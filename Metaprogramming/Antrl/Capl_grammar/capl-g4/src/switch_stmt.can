variables
{

}

void func()
{
    float value1, value2, result;
    char operator;

    switch ( operator )
    {
        case '+':
            result = value1 + value2;
            break;

        case '-':
            result = value1 - value2;
            break;

        case '*':
            result = value1 * value2;
            break;

        case '/':
            if ( value2 == 0)
                write ("Division by zero!");
            else
                result = value1 / value2;
            break;

        default:
            write ("Unknown operator.");
            break;
    }
}