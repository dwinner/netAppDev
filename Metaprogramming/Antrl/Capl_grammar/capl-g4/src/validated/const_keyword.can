variables
{
    const long kOff = 0;
    const long kOn = 1;
}

on message LightState
{
    if (this.dir == RX)
    {
        SetLightDsp(this.HeadLight, this.FlashLight);
    }    
    else
    {
        write ("Error: LightState TX received by node %NODE_NAME");
    }    
}

SetLightDsp (long headLight, long hazardFlasher)
{
    long tmpLightDsp;

    tmpLightDsp = 0;
    if (headLight == kOn)
        tmpLightDsp = 4;
    if (hazardFlasher == kOn)
        tmpLightDsp += 3;   
}
