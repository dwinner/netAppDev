variables
{
    multiplexed_message * mpMessage;
}

on message mpMessage
{
    write("received");
}

on multiplexed_message mpMessage
{
    write("received");
}