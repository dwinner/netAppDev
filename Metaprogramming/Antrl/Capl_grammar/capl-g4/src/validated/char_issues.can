variables
{
    char value5 = 'B';
    char value6 = '8';
    char value7 = '?';
}

on key 'a' // for the lowercase 'a' key only
{
    // print the ‘a’ key
    write("The 'a' key is pressed");
}

on key 'b'
{
    conditionA =! conditionA; // toggle conditionA
    if(conditionA == 1) // if condition is active
    {
        setTimer(timerA,200); // then start timer
    }
}

on key F1
{
    setTimer(mytimer, 100); // start 100 ms timer
    write("F1 pressed"); // output to Write window
}

on key *
{
    // starts the Logging block "Logging 1" with pre-trigger time of 2000 milliseconds.
    startLogging( "Logging 1", 2000);
}