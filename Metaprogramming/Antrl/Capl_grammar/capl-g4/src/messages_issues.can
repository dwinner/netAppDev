variables
{
    message * all;
    message 100 msg; // CAN message
    msTimer myTimer; // creates a millisecond timer
    message wake-up xxx; // see Chapter 11 on using messages for more detail
    message 100 msg; // creates message 100
    message 0x555 msg1 = {dlc = 1};
    message 0x400 msgA = {dlc=1};
    message 0x100 eTemp = {DLC = 8};
    message 0x100 msg2 = {dlc = 8}; // declare message to send
    message 0x555 msg3 = {dlc=1};
}

on message 100 // this example triggers all the Logging blocks
{
    writeToLog("Logging starts");
    // this example sets the pre-trigger time before logging to 25 milliseconds:
    setPreTrigger(25);
    trigger(); // start logging
}

on message 555
{
    byte val;
    val = 0;

    /* checks to see if the message was received on CAN channel 1*/
    if (this.CAN == 1)
    {
        // sets "val" to the value of the first data byte in the CAN message
        val = this.byte(0);
    }
}

on timer myTimer // when myTimer expires (after 20 ms)
{
    output(msg); // output the message

    msg1.byte(0) = msg1.byte(0) + 1; // increment the data
    output(msg1); // output message
    setTimer(timer1, 100); // reset the timer

    msgA.byte(0)=msgA.byte(0)-1; // change the data
    output(msgA); // output message
}

on message CAN2.0x100 // for messages with ID equal to 0x100 from CAN channel 2
{    
    // print
    write("The message with ID 0x100 is received from CAN channel 2.");
}

on message 0x100 // for messages with ID equal to 100 in hex only
{
    // print
    write("The message with ID 0x100 is received.");
}