variables
{
    // type casting
    int sum;
    sum = 1.6 + 1.7;
    sum = (int) 1.6 + (int) 1.7;

    // arrays
    char alphabet[27] = "ABCDEFGHIJKLMNOPQRSTUVWXYZ";
    int sample_data[4] = { 100, 300, 500, 600 };
    int M[4][5] =
    {
        { 10, 5, -3, 17, 82 },
        { 9, 0, 0, 8, -7 },
        { 32, 20, 1, 0, 14 },
        { 0, 0, 8, 7, 6 }
    };

    // initializers
    int value = 20;
    int value2 = 0x14;
    float value3 = 0.23;
    float value4 = 23E-2;

    char value8 = 0x42;
    char value9 = 0x38;
    char value10 = 0x3F;

    char value11[30] = "Here’s a string in C and CAPL";
    char value12[19] = "spaces are allowed";
    char value13[31] = "with a tab escape sequence \t";

    char buffer[10];
}

void myFunc()
{
    byte value = 10; // static; called once
    write("value = %d", value);
    value = 35;
}

void myFunc2()
{
    byte value; // variable declarations
    int x, y;
    value = 10; // variable initializations
    x = 0;
    y = 5;    
}