variables
{
    /* declarating a struct */
    struct MyData {
        int i;
        float f;
    };
}

on start
{
    /* defining a struct variable and initiliazing the elements */
    struct MyData data = {
        i = 42,
        f = 1.32
    };

    /* accessing the struct elements */
    write("i=%d, f=%f", data.i, data.f);
}