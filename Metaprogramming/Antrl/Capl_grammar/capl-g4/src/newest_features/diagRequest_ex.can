/*@!Encoding:1252*/
// --------------------------------------------------
// Simple diagnostics ECU simulation.
// For the sake of simplicity, this example omits 
// security access mechanisms, especially for the
// write services. In many cases, return parameters
// are not checked as well.
// Only a subset of services will be answered with
// a positive response, for the rest a negative
// response "Service not supported" will be
// returned.
//
// CANoe 10.0 SP6
// --------------------------------------------------

includes
{
  
}

variables
{

}

on diagRequest Door.*
{
  diagResponse this resp;
  diagSendNegativeResponse(resp, 0x11);
}

on diagRequest Door.Sessions::*
{
  diagResponse this resp;
  byte sessionState;
  
  sessionState = DiagGetPrimitiveByte(this, 1); // Retrieve the session state of the request
  if(sessionState<0)
    write("Could not retrieve session state on ECU side. Error %d", sessionState);
    
  // Send a positive response to the session states 0x01, 0x02 and 0x03 only
  if(sessionState > 0x00 && sessionState < 0x04)
  {
    diagSendPositiveResponse(resp);
  }
  else
  {
    diagSendNegativeResponse(resp, 0x12); // Send NRC 0x12: Subfunction not supported
  }
}

