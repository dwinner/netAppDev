on sysvar sysvar::VTS::Speed::PWMFreq 
{ 
    if (@sysvar::VTS::Speed::PWMFreq > 100) 
        TestSupplyTextEvent (“Speed100”); 
}
 
testcase TC () 
{   
    TestWaitForTextEvent (“Speed100”, 2000);
    @sysvar::Lights::LightDisplay = tmpLightDsp;    
}

on message EngineState
{
    @sysvar::Engine::EngineSpeedDspMeter = this.EngineSpeed / 1000.0;
}