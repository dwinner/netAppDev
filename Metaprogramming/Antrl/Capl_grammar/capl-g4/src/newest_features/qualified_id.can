variables
{
    int var_DBLookupDefaultValue;

    var_DBLookupDefaultValue = (DBLookup(lookupSignal(parsedSignal)).DefaultValue * DBLookup(lookupSignal(parsedSignal)).factor)
                                        + DBLookup(lookupSignal(parsedSignal)).offset;
}
/*
testcase TEST_001()
{
    dword index; 
  
    int var_DBLookupDefaultValue; 
    int var_DBLookupGenSigStartValue; 
    int var_getSignal; 
    int var_phys_val; 
    int var_raw_val; 
    
    glbHandle = OpenFileRead("D:\\ExportOfSignalsList.txt", 0); 
  
    while(fileGetStringSZ(parsedSignal, elcount(parsedSignal), glbHandle)) 
    { 
        // This could be verified by comparing if DBLookup().DefaultValue returns a zero value 
        if ((DBLookup(lookupSignal(parsedSignal)).DefaultValue == 0)
            && (DBLookup(lookupSignal(parsedSignal)).GenSigStartValue == 0))
        { 
            // phy = (raw x factor) + offset 
            var_DBLookupDefaultValue = (DBLookup(lookupSignal(parsedSignal)).DefaultValue * DBLookup(lookupSignal(parsedSignal)).factor)
                                        + DBLookup(lookupSignal(parsedSignal)).offset; 
        } 
        else 
        { 
            var_DBLookupDefaultValue = DBLookup(lookupSignal(parsedSignal)).DefaultValue; 
        } 
  
        var_DBLookupGenSigStartValue = DBLookup(lookupSignal(parsedSignal)).GenSigStartValue; 
        var_getSignal = getSignal(parsedSignal); 
        var_raw_val = raw_val(lookupSignal(parsedSignal)); 
        var_phys_val = phys_val(lookupSignal(parsedSignal)); 
        
        write("Default/Init/Received Values of '%s':", parsedSignal); 
        write("DB value (i.e. physical value) is %d", var_DBLookupDefaultValue); 
        write("DB value (i.e. init value) is %d", var_DBLookupGenSigStartValue); 
        write("Received value is %d (phy: form 1)", var_getSignal); 
        write("Received value is %d (phy: form 2)", var_phys_val); 
        write("Received value is %d (raw: form 2)", var_raw_val);      
       
        if (TestWaitForSignal(lookupSignal(parsedSignal), 2000) == 1)
        { 
            if(DBLookup(lookupSignal(parsedSignal)) == 1) // if the parsed string is indeed a signal 
            { 
                if(var_DBLookupDefaultValue == var_getSignal) 
                { 
                    write("      > PASS: DBC default value & bus-received value of CAN signal '%s' match\n\n", parsedSignal); 
                } 
                else 
                { 
                    write("      > FAIL: DBC default value & bus-received value of CAN signal '%s' do not match\n\n", parsedSignal); 
                } 
            } 
        } 
    } 
}
*/