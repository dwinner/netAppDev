enum OPTION_1
{
    ACTIVATED   = 1,
    DEACTIVATED = 0
};

enum OPTION_2
{
    ON  = 1,
    OFF = 0
};

variables
{
    enum OPTION_1 opt1;
    enum OPTION_2 opt2;

    opt1 = OPTION_1.ACTIVATED;
    opt2 = OPTION_2.OFF;
}
