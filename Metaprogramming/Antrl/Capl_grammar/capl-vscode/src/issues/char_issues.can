variables
{
    char value5 = 'B';
    char value6 = '8';
}
