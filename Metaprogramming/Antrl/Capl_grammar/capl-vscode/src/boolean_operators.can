variables
{
    byte y, z;
    y = 0x00;
    z = 0x01;
    if (!y) // test result is TRUE
    {

    }

    if (!z) // test result is FALSE
    {

    }

    if (y == 0 && z == 1) // test result is TRUE
    {

    }

    if (y == 1 || z == 1) // test result is TRUE
    {
        
    }
}