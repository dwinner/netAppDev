variables
{

}

on errorFrame
{
    if (this.can == 1 && (timeNow() – pretime) < 100000)
        write(“Error frames received less than one second apart on channel 1.”);
}