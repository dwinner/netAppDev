variables
{
    byte binaryArray[16]; // global variable
}

binary ( int number ) // user-defined CAPL function
{
    int index;
    index = 0;
    for ( ; number != 0; )
    {
        binaryArray[index++] = number % 10;
        number = number / 10;
    }
}