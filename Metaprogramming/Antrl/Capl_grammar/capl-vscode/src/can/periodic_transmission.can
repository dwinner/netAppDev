variables
{
    message 0x555 msg1 = {dlc=1};
    mstimer timer1; // define timer1
}

on start
{
    setTimer(timer1,100); // initialize timer to 100 msec
}

on timer timer1
{
    setTimer(timer1,100); // reset timer
    msg1.byte(0)=msg1.byte(0)+1; // change the data
    output(msg1); // output message
}