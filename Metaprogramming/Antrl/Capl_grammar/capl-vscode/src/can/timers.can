variables
{
    msTimer myTimer; // creates a millisecond timer
    message 100 msg; // creates message 100

    message 0x555 msg1 = {dlc = 1};
    mstimer timer1; // define timer1
}

on key 'a' // when the 'a' key is pressed
{
    setTimer(myTimer,20); // set myTimer to 20 ms
    setTimer(timer1, 100); // initialize timer to run for 100 msec
}

on timer myTimer // when myTimer expires (after 20 ms)
{
    output(msg); // output the message

    msg1.byte(0) = msg1.byte(0) + 1; // increment the data
    output(msg1); // output message
    setTimer(timer1, 100); // reset the timer
}