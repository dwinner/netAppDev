/*@!Encoding:1252*/
/*
Copyright ( C ) Continental AG 2012

Date of creation :  14.04.2011

Created by :                 Hans Jürgen Hipp


Version info

1.00	   02.2014	Inital versioning introduced
1.1	19.02.2014	HMI_2014_05a database

*/


variables
{
    // IC_408h
    word       _IC_408h_CycleTime =            100;
    byte       _IC_408h_CycleReduction =         0;
    byte      _cIC_408h_CycleReductionValue =   10;
    const word _IC_408h_OnEventDetectTime =     90;
    byte       _IC_408h_OnEventTrap_Active =     0;
    msTimer    tIC_408h_OnEventTrap;
    msTimer    tIC_408h_OnEventIND;

    // IC_412h
    word       _IC_412h_CycleTime =            100;
    byte       _IC_412h_CycleReduction =         0;
    byte      _cIC_412h_CycleReductionValue =   10;
    const word _IC_412h_OnEventDetectTime =     90;
    byte       _IC_412h_OnEventTrap_Active =     0;
    msTimer    tIC_412h_OnEventTrap;
    msTimer    tIC_412h_OnEventIND;

    // IC_52Ah
    word       _IC_52Ah_CycleTime =           1000;
    byte       _IC_52Ah_CycleReduction =         0;
    byte      _cIC_52Ah_CycleReductionValue =    5;
    const word _IC_52Ah_OnEventDetectTime =    990;
    byte       _IC_52Ah_OnEventTrap_Active =     0;
    msTimer    tIC_52Ah_OnEventTrap;
    msTimer    tIC_52Ah_OnEventIND;

}

on message IC_408h
{
    byte bAliveCtr;

    //putValue( HMI_SwIllLvl, this.SwIllLvl.phys );

// --- cyclicAndSpontanWithDelay 5 --- 200ms cycle time ---
// Evaluate if received message is on event 
    bAliveCtr = getValue( TCO__MSGAliveCtr_IC_408h );
    if( _IC_408h_OnEventTrap_Active )
    {
        putValue( TCO__MSG_OnEvent_IC_408h, 1 );
        cancelTimer( tIC_408h_OnEventIND );
        setTimer( tIC_408h_OnEventIND, 1000 );
    }
    else
    {
        _IC_408h_CycleReduction++;
        if( _IC_408h_CycleReduction >= _cIC_408h_CycleReductionValue )
        {
            _IC_408h_CycleReduction = 0;
            if( bAliveCtr < 8 )
            {
                bAliveCtr = ( bAliveCtr + 1 ) & 0x07;
            }
            else
            {
                bAliveCtr = 0;
            }
        }
        putValue( TCO__MSGAliveCtr_IC_408h, bAliveCtr );
        _IC_408h_OnEventTrap_Active = 1;
        setTimer( tIC_408h_OnEventTrap, _IC_408h_OnEventDetectTime );
    }
}

on timer tIC_408h_OnEventIND
{
    putValue( TCO__MSG_OnEvent_IC_408h, 0 );
}

on timer tIC_408h_OnEventTrap
{
    _IC_408h_OnEventTrap_Active = 0;
}

on message IC_412h
{
    byte bAliveCtr;

    putValue( HMI_VehSpd_Disp, 				this.VehSpd_Disp.phys );

// --- cyclicAndSpontanWithDelay 5 --- 1000ms cycle time ---
// Evaluate if received message is on event 
    bAliveCtr = getValue( TCO__MSGAliveCtr_IC_412h );
    if( _IC_412h_OnEventTrap_Active )
    {
        putValue( TCO__MSG_OnEvent_IC_412h, 1 );
        cancelTimer( tIC_412h_OnEventIND );
        setTimer( tIC_412h_OnEventIND, 1000 );
    }
    else
    {
        if( bAliveCtr < 8 )
        {
            bAliveCtr = ( bAliveCtr + 1 ) & 0x07;
        }
        else
        {
            bAliveCtr = 0;
		}
        putValue( TCO__MSGAliveCtr_IC_412h, bAliveCtr );
        _IC_412h_OnEventTrap_Active = 1;
        setTimer( tIC_412h_OnEventTrap, _IC_412h_OnEventDetectTime );
    }
}

on timer tIC_412h_OnEventIND
{
    putValue( TCO__MSG_OnEvent_IC_412h, 0 );
}

on timer tIC_412h_OnEventTrap
{
    _IC_412h_OnEventTrap_Active = 0;
}

on message IC_52Ah
{
    byte bAliveCtr;

    putValue( TCO_Reset_1, this.Reset_1.phys );
    putValue( TCO_Reset_2, this.Reset_2.phys );

// --- cyclicAndSpontanWithDelay 5 --- 200ms cycle time ---
// Evaluate if received message is on event 
    bAliveCtr = getValue( TCO__MSGAliveCtr_IC_52Ah );
    if( _IC_52Ah_OnEventTrap_Active )
    {
        putValue( TCO__MSG_OnEvent_IC_52Ah, 1 );
        cancelTimer( tIC_52Ah_OnEventIND );
        setTimer( tIC_52Ah_OnEventIND, 1000 );
    }
    else
    {
        _IC_52Ah_CycleReduction++;
        if( _IC_52Ah_CycleReduction >= _cIC_52Ah_CycleReductionValue )
        {
            _IC_52Ah_CycleReduction = 0;
            if( bAliveCtr < 8 )
            {
                bAliveCtr = ( bAliveCtr + 1 ) & 0x07;
            }
            else
            {
                bAliveCtr = 0;
            }
        }
        putValue( TCO__MSGAliveCtr_IC_52Ah, bAliveCtr );
        _IC_52Ah_OnEventTrap_Active = 1;
        setTimer( tIC_52Ah_OnEventTrap, _IC_52Ah_OnEventDetectTime );
    }
}

on timer tIC_52Ah_OnEventIND
{
    putValue( TCO__MSG_OnEvent_IC_52Ah, 0 );
}

on timer tIC_52Ah_OnEventTrap
{
    _IC_52Ah_OnEventTrap_Active = 0;
}

