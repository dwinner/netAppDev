/*@@var:*/
/*
Copyright ( C ) Continental AG 2012

Date of creation :  14.04.2011

Created by :                 Hans Jürgen Hipp


Version info

1.0	   10.2013	Inital versioning introduced

*/


variables
{
}
/*@@end*/

/*@@msg:CAN1.hmi_2011_29a::HUD_Stat_AR (0x459):*/
on message HUD_Stat_AR
{
	putValue( HMI_HUD_ImgSwiv_Rq, this.HUD_ImgSwiv_Rq.phys );
	putValue( HMI_HUD_Menu_ArrDown_Rq, this.HUD_Menu_ArrDown_Rq.phys );
	putValue( HMI_HUD_Menu_ArrUp_Rq, this.HUD_Menu_ArrUp_Rq.phys );
	putValue( HMI_HUD_Pos_Stat, this.HUD_Pos_Stat.phys );
	putValue( HMI_HUD_Stat, this.HUD_Stat.phys );
}
/*@@end*/

/*@@msg:CAN1.hmi_2011_29a::Meas_HUD_1 (0x18EF4203X):*/
on message Meas_HUD_1
{
	putValue( HMI_Meas_HUD_1A, this.Meas_HUD_1A.phys );
	putValue( HMI_Meas_HUD_1B, this.Meas_HUD_1B.phys );
	putValue( HMI_Meas_HUD_1C, this.Meas_HUD_1C.phys );
	putValue( HMI_Meas_HUD_1D, this.Meas_HUD_1D.phys );
	putValue( HMI_Meas_HUD_1E, this.Meas_HUD_1E.phys );
	putValue( HMI_Meas_HUD_1F, this.Meas_HUD_1F.phys );
	putValue( HMI_Meas_HUD_1G, this.Meas_HUD_1G.phys );
	putValue( HMI_Meas_HUD_1H, this.Meas_HUD_1H.phys );
}
/*@@end*/

/*@@msg:CAN1.hmi_2011_29a::ROE_HUD (0x18EF4200X):*/
on message ROE_HUD
{
	putValue( HMI_ROE_DTC_HUD, this.ROE_DTC_HUD.phys );
	putValue( HMI_ROE_DTC_Stat_HUD, this.ROE_DTC_Stat_HUD.phys );
	putValue( HMI_ROE_Header_HUD, this.ROE_Header_HUD.phys );
}
/*@@end*/

/*@@msg:CAN1.hmi_2011_29a::NM_HUD_AR (0x542):*/
on message NM_HUD_AR
{
	putValue( HMI_Awake_Diag_Actv_HUD, this.Awake_Diag_Actv.phys );
	putValue( HMI_Awake_Ignition_On_HUD, this.Awake_Ignition_On.phys );
	putValue( HMI_WakeupRsn_HUD, this.WakeupRsn_HUD.phys );
}
/*@@end*/

