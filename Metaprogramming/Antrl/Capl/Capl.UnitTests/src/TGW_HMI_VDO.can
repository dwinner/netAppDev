/*@!Encoding:1252*/
/*
Copyright ( C ) Continental AG 2012

Date of creation :  14.04.2011

Created by :                 Hans Jürgen Hipp


Version info

1.00	   10.2013	Inital versioning introduced
1.1	04.11.2013	HMI_2013_42a database

*/


variables
{
    const TRUE =      0xAA;
    const FALSE =     0x00;
    const cManual =   0x00;
    const cAuto =     0xAA;

    const word cFLDoorNMRequest =       0x0001;
    const word cFRDoorNMRequest =       0x0002;
    const word cRLDoorNMRequest =       0x0004;
    const word cRRDoorNMRequest =       0x0008;
    const word cAllDoorNMRequest =      0x000F;
    const word cIgnitionNMRequest =     0x0010;
    const word cStWhlButtonNMRequest =  0x0020;
    const word cWakeWarningNMRequest =  0x0040;
    const word cEPKBWarningNMRequest =  0x0080;
    const word cIlluNMRequest =         0x0100;
    const word cCarClosureNMRequest =   0x0200;
    const word cGearIndNMRequest =      0x0400;
    const word cLowBeamNMRequest =      0x0800;

    const word cManualNMRequest =       0x8000;
    const word cAllNMRequest =          0xFFFF;



    /* Botschaft Disp_IC_Rq_AR ID: 314 --- Sendeart 5 cyclicAndSpontanWithDelay --- 
BA_ "ApplMessage" BO_ 314 0;
BA_ "NmAsrMessage" BO_ 314 0;
BA_ "GenMsgMinAcceptLength" BO_ 314 6;
BA_ "GenMsgILSupport" BO_ 314 1;
BA_ "DiagState" BO_ 314 0;
BA_ "DiagRequest" BO_ 314 0;
BA_ "DiagResponse" BO_ 314 0;
BA_ "GenMsgStartValue" BO_ 314 "0";
BA_ "GenMsgStartDelayTime" BO_ 314 35;
BA_ "GenMsgDelayTime" BO_ 314 20;
BA_ "GenMsgNrOfRepetition" BO_ 314 0;
BA_ "GenMsgCycleTime" BO_ 314 100;
BA_ "GenMsgSendType" BO_ 314 5;
    */ 
    word       _Disp_IC_Rq_AR_CycleTime =            100;
    byte       _Disp_IC_Rq_AR_CycleReduction =         0;
    byte      _cDisp_IC_Rq_AR_CycleReductionValue =    5;
    const word _Disp_IC_Rq_AR_OnEventDetectTime =     90;
    byte       _Disp_IC_Rq_AR_OnEventTrap_Active =     0;
    msTimer    tDisp_IC_Rq_AR_OnEventTrap;
    msTimer    tDisp_IC_Rq_AR_OnEventIND;

    /* Botschaft Dimming_Stat_AR ID: 1081 --- Sendeart 5 cyclicAndSpontanWithDelay --- 
BA_ "ApplMessage" BO_ 1081 0;
BA_ "NmAsrMessage" BO_ 1081 0;
BA_ "GenMsgMinAcceptLength" BO_ 1081 4;
BA_ "GenMsgILSupport" BO_ 1081 1;
BA_ "DiagState" BO_ 1081 0;
BA_ "DiagRequest" BO_ 1081 0;
BA_ "DiagResponse" BO_ 1081 0;
BA_ "GenMsgStartValue" BO_ 1081 "0";
BA_ "GenMsgStartDelayTime" BO_ 1081 20;
BA_ "GenMsgDelayTime" BO_ 1081 50;
BA_ "GenMsgNrOfRepetitions" BO_ 1081 0;
BA_ "GenMsgCycleTime" BO_ 1081 200;
BA_ "GenMsgSendType" BO_ 1081 5;
    */ 
    word       _Dimming_Stat_AR_CycleTime =            200;
    byte       _Dimming_Stat_AR_CycleReduction =         0;
    byte      _cDimming_Stat_AR_CycleReductionValue =    5;
    const word _Dimming_Stat_AR_OnEventDetectTime =    190;
    byte       _Dimming_Stat_AR_OnEventTrap_Active =     0;
    msTimer    tDimming_Stat_AR_OnEventTrap;
    msTimer    tDimming_Stat_AR_OnEventIND;

    /* Botschaft IC_BasicInfo_AR ID: 777 --- Sendeart 5 cyclicAndSpontanWithDelay --- 
BA_ "ApplMessage" BO_ 777 0;
BA_ "NmAsrMessage" BO_ 777 0;
BA_ "GenMsgMinAcceptLength" BO_ 777 8;
BA_ "GenMsgILSupport" BO_ 777 1;
BA_ "DiagState" BO_ 777 0;
BA_ "DiagRequest" BO_ 777 0;
BA_ "DiagResponse" BO_ 777 0;
BA_ "GenMsgStartValue" BO_ 777 "0";
BA_ "GenMsgStartDelayTime" BO_ 777 295;
BA_ "GenMsgDelayTime" BO_ 777 100;
BA_ "GenMsgNrOfRepetitions" BO_ 777 0;
BA_ "GenMsgCycleTime" BO_ 777 1000;
BA_ "GenMsgSendType" BO_ 777 5;
    */
    word       _IC_BasicInfo_AR_CycleTime =           1000;
    byte       _IC_BasicInfo_AR_CycleReduction =         0;
    byte      _cIC_BasicInfo_AR_CycleReductionValue =    5;
    const word _IC_BasicInfo_AR_OnEventDetectTime =    990;
    byte       _IC_BasicInfo_AR_OnEventTrap_Active =     0;
    msTimer    tIC_BasicInfo_AR_OnEventTrap;
    msTimer    tIC_BasicInfo_AR_OnEventIND;

    // NM_IC_AR
    word       _NM_IC_AR_CycleTime =           1000;
    byte       _NM_IC_AR_CycleReduction =         0;
    byte      _cNM_IC_AR_CycleReductionValue =    5;
    const word _NM_IC_AR_OnEventDetectTime =    990;
    byte       _NM_IC_AR_OnEventTrap_Active =     0;
    msTimer    tNM_IC_AR_OnEventTrap;
    msTimer    tNM_IC_AR_OnEventIND;

    /* Botschaft RTC_Date_Time_AR ID: 779 --- Sendeart 5 cyclicAndSpontanWithDelay --- 
BA_ "ApplMessage" BO_ 779 0;
BA_ "NmAsrMessage" BO_ 779 0;
BA_ "GenMsgMinAcceptLength" BO_ 779 8;
BA_ "GenMsgILSupport" BO_ 779 1;
BA_ "DiagState" BO_ 779 0;
BA_ "DiagRequest" BO_ 779 0;
BA_ "DiagResponse" BO_ 779 0;
BA_ "GenMsgStartValue" BO_ 779 "0";
BA_ "GenMsgStartDelayTime" BO_ 779 250;
BA_ "GenMsgDelayTime" BO_ 779 40;
BA_ "GenMsgNrOfRepetitions" BO_ 779 0;
BA_ "GenMsgCycleTime" BO_ 779 1000;
BA_ "GenMsgSendType" BO_ 779 5;
    */
    word       _RTC_Date_Time_AR_CycleTime =           1000;
    byte       _RTC_Date_Time_AR_CycleReduction =         0;
    byte      _cRTC_Date_Time_AR_CycleReductionValue =    5;
    const word _RTC_Date_Time_AR_OnEventDetectTime =    990;
    byte       _RTC_Date_Time_AR_OnEventTrap_Active =     0;
    msTimer    tRTC_Date_Time_AR_OnEventTrap;
    msTimer    tRTC_Date_Time_AR_OnEventIND;


    byte  crctable_profile02[256] = {
        0x00, 0x2F, 0x5E, 0x71, 0xBC, 0x93, 0xE2, 0xCD, 0x57, 0x78, 0x09, 0x26, 0xEB, 0xC4, 0xB5, 0x9A,
        0xAE, 0x81, 0xF0, 0xDF, 0x12, 0x3D, 0x4C, 0x63, 0xF9, 0xD6, 0xA7, 0x88, 0x45, 0x6A, 0x1B, 0x34,
        0x73, 0x5C, 0x2D, 0x02, 0xCF, 0xE0, 0x91, 0xBE, 0x24, 0x0B, 0x7A, 0x55, 0x98, 0xB7, 0xC6, 0xE9,
        0xDD, 0xF2, 0x83, 0xAC, 0x61, 0x4E, 0x3F, 0x10, 0x8A, 0xA5, 0xD4, 0xFB, 0x36, 0x19, 0x68, 0x47,
        0xE6, 0xC9, 0xB8, 0x97, 0x5A, 0x75, 0x04, 0x2B, 0xB1, 0x9E, 0xEF, 0xC0, 0x0D, 0x22, 0x53, 0x7C,
        0x48, 0x67, 0x16, 0x39, 0xF4, 0xDB, 0xAA, 0x85, 0x1F, 0x30, 0x41, 0x6E, 0xA3, 0x8C, 0xFD, 0xD2,
        0x95, 0xBA, 0xCB, 0xE4, 0x29, 0x06, 0x77, 0x58, 0xC2, 0xED, 0x9C, 0xB3, 0x7E, 0x51, 0x20, 0x0F,
        0x3B, 0x14, 0x65, 0x4A, 0x87, 0xA8, 0xD9, 0xF6, 0x6C, 0x43, 0x32, 0x1D, 0xD0, 0xFF, 0x8E, 0xA1,
        0xE3, 0xCC, 0xBD, 0x92, 0x5F, 0x70, 0x01, 0x2E, 0xB4, 0x9B, 0xEA, 0xC5, 0x08, 0x27, 0x56, 0x79,
        0x4D, 0x62, 0x13, 0x3C, 0xF1, 0xDE, 0xAF, 0x80, 0x1A, 0x35, 0x44, 0x6B, 0xA6, 0x89, 0xF8, 0xD7,
        0x90, 0xBF, 0xCE, 0xE1, 0x2C, 0x03, 0x72, 0x5D, 0xC7, 0xE8, 0x99, 0xB6, 0x7B, 0x54, 0x25, 0x0A,
        0x3E, 0x11, 0x60, 0x4F, 0x82, 0xAD, 0xDC, 0xF3, 0x69, 0x46, 0x37, 0x18, 0xD5, 0xFA, 0x8B, 0xA4,
        0x05, 0x2A, 0x5B, 0x74, 0xB9, 0x96, 0xE7, 0xC8, 0x52, 0x7D, 0x0C, 0x23, 0xEE, 0xC1, 0xB0, 0x9F,
        0xAB, 0x84, 0xF5, 0xDA, 0x17, 0x38, 0x49, 0x66, 0xFC, 0xD3, 0xA2, 0x8D, 0x40, 0x6F, 0x1E, 0x31,
        0x76, 0x59, 0x28, 0x07, 0xCA, 0xE5, 0x94, 0xBB, 0x21, 0x0E, 0x7F, 0x50, 0x9D, 0xB2, 0xC3, 0xEC,
        0xD8, 0xF7, 0x86, 0xA9, 0x64, 0x4B, 0x3A, 0x15, 0x8F, 0xA0, 0xD1, 0xFE, 0x33, 0x1C, 0x6D, 0x42
    };



}

on start
{
    putValue( Env_HIL_Submenu_Msg_Byte2,	0xFF );
    putValue( Env_HIL_Submenu_Msg_Byte1,	0xFF );
    putValue( Env_HIL_MainMenu,	            0xFF );
}

on message Dimming_Stat_AR
{
    putValue( HU_DispBrt_IC, this.DispBrt_IC.phys );
    putValue( HU_FctIllLvl, this.FctIllLvl.phys );
    putValue( HU_IP_Brt_IC, this.IP_Brt_IC.phys );
    putValue( HU_SwIll_NightDay, this.SwIll_NightDay.phys );
    putValue( HU_SwIllLvl, this.SwIllLvl.phys );
    putValue( HU_SwIllLvl_Dim_Md, this.SwIllLvl_Dim_Md.phys );
    putValue( HU_SwIllLvl_Stat_AMG, this.SwIllLvl_Stat_AMG.phys );
}

/*@@timer:tDimming_Stat_AR_OnEventIND:*/
on timer tDimming_Stat_AR_OnEventIND
{
    putValue( HMI__MSG_OnEvent_Dimming_Stat_AR, 0 );
}

on timer tDimming_Stat_AR_OnEventTrap
{
    _Dimming_Stat_AR_OnEventTrap_Active = 0;
}

on message Disp_IC_Rq_AR
{
    if( getValue( Env_DISP_IC_BackLgt_Rq_Source_IC ) )
    {
        putValue( HU_DISP_IC_BackLgt_Rq, this.DISP_IC_BackLgt_Rq.phys );
    }
    if( getValue( Env_DISP_IC_Brt_Rq_Source_IC ) )
    {
        putValue( HU_DISP_IC_Brt_Rq, this.DISP_IC_Brt_Rq.phys );
    }
    if( getValue( Env_DISP_IC_BrtOffset_Rq_Source_IC ) )
    {
        putValue( HU_DISP_IC_BrtOffset_Rq, this.DISP_IC_BrtOffset_Rq.phys );
    }
    if( getValue( Env_DISP_IC_On_Rq_Source_IC ) )
    {
        putValue( HU_DISP_IC_On_Rq, this.DISP_IC_On_Rq.phys );
    }
    if( getValue( Env_DISP_IC_SafeState_Rq_Source_IC ) )
    {
        putValue( HU_DISP_IC_SafeState_Rq, this.DISP_IC_SafeState_Rq.phys );
    }
}

on timer tDisp_IC_Rq_AR_OnEventIND
{
    putValue( HMI__MSG_OnEvent_Disp_IC_Rq_AR, 0 );
}

on timer tDisp_IC_Rq_AR_OnEventTrap
{
    _Disp_IC_Rq_AR_OnEventTrap_Active = 0;
}

on message IC_BasicInfo_AR
{
    putValue( HU_AirTemp_Outsd_Disp, 		this.AirTemp_Outsd_Disp.phys );
    putValue( HU_IC_TP_Alive, 				this.IC_TP_Alive.phys );//neu SLP10.08
    putValue( HU_Odo, 						this.Odo.phys );
    putValue( HU_UnitVehSpd, 				this.UnitVehSpd.phys );
    putValue( HU_VehSpd_Disp, 				this.VehSpd_Disp.phys );
}
/*@@end*/

on timer tIC_BasicInfo_AR_OnEventIND
{
    putValue( HMI__MSG_OnEvent_IC_BasicInfo_AR, 0 );
}

on timer tIC_BasicInfo_AR_OnEventTrap
{
    _IC_BasicInfo_AR_OnEventTrap_Active = 0;
}

on message NM_IC_AR
{
    byte bAliveCtr;

	putValue( HMI_NM_Awake_DataExchg_Actv_IC, this.Awake_DataExchg_Actv.phys );
	putValue( HMI_NM_Awake_Diag_Actv_IC, this.Awake_Diag_Actv.phys );
	putValue( HMI_NM_Awake_HU_On_IC, this.Awake_HU_On.phys );
	putValue( HMI_NM_Awake_IC_On_IC, this.Awake_IC_On.phys );
	putValue( HMI_NM_Awake_IgnitionAccessory_On_IC, this.Awake_IgnitionAccessory_On.phys );
	putValue( HMI_NM_Awake_NwSt_IC, this.Awake_NwSt.phys );
	putValue( HMI_NM_Awake_SwIllLvl_IC, this.Awake_SwIllLvl.phys );
	putValue( HMI_NM_Awake_TGW_Actv_IC, this.Awake_TGW_Actv.phys );
	putValue( HMI_NM_ActvWakeup_IC, this.NM_ActvWakeup.phys );
	putValue( HMI_NM_Coord_Id_IC, this.NM_Coord_Id.phys );
	putValue( HMI_NM_Coord_SleepRdy_IC, this.NM_Coord_SleepRdy.phys );
	putValue( HMI_NM_PartNw_Info_IC, this.NM_PartNw_Info.phys );
	putValue( HMI_NM_RepeatMsg_Rq_IC, this.NM_RepeatMsg_Rq.phys );
	putValue( HMI_NM_SrcNode_Id_IC, this.NM_SrcNode_Id.phys );
	putValue( HMI_NM_WakeupRsn_IC, this.WakeupRsn_IC.phys );
 
// --- spontan 1 --- 
// Evaluate if received message is on event 
    bAliveCtr = getValue( HMI__MSGAliveCtr_NM_IC_AR );
    if( _NM_IC_AR_OnEventTrap_Active )
    {
        putValue( HMI__MSG_OnEvent_NM_IC_AR, 1 );
        cancelTimer( tNM_IC_AR_OnEventIND );
        setTimer( tNM_IC_AR_OnEventIND, 1000 );
    }
    else
    {
        if( bAliveCtr < 8 )
        {
            bAliveCtr = ( bAliveCtr + 1 ) & 0x07;
        }
        else
        {
            bAliveCtr = 0;
		}
        putValue( HMI__MSGAliveCtr_NM_IC_AR, bAliveCtr );
        _NM_IC_AR_OnEventTrap_Active = 1;
        setTimer( tNM_IC_AR_OnEventTrap, _NM_IC_AR_OnEventDetectTime );
    }
}

on timer tNM_IC_AR_OnEventIND
{
    putValue( HU__NM_TGW_NM_Request, cIgnitionNMRequest );
 //   putValue( HU__NM_Remote_ReleaseCommRequest, 1 );
}

on timer tNM_IC_AR_OnEventTrap
{
    _NM_IC_AR_OnEventTrap_Active = 0;
}

on message RTC_Date_Time_AR
{
 /*   putValue( HU_DateTmDay, this.DateTmDay.phys );
    putValue( HU_DateTmHour, this.DateTmHour.phys );
    putValue( HU_DateTmMinute, this.DateTmMinute.phys );
    putValue( HU_DateTmMonth, this.DateTmMonth.phys );
    putValue( HU_DateTmSecond, this.DateTmSecond.phys );
    putValue( HU_DateTmStat, this.DateTmStat.phys );
    putValue( HU_DateTmWeekday, this.DateTmWeekday.phys );
    putValue( HU_DateTmYear, this.DateTmYear.phys );
    putValue( HU_ICH_Dur_Rq, this.ICH_Dur_Rq.phys );
    putValue( HU_ICH_HtVn_Rq_IC, this.ICH_HtVn_Rq_IC.phys );*/
}

on timer tRTC_Date_Time_AR_OnEventIND
{
    putValue( HMI__MSG_OnEvent_RTC_Date_Time_AR, 0 );
}

on timer tRTC_Date_Time_AR_OnEventTrap
{
    _RTC_Date_Time_AR_OnEventTrap_Active = 0;
}

on message 0x500-0x57F
{
//    setTimer( tNM_IC_AR_OnEventIND, 1200 );
//    putValue( HU__NM_TGW_NM_Request, cIgnitionNMRequest );
//    putValue( HU__NM_Remote_SetCommRequest, 1 );
}

on message Ign_Veh_Stat_AR
{
    putValue( HU_BusFlt_PrmntActv, this.BusFlt_PrmntActv.phys );
    putValue( HU_Carwash_Actv_Rq, this.Carwash_Actv_Rq.phys );
    putValue( HU_ContEngRun_Stat, this.ContEngRun_Stat.phys );
    putValue( HU_CRC_Ign_Stat, this.CRC_Ign_Stat.phys );
    putValue( HU_DidA_ExtTest_Pres, this.DidA_ExtTest_Pres.phys );
    putValue( HU_EngSt_Enbl_Rq_KG, this.EngSt_Enbl_Rq_KG.phys );
    putValue( HU_ESL_Lk_Rq, this.ESL_Lk_Rq.phys );
    putValue( HU_Ign_On_StartProc_Inact, this.Ign_On_StartProc_Inact.phys );
    putValue( HU_ISw_Stat, this.ISw_Stat.phys );
    putValue( HU_KG_IgnCtrl_Actv, this.KG_IgnCtrl_Actv.phys );
    putValue( HU_KG_StartSw_Psd, this.KG_StartSw_Psd.phys );
 //   putValue( HU_Mobile_Chrg_Rq_EIS, this.Mobile_Chrg_Rq_EIS.phys );
    putValue( HU_RemSt_IgnCtrl_Actv, this.RemSt_IgnCtrl_Actv.phys );
    putValue( HU_RemSt_IgnCtrl_Info, this.RemSt_IgnCtrl_Info.phys );
    putValue( HU_RevGr_Engg, this.RevGr_Engg.phys );
    putValue( HU_SPCR_AcustWarn_Rq_EIS, this.SPCR_AcustWarn_Rq_EIS.phys );
    putValue( HU_SPCR_Conf_EIS, this.SPCR_Conf_EIS.phys );
    putValue( HU_SPCR_Flt_EIS, this.SPCR_Flt_EIS.phys );
    putValue( HU_SQC_Ign_Stat, this.SQC_Ign_Stat.phys );
    putValue( HU_TxPkPosn_Emg_Rq, this.TxPkPosn_Emg_Rq.phys );
    putValue( HU_TxPkPosn_Rq, this.TxPkPosn_Rq.phys );
    putValue( HU_TxPkPosn_Rq_SPCR_Enbl, this.TxPkPosn_Rq_SPCR_Enbl.phys );
    putValue( HU_TxPkPosnAuto_Enbl, this.TxPkPosnAuto_Enbl.phys );
}

on message EVC_CfgList_01_0C_AR
{
//    putValue( HU_CRC_EVC_CfgList_01_0C, this.CRC_EVC_CfgList_01_0C.phys );
    putValue( HU_EVC_CfgList_01_0C_Stat, this.EVC_CfgList_01_0C_Stat.phys );
    putValue( HU_EVC_List01_StStyle, this.EVC_List01_StStyle.phys );
    putValue( HU_EVC_List02_BodyStyle, this.EVC_List02_BodyStyle.phys );
    putValue( HU_EVC_List03_RoofStyle, this.EVC_List03_RoofStyle.phys );
    putValue( HU_EVC_List04_HL_Style, this.EVC_List04_HL_Style.phys );
    putValue( HU_EVC_List05_TxStyle, this.EVC_List05_TxStyle.phys );
    putValue( HU_EVC_List06_VehLineYear, this.EVC_List06_VehLineYear.phys );
    putValue( HU_EVC_List07_HVAC_Style, this.EVC_List07_HVAC_Style.phys );
    putValue( HU_EVC_List08_Country, this.EVC_List08_Country.phys );
    putValue( HU_EVC_List09_HU_Style, this.EVC_List09_HU_Style.phys );
    putValue( HU_EVC_List0A_TPM_Style, this.EVC_List0A_TPM_Style.phys );
    putValue( HU_EVC_List0B_AddEquip, this.EVC_List0B_AddEquip.phys );
    putValue( HU_EVC_List0C_VehLine, this.EVC_List0C_VehLine.phys );
//    putValue( HU_SQC_EVC_CfgList_01_0C, this.SQC_EVC_CfgList_01_0C.phys );
}

on message FBL_CFG_Star2_AR
{
    putValue( HU_Platform_Stat_Star2, this.Platform_Stat_Star2.phys );
}

on message IL_AmbLgtCfg_Stat_AR
{
 /*   putValue( HU_AmbLgtCfg_01_Stat, this.AmbLgtCfg_01_Stat.phys );
    putValue( HU_AmbLgtCfg_02_Stat, this.AmbLgtCfg_02_Stat.phys );
    putValue( HU_AmbLgtColor_Stat_V2, this.AmbLgtColor_Stat_V2.phys );
    putValue( HU_AmbLgtColProg_Stat, this.AmbLgtColProg_Stat.phys );*/
}

on message IL_AmbLgtCfg_Stat2_AR
{
 /*   putValue( HU_AmbBrt_Z01_Stat, this.AmbBrt_Z01_Stat.phys );
    putValue( HU_AmbBrt_Z02_Stat, this.AmbBrt_Z02_Stat.phys );
    putValue( HU_AmbBrt_Z03_Stat, this.AmbBrt_Z03_Stat.phys );
    putValue( HU_AmbBrt_Z04_Stat, this.AmbBrt_Z04_Stat.phys );
    putValue( HU_AmbBrt_Z05_Stat, this.AmbBrt_Z05_Stat.phys );
    putValue( HU_AmbBrt_Z06_Stat, this.AmbBrt_Z06_Stat.phys );
    putValue( HU_AmbBrt_Z07_Stat, this.AmbBrt_Z07_Stat.phys );*/
}

on message LgtSens_State_AR
{
    putValue( HU_HUD_Sens_Actv, this.HUD_Sens_Actv.phys );
    putValue( HU_HUD_Sens_Init, this.HUD_Sens_Init.phys );
    putValue( HU_HUD_Sens_Value, this.HUD_Sens_Value.phys );
    putValue( HU_HUD_Sens_Variant, this.HUD_Sens_Variant.phys );
    putValue( HU_HUD_SensCode_Flt, this.HUD_SensCode_Flt.phys );
    putValue( HU_HUD_SensInt_Flt, this.HUD_SensInt_Flt.phys );
    putValue( HU_LgtSens_Flt, this.LgtSens_Flt.phys );
    putValue( HU_LgtSens_LoBm_On_Rq, this.LgtSens_LoBm_On_Rq.phys );
    putValue( HU_LgtSens_Night, this.LgtSens_Night.phys );
    putValue( HU_LgtSens_Night2, this.LgtSens_Night2.phys );
    putValue( HU_LgtSens_Night3, this.LgtSens_Night3.phys );
    putValue( HU_LgtSens_SNA, this.LgtSens_SNA.phys );
    putValue( HU_LgtSens_Tunnel, this.LgtSens_Tunnel.phys );
    putValue( HU_LgtSens_Twlgt, this.LgtSens_Twlgt.phys );
    putValue( HU_SunInsty_Actv, this.SunInsty_Actv.phys );
    putValue( HU_SunInsty_FL, this.SunInsty_FL.phys );
    putValue( HU_SunInsty_Flt, this.SunInsty_Flt.phys );
    putValue( HU_SunInsty_FR, this.SunInsty_FR.phys );
}

on message ORC_Disp_Stat_AR
{
    putValue( HU_Airbag_P_LED_On_Rq, this.Airbag_P_LED_On_Rq.phys );
 //   putValue( HU_Bckl_Sw_D_Stat, this.Bckl_Sw_D_Stat.phys );
//    putValue( HU_Bckl_Sw_FP_Stat, this.Bckl_Sw_FP_Stat.phys );
//   putValue( HU_Bckl_Sw_FPM_Stat, this.Bckl_Sw_FPM_Stat.phys );
    putValue( HU_COD_Ind_LED_Rq, this.COD_Ind_LED_Rq.phys );
//    putValue( HU_CRC_Bckl_Sw_Ft_Stat, this.CRC_Bckl_Sw_Ft_Stat.phys );
 //   putValue( HU_ESL_Lk_Appl_ORC, this.ESL_Lk_Appl_ORC.phys );
 //   putValue( HU_HV_Pyrofuse_Flt, this.HV_Pyrofuse_Flt.phys );
  //  putValue( HU_OC_D_Fast_ORC, this.OC_D_Fast_ORC.phys );
  //  putValue( HU_OC_P_Fast_ORC, this.OC_P_Fast_ORC.phys );
  //  putValue( HU_OC_P_Flt_ORC, this.OC_P_Flt_ORC.phys );
  //  putValue( HU_OC_P_ORC, this.OC_P_ORC.phys );
   // putValue( HU_OC_PM_Fast_ORC, this.OC_PM_Fast_ORC.phys );
   // putValue( HU_OCM_MsgDisp_Rq, this.OCM_MsgDisp_Rq.phys );
  //  putValue( HU_ORC_CrashDet_Flt, this.ORC_CrashDet_Flt.phys );
 //   putValue( HU_PP_Msg1_Disp_Rq, this.PP_Msg1_Disp_Rq.phys );
//    putValue( HU_SQC_Bckl_Sw_Ft_Stat, this.SQC_Bckl_Sw_Ft_Stat.phys );
 /*   putValue( HU_SRS_DtlMsg01_Disp_Rq, this.SRS_DtlMsg01_Disp_Rq.phys );
    putValue( HU_SRS_DtlMsg02_Disp_Rq, this.SRS_DtlMsg02_Disp_Rq.phys );
    putValue( HU_SRS_DtlMsg03_Disp_Rq, this.SRS_DtlMsg03_Disp_Rq.phys );
    putValue( HU_SRS_DtlMsg04_Disp_Rq, this.SRS_DtlMsg04_Disp_Rq.phys );
    putValue( HU_SRS_DtlMsg05_Disp_Rq, this.SRS_DtlMsg05_Disp_Rq.phys );
    putValue( HU_SRS_DtlMsg06_Disp_Rq, this.SRS_DtlMsg06_Disp_Rq.phys );
    putValue( HU_SRS_DtlMsg07_Disp_Rq, this.SRS_DtlMsg07_Disp_Rq.phys );
    putValue( HU_SRS_DtlMsg08_Disp_Rq, this.SRS_DtlMsg08_Disp_Rq.phys );
    putValue( HU_SRS_DtlMsg09_Disp_Rq, this.SRS_DtlMsg09_Disp_Rq.phys );
    putValue( HU_SRS_DtlMsg10_Disp_Rq, this.SRS_DtlMsg10_Disp_Rq.phys );
    putValue( HU_SRS_DtlMsg11_Disp_Rq, this.SRS_DtlMsg11_Disp_Rq.phys );
    putValue( HU_SRS_DtlMsg12_Disp_Rq, this.SRS_DtlMsg12_Disp_Rq.phys );
    putValue( HU_SRS_DtlMsg13_Disp_Rq, this.SRS_DtlMsg13_Disp_Rq.phys );
    putValue( HU_SRS_DtlMsg14_Disp_Rq, this.SRS_DtlMsg14_Disp_Rq.phys );
    putValue( HU_SRS_DtlMsg15_Disp_Rq, this.SRS_DtlMsg15_Disp_Rq.phys );
    putValue( HU_SRS_DtlMsg16_Disp_Rq, this.SRS_DtlMsg16_Disp_Rq.phys );*/
  //  putValue( HU_SRS_IndLmp_Rq, this.SRS_IndLmp_Rq.phys );
}

on message PN14_Stat_AR
{
    putValue( HU_DPM_ExtMd_Enbl_Rq, this.DPM_ExtMd_Enbl_Rq.phys );
    putValue( HU_DPM_MdLmt_Rq, this.DPM_MdLmt_Rq.phys );
    putValue( HU_LHC_CoolBox_R_Rq, this.LHC_CoolBox_R_Rq.phys );
    putValue( HU_LHC_EBL_Rq, this.LHC_EBL_Rq.phys );
    putValue( HU_LHC_EngFan_50_Rq, this.LHC_EngFan_50_Rq.phys );
    putValue( HU_LHC_ICH_Rq, this.LHC_ICH_Rq.phys );
    putValue( HU_LHC_IntFan_F_50_Rq, this.LHC_IntFan_F_50_Rq.phys );
    putValue( HU_LHC_IntFan_R_0_Rq, this.LHC_IntFan_R_0_Rq.phys );
    putValue( HU_LHC_IntFan_R_50_Rq, this.LHC_IntFan_R_50_Rq.phys );
    putValue( HU_LHC_MirrHt_Rq, this.LHC_MirrHt_Rq.phys );
    putValue( HU_LHC_PkLmp_Rq, this.LHC_PkLmp_Rq.phys );
    putValue( HU_LHC_PosnLmp_Rq, this.LHC_PosnLmp_Rq.phys );
    putValue( HU_LHC_PT_Stg1_Rq, this.LHC_PT_Stg1_Rq.phys );
    putValue( HU_LHC_PT_Stg2_Rq, this.LHC_PT_Stg2_Rq.phys );
    putValue( HU_LHC_PTC1_Rq, this.LHC_PTC1_Rq.phys );
    putValue( HU_LHC_PTC2_Rq, this.LHC_PTC2_Rq.phys );
    putValue( HU_LHC_PTC3_Rq, this.LHC_PTC3_Rq.phys );
    putValue( HU_LHC_PTC4_Rq, this.LHC_PTC4_Rq.phys );
    putValue( HU_LHC_PTC5_Rq, this.LHC_PTC5_Rq.phys );
    putValue( HU_LHC_PTC6_Rq, this.LHC_PTC6_Rq.phys );
    putValue( HU_LHC_RHU_Rq, this.LHC_RHU_Rq.phys );
    putValue( HU_LHC_SeatHtStg1_Rq, this.LHC_SeatHtStg1_Rq.phys );
    putValue( HU_LHC_SeatHtStg2_Rq, this.LHC_SeatHtStg2_Rq.phys );
    putValue( HU_LHC_SeatHtStg3_Rq, this.LHC_SeatHtStg3_Rq.phys );
    putValue( HU_LHC_SeatVn_Rq, this.LHC_SeatVn_Rq.phys );
    putValue( HU_LHC_StW_Ht_Rq, this.LHC_StW_Ht_Rq.phys );
    putValue( HU_LHC_Taxi_Rq, this.LHC_Taxi_Rq.phys );
    putValue( HU_LHC_Tlm_Rq, this.LHC_Tlm_Rq.phys );
    putValue( HU_LHC_TrkSock_Rq, this.LHC_TrkSock_Rq.phys );
    putValue( HU_LHC_TrlrSock_Rq, this.LHC_TrlrSock_Rq.phys );
    putValue( HU_LHC_WprPkHt_Rq, this.LHC_WprPkHt_Rq.phys );
    putValue( HU_LHC_WShHt_50_Rq, this.LHC_WShHt_50_Rq.phys );
    putValue( HU_LHC_WShHt_Rq, this.LHC_WShHt_Rq.phys );
    putValue( HU_PN14_eHeV_Enbl, this.PN14_eHeV_Enbl.phys );
    putValue( HU_PN14_LHC_Actv, this.PN14_LHC_Actv.phys );
    putValue( HU_PN14_SupBat_Curr, this.PN14_SupBat_Curr.phys );
    putValue( HU_PN14_SupBat_Volt, this.PN14_SupBat_Volt.phys );
    putValue( HU_PN14_SupBatCutSw_Stat, this.PN14_SupBatCutSw_Stat.phys );
    putValue( HU_PN14_TransMd_Stat, this.PN14_TransMd_Stat.phys );
    putValue( HU_PN14_TransMd_Updt_Rq, this.PN14_TransMd_Updt_Rq.phys );
    putValue( HU_SSA_EngRestart_Actv, this.SSA_EngRestart_Actv.phys );
}

