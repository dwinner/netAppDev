//-----------------------------------------------------------------------------
//  Copyright (C) Continental Automotive All Right Reserved
//            File        : NavigationInfo.can
//            Author      : Ratheesh
//            Environment : CAPL
//-----------------------------------------------------------------------------
//  Type        : CAPL script
//  Description : This file contains the NavigationInfo FBlock implementation
//  Code Status : Not tested
//  Reference   : MIB_MOST_KMatrix_V1.13.00F_20121108_MT.html
//-----------------------------------------------------------------------------
//  Revision History
//  Version     Modified by         Date            Description
//  1.0         Ratheesh            10-Jan-2013     Initial version
//  1.1         Ratheesh            09-Apr-2013     Added NavigationInfo panel
//-----------------------------------------------------------------------------

includes
{
  #include "MostDefs.cin"
  #include "FCatDefs.cin"
}

//
// Simulation of the function block NavigationInfo
// The function IDs supported are
// 1. FktIDs
// 2. Notification
// 3. NotificationCheck
// 4. RG_Select
// 5. Capability
//
variables
{
  // Application phase
  const byte kAppOff      = 0; // no power; no communication
  const byte kAppOn       = 1; // power on
  const byte kAppShutdown = 2; // power on; shutdown started
  byte  gAppPhase = kAppOff;
  // Device address of destination data sink 
  word gDestDev = 0x517; // :TBD: To change 
  // Instance ID
  long gInstId_NavInfo = 1;
  // RG Mode
  byte gRG_Mode = kRG_Mode_INIT;

  // Supported Navigation type
  byte gSuppNavType = 0x03; // Komo(EV/KDK) and MAP supported
}

on preStart
{
  // configure CAPL node as application node (don't receive spy messages...)
  mostApplicationNode();

  // configure FBlock
  ConfigureFBlock();
}

void ConfigureFBlock(void)
{
  // Configures the FBlock.
  // Therefore functions are registered at CANoe's Function and 
  // Notification Service.

  long oldInstId = -1; // static variable
  long newInstId;

  newInstId = MostApGetInstId();

  if(newInstId < 0)
  {
    newInstId = -1;
  }

  if(oldInstId != -1)
  {
    // disable Notification Service
    mostAsNtfDisableEx(kFB_NAV, oldInstId);
    // disable Function Service
    mostAsFsDisableEx(kFB_NAV, oldInstId);
  }

  if(newInstId != -1)
  {
    gInstId_NavInfo = newInstId;
    // enable Function Service
    mostAsFsEnable();

    // Enable function IDs RG_Select and Capabilities
    mostAsFsFunctionEnable(kFct_NAV_RG_Select, kOpTFAllInFCat);
    mostAsFsFunctionEnable(kFct_NAV_Capabilities, kOpTFAllInFCat);
    mostAsFsFunctionEnable(kFct_NAV_CurrentStreet, kOpTFAllInFCat);
    mostAsFsFunctionEnable(kFct_NAV_TurnToStreet, kOpTFAllInFCat);
  }
  oldInstId = newInstId;  
}

// Handling of NavigationInfo.RG_Select.Get message
on mostAmsMessage NavigationInfo.RG_Select.Get
{
  mostAMSMessage NavigationInfo.RG_Select.Status msg;

  // Validate the length
  if (!CheckValidReceptionAndLength(this, 0))
    return;

  msg.MsgChannel = mostGetChannel();
  msg.DA = this.SA;
  msg.InstanceId = MostApGetInstID();
  msg.RG_MODE = @NAV::RG_Mode;
  msg.DLC = 0x01;
  output(msg);
}

// Handling of NavigationInfo.Capabilities.Get message
on mostAmsMessage NavigationInfo.Capabilities.Get
{
  mostAMSMessage NavigationInfo.Capabilities.Status msg;

  // Validate the length
  if (!CheckValidReceptionAndLength(this, 0))
    return;

  msg.MsgChannel = mostGetChannel();
  msg.DA = this.SA;
  msg.InstanceId = MostApGetInstID();
  msg.SuppNavType = @NAV::SuppNavType;
  msg.DLC = 0x01;
  output(msg);
}

void SendCurrentStreetStatus(word u16_DestAddr)
{
  mostAMSMessage NavigationInfo.CurrentStreet.Status msg;
  char s_CurrStreet[255];
  word u16_StrLen;
  word u16_Idx;
  word i;

  sysGetVariableString(sysvar::NAV::CurrentStreet_CurrentStreet, s_CurrStreet, elcount(s_CurrStreet));
  // Prepare message
  msg.DA = u16_DestAddr;
  msg.MsgChannel = mostGetChannel();
  msg.InstanceId = gInstId_NavInfo;
  u16_StrLen = strlen(s_CurrStreet);
  u16_Idx = 0; // Reset the index to 0
  msg.BYTE(u16_Idx) = 0x02; // UTF8
  u16_Idx++;
  for (i = 0; i < u16_StrLen; i++)
  {
    msg.BYTE(u16_Idx+i) = s_CurrStreet[i];
  }
  u16_Idx += u16_StrLen;
  msg.BYTE(u16_Idx) = 0x00;
  msg.DLC = u16_Idx+1;
  output(msg);
}

void SendTurnToStreetStatus(word u16_DestAddr)
{
  mostAMSMessage NavigationInfo.TurnToStreet.Status msg;
  char s_TurnToInfo[255];
  char s_SignPost[255];
  word u16_StrLen;
  word u16_Idx;
  word i;

  //Get string from panel
  sysGetVariableString(sysvar::NAV::TurnToStreet_TurnToInfo, s_TurnToInfo, elcount(s_TurnToInfo));
  sysGetVariableString(sysvar::NAV::TurnToStreet_SignPost, s_SignPost, elcount(s_SignPost));
  // Prepare message
  msg.DA = u16_DestAddr;
  msg.MsgChannel = mostGetChannel();
  msg.InstanceId = gInstId_NavInfo;
  u16_StrLen = strlen(s_TurnToInfo);
  u16_Idx = 0; // Reset the index to 0
  msg.BYTE(u16_Idx) = 0x02; // UTF8
  u16_Idx++;
  for (i = 0; i < u16_StrLen; i++)
  {
    msg.BYTE(u16_Idx + i) = s_TurnToInfo[i];
  }
  u16_Idx = u16_Idx + u16_StrLen;
  msg.BYTE(u16_Idx) = 0x00;
  u16_Idx++;
  u16_StrLen = strlen(s_SignPost);
  msg.BYTE(u16_Idx) = 0x02; // UTF8
  u16_Idx++;
  for (i = 0; i < u16_StrLen; i++)
  {
    msg.BYTE(u16_Idx + i) = s_SignPost[i];
  }
  u16_Idx = u16_Idx + u16_StrLen;
  msg.BYTE(u16_Idx) = 0x00;
  msg.DLC = u16_Idx+1;
  output(msg);
}

on sysvar NAV::Button_CurrentStreet_Update
{
  if (@this == 0)
    return;

  SendCurrentStreetStatus(gDestDev);
}

on sysvar NAV::Button_TurnToStreet_Update
{
  if (@this == 0)
    return;

  SendTurnToStreetStatus(gDestDev);
}

on mostAmsMessage NavigationInfo.CurrentStreet.Get
{
  // Validate the length
  if (!CheckValidReceptionAndLength(this, 0))
    return;
  SendCurrentStreetStatus(this.SA);
}

on mostAmsMessage NavigationInfo.TurnToStreet.Get
{
  // Validate the length
  if (!CheckValidReceptionAndLength(this, 0))
    return;

  SendTurnToStreetStatus(this.SA);
}