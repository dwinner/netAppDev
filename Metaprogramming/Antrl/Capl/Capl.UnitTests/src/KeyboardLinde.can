/*@!Encoding:1252*/
includes
{
  
}

variables
{
  message 0x7FF bla;
  message 0x0 nmt;
  message LiIoCharger_SDOreq_LiIoBMS CSdo;
  message Traction_SDOreq_LiIoBMS   TSdo;
  byte toggle = 0;
}

//on key 'q' {
//  bla.ID = 0x0;
//  output(bla);
//}
//on key 'w' {
//  bla.ID = 0x7FF;
//  output(bla);
//}
//on key 'e' {
//  bla.ID = 0x20D;
//  output(bla);
//}
//on key 'r' {
//  bla.ID = 0x80;
//  output(bla);
//}

on key '1'
{
  // hourmeter cs 0x13
  bla.ID = 0x265;
  bla.DLC = 8;
  if (toggle == 0) {
    bla.byte(0) = 0x7;
  }
  else {
    bla.byte(0) = 0x23;
  }
  toggle = toggle ^1;
  output(bla);
}

on key '2'
{
  // hours 0x265 cs 0x20
  bla.ID = 0x265;
  bla.DLC = 4;
  if (toggle == 0) {
    bla.byte(0) = 0x50;
  }
  else {
    bla.byte(0) = 0xFF;
  }
  toggle = toggle ^1;
  output(bla);
}

on key '3'
{
  //Disprtc cs 0x20
  bla.ID = 0x462;
  bla.DLC = 8;
  if (toggle == 0) {
    bla.byte(0) = 0x17;
  }
  else {
    bla.byte(0) = 0x4;
  }
  toggle = toggle ^1;
  output(bla);
}

on key '4'
{
  // timestamp cs 0x21, 0x30
  bla.ID = 0xFF;
  bla.DLC = 4;
  if (toggle == 0) {
    bla.byte(0) = 0x94;
  }
  else {
    bla.byte(0) = 0xFA;
  }
  toggle = toggle ^1;
  output(bla);
}

on key '5'
{
  // Trac4PDO cs 0x21
  bla.ID = 0x481;
  bla.DLC = 8;
  if (toggle == 0) {
    bla.byte(0) = 0xBB;
  }
  else {
    bla.byte(0) = 0xAA;
  }
  toggle = toggle ^1;
  output(bla);
}

on key '6'
{
  // Trac4PDO cs 0x30
  bla.ID = 0x481;
  bla.DLC = 4;
  if (toggle == 0) {
    bla.byte(0) = 0x0A;
  }
  else {
    bla.byte(0) = 0xAB;
  }
  toggle = toggle ^1;
  output(bla);
}

on key 'k'
{
  CSdo.byte(0) = 0x2F;
  TSdo.byte(0) = 0x2F;
  
  CSdo.byte(1) = 0x0;
  TSdo.byte(1) = 0x0;
  
  CSdo.byte(2) = 0x22;
  TSdo.byte(2) = 0x22;
  
  CSdo.byte(3) = 0x2;
  TSdo.byte(3) = 0x1;
    
  CSdo.byte(4) = 0x1;
  TSdo.byte(4) = 0x1;
  output(TSdo);
  output(CSdo); 
  
}

on key 'j'
{
  nmt.byte(0) = 1;
  nmt.byte(1) = 0;
  output(nmt);
}
