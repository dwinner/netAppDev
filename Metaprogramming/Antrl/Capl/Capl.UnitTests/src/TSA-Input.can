/*@@var:*/
variables
{
    byte Command_OnCAN;
    const byte cMenuInfoCommand =    0x10;
    const byte cWarnInfoCommand =    0x20;
    const byte cWarnMsgCommand =     0x21;
//    byte Layout_OnCAN;
    const byte cNoInfoLayout =  0x00;
    const byte cOneSignLayout = 0x30;
    const byte cTwoSignLayout = 0x31;
    const byte cTextualLayout = 0x22;
//    byte Sign1_OnCAN;
//    byte Supplement1_OnCAN;
//    byte Sign2_OnCAN;
//    byte Supplement2_OnCAN;
//    byte Unit_OnCAN;
    const byte cKM = 1;
    const byte cMiles = 2;
//    byte Icon_Set_Type_OnCAN;
    const byte cVienna_RHD =   0x00;
    const byte cVienna_LHD =   0x01;
    const byte cUS =           0x02;
    const byte cChina =        0x03;
    const byte cKorea =        0x04;
    const byte cJapan =        0x05;
    const byte cCanada =       0x06;
    const byte cSouthAmerica = 0x07;
    const byte cGulfStates =   0x08;
//    byte Speedlimit_Warn_Type;
    const byte cIdle_0 =       0x00;
    const byte cOpt_only =     0x01;
    const byte cOpt_Acoust =   0x02;
    const byte cSNA_3 =        0x03;

    int counter;

    byte SLA_Framecounter = 1;
    int  auswahl_routine;
    
}
/*@@end*/

/*@@startStart:Start:*/
on start
{
    // Initialisierung
    counter = 0;
 
    putValue( Env_TSA_CTRL_Command_in, 1 );
    putValue( Env_TSA_CTRL_Warning_Settype_numeric, 3 );
    putValue( Env_TSA_CTRL_Menutext_Settype_numeric, 4 );
    putValue( Env_TSA_CTRL_Sign1_Speedlimit_numeric, 5 );
    putValue( Env_TSA_CTRL_Sign1_Endoflimit_numeric, 5 );
    putValue( Env_TSA_CTRL_Sign1_Empty_numeric, 206 );
    putValue( Env_TSA_CTRL_Sign2_Speedlimit_numeric, 5 );
    putValue( Env_TSA_CTRL_Sign2_Endoflimit_numeric, 5 );
    putValue( Env_TSA_CTRL_Sign2_Empty_numeric, 206 );
    putValue( Env_TSA_CTRL_Supplement1_numeric, 14 );
    putValue( Env_TSA_CTRL_Supplement2_numeric, 14 );
    putValue( Env_TSA_CTRL_Icons_Settype_numeric, 9 );
//    putValue( Env_TSA_CTRL_Icons_Settype_radio, 3 );
    putValue( Env_TSA_CTRL_SLA_WarnSpd_Unit_in, 1 );
}
/*@@end*/

/*@@envVar:Env_TSA_CTRL_Warning_Settype_radio:*/
on envVar Env_TSA_CTRL_Warning_Settype_radio
{
    if( getValue( this ) == 3 )
    {
        putValue( Env_TSA_CTRL_Warning_Settype, getValue( Env_TSA_CTRL_Warning_Settype_numeric ) );
    }    
    else
        putValue( Env_TSA_CTRL_Warning_Settype, getValue( this ) );
}
/*@@end*/

/*@@envVar:Env_TSA_CTRL_Warning_Settype_numeric:*/
on envVar Env_TSA_CTRL_Warning_Settype_numeric
{
    if( getValue( Env_TSA_CTRL_Warning_Settype_radio ) == 3 )
    {
        putValue( Env_TSA_CTRL_Warning_Settype, getValue( this ) );
    }
}
/*@@end*/

/*@@envVar:Env_TSA_CTRL_Menutext_Settype_radio:*/
on envVar Env_TSA_CTRL_Menutext_Settype_radio
{
    if( getValue( this ) == 4 )
    {
        putValue( Env_TSA_CTRL_Menutext_Settype, getValue( Env_TSA_CTRL_Menutext_Settype_numeric ) );
    }
    else
        putValue( Env_TSA_CTRL_Menutext_Settype, getValue( this ) );
}
/*@@end*/

/*@@envVar:Env_TSA_CTRL_Menutext_Settype_numeric:*/
on envVar Env_TSA_CTRL_Menutext_Settype_numeric
{
    if( getValue( Env_TSA_CTRL_Menutext_Settype_radio ) == 4 )
    {
        putValue( Env_TSA_CTRL_Menutext_Settype, getValue( this ) );
    } 
}
/*@@end*/

/*@@envVar:Env_TSA_CTRL_Sign1_radio:*/
on envVar Env_TSA_CTRL_Sign1_radio
{
    byte sign1_radio;
    byte sign1;

    sign1_radio = getValue( Env_TSA_CTRL_Sign1_radio );                       // Umgebungsvariable auslesen
    if( sign1_radio == 1 )
    {
        sign1 = ( getValue( Env_TSA_CTRL_Sign1_Speedlimit_numeric ) ) ;
    }
    else if( sign1_radio == 33 )
    {
        sign1 = ( getValue( Env_TSA_CTRL_Sign1_Endoflimit_numeric ) + 32 );
    }
    else if( sign1_radio == 65 )
    {
        sign1 = ( getValue( Env_TSA_CTRL_Sign1_MinSpeed_numeric ) + 64 );
    }
    else if( sign1_radio == 97 )
    {
        sign1 = ( getValue( Env_TSA_CTRL_Sign1_EndofMinSpeed_numeric ) + 96 );
    }
    else if( sign1_radio == 129 )
    {
        sign1 = ( getValue( Env_TSA_CTRL_Sign1_AdvSpeed_numeric ) + 128 );
    }
    else if( sign1_radio == 161 )
    {
        sign1 = ( getValue( Env_TSA_CTRL_Sign1_EndofAdvSpeed_numeric ) + 160 );
    }
    else if( sign1_radio == 206 )
    {
        sign1 = getValue( Env_TSA_CTRL_Sign1_Empty_numeric );
    }
    else
        sign1 = sign1_radio;

    putValue( Env_TSA_CTRL_Sign1, sign1 );
}
/*@@end*/

/*@@envVar:Env_TSA_CTRL_Sign1_Speedlimit_numeric:*/
on envVar Env_TSA_CTRL_Sign1_Speedlimit_numeric
{
    if( getValue( Env_TSA_CTRL_Sign1_radio ) == 1 )
    {
        putValue( Env_TSA_CTRL_Sign1, getValue( Env_TSA_CTRL_Sign1_Speedlimit_numeric ) );
    }
}
/*@@end*/

/*@@envVar:Env_TSA_CTRL_Sign1_Endoflimit_numeric:*/
on envVar Env_TSA_CTRL_Sign1_Endoflimit_numeric
{
    if( getValue( Env_TSA_CTRL_Sign1_radio ) == 33 )
    {
        putValue( Env_TSA_CTRL_Sign1, getValue( Env_TSA_CTRL_Sign1_Endoflimit_numeric ) + 32 );
    }
}
/*@@end*/

/*@@envVar:Env_TSA_CTRL_Sign1_MinSpeed_numeric:*/
on envVar Env_TSA_CTRL_Sign1_MinSpeed_numeric
{
    if( getValue( Env_TSA_CTRL_Sign1_radio ) == 65 )
    {
        putValue( Env_TSA_CTRL_Sign1, getValue( Env_TSA_CTRL_Sign1_MinSpeed_numeric ) + 64 );
    }
}
/*@@end*/

/*@@envVar:Env_TSA_CTRL_Sign1_EndofMinSpeed_numeric:*/
on envVar Env_TSA_CTRL_Sign1_EndofMinSpeed_numeric
{
    if( getValue( Env_TSA_CTRL_Sign1_radio ) == 97 )
    {
        putValue( Env_TSA_CTRL_Sign1, getValue( Env_TSA_CTRL_Sign1_EndofMinSpeed_numeric ) + 96 );
    }
}
/*@@end*/

/*@@envVar:Env_TSA_CTRL_Sign1_AdvSpeed_numeric:*/
on envVar Env_TSA_CTRL_Sign1_AdvSpeed_numeric
{
    if( getValue( Env_TSA_CTRL_Sign1_radio ) == 129 )
    {
        putValue( Env_TSA_CTRL_Sign1, getValue( Env_TSA_CTRL_Sign1_AdvSpeed_numeric ) + 128 );
    }
}
/*@@end*/

/*@@envVar:Env_TSA_CTRL_Sign1_EndofAdvSpeed_numeric:*/
on envVar Env_TSA_CTRL_Sign1_EndofAdvSpeed_numeric
{
    if( getValue( Env_TSA_CTRL_Sign1_radio ) == 161 )
    {
        putValue( Env_TSA_CTRL_Sign1, getValue( Env_TSA_CTRL_Sign1_EndofAdvSpeed_numeric ) + 160 );
    }
}
/*@@end*/

/*@@envVar:Env_TSA_CTRL_Sign1_Empty_numeric:*/
on envVar Env_TSA_CTRL_Sign1_Empty_numeric
{
    if( getValue( Env_TSA_CTRL_Sign1_radio ) == 206 )
    {
        putValue( Env_TSA_CTRL_Sign1, getValue( Env_TSA_CTRL_Sign1_Empty_numeric ) );
    } 
}
/*@@end*/

/*@@envVar:Env_TSA_CTRL_Sign2_radio:*/
on envVar Env_TSA_CTRL_Sign2_radio
{
    byte sign2_radio;
    byte sign2;

    sign2_radio = getValue( this );
    if( sign2_radio == 1 )
    {
        sign2 = getValue( Env_TSA_CTRL_Sign2_Speedlimit_numeric );
    }
    else if( sign2_radio == 33 )
    {
        sign2 = ( getValue( Env_TSA_CTRL_Sign2_Endoflimit_numeric ) + 32 );
    }
    else if( sign2_radio == 65 )
    {
        sign2 = ( getValue( Env_TSA_CTRL_Sign2_MinSpeed_numeric ) + 64 );
    }
    else if( sign2_radio == 97 )
    {
        sign2 = ( getValue( Env_TSA_CTRL_Sign2_EndofMinSpeed_numeric ) + 96 );
    }
    else if( sign2_radio == 129 )
    {
        sign2 = ( getValue( Env_TSA_CTRL_Sign2_AdvSpeed_numeric ) + 128 );
    }
    else if( sign2_radio == 161 )
    {
        sign2 = ( getValue( Env_TSA_CTRL_Sign2_EndofAdvSpeed_numeric ) + 160 );
    }
    else if( sign2_radio == 206 )
    {
        sign2 = getValue( Env_TSA_CTRL_Sign2_Empty_numeric );
    }
    else
        sign2 = sign2_radio;

    putValue( Env_TSA_CTRL_Sign2, sign2 );
}
/*@@end*/

/*@@envVar:Env_TSA_CTRL_Sign2_Speedlimit_numeric:*/
on envVar Env_TSA_CTRL_Sign2_Speedlimit_numeric
{
    if( getValue( Env_TSA_CTRL_Sign2_radio ) == 1 )
    {
        putValue( Env_TSA_CTRL_Sign2, getValue( Env_TSA_CTRL_Sign2_Speedlimit_numeric ) );
    }
}
/*@@end*/

/*@@envVar:Env_TSA_CTRL_Sign2_Endoflimit_numeric:*/
on envVar Env_TSA_CTRL_Sign2_Endoflimit_numeric
{
    if( getValue( Env_TSA_CTRL_Sign2_radio ) == 33 )
    {
        putValue( Env_TSA_CTRL_Sign2, getValue( Env_TSA_CTRL_Sign2_Endoflimit_numeric ) + 32 );
    }
}
/*@@end*/

/*@@envVar:Env_TSA_CTRL_Sign2_MinSpeed_numeric:*/
on envVar Env_TSA_CTRL_Sign2_MinSpeed_numeric
{
    if( getValue( Env_TSA_CTRL_Sign2_radio ) == 65 )
    {
        putValue( Env_TSA_CTRL_Sign2, getValue( Env_TSA_CTRL_Sign2_MinSpeed_numeric ) + 64 );
    }
}
/*@@end*/

/*@@envVar:Env_TSA_CTRL_Sign2_EndofMinSpeed_numeric:*/
on envVar Env_TSA_CTRL_Sign2_EndofMinSpeed_numeric
{
    if( getValue( Env_TSA_CTRL_Sign2_radio ) == 97 )
    {
        putValue( Env_TSA_CTRL_Sign2, getValue( Env_TSA_CTRL_Sign2_EndofMinSpeed_numeric ) + 96 );
    }
}
/*@@end*/

/*@@envVar:Env_TSA_CTRL_Sign2_AdvSpeed_numeric:*/
on envVar Env_TSA_CTRL_Sign2_AdvSpeed_numeric
{
    if( getValue( Env_TSA_CTRL_Sign2_radio ) == 129 )
    {
        putValue( Env_TSA_CTRL_Sign2, getValue( Env_TSA_CTRL_Sign2_AdvSpeed_numeric ) + 128 );
    }
}
/*@@end*/

/*@@envVar:Env_TSA_CTRL_Sign2_EndofAdvSpeed_numeric:*/
on envVar Env_TSA_CTRL_Sign2_EndofAdvSpeed_numeric
{
    if( getValue( Env_TSA_CTRL_Sign2_radio ) == 161 )
    {
        putValue( Env_TSA_CTRL_Sign2, getValue( Env_TSA_CTRL_Sign2_EndofAdvSpeed_numeric ) + 160 );
    }
}
/*@@end*/

/*@@envVar:Env_TSA_CTRL_Supplement1_radio:*/
on envVar Env_TSA_CTRL_Supplement1_radio
{
    if( getValue( this ) == 14 )
    {
        putValue( Env_TSA_CTRL_Supplement1, getValue( Env_TSA_CTRL_Supplement1_numeric ) );
    }    
    else
        putValue( Env_TSA_CTRL_Supplement1, getValue( this ) );
}
/*@@end*/

/*@@envVar:Env_TSA_CTRL_Supplement1_numeric:*/
on envVar Env_TSA_CTRL_Supplement1_numeric
{
    if( getValue( Env_TSA_CTRL_Supplement1_radio ) == 14 )
    {
        putValue( Env_TSA_CTRL_Supplement1, getValue( Env_TSA_CTRL_Sign1_Endoflimit_numeric ) );
    }
}
/*@@end*/

/*@@envVar:Env_TSA_CTRL_Supplement2_radio:*/
on envVar Env_TSA_CTRL_Supplement2_radio
{
    if( getValue( this ) == 14 )
    {
        putValue( Env_TSA_CTRL_Supplement2, getValue( Env_TSA_CTRL_Supplement2_numeric ) );
    }    
    else
        putValue( Env_TSA_CTRL_Supplement2, getValue( this ) );
}
/*@@end*/

/*@@envVar:Env_TSA_CTRL_Supplement2_numeric:*/
on envVar Env_TSA_CTRL_Supplement2_numeric
{
    if( getValue( Env_TSA_CTRL_Supplement2_radio ) == 14 )
    {
        putValue( Env_TSA_CTRL_Supplement2, getValue( Env_TSA_CTRL_Sign2_Endoflimit_numeric ) );
    }
}
/*@@end*/

/*@@envVar:Env_TSA_CTRL_Icons_Settype_radio:*/
on envVar Env_TSA_CTRL_Icons_Settype_radio
{
    if( getValue( this ) == 9 )
    {
        putValue( Env_TSA_CTRL_Icons_Settype, getValue( Env_TSA_CTRL_Icons_Settype_numeric ) );
    }    
    else
        putValue( Env_TSA_CTRL_Icons_Settype, getValue( Env_TSA_CTRL_Icons_Settype_radio ) );
}
/*@@end*/

/*@@envVar:Env_TSA_CTRL_Icons_Settype_numeric:*/
on envVar Env_TSA_CTRL_Icons_Settype_numeric
{
    if( getValue( Env_TSA_CTRL_Icons_Settype_radio ) == 9 )
        putValue( Env_TSA_CTRL_Icons_Settype, getValue( this ) );
    else
        putValue( Env_TSA_CTRL_Icons_Settype, getValue( Env_TSA_CTRL_Icons_Settype_radio ) );
}
/*@@end*/

/*@@envVar:Env_TSA_CTRL_Button_Reset:*/
on envVar Env_TSA_CTRL_Button_Reset
{
    if( getValue( this ) == 1 )
    {
        fct_reset();
    }
}
/*@@end*/

/*@@caplFunc:fct_reset():*///function
void fct_reset()
{
    putValue( Env_TSA_CTRL_Command_in, 1 );
    putValue( Env_TSA_CTRL_Layout_in, 0 );
    putValue( Env_TSA_CTRL_Warning_Settype_radio, 0 );
    putValue( Env_TSA_CTRL_Warning_Settype_numeric, 3 );
    putValue( Env_TSA_CTRL_Menutext_Settype_radio, 0 );
    putValue( Env_TSA_CTRL_Menutext_Settype_numeric, 4 );
    putValue( Env_TSA_CTRL_Sign1_radio, 0 );
    putValue( Env_TSA_CTRL_Sign1_Speedlimit_numeric, 5 );
    putValue( Env_TSA_CTRL_Sign1_Endoflimit_numeric, 5 );
    putValue( Env_TSA_CTRL_Sign1_Empty_numeric, 101 );
    putValue( Env_TSA_CTRL_Sign2_radio, 0 );
    putValue( Env_TSA_CTRL_Sign2_Speedlimit_numeric, 5 );
    putValue( Env_TSA_CTRL_Sign2_Endoflimit_numeric, 5 );
    putValue( Env_TSA_CTRL_Sign2_Empty_numeric, 101 );
    putValue( Env_TSA_CTRL_Supplement1_radio, 0 );
    putValue( Env_TSA_CTRL_Supplement1_numeric, 14 );
    putValue( Env_TSA_CTRL_Supplement2_radio, 0 );
    putValue( Env_TSA_CTRL_Supplement2_numeric, 14 );
    putValue( Env_TSA_CTRL_Icons_Settype_numeric, 7 );
    putValue( Env_TSA_CTRL_Icons_Settype_radio, 3 );
    putValue( Env_TSA_CTRL_SLA_WarnSpd_Unit_in, 60 );

    counter = 0;
}

   
/*@@end*/

/*@@envVar:Env_TSA_Uebernehmen:*/
on envVar Env_TSA_Uebernehmen
{
    if(  getValue( this ) )
    {      
        if( getValue( HMI__STMSG_Manual_TSA_Disp_Rq2_AR ) == 0 )
        {
            putValue( HMI_TSA_Disp_Rq2_Data1, getValue( Env_TSA_CTRL_Command_in ) );
            if( getValue( HMI_TSA_Disp_Rq2_Data1 ) == cMenuInfoCommand )
            {
                putValue( HMI_TSA_Disp_Rq2_Data2,     getValue( Env_TSA_CTRL_Layout_in           )             );
                putValue( HMI_TSA_Disp_Rq2_Data3,     getValue( Env_TSA_CTRL_Sign1               )             );
                putValue( HMI_TSA_Disp_Rq2_Data4, ( ( getValue( Env_TSA_CTRL_SLA_Warn_Type_Sign1 ) * 64 ) + 
                                                      getValue( Env_TSA_CTRL_Supplement1         )          )  );
                putValue( HMI_TSA_Disp_Rq2_Data5,     getValue( Env_TSA_CTRL_Sign2               )             );
                putValue( HMI_TSA_Disp_Rq2_Data6, ( ( getValue( Env_TSA_CTRL_SLA_Warn_Type_Sign2 ) * 64 ) + 
                                                      getValue( Env_TSA_CTRL_Supplement2         )          )  );
                putValue( HMI_TSA_Disp_Rq2_Data7, ( ( getValue( Env_TSA_CTRL_Icons_Settype       ) *  4 ) + 
                                                      getValue( Env_TSA_CTRL_SLA_WarnSpd_Unit_in )          )  );
                putValue( HMI_TSA_Disp_Rq2_Data8,     counter );
            }
            else
            {
                putValue( HMI_TSA_Disp_Rq2_Data2,     getValue( Env_TSA_CTRL_Warning_Settype ) );
                putValue( HMI_TSA_Disp_Rq2_Data3,     getValue( Env_TSA_CTRL_Menutext_Settype ) );
                putValue( HMI_TSA_Disp_Rq2_Data4,     0 );
                putValue( HMI_TSA_Disp_Rq2_Data5,     0 );
                putValue( HMI_TSA_Disp_Rq2_Data6,     0 );
                putValue( HMI_TSA_Disp_Rq2_Data7,     0 );
                putValue( HMI_TSA_Disp_Rq2_Data8,     0 );
            }
        }
        else
        {
            if( SLA_Framecounter == 1 )
            {
                putValue ( HMI_TSA_Disp_Rq2_Data1, getvalue( Env_TSA_DISP_RQ2_10_Byte0 ) );
                putValue ( HMI_TSA_Disp_Rq2_Data2, getvalue( Env_TSA_DISP_RQ2_10_Byte1 ) );
                putValue ( HMI_TSA_Disp_Rq2_Data3, getvalue( Env_TSA_DISP_RQ2_10_Byte2 ) );
                putValue ( HMI_TSA_Disp_Rq2_Data4, getvalue( Env_TSA_DISP_RQ2_10_Byte3 ) );
                putValue ( HMI_TSA_Disp_Rq2_Data5, getvalue( Env_TSA_DISP_RQ2_10_Byte4 ) );
                putValue ( HMI_TSA_Disp_Rq2_Data6, getvalue( Env_TSA_DISP_RQ2_10_Byte5 ) );
                putValue ( HMI_TSA_Disp_Rq2_Data7, getvalue( Env_TSA_DISP_RQ2_10_Byte6 ) );
                putValue ( HMI_TSA_Disp_Rq2_Data8, getvalue( Env_TSA_DISP_RQ2_10_Byte7 ) );
                if( getValue( Env_TSA_DISP_RQ2_21_Aktiv ) )
                    SLA_Framecounter = 3;
                else
                    SLA_Framecounter = 2;
                return;
            }

            if( SLA_Framecounter == 2 )
            {
                putValue ( HMI_TSA_Disp_Rq2_Data1, getvalue( Env_TSA_DISP_RQ2_20_Byte0 ) );
                putValue ( HMI_TSA_Disp_Rq2_Data2, getvalue( Env_TSA_DISP_RQ2_20_Byte1 ) );
                putValue ( HMI_TSA_Disp_Rq2_Data3, getvalue( Env_TSA_DISP_RQ2_20_Byte2 ) );
                putValue ( HMI_TSA_Disp_Rq2_Data4, getvalue( Env_TSA_DISP_RQ2_20_Byte3 ) );
                putValue ( HMI_TSA_Disp_Rq2_Data5, getvalue( Env_TSA_DISP_RQ2_20_Byte4 ) );
                putValue ( HMI_TSA_Disp_Rq2_Data6, getvalue( Env_TSA_DISP_RQ2_20_Byte5 ) );
                putValue ( HMI_TSA_Disp_Rq2_Data7, getvalue( Env_TSA_DISP_RQ2_20_Byte6 ) );
                putValue ( HMI_TSA_Disp_Rq2_Data8, getvalue( Env_TSA_DISP_RQ2_20_Byte7 ) );
                SLA_Framecounter = 1;
                return;
            }

            if( SLA_Framecounter == 3 )
            {
                putValue ( HMI_TSA_Disp_Rq2_Data1, getvalue( Env_TSA_DISP_RQ2_21_Byte0 ) );
                putValue ( HMI_TSA_Disp_Rq2_Data2, getvalue( Env_TSA_DISP_RQ2_21_Byte1 ) );
                putValue ( HMI_TSA_Disp_Rq2_Data3, getvalue( Env_TSA_DISP_RQ2_21_Byte2 ) );
                putValue ( HMI_TSA_Disp_Rq2_Data4, getvalue( Env_TSA_DISP_RQ2_21_Byte3 ) );
                putValue ( HMI_TSA_Disp_Rq2_Data5, getvalue( Env_TSA_DISP_RQ2_21_Byte4 ) );
                putValue ( HMI_TSA_Disp_Rq2_Data6, getvalue( Env_TSA_DISP_RQ2_21_Byte5 ) );
                putValue ( HMI_TSA_Disp_Rq2_Data7, getvalue( Env_TSA_DISP_RQ2_21_Byte6 ) );
                putValue ( HMI_TSA_Disp_Rq2_Data8, getvalue( Env_TSA_DISP_RQ2_21_Byte7 ) );
                SLA_Framecounter = 1;
            }
        }
    }
}
/*@@end*/

/*@@msg:TSA_Disp_Rq2_AR (0x41B):*/
on message TSA_Disp_Rq2_AR
{
    if( getValue( HMI__STMSG_Manual_TSA_Disp_Rq2_AR ) == 0 )
    {
        if( this.TSA_Disp_Rq2_Data1.phys == cMenuInfoCommand )
        {
            counter = this.TSA_Disp_Rq2_Data8;
            counter ++;
            if(counter == 16 )
            {
                counter = 0;
            }
            putValue( HMI_TSA_Disp_Rq2_Data8, counter );
        }
        if( ( this.TSA_Disp_Rq2_Data1.phys == 0x21 ) )
        {
            putValue( HMI_TSA_Disp_Rq2_Data1, 0x10 );
        }
        else
            if( ( this.TSA_Disp_Rq2_Data1.phys == 0x10 ) &&
            getValue( Env_TSA_CTRL_Command_in ) == 0x21 )
            {
                putValue( HMI_TSA_Disp_Rq2_Data1, 0x21 );
            }
    }
    else
    {
        if( SLA_Framecounter == 1 )
        {
            putValue ( HMI_TSA_Disp_Rq2_Data1, getvalue( Env_TSA_DISP_RQ2_10_Byte0 ) );
            putValue ( HMI_TSA_Disp_Rq2_Data2, getvalue( Env_TSA_DISP_RQ2_10_Byte1 ) );
            putValue ( HMI_TSA_Disp_Rq2_Data3, getvalue( Env_TSA_DISP_RQ2_10_Byte2 ) );
            putValue ( HMI_TSA_Disp_Rq2_Data4, getvalue( Env_TSA_DISP_RQ2_10_Byte3 ) );
            putValue ( HMI_TSA_Disp_Rq2_Data5, getvalue( Env_TSA_DISP_RQ2_10_Byte4 ) );
            putValue ( HMI_TSA_Disp_Rq2_Data6, getvalue( Env_TSA_DISP_RQ2_10_Byte5 ) );
            putValue ( HMI_TSA_Disp_Rq2_Data7, getvalue( Env_TSA_DISP_RQ2_10_Byte6 ) );
            putValue ( HMI_TSA_Disp_Rq2_Data8, getvalue( Env_TSA_DISP_RQ2_10_Byte7 ) );
            if( getValue( Env_TSA_DISP_RQ2_21_Aktiv ) )
                SLA_Framecounter = 3;
            else
                SLA_Framecounter = 2;
            return;
        }

        if( SLA_Framecounter == 2 )
        {
            putValue ( HMI_TSA_Disp_Rq2_Data1, getvalue( Env_TSA_DISP_RQ2_20_Byte0 ) );
            putValue ( HMI_TSA_Disp_Rq2_Data2, getvalue( Env_TSA_DISP_RQ2_20_Byte1 ) );
            putValue ( HMI_TSA_Disp_Rq2_Data3, getvalue( Env_TSA_DISP_RQ2_20_Byte2 ) );
            putValue ( HMI_TSA_Disp_Rq2_Data4, getvalue( Env_TSA_DISP_RQ2_20_Byte3 ) );
            putValue ( HMI_TSA_Disp_Rq2_Data5, getvalue( Env_TSA_DISP_RQ2_20_Byte4 ) );
            putValue ( HMI_TSA_Disp_Rq2_Data6, getvalue( Env_TSA_DISP_RQ2_20_Byte5 ) );
            putValue ( HMI_TSA_Disp_Rq2_Data7, getvalue( Env_TSA_DISP_RQ2_20_Byte6 ) );
            putValue ( HMI_TSA_Disp_Rq2_Data8, getvalue( Env_TSA_DISP_RQ2_20_Byte7 ) );
            SLA_Framecounter = 1;
            return;
        }

        if( SLA_Framecounter == 3 )
        {
            putValue ( HMI_TSA_Disp_Rq2_Data1, getvalue( Env_TSA_DISP_RQ2_21_Byte0 ) );
            putValue ( HMI_TSA_Disp_Rq2_Data2, getvalue( Env_TSA_DISP_RQ2_21_Byte1 ) );
            putValue ( HMI_TSA_Disp_Rq2_Data3, getvalue( Env_TSA_DISP_RQ2_21_Byte2 ) );
            putValue ( HMI_TSA_Disp_Rq2_Data4, getvalue( Env_TSA_DISP_RQ2_21_Byte3 ) );
            putValue ( HMI_TSA_Disp_Rq2_Data5, getvalue( Env_TSA_DISP_RQ2_21_Byte4 ) );
            putValue ( HMI_TSA_Disp_Rq2_Data6, getvalue( Env_TSA_DISP_RQ2_21_Byte5 ) );
            putValue ( HMI_TSA_Disp_Rq2_Data7, getvalue( Env_TSA_DISP_RQ2_21_Byte6 ) );
            putValue ( HMI_TSA_Disp_Rq2_Data8, getvalue( Env_TSA_DISP_RQ2_21_Byte7 ) );
            SLA_Framecounter = 1;
        }
    }
}
/*@@end*/

/*@@envVar:Env_TSA_CTRL_Sign2_Empty_numeric:*/
on envVar Env_TSA_CTRL_Sign2_Empty_numeric
{
    if( getValue( Env_TSA_CTRL_Sign2_radio ) == 206 )
    {
        putValue( Env_TSA_CTRL_Sign2, getValue( Env_TSA_CTRL_Sign2_Empty_numeric ) );
    } 
}
/*@@end*/

