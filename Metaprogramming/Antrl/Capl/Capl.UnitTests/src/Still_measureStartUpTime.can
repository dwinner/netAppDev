/*@!Encoding:1252*/
/**
 * Project: BMZ BMS - 5191
 * \file   Still_measureStartUpTime.can
 * \author  Johannes Raab
 * \brief   Startup-Zeiten Messung Still
 * 27.10.2015
 *
 * copyright (c) 2014 Preh GmbH all rights reserved.
 */

/* ----------------------------------------------------------------------------
 Affected documents:
 -------------------
 If appropriate further applicable documents incl. their version's information
 should be referenced. Especially a reference to corresponding specifications
 shall be given.

 Information for the configuration management-system:
 ----------------------------------------------------
 Repository path and filename:
 $Archive: BMZ_BMS/06_Software/10_Common/04_CAN/CANoe/Still_measureStartUpTime.can$
 Workfile:                      
 $Workfile: Still_measureStartUpTime.can$
 Branch:                        
 $Branch: BMZ_BMS$

 Documentation of modifications:
 -------------------------------
 (it will generated automatically during Check-In into the configuration management tool)
 $Revision: 2$
 $Date: Tuesday, October 27, 2015 14:00:04$
 
 $Log$
 RaabJ - Tuesday, October 27, 2015 14:00:04
 -Startup-Time Messung fuer Integrationstest hinzu

 */

includes
{
  
}

variables
{
  dword timestart;
  dword timestop;
  byte ucState;
  byte BMS_State;
  const byte STATE_IDLE = 0;
  const byte STATE_START_UP_READY = 1;
  const byte STATE_START_UP_RUN = 2;
  
  const byte BMS_STATE_READY = 0x3;
  const byte BMS_STATE_RUN = 0x7;
  
  message 0x63C mSDO;
  msTimer msTDelay;
}

on envVar Still_StartUpTimeReady {
  if (getValue(Still_StartUpTimeReady) == 1)
  {
    ucState = STATE_START_UP_READY;
    putValue(Still_normalOperationEnable, 0);
    putValue(Still_normalOperationEnable, 1);
    timestart = timeNow();
  }
}

on envVar Still_StartUpTimeRun {
  if (getValue(Still_StartUpTimeRun) == 1)
  {
    ucState = STATE_START_UP_RUN;
    putValue(Still_onBit,0);
    putValue(Still_normalOperationEnable, 0);
    putValue(Still_normalOperationEnable, 1);
    timestart = timeNow();
  }
}

on envVar Still_GotoSleep {
  if (getValue(this) == 1){
    putValue(Still_normalOperationEnable, 0);
    setTimer(msTDelay, 600);
  }
}

on timer msTDelay{
  sendSleepSDO();
}
on message ST_LiIoBMS_PDO1tx {
  
  if (ucState == STATE_START_UP_READY) {
    if (this.ST_LiIoBMS_BatteryTxStatus == BMS_STATE_READY) {
      timestop = timeNow();
      putValueToControl("StartUpTimeTest","measTimeReadyStill", (float)((timestop - timestart) /100.0));
      ucState = STATE_IDLE;
    }
  }
  else if (ucState == STATE_START_UP_RUN) {
    if (this.ST_LiIoBMS_BatteryTxStatus == BMS_STATE_READY) {
      putValue(Still_onBit,1);
      putValue(Still_driveBit,1);
    }
    else if (this.ST_LiIoBMS_BatteryTxStatus == BMS_STATE_RUN) {
      timestop = timeNow();
      putValueToControl("StartUpTimeTest","measTimeRunStill", (float)((timestop - timestart) /100.0));
      ucState = STATE_IDLE;
    }
    else {}
  }
  else {}
  
}

void sendSleepSDO (void)
{
  mSDO.DLC = 8;
  mSDO.byte(0) = 0x2F;
  mSDO.byte(1) = 0x09;
  mSDO.byte(2) = 0x26;
  mSDO.byte(3) = 0x04;
  mSDO.byte(4) = 1;
  output(mSDO);
}


