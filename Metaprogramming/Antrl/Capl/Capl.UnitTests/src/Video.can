//-----------------------------------------------------------------------------
//  Copyright (C) Continental Automotive All Right Reserved
//            File        : Video.can
//            Author      : Ratheesh
//            Environment : CAPL
//-----------------------------------------------------------------------------
//  Type        : CAPL script
//  Description : This file contains the implementation of video streaming 
//                functionalities with SMSC PCI tool
//  Code Status : Not tested
//  Reference   : UM_Socket_Protocol_API_MOST_PCI_Interface_150o_V01_00_01-1.pdf
//-----------------------------------------------------------------------------
//  Revision History
//  Version     Modified by         Date            Description
//  1.0         Ratheesh/Ralf       23-Apr-2013     Initial version
//  1.1         Ratheesh            23-May-2013     Improved user experience
//-----------------------------------------------------------------------------

includes
{
  // Nil
}

variables
{
  // TCP Socket
  dword dwSocket;
  // TCP receive data;
  char abRxData[2048];
  // Timer restart most network after cable break
  msTimer tMBRestartTimer;
  // MBI FBlockIDs
  const byte bMBI_FBlockID_NetServices                    = 0x01;
  const byte bMBI_FBlockID_MHP                            = 0x02;
  const byte bMBI_FBlockID_Platform                       = 0x07;
  const byte bMBI_FBlockID_Server                         = 0x08;
  const byte bMBI_FBlockID_Generic                        = 0x80;
  // MBI function IDs
  const word wMBI_FuncID_StartUp                          = 0x0100;
  const word wMBI_FuncID_DeviceMode                       = 0x020D;
  const word wMBI_FuncID_MediaStreamConnInfo              = 0x11FF;
  const word wMBI_FuncID_MediaConnInIsochronousStream     = 0x11FA;
  const word wMBI_FuncID_MediaConnInIsochronousStreamExt  = 0x11F8;
  const word wMBI_FuncID_MediaConnOutIsochronousStreamExt = 0x11F7;
  const word wMBI_FuncID_MediaDisconnectStream            = 0x11FE;
  // MBI command error codes
  const long lMbiCmdOk      = 0;
  const long lMbiCmdErr     = 1;
  const long lMbiCmdInvalid = 2;
  // MBI message
  struct MbiMsg
  {
    char cDeviceClass;
    char cInstance;
    char cFBlock;
    char cInstId;
    dword dwTimeStamp;
    char cTimeResolution;
    dword dwLength;
    word wFunctionID;
    char cOperation;
    char abData[255];
  };
  // Flag indicating streaming status
  byte bIsStreaming = 0;
  // Streaming connection id
  byte gu8_ConnId;
  // MBI commands
  enum MbiCmd
  {
    en_MbiCmd_Startup,
    en_MbiCmd_DeviceMode,
    en_MbiCmd_MediaStreamConnInfo,
    en_MbiCmd_MediaConnInIsochroStreamExt,
    en_MbiCmd_MediaConnOutIsochroStreamExt,
    en_MbiCmd_MediaDisconnStream
  };
}

on preStart
{
  dwSocket = 0;
}

// Return 1 - if file exist
// Return 0 - if file not exist
long IsFileExist(char sPath[])
{
//  long lRet;
//  dword fileHandle;
//
//  fileHandle = openFileRead(sPath, 1);
//  if (fileHandle == 0)
//  {
//    lRet = 0;
//  }
//  else
//  {
//    lRet = 1;
//    fileClose(fileHandle);
//  }
//  return lRet;
  return 1;
}

// Return 1 - Success
//        0 - Failure
long VideoStreamingStart(void)
{
  char sPath[255];
  char sTempPath[255];
  char sWorkingDir[255];
  char sCmd[255];
  long lRet;
  long lStat;

  // Get video file path from panel
  sysGetVariableString(sysvar::VIDEO::VideoFile_Path, sTempPath, elcount(sTempPath));
  lStat = IsFileExist(sTempPath);
  if (lStat == 1)
  {
    // Prepare parameters
    getAbsFilePath(".", sWorkingDir, 256);
    snprintf(sCmd, elcount(sCmd),"\"%s\\VideoStreamStart.bat\"",sWorkingDir);
    strncat(sTempPath, "\" out.ts", 255);
    snprintf(sPath, elcount(sPath),"\"%s", sTempPath);
    lStat = sysExec(sCmd, sPath, sWorkingDir);
    if (lStat == 0)
    {
      write("%FILE_NAME%: VideoStreamingStart(): Failed sysExec");
      lRet = 0;
    }
    else
    {
      lRet = 1;
    }
  }
  else
  {
    write("%FILE_NAME%: VideoStreamingStart(): Invalid video file selection");
    lRet = 0;
  }
  return lRet;
}

// Return 1 - Success
//        0 - Failure
long VideoStreamingStartWithDefParam(void)
{
  char sParam[255];
  char sWorkingDir[255];
  char sCmd[255];
  int i;
  long lRet;
  long lStat;
  
  // Prepare parameters
  getAbsFilePath(".", sWorkingDir, 256);
  snprintf(sCmd, elcount(sCmd),"\"%s\\VideoStreamStartDef.bat\"",sWorkingDir);
  snprintf(sParam, elcount(sParam), "out.ts");
  lStat = IsFileExist(sParam);
  if (lStat == 1)
  {
    lStat = sysExec(sCmd, sParam, sWorkingDir);
    if (lStat == 0)
      write("%FILE_NAME%: VideoStreamingStartWithDefParam(): Failed sysExec");
    lRet = 1;
  }
  else
  {
    write("%FILE_NAME%: VideoStreamingStartWithDefParam(): Could not found file out.ts in default path");
    lRet = 0;
  }
  return lRet;
}

void VideoStreamingStop(void)
{
  long lRet;

  // Disconnect streaming connection
  lRet = MBISend(en_MbiCmd_MediaDisconnStream);
  if (lRet != lMbiCmdOk)
    write("%FILE_NAME%: VideoStreamingStop: MBICmdSend(bMBI_FBlockID_Platform, wMBI_FuncID_MediaDisconnectStream) Error = %d", lRet);

  // Close PCI card applications
  lRet = sysExec("taskkill", "/f /im mbstream.exe");
  if (lRet == 0)
    write("%FILE_NAME%: VideoStreamingStop(): Failed taskkill /f /im mbstream.exe");
  lRet = sysExec("taskkill", "/f /im MICtrlc.exe");
  if (lRet == 0)
    write("%FILE_NAME%: VideoStreamingStop(): Failed taskkill /f /im MICtrlc.exe");
}

on timer tMBRestartTimer
{
  // Connect to PCI card
  PCICardConnect();
}

on sysvar VIDEO::Button_StreamingStart
{
  long lRet;
  char sCmd[255];
  char sWorkingDir[255];

  if ((@this == 0) || (bIsStreaming == 1))
    return;

  // Prepare parameters
  getAbsFilePath(".", sWorkingDir, 256);

  snprintf(sCmd, elcount(sCmd),"\"%s\\MICtrlc.exe\"",sWorkingDir);
  // Open MOST interface control for PCI card
  lRet = sysExec(sCmd, "", sWorkingDir);
  if (lRet != 0)
  {
    // Start streaming
    lRet = VideoStreamingStart();
    if (lRet == 1)
    {
      // Set streaming flag
      bIsStreaming = 1;
      // Connect to PCI card
      PCICardConnect();
    }
    else
    {
      lRet = sysExec("taskkill", "/f /im MICtrlc.exe");
      if (lRet == 0)
        write("%FILE_NAME%: Failed taskkill /f /im MICtrlc.exe");
    }
  }
  else
  {
    write("%FILE_NAME%: Failed opening MICtrlc.exe\nPlease check MICtrlc.exe resides in default directory of simulation");
  }
}

on sysvar MAIN::Button_VideoStart
{
  long lRet;
  char sCmd[255];
  char sWorkingDir[255];

  if ((@this == 0) || (bIsStreaming == 1))
    return;

  getAbsFilePath(".", sWorkingDir, 256);
  snprintf(sCmd, elcount(sCmd),"\"%s\\MICtrlc.exe\"",sWorkingDir);
  // Open MOST interface control for PCI card
  lRet = sysExec(sCmd, "", sWorkingDir);
  if (lRet != 0)
  {
    // Start streaming
    lRet = VideoStreamingStartWithDefParam();
    if (lRet == 1)
    {
      // Set streaming flag
      bIsStreaming = 1;
      // Connect to PCI card
      PCICardConnect();
    }
    else
    {
      lRet = sysExec("taskkill", "/f /im MICtrlc.exe");
      if (lRet == 0)
        write("%FILE_NAME%: Failed taskkill /f /im MICtrlc.exe");
    }
  }
  else
  {
    write("%FILE_NAME%: Failed opening MICtrlc.exe\nPlease check MICtrlc.exe resides in default directory of simulation");
  }
}

on sysvar MAIN::Button_VideoStop
{
  if (@this == 0)
    return;

  StreamingStop();
}

on sysvar VIDEO::Button_StreamingStop
{
  if (@this == 0)
    return;

  StreamingStop();
}

void StreamingStop(void)
{
  byte bRgType;

  if (bIsStreaming == 0)
    return;

  // Clear streaming flag
  bIsStreaming = 0;
  bRgType = getvalue(env_NaviSD_ActRGTy_RGType);
  write ("RgType= 0x%x",bRgType);
  // Stop streaming
  VideoStreamingStop();
  // Disconnect PCI card
  PCICardDisconnect();
}

void PCICardConnect(void)
{
  long lIPErr;

  if (dwSocket == 0)
  {
    // Create TCP socket
    dwSocket = TcpOpen(0,0);
    if (dwSocket == 0)
    {
      lIPErr = IpGetLastError();
      write("%FILE_NAME%: PCICardConnect: TcpOpen Error - %d", lIPErr); 
    }
    else
    {
      // Establish connection with PCI card
      lIPErr = TcpConnect(dwSocket, 0x0100007F, 27999);
      if (lIPErr != 0)
      {
        lIPErr = IpGetLastSocketError(dwSocket);
        if (lIPErr != 10035)
        {
          write("%FILE_NAME%: PCICardConnect: TcpConnect Error - %d", lIPErr);
          TcpClose(dwSocket);
          dwSocket = 0;
        }
      }
    }
  }
}

void PCICardDisconnect(void)
{
  long lIPErr;

  cancelTimer(tMBRestartTimer);
  if (dwSocket != 0)
  {
    lIPErr = TcpClose(dwSocket);
    if (lIPErr != 0)
      write("%FILE_NAME%: PCICardDisconnect: TcpClose Error - %d", lIPErr);
    dwSocket = 0;
  }
}

OnTcpConnect(dword socket, long result)
{
  long lErr;

  // set buffer to receive data from socket
  TcpReceive( socket, abRxData, 2048);

  // Check whether the right connection
  if ((dwSocket == socket) && (result == 0))
  {
    lErr = MBISend(en_MbiCmd_Startup);
    if (lErr != lMbiCmdOk)
      write("%FILE_NAME%: OnTcpConnect: MBICmdSend(en_MbiCmd_Startup) Error = %d", lErr);

    lErr = MBISend(en_MbiCmd_DeviceMode);
    if (lErr != lMbiCmdOk)
      write("%FILE_NAME%: OnTcpConnect: MBICmdSend(en_MbiCmd_DeviceMode) Error = %d", lErr);

    lErr = MBISend(en_MbiCmd_MediaStreamConnInfo);
    if (lErr != lMbiCmdOk)
      write("%FILE_NAME%: OnTcpConnect: MBICmdSend(en_MbiCmd_MediaStreamConnInfo) Error = %d", lErr);
  }
  else
  {
    write("%FILE_NAME%: OnTcpConnect: Invalid connection, socket = %d result = %d", socket, result);
  }
}

OnTcpReceive( dword socket, long result, dword address, dword port, char buffer[], dword size)
{
  MBIReceive(buffer,size);
  // provide buffer for next TCP data
  TcpReceive( socket, abRxData, 2048);
}

void MBIReceive(char abMBData[], dword dwSize)
{
  dword dwPos = 0;
  dword dwCnt;
  struct MbiMsg st_MbiMsg;
  
  dwPos = 0;
  do 
  {
    if ((abMBData[dwPos] != '<') && (33 >(dwSize - dwPos)))
    {
      // Stream invalid skip it
      dwPos++;
    }
    else
    {
      st_MbiMsg.cDeviceClass = a2i(abMBData[dwPos + 1]) << 4;
      st_MbiMsg.cDeviceClass |= a2i(abMBData[dwPos + 2]);
      st_MbiMsg.cInstance = a2i(abMBData[dwPos + 3]) << 4;
      st_MbiMsg.cInstance |= a2i(abMBData[dwPos + 4]);
      st_MbiMsg.cFBlock = a2i(abMBData[dwPos + 5]) << 4;
      st_MbiMsg.cFBlock |= a2i(abMBData[dwPos + 6]);
      st_MbiMsg.cInstId = a2i(abMBData[dwPos + 7]) << 4;
      st_MbiMsg.cInstId |= a2i(abMBData[dwPos + 8]);
      st_MbiMsg.dwTimeStamp = a2i(abMBData[dwPos + 9]) << 28;
      st_MbiMsg.dwTimeStamp |= a2i(abMBData[dwPos + 10]) << 24;
      st_MbiMsg.dwTimeStamp |= a2i(abMBData[dwPos + 11]) << 20;
      st_MbiMsg.dwTimeStamp |= a2i(abMBData[dwPos + 12]) << 16;
      st_MbiMsg.dwTimeStamp |= a2i(abMBData[dwPos + 13]) << 12;
      st_MbiMsg.dwTimeStamp |= a2i(abMBData[dwPos + 14]) << 8;
      st_MbiMsg.dwTimeStamp |= a2i(abMBData[dwPos + 15]) << 4;
      st_MbiMsg.dwTimeStamp |= a2i(abMBData[dwPos + 16]);
      st_MbiMsg.cTimeResolution = a2i(abMBData[dwPos + 17]) << 4;
      st_MbiMsg.cTimeResolution |= a2i(abMBData[dwPos + 18]);
      st_MbiMsg.dwLength = a2i(abMBData[dwPos + 19]) << 20;
      st_MbiMsg.dwLength |= a2i(abMBData[dwPos + 20]) << 16;
      st_MbiMsg.dwLength |= a2i(abMBData[dwPos + 21]) << 12;
      st_MbiMsg.dwLength |= a2i(abMBData[dwPos + 22]) << 8;
      st_MbiMsg.dwLength |= a2i(abMBData[dwPos + 23]) << 4;
      st_MbiMsg.dwLength |= a2i(abMBData[dwPos + 24]);
      st_MbiMsg.wFunctionID = a2i(abMBData[dwPos + 25]) << 12;
      st_MbiMsg.wFunctionID |= a2i(abMBData[dwPos + 26]) << 8;
      st_MbiMsg.wFunctionID |= a2i(abMBData[dwPos + 27]) << 4;
      st_MbiMsg.wFunctionID |= a2i(abMBData[dwPos + 28]);
      st_MbiMsg.cOperation = a2i(abMBData[dwPos + 29]) << 4;
      st_MbiMsg.cOperation |= a2i(abMBData[dwPos + 30]);
      if (dwSize > (dwPos + 31 + (st_MbiMsg.dwLength * 2)))
      {
        for (dwCnt = 0; dwCnt < st_MbiMsg.dwLength; dwCnt++)
        {
           st_MbiMsg.abData[dwCnt] =  a2i(abMBData[dwPos + 31 + (dwCnt * 2)]) << 4;
           st_MbiMsg.abData[dwCnt] |= a2i(abMBData[dwPos + 31 + (dwCnt * 2) + 1]);
        }
        MBCallFunctionCatalog(st_MbiMsg);
      }
      else
      {
        //stream invalid skip it
        dwPos = dwSize;
      }
      dwPos = dwPos + 31 + (dwCnt * 2) + 2;
    }
    //write("Pos %x::%x",dwPos, dwSize);
  }
  while (dwPos < dwSize);
}

long MBISend(long u32_Cmd)
{
  long lErr = lMbiCmdOk;
  long lRet;

  switch(u32_Cmd)
  {
    case en_MbiCmd_Startup:
    {
      if (@VIDEO::RadioButton_NetworkMode == 1)
      {
        //write ("MostMaster");
        lRet = TcpSend(dwSocket, ">0200010000000000010000020100000100\r\n", 37);
      }
      else
      {
        //write("Most Slave");
        lRet = TcpSend(dwSocket, ">0200010000000000010000020100000000\r\n", 37);
      }
      
      if (lRet != 0)
      {
        write("%FILE_NAME%: MBICmdSend: TcpSend() error = %d", lRet);
        lErr = lMbiCmdErr;
      }
    }
    break;
    case en_MbiCmd_DeviceMode:
    {
      if (@VIDEO::RadioButton_NetworkMode == 1)
      {
        lRet = TcpSend( dwSocket, ">020001000000000001000001020D0001\r\n", 35);
      }
      else
      {
        lRet = TcpSend( dwSocket, ">020001000000000001000001020D0000\r\n", 35);
      }
      if (lRet != 0)
      {
        write("%FILE_NAME%: MBICmdSend: TcpSend() error = %d", lRet);
        lErr = lMbiCmdErr;
      }
    }
    break;
    case en_MbiCmd_MediaStreamConnInfo:
    {
      lRet = TcpSend( dwSocket, ">02000700000000000100000011ff01\r\n", 33);
      if (lRet != 0)
      {
        write("%FILE_NAME%: MBICmdSend: TcpSend() error = %d", lRet);
        lErr = lMbiCmdErr;
      }
    }
    break;
    case en_MbiCmd_MediaConnInIsochroStreamExt:
    {
      
    }
    break;
    case en_MbiCmd_MediaConnOutIsochroStreamExt:
    {
      
    }
    break;
    case en_MbiCmd_MediaDisconnStream:
    {
      char sBuff2[255];
      char sBuff[255] = ">02000700000000000100000111fe00";
      char sTemp[255];

      strncpy(sBuff2, sBuff, elcount(sBuff2));
      snprintf(sTemp, elcount(sTemp), "%.2X\r\n", gu8_ConnId);
      strncat(sBuff2, sTemp, elcount(sBuff2));
      write("%s", sBuff2);
      lRet = TcpSend(dwSocket, sBuff2, strlen(sBuff2));
      if (lRet != 0)
      {
        write("%FILE_NAME%: MBICmdSend: TcpSend() error = %d", lRet);
        lErr = lMbiCmdErr;
      }
    }
    break;
    default:
    {
      lErr = lMbiCmdInvalid;
    }
    break;
  }
  return lErr;
}

void MBCallFunctionCatalog(struct MBIMsg st_Msg)
{
  switch (st_Msg.cFBlock)
  {
    case bMBI_FBlockID_NetServices:
    {
      MBCallFBlock_NetServices(st_Msg);
    }
    break;
    case bMBI_FBlockID_MHP:
    {
      MBCallFBlock_HighProtocol(st_Msg);
    }
    break;
    case bMBI_FBlockID_Platform:
    {
      MBCallFBlock_PlatformSpecific(st_Msg);
    }
    break;
    case bMBI_FBlockID_Server:
    {
      MBCallFBlock_Server(st_Msg);
    }
    break;
    case bMBI_FBlockID_Generic:
    {
      MBCallFBlock_Generic(st_Msg);
    }
    break;
    default:
    {
      // Do nothing
    }
    break;
  }
}

MBCallFBlock_NetServices(struct MBIMsg st_Msg)
{
  // Do nothing
}

MBCallFBlock_HighProtocol(struct MBIMsg st_Msg)
{
  // Do nothing
}

MBCallFBlock_PlatformSpecific(struct MBIMsg st_Msg)
{
  long lErr;

  switch (st_Msg.wFunctionID)
  {
    case wMBI_FuncID_MediaStreamConnInfo:
    {
      if (st_Msg.cOperation == 0x0c)
      {
        word wLabel;
        word wWidth;
        char sBuff1[255] = ">02000700000000000100000511f80000";
        char sTempBuff1[255];
        char sBuff2[255] = ">02000700000000000100000711f70000";
        char sTempBuff2[255];
        char sIsoPktPerBuf[10];

        if (st_Msg.dwLength < 7)
        {
          snprintf(sIsoPktPerBuf, elcount(sIsoPktPerBuf), "%.4X", @VIDEO::IsoPacketsPerBuffer);
          if(@VIDEO::RadioButton_StreamingMode == 0)
          {
            // Output direction, send video to most
            strncpy(sTempBuff1, sBuff1, elcount(sTempBuff1));
            strncat(sTempBuff1, sIsoPktPerBuf, elcount(sTempBuff1));
            strncat(sTempBuff1, "00BC\r\n", elcount(sTempBuff1));
            write("StreamIn 1 %s", sTempBuff1);
            lErr = TcpSend( dwSocket, sTempBuff1, strlen(sTempBuff1));
          }
          else
          {
            // Input direction, receive video from most
            strncpy(sTempBuff2, sBuff2, elcount(sTempBuff2));
            strncat(sTempBuff2, sIsoPktPerBuf, elcount(sTempBuff2));
            strncat(sTempBuff2, "00AF00BC\r\n", elcount(sTempBuff2));
            write(" StreamIn 2 %s", sTempBuff2);
            lErr = TcpSend( dwSocket, sTempBuff2, strlen(sTempBuff2));  
          }
          if (lErr != 0)
          {
            write("%FILE_NAME%: MBCallFBlock_PlatformSpecific: TcpSend() error = %d", IpGetLastSocketError(dwSocket));
          }
        }
        else
        {
          wLabel = (byte)st_Msg.abData[5]<<8 | (byte)st_Msg.abData[6];
          wWidth = (byte)st_Msg.abData[3]<<8 | (byte)st_Msg.abData[4];
          write("%FILE_NAME%: MBCallFBlock_PlatformSpecific: Connection ID:%d, Type:%X, Index/Offset: %X, Width:%X, Label: %X",
            st_Msg.abData[0], st_Msg.abData[1], st_Msg.abData[2], wWidth, wLabel);
          gu8_ConnId = st_Msg.abData[0];
          if (st_Msg.abData[1]== 0x03)
          {
            // we have an isochronus stream OUT
            write("%FILE_NAME%: Start Videoviewer");
            sysExec("MostVideoViewer.exe", "-iso -o 0 -w 112 -vpid 0x150 -apid 0" );
          }
          else
          {
            // we need to send a connect
            mostAMSMessage GfxStreamSink.Connect.StartResultAck msg;

            // Prepare message
            msg.DA = 0x03C8;
            msg.MsgChannel = mostGetChannel();
            msg.InstanceId = 0x01;
            msg.SenderHandle = 0;
            msg.SinkNr = 0x14;
            msg.BlockWidth = wWidth;
            msg.ConnectionLabel = wLabel;
            output(msg);
          }
        }
      }
    }
    break;
  case wMBI_FuncID_MediaConnInIsochronousStreamExt:
    case wMBI_FuncID_MediaConnOutIsochronousStreamExt:
    {
      if (st_Msg.cOperation == 0x0F)
      {
        // Open connection failed. Disconnect device and start restart timer.
        PCICardDisconnect();
        setTimer(tMBRestartTimer,2000);
      }
    }	
	break;
    default:
    {
      // Do nothing
    }
    break;
  }
}

MBCallFBlock_Server(struct MBIMsg st_Msg)
{
  // Do nothing
}

MBCallFBlock_Generic(struct MBIMsg st_Msg)
{
  // Do nothing
}

char a2i(char cASCII)
{
  char bValue;
  switch (cASCII)
  {
    case 0x30: case 0x31: case 0x32: case 0x33: case 0x34:
    case 0x35: case 0x36: case 0x37: case 0x38: case 0x39:
    {
      bValue = cASCII - 0x30;
    }
    break;
    case 'A': case 'a':
    {
      bValue = 10;
    }
    break;
    case 'B': case 'b':
    {
      bValue = 11;
    }
    break;
    case 'C': case 'c':
    {
      bValue = 12;
    }
    break;
    case 'D': case 'd':
    {
      bValue = 13;
    }
    break;
    case 'E': case 'e':
    {
      bValue = 14;
    }
    break;
    case 'F': case 'f':
    {
      bValue = 15;
    }
    break;
    default:
    {
      bValue = 0xFF;
    }
    break;
  }
  return (bValue);
}
