    // Botschaft XXX ID: ZZZ --- Sendeart 2 cyclicIfActiveFast --- 
    message XXX _mXXX;
    int _XXX_Timebase;
    int _XXX_CycleCount;
    int _XXX_StartDelay;
    int _XXX_Cnt;
    int _XXX_SigActivity;

    int _XXX_xxy_LastState = 0;

    int _XXX_xxy_InactiveValue = 'value';
    
    msTimer _tXXX;







/*@@caplFunc:XXX_Activity(int):*/
void XXX_Activity(int active)
{
    if( active)
    {
        if( _XXX_SigActivity == 0 )
            _XXX_Cnt = 1;
        _XXX_SigActivity++;
    }
    else
    {
        _XXX_SigActivity--;
    }
}
/*@@end*/

/*@@caplFunc:XXX_Change(int,int,int):*/
int XXX_Change(int lastValue, int sigValue, int inActValue)
{
    bActiveHelper = (sigValue != inActValue);
      if( !lastValue && bActiveHelper)
        XXX_Activity(1 );
      else if( lastValue && !bActiveHelper)
        XXX_Activity(0 );
    return bActiveHelper;
}
/*@@end*/

/*@@caplFunc:XXX_check_output():*/
XXX_check_output()
{
    if( !getValue( HMI__STMSG_XXX ) )
    {
        // Botschaft XXX ID: ZZZ --- Sendeart 2 cyclicIfActiveX --- 
        if( _XXX_SigActivity )
            _XXX_Cnt--;
        if( _XXX_Cnt < 1 )
        {
            XXX_output(); // Zyklus abgelaufen, Nachricht senden
            _XXX_Cnt = _XXX_CycleCount;
        }
    }
}
/*@@end*/

/*@@caplFunc:XXX_init():*/
XXX_init()
{   /* Botschaft XXX ID: ZZZ --- Sendeart 2 cyclicIfActiveX --- 
BA_ "ApplMessage" BO_ ZZZ 0;
BA_ "NmAsrMessage" BO_ ZZZ 0;
BA_ "GenMsgMinAcceptLength" BO_ ZZZ 4;
BA_ "GenMsgILSupport" BO_ ZZZ 1;
BA_ "DiagState" BO_ ZZZ 0;
BA_ "DiagRequest" BO_ ZZZ 0;
BA_ "DiagResponse" BO_ ZZZ 0;
BA_ "GenMsgStartValue" BO_ ZZZ "0";
BA_ "GenMsgStartDelayTime" BO_ ZZZ 0;
BA_ "GenMsgDelayTime" BO_ ZZZ 5;
BA_ "GenMsgCycleTime" BO_ ZZZ 0;
BA_ "GenMsgCycleTimeActive" BO_ ZZZ 50;
BA_ "GenMsgSendType" BO_ ZZZ 2;
    */
    _XXX_Timebase =            c_tDBKomTimer_20ms;
    _XXX_CycleCount =          50 / _XXX_Timebase;
    _XXX_StartDelay =           0 / _XXX_Timebase;
    _XXX_Cnt = 0;
    _XXX_SigActivity = 0;

    putValue( HMI__STMSGSD_XXX, _XXX_StartDelay * _XXX_Timebase );

    _mXXX.xxy.phys = getValue( HMI_xxy );                  _XXX_xxy_LastState = XXX_Change( _XXX_xxy_LastState, _mXXX.xxy, _XXX_xxy_InactiveValue );
}
/*@@end*/

/*@@caplFunc:XXX_output():*/
XXX_output()
{
    output( _mXXX );
}
/*@@end*/

/*@@caplFunc:XXX_saveEnvVars(dword):*/
XXX_saveEnvVars( dword hFile )
{
    filePutString("\n// Knoten TGW: XXX\n", 32, hFile);
    snprintf( buffer, elcount(buffer), "0.0000 HMI__STMSG_XXX := %X\n", getValue( HMI__STMSG_XXX ));        filePutString( buffer, elcount(buffer), hFile);
    snprintf( buffer, elcount(buffer), "0.0000 HMI__STMSGT_XXX := %X\n", getValue( HMI__STMSGT_XXX ));        filePutString( buffer, elcount(buffer), hFile);
    snprintf( buffer, elcount(buffer), "0.0000 HMI_xxy := %X\n", getValue( HMI_xxy ) );        filePutString( buffer, elcount(buffer), hFile);
}
/*@@end*/

/*@@timer:_tXXX:*/
on timer _tXXX
{
    putValue( HMI__STMSG_XXX, 0 );
}
/*@@end*/

/*@@envVar:HMI__STMSG_XXX:*/
on EnvVar HMI__STMSG_XXX
{
    long tDelay;
    if( getValue( this ) == 2 )
    {
        tDelay = getValue( HMI__STMSGT_XXX );
        if( tDelay > 0 )    
            setTimer( _tXXX, tDelay );
        else
            putValue( HMI__STMSG_XXX, 0 );
    }
}
/*@@end*/

/*@@envVar:HMI__ALLDEF_XXX:*/
on EnvVar HMI__ALLDEF_XXX
{
    if( getValue(this))
    {
        // alle signale auf default einstellen
        putValue( HMI_xxy, _XXX_xxy_InactiveValue );
    }
}
/*@@end*/

/*@@envVar:HMI_xxy:*/
on EnvVar HMI_xxy
{
    _mXXX.xxy.phys = getValue(this);
    _XXX_xxy_LastState = XXX_Change(_XXX_xxy_LastState, _mXXX.xxy, _XXX_xxy_InactiveValue );
}
/*@@end*/

