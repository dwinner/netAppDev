variables
{
    byte x, y, z;
    y = 0x0AA; // y = 1010 1010
    z = 0x05A; // z = 0101 1010
    x = y & z; // AND result = 0000 1010
    x = y | z; // OR result = 1111 1010
    x = y ^ z; // XOR result = 1111 0000
    x = y << 1; // shift left result = 0101 0100
    x = y >> 1; // shift right result = 0101 0101
    x = ~y; // 1’s complement result = 0101 0101
}