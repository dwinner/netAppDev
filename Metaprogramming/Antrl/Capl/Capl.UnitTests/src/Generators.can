/*@@var:*/
variables
{
    dword KL_15_T1;
    dword KL_15_T2;
    word KL_15_dT;

    dword KL_S_T1;
    dword KL_S_T2;
    word KL_S_dT;

    dword NMH_T1;
    dword NMH_T2;
    word NMH_dT;

    word KL_15_dT_val;
    dword KL_15_T1_val;
    dword KL_15_T2_val;    

    word KL_S_dT_val;
    dword KL_S_T1_val;
    dword KL_S_T2_val;

    word NMH_dT_val;
    dword NMH_T1_val;
    dword NMH_T2_val;

    mstimer KL_15_T1_mstimer;
    mstimer KL_15_T2_mstimer;
    mstimer KL_15_dT_mstimer;

    mstimer KL_S_T1_mstimer;
    mstimer KL_S_T2_mstimer;
    mstimer KL_S_dT_mstimer;

    mstimer NMH_T1_mstimer;
    mstimer NMH_T2_mstimer;
    mstimer NMH_dT_mstimer;

    timer KL_15_T1_timer;
    timer KL_15_T2_timer;
    timer KL_15_dT_timer;

    timer KL_S_T1_timer;
    timer KL_S_T2_timer;
    timer KL_S_dT_timer;

    timer NMH_T1_timer;
    timer NMH_T2_timer;
    timer NMH_dT_timer;
}
/*@@end*/

/*@@envVar:eKL_15_Test:*/
on envVar eKL_15_Test
{
    if (getValue(this))
    {   
        KL_15_dT_val = getValue(eKL_15_dT);
        KL_15_T1_val = getValue(eKL_15_T1);
        KL_15_T2_val = getValue(eKL_15_T2);    
                
        if ((KL_15_T1_val > 0) && (KL_15_T2_val > 0))
        {      
            putValue(eParameterString, "Valid");
            KL_15_dT = KL_15_dT_val;
            
            putValue (eZAS_Kl_15S, 0);

            if (getValue(eTimerType) == 0)
            {
                setTimer (KL_15_dT_timer, KL_15_dT);
            }
            else
            {
                setTimer (KL_15_dT_mstimer, KL_15_dT);
            }
        }
		else
		{
			putValue(eParameterString, "Invalid");
		}
    }
    else
    {
        putValue (eZAS_Kl_15S, 0);

        if (getValue(eTimerType) == 0)
        {
            cancelTimer (KL_15_dT_timer);
            cancelTimer (KL_15_T1_timer);
            cancelTimer (KL_15_T2_timer);
        }
        else
        {
            cancelTimer (KL_15_dT_mstimer);
            cancelTimer (KL_15_T1_mstimer);
            cancelTimer (KL_15_T2_mstimer);
        }
    }
}
/*@@end*/

/*@@envVar:eKL_S_Test:*/
on envVar eKL_S_Test
{
    if (getValue(this))
    {
        KL_S_dT_val = getValue (eKL_S_dT);
        KL_S_T1_val = getValue (eKL_S_T1);
        KL_S_T2_val = getValue (eKL_S_T2);

        if ((KL_S_T1_val > 0) && (KL_S_T2_val > 0))
        {   
            putValue(eParameterString, "Valid");
            KL_S_dT = KL_S_dT_val;
        
            putValue (eZAS_Kl_SS, 0);

            if (getValue(eTimerType) == 0)
            {
                setTimer (KL_S_dT_timer, KL_S_dT);        
            }
            else
            {
                setTimer (KL_S_dT_mstimer, KL_S_dT);        
            }
        }
		else
		{
			putValue(eParameterString, "Invalid");
		}
    }
    else
    {
        putValue (eZAS_Kl_SS, 0);

        if (getValue(eTimerType) == 0)
        {
            cancelTimer (KL_S_dT_timer);
            cancelTimer (KL_S_T1_timer);
            cancelTimer (KL_S_T2_timer);
        }
        else
        {
            cancelTimer (KL_S_dT_mstimer);
            cancelTimer (KL_S_T1_mstimer);
            cancelTimer (KL_S_T2_mstimer);
        }
    }
}
/*@@end*/

/*@@envVar:eNMH_Test:*/
on envVar eNMH_Test
{
    if (getValue(this))
    {
        NMH_dT_val = getValue (eNMH_dT);
        NMH_T1_val = getValue (eNMH_T1);
        NMH_T2_val = getValue (eNMH_T2);

        if ((NMH_T1_val > 0) && (NMH_T2_val > 0))
        { 
            putValue(eParameterString, "Valid");
            putValue (eNMHMode, 1);
            putValue (eNMHControllerNodeAwake, 0);

            NMH_dT = NMH_dT_val;

            if (getValue(eTimerType) == 0)
            {
                setTimer (NMH_dT_timer, NMH_dT);
            }
            else
            {
                setTimer (NMH_dT_mstimer, NMH_dT);
            }
        }
		else
		{
			putValue(eParameterString, "Invalid");
		}
    }
    else
    {
        if (getValue(eTimerType) == 0)
        {
            cancelTimer (NMH_dT_timer);
            cancelTimer (NMH_T1_timer);
            cancelTimer (NMH_T2_timer);
        }
        else
        {
            cancelTimer (NMH_dT_mstimer);
            cancelTimer (NMH_T1_mstimer);
            cancelTimer (NMH_T2_mstimer);
        }
    }
}
/*@@end*/

/*@@envVar:eAll_Test:*/
on envVar eAll_Test
{
    if (getValue(this))
    {
        KL_S_dT_val = getValue (eKL_S_dT);
        KL_S_T1_val = getValue (eKL_S_T1);
        KL_S_T2_val = getValue (eKL_S_T2);

        KL_15_dT_val = getValue (eKL_15_dT);
        KL_15_T1_val = getValue (eKL_15_T1);
        KL_15_T2_val = getValue (eKL_15_T2);

        NMH_dT_val = getValue (eNMH_dT);
        NMH_T1_val = getValue (eNMH_T1);
        NMH_T2_val = getValue (eNMH_T2);

        if (getValue(eParameterCheck))
        {
            if ((KL_15_dT_val > NMH_dT_val) && (KL_S_dT_val > KL_15_dT_val)
            &&  (KL_15_T1_val < NMH_T1_val) && (KL_S_T1_val < KL_15_T1_val)
            &&  (KL_15_T2_val > NMH_T2_val) && (KL_S_T2_val > KL_15_T2_val))
            {   
                if (((NMH_T1_val + NMH_T2_val) == (KL_15_T1_val + KL_15_T2_val))
                &&  ((KL_15_T1_val + KL_15_T2_val) == (KL_S_T1_val + KL_S_T2_val)))
                {
                    putValue(eParameterString, "Valid");

                    putValue (eNMH_Test, 1);                       
                    putValue (eKL_15_Test, 1);
                    putValue (eKL_S_Test, 1);                
                }
                else
                {
                    putValue (eParameterString, "Invalid");
                }
            }
            else
            {
                putValue (eParameterString, "Invalid");
            }
        }
        else
        {
            putValue(eParameterString, "Valid");
            putValue (eNMH_Test, 1);                       
            putValue (eKL_15_Test, 1);
            putValue (eKL_S_Test, 1);
        }                
    }
    else
    {   
        putValue (eNMH_Test, 0);     
        putValue (eKL_15_Test, 0);
        putValue (eKL_S_Test, 0);        
    }
}
/*@@end*/

/*@@timer:KL_15_dT_timer:*/
on timer KL_15_dT_timer
{
    putValue (eZAS_Kl_15S, 1);

    KL_15_T1 = KL_15_T1_val;
    setTimer (KL_15_T1_timer, KL_15_T1);
}
/*@@end*/

/*@@timer:KL_15_T1_timer:*/
on timer KL_15_T1_timer
{
    putValue (eZAS_Kl_15S, 0);

    KL_15_T2 = KL_15_T2_val;
    setTimer (KL_15_T2_timer, KL_15_T2);
}
/*@@end*/

/*@@timer:KL_15_T2_timer:*/
on timer KL_15_T2_timer
{
    putValue (eZAS_Kl_15S, 1);

    KL_15_T1 = KL_15_T1_val;
    setTimer (KL_15_T1_timer, KL_15_T1);
}
/*@@end*/

/*@@timer:KL_S_dT_timer:*/
on timer KL_S_dT_timer
{
    putValue (eZAS_Kl_SS, 1);

    KL_S_T1 = KL_S_T1_val;
    setTimer (KL_S_T1_timer, KL_S_T1);
}
/*@@end*/

/*@@timer:KL_S_T1_timer:*/
on timer KL_S_T1_timer
{
    putValue (eZAS_Kl_SS, 0);

    KL_S_T2 = KL_S_T2_val;
    setTimer (KL_S_T2_timer, KL_S_T2);
}
/*@@end*/

/*@@timer:KL_S_T2_timer:*/
on timer KL_S_T2_timer
{
    putValue (eZAS_Kl_SS, 1);

    KL_S_T1 = KL_S_T1_val;
    setTimer (KL_S_T1_timer, KL_S_T1);
}
/*@@end*/

/*@@timer:NMH_dT_timer:*/
on timer NMH_dT_timer
{
    putValue (eNMHMode, 1);
    putValue (eNMHControllerNodeAwake, 1);

    NMH_T1 = NMH_T1_val;
    setTimer (NMH_T1_timer, NMH_T1);
}
/*@@end*/

/*@@timer:NMH_T1_timer:*/
on timer NMH_T1_timer
{
    putValue (eNMHMode, 1);
    putValue (eNMHControllerNodeAwake, 0);

    NMH_T2 = NMH_T2_val;
    setTimer (NMH_T2_timer, NMH_T2);
}
/*@@end*/

/*@@timer:NMH_T2_timer:*/
on timer NMH_T2_timer
{
    putValue (eNMHMode, 1);
    putValue (eNMHControllerNodeAwake, 1);

    NMH_T1 = NMH_T1_val;
    setTimer (NMH_T1_timer, NMH_T1);
}
/*@@end*/

/*@@startStart:Start:*/
on start
{
    putValue (eParameterString, "Valid");
}
/*@@end*/

/*@@envVar:eNMH_KL_15_Test:*/
on envVar eNMH_KL_15_Test
{
    if (getValue(this))
    {        
        KL_15_dT_val = getValue (eKL_15_dT);
        KL_15_T1_val = getValue (eKL_15_T1);
        KL_15_T2_val = getValue (eKL_15_T2);

        NMH_dT_val = getValue (eNMH_dT);
        NMH_T1_val = getValue (eNMH_T1);
        NMH_T2_val = getValue (eNMH_T2);

        if (getValue(eParameterCheck))
        {
            if ((KL_15_dT_val > NMH_dT_val)
            &&  (KL_15_T1_val < NMH_T1_val) 
            &&  (KL_15_T2_val > NMH_T2_val))
            {   
                if ((NMH_T1_val + NMH_T2_val) == (KL_15_T1_val + KL_15_T2_val))            
                {
                    putValue(eParameterString, "Valid");

                    putValue (eNMH_Test, 1);                       
                    putValue (eKL_15_Test, 1);                               
                }
                else
                {
                    putValue (eParameterString, "Invalid");
                }
            }
            else
            {
                putValue (eParameterString, "Invalid");
            }
         }
         else
         {
            putValue(eParameterString, "Valid");
            putValue (eNMH_Test, 1);                       
            putValue (eKL_15_Test, 1);                               
         }                
    }
    else
    {                
        putValue (eNMH_Test, 0);
        putValue (eKL_15_Test, 0);        
    }
}
/*@@end*/

/*@@envVar:eKL_15_KL_S_Test:*/
on envVar eKL_15_KL_S_Test
{
    if (getValue(this))
    {
        KL_S_dT_val = getValue (eKL_S_dT);
        KL_S_T1_val = getValue (eKL_S_T1);
        KL_S_T2_val = getValue (eKL_S_T2);

        KL_15_dT_val = getValue (eKL_15_dT);
        KL_15_T1_val = getValue (eKL_15_T1);
        KL_15_T2_val = getValue (eKL_15_T2);        

        if (getValue(eParameterCheck))
        {
            if ((KL_S_dT_val > KL_15_dT_val)
            &&  (KL_S_T1_val < KL_15_T1_val)
            &&  (KL_S_T2_val > KL_15_T2_val))
            {               
                if ((KL_15_T1_val + KL_15_T2_val) == (KL_S_T1_val + KL_S_T2_val))
                {
                    putValue(eParameterString, "Valid");
                    
                    putValue (eKL_15_Test, 1);
                    putValue (eKL_S_Test, 1);                
                }
                else
                {
                    putValue (eParameterString, "Invalid");
                }
            }
            else
            {
                putValue (eParameterString, "Invalid");
            }
        }
        else
        {
            putValue(eParameterString, "Valid");                    
            putValue (eKL_15_Test, 1);
            putValue (eKL_S_Test, 1); 
        }                
    }
    else
    {           
        putValue (eKL_15_Test, 0);
        putValue (eKL_S_Test, 0);        
    }
}
/*@@end*/

/*@@envVar:eKL_S_NMH_Test:*/
on envVar eKL_S_NMH_Test
{
    if (getValue(this))
    {
        KL_S_dT_val = getValue (eKL_S_dT);
        KL_S_T1_val = getValue (eKL_S_T1);
        KL_S_T2_val = getValue (eKL_S_T2);        

        NMH_dT_val = getValue (eNMH_dT);
        NMH_T1_val = getValue (eNMH_T1);
        NMH_T2_val = getValue (eNMH_T2);

        if (getValue(eParameterCheck))
        {
            if ((KL_S_dT_val > NMH_dT_val) 
            &&  (KL_S_T1_val < NMH_T1_val)
            &&  (KL_S_T2_val > NMH_T2_val))
            {   
                if ((NMH_T1_val + NMH_T2_val) == (KL_S_T1_val + KL_S_T2_val))            
                {
                    putValue(eParameterString, "Valid");

                    putValue (eNMH_Test, 1);                                       
                    putValue (eKL_S_Test, 1);                
                }
                else
                {
                    putValue (eParameterString, "Invalid");
                }
            }
            else
            {
                putValue (eParameterString, "Invalid");
            }
        }
        else
        {
            putValue(eParameterString, "Valid");
            putValue (eNMH_Test, 1);                                       
            putValue (eKL_S_Test, 1);                
        }                
    }
    else
    {   
        putValue (eNMH_Test, 0);     
        putValue (eKL_S_Test, 0);        
    }
}
/*@@end*/

/*@@timer:KL_15_T1_mstimer:*/
on timer KL_15_T1_mstimer
{
    putValue (eZAS_Kl_15S, 0);

    KL_15_T2 = KL_15_T2_val;
    setTimer (KL_15_T2_mstimer, KL_15_T2);
}
/*@@end*/

/*@@timer:KL_15_T2_mstimer:*/
on timer KL_15_T2_mstimer
{
    putValue (eZAS_Kl_15S, 1);

    KL_15_T1 = KL_15_T1_val;
    setTimer (KL_15_T1_mstimer, KL_15_T1);
}
/*@@end*/

/*@@timer:KL_15_dT_mstimer:*/
on timer KL_15_dT_mstimer
{
    putValue (eZAS_Kl_15S, 1);

    KL_15_T1 = KL_15_T1_val;
    setTimer (KL_15_T1_mstimer, KL_15_T1);
}
/*@@end*/

/*@@timer:KL_S_T1_mstimer:*/
on timer KL_S_T1_mstimer
{
    putValue (eZAS_Kl_SS, 0);

    KL_S_T2 = KL_S_T2_val;
    setTimer (KL_S_T2_mstimer, KL_S_T2);
}
/*@@end*/

/*@@timer:KL_S_T2_mstimer:*/
on timer KL_S_T2_mstimer
{
    putValue (eZAS_Kl_SS, 1);

    KL_S_T1 = KL_S_T1_val;
    setTimer (KL_S_T1_mstimer, KL_S_T1);
}
/*@@end*/

/*@@timer:KL_S_dT_mstimer:*/
on timer KL_S_dT_mstimer
{
    putValue (eZAS_Kl_SS, 1);

    KL_S_T1 = KL_S_T1_val;
    setTimer (KL_S_T1_mstimer, KL_S_T1);
}
/*@@end*/

/*@@timer:NMH_T1_mstimer:*/
on timer NMH_T1_mstimer
{
    putValue (eNMHMode, 1);
    putValue (eNMHControllerNodeAwake, 0);

    NMH_T2 = NMH_T2_val;
    setTimer (NMH_T2_mstimer, NMH_T2);
}
/*@@end*/

/*@@timer:NMH_T2_mstimer:*/
on timer NMH_T2_mstimer
{
    putValue (eNMHMode, 1);
    putValue (eNMHControllerNodeAwake, 1);

    NMH_T1 = NMH_T1_val;
    setTimer (NMH_T1_mstimer, NMH_T1);
}
/*@@end*/

/*@@timer:NMH_dT_mstimer:*/
on timer NMH_dT_mstimer
{
    putValue (eNMHMode, 1);
    putValue (eNMHControllerNodeAwake, 1);

    NMH_T1 = NMH_T1_val;
    setTimer (NMH_T1_mstimer, NMH_T1);
}
/*@@end*/

