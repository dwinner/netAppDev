/*@!Encoding:1252*/
/**
 * Project: BMZ BMS - 5191
 * \file    GoToBolo.can
 * \author  Johannes Raab
 * \brief   Go to Bootloader via KWP services
 *
 * copyright (c) 2015 Preh GmbH all rights reserved.
 */

/* ----------------------------------------------------------------------------
 Affected documents:
 -------------------
 If appropriate further applicable documents incl. their version's information
 should be referenced. Especially a reference to corresponding specifications
 shall be given.

 Information for the configuration management-system:
 ----------------------------------------------------
 Repository path and filename:
 $Archive: BMZ_BMS/06_Software/10_Common/04_CAN/CANoe/GoToBolo.can$
 Workfile:                      
 $Workfile: GoToBolo.can$
 Branch:                        
 $Branch: BMZ_BMS$

 Documentation of modifications:
 -------------------------------
 (it will generated automatically during Check-In into the configuration management tool)
 $Revision: 2$

 
 $Log$
 RaabJ - Wednesday, June 24, 2015 16:11:06
 -fileheader


 */
includes
{
  
}

variables
{
  message DiagRequest_LiIoBMS mDiagPassiveMode;
  message DiagRequest_LiIoBMS mDiagGoToFlasher;
 
  msTimer msTDelay;
}

on start {
  mDiagPassiveMode.DLC = 8;
  mDiagGoToFlasher.DLC = 8;
  
  mDiagPassiveMode.byte(0) = 0x3;
  mDiagPassiveMode.byte(1) = 0x31;
  mDiagPassiveMode.byte(2) = 0x4;
  mDiagPassiveMode.byte(3) = 0;
  mDiagPassiveMode.byte(4) = 0;
  mDiagPassiveMode.byte(5) = 0;
  mDiagPassiveMode.byte(6) = 0;
  mDiagPassiveMode.byte(7) = 0;
  
  mDiagGoToFlasher.byte(0) = 0x3;
  mDiagGoToFlasher.byte(1) = 0x31;
  mDiagGoToFlasher.byte(2) = 0x1;
  mDiagGoToFlasher.byte(3) = 0;
  mDiagGoToFlasher.byte(4) = 0;
  mDiagGoToFlasher.byte(5) = 0;
  mDiagGoToFlasher.byte(6) = 0;
  mDiagGoToFlasher.byte(7) = 0;
}

on envVar (GoToBolo) {
  if (getValue(GoToBolo) == 1) {
    output(mDiagPassiveMode);
    setTimer(msTDelay, 300);
  }
}

on Timer msTDelay {
  output(mDiagGoToFlasher);
}