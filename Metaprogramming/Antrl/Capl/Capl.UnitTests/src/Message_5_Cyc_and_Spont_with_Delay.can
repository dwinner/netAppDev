XXX = message-name
xxy = signal-name




    // Botschaft XXX ID: ZZZ ---- Sendeart 5 cyclicAndSpontanWithDelay ---
    message XXX _mXXX;
    int _XXX_CycleCount;
    int _XXX_StartDelay;
    int _XXX_MinDelay;
    int _XXX_Cnt;
    int _XXX_SpontanFlag;
    int _XXX_DelayCnt;
    msTimer _tXXX;





/*@@caplFunc:XXX_check_output():*/
XXX_check_output()
{
    if( !getValue( HMI__STMSG_XXX ) )
    {
        // Botschaft XXX ID: ZZZ --- Sendeart 5 cyclicAndSpontanWithDelay --- 
        if( _XXX_DelayCnt > 0) _XXX_DelayCnt--; // Mindestsendeabstand
        _XXX_Cnt--;
        if( _XXX_Cnt < 1 )
        {
            if( _XXX_DelayCnt < 1 )
            {
                // Nachricht wg. abgelaufenem Zyklus ausgeben (Mindestsendeabstand eingehalten)
                XXX_output();
                _XXX_SpontanFlag = 0; // Spontan-Flag zurücksetzen
                _XXX_DelayCnt = _XXX_MinDelay;
            }
            else
            {
                // Spontanflag setzen damit nach Ablauf Mindestsendeabstand gesendet wird
                 _XXX_SpontanFlag = 1;
            }
            _XXX_Cnt = _XXX_CycleCount; // Zyklus-Zähler zurücksetzen
        }
        else if( _XXX_SpontanFlag)
        {
            if( _XXX_DelayCnt < 1 )
            {
                // Nachricht wg. spontaner Änderung ausgeben (Mindestsendeabstand eingehalten)
                XXX_output();
                _XXX_SpontanFlag = 0; // Spontan-Flag zurücksetzen
                _XXX_DelayCnt = _XXX_MinDelay;
            }
        }
    }
}
/*@@end*/

/*@@caplFunc:XXX_init():*/
XXX_init()
{   /* Botschaft XXX ID: ZZZ --- Sendeart 5 cyclicAndSpontanWithDelay --- 
BA_ "ApplMessage" BO_ ZZZ 0;
BA_ "NmAsrMessage" BO_ ZZZ 0;
BA_ "GenMsgMinAcceptLength" BO_ ZZZ 8;
BA_ "GenMsgILSupport" BO_ ZZZ 1;
BA_ "DiagState" BO_ ZZZ 0;
BA_ "DiagRequest" BO_ ZZZ 0;
BA_ "DiagResponse" BO_ ZZZ 0;
BA_ "GenMsgStartValue" BO_ ZZZ "0";
BA_ "GenMsgStartDelayTime"  BO_ ZZZ 260;
BA_ "GenMsgDelayTime" BO_ ZZZ 200;
BA_ "GenMsgNrOfRepetitions" BO_ ZZZ 0;
BA_ "GenMsgCycleTime" BO_ ZZZ 1000;
BA_ "GenMsgSendType" BO_ ZZZ 5;
    */
    _XXX_Timebase =      c_tDBKomTimer_20ms;
    _XXX_CycleCount =   1000 / _XXX_Timebase;
    _XXX_StartDelay =      0 / _XXX_Timebase;
    _XXX_MinDelay =      200 / _XXX_Timebase;
    _XXX_Cnt = _XXX_StartDelay;
    _XXX_SpontanFlag = 0;
    _XXX_DelayCnt = 0;

    putValue( HMI__STMSGSD_XXX, _XXX_StartDelay * _XXX_Timebase );

    _mXXX.xxy.phys = getValue( HMI_xxy );
}
/*@@end*/

/*@@caplFunc:XXX_output():*/
XXX_output(void)
{
    output( _mXXX );
}
/*@@end*/

/*@@caplFunc:XXX_saveEnvVars(dword):*/
XXX_saveEnvVars( dword hFile )
{
    filePutString("\n// Knoten EIS: XXX\n", 27, hFile );
    snprintf( buffer, elcount( buffer ), "0.0000 HMI__STMSG_XXX := %X\n", getValue( HMI__STMSG_XXX ) );        filePutString ( buffer, elcount( buffer ), hFile );
    snprintf( buffer, elcount( buffer ), "0.0000 HMI__STMSGT_XXX := %X\n", getValue( HMI__STMSGT_XXX ) );        filePutString ( buffer, elcount( buffer ), hFile );
    snprintf( buffer, elcount( buffer ), "0.0000 HMI_xxy := %X\n", getValue( HMI_xxy ) );        filePutString ( buffer, elcount( buffer ), hFile );
}
/*@@end*/

/*@@timer:_tXXX:*/
on timer _tXXX
{
    putValue( HMI__STMSG_XXX, 0 );
}
/*@@end*/

/*@@envVar:HMI__STMSG_XXX:*/
on EnvVar HMI__STMSG_XXX
{
    long tDelay;
    if( getValue( this ) == 2 )
    {
        tDelay = getValue( HMI__STMSGT_XXX );
        if( tDelay > 0)    
            setTimer( _tXXX, tDelay );
        else
            putValue( HMI__STMSG_XXX, 0 );
    }
}
/*@@end*/

/*@@envVar:HMI_xxy:*/
on EnvVar HMI_xxy
{
    _mXXX.xxy.phys = getValue(this);
    _XXX_SpontanFlag = 1;
}
/*@@end*/

