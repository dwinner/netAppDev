/*@@var:*/
/***************************************************************************
*=====================      Copyright by Continental AG      ===============
****************************************************************************
* Title            : HudStressByConsumption.can
*
* Description  : Test 04.09 (T_47)
*                Generates HUD display changes by fuel consumption changes.
*
* Responsible  : Christian Spahn <Christian.Spahn-EXT@continental-corporation.com>
*
* Revision List: (Will NOT be filled by XStudio)
*
* Archive: Rev. 3 ChrSpa: Added version information
*          Rev. 2 ChrSpa: Solved init problem
*          Rev. 1 ChrSpa: Inital checkin
*
****************************************************************************/

variables
{
   const word u16TimeWidth = 100;
   float fStepWidth = 0.2;
   msTimer tmrSweep;
}
/*@@end*/

/*@@startStart:Start:*/
on start {
   putValue(HMI_TC_FuelType_TC_DISP_RQ_Liquid, 1);
   putValue(Env_BS_Raddrehzahlen, 50);
   putValue(Env_EngRPM, 1000);
   setTimer(tmrSweep, u16TimeWidth);
}
/*@@end*/

/*@@timer:tmrSweep:*/
on timer tmrSweep {
   float fValue;
   fValue = getValue(HMI_TC_LiquidFuelCons) + fStepWidth;
   if (fValue > 20) {
      fStepWidth = -fStepWidth;
      fValue = (getValue(HMI_TC_LiquidFuelCons) > 20) ? 20 : getValue(HMI_TC_LiquidFuelCons) + fStepWidth;
   } else if (fValue < 0) {
      fStepWidth = -fStepWidth;
      fValue = getValue(HMI_TC_LiquidFuelCons) + fStepWidth;
   }
   putValue(HMI_TC_LiquidFuelCons, fValue);
   setTimer(tmrSweep, u16TimeWidth);
}
/*@@end*/

