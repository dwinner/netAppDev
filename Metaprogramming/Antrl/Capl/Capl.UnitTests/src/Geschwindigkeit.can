/*@!Encoding:1252*/
variables
{
  byte    region;
  byte    reifenumfang_req_flag;
  int     max_Reifenumfang;
  float   speed;
  message ISO_Kombi_Req mISO_Kombi_Req;
  
  msTimer Odometry_Notification_speeds_Send_reset;
}

on start
{
  @EnvKBI_V_Digital_soll = 0;
  max_Reifenumfang       = 2278;
  @Env_max_Reifenumfang  = max_Reifenumfang;
}

/*on envVar EnvKBI_V_Digital_soll
{
  speed = @this; 
  
  // Kombi aktiv
  if (@IL_CAN1::EnableNode::Kombi == 1)
  {
    if (reifenumfang_req_flag == 0) 
    {
      mISO_Kombi_Req.byte(0)=0x03;
      mISO_Kombi_Req.byte(1)=0x22;
      mISO_Kombi_Req.byte(2)=0x22;
      mISO_Kombi_Req.byte(3)=0x9D;
      mISO_Kombi_Req.byte(4)=0x55;
      mISO_Kombi_Req.byte(5)=0x55;
      mISO_Kombi_Req.byte(6)=0x55;
      mISO_Kombi_Req.byte(7)=0x55;
      output(mISO_Kombi_Req);
    }

    else
    {
      if (max_Reifenumfang!=0)
        calculate_speed();
      else
        write("Error, codierter Reifenumfang = 0");
    }
  }
  
  
  //if (@ServiceDiscovery_Offer_Service_Odometry == 1 && @Odometry_SubscribeStatus_speeds == 1)
  //{
    @Odometry_Notification_speeds_value = @this;
    @Odometry_Notification_speeds_Send = 1;
    settimer (Odometry_Notification_speeds_Send_reset, 5);
  //}
  //else
  //  writelineex (0,3,"Ethernet Service Odometry and/or Eventgroup speeds not available/activated"); 
}

on message ISO_Kombi_Resp
{
  if (reifenumfang_req_flag == 0 && this.byte(1) == 0x62 && this.byte(2) == 0x22 && this.byte(3) == 0x9D)
  {
    max_Reifenumfang = this.byte(6) * 256 + this.byte(7);
    @Env_max_Reifenumfang = max_Reifenumfang;
    //writelineex(4,0,"max_Reifenumfang: %d",max_Reifenumfang);
    reifenumfang_req_flag = 1;
    
    if (max_Reifenumfang!=0)
      calculate_speed();
    else
    {
      //max_Reifenumfang = this.byte(4) * 256 + this.byte(5);
      //@Env_max_Reifenumfang = max_Reifenumfang;
      //write("Error, codierter Reifenumfang = 0, stattdessen wird der minimale Reifenumfang %d verwendet",@Env_max_Reifenumfang);
      //calculate_speed();
      write("Error, codierter Reifenumfang = 0");
    }
  }
}*/

on envVar EnvKBI_V_Digital_soll
{
  speed = @this; 
  
  // Kombi aktiv
  if (@IL_CAN1::EnableNode::Kombi == 1)
    calculate_speed();
  
  @Odometry_Notification_speeds_value = @this;
  @Odometry_Notification_speeds_Send = 1;
  settimer (Odometry_Notification_speeds_Send_reset, 5);
}

calculate_speed()
{
  $ESP_m_Raddrehz = (speed / (max_Reifenumfang * (3.60000 / 1000.000000)));
}

on Timer Odometry_Notification_speeds_Send_reset
{
  @Odometry_Notification_speeds_Send = 0;
}


on envVar Env_max_Reifenumfang
{
  max_Reifenumfang = @this;
}