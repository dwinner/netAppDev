/*@!Encoding:1252*/
includes
{
  #include "../../_DLL/latest_BAP_DLL.cin"
}

variables
{

	//@BAPSIMGEN_VAR_SECTION_BEGIN

	/***************************************************/
	/*            BapSimGen ASG template               */
	/***************************************************/

	/************** Ausgabe Konsolen (Traces) ***********/
	dword gBAP_Trace;
	dword gError_Trace;

	/************** Node Verwaltung ***************/
	//Power on/off
	byte gSG_PowerOnOff=0x01;     // wird mit Power_off/on gesetzt
	byte gBAP_Init=0;             // schon mal initialisiert?

	const Power_off = 0x00;
	const Power_on	= 0x01;

	mstimer TaskTimer;				//real communication timer

	/************** Request **************/
	const Requestbuffer_lines = 100;
	const BAP_buffer_size = 4096;

	/************ Speichern von Requests im "Ringbuffer" ***********/
	int   gBAP_Requestbuffer_status     [Requestbuffer_lines];		            // 0: kein Eintrag, 1:pending
	dword gBAP_Request_header			[Requestbuffer_lines] [6];				// beinhaltet auch skalare Daten
	dword gBAP_Request_data             [Requestbuffer_lines] [BAP_buffer_size];// ringbuffer Eintrag fuer BAP-Request


	/************** Indication **************/
	// enthaelt die derzeitige Indication
	dword gBAP_Indication_header[6];	
	byte  gBAP_Indication_data[BAP_buffer_size];		

	/************** Konstanten ****************/

	//BAP Data Type 
	const Bap_void				=0;
	const Bap_uint8				=1;
	const Bap_uint16			=2;
	const Bap_uint32			=3;
	const Bap_byteSequence		=4;
	const Bap_error				=5;
	const Bap_acknowledge		=6;

	char Datatype_Text[7][20] =
	{
		"void", "uint8", "uint16", "uint32", "byteSequence", "error", "acknowledge"
	};

	//BAP request types
	const DataSetGet_REQ  = 0x00;
	const DataSet_REQ	  = 0x01;
	const DataGet_REQ	  = 0x02;
	const Data_REQ		  = 0x03;
	const Changed_REQ	  = 0x04;
	const Start_REQ		  = 0x05;
	const StartResult_REQ = 0x06;
	const AbortResult_REQ = 0x07;
	const Processing_REQ  = 0x08;
	const Result_REQ      = 0x09;
	const DataAck_REQ     = 0x0A;
	const Ack_REQ         = 0x0B;
	const Invalid_REQ     = 0x1F;      // Interne Kennzeichnung fuer einen ungueltigen Request

	//eigene Error-Definition
	const Error_REQ=0x20;

	char Requesttype_Text[33][30] =
	{
		"DataSetGet_REQ", "DataSet_REQ", "DataGet_REQ", "Data_REQ",			/* 00 .. 03 */
		"Changed_REQ", "Start_REQ", "StartResult_REQ", "AbortResult_REQ",   /* 04 .. 07 */
		"Processing_REQ", "Result_REQ", "DataAck_REQ", "Ack_REQ", 			/* 08 .. 0b */
		"Invalid_REQ", "Invalid_REQ", "Invalid_REQ", "Invalid_REQ",  		/* 0c .. 0f */
		"Invalid_REQ", "Invalid_REQ", "Invalid_REQ", "Invalid_REQ",  		/* 10 .. 13 */
		"Invalid_REQ", "Invalid_REQ", "Invalid_REQ", "Invalid_REQ",  		/* 14 .. 17 */
		"Invalid_REQ", "Invalid_REQ", "Invalid_REQ", "Invalid_REQ", 		/* 18 .. 1b */
		"Invalid_REQ", "Invalid_REQ", "Invalid_REQ", "Invalid_REQ",  		/* 1c .. 1f */
		"Error_REQ"	  														/* 20 */
	};

	//BAP indication types
	const Data_IND			 = 0x00;
	const Reset_IND			 = 0x01;
	const DataAck_IND        = 0x02;
	const Result_IND		 = 0x03;
	const Processing_IND	 = 0x04;
  	const Changed_IND		 = 0x05;
  	const DataSetGet_IND	 = 0x06;
	const DataSet_IND		 = 0x07;
	const DataGet_IND		 = 0x08;
	const Ack_IND            = 0x09;
	const Processing_CNF_IND = 0x0A;
	const Start_IND			 = 0x0B;
	const StartResult_IND	 = 0x0C;
	const AbortResult_IND	 = 0x0D;
	const Invalid_IND		 = 0x1F; // Kennzeichnung fuer eine ungueltige Indication
	const Error_IND			 = 0x20;
	
	char Indicationtype_Text[33][30] =
	{
		"Data_IND", "Reset_IND", "DataAck_IND", "Result_IND",			 	/* 00 .. 03 */
		"Processing_IND", "Changed_IND", "DataSetGet_IND", "DataSet_IND", 	/* 04 .. 07 */
		"DataGet_IND", "Ack_IND", "Processing_CNF_IND", "Start_REQ",	 	/* 08 .. 0b */
		"StartResult_REQ", "AbortResult_REQ", "Invalid_REQ", "Invalid_REQ", /* 0c .. 0f */
		"Invalid_REQ", "Invalid_REQ", "Invalid_REQ", "Invalid_REQ",  		/* 10 .. 13 */
		"Invalid_REQ", "Invalid_REQ", "Invalid_REQ", "Invalid_REQ",  		/* 14 .. 17 */
		"Invalid_REQ", "Invalid_REQ", "Invalid_REQ", "Invalid_REQ", 		/* 18 .. 1b */
		"Invalid_REQ", "Invalid_REQ", "Invalid_REQ", "Invalid_REQ",  		/* 1c .. 1f */
		"Error_REQ"	  														/* 20 */
	};	
	
	char Acknowledgetype_Text[24][30] =
	{
		"Property_SetGet_ACK", "Array_SetGet_ACK", "Property_Set_ACK", "Array_Set_ACK",  			/* 00 .. 03 */
		"Method_Start_ACK", "Method_StartResult_ACK", "Method_AbortResult_ACK", "Property_Get_ACK",	/* 04 .. 07 */
		"Array_Get_ACK", "Cache_GetAll_ACK", "Property_Ack_ACK", "Property_Status_ACK",	   			/* 08 .. 0b */
		"Property_StatusAck_ACK", "Property_Error_ACK", "Array_Status_ACK", "Array_Changed_ACK",	/* 0c .. 0f */
		"Array_Error_ACK", "Method_Processing_ACK", "Method_Result_ACK", "Method_Error_ACK",  		/* 10 .. 13 */
		"Unknown_ACK", "Unknown_ACK", "Unknown_ACK", "Unknown_ACK"									/* 14 .. 17 */
	};

	/**************************** Global Function-ID's ******************************/
	/** TODO: already_pressed kann zwischen den Funktionen geshared werden          */

	byte already_pressed = 0;

	const FctID_GetAll									= 0x01;
	const FctID_BAP_Config								= 0x02;
	const FctID_FunctionList							= 0x03;
	const FctID_HeartBeat								= 0x04;
    
    char SGtype[4]="ASG";

	char  dbcan_path[255]           = "BAP\\ASG69_DisplayConfig_35\\bapdb\\BAP_only_MQB_MLBevo_v1.60.dbc";
	char  xml_path[255]             = "BAP\\ASG69_DisplayConfig_35\\bapxml\\BAP_SW17_DisplayConfig_MLBevo_P30DF35_ASG_ZR_V1.50.xml";
	dword NODE_INDEX                =  0;
	char  NODE_NAME[100]            = "DisplayConfig";
	const LSGID                     = 69;
	char  panel_name[100]           = "ASG69_0";
	char  bapconfig_panel_name[100]    = "panel1";
	char  common_panel_name[100]    = "panel2";
	const TaskTime                  = 10;
	const heartBeatFactor                               = 5;
	 const C_ASG_69_0_0_1_ID = 1;
	 byte C_ASG_69_0_0_1GetAll_BTN_already_pressed = 0;
	 char gCheckbox1[100] = "checkbox_C_ASG_69_0_0_1";
	 char gErrField1[100] = "errfield_C_ASG_69_0_0_1";
	 byte gC_ASG_69_0_0_1_ErrCode = 1;
	 const P_ASG_69_0_0_2_ID = 2;
	 byte P_ASG_69_0_0_2Get_BTN_already_pressed = 0;
	 char gCheckbox2[100] = "checkbox_P_ASG_69_0_0_2";
	 char gErrField2[100] = "errfield_P_ASG_69_0_0_2";
	 byte gP_ASG_69_0_0_2_ErrCode = 1;
	 const P_ASG_69_0_0_3_ID = 3;
	 byte P_ASG_69_0_0_3Get_BTN_already_pressed = 0;
	 char gCheckbox3[100] = "checkbox_P_ASG_69_0_0_3";
	 char gErrField3[100] = "errfield_P_ASG_69_0_0_3";
	 byte gP_ASG_69_0_0_3_ErrCode = 1;
	 const P_ASG_69_0_0_4_ID = 4;
	 byte P_ASG_69_0_0_4Get_BTN_already_pressed = 0;
	 char gCheckbox4[100] = "checkbox_P_ASG_69_0_0_4";
	 char gErrField4[100] = "errfield_P_ASG_69_0_0_4";
	 byte gP_ASG_69_0_0_4_ErrCode = 1;
	 const P_ASG_69_0_0_13_ID = 13;
	 byte P_ASG_69_0_0_13Get_BTN_already_pressed = 0;
	 byte P_ASG_69_0_0_13SetGet_BTN_already_pressed = 0;
	 char gCheckbox13[100] = "checkbox_P_ASG_69_0_0_13";
	 char gErrField13[100] = "errfield_P_ASG_69_0_0_13";
	 byte gP_ASG_69_0_0_13_ErrCode = 1;
	 char gPanel13[100] = "panel_P_ASG_69_0_0_13";
	 const P_ASG_69_0_0_14_ID = 14;
	 byte P_ASG_69_0_0_14Get_BTN_already_pressed = 0;
	 char gCheckbox14[100] = "checkbox_P_ASG_69_0_0_14";
	 char gErrField14[100] = "errfield_P_ASG_69_0_0_14";
	 byte gP_ASG_69_0_0_14_ErrCode = 1;
	 char gPanel14[100] = "panel_P_ASG_69_0_0_14";
	 const P_ASG_69_0_0_15_ID = 15;
	 byte P_ASG_69_0_0_15Get_BTN_already_pressed = 0;
	 char gCheckbox15[100] = "checkbox_P_ASG_69_0_0_15";
	 char gErrField15[100] = "errfield_P_ASG_69_0_0_15";
	 byte gP_ASG_69_0_0_15_ErrCode = 1;
	 char gPanel15[100] = "panel_P_ASG_69_0_0_15";
	 const P_ASG_69_0_0_16_ID = 16;
	 byte P_ASG_69_0_0_16Get_BTN_already_pressed = 0;
	 byte P_ASG_69_0_0_16SetGet_BTN_already_pressed = 0;
	 char gCheckbox16[100] = "checkbox_P_ASG_69_0_0_16";
	 char gErrField16[100] = "errfield_P_ASG_69_0_0_16";
	 byte gP_ASG_69_0_0_16_ErrCode = 1;
	 char gPanel16[100] = "panel_P_ASG_69_0_0_16";
	 const P_ASG_69_0_0_17_ID = 17;
	 byte P_ASG_69_0_0_17Get_BTN_already_pressed = 0;
	 byte P_ASG_69_0_0_17SetGet_BTN_already_pressed = 0;
	 char gCheckbox17[100] = "checkbox_P_ASG_69_0_0_17";
	 char gErrField17[100] = "errfield_P_ASG_69_0_0_17";
	 byte gP_ASG_69_0_0_17_ErrCode = 1;
	 char gPanel17[100] = "panel_P_ASG_69_0_0_17";
	 const A_ASG_69_0_0_18_ID = 18;
	 byte A_ASG_69_0_0_18Get_BTN_already_pressed = 0;
	 byte A_ASG_69_0_0_18SetGet_BTN_already_pressed = 0;
	 char gCheckbox18[100] = "checkbox_A_ASG_69_0_0_18";
	 char gErrField18[100] = "errfield_A_ASG_69_0_0_18";
	 byte gA_ASG_69_0_0_18_ErrCode = 1;
	 char gPanel18[100] = "panel_A_ASG_69_0_0_18";
	 byte A_ASG_69_0_0_18_DataIndex_Decr_already_pressed = 0;
	 byte A_ASG_69_0_0_18_DataIndex_Incr_already_pressed = 0;
	 byte A_ASG_69_0_0_18_DataIndex_SetGet_Decr_already_pressed = 0;
	 byte A_ASG_69_0_0_18_DataIndex_SetGet_Incr_already_pressed = 0;
	 byte A_ASG_69_0_0_18_generateData_Btn_already_pressed = 0;
	 byte A_ASG_69_0_0_18_loadArray_Btn_already_pressed = 0;
	 _align(1) struct A_ASG_69_0_0_18_ArrayDataStruct {
		 byte Param1;
		 byte Param2;
		 byte Param3;
		 byte Param4;
		 byte Param5;
		 byte Param6[2];
		 word Param6_Length;
	 };
	 struct A_ASG_69_0_0_18_ArrayDataStruct A_ASG_69_0_0_18_ArrayDataList[255];
	 const A_ASG_69_0_0_18_ArrayDataList_Length = 255;
	 long A_ASG_69_0_0_18_Data_6_LenList[255];
	 byte A_ASG_69_0_0_18_Data_6_CntList[255];
	 long A_ASG_69_0_0_18_Data_6_SetGet_LenList[255];
	 byte A_ASG_69_0_0_18_Data_6_SetGet_CntList[255];
	 const P_ASG_69_0_0_19_ID = 19;
	 byte P_ASG_69_0_0_19Get_BTN_already_pressed = 0;
	 char gCheckbox19[100] = "checkbox_P_ASG_69_0_0_19";
	 char gErrField19[100] = "errfield_P_ASG_69_0_0_19";
	 byte gP_ASG_69_0_0_19_ErrCode = 1;
	 char gPanel19[100] = "panel_P_ASG_69_0_0_19";
	 const P_ASG_69_0_0_20_ID = 20;
	 byte P_ASG_69_0_0_20Get_BTN_already_pressed = 0;
	 byte P_ASG_69_0_0_20SetGet_BTN_already_pressed = 0;
	 char gCheckbox20[100] = "checkbox_P_ASG_69_0_0_20";
	 char gErrField20[100] = "errfield_P_ASG_69_0_0_20";
	 byte gP_ASG_69_0_0_20_ErrCode = 1;
	 char gPanel20[100] = "panel_P_ASG_69_0_0_20";
	 const P_ASG_69_0_0_21_ID = 21;
	 byte P_ASG_69_0_0_21Get_BTN_already_pressed = 0;
	 char gCheckbox21[100] = "checkbox_P_ASG_69_0_0_21";
	 char gErrField21[100] = "errfield_P_ASG_69_0_0_21";
	 byte gP_ASG_69_0_0_21_ErrCode = 1;
	 char gPanel21[100] = "panel_P_ASG_69_0_0_21";
	 const P_ASG_69_0_0_22_ID = 22;
	 byte P_ASG_69_0_0_22Get_BTN_already_pressed = 0;
	 byte P_ASG_69_0_0_22SetGet_BTN_already_pressed = 0;
	 char gCheckbox22[100] = "checkbox_P_ASG_69_0_0_22";
	 char gErrField22[100] = "errfield_P_ASG_69_0_0_22";
	 byte gP_ASG_69_0_0_22_ErrCode = 1;
	 char gPanel22[100] = "panel_P_ASG_69_0_0_22";
	 const P_ASG_69_0_0_23_ID = 23;
	 byte P_ASG_69_0_0_23Get_BTN_already_pressed = 0;
	 char gCheckbox23[100] = "checkbox_P_ASG_69_0_0_23";
	 char gErrField23[100] = "errfield_P_ASG_69_0_0_23";
	 byte gP_ASG_69_0_0_23_ErrCode = 1;
	 char gPanel23[100] = "panel_P_ASG_69_0_0_23";
	 const P_ASG_69_0_0_24_ID = 24;
	 byte P_ASG_69_0_0_24Get_BTN_already_pressed = 0;
	 byte P_ASG_69_0_0_24SetGet_BTN_already_pressed = 0;
	 char gCheckbox24[100] = "checkbox_P_ASG_69_0_0_24";
	 char gErrField24[100] = "errfield_P_ASG_69_0_0_24";
	 byte gP_ASG_69_0_0_24_ErrCode = 1;
	 char gPanel24[100] = "panel_P_ASG_69_0_0_24";
	 const P_ASG_69_0_0_25_ID = 25;
	 byte P_ASG_69_0_0_25Get_BTN_already_pressed = 0;
	 byte P_ASG_69_0_0_25SetGet_BTN_already_pressed = 0;
	 char gCheckbox25[100] = "checkbox_P_ASG_69_0_0_25";
	 char gErrField25[100] = "errfield_P_ASG_69_0_0_25";
	 byte gP_ASG_69_0_0_25_ErrCode = 1;
	 char gPanel25[100] = "panel_P_ASG_69_0_0_25";
	 const P_ASG_69_0_0_26_ID = 26;
	 byte P_ASG_69_0_0_26Get_BTN_already_pressed = 0;
	 byte P_ASG_69_0_0_26SetGet_BTN_already_pressed = 0;
	 char gCheckbox26[100] = "checkbox_P_ASG_69_0_0_26";
	 char gErrField26[100] = "errfield_P_ASG_69_0_0_26";
	 byte gP_ASG_69_0_0_26_ErrCode = 1;
	 char gPanel26[100] = "panel_P_ASG_69_0_0_26";
	 const A_ASG_69_0_0_27_ID = 27;
	 byte A_ASG_69_0_0_27Get_BTN_already_pressed = 0;
	 byte A_ASG_69_0_0_27SetGet_BTN_already_pressed = 0;
	 char gCheckbox27[100] = "checkbox_A_ASG_69_0_0_27";
	 char gErrField27[100] = "errfield_A_ASG_69_0_0_27";
	 byte gA_ASG_69_0_0_27_ErrCode = 1;
	 char gPanel27[100] = "panel_A_ASG_69_0_0_27";
	 byte A_ASG_69_0_0_27_DataIndex_Decr_already_pressed = 0;
	 byte A_ASG_69_0_0_27_DataIndex_Incr_already_pressed = 0;
	 byte A_ASG_69_0_0_27_DataIndex_SetGet_Decr_already_pressed = 0;
	 byte A_ASG_69_0_0_27_DataIndex_SetGet_Incr_already_pressed = 0;
	 byte A_ASG_69_0_0_27_generateData_Btn_already_pressed = 0;
	 byte A_ASG_69_0_0_27_loadArray_Btn_already_pressed = 0;
	 _align(1) struct A_ASG_69_0_0_27_ArrayDataStruct {
		 byte Param1;
		 byte Param2;
		 byte Param3;
		 byte Param4;
		 dword Param5;
		 dword Param6;
		 dword Param7;
		 dword Param8;
		 dword Param9;
		 dword Param10;
		 dword Param11;
		 dword Param12;
		 dword Param13;
		 dword Param14;
		 dword Param15;
		 dword Param16;
		 dword Param17;
		 dword Param18;
		 dword Param19;
		 byte Param20[2];
		 word Param20_Length;
	 };
	 struct A_ASG_69_0_0_27_ArrayDataStruct A_ASG_69_0_0_27_ArrayDataList[254];
	 const A_ASG_69_0_0_27_ArrayDataList_Length = 254;
	 long A_ASG_69_0_0_27_Data_20_LenList[254];
	 byte A_ASG_69_0_0_27_Data_20_CntList[254];
	 long A_ASG_69_0_0_27_Data_20_SetGet_LenList[254];
	 byte A_ASG_69_0_0_27_Data_20_SetGet_CntList[254];
	 const P_ASG_69_0_0_28_ID = 28;
	 byte P_ASG_69_0_0_28Get_BTN_already_pressed = 0;
	 byte P_ASG_69_0_0_28SetGet_BTN_already_pressed = 0;
	 char gCheckbox28[100] = "checkbox_P_ASG_69_0_0_28";
	 char gErrField28[100] = "errfield_P_ASG_69_0_0_28";
	 byte gP_ASG_69_0_0_28_ErrCode = 1;
	 char gPanel28[100] = "panel_P_ASG_69_0_0_28";
	 const P_ASG_69_0_0_29_ID = 29;
	 byte P_ASG_69_0_0_29Get_BTN_already_pressed = 0;
	 byte P_ASG_69_0_0_29SetGet_BTN_already_pressed = 0;
	 char gCheckbox29[100] = "checkbox_P_ASG_69_0_0_29";
	 char gErrField29[100] = "errfield_P_ASG_69_0_0_29";
	 byte gP_ASG_69_0_0_29_ErrCode = 1;
	 char gPanel29[100] = "panel_P_ASG_69_0_0_29";
	 const P_ASG_69_0_0_30_ID = 30;
	 byte P_ASG_69_0_0_30Get_BTN_already_pressed = 0;
	 byte P_ASG_69_0_0_30SetGet_BTN_already_pressed = 0;
	 char gCheckbox30[100] = "checkbox_P_ASG_69_0_0_30";
	 char gErrField30[100] = "errfield_P_ASG_69_0_0_30";
	 byte gP_ASG_69_0_0_30_ErrCode = 1;
	 char gPanel30[100] = "panel_P_ASG_69_0_0_30";
	 const P_ASG_69_0_0_31_ID = 31;
	 byte P_ASG_69_0_0_31Get_BTN_already_pressed = 0;
	 byte P_ASG_69_0_0_31SetGet_BTN_already_pressed = 0;
	 char gCheckbox31[100] = "checkbox_P_ASG_69_0_0_31";
	 char gErrField31[100] = "errfield_P_ASG_69_0_0_31";
	 byte gP_ASG_69_0_0_31_ErrCode = 1;
	 char gPanel31[100] = "panel_P_ASG_69_0_0_31";
	 const P_ASG_69_0_0_32_ID = 32;
	 byte P_ASG_69_0_0_32Get_BTN_already_pressed = 0;
	 byte P_ASG_69_0_0_32SetGet_BTN_already_pressed = 0;
	 char gCheckbox32[100] = "checkbox_P_ASG_69_0_0_32";
	 char gErrField32[100] = "errfield_P_ASG_69_0_0_32";
	 byte gP_ASG_69_0_0_32_ErrCode = 1;
	 char gPanel32[100] = "panel_P_ASG_69_0_0_32";
	 const P_ASG_69_0_0_33_ID = 33;
	 byte P_ASG_69_0_0_33Get_BTN_already_pressed = 0;
	 byte P_ASG_69_0_0_33SetGet_BTN_already_pressed = 0;
	 char gCheckbox33[100] = "checkbox_P_ASG_69_0_0_33";
	 char gErrField33[100] = "errfield_P_ASG_69_0_0_33";
	 byte gP_ASG_69_0_0_33_ErrCode = 1;
	 char gPanel33[100] = "panel_P_ASG_69_0_0_33";
	 const A_ASG_69_0_0_34_ID = 34;
	 byte A_ASG_69_0_0_34Get_BTN_already_pressed = 0;
	 byte A_ASG_69_0_0_34SetGet_BTN_already_pressed = 0;
	 char gCheckbox34[100] = "checkbox_A_ASG_69_0_0_34";
	 char gErrField34[100] = "errfield_A_ASG_69_0_0_34";
	 byte gA_ASG_69_0_0_34_ErrCode = 1;
	 char gPanel34[100] = "panel_A_ASG_69_0_0_34";
	 byte A_ASG_69_0_0_34_DataIndex_Decr_already_pressed = 0;
	 byte A_ASG_69_0_0_34_DataIndex_Incr_already_pressed = 0;
	 byte A_ASG_69_0_0_34_DataIndex_SetGet_Decr_already_pressed = 0;
	 byte A_ASG_69_0_0_34_DataIndex_SetGet_Incr_already_pressed = 0;
	 byte A_ASG_69_0_0_34_generateData_Btn_already_pressed = 0;
	 byte A_ASG_69_0_0_34_loadArray_Btn_already_pressed = 0;
	 _align(1) struct A_ASG_69_0_0_34_ArrayDataStruct {
		 dword Param1;
		 byte Param2;
		 byte Param3;
		 dword Param4;
		 byte Param5[118];
		 word Param5_Length;
	 };
	 struct A_ASG_69_0_0_34_ArrayDataStruct A_ASG_69_0_0_34_ArrayDataList[10];
	 const A_ASG_69_0_0_34_ArrayDataList_Length = 10;
	 long A_ASG_69_0_0_34_Data_5_LenList[10];
	 byte A_ASG_69_0_0_34_Data_5_CntList[10];
	 long A_ASG_69_0_0_34_Data_5_SetGet_LenList[10];
	 byte A_ASG_69_0_0_34_Data_5_SetGet_CntList[10];


	/// Begin: Definition der BUS-Schnittstellen
	
	// FLEXRAY NOT ENABLED!
	
	// ETHERNET NOT ENABLED! 
	
	//// End Bus Schnittstellen
}

on preStart
{
	char Version[200];
  
	/***** Erzeugen der Ausgabeconsolen *****/	
	gBAP_Trace=writecreate("BAP-Trace");		//write-window for BAP-cummunication
	writeclear(gBAP_Trace);						//clear BAP-window in write-window
	
	gError_Trace=writecreate("Error");			//error-window for BAP-cummunication
	writeclear(gError_Trace);					//clear error-window in write-window
	
	writeclear(1);								//clear CAPL-window in write-window
	
	/**** Versionsstring von DLL holen und auf Bildschirm ausgeben ***/	
	BAP150_GetVersions(Version, 200);
	writelineEx(gBAP_Trace, 0, "Versionx:%s", Version);
											
  NODE_INDEX = BAP150_CreateNode();
  writelineEx(gBAP_Trace, 0, "ASG %d Nodeindex:%d", LSGID, Version);

	// FLEXRAY NOT ENABLED!
	
}

DisableFctCtrl ()
{
  	EnableControl(panel_name, common_panel_name, 0);
	EnableControl(panel_name,gErrField1,0);
	EnableControl(panel_name,gErrField2,0);
	EnableControl(panel_name,gErrField3,0);
	EnableControl(panel_name,gErrField4,0);
	EnableControl(panel_name,gErrField13,0);
	EnableControl(panel_name,gPanel13,0);
	EnableControl(panel_name,"panel_P_ASG_69_0_0_13",0);
	EnableControl(panel_name,gErrField14,0);
	EnableControl(panel_name,gPanel14,0);
	EnableControl(panel_name,"panel_P_ASG_69_0_0_14",0);
	EnableControl(panel_name,gErrField15,0);
	EnableControl(panel_name,gPanel15,0);
	EnableControl(panel_name,"panel_P_ASG_69_0_0_15",0);
	EnableControl(panel_name,gErrField16,0);
	EnableControl(panel_name,gPanel16,0);
	EnableControl(panel_name,"panel_P_ASG_69_0_0_16",0);
	EnableControl(panel_name,gErrField17,0);
	EnableControl(panel_name,gPanel17,0);
	EnableControl(panel_name,"panel_P_ASG_69_0_0_17",0);
	EnableControl(panel_name,gErrField18,0);
	EnableControl(panel_name,gPanel18,0);
	EnableControl(panel_name,"panel_A_ASG_69_0_0_18",0);
	EnableControl(panel_name,"panel_A_ASG_69_0_0_18_Changed",0);
	EnableControl(panel_name,"panel_A_ASG_69_0_0_18_SetGet",0);
	EnableControl(panel_name,gErrField19,0);
	EnableControl(panel_name,gPanel19,0);
	EnableControl(panel_name,"panel_P_ASG_69_0_0_19",0);
	EnableControl(panel_name,gErrField20,0);
	EnableControl(panel_name,gPanel20,0);
	EnableControl(panel_name,"panel_P_ASG_69_0_0_20",0);
	EnableControl(panel_name,gErrField21,0);
	EnableControl(panel_name,gPanel21,0);
	EnableControl(panel_name,"panel_P_ASG_69_0_0_21",0);
	EnableControl(panel_name,gErrField22,0);
	EnableControl(panel_name,gPanel22,0);
	EnableControl(panel_name,"panel_P_ASG_69_0_0_22",0);
	EnableControl(panel_name,gErrField23,0);
	EnableControl(panel_name,gPanel23,0);
	EnableControl(panel_name,"panel_P_ASG_69_0_0_23",0);
	EnableControl(panel_name,gErrField24,0);
	EnableControl(panel_name,gPanel24,0);
	EnableControl(panel_name,"panel_P_ASG_69_0_0_24",0);
	EnableControl(panel_name,gErrField25,0);
	EnableControl(panel_name,gPanel25,0);
	EnableControl(panel_name,"panel_P_ASG_69_0_0_25",0);
	EnableControl(panel_name,gErrField26,0);
	EnableControl(panel_name,gPanel26,0);
	EnableControl(panel_name,"panel_P_ASG_69_0_0_26",0);
	EnableControl(panel_name,gErrField27,0);
	EnableControl(panel_name,gPanel27,0);
	EnableControl(panel_name,"panel_A_ASG_69_0_0_27",0);
	EnableControl(panel_name,"panel_A_ASG_69_0_0_27_Changed",0);
	EnableControl(panel_name,"panel_A_ASG_69_0_0_27_SetGet",0);
	EnableControl(panel_name,gErrField28,0);
	EnableControl(panel_name,gPanel28,0);
	EnableControl(panel_name,"panel_P_ASG_69_0_0_28",0);
	EnableControl(panel_name,gErrField29,0);
	EnableControl(panel_name,gPanel29,0);
	EnableControl(panel_name,"panel_P_ASG_69_0_0_29",0);
	EnableControl(panel_name,gErrField30,0);
	EnableControl(panel_name,gPanel30,0);
	EnableControl(panel_name,"panel_P_ASG_69_0_0_30",0);
	EnableControl(panel_name,gErrField31,0);
	EnableControl(panel_name,gPanel31,0);
	EnableControl(panel_name,"panel_P_ASG_69_0_0_31",0);
	EnableControl(panel_name,gErrField32,0);
	EnableControl(panel_name,gPanel32,0);
	EnableControl(panel_name,"panel_P_ASG_69_0_0_32",0);
	EnableControl(panel_name,gErrField33,0);
	EnableControl(panel_name,gPanel33,0);
	EnableControl(panel_name,"panel_P_ASG_69_0_0_33",0);
	EnableControl(panel_name,gErrField34,0);
	EnableControl(panel_name,gPanel34,0);
	EnableControl(panel_name,"panel_A_ASG_69_0_0_34",0);
	EnableControl(panel_name,"panel_A_ASG_69_0_0_34_Changed",0);
	EnableControl(panel_name,"panel_A_ASG_69_0_0_34_SetGet",0);

}

EnableFctCtrl ()
{
  	EnableControl(panel_name, common_panel_name, 1);
		 EnableControl(panel_name,gPanel13,1);
		 EnableControl(panel_name,gErrField13,1);
		 EnableControl(panel_name,gPanel14,1);
		 EnableControl(panel_name,gErrField14,1);
		 EnableControl(panel_name,gPanel15,1);
		 EnableControl(panel_name,gErrField15,1);
		 EnableControl(panel_name,gPanel16,1);
		 EnableControl(panel_name,gErrField16,1);
		 EnableControl(panel_name,gPanel17,1);
		 EnableControl(panel_name,gErrField17,1);
		 EnableControl(panel_name,gPanel18,1);
		 EnableControl(panel_name,gErrField18,1);
		 EnableControl(panel_name,gPanel19,1);
		 EnableControl(panel_name,gErrField19,1);
		 EnableControl(panel_name,gPanel20,1);
		 EnableControl(panel_name,gErrField20,1);
		 EnableControl(panel_name,gPanel21,1);
		 EnableControl(panel_name,gErrField21,1);
		 EnableControl(panel_name,gPanel22,1);
		 EnableControl(panel_name,gErrField22,1);
		 EnableControl(panel_name,gPanel23,1);
		 EnableControl(panel_name,gErrField23,1);
		 EnableControl(panel_name,gPanel24,1);
		 EnableControl(panel_name,gErrField24,1);
		 EnableControl(panel_name,gPanel25,1);
		 EnableControl(panel_name,gErrField25,1);
		 EnableControl(panel_name,gPanel26,1);
		 EnableControl(panel_name,gErrField26,1);
		 EnableControl(panel_name,gPanel27,1);
		 EnableControl(panel_name,gErrField27,1);
		 EnableControl(panel_name,gPanel28,1);
		 EnableControl(panel_name,gErrField28,1);
		 EnableControl(panel_name,gPanel29,1);
		 EnableControl(panel_name,gErrField29,1);
		 EnableControl(panel_name,gPanel30,1);
		 EnableControl(panel_name,gErrField30,1);
		 EnableControl(panel_name,gPanel31,1);
		 EnableControl(panel_name,gErrField31,1);
		 EnableControl(panel_name,gPanel32,1);
		 EnableControl(panel_name,gErrField32,1);
		 EnableControl(panel_name,gPanel33,1);
		 EnableControl(panel_name,gErrField33,1);
		 EnableControl(panel_name,gPanel34,1);
		 EnableControl(panel_name,gErrField34,1);

}

EnableConfigCtrl ()
{
  	if(getValue(C_ASG_69_0_0_1_FctLstItemEn))
	{
		setControlForeColor(panel_name, gCheckbox1, MakeRGB(0,240,0));
	}
	else
	{
		setControlForeColor(panel_name, gCheckbox1, MakeRGB(250,0,0));
	}
	if(getValue(P_ASG_69_0_0_2_FctLstItemEn))
	{
		setControlForeColor(panel_name, gCheckbox2, MakeRGB(0,240,0));
	}
	else
	{
		setControlForeColor(panel_name, gCheckbox2, MakeRGB(250,0,0));
	}
	if(getValue(P_ASG_69_0_0_3_FctLstItemEn))
	{
		setControlForeColor(panel_name, gCheckbox3, MakeRGB(0,240,0));
	}
	else
	{
		setControlForeColor(panel_name, gCheckbox3, MakeRGB(250,0,0));
	}
	EnableControl(panel_name, "panel_P_ASG_69_0_0_4", 1);
	if(getValue(P_ASG_69_0_0_4_FctLstItemEn))
	{
		setControlForeColor(panel_name, gCheckbox4, MakeRGB(0,240,0));
	}
	else
	{
		setControlForeColor(panel_name, gCheckbox4, MakeRGB(250,0,0));
	}
	if(getValue(P_ASG_69_0_0_13_FctLstItemEn))
	{
		EnableControl(panel_name, "panel_P_ASG_69_0_0_13",1);
		EnableControl(panel_name,"errfield_P_ASG_69_0_0_13",1);
		setControlForeColor(panel_name, gCheckbox13, MakeRGB(0,240,0));
	}
	else
	{
		EnableControl(panel_name, "panel_P_ASG_69_0_0_13",0);
		EnableControl(panel_name,"errfield_P_ASG_69_0_0_13",0);
		setControlForeColor(panel_name, gCheckbox13, MakeRGB(250,0,0));
	}
	if(getValue(P_ASG_69_0_0_14_FctLstItemEn))
	{
		EnableControl(panel_name, "panel_P_ASG_69_0_0_14",1);
		EnableControl(panel_name,"errfield_P_ASG_69_0_0_14",1);
		setControlForeColor(panel_name, gCheckbox14, MakeRGB(0,240,0));
	}
	else
	{
		EnableControl(panel_name, "panel_P_ASG_69_0_0_14",0);
		EnableControl(panel_name,"errfield_P_ASG_69_0_0_14",0);
		setControlForeColor(panel_name, gCheckbox14, MakeRGB(250,0,0));
	}
	if(getValue(P_ASG_69_0_0_15_FctLstItemEn))
	{
		EnableControl(panel_name, "panel_P_ASG_69_0_0_15",1);
		EnableControl(panel_name,"errfield_P_ASG_69_0_0_15",1);
		setControlForeColor(panel_name, gCheckbox15, MakeRGB(0,240,0));
	}
	else
	{
		EnableControl(panel_name, "panel_P_ASG_69_0_0_15",0);
		EnableControl(panel_name,"errfield_P_ASG_69_0_0_15",0);
		setControlForeColor(panel_name, gCheckbox15, MakeRGB(250,0,0));
	}
	if(getValue(P_ASG_69_0_0_16_FctLstItemEn))
	{
		EnableControl(panel_name, "panel_P_ASG_69_0_0_16",1);
		EnableControl(panel_name,"errfield_P_ASG_69_0_0_16",1);
		setControlForeColor(panel_name, gCheckbox16, MakeRGB(0,240,0));
	}
	else
	{
		EnableControl(panel_name, "panel_P_ASG_69_0_0_16",0);
		EnableControl(panel_name,"errfield_P_ASG_69_0_0_16",0);
		setControlForeColor(panel_name, gCheckbox16, MakeRGB(250,0,0));
	}
	if(getValue(P_ASG_69_0_0_17_FctLstItemEn))
	{
		EnableControl(panel_name, "panel_P_ASG_69_0_0_17",1);
		EnableControl(panel_name,"errfield_P_ASG_69_0_0_17",1);
		setControlForeColor(panel_name, gCheckbox17, MakeRGB(0,240,0));
	}
	else
	{
		EnableControl(panel_name, "panel_P_ASG_69_0_0_17",0);
		EnableControl(panel_name,"errfield_P_ASG_69_0_0_17",0);
		setControlForeColor(panel_name, gCheckbox17, MakeRGB(250,0,0));
	}
	if(getValue(A_ASG_69_0_0_18_FctLstItemEn))
	{
		EnableControl(panel_name, "panel_A_ASG_69_0_0_18",1);
		EnableControl(panel_name,"errfield_A_ASG_69_0_0_18",1);
		EnableControl(panel_name,"panel_A_ASG_69_0_0_18_Changed",1);
		EnableControl(panel_name,"panel_A_ASG_69_0_0_18_SetGet",1);
		setControlForeColor(panel_name, gCheckbox18, MakeRGB(0,240,0));
	}
	else
	{
		EnableControl(panel_name, "panel_A_ASG_69_0_0_18",0);
		EnableControl(panel_name,"errfield_A_ASG_69_0_0_18",0);
		EnableControl(panel_name,"panel_A_ASG_69_0_0_18_Changed",0);
		EnableControl(panel_name,"panel_A_ASG_69_0_0_18_SetGet",0);
		setControlForeColor(panel_name, gCheckbox18, MakeRGB(250,0,0));
	}
	if(getValue(P_ASG_69_0_0_19_FctLstItemEn))
	{
		EnableControl(panel_name, "panel_P_ASG_69_0_0_19",1);
		EnableControl(panel_name,"errfield_P_ASG_69_0_0_19",1);
		setControlForeColor(panel_name, gCheckbox19, MakeRGB(0,240,0));
	}
	else
	{
		EnableControl(panel_name, "panel_P_ASG_69_0_0_19",0);
		EnableControl(panel_name,"errfield_P_ASG_69_0_0_19",0);
		setControlForeColor(panel_name, gCheckbox19, MakeRGB(250,0,0));
	}
	if(getValue(P_ASG_69_0_0_20_FctLstItemEn))
	{
		EnableControl(panel_name, "panel_P_ASG_69_0_0_20",1);
		EnableControl(panel_name,"errfield_P_ASG_69_0_0_20",1);
		setControlForeColor(panel_name, gCheckbox20, MakeRGB(0,240,0));
	}
	else
	{
		EnableControl(panel_name, "panel_P_ASG_69_0_0_20",0);
		EnableControl(panel_name,"errfield_P_ASG_69_0_0_20",0);
		setControlForeColor(panel_name, gCheckbox20, MakeRGB(250,0,0));
	}
	if(getValue(P_ASG_69_0_0_21_FctLstItemEn))
	{
		EnableControl(panel_name, "panel_P_ASG_69_0_0_21",1);
		EnableControl(panel_name,"errfield_P_ASG_69_0_0_21",1);
		setControlForeColor(panel_name, gCheckbox21, MakeRGB(0,240,0));
	}
	else
	{
		EnableControl(panel_name, "panel_P_ASG_69_0_0_21",0);
		EnableControl(panel_name,"errfield_P_ASG_69_0_0_21",0);
		setControlForeColor(panel_name, gCheckbox21, MakeRGB(250,0,0));
	}
	if(getValue(P_ASG_69_0_0_22_FctLstItemEn))
	{
		EnableControl(panel_name, "panel_P_ASG_69_0_0_22",1);
		EnableControl(panel_name,"errfield_P_ASG_69_0_0_22",1);
		setControlForeColor(panel_name, gCheckbox22, MakeRGB(0,240,0));
	}
	else
	{
		EnableControl(panel_name, "panel_P_ASG_69_0_0_22",0);
		EnableControl(panel_name,"errfield_P_ASG_69_0_0_22",0);
		setControlForeColor(panel_name, gCheckbox22, MakeRGB(250,0,0));
	}
	if(getValue(P_ASG_69_0_0_23_FctLstItemEn))
	{
		EnableControl(panel_name, "panel_P_ASG_69_0_0_23",1);
		EnableControl(panel_name,"errfield_P_ASG_69_0_0_23",1);
		setControlForeColor(panel_name, gCheckbox23, MakeRGB(0,240,0));
	}
	else
	{
		EnableControl(panel_name, "panel_P_ASG_69_0_0_23",0);
		EnableControl(panel_name,"errfield_P_ASG_69_0_0_23",0);
		setControlForeColor(panel_name, gCheckbox23, MakeRGB(250,0,0));
	}
	if(getValue(P_ASG_69_0_0_24_FctLstItemEn))
	{
		EnableControl(panel_name, "panel_P_ASG_69_0_0_24",1);
		EnableControl(panel_name,"errfield_P_ASG_69_0_0_24",1);
		setControlForeColor(panel_name, gCheckbox24, MakeRGB(0,240,0));
	}
	else
	{
		EnableControl(panel_name, "panel_P_ASG_69_0_0_24",0);
		EnableControl(panel_name,"errfield_P_ASG_69_0_0_24",0);
		setControlForeColor(panel_name, gCheckbox24, MakeRGB(250,0,0));
	}
	if(getValue(P_ASG_69_0_0_25_FctLstItemEn))
	{
		EnableControl(panel_name, "panel_P_ASG_69_0_0_25",1);
		EnableControl(panel_name,"errfield_P_ASG_69_0_0_25",1);
		setControlForeColor(panel_name, gCheckbox25, MakeRGB(0,240,0));
	}
	else
	{
		EnableControl(panel_name, "panel_P_ASG_69_0_0_25",0);
		EnableControl(panel_name,"errfield_P_ASG_69_0_0_25",0);
		setControlForeColor(panel_name, gCheckbox25, MakeRGB(250,0,0));
	}
	if(getValue(P_ASG_69_0_0_26_FctLstItemEn))
	{
		EnableControl(panel_name, "panel_P_ASG_69_0_0_26",1);
		EnableControl(panel_name,"errfield_P_ASG_69_0_0_26",1);
		setControlForeColor(panel_name, gCheckbox26, MakeRGB(0,240,0));
	}
	else
	{
		EnableControl(panel_name, "panel_P_ASG_69_0_0_26",0);
		EnableControl(panel_name,"errfield_P_ASG_69_0_0_26",0);
		setControlForeColor(panel_name, gCheckbox26, MakeRGB(250,0,0));
	}
	if(getValue(A_ASG_69_0_0_27_FctLstItemEn))
	{
		EnableControl(panel_name, "panel_A_ASG_69_0_0_27",1);
		EnableControl(panel_name,"errfield_A_ASG_69_0_0_27",1);
		EnableControl(panel_name,"panel_A_ASG_69_0_0_27_Changed",1);
		EnableControl(panel_name,"panel_A_ASG_69_0_0_27_SetGet",1);
		setControlForeColor(panel_name, gCheckbox27, MakeRGB(0,240,0));
	}
	else
	{
		EnableControl(panel_name, "panel_A_ASG_69_0_0_27",0);
		EnableControl(panel_name,"errfield_A_ASG_69_0_0_27",0);
		EnableControl(panel_name,"panel_A_ASG_69_0_0_27_Changed",0);
		EnableControl(panel_name,"panel_A_ASG_69_0_0_27_SetGet",0);
		setControlForeColor(panel_name, gCheckbox27, MakeRGB(250,0,0));
	}
	if(getValue(P_ASG_69_0_0_28_FctLstItemEn))
	{
		EnableControl(panel_name, "panel_P_ASG_69_0_0_28",1);
		EnableControl(panel_name,"errfield_P_ASG_69_0_0_28",1);
		setControlForeColor(panel_name, gCheckbox28, MakeRGB(0,240,0));
	}
	else
	{
		EnableControl(panel_name, "panel_P_ASG_69_0_0_28",0);
		EnableControl(panel_name,"errfield_P_ASG_69_0_0_28",0);
		setControlForeColor(panel_name, gCheckbox28, MakeRGB(250,0,0));
	}
	if(getValue(P_ASG_69_0_0_29_FctLstItemEn))
	{
		EnableControl(panel_name, "panel_P_ASG_69_0_0_29",1);
		EnableControl(panel_name,"errfield_P_ASG_69_0_0_29",1);
		setControlForeColor(panel_name, gCheckbox29, MakeRGB(0,240,0));
	}
	else
	{
		EnableControl(panel_name, "panel_P_ASG_69_0_0_29",0);
		EnableControl(panel_name,"errfield_P_ASG_69_0_0_29",0);
		setControlForeColor(panel_name, gCheckbox29, MakeRGB(250,0,0));
	}
	if(getValue(P_ASG_69_0_0_30_FctLstItemEn))
	{
		EnableControl(panel_name, "panel_P_ASG_69_0_0_30",1);
		EnableControl(panel_name,"errfield_P_ASG_69_0_0_30",1);
		setControlForeColor(panel_name, gCheckbox30, MakeRGB(0,240,0));
	}
	else
	{
		EnableControl(panel_name, "panel_P_ASG_69_0_0_30",0);
		EnableControl(panel_name,"errfield_P_ASG_69_0_0_30",0);
		setControlForeColor(panel_name, gCheckbox30, MakeRGB(250,0,0));
	}
	if(getValue(P_ASG_69_0_0_31_FctLstItemEn))
	{
		EnableControl(panel_name, "panel_P_ASG_69_0_0_31",1);
		EnableControl(panel_name,"errfield_P_ASG_69_0_0_31",1);
		setControlForeColor(panel_name, gCheckbox31, MakeRGB(0,240,0));
	}
	else
	{
		EnableControl(panel_name, "panel_P_ASG_69_0_0_31",0);
		EnableControl(panel_name,"errfield_P_ASG_69_0_0_31",0);
		setControlForeColor(panel_name, gCheckbox31, MakeRGB(250,0,0));
	}
	if(getValue(P_ASG_69_0_0_32_FctLstItemEn))
	{
		EnableControl(panel_name, "panel_P_ASG_69_0_0_32",1);
		EnableControl(panel_name,"errfield_P_ASG_69_0_0_32",1);
		setControlForeColor(panel_name, gCheckbox32, MakeRGB(0,240,0));
	}
	else
	{
		EnableControl(panel_name, "panel_P_ASG_69_0_0_32",0);
		EnableControl(panel_name,"errfield_P_ASG_69_0_0_32",0);
		setControlForeColor(panel_name, gCheckbox32, MakeRGB(250,0,0));
	}
	if(getValue(P_ASG_69_0_0_33_FctLstItemEn))
	{
		EnableControl(panel_name, "panel_P_ASG_69_0_0_33",1);
		EnableControl(panel_name,"errfield_P_ASG_69_0_0_33",1);
		setControlForeColor(panel_name, gCheckbox33, MakeRGB(0,240,0));
	}
	else
	{
		EnableControl(panel_name, "panel_P_ASG_69_0_0_33",0);
		EnableControl(panel_name,"errfield_P_ASG_69_0_0_33",0);
		setControlForeColor(panel_name, gCheckbox33, MakeRGB(250,0,0));
	}
	if(getValue(A_ASG_69_0_0_34_FctLstItemEn))
	{
		EnableControl(panel_name, "panel_A_ASG_69_0_0_34",1);
		EnableControl(panel_name,"errfield_A_ASG_69_0_0_34",1);
		EnableControl(panel_name,"panel_A_ASG_69_0_0_34_Changed",1);
		EnableControl(panel_name,"panel_A_ASG_69_0_0_34_SetGet",1);
		setControlForeColor(panel_name, gCheckbox34, MakeRGB(0,240,0));
	}
	else
	{
		EnableControl(panel_name, "panel_A_ASG_69_0_0_34",0);
		EnableControl(panel_name,"errfield_A_ASG_69_0_0_34",0);
		EnableControl(panel_name,"panel_A_ASG_69_0_0_34_Changed",0);
		EnableControl(panel_name,"panel_A_ASG_69_0_0_34_SetGet",0);
		setControlForeColor(panel_name, gCheckbox34, MakeRGB(250,0,0));
	}

}

DisableReservedFld ()
{
  	EnableControl(panel_name,"P_ASG_69_0_0_16_2_reserved",0);
	EnableControl(panel_name,"P_ASG_69_0_0_16_3_reserved",0);
	EnableControl(panel_name,"P_ASG_69_0_0_17_2_reserved",0);
	EnableControl(panel_name,"P_ASG_69_0_0_17_3_reserved",0);
	EnableControl(panel_name,"P_ASG_69_0_0_25_3_reserved",0);
	EnableControl(panel_name,"P_ASG_69_0_0_25_4_reserved",0);
	EnableControl(panel_name,"P_ASG_69_0_0_28_4_reserved",0);
	EnableControl(panel_name,"P_ASG_69_0_0_28_5_reserved",0);
	EnableControl(panel_name,"P_ASG_69_0_0_29_2_reserved",0);
	EnableControl(panel_name,"P_ASG_69_0_0_29_3_reserved",0);
	EnableControl(panel_name,"P_ASG_69_0_0_30_4_reserved",0);
	EnableControl(panel_name,"P_ASG_69_0_0_30_5_reserved",0);
	EnableControl(panel_name,"P_ASG_69_0_0_31_2_reserved",0);
	EnableControl(panel_name,"P_ASG_69_0_0_31_3_reserved",0);
	EnableControl(panel_name,"P_ASG_69_0_0_32_3_reserved",0);
	EnableControl(panel_name,"P_ASG_69_0_0_32_4_reserved",0);
	EnableControl(panel_name,"P_ASG_69_0_0_33_2_reserved",0);
	EnableControl(panel_name,"P_ASG_69_0_0_33_3_reserved",0);

}

resetErrfieldColor()
{
  	setControlBackColor(panel_name, "errfield_C_ASG_69_0_0_1", MakeRGB(255,255,255));
	setControlBackColor(panel_name, "errfield_P_ASG_69_0_0_2", MakeRGB(255,255,255));
	setControlBackColor(panel_name, "errfield_P_ASG_69_0_0_3", MakeRGB(255,255,255));
	setControlBackColor(panel_name, "errfield_P_ASG_69_0_0_4", MakeRGB(255,255,255));
	setControlBackColor(panel_name, "errfield_P_ASG_69_0_0_13", MakeRGB(255,255,255));
	setControlBackColor(panel_name, "errfield_P_ASG_69_0_0_14", MakeRGB(255,255,255));
	setControlBackColor(panel_name, "errfield_P_ASG_69_0_0_15", MakeRGB(255,255,255));
	setControlBackColor(panel_name, "errfield_P_ASG_69_0_0_16", MakeRGB(255,255,255));
	setControlBackColor(panel_name, "errfield_P_ASG_69_0_0_17", MakeRGB(255,255,255));
	setControlBackColor(panel_name, "errfield_A_ASG_69_0_0_18", MakeRGB(255,255,255));
	setControlBackColor(panel_name, "errfield_P_ASG_69_0_0_19", MakeRGB(255,255,255));
	setControlBackColor(panel_name, "errfield_P_ASG_69_0_0_20", MakeRGB(255,255,255));
	setControlBackColor(panel_name, "errfield_P_ASG_69_0_0_21", MakeRGB(255,255,255));
	setControlBackColor(panel_name, "errfield_P_ASG_69_0_0_22", MakeRGB(255,255,255));
	setControlBackColor(panel_name, "errfield_P_ASG_69_0_0_23", MakeRGB(255,255,255));
	setControlBackColor(panel_name, "errfield_P_ASG_69_0_0_24", MakeRGB(255,255,255));
	setControlBackColor(panel_name, "errfield_P_ASG_69_0_0_25", MakeRGB(255,255,255));
	setControlBackColor(panel_name, "errfield_P_ASG_69_0_0_26", MakeRGB(255,255,255));
	setControlBackColor(panel_name, "errfield_A_ASG_69_0_0_27", MakeRGB(255,255,255));
	setControlBackColor(panel_name, "errfield_P_ASG_69_0_0_28", MakeRGB(255,255,255));
	setControlBackColor(panel_name, "errfield_P_ASG_69_0_0_29", MakeRGB(255,255,255));
	setControlBackColor(panel_name, "errfield_P_ASG_69_0_0_30", MakeRGB(255,255,255));
	setControlBackColor(panel_name, "errfield_P_ASG_69_0_0_31", MakeRGB(255,255,255));
	setControlBackColor(panel_name, "errfield_P_ASG_69_0_0_32", MakeRGB(255,255,255));
	setControlBackColor(panel_name, "errfield_P_ASG_69_0_0_33", MakeRGB(255,255,255));
	setControlBackColor(panel_name, "errfield_A_ASG_69_0_0_34", MakeRGB(255,255,255));

}

CANoe_Shutdown ()
{
	// Timer 
	canceltimer(TaskTimer);		//cancel real CAN-communication timer

	// Ruecksetzen der Hintergrundfarbe der Error-Felder
	resetErrfieldColor();
	// Deaktivierung aller Panel Elemente 
	DisableFctCtrl();
	EnableControl(panel_name, bapconfig_panel_name, 0); 
	EnableConfigCtrl();

}

on timer TaskTimer
{

	/*** Aufruf des BAP Task in DLL fuer NODE_INDEX ***/
	BAP150_Task(NODE_INDEX);	

	/*** Pollen ueber die anstehenden Indications (Lesen aus DLL, Auslesen eines Puffers der DLL) ***/
	BAP_DLL_Indication();	
	
	/*** Pollen ueber die anstehenden Requests (Schreiben in DLL, dort werden evt. Sendeauftraege gesetzt) ***/
	BAP_DLL_Request();
	
	/*** Abarbeiten der ausstehenden Sendeauftraege innerhalb der BAP DLL und Versenden ueber CANoe ***/
	BAP_CAN_TX_Request();
  
  BAP_DLL_SetRxData();

	/*** Retriggern des Timers mit 10 ms ***/
	setTimer(TaskTimer, TaskTime); // @TODO bei anderer Taskzeit muss hier modifiziert werden
}


BAP_DLL_SetRxData()
{
}

BAP_DLL_Indication()	//function to get received BAP-data from DLL (at BAL-interface)
{
	int i, length, datalength, temp;
	byte Indication_data[BAP_buffer_size];		// indication data from DLL
	dword Indication_header[6];					// indication header from DLL
	byte BAP_data_type;

	//init local variables
	length=0;
	datalength=0;
	temp=0;
	BAP_data_type=0;

	for(i=0;i<6;i++)
		Indication_header[i]=0;

	for(i=0;i<BAP_buffer_size;i++)
		Indication_data[i]=0;

	// BAP-Stack needs this information for successful BAP150_GetIndication 
	Indication_header[4]=BAP_buffer_size;

	while (BAP150_GetInd(NODE_INDEX, Indication_header, Indication_data) == 0)
	{		
		//read header and write in global variable
		for (i = 0; i < 6; i++) {
			gBAP_Indication_header[i]=Indication_header[i];	
		}

		// nur Bytesequneces haben Datenanteil
		if (gBAP_Indication_header[3] == Bap_byteSequence)
		{
			for (i = 0; i < BAP_buffer_size; i++) {
				gBAP_Indication_data[i]=Indication_data[i];	
			}
		}	
		// Verarbeiten der Indication
		Process_Current_Indication();

		// Vorbereiten fuer naechsten Durchlauf 
		Indication_header[4]=BAP_buffer_size;
	} 
}

ChangeConfig(long paramIndex,long config[])
{

        byte temp ;
        temp = BAP150_ChangeConfig(NODE_INDEX, paramIndex, config);
        if(temp == 0)
            writelineEx(gBAP_Trace, 0, "BAP150_ChangeConfig for %s succesful (LSG %d, NODE_INDEX %d)", NODE_NAME, LSGID, NODE_INDEX);
        else
            writelineEx(gError_Trace, 0, "BAP150_ChangeConfig error 0x%X for %s (LSG %d, NODE_INDEX %d)", temp, NODE_NAME, LSGID, NODE_INDEX);        
}

PrintIndicationError(char reason[])
{
	writelineEx(gError_Trace, 0, "%s - %s lsgId:%d fctid:%d indType:%s dataType:%s",
		reason, SGtype, gBAP_Indication_header[0], gBAP_Indication_header[1], Indicationtype_Text[gBAP_Indication_header[2]], Datatype_Text[gBAP_Indication_header[3]]);
}

BapOnOff(byte _on)
{
  int length, temp;
  char Path[255];
  
  /***** Einschalten ******/
  if(_on==1){
    
    if(@BusType_ASG69_0 == 0){  // Uses CAN
      getAbsFilePath(dbcan_path, Path, 255);
      if(BAP180_LoadDB(NODE_INDEX,1, 0, Path) != 0){
        writelineEx(gError_Trace, 0, "Fehler beim Laden: %s !", Path);
      }
    }
    
    /**** Laden des BAP XML Files ****/
    getAbsFilePath(xml_path, Path, 255);
    writelineEx(gBAP_Trace, 0, "Load BAP-XML-File: %s", Path);
    if (BAP150_LoadConfig(NODE_INDEX, Path) != 0) {
        writelineEx(gError_Trace, 0, "Fehler beim Laden: %s !", Path);
    }

    if (BAP150_AddCanMap(NODE_INDEX, 1, 1) != 0) {
        writelineEx(gError_Trace, 0, "Fehler beim Mappen!");
    }
  
    // soll der BAP Stack wieder initlialisiert werden?                                 
    if(gBAP_Init==0){
        //gBAP_Init=1;
        temp=BAP150_Init(NODE_INDEX, LSGID);
        if(temp==0)
            writelineEx(gBAP_Trace, 0, "BAP_Init for %s succesful (LSG %d, NODE_INDEX %d)", NODE_NAME, LSGID, NODE_INDEX);
        else
            writelineEx(gError_Trace, 0, "BAP_Init error 0x%X for %s (LSG %d, NODE_INDEX %d)", temp, NODE_NAME, LSGID, NODE_INDEX);         
    }

    // Initialisierung aller Variablen
    Initialize_Variables();                     

    // Aktivierung aller Panelelemente
    //EnableFctCtrl();
    initInvalidFields();
    EnableControl(panel_name, common_panel_name, 1);
    EnableControl(panel_name, bapconfig_panel_name, 1); 
    DisableReservedFld();
    
    
    //BAP-Shutdown
    temp = BAP150_Shutdown(NODE_INDEX, LSGID);
    if(temp==0)
        writelineEx(gBAP_Trace, 0, "BAP_Shutdown for %s succesful (LSG %d, NODE_INDEX %d)", NODE_NAME, LSGID, NODE_INDEX);
    else
        writelineEx(gError_Trace, 0, "BAP_Shutdown error 0x%X for %s (LSG %d, NODE_INDEX %d)", temp, NODE_NAME, LSGID, NODE_INDEX); 

    //BAP-Start
    temp = BAP150_Start(NODE_INDEX, LSGID);             
    if(temp == 0)
        writelineEx(gBAP_Trace, 0, "BAP_Start for %s succesful (LSG %d, NODE_INDEX %d)", NODE_NAME, LSGID, NODE_INDEX);
    else
        writelineEx(gError_Trace, 0, "BAP_Start error 0x%X for %s (LSG %d, NODE_INDEX %d)", temp, NODE_NAME, LSGID, NODE_INDEX);        

    // setze den Timer fuer den zyklischen Aufruf des CANoe-"Tasks"
    setTimer(TaskTimer, 10);                
// ETHERNET AND FLEXRAY NOT ENABLED!
    //  BAPFsg_ProcessDebug(NODE_INDEX,DEBUG_CAN_CHANNEL, DEBUG_ID, LSGID, DEBUG_SWITCH_ON);    
  }
  else{ /***** Ausschalten ****/
      
      BAP150_Shutdown(NODE_INDEX,LSGID);
      
      CANoe_Shutdown();
      
      // ETHERNET NOT ENABLED! (CALL_FCT_CLOSE_UPD_SOCKET_TOKEN)
  }
}

Initialize_Variables()	//initialize/reset all global variables
{
	int i;
	byte  Init_data[BAP_buffer_size];	// InitSend data for DLL

	/**** Request Buffer Geschichten initialisieren ****/
	for (i = 0; i < Requestbuffer_lines; i++)
	{
		gBAP_Requestbuffer_status[i] = 0;
	}
	for (i = 0; i < BAP_buffer_size; i++)
	{
		Init_data[i] = 0;
	}
	
	/* Wert im Eingabefeld initialisieren*/
	putValue(P_ASG_69_0_0_13, 0);
	getValue(P_ASG_69_0_0_16,Init_data);
	putValue(P_ASG_69_0_0_16,Init_data, 2);
	getValue(P_ASG_69_0_0_17,Init_data);
	putValue(P_ASG_69_0_0_17,Init_data, 2);
	getValue(P_ASG_69_0_0_20,Init_data);
	putValue(P_ASG_69_0_0_20,Init_data, 5);
	getValue(P_ASG_69_0_0_22,Init_data);
	putValue(P_ASG_69_0_0_22,Init_data, 5);
	getValue(P_ASG_69_0_0_24,Init_data);
	putValue(P_ASG_69_0_0_24,Init_data, 5);
	getValue(P_ASG_69_0_0_25,Init_data);
	putValue(P_ASG_69_0_0_25,Init_data, 3);
	putValue(P_ASG_69_0_0_26, 0);
	getValue(P_ASG_69_0_0_28,Init_data);
	putValue(P_ASG_69_0_0_28,Init_data, 4);
	getValue(P_ASG_69_0_0_29,Init_data);
	putValue(P_ASG_69_0_0_29,Init_data, 2);
	getValue(P_ASG_69_0_0_30,Init_data);
	putValue(P_ASG_69_0_0_30,Init_data, 4);
	getValue(P_ASG_69_0_0_31,Init_data);
	putValue(P_ASG_69_0_0_31,Init_data, 6);
	getValue(P_ASG_69_0_0_32,Init_data);
	putValue(P_ASG_69_0_0_32,Init_data, 3);
	getValue(P_ASG_69_0_0_33,Init_data);
	putValue(P_ASG_69_0_0_33,Init_data, 2);
	/* Farbe setzen*/
	putValue(C_ASG_69_0_0_1_State,"");
	setControlBackColor(panel_name, "errfield_C_ASG_69_0_0_1_State", MakeRGB(255,255,255));

}

initInvalidFields()	//initialize/reset all global variables
{
	    setControlBackColor(panel_name, "panel1_edit", MakeRGB(220,220,220));
    setControlBackColor(panel_name, "panel_P_ASG_69_0_0_4", MakeRGB(220,220,220));
    setControlBackColor(panel_name, "panel_P_ASG_69_0_0_13", MakeRGB(220,220,220));
    setControlBackColor(panel_name, "panel_P_ASG_69_0_0_14", MakeRGB(220,220,220));
    setControlBackColor(panel_name, "panel_P_ASG_69_0_0_15", MakeRGB(220,220,220));
    setControlBackColor(panel_name, "panel_P_ASG_69_0_0_16", MakeRGB(220,220,220));
    setControlBackColor(panel_name, "panel_P_ASG_69_0_0_17", MakeRGB(220,220,220));
    setControlBackColor(panel_name, "panel_A_ASG_69_0_0_18", MakeRGB(220,220,220));
    setControlBackColor(panel_name, "panel_A_ASG_69_0_0_18_Changed",MakeRGB(220,220,220));
    setControlBackColor(panel_name, "panel_P_ASG_69_0_0_19", MakeRGB(220,220,220));
    setControlBackColor(panel_name, "panel_P_ASG_69_0_0_20", MakeRGB(220,220,220));
    setControlBackColor(panel_name, "panel_P_ASG_69_0_0_21", MakeRGB(220,220,220));
    setControlBackColor(panel_name, "panel_P_ASG_69_0_0_22", MakeRGB(220,220,220));
    setControlBackColor(panel_name, "panel_P_ASG_69_0_0_23", MakeRGB(220,220,220));
    setControlBackColor(panel_name, "panel_P_ASG_69_0_0_24", MakeRGB(220,220,220));
    setControlBackColor(panel_name, "panel_P_ASG_69_0_0_25", MakeRGB(220,220,220));
    setControlBackColor(panel_name, "panel_P_ASG_69_0_0_26", MakeRGB(220,220,220));
    setControlBackColor(panel_name, "panel_A_ASG_69_0_0_27", MakeRGB(220,220,220));
    setControlBackColor(panel_name, "panel_A_ASG_69_0_0_27_Changed",MakeRGB(220,220,220));
    setControlBackColor(panel_name, "panel_P_ASG_69_0_0_28", MakeRGB(220,220,220));
    setControlBackColor(panel_name, "panel_P_ASG_69_0_0_29", MakeRGB(220,220,220));
    setControlBackColor(panel_name, "panel_P_ASG_69_0_0_30", MakeRGB(220,220,220));
    setControlBackColor(panel_name, "panel_P_ASG_69_0_0_31", MakeRGB(220,220,220));
    setControlBackColor(panel_name, "panel_P_ASG_69_0_0_32", MakeRGB(220,220,220));
    setControlBackColor(panel_name, "panel_P_ASG_69_0_0_33", MakeRGB(220,220,220));
    setControlBackColor(panel_name, "panel_A_ASG_69_0_0_34", MakeRGB(220,220,220));
    setControlBackColor(panel_name, "panel_A_ASG_69_0_0_34_Changed",MakeRGB(220,220,220));

}

on start
{
	// noch nicht eingeschaltet
	gSG_PowerOnOff=0;
	// noch nicht initialisiert
	gBAP_Init=0;
	// open the panel, nur fuer CANoe-Version >= 5.1 erlaubt
	//openPanel(panel_name);
	// deaktiviere alle aktiven Panel Elemente, ausser AN/AUSS
    CANoe_Shutdown();
    // ungueltige Felder initialisieren
    initInvalidFields();    
    
// ETHERNET AND FLEXRAY NOT ENABLED!
}

BAP_CAN_TX_Request()	//Function to send BAP-data over CAN
{
   int i;
   byte DestIp[16];
   byte TX_Data[1500];				// CAN-data
   byte TX_Data_FR[10];    		// FlexRay-Data
   dword TX_Header[13];			// Header
   message 0x100 TX_Message;	// dummy-message, Adresse wird noch modifiziert
   
   byte send_result;
   
   // ONLY CAN IS ENABLED! 
      TX_Header[0] = 1; /*BusType: 1=Can, 2=Lin, 3=Flexray, 4=Ethernet*/
   		TX_Header[2] = 8; // max-Length of TX_Data

		// Pollen ueber die Queue, die von der DLL zur Verfuegung gestellt wird
		// Diese Daten muessen ueber den CAN Bus gesendet werden
	   	while (BAP180_GetTxData(NODE_INDEX,TX_Header,TX_Data) == 0) {	
        TX_Message.CAN = TX_Header[1]; 		//CAN channel
        TX_Message.ID = TX_Header[3]; 	  //Can ID
        TX_Message.DataLength = TX_Header[2]; 		// received length
			
			  for (i=0; i<TX_Message.DataLength; i++) {	//CAN data-bytes
		  		TX_Message.byte(i) = TX_Data[i];
		  	}
		  	
        TX_Message.EDL = 0;
        TX_Message.BRS = 0;
        if(TX_Header[4] & 2) 
          TX_Message.EDL = 1;
        if(TX_Header[4] & 4) 
          TX_Message.BRS = 1;
        
		  	output(TX_Message);					//send CAN message
		  	
		  	//Versions Output
		  	if(TX_Data[0] == 0x40 && TX_Data[1] == 0x00 && TX_Header[2] == 4)
		  	{
		    	writelineEx(gBAP_Trace, 0,"Major Version: %i, Minor Version: %i", TX_Data[2], TX_Data[3]);
		  	}       
		  	TX_Header[2] = 8; // max-Length of TX_Data
	   	} 
   // ONLY CAN IS ENABLED!
   // FLEXRAY NOT ENABLED! (TX_FR_TOKEN)
   // ETHERNET NOT ENABLED! (TX_IP_TOKEN)
}

ringbuffer_write (byte lsgID, byte fctID, byte request, byte dataType, word length, dword singleData, byte data[])
{
	int bufferline, i;

	bufferline = getNextWriteIndex();	//get next free position in ring-buffer

	if (bufferline == -1) 
	{
		writelineEx(gError_Trace, 0, "Crititcal Error: No free buffer found!");
		return;
	}
		
	gBAP_Request_header[bufferline][0] = lsgID;	// LSG
	gBAP_Request_header[bufferline][1] = fctID;	// FCT
	gBAP_Request_header[bufferline][3] = dataType; // dataType

    //writelineEx(gBAP_Trace, 0, "Write request in buffer ASG NODEINDEX:%d lsgid:%d fctid:%d requesttype:%d datatype:%d length:%d", 
    //        NODE_INDEX,lsgID,fctID,request,dataType,length);
	switch (dataType)
	{
		case Bap_void:
			gBAP_Request_header[bufferline][2] = request;	// request
			gBAP_Request_header[bufferline][4] = 0;	// length
				// Void
			// @TODO?		
			break;
		case Bap_uint8:
			gBAP_Request_header[bufferline][2] = request;		// request
			gBAP_Request_header[bufferline][5] = singleData;	// Daten		
			break;
		case Bap_uint16:
			gBAP_Request_header[bufferline][2] = request;		// request
			gBAP_Request_header[bufferline][5] = singleData;	// Daten
			break;			
		case Bap_uint32:
			gBAP_Request_header[bufferline][2] = request;		// request
			gBAP_Request_header[bufferline][5] = singleData;	// Daten		
			break;	
		case Bap_byteSequence:
			gBAP_Request_header[bufferline][2] = request;	// request
			gBAP_Request_header[bufferline][4] = length;	// length
			// Daten der ByteSequence kopieren
			for(i = 0; i < BAP_buffer_size; i++)									
				gBAP_Request_data[bufferline][i] = data[i];
		case Bap_error:
			gBAP_Request_header[bufferline][5] = singleData;	// Errorcode						
			break;
		default:
			break;
	}

			

}

float round (float value, float step)
{
	return _floor(value / step + 0.5) * step;
}

Request_Void (byte lsgID, byte fctID, byte request)
{
	int i;
	byte dataArray [BAP_buffer_size];

	// Initialisieren eines Arrays
	for(i=0;i<BAP_buffer_size;i++) dataArray [i]=0;

	ringbuffer_write (lsgID, fctID, request, Bap_void, 0, 0, dataArray);	
}

Request_Int8 (byte lsgID, byte fctID, byte request, dword data)
{
	int i;
	byte dataArray [BAP_buffer_size];

	// Initialisieren eines Arrays
	for(i=0;i<BAP_buffer_size;i++) dataArray [i]=0;

	ringbuffer_write (lsgID, fctID, request, Bap_uint8, 0, data, dataArray);

}

Request_Int16 (byte lsgID, byte fctID, byte request, dword data)
{
	int i;
	byte dataArray [BAP_buffer_size];

	// Initialisieren eines Arrays
	for(i=0;i<BAP_buffer_size;i++) dataArray [i]=0;

	ringbuffer_write (lsgID, fctID, request, Bap_uint16, 0, data, dataArray);

}

Request_Int32 (byte lsgID, byte fctID, byte request, dword data)
{
	int i;
	byte dataArray [BAP_buffer_size];

	// Initialisieren eines Arrays
	for(i=0;i<BAP_buffer_size;i++) dataArray [i]=0;

	ringbuffer_write (lsgID, fctID, request, Bap_uint32, 0, data, dataArray);
}

Request_ByteSequence (byte lsgID, byte fctID, byte request, byte data[], word length)
{
	int i;
	byte dataArray [BAP_buffer_size];

	// Initialisieren eines Arrays
	for(i=0;i<BAP_buffer_size;i++) dataArray [i]=0;

	// Fuellen des Arrays
	for(i=0;i<length;i++) dataArray [i]=data[i];

	ringbuffer_write (lsgID, fctID, request, Bap_byteSequence, length, 0, dataArray);
}

Request_Error (byte lsgID, byte fctID, byte errorCode)
{
	int i;
	byte dataArray [BAP_buffer_size];

	// Initialisieren eines Arrays
	for(i=0;i<BAP_buffer_size;i++) dataArray [i]=0;

	ringbuffer_write (lsgID, fctID, 0, Bap_error, 0, errorCode, dataArray);
}

DisplayRequestErrorCode(dword fctID, dword errCode)
{
       switch(fctID)
   {
       case C_ASG_69_0_0_1_ID:
           gC_ASG_69_0_0_1_ErrCode = 0;
           putValue(C_ASG_69_0_0_1_ErrCode,  errCode);
           setControlBackColor(panel_name,"errfield_C_ASG_69_0_0_1", MakeRGB(255,79,79));
       break;
       case P_ASG_69_0_0_2_ID:
           gP_ASG_69_0_0_2_ErrCode = 0;
           putValue(P_ASG_69_0_0_2_ErrCode,  errCode);
           setControlBackColor(panel_name,"errfield_P_ASG_69_0_0_2", MakeRGB(255,79,79));
       break;
       case P_ASG_69_0_0_3_ID:
           gP_ASG_69_0_0_3_ErrCode = 0;
           putValue(P_ASG_69_0_0_3_ErrCode,  errCode);
           setControlBackColor(panel_name,"errfield_P_ASG_69_0_0_3", MakeRGB(255,79,79));
       break;
       case P_ASG_69_0_0_4_ID:
           gP_ASG_69_0_0_4_ErrCode = 0;
           putValue(P_ASG_69_0_0_4_ErrCode,  errCode);
           setControlBackColor(panel_name,"errfield_P_ASG_69_0_0_4", MakeRGB(255,79,79));
       break;
       case P_ASG_69_0_0_13_ID:
           gP_ASG_69_0_0_13_ErrCode = 0;
           putValue(P_ASG_69_0_0_13_ErrCode,  errCode);
           setControlBackColor(panel_name,"errfield_P_ASG_69_0_0_13", MakeRGB(255,79,79));
       break;
       case P_ASG_69_0_0_14_ID:
           gP_ASG_69_0_0_14_ErrCode = 0;
           putValue(P_ASG_69_0_0_14_ErrCode,  errCode);
           setControlBackColor(panel_name,"errfield_P_ASG_69_0_0_14", MakeRGB(255,79,79));
       break;
       case P_ASG_69_0_0_15_ID:
           gP_ASG_69_0_0_15_ErrCode = 0;
           putValue(P_ASG_69_0_0_15_ErrCode,  errCode);
           setControlBackColor(panel_name,"errfield_P_ASG_69_0_0_15", MakeRGB(255,79,79));
       break;
       case P_ASG_69_0_0_16_ID:
           gP_ASG_69_0_0_16_ErrCode = 0;
           putValue(P_ASG_69_0_0_16_ErrCode,  errCode);
           setControlBackColor(panel_name,"errfield_P_ASG_69_0_0_16", MakeRGB(255,79,79));
       break;
       case P_ASG_69_0_0_17_ID:
           gP_ASG_69_0_0_17_ErrCode = 0;
           putValue(P_ASG_69_0_0_17_ErrCode,  errCode);
           setControlBackColor(panel_name,"errfield_P_ASG_69_0_0_17", MakeRGB(255,79,79));
       break;
       case A_ASG_69_0_0_18_ID:
           gA_ASG_69_0_0_18_ErrCode = 0;
           putValue(A_ASG_69_0_0_18_ErrCode,  errCode);
           setControlBackColor(panel_name,"errfield_A_ASG_69_0_0_18", MakeRGB(255,79,79));
       break;
       case P_ASG_69_0_0_19_ID:
           gP_ASG_69_0_0_19_ErrCode = 0;
           putValue(P_ASG_69_0_0_19_ErrCode,  errCode);
           setControlBackColor(panel_name,"errfield_P_ASG_69_0_0_19", MakeRGB(255,79,79));
       break;
       case P_ASG_69_0_0_20_ID:
           gP_ASG_69_0_0_20_ErrCode = 0;
           putValue(P_ASG_69_0_0_20_ErrCode,  errCode);
           setControlBackColor(panel_name,"errfield_P_ASG_69_0_0_20", MakeRGB(255,79,79));
       break;
       case P_ASG_69_0_0_21_ID:
           gP_ASG_69_0_0_21_ErrCode = 0;
           putValue(P_ASG_69_0_0_21_ErrCode,  errCode);
           setControlBackColor(panel_name,"errfield_P_ASG_69_0_0_21", MakeRGB(255,79,79));
       break;
       case P_ASG_69_0_0_22_ID:
           gP_ASG_69_0_0_22_ErrCode = 0;
           putValue(P_ASG_69_0_0_22_ErrCode,  errCode);
           setControlBackColor(panel_name,"errfield_P_ASG_69_0_0_22", MakeRGB(255,79,79));
       break;
       case P_ASG_69_0_0_23_ID:
           gP_ASG_69_0_0_23_ErrCode = 0;
           putValue(P_ASG_69_0_0_23_ErrCode,  errCode);
           setControlBackColor(panel_name,"errfield_P_ASG_69_0_0_23", MakeRGB(255,79,79));
       break;
       case P_ASG_69_0_0_24_ID:
           gP_ASG_69_0_0_24_ErrCode = 0;
           putValue(P_ASG_69_0_0_24_ErrCode,  errCode);
           setControlBackColor(panel_name,"errfield_P_ASG_69_0_0_24", MakeRGB(255,79,79));
       break;
       case P_ASG_69_0_0_25_ID:
           gP_ASG_69_0_0_25_ErrCode = 0;
           putValue(P_ASG_69_0_0_25_ErrCode,  errCode);
           setControlBackColor(panel_name,"errfield_P_ASG_69_0_0_25", MakeRGB(255,79,79));
       break;
       case P_ASG_69_0_0_26_ID:
           gP_ASG_69_0_0_26_ErrCode = 0;
           putValue(P_ASG_69_0_0_26_ErrCode,  errCode);
           setControlBackColor(panel_name,"errfield_P_ASG_69_0_0_26", MakeRGB(255,79,79));
       break;
       case A_ASG_69_0_0_27_ID:
           gA_ASG_69_0_0_27_ErrCode = 0;
           putValue(A_ASG_69_0_0_27_ErrCode,  errCode);
           setControlBackColor(panel_name,"errfield_A_ASG_69_0_0_27", MakeRGB(255,79,79));
       break;
       case P_ASG_69_0_0_28_ID:
           gP_ASG_69_0_0_28_ErrCode = 0;
           putValue(P_ASG_69_0_0_28_ErrCode,  errCode);
           setControlBackColor(panel_name,"errfield_P_ASG_69_0_0_28", MakeRGB(255,79,79));
       break;
       case P_ASG_69_0_0_29_ID:
           gP_ASG_69_0_0_29_ErrCode = 0;
           putValue(P_ASG_69_0_0_29_ErrCode,  errCode);
           setControlBackColor(panel_name,"errfield_P_ASG_69_0_0_29", MakeRGB(255,79,79));
       break;
       case P_ASG_69_0_0_30_ID:
           gP_ASG_69_0_0_30_ErrCode = 0;
           putValue(P_ASG_69_0_0_30_ErrCode,  errCode);
           setControlBackColor(panel_name,"errfield_P_ASG_69_0_0_30", MakeRGB(255,79,79));
       break;
       case P_ASG_69_0_0_31_ID:
           gP_ASG_69_0_0_31_ErrCode = 0;
           putValue(P_ASG_69_0_0_31_ErrCode,  errCode);
           setControlBackColor(panel_name,"errfield_P_ASG_69_0_0_31", MakeRGB(255,79,79));
       break;
       case P_ASG_69_0_0_32_ID:
           gP_ASG_69_0_0_32_ErrCode = 0;
           putValue(P_ASG_69_0_0_32_ErrCode,  errCode);
           setControlBackColor(panel_name,"errfield_P_ASG_69_0_0_32", MakeRGB(255,79,79));
       break;
       case P_ASG_69_0_0_33_ID:
           gP_ASG_69_0_0_33_ErrCode = 0;
           putValue(P_ASG_69_0_0_33_ErrCode,  errCode);
           setControlBackColor(panel_name,"errfield_P_ASG_69_0_0_33", MakeRGB(255,79,79));
       break;
       case A_ASG_69_0_0_34_ID:
           gA_ASG_69_0_0_34_ErrCode = 0;
           putValue(A_ASG_69_0_0_34_ErrCode,  errCode);
           setControlBackColor(panel_name,"errfield_A_ASG_69_0_0_34", MakeRGB(255,79,79));
       break;
       default:
           writelineEx(gError_Trace, 0, "%s%d/%d Unknown Functionid in  displayErrorCode", SGtype, LSGID,fctID);
   }

}

BAP_DLL_Request ()
{
	int i;
    int l=0;
	byte temp;
	byte Request_data[4096];	//Request data for DLL
	dword Request_header[6];	//Request header for DLL
	byte dataValid;
	int nextElementToRead;
	
	// defaultmaessig ist senden OK
	dataValid = 1;

	// loeschen der Daten "Container"
	for(i=0;i<6;i++)
		Request_header[i]=0;
	for(i=0;i<BAP_buffer_size;i++)
		Request_data[i]=0;

    
	// Verarbeiten aller noch offenen Requests	
	while ((nextElementToRead = getNextReadIndex()) != -1) 
	{
		// Fuer alle Datentypen gleich
		Request_header[0]=gBAP_Request_header [nextElementToRead][0];		//LSG-ID
		Request_header[1]=gBAP_Request_header [nextElementToRead][1];		//Function-ID
		Request_header[2]=gBAP_Request_header [nextElementToRead][2];		//request type
		Request_header[3]=gBAP_Request_header [nextElementToRead][3];		//BAP data type

		switch(gBAP_Request_header[nextElementToRead][3]){
			case Bap_uint32:
                l=2;
            case Bap_uint16:
                l++;
            case Bap_uint8:
			case Bap_error: // Request (2) wird dabei ignoriert
                l++;
			case Bap_void:  // Datenfeld (5) wird dabei ignoriert
				Request_header[4]=l;												//	not used
				Request_header[5]=gBAP_Request_header [nextElementToRead][5];		// Daten
			break;
			case Bap_byteSequence:									
				Request_header[4]=gBAP_Request_header [nextElementToRead][4];		// length
				Request_header[5]=0;												// not used

				// data-array for BAP-DLL funcion 'BAP_Request'
				for(i=0;i<BAP_buffer_size;i++)
					Request_data[i]=gBAP_Request_data [nextElementToRead][i];
				break;			
			default:
				writelineEx(gError_Trace, 0, "BAP_DLL_Request: invalid BAP-Data-Type: %d", gBAP_Request_header[nextElementToRead][3]);
				dataValid = 0;
			break;			
		}
		
		if(dataValid){
            // wie heisst der Request?
            writelineEx(gBAP_Trace, 0, "%s%d/%d BAP_Request %s datatype:%s length:%d", SGtype, Request_header[0],Request_header[1],Requesttype_Text[Request_header[2]],Datatype_Text[Request_header[3]],Request_header[4]);
			temp = BAP150_Request(NODE_INDEX, Request_header, Request_data);	//send data to BAP-DLL	
			// BAP-Request failed
            if(temp != 0){
                // Fehlercode: Request failed
                writelineEx(gError_Trace, 0, "%s%d/%d Error during BAP_Request errorcode: 0x%X", SGtype, Request_header[0],Request_header[1],temp);
                DisplayRequestErrorCode(Request_header[1],temp);
            } 
		}

	}
} 

int getNextReadIndex ()
{
	int i, ret;
	// der Puffer wird nach dem naechsten zu lesenden Eintrag durchsucht
	// Existiert keiner wird -1 zurueckgegeben
	ret = -1;

	for (i = 0; i < Requestbuffer_lines; i++)
	{
		if (gBAP_Requestbuffer_status[i] == 1)
		{
			// zum verschicken
			ret = i;
			// und wieder freigeben
			gBAP_Requestbuffer_status[i] = 0;
			break;
		}
	}

	return (ret);
}

int getNextWriteIndex ()
{
	int i, ret;
	// der Puffer wird nach dem naechsten freien Eintrag durchsucht
	// Existiert keiner wird -1 zurueckgegeben
	ret = -1;

	for (i = 0; i < Requestbuffer_lines; i++)
	{
		if (gBAP_Requestbuffer_status[i] == 0)
		{
			// zum schreiben
			ret = i;
			// belegen
			gBAP_Requestbuffer_status[i] = 1;
			break;
		}
	}

	return (ret);
}

byte  isBitForFctSetted(word fctid, byte fctList[])
{
    byte byteNo ;
    byte bitno ;
    byte fctValue ;

    byteNo = fctid / 8;
    bitno = fctid % 8;

    fctValue = 0x80 >> bitno;

    return (fctList[byteNo] & fctValue)?1:0;
}

UpdateAllProperties()
{
	Request_Void(LSGID,P_ASG_69_0_0_2_ID,DataGet_REQ);
	Request_Void(LSGID,P_ASG_69_0_0_3_ID,DataGet_REQ);
	Request_Void(LSGID,P_ASG_69_0_0_4_ID,DataGet_REQ);
	Request_Void(LSGID,P_ASG_69_0_0_13_ID,DataGet_REQ);
	Request_Void(LSGID,P_ASG_69_0_0_14_ID,DataGet_REQ);
	Request_Void(LSGID,P_ASG_69_0_0_15_ID,DataGet_REQ);
	Request_Void(LSGID,P_ASG_69_0_0_16_ID,DataGet_REQ);
	Request_Void(LSGID,P_ASG_69_0_0_17_ID,DataGet_REQ);
	Request_Void(LSGID,P_ASG_69_0_0_19_ID,DataGet_REQ);
	Request_Void(LSGID,P_ASG_69_0_0_20_ID,DataGet_REQ);
	Request_Void(LSGID,P_ASG_69_0_0_21_ID,DataGet_REQ);
	Request_Void(LSGID,P_ASG_69_0_0_22_ID,DataGet_REQ);
	Request_Void(LSGID,P_ASG_69_0_0_23_ID,DataGet_REQ);
	Request_Void(LSGID,P_ASG_69_0_0_24_ID,DataGet_REQ);
	Request_Void(LSGID,P_ASG_69_0_0_25_ID,DataGet_REQ);
	Request_Void(LSGID,P_ASG_69_0_0_26_ID,DataGet_REQ);
	Request_Void(LSGID,P_ASG_69_0_0_28_ID,DataGet_REQ);
	Request_Void(LSGID,P_ASG_69_0_0_29_ID,DataGet_REQ);
	Request_Void(LSGID,P_ASG_69_0_0_30_ID,DataGet_REQ);
	Request_Void(LSGID,P_ASG_69_0_0_31_ID,DataGet_REQ);
	Request_Void(LSGID,P_ASG_69_0_0_32_ID,DataGet_REQ);
	Request_Void(LSGID,P_ASG_69_0_0_33_ID,DataGet_REQ);

}

Process_Current_Indication ()
{
   int rxsize;
   int txsize;
   byte temp[BAP_buffer_size];
   char buffer[BAP_buffer_size];
   if(strncmp(Datatype_Text[gBAP_Indication_header[3]], "acknowledge", 4)!=0) 
       writelineEx(gBAP_Trace, 0, "NodeIndex: %d: CurrentIndication %s lsgid:%d fctid:%d indType:%s dataType=%s length=%d",
               NODE_INDEX, SGtype, gBAP_Indication_header[0], gBAP_Indication_header[1], Indicationtype_Text[gBAP_Indication_header[2]], Datatype_Text[gBAP_Indication_header[3]], gBAP_Indication_header[4]);
   else 
       writelineEx(gBAP_Trace, 0, "Internal acknowledge %s-%d fctid:%d indType:%s dataType=%s length=%d",
               SGtype, gBAP_Indication_header[0], gBAP_Indication_header[1], Acknowledgetype_Text[gBAP_Indication_header[5]], Datatype_Text[gBAP_Indication_header[3]], gBAP_Indication_header[4]);
   switch(gBAP_Indication_header[0])  // LSGID
   {
   case LSGID:
       switch(gBAP_Indication_header[1]) // FCTID
       {
    case C_ASG_69_0_0_1_ID: 
        switch(gBAP_Indication_header[3]) // Datentyp 
        {
        case Bap_void:
            switch (gBAP_Indication_header[2]) // IndType
            {
                case Data_IND: // Indicationtyp pruefen
                    //Now every Property with Cache is updated
                    UpdateAllProperties();
                    putValue(C_ASG_69_0_0_1_State, "StatusAll");
                    setControlBackColor(panel_name, "errfield_C_ASG_69_0_0_1_State", MakeRGB(255,255,255));
                    break;
                default:
                    PrintIndicationError("Illegal IndType");
                    break;
            }
            break;
            case Bap_error:
               snprintf(buffer,BAP_buffer_size-1,"Error %02x", gBAP_Indication_header[5]);
               putValue(C_ASG_69_0_0_1_State, buffer);
               setControlBackColor(panel_name, "errfield_C_ASG_69_0_0_1_State", MakeRGB(255,79,79));
               break;
            case Bap_acknowledge:
                break;
            default:
                PrintIndicationError("Illegal DataType");
                break;
        }
    break;
    case P_ASG_69_0_0_2_ID: 
        switch(gBAP_Indication_header[3]) // Datentyp 
        {
        case Bap_byteSequence:
            switch (gBAP_Indication_header[2]) // IndType
            {
                case Reset_IND: // Nur fuer FctId 2 (BAPConfig) relevant
                   putValue(C_ASG_69_0_0_1_State, "");
                   setControlBackColor(panel_name, "errfield_C_ASG_69_0_0_1_State", MakeRGB(255,255,255));
                   initInvalidFields();
                   // Fall through
                case Data_IND: // Indicationtyp pruefen
                    // Daten setzen
                    putValue(BAPCFG_ASG_69_0_0_ProtocolMajor, gBAP_Indication_data[0]);
                    putValue(BAPCFG_ASG_69_0_0_ProtocolMinor, gBAP_Indication_data[1]);
                    putValue(BAPCFG_ASG_69_0_0_LsgClassMajor, gBAP_Indication_data[2]);
                    putValue(BAPCFG_ASG_69_0_0_LsgClassMinor, gBAP_Indication_data[3]);
                    putValue(BAPCFG_ASG_69_0_0_DFMajor, gBAP_Indication_data[4]);
                    putValue(BAPCFG_ASG_69_0_0_DFMinor, gBAP_Indication_data[5]);
                    setControlBackColor(panel_name, "errfield_P_ASG_69_0_0_2", MakeRGB(255,255,255));  
                    setControlBackColor(panel_name, "panel1_edit", MakeRGB(255,255,255));  
                    break;
                default:
                    PrintIndicationError("Illegal IndType");
                    break;
            }
            break;
            case Bap_error:
                putValue(P_ASG_69_0_0_2_ErrCode,  gBAP_Indication_header[5]);
                setControlBackColor(panel_name, "errfield_P_ASG_69_0_0_2", MakeRGB(255,79,79));  
                setControlBackColor(panel_name, "panel1_edit", MakeRGB(220,220,220));  
                break;
            case Bap_acknowledge:
                break;
            default:
                PrintIndicationError("Illegal DataType");
                break;
        }
    break;
    case P_ASG_69_0_0_3_ID: 
       switch(gBAP_Indication_header[3]) // Datentyp
       {
            case Bap_byteSequence:
                switch (gBAP_Indication_header[2]) // IndType
                {
                    case Data_IND: // Indicationtyp pruefen
                    case Reset_IND: // Nur fuer FctId 2 (BAPConfig) relevant
                    {
                        setControlBackColor(panel_name, "errfield_P_ASG_69_0_0_3", MakeRGB(255,255,255));
                        if(isBitForFctSetted(A_ASG_69_0_0_34_ID,gBAP_Indication_data))
                        {
                            putValue(A_ASG_69_0_0_34_FctLstItemEn, 1);
                            setControlForeColor(panel_name, gCheckbox34,MakeRGB(0,240,0));
                            EnableControl(panel_name, gPanel34, 1);
                            EnableControl(panel_name, "panel_A_ASG_69_0_0_34",1);
                            EnableControl(panel_name, "panel_A_ASG_69_0_0_34_Changed",1);
                            EnableControl(panel_name, "panel_A_ASG_69_0_0_34_SetGet",1);
                        }
                        else
                        {
                            putValue(A_ASG_69_0_0_34_FctLstItemEn, 0);
                            setControlForeColor(panel_name, gCheckbox34,MakeRGB(250,0,0));
                            EnableControl(panel_name, gPanel34, 0);
                            EnableControl(panel_name, "panel_A_ASG_69_0_0_34",0);
                            EnableControl(panel_name, "panel_A_ASG_69_0_0_34_Changed",0);
                            EnableControl(panel_name, "panel_A_ASG_69_0_0_34_SetGet",0);
                        }

                        if(isBitForFctSetted(P_ASG_69_0_0_33_ID,gBAP_Indication_data))
                        {
                            putValue(P_ASG_69_0_0_33_FctLstItemEn, 1);
                            setControlForeColor(panel_name, gCheckbox33,MakeRGB(0,240,0));
                            EnableControl(panel_name, gPanel33, 1);
                            EnableControl(panel_name, "panel_P_ASG_69_0_0_33",1);
                        }
                        else
                        {
                            putValue(P_ASG_69_0_0_33_FctLstItemEn, 0);
                            setControlForeColor(panel_name, gCheckbox33,MakeRGB(250,0,0));
                            EnableControl(panel_name, gPanel33, 0);
                            EnableControl(panel_name, "panel_P_ASG_69_0_0_33",0);
                        }

                        if(isBitForFctSetted(P_ASG_69_0_0_32_ID,gBAP_Indication_data))
                        {
                            putValue(P_ASG_69_0_0_32_FctLstItemEn, 1);
                            setControlForeColor(panel_name, gCheckbox32,MakeRGB(0,240,0));
                            EnableControl(panel_name, gPanel32, 1);
                            EnableControl(panel_name, "panel_P_ASG_69_0_0_32",1);
                        }
                        else
                        {
                            putValue(P_ASG_69_0_0_32_FctLstItemEn, 0);
                            setControlForeColor(panel_name, gCheckbox32,MakeRGB(250,0,0));
                            EnableControl(panel_name, gPanel32, 0);
                            EnableControl(panel_name, "panel_P_ASG_69_0_0_32",0);
                        }

                        if(isBitForFctSetted(P_ASG_69_0_0_31_ID,gBAP_Indication_data))
                        {
                            putValue(P_ASG_69_0_0_31_FctLstItemEn, 1);
                            setControlForeColor(panel_name, gCheckbox31,MakeRGB(0,240,0));
                            EnableControl(panel_name, gPanel31, 1);
                            EnableControl(panel_name, "panel_P_ASG_69_0_0_31",1);
                        }
                        else
                        {
                            putValue(P_ASG_69_0_0_31_FctLstItemEn, 0);
                            setControlForeColor(panel_name, gCheckbox31,MakeRGB(250,0,0));
                            EnableControl(panel_name, gPanel31, 0);
                            EnableControl(panel_name, "panel_P_ASG_69_0_0_31",0);
                        }

                        if(isBitForFctSetted(P_ASG_69_0_0_30_ID,gBAP_Indication_data))
                        {
                            putValue(P_ASG_69_0_0_30_FctLstItemEn, 1);
                            setControlForeColor(panel_name, gCheckbox30,MakeRGB(0,240,0));
                            EnableControl(panel_name, gPanel30, 1);
                            EnableControl(panel_name, "panel_P_ASG_69_0_0_30",1);
                        }
                        else
                        {
                            putValue(P_ASG_69_0_0_30_FctLstItemEn, 0);
                            setControlForeColor(panel_name, gCheckbox30,MakeRGB(250,0,0));
                            EnableControl(panel_name, gPanel30, 0);
                            EnableControl(panel_name, "panel_P_ASG_69_0_0_30",0);
                        }

                        if(isBitForFctSetted(P_ASG_69_0_0_19_ID,gBAP_Indication_data))
                        {
                            putValue(P_ASG_69_0_0_19_FctLstItemEn, 1);
                            setControlForeColor(panel_name, gCheckbox19,MakeRGB(0,240,0));
                            EnableControl(panel_name, gPanel19, 1);
                            EnableControl(panel_name, "panel_P_ASG_69_0_0_19",1);
                        }
                        else
                        {
                            putValue(P_ASG_69_0_0_19_FctLstItemEn, 0);
                            setControlForeColor(panel_name, gCheckbox19,MakeRGB(250,0,0));
                            EnableControl(panel_name, gPanel19, 0);
                            EnableControl(panel_name, "panel_P_ASG_69_0_0_19",0);
                        }

                        if(isBitForFctSetted(A_ASG_69_0_0_18_ID,gBAP_Indication_data))
                        {
                            putValue(A_ASG_69_0_0_18_FctLstItemEn, 1);
                            setControlForeColor(panel_name, gCheckbox18,MakeRGB(0,240,0));
                            EnableControl(panel_name, gPanel18, 1);
                            EnableControl(panel_name, "panel_A_ASG_69_0_0_18",1);
                            EnableControl(panel_name, "panel_A_ASG_69_0_0_18_Changed",1);
                            EnableControl(panel_name, "panel_A_ASG_69_0_0_18_SetGet",1);
                        }
                        else
                        {
                            putValue(A_ASG_69_0_0_18_FctLstItemEn, 0);
                            setControlForeColor(panel_name, gCheckbox18,MakeRGB(250,0,0));
                            EnableControl(panel_name, gPanel18, 0);
                            EnableControl(panel_name, "panel_A_ASG_69_0_0_18",0);
                            EnableControl(panel_name, "panel_A_ASG_69_0_0_18_Changed",0);
                            EnableControl(panel_name, "panel_A_ASG_69_0_0_18_SetGet",0);
                        }

                        if(isBitForFctSetted(P_ASG_69_0_0_17_ID,gBAP_Indication_data))
                        {
                            putValue(P_ASG_69_0_0_17_FctLstItemEn, 1);
                            setControlForeColor(panel_name, gCheckbox17,MakeRGB(0,240,0));
                            EnableControl(panel_name, gPanel17, 1);
                            EnableControl(panel_name, "panel_P_ASG_69_0_0_17",1);
                        }
                        else
                        {
                            putValue(P_ASG_69_0_0_17_FctLstItemEn, 0);
                            setControlForeColor(panel_name, gCheckbox17,MakeRGB(250,0,0));
                            EnableControl(panel_name, gPanel17, 0);
                            EnableControl(panel_name, "panel_P_ASG_69_0_0_17",0);
                        }

                        if(isBitForFctSetted(P_ASG_69_0_0_16_ID,gBAP_Indication_data))
                        {
                            putValue(P_ASG_69_0_0_16_FctLstItemEn, 1);
                            setControlForeColor(panel_name, gCheckbox16,MakeRGB(0,240,0));
                            EnableControl(panel_name, gPanel16, 1);
                            EnableControl(panel_name, "panel_P_ASG_69_0_0_16",1);
                        }
                        else
                        {
                            putValue(P_ASG_69_0_0_16_FctLstItemEn, 0);
                            setControlForeColor(panel_name, gCheckbox16,MakeRGB(250,0,0));
                            EnableControl(panel_name, gPanel16, 0);
                            EnableControl(panel_name, "panel_P_ASG_69_0_0_16",0);
                        }

                        if(isBitForFctSetted(P_ASG_69_0_0_15_ID,gBAP_Indication_data))
                        {
                            putValue(P_ASG_69_0_0_15_FctLstItemEn, 1);
                            setControlForeColor(panel_name, gCheckbox15,MakeRGB(0,240,0));
                            EnableControl(panel_name, gPanel15, 1);
                            EnableControl(panel_name, "panel_P_ASG_69_0_0_15",1);
                        }
                        else
                        {
                            putValue(P_ASG_69_0_0_15_FctLstItemEn, 0);
                            setControlForeColor(panel_name, gCheckbox15,MakeRGB(250,0,0));
                            EnableControl(panel_name, gPanel15, 0);
                            EnableControl(panel_name, "panel_P_ASG_69_0_0_15",0);
                        }

                        if(isBitForFctSetted(P_ASG_69_0_0_14_ID,gBAP_Indication_data))
                        {
                            putValue(P_ASG_69_0_0_14_FctLstItemEn, 1);
                            setControlForeColor(panel_name, gCheckbox14,MakeRGB(0,240,0));
                            EnableControl(panel_name, gPanel14, 1);
                            EnableControl(panel_name, "panel_P_ASG_69_0_0_14",1);
                        }
                        else
                        {
                            putValue(P_ASG_69_0_0_14_FctLstItemEn, 0);
                            setControlForeColor(panel_name, gCheckbox14,MakeRGB(250,0,0));
                            EnableControl(panel_name, gPanel14, 0);
                            EnableControl(panel_name, "panel_P_ASG_69_0_0_14",0);
                        }

                        if(isBitForFctSetted(P_ASG_69_0_0_13_ID,gBAP_Indication_data))
                        {
                            putValue(P_ASG_69_0_0_13_FctLstItemEn, 1);
                            setControlForeColor(panel_name, gCheckbox13,MakeRGB(0,240,0));
                            EnableControl(panel_name, gPanel13, 1);
                            EnableControl(panel_name, "panel_P_ASG_69_0_0_13",1);
                        }
                        else
                        {
                            putValue(P_ASG_69_0_0_13_FctLstItemEn, 0);
                            setControlForeColor(panel_name, gCheckbox13,MakeRGB(250,0,0));
                            EnableControl(panel_name, gPanel13, 0);
                            EnableControl(panel_name, "panel_P_ASG_69_0_0_13",0);
                        }

                        if(isBitForFctSetted(P_ASG_69_0_0_29_ID,gBAP_Indication_data))
                        {
                            putValue(P_ASG_69_0_0_29_FctLstItemEn, 1);
                            setControlForeColor(panel_name, gCheckbox29,MakeRGB(0,240,0));
                            EnableControl(panel_name, gPanel29, 1);
                            EnableControl(panel_name, "panel_P_ASG_69_0_0_29",1);
                        }
                        else
                        {
                            putValue(P_ASG_69_0_0_29_FctLstItemEn, 0);
                            setControlForeColor(panel_name, gCheckbox29,MakeRGB(250,0,0));
                            EnableControl(panel_name, gPanel29, 0);
                            EnableControl(panel_name, "panel_P_ASG_69_0_0_29",0);
                        }

                        if(isBitForFctSetted(P_ASG_69_0_0_28_ID,gBAP_Indication_data))
                        {
                            putValue(P_ASG_69_0_0_28_FctLstItemEn, 1);
                            setControlForeColor(panel_name, gCheckbox28,MakeRGB(0,240,0));
                            EnableControl(panel_name, gPanel28, 1);
                            EnableControl(panel_name, "panel_P_ASG_69_0_0_28",1);
                        }
                        else
                        {
                            putValue(P_ASG_69_0_0_28_FctLstItemEn, 0);
                            setControlForeColor(panel_name, gCheckbox28,MakeRGB(250,0,0));
                            EnableControl(panel_name, gPanel28, 0);
                            EnableControl(panel_name, "panel_P_ASG_69_0_0_28",0);
                        }

                        if(isBitForFctSetted(A_ASG_69_0_0_27_ID,gBAP_Indication_data))
                        {
                            putValue(A_ASG_69_0_0_27_FctLstItemEn, 1);
                            setControlForeColor(panel_name, gCheckbox27,MakeRGB(0,240,0));
                            EnableControl(panel_name, gPanel27, 1);
                            EnableControl(panel_name, "panel_A_ASG_69_0_0_27",1);
                            EnableControl(panel_name, "panel_A_ASG_69_0_0_27_Changed",1);
                            EnableControl(panel_name, "panel_A_ASG_69_0_0_27_SetGet",1);
                        }
                        else
                        {
                            putValue(A_ASG_69_0_0_27_FctLstItemEn, 0);
                            setControlForeColor(panel_name, gCheckbox27,MakeRGB(250,0,0));
                            EnableControl(panel_name, gPanel27, 0);
                            EnableControl(panel_name, "panel_A_ASG_69_0_0_27",0);
                            EnableControl(panel_name, "panel_A_ASG_69_0_0_27_Changed",0);
                            EnableControl(panel_name, "panel_A_ASG_69_0_0_27_SetGet",0);
                        }

                        if(isBitForFctSetted(P_ASG_69_0_0_26_ID,gBAP_Indication_data))
                        {
                            putValue(P_ASG_69_0_0_26_FctLstItemEn, 1);
                            setControlForeColor(panel_name, gCheckbox26,MakeRGB(0,240,0));
                            EnableControl(panel_name, gPanel26, 1);
                            EnableControl(panel_name, "panel_P_ASG_69_0_0_26",1);
                        }
                        else
                        {
                            putValue(P_ASG_69_0_0_26_FctLstItemEn, 0);
                            setControlForeColor(panel_name, gCheckbox26,MakeRGB(250,0,0));
                            EnableControl(panel_name, gPanel26, 0);
                            EnableControl(panel_name, "panel_P_ASG_69_0_0_26",0);
                        }

                        if(isBitForFctSetted(P_ASG_69_0_0_4_ID,gBAP_Indication_data))
                        {
                            putValue(P_ASG_69_0_0_4_FctLstItemEn, 1);
                            setControlForeColor(panel_name, gCheckbox4,MakeRGB(0,240,0));
                        }
                        else
                        {
                            putValue(P_ASG_69_0_0_4_FctLstItemEn, 0);
                            setControlForeColor(panel_name, gCheckbox4,MakeRGB(250,0,0));
                        }

                        if(isBitForFctSetted(P_ASG_69_0_0_25_ID,gBAP_Indication_data))
                        {
                            putValue(P_ASG_69_0_0_25_FctLstItemEn, 1);
                            setControlForeColor(panel_name, gCheckbox25,MakeRGB(0,240,0));
                            EnableControl(panel_name, gPanel25, 1);
                            EnableControl(panel_name, "panel_P_ASG_69_0_0_25",1);
                        }
                        else
                        {
                            putValue(P_ASG_69_0_0_25_FctLstItemEn, 0);
                            setControlForeColor(panel_name, gCheckbox25,MakeRGB(250,0,0));
                            EnableControl(panel_name, gPanel25, 0);
                            EnableControl(panel_name, "panel_P_ASG_69_0_0_25",0);
                        }

                        if(isBitForFctSetted(P_ASG_69_0_0_3_ID,gBAP_Indication_data))
                        {
                            putValue(P_ASG_69_0_0_3_FctLstItemEn, 1);
                            setControlForeColor(panel_name, gCheckbox3,MakeRGB(0,240,0));
                        }
                        else
                        {
                            putValue(P_ASG_69_0_0_3_FctLstItemEn, 0);
                            setControlForeColor(panel_name, gCheckbox3,MakeRGB(250,0,0));
                        }

                        if(isBitForFctSetted(P_ASG_69_0_0_24_ID,gBAP_Indication_data))
                        {
                            putValue(P_ASG_69_0_0_24_FctLstItemEn, 1);
                            setControlForeColor(panel_name, gCheckbox24,MakeRGB(0,240,0));
                            EnableControl(panel_name, gPanel24, 1);
                            EnableControl(panel_name, "panel_P_ASG_69_0_0_24",1);
                        }
                        else
                        {
                            putValue(P_ASG_69_0_0_24_FctLstItemEn, 0);
                            setControlForeColor(panel_name, gCheckbox24,MakeRGB(250,0,0));
                            EnableControl(panel_name, gPanel24, 0);
                            EnableControl(panel_name, "panel_P_ASG_69_0_0_24",0);
                        }

                        if(isBitForFctSetted(P_ASG_69_0_0_2_ID,gBAP_Indication_data))
                        {
                            putValue(P_ASG_69_0_0_2_FctLstItemEn, 1);
                            setControlForeColor(panel_name, gCheckbox2,MakeRGB(0,240,0));
                        }
                        else
                        {
                            putValue(P_ASG_69_0_0_2_FctLstItemEn, 0);
                            setControlForeColor(panel_name, gCheckbox2,MakeRGB(250,0,0));
                        }

                        if(isBitForFctSetted(P_ASG_69_0_0_23_ID,gBAP_Indication_data))
                        {
                            putValue(P_ASG_69_0_0_23_FctLstItemEn, 1);
                            setControlForeColor(panel_name, gCheckbox23,MakeRGB(0,240,0));
                            EnableControl(panel_name, gPanel23, 1);
                            EnableControl(panel_name, "panel_P_ASG_69_0_0_23",1);
                        }
                        else
                        {
                            putValue(P_ASG_69_0_0_23_FctLstItemEn, 0);
                            setControlForeColor(panel_name, gCheckbox23,MakeRGB(250,0,0));
                            EnableControl(panel_name, gPanel23, 0);
                            EnableControl(panel_name, "panel_P_ASG_69_0_0_23",0);
                        }

                        if(isBitForFctSetted(C_ASG_69_0_0_1_ID,gBAP_Indication_data))
                        {
                            putValue(C_ASG_69_0_0_1_FctLstItemEn, 1);
                            setControlForeColor(panel_name, gCheckbox1,MakeRGB(0,240,0));
                        }
                        else
                        {
                            putValue(C_ASG_69_0_0_1_FctLstItemEn, 0);
                            setControlForeColor(panel_name, gCheckbox1,MakeRGB(250,0,0));
                        }

                        if(isBitForFctSetted(P_ASG_69_0_0_22_ID,gBAP_Indication_data))
                        {
                            putValue(P_ASG_69_0_0_22_FctLstItemEn, 1);
                            setControlForeColor(panel_name, gCheckbox22,MakeRGB(0,240,0));
                            EnableControl(panel_name, gPanel22, 1);
                            EnableControl(panel_name, "panel_P_ASG_69_0_0_22",1);
                        }
                        else
                        {
                            putValue(P_ASG_69_0_0_22_FctLstItemEn, 0);
                            setControlForeColor(panel_name, gCheckbox22,MakeRGB(250,0,0));
                            EnableControl(panel_name, gPanel22, 0);
                            EnableControl(panel_name, "panel_P_ASG_69_0_0_22",0);
                        }

                        if(isBitForFctSetted(P_ASG_69_0_0_21_ID,gBAP_Indication_data))
                        {
                            putValue(P_ASG_69_0_0_21_FctLstItemEn, 1);
                            setControlForeColor(panel_name, gCheckbox21,MakeRGB(0,240,0));
                            EnableControl(panel_name, gPanel21, 1);
                            EnableControl(panel_name, "panel_P_ASG_69_0_0_21",1);
                        }
                        else
                        {
                            putValue(P_ASG_69_0_0_21_FctLstItemEn, 0);
                            setControlForeColor(panel_name, gCheckbox21,MakeRGB(250,0,0));
                            EnableControl(panel_name, gPanel21, 0);
                            EnableControl(panel_name, "panel_P_ASG_69_0_0_21",0);
                        }

                        if(isBitForFctSetted(P_ASG_69_0_0_20_ID,gBAP_Indication_data))
                        {
                            putValue(P_ASG_69_0_0_20_FctLstItemEn, 1);
                            setControlForeColor(panel_name, gCheckbox20,MakeRGB(0,240,0));
                            EnableControl(panel_name, gPanel20, 1);
                            EnableControl(panel_name, "panel_P_ASG_69_0_0_20",1);
                        }
                        else
                        {
                            putValue(P_ASG_69_0_0_20_FctLstItemEn, 0);
                            setControlForeColor(panel_name, gCheckbox20,MakeRGB(250,0,0));
                            EnableControl(panel_name, gPanel20, 0);
                            EnableControl(panel_name, "panel_P_ASG_69_0_0_20",0);
                        }

                     }
                        break;
                    default:
                      writelineEx(gError_Trace, 0, "NodeIndex: %d: Illegal IndType : lsgid:%d fctid:%d indType:%d",
                           NODE_INDEX, gBAP_Indication_header[0], gBAP_Indication_header[1], gBAP_Indication_header[2]);
                       break;
                  }
                  break;
            case Bap_error:
                putValue(P_ASG_69_0_0_3_ErrCode,  gBAP_Indication_header[5]);
                setControlBackColor(panel_name, "errfield_P_ASG_69_0_0_3", MakeRGB(255,79,79));
                break;
            case Bap_acknowledge:
            	 break;
            default:
                PrintIndicationError("Illegal DataType");
                break;
       }
       break;
    case P_ASG_69_0_0_4_ID: 
        switch(gBAP_Indication_header[3]) // Datentyp 
        {
           case Bap_uint8:
                   switch(gBAP_Indication_header[2]) // IndType
                   {
                       case Data_IND: // Indicationtyp pruefen
                           // Daten setzen
                           putValue(P_ASG_69_0_0_4, gBAP_Indication_header[5]);
                           setControlBackColor(panel_name, "errfield_P_ASG_69_0_0_4", MakeRGB(255,255,255));  
                           setControlBackColor(panel_name, "panel_P_ASG_69_0_0_4", MakeRGB(255,255,255));  
                           break;                              
                       default:
                           PrintIndicationError("Illegal IndType");
                           break;
                   }
                   break;
            case Bap_error:
                putValue(P_ASG_69_0_0_4_ErrCode,  gBAP_Indication_header[5]);
                setControlBackColor(panel_name, "errfield_P_ASG_69_0_0_4", MakeRGB(255,79,79));  
                setControlBackColor(panel_name, "panel_P_ASG_69_0_0_4", MakeRGB(220,220,220));  
                if(gBAP_Indication_header[5]==0x21)
                {
                   putValue(C_ASG_69_0_0_1_State, "");
                   setControlBackColor(panel_name, "errfield_C_ASG_69_0_0_1_State", MakeRGB(255,255,255));
                }
                break;
            case Bap_acknowledge:
                break;
            default:
                PrintIndicationError("Illegal DataType");
                break;
        }
    break;
    case P_ASG_69_0_0_13_ID: 
        switch(gBAP_Indication_header[3]) // Datentyp 
        {
            case Bap_uint8:
                    switch(gBAP_Indication_header[2]) // IndType
                    {
                        case Data_IND: // Indicationtyp pruefen
                            // Daten setzen
                            putValue(P_ASG_69_0_0_13, gBAP_Indication_header[5]);
                            setControlBackColor(panel_name, "errfield_P_ASG_69_0_0_13", MakeRGB(255,255,255));  
                            setControlBackColor(panel_name, "panel_P_ASG_69_0_0_13", MakeRGB(255,255,255));  
                            break;                              
                        default:
                            PrintIndicationError("Illegal IndType");
                            break;
                    }
                    break;
            case Bap_error:
                gP_ASG_69_0_0_13_ErrCode = 0;
                putValue(P_ASG_69_0_0_13_ErrCode,  gBAP_Indication_header[5]);
                setControlBackColor(panel_name, "errfield_P_ASG_69_0_0_13", MakeRGB(255,79,79));  
                setControlBackColor(panel_name, "panel_P_ASG_69_0_0_13", MakeRGB(220,220,220));  
                break;
            case Bap_acknowledge:
                break;
            default:
                    PrintIndicationError("Illegal DataType");
                    break;
        }
    break;
    case P_ASG_69_0_0_14_ID: 
        switch(gBAP_Indication_header[3]) // Datentyp 
        {
            case Bap_byteSequence:
                switch (gBAP_Indication_header[2]) // IndType
                {
                    case Data_IND: // Indicationtyp pruefen
                        // Daten setzen
                        putValue(P_ASG_69_0_0_14, gBAP_Indication_data, gBAP_Indication_header[4]);
                        setControlBackColor(panel_name, "errfield_P_ASG_69_0_0_14", MakeRGB(255,255,255));  
                        setControlBackColor(panel_name, "panel_P_ASG_69_0_0_14", MakeRGB(255,255,255));  
                        break;
                    default:
                        PrintIndicationError("Illegal IndType");
                        break;
                }
                break;
            case Bap_error:
                gP_ASG_69_0_0_14_ErrCode = 0;
                putValue(P_ASG_69_0_0_14_ErrCode,  gBAP_Indication_header[5]);
                setControlBackColor(panel_name, "errfield_P_ASG_69_0_0_14", MakeRGB(255,79,79));  
                setControlBackColor(panel_name, "panel_P_ASG_69_0_0_14", MakeRGB(220,220,220));  
                break;
            case Bap_acknowledge:
                break;
            default:
                PrintIndicationError("Illegal DataType");
                break;
        }
    break;
    case P_ASG_69_0_0_15_ID: 
        switch(gBAP_Indication_header[3]) // Datentyp 
        {
            case Bap_uint8:
                    switch(gBAP_Indication_header[2]) // IndType
                    {
                        case Data_IND: // Indicationtyp pruefen
                            // Daten setzen
                            putValue(P_ASG_69_0_0_15, gBAP_Indication_header[5]);
                            setControlBackColor(panel_name, "errfield_P_ASG_69_0_0_15", MakeRGB(255,255,255));  
                            setControlBackColor(panel_name, "panel_P_ASG_69_0_0_15", MakeRGB(255,255,255));  
                            break;                              
                        default:
                            PrintIndicationError("Illegal IndType");
                            break;
                    }
                    break;
            case Bap_error:
                gP_ASG_69_0_0_15_ErrCode = 0;
                putValue(P_ASG_69_0_0_15_ErrCode,  gBAP_Indication_header[5]);
                setControlBackColor(panel_name, "errfield_P_ASG_69_0_0_15", MakeRGB(255,79,79));  
                setControlBackColor(panel_name, "panel_P_ASG_69_0_0_15", MakeRGB(220,220,220));  
                break;
            case Bap_acknowledge:
                break;
            default:
                    PrintIndicationError("Illegal DataType");
                    break;
        }
    break;
    case P_ASG_69_0_0_16_ID: 
        switch(gBAP_Indication_header[3]) // Datentyp 
        {
            case Bap_byteSequence:
                switch (gBAP_Indication_header[2]) // IndType
                {
                    case Data_IND: // Indicationtyp pruefen
                        // Daten setzen
                        putValue(P_ASG_69_0_0_16, gBAP_Indication_data, gBAP_Indication_header[4]);
                        setControlBackColor(panel_name, "errfield_P_ASG_69_0_0_16", MakeRGB(255,255,255));  
                        setControlBackColor(panel_name, "panel_P_ASG_69_0_0_16", MakeRGB(255,255,255));  
                        break;
                    default:
                        PrintIndicationError("Illegal IndType");
                        break;
                }
                break;
            case Bap_error:
                gP_ASG_69_0_0_16_ErrCode = 0;
                putValue(P_ASG_69_0_0_16_ErrCode,  gBAP_Indication_header[5]);
                setControlBackColor(panel_name, "errfield_P_ASG_69_0_0_16", MakeRGB(255,79,79));  
                setControlBackColor(panel_name, "panel_P_ASG_69_0_0_16", MakeRGB(220,220,220));  
                break;
            case Bap_acknowledge:
                break;
            default:
                PrintIndicationError("Illegal DataType");
                break;
        }
    break;
    case P_ASG_69_0_0_17_ID: 
        switch(gBAP_Indication_header[3]) // Datentyp 
        {
            case Bap_byteSequence:
                switch (gBAP_Indication_header[2]) // IndType
                {
                    case Data_IND: // Indicationtyp pruefen
                        // Daten setzen
                        putValue(P_ASG_69_0_0_17, gBAP_Indication_data, gBAP_Indication_header[4]);
                        setControlBackColor(panel_name, "errfield_P_ASG_69_0_0_17", MakeRGB(255,255,255));  
                        setControlBackColor(panel_name, "panel_P_ASG_69_0_0_17", MakeRGB(255,255,255));  
                        break;
                    default:
                        PrintIndicationError("Illegal IndType");
                        break;
                }
                break;
            case Bap_error:
                gP_ASG_69_0_0_17_ErrCode = 0;
                putValue(P_ASG_69_0_0_17_ErrCode,  gBAP_Indication_header[5]);
                setControlBackColor(panel_name, "errfield_P_ASG_69_0_0_17", MakeRGB(255,79,79));  
                setControlBackColor(panel_name, "panel_P_ASG_69_0_0_17", MakeRGB(220,220,220));  
                break;
            case Bap_acknowledge:
                break;
            default:
                PrintIndicationError("Illegal DataType");
                break;
        }
    break;
    case A_ASG_69_0_0_18_ID: 
        switch(gBAP_Indication_header[3]) // Datentyp 
        {
            case Bap_byteSequence:
                switch (gBAP_Indication_header[2]) // IndType
                {
                    case Data_IND: // Indicationtyp pruefen
                        // Daten setzen
                        //putValue(A_ASG_69_0_0_18, gBAP_Indication_data, gBAP_Indication_header[4]);
                        A_ASG_69_0_0_18_DataInd();
                        setControlBackColor(panel_name, "errfield_A_ASG_69_0_0_18", MakeRGB(255,255,255));  
                        setControlBackColor(panel_name, "panel_A_ASG_69_0_0_18", MakeRGB(255,255,255));  
                        break;
                    case Changed_IND: // Indicationtyp pruefen
                        // Daten setzen
                        //putValue(A_ASG_69_0_0_18_Changed, gBAP_Indication_data, gBAP_Indication_header[4]);
                        A_ASG_69_0_0_18_ChangedInd();
                        setControlBackColor(panel_name, "errfield_A_ASG_69_0_0_18", MakeRGB(255,255,255));  
                        setControlBackColor(panel_name, "panel_A_ASG_69_0_0_18_Changed", MakeRGB(255,255,255));  
                        break;
                    default:
                        PrintIndicationError("Illegal IndType");
                        break;
                }
                break;
            case Bap_error:
                gA_ASG_69_0_0_18_ErrCode = 0;
                putValue(A_ASG_69_0_0_18_ErrCode,  gBAP_Indication_header[5]);
                setControlBackColor(panel_name, "errfield_A_ASG_69_0_0_18", MakeRGB(255,79,79));  
                setControlBackColor(panel_name, "panel_A_ASG_69_0_0_18", MakeRGB(220,220,220));  
                setControlBackColor(panel_name, "panel_A_ASG_69_0_0_18_Changed", MakeRGB(220,220,220));  
                break;
            case Bap_acknowledge:
                break;
            default:
                    PrintIndicationError("Illegal DataType");
                    break;
        }
    break;
    case P_ASG_69_0_0_19_ID: 
        switch(gBAP_Indication_header[3]) // Datentyp 
        {
            case Bap_byteSequence:
                switch (gBAP_Indication_header[2]) // IndType
                {
                    case Data_IND: // Indicationtyp pruefen
                        // Daten setzen
                        putValue(P_ASG_69_0_0_19, gBAP_Indication_data, gBAP_Indication_header[4]);
                        setControlBackColor(panel_name, "errfield_P_ASG_69_0_0_19", MakeRGB(255,255,255));  
                        setControlBackColor(panel_name, "panel_P_ASG_69_0_0_19", MakeRGB(255,255,255));  
                        break;
                    default:
                        PrintIndicationError("Illegal IndType");
                        break;
                }
                break;
            case Bap_error:
                gP_ASG_69_0_0_19_ErrCode = 0;
                putValue(P_ASG_69_0_0_19_ErrCode,  gBAP_Indication_header[5]);
                setControlBackColor(panel_name, "errfield_P_ASG_69_0_0_19", MakeRGB(255,79,79));  
                setControlBackColor(panel_name, "panel_P_ASG_69_0_0_19", MakeRGB(220,220,220));  
                break;
            case Bap_acknowledge:
                break;
            default:
                PrintIndicationError("Illegal DataType");
                break;
        }
    break;
    case P_ASG_69_0_0_20_ID: 
        switch(gBAP_Indication_header[3]) // Datentyp 
        {
            case Bap_byteSequence:
                switch (gBAP_Indication_header[2]) // IndType
                {
                    case Data_IND: // Indicationtyp pruefen
                        // Daten setzen
                        putValue(P_ASG_69_0_0_20, gBAP_Indication_data, gBAP_Indication_header[4]);
                        setControlBackColor(panel_name, "errfield_P_ASG_69_0_0_20", MakeRGB(255,255,255));  
                        setControlBackColor(panel_name, "panel_P_ASG_69_0_0_20", MakeRGB(255,255,255));  
                        break;
                    default:
                        PrintIndicationError("Illegal IndType");
                        break;
                }
                break;
            case Bap_error:
                gP_ASG_69_0_0_20_ErrCode = 0;
                putValue(P_ASG_69_0_0_20_ErrCode,  gBAP_Indication_header[5]);
                setControlBackColor(panel_name, "errfield_P_ASG_69_0_0_20", MakeRGB(255,79,79));  
                setControlBackColor(panel_name, "panel_P_ASG_69_0_0_20", MakeRGB(220,220,220));  
                break;
            case Bap_acknowledge:
                break;
            default:
                PrintIndicationError("Illegal DataType");
                break;
        }
    break;
    case P_ASG_69_0_0_21_ID: 
        switch(gBAP_Indication_header[3]) // Datentyp 
        {
            case Bap_byteSequence:
                switch (gBAP_Indication_header[2]) // IndType
                {
                    case Data_IND: // Indicationtyp pruefen
                        // Daten setzen
                        putValue(P_ASG_69_0_0_21, gBAP_Indication_data, gBAP_Indication_header[4]);
                        setControlBackColor(panel_name, "errfield_P_ASG_69_0_0_21", MakeRGB(255,255,255));  
                        setControlBackColor(panel_name, "panel_P_ASG_69_0_0_21", MakeRGB(255,255,255));  
                        break;
                    default:
                        PrintIndicationError("Illegal IndType");
                        break;
                }
                break;
            case Bap_error:
                gP_ASG_69_0_0_21_ErrCode = 0;
                putValue(P_ASG_69_0_0_21_ErrCode,  gBAP_Indication_header[5]);
                setControlBackColor(panel_name, "errfield_P_ASG_69_0_0_21", MakeRGB(255,79,79));  
                setControlBackColor(panel_name, "panel_P_ASG_69_0_0_21", MakeRGB(220,220,220));  
                break;
            case Bap_acknowledge:
                break;
            default:
                PrintIndicationError("Illegal DataType");
                break;
        }
    break;
    case P_ASG_69_0_0_22_ID: 
        switch(gBAP_Indication_header[3]) // Datentyp 
        {
            case Bap_byteSequence:
                switch (gBAP_Indication_header[2]) // IndType
                {
                    case Data_IND: // Indicationtyp pruefen
                        // Daten setzen
                        putValue(P_ASG_69_0_0_22, gBAP_Indication_data, gBAP_Indication_header[4]);
                        setControlBackColor(panel_name, "errfield_P_ASG_69_0_0_22", MakeRGB(255,255,255));  
                        setControlBackColor(panel_name, "panel_P_ASG_69_0_0_22", MakeRGB(255,255,255));  
                        break;
                    default:
                        PrintIndicationError("Illegal IndType");
                        break;
                }
                break;
            case Bap_error:
                gP_ASG_69_0_0_22_ErrCode = 0;
                putValue(P_ASG_69_0_0_22_ErrCode,  gBAP_Indication_header[5]);
                setControlBackColor(panel_name, "errfield_P_ASG_69_0_0_22", MakeRGB(255,79,79));  
                setControlBackColor(panel_name, "panel_P_ASG_69_0_0_22", MakeRGB(220,220,220));  
                break;
            case Bap_acknowledge:
                break;
            default:
                PrintIndicationError("Illegal DataType");
                break;
        }
    break;
    case P_ASG_69_0_0_23_ID: 
        switch(gBAP_Indication_header[3]) // Datentyp 
        {
            case Bap_byteSequence:
                switch (gBAP_Indication_header[2]) // IndType
                {
                    case Data_IND: // Indicationtyp pruefen
                        // Daten setzen
                        putValue(P_ASG_69_0_0_23, gBAP_Indication_data, gBAP_Indication_header[4]);
                        setControlBackColor(panel_name, "errfield_P_ASG_69_0_0_23", MakeRGB(255,255,255));  
                        setControlBackColor(panel_name, "panel_P_ASG_69_0_0_23", MakeRGB(255,255,255));  
                        break;
                    default:
                        PrintIndicationError("Illegal IndType");
                        break;
                }
                break;
            case Bap_error:
                gP_ASG_69_0_0_23_ErrCode = 0;
                putValue(P_ASG_69_0_0_23_ErrCode,  gBAP_Indication_header[5]);
                setControlBackColor(panel_name, "errfield_P_ASG_69_0_0_23", MakeRGB(255,79,79));  
                setControlBackColor(panel_name, "panel_P_ASG_69_0_0_23", MakeRGB(220,220,220));  
                break;
            case Bap_acknowledge:
                break;
            default:
                PrintIndicationError("Illegal DataType");
                break;
        }
    break;
    case P_ASG_69_0_0_24_ID: 
        switch(gBAP_Indication_header[3]) // Datentyp 
        {
            case Bap_byteSequence:
                switch (gBAP_Indication_header[2]) // IndType
                {
                    case Data_IND: // Indicationtyp pruefen
                        // Daten setzen
                        putValue(P_ASG_69_0_0_24, gBAP_Indication_data, gBAP_Indication_header[4]);
                        setControlBackColor(panel_name, "errfield_P_ASG_69_0_0_24", MakeRGB(255,255,255));  
                        setControlBackColor(panel_name, "panel_P_ASG_69_0_0_24", MakeRGB(255,255,255));  
                        break;
                    default:
                        PrintIndicationError("Illegal IndType");
                        break;
                }
                break;
            case Bap_error:
                gP_ASG_69_0_0_24_ErrCode = 0;
                putValue(P_ASG_69_0_0_24_ErrCode,  gBAP_Indication_header[5]);
                setControlBackColor(panel_name, "errfield_P_ASG_69_0_0_24", MakeRGB(255,79,79));  
                setControlBackColor(panel_name, "panel_P_ASG_69_0_0_24", MakeRGB(220,220,220));  
                break;
            case Bap_acknowledge:
                break;
            default:
                PrintIndicationError("Illegal DataType");
                break;
        }
    break;
    case P_ASG_69_0_0_25_ID: 
        switch(gBAP_Indication_header[3]) // Datentyp 
        {
            case Bap_byteSequence:
                switch (gBAP_Indication_header[2]) // IndType
                {
                    case Data_IND: // Indicationtyp pruefen
                        // Daten setzen
                        putValue(P_ASG_69_0_0_25, gBAP_Indication_data, gBAP_Indication_header[4]);
                        setControlBackColor(panel_name, "errfield_P_ASG_69_0_0_25", MakeRGB(255,255,255));  
                        setControlBackColor(panel_name, "panel_P_ASG_69_0_0_25", MakeRGB(255,255,255));  
                        break;
                    default:
                        PrintIndicationError("Illegal IndType");
                        break;
                }
                break;
            case Bap_error:
                gP_ASG_69_0_0_25_ErrCode = 0;
                putValue(P_ASG_69_0_0_25_ErrCode,  gBAP_Indication_header[5]);
                setControlBackColor(panel_name, "errfield_P_ASG_69_0_0_25", MakeRGB(255,79,79));  
                setControlBackColor(panel_name, "panel_P_ASG_69_0_0_25", MakeRGB(220,220,220));  
                break;
            case Bap_acknowledge:
                break;
            default:
                PrintIndicationError("Illegal DataType");
                break;
        }
    break;
    case P_ASG_69_0_0_26_ID: 
        switch(gBAP_Indication_header[3]) // Datentyp 
        {
            case Bap_uint8:
                    switch(gBAP_Indication_header[2]) // IndType
                    {
                        case Data_IND: // Indicationtyp pruefen
                            // Daten setzen
                            putValue(P_ASG_69_0_0_26, gBAP_Indication_header[5]);
                            setControlBackColor(panel_name, "errfield_P_ASG_69_0_0_26", MakeRGB(255,255,255));  
                            setControlBackColor(panel_name, "panel_P_ASG_69_0_0_26", MakeRGB(255,255,255));  
                            break;                              
                        default:
                            PrintIndicationError("Illegal IndType");
                            break;
                    }
                    break;
            case Bap_error:
                gP_ASG_69_0_0_26_ErrCode = 0;
                putValue(P_ASG_69_0_0_26_ErrCode,  gBAP_Indication_header[5]);
                setControlBackColor(panel_name, "errfield_P_ASG_69_0_0_26", MakeRGB(255,79,79));  
                setControlBackColor(panel_name, "panel_P_ASG_69_0_0_26", MakeRGB(220,220,220));  
                break;
            case Bap_acknowledge:
                break;
            default:
                    PrintIndicationError("Illegal DataType");
                    break;
        }
    break;
    case A_ASG_69_0_0_27_ID: 
        switch(gBAP_Indication_header[3]) // Datentyp 
        {
            case Bap_byteSequence:
                switch (gBAP_Indication_header[2]) // IndType
                {
                    case Data_IND: // Indicationtyp pruefen
                        // Daten setzen
                        //putValue(A_ASG_69_0_0_27, gBAP_Indication_data, gBAP_Indication_header[4]);
                        A_ASG_69_0_0_27_DataInd();
                        setControlBackColor(panel_name, "errfield_A_ASG_69_0_0_27", MakeRGB(255,255,255));  
                        setControlBackColor(panel_name, "panel_A_ASG_69_0_0_27", MakeRGB(255,255,255));  
                        break;
                    case Changed_IND: // Indicationtyp pruefen
                        // Daten setzen
                        //putValue(A_ASG_69_0_0_27_Changed, gBAP_Indication_data, gBAP_Indication_header[4]);
                        A_ASG_69_0_0_27_ChangedInd();
                        setControlBackColor(panel_name, "errfield_A_ASG_69_0_0_27", MakeRGB(255,255,255));  
                        setControlBackColor(panel_name, "panel_A_ASG_69_0_0_27_Changed", MakeRGB(255,255,255));  
                        break;
                    default:
                        PrintIndicationError("Illegal IndType");
                        break;
                }
                break;
            case Bap_error:
                gA_ASG_69_0_0_27_ErrCode = 0;
                putValue(A_ASG_69_0_0_27_ErrCode,  gBAP_Indication_header[5]);
                setControlBackColor(panel_name, "errfield_A_ASG_69_0_0_27", MakeRGB(255,79,79));  
                setControlBackColor(panel_name, "panel_A_ASG_69_0_0_27", MakeRGB(220,220,220));  
                setControlBackColor(panel_name, "panel_A_ASG_69_0_0_27_Changed", MakeRGB(220,220,220));  
                break;
            case Bap_acknowledge:
                break;
            default:
                    PrintIndicationError("Illegal DataType");
                    break;
        }
    break;
    case P_ASG_69_0_0_28_ID: 
        switch(gBAP_Indication_header[3]) // Datentyp 
        {
            case Bap_byteSequence:
                switch (gBAP_Indication_header[2]) // IndType
                {
                    case Data_IND: // Indicationtyp pruefen
                        // Daten setzen
                        putValue(P_ASG_69_0_0_28, gBAP_Indication_data, gBAP_Indication_header[4]);
                        setControlBackColor(panel_name, "errfield_P_ASG_69_0_0_28", MakeRGB(255,255,255));  
                        setControlBackColor(panel_name, "panel_P_ASG_69_0_0_28", MakeRGB(255,255,255));  
                        break;
                    default:
                        PrintIndicationError("Illegal IndType");
                        break;
                }
                break;
            case Bap_error:
                gP_ASG_69_0_0_28_ErrCode = 0;
                putValue(P_ASG_69_0_0_28_ErrCode,  gBAP_Indication_header[5]);
                setControlBackColor(panel_name, "errfield_P_ASG_69_0_0_28", MakeRGB(255,79,79));  
                setControlBackColor(panel_name, "panel_P_ASG_69_0_0_28", MakeRGB(220,220,220));  
                break;
            case Bap_acknowledge:
                break;
            default:
                PrintIndicationError("Illegal DataType");
                break;
        }
    break;
    case P_ASG_69_0_0_29_ID: 
        switch(gBAP_Indication_header[3]) // Datentyp 
        {
            case Bap_byteSequence:
                switch (gBAP_Indication_header[2]) // IndType
                {
                    case Data_IND: // Indicationtyp pruefen
                        // Daten setzen
                        putValue(P_ASG_69_0_0_29, gBAP_Indication_data, gBAP_Indication_header[4]);
                        setControlBackColor(panel_name, "errfield_P_ASG_69_0_0_29", MakeRGB(255,255,255));  
                        setControlBackColor(panel_name, "panel_P_ASG_69_0_0_29", MakeRGB(255,255,255));  
                        break;
                    default:
                        PrintIndicationError("Illegal IndType");
                        break;
                }
                break;
            case Bap_error:
                gP_ASG_69_0_0_29_ErrCode = 0;
                putValue(P_ASG_69_0_0_29_ErrCode,  gBAP_Indication_header[5]);
                setControlBackColor(panel_name, "errfield_P_ASG_69_0_0_29", MakeRGB(255,79,79));  
                setControlBackColor(panel_name, "panel_P_ASG_69_0_0_29", MakeRGB(220,220,220));  
                break;
            case Bap_acknowledge:
                break;
            default:
                PrintIndicationError("Illegal DataType");
                break;
        }
    break;
    case P_ASG_69_0_0_30_ID: 
        switch(gBAP_Indication_header[3]) // Datentyp 
        {
            case Bap_byteSequence:
                switch (gBAP_Indication_header[2]) // IndType
                {
                    case Data_IND: // Indicationtyp pruefen
                        // Daten setzen
                        putValue(P_ASG_69_0_0_30, gBAP_Indication_data, gBAP_Indication_header[4]);
                        setControlBackColor(panel_name, "errfield_P_ASG_69_0_0_30", MakeRGB(255,255,255));  
                        setControlBackColor(panel_name, "panel_P_ASG_69_0_0_30", MakeRGB(255,255,255));  
                        break;
                    default:
                        PrintIndicationError("Illegal IndType");
                        break;
                }
                break;
            case Bap_error:
                gP_ASG_69_0_0_30_ErrCode = 0;
                putValue(P_ASG_69_0_0_30_ErrCode,  gBAP_Indication_header[5]);
                setControlBackColor(panel_name, "errfield_P_ASG_69_0_0_30", MakeRGB(255,79,79));  
                setControlBackColor(panel_name, "panel_P_ASG_69_0_0_30", MakeRGB(220,220,220));  
                break;
            case Bap_acknowledge:
                break;
            default:
                PrintIndicationError("Illegal DataType");
                break;
        }
    break;
    case P_ASG_69_0_0_31_ID: 
        switch(gBAP_Indication_header[3]) // Datentyp 
        {
            case Bap_byteSequence:
                switch (gBAP_Indication_header[2]) // IndType
                {
                    case Data_IND: // Indicationtyp pruefen
                        // Daten setzen
                        putValue(P_ASG_69_0_0_31, gBAP_Indication_data, gBAP_Indication_header[4]);
                        setControlBackColor(panel_name, "errfield_P_ASG_69_0_0_31", MakeRGB(255,255,255));  
                        setControlBackColor(panel_name, "panel_P_ASG_69_0_0_31", MakeRGB(255,255,255));  
                        break;
                    default:
                        PrintIndicationError("Illegal IndType");
                        break;
                }
                break;
            case Bap_error:
                gP_ASG_69_0_0_31_ErrCode = 0;
                putValue(P_ASG_69_0_0_31_ErrCode,  gBAP_Indication_header[5]);
                setControlBackColor(panel_name, "errfield_P_ASG_69_0_0_31", MakeRGB(255,79,79));  
                setControlBackColor(panel_name, "panel_P_ASG_69_0_0_31", MakeRGB(220,220,220));  
                break;
            case Bap_acknowledge:
                break;
            default:
                PrintIndicationError("Illegal DataType");
                break;
        }
    break;
    case P_ASG_69_0_0_32_ID: 
        switch(gBAP_Indication_header[3]) // Datentyp 
        {
            case Bap_byteSequence:
                switch (gBAP_Indication_header[2]) // IndType
                {
                    case Data_IND: // Indicationtyp pruefen
                        // Daten setzen
                        putValue(P_ASG_69_0_0_32, gBAP_Indication_data, gBAP_Indication_header[4]);
                        setControlBackColor(panel_name, "errfield_P_ASG_69_0_0_32", MakeRGB(255,255,255));  
                        setControlBackColor(panel_name, "panel_P_ASG_69_0_0_32", MakeRGB(255,255,255));  
                        break;
                    default:
                        PrintIndicationError("Illegal IndType");
                        break;
                }
                break;
            case Bap_error:
                gP_ASG_69_0_0_32_ErrCode = 0;
                putValue(P_ASG_69_0_0_32_ErrCode,  gBAP_Indication_header[5]);
                setControlBackColor(panel_name, "errfield_P_ASG_69_0_0_32", MakeRGB(255,79,79));  
                setControlBackColor(panel_name, "panel_P_ASG_69_0_0_32", MakeRGB(220,220,220));  
                break;
            case Bap_acknowledge:
                break;
            default:
                PrintIndicationError("Illegal DataType");
                break;
        }
    break;
    case P_ASG_69_0_0_33_ID: 
        switch(gBAP_Indication_header[3]) // Datentyp 
        {
            case Bap_byteSequence:
                switch (gBAP_Indication_header[2]) // IndType
                {
                    case Data_IND: // Indicationtyp pruefen
                        // Daten setzen
                        putValue(P_ASG_69_0_0_33, gBAP_Indication_data, gBAP_Indication_header[4]);
                        setControlBackColor(panel_name, "errfield_P_ASG_69_0_0_33", MakeRGB(255,255,255));  
                        setControlBackColor(panel_name, "panel_P_ASG_69_0_0_33", MakeRGB(255,255,255));  
                        break;
                    default:
                        PrintIndicationError("Illegal IndType");
                        break;
                }
                break;
            case Bap_error:
                gP_ASG_69_0_0_33_ErrCode = 0;
                putValue(P_ASG_69_0_0_33_ErrCode,  gBAP_Indication_header[5]);
                setControlBackColor(panel_name, "errfield_P_ASG_69_0_0_33", MakeRGB(255,79,79));  
                setControlBackColor(panel_name, "panel_P_ASG_69_0_0_33", MakeRGB(220,220,220));  
                break;
            case Bap_acknowledge:
                break;
            default:
                PrintIndicationError("Illegal DataType");
                break;
        }
    break;
    case A_ASG_69_0_0_34_ID: 
        switch(gBAP_Indication_header[3]) // Datentyp 
        {
            case Bap_byteSequence:
                switch (gBAP_Indication_header[2]) // IndType
                {
                    case Data_IND: // Indicationtyp pruefen
                        // Daten setzen
                        //putValue(A_ASG_69_0_0_34, gBAP_Indication_data, gBAP_Indication_header[4]);
                        A_ASG_69_0_0_34_DataInd();
                        setControlBackColor(panel_name, "errfield_A_ASG_69_0_0_34", MakeRGB(255,255,255));  
                        setControlBackColor(panel_name, "panel_A_ASG_69_0_0_34", MakeRGB(255,255,255));  
                        break;
                    case Changed_IND: // Indicationtyp pruefen
                        // Daten setzen
                        //putValue(A_ASG_69_0_0_34_Changed, gBAP_Indication_data, gBAP_Indication_header[4]);
                        A_ASG_69_0_0_34_ChangedInd();
                        setControlBackColor(panel_name, "errfield_A_ASG_69_0_0_34", MakeRGB(255,255,255));  
                        setControlBackColor(panel_name, "panel_A_ASG_69_0_0_34_Changed", MakeRGB(255,255,255));  
                        break;
                    default:
                        PrintIndicationError("Illegal IndType");
                        break;
                }
                break;
            case Bap_error:
                gA_ASG_69_0_0_34_ErrCode = 0;
                putValue(A_ASG_69_0_0_34_ErrCode,  gBAP_Indication_header[5]);
                setControlBackColor(panel_name, "errfield_A_ASG_69_0_0_34", MakeRGB(255,79,79));  
                setControlBackColor(panel_name, "panel_A_ASG_69_0_0_34", MakeRGB(220,220,220));  
                setControlBackColor(panel_name, "panel_A_ASG_69_0_0_34_Changed", MakeRGB(220,220,220));  
                break;
            case Bap_acknowledge:
                break;
            default:
                    PrintIndicationError("Illegal DataType");
                    break;
        }
    break;
       default:
           writelineEx(gError_Trace, 0, "NodeIndex: %d: Illegal Fct: lsgid:%d fctid:%d indType:%d",
           NODE_INDEX, gBAP_Indication_header[0], gBAP_Indication_header[1], gBAP_Indication_header[2]);
           break;
       }
       break;
   default:
       writelineEx(gError_Trace, 0, "NodeIndex: %d: Illegal LSGID: lsgid:%d fctid:%d indType:%s", NODE_INDEX, gBAP_Indication_header[0], gBAP_Indication_header[1], Indicationtype_Text[gBAP_Indication_header[2]]);
       break;
   }
}


on message BAP_DisplayConfig_FSG_01
{
   int i, temp;
   byte RX_Data[64];            // received CAN-DATA
   dword RX_Header[4];         // received CAN-Header
   if(gSG_PowerOnOff==Power_on){
       if(this.msgChannel == 1){
           RX_Header[0]=1; /*BusType: 1=Can, 2=Lin, 3=Flexray, 4=Ethernet*/
           RX_Header[1]=1;
           RX_Header[2]=this.DataLength; // received length
           RX_Header[3]=this.ID;
           for (i=0; i<this.DataLength; i++) {
               RX_Data[i]=this.byte(i);
           }
           temp=BAP180_SetRxData(NODE_INDEX, RX_Header, RX_Data);
       }
   }
}



intertelegram_err(long fctId)
{
    long data[4];
    data[0]=LSGID;
    data[1]=fctId;
    data[2]=1;
    data[3]=940;
    ChangeConfig(0x0020,data);
}

sequence_err(long fctId, long size)
{
    long data[5];
    long lastSeg;

    lastSeg = size-5;

    data[0]=LSGID;
    data[1]=fctId;
    data[2]=lastSeg/7+1;
    data[3]=1;
    data[4]=(lastSeg/7+4) & 15;
    ChangeConfig(0x0021,data);
}

intertelegram_err_off(long fctId)
{
    long data[4];
    data[0]=LSGID;
    data[1]=fctId;
    data[2]=5000;
    data[3]=0;
    ChangeConfig(0x0020,data);
}

sequence_err_off(long fctId)
{
    long data[5];

    data[0]=LSGID;
    data[1]=fctId;
    data[2]=5000;
    data[3]=0;
    data[4]=0;
    ChangeConfig(0x0021,data);
}

// START OF BUS CONFIG PANEL CAPL

// ETHERNET AND FLEXRAY NOT ENABLED! (ENABLE_BUS_SELECTOR_PANEL_TOKEN)

// ETHERNET AND FLEXRAY NOT ENABLED! (ENABLE_CAN_FRAME_TOKEN)

// ETHERNET AND FLEXRAY NOT ENABLED! (ENABLE_FR_FRAME_TOKEN)

// ETHERNET AND FLEXRAY NOT ENABLED! (ENABLE_ETHERNET_FRAME_TOKEN)

// ETHERNET AND FLEXRAY NOT ENABLED! (ON_ENVVAR_BUSTYPE_TOKEN)

// ETHERNET NOT ENABLED! (ON_UDP_RECEIVE_FROM_TOKEN)

// ETHERNET NOT ENABLED!

on envVar ON_OFF_ASG69_0
{
   BapOnOff(getvalue(this));
   gSG_PowerOnOff=getvalue(ON_OFF_ASG69_0);
}
on envVar C_ASG_69_0_0_1GetAll_BTN
{
 if (C_ASG_69_0_0_1GetAll_BTN_already_pressed == 0)
  {
     C_ASG_69_0_0_1GetAll_BTN_already_pressed = 1;
     Request_Void(LSGID, C_ASG_69_0_0_1_ID, DataGet_REQ); 
     putValue(C_ASG_69_0_0_1_State, "GetAll");
     setControlBackColor(panel_name, "errfield_C_ASG_69_0_0_1_State", MakeRGB(255,255,255));
 }
 else
 {
     C_ASG_69_0_0_1GetAll_BTN_already_pressed = 0;
 }
}
on envVar P_ASG_69_0_0_2Get_BTN
{
 if (P_ASG_69_0_0_2Get_BTN_already_pressed == 0)
  {
       putValue(P_ASG_69_0_0_2_ErrCode,0);
       SetControlBackColor(panel_name,"errField_P_ASG_69_0_0_2",MakeRGB(255,255,255));
       P_ASG_69_0_0_2Get_BTN_already_pressed = 1;
 }
 else
 {
       Request_Void(LSGID, P_ASG_69_0_0_2_ID, DataGet_REQ); 
       P_ASG_69_0_0_2Get_BTN_already_pressed = 0;
 }
}
on envVar P_ASG_69_0_0_3Get_BTN
{
 if (P_ASG_69_0_0_3Get_BTN_already_pressed == 0)
  {
       putValue(P_ASG_69_0_0_3_ErrCode,0);
       SetControlBackColor(panel_name,"errField_P_ASG_69_0_0_3",MakeRGB(255,255,255));
       P_ASG_69_0_0_3Get_BTN_already_pressed = 1;
 }
 else
 {
       Request_Void(LSGID, P_ASG_69_0_0_3_ID, DataGet_REQ); 
       P_ASG_69_0_0_3Get_BTN_already_pressed = 0;
 }
}
on envVar P_ASG_69_0_0_4Get_BTN
{
 if (P_ASG_69_0_0_4Get_BTN_already_pressed == 0)
  {
       putValue(P_ASG_69_0_0_4_ErrCode,0);
       SetControlBackColor(panel_name,"errField_P_ASG_69_0_0_4",MakeRGB(255,255,255));
       P_ASG_69_0_0_4Get_BTN_already_pressed = 1;
 }
 else
 {
       Request_Void(LSGID, P_ASG_69_0_0_4_ID, DataGet_REQ); 
       P_ASG_69_0_0_4Get_BTN_already_pressed = 0;
 }
}
on envVar P_ASG_69_0_0_13Get_BTN
{
 if (P_ASG_69_0_0_13Get_BTN_already_pressed == 0)
  {
       putValue(P_ASG_69_0_0_13_ErrCode,0);
       SetControlBackColor(panel_name,"errField_P_ASG_69_0_0_13",MakeRGB(255,255,255));
       P_ASG_69_0_0_13Get_BTN_already_pressed = 1;
 }
 else
 {
       Request_Void(LSGID, P_ASG_69_0_0_13_ID, DataGet_REQ); 
       P_ASG_69_0_0_13Get_BTN_already_pressed = 0;
 }
}
on envVar P_ASG_69_0_0_13SetGet_BTN
{
    if (P_ASG_69_0_0_13SetGet_BTN_already_pressed == 0)
    {
       putValue(P_ASG_69_0_0_13_ErrCode,0);
       SetControlBackColor(panel_name,"errField_P_ASG_69_0_0_13",MakeRGB(255,255,255));
       P_ASG_69_0_0_13SetGet_BTN_already_pressed = 1;
    }
    else
    {
       Request_Int8(LSGID, P_ASG_69_0_0_13_ID, DataSetGet_REQ, getValue(P_ASG_69_0_0_13));
       P_ASG_69_0_0_13SetGet_BTN_already_pressed = 0;
    }
}
on envVar P_ASG_69_0_0_13 // bus value of FSG_Control (13).
{
	// opcodes: Error-Status
	byte param1; // Controlcode
	// DATATYPE_UINTXX
	param1 = getValue(P_ASG_69_0_0_13);
	putValue(P_ASG_69_0_0_13_1, param1);
}

on envVar P_ASG_69_0_0_13_1_0
{
	byte bitval;
	//thisval steht hier fuer den bitfield-wert, 
	//aus Generierungsgruenden hier keine einheitliche Bezeichnung moeglich.
	byte thisval; // Controlcode
	bitval= getValue(this);
	thisval = getValue(P_ASG_69_0_0_13_1);
	thisval = thisval&~(1<<0)|(bitval<<0);
	putValue(P_ASG_69_0_0_13_1,thisval);
}

on envVar P_ASG_69_0_0_13_1 // FSG_Control.Controlcode
{
	byte superval;

	//Update Childvalue (BitField)
	byte mask=0x01;
	int i = 0;
	byte thisval; // Controlcode
	thisval = getValue(this);
	if(thisval&(mask<<0))
		putValue(P_ASG_69_0_0_13_1_0, 1);
	else
		putValue(P_ASG_69_0_0_13_1_0, 0);

    // Update superval
	superval = getValue(P_ASG_69_0_0_13);
	superval = thisval;
	putValue(P_ASG_69_0_0_13,superval);
}

on envVar P_ASG_69_0_0_14Get_BTN
{
 if (P_ASG_69_0_0_14Get_BTN_already_pressed == 0)
  {
       putValue(P_ASG_69_0_0_14_ErrCode,0);
       SetControlBackColor(panel_name,"errField_P_ASG_69_0_0_14",MakeRGB(255,255,255));
       P_ASG_69_0_0_14Get_BTN_already_pressed = 1;
 }
 else
 {
       Request_Void(LSGID, P_ASG_69_0_0_14_ID, DataGet_REQ); 
       P_ASG_69_0_0_14Get_BTN_already_pressed = 0;
 }
}
on envVar P_ASG_69_0_0_14 // bus value of FSG_Setup (14).
{
	// opcodes: Error-Status
	byte param1; // MaxVolume
	byte param2; // FunctionSupport
	byte param3; // AdditionalInstrumentSetup
	byte param4; // PopupSetup
	byte param5; // AdditionalInstrument2Setup
	byte param6; // Extension1
	// DATATYPE_BYTESEQUENCE / DATATYPE_FIXEDBYTESEQUENCE
	int i;
	byte superval[6];
	int currentPos;
	currentPos = 0;
	for( i = 0; i < 6; i++ ) {
		superval[i] = 0;
	}
	getValue(P_ASG_69_0_0_14, superval);
	///////// Start param1 - UINT8 /////////
	param1 = superval[currentPos++];
	putValue(P_ASG_69_0_0_14_1, round((param1 * 1.0) - (0) + (0), 1.0));
	///////// Start param2 - UINT8 /////////
	param2 = superval[currentPos++];
	putValue(P_ASG_69_0_0_14_2, param2);
	///////// Start param3 - UINT8 /////////
	param3 = superval[currentPos++];
	putValue(P_ASG_69_0_0_14_3, param3);
	///////// Start param4 - UINT8 /////////
	param4 = superval[currentPos++];
	putValue(P_ASG_69_0_0_14_4, param4);
	///////// Start param5 - UINT8 /////////
	param5 = superval[currentPos++];
	putValue(P_ASG_69_0_0_14_5, param5);
	///////// Start param6 - UINT8 /////////
	param6 = superval[currentPos++];
	putValue(P_ASG_69_0_0_14_6, round((param6 * 1.0) - (0) + (0), 1.0));
}

// Ueberwachung der Darstellungsvariable der Range.
on envVar P_ASG_69_0_0_14_1_range // FSG_Setup.MaxVolume 
{
	@P_ASG_69_0_0_14_1 = @P_ASG_69_0_0_14_1_range - (0); // slider = range - min
}

on envVar P_ASG_69_0_0_14_1 // FSG_Setup.MaxVolume
{
	byte superval[6];

	//Update Childvalue (Number)
	byte thisval; // MaxVolume
	float slider_value;

	slider_value = round(@P_ASG_69_0_0_14_1, 1.0);
	@P_ASG_69_0_0_14_1_range = slider_value + (0); // real value := slider value + range min.
	thisval = (byte)round((slider_value + (0) - (0)) / (1.0), 1); // bus value := (slider value + min - offset) / step.

    // Update superval
	getValue(P_ASG_69_0_0_14, superval);
	superval[0]=thisval;
	putValue(P_ASG_69_0_0_14,superval);
}

on envVar P_ASG_69_0_0_14_2_0
{
	byte bitval;
	//thisval steht hier fuer den bitfield-wert, 
	//aus Generierungsgruenden hier keine einheitliche Bezeichnung moeglich.
	byte thisval; // FunctionSupport
	bitval= getValue(this);
	thisval = getValue(P_ASG_69_0_0_14_2);
	thisval = thisval&~(1<<0)|(bitval<<0);
	putValue(P_ASG_69_0_0_14_2,thisval);
}

on envVar P_ASG_69_0_0_14_2 // FSG_Setup.FunctionSupport
{
	byte superval[6];

	//Update Childvalue (BitField)
	byte mask=0x01;
	int i = 0;
	byte thisval; // FunctionSupport
	thisval = getValue(this);
	if(thisval&(mask<<0))
		putValue(P_ASG_69_0_0_14_2_0, 1);
	else
		putValue(P_ASG_69_0_0_14_2_0, 0);

    // Update superval
	getValue(P_ASG_69_0_0_14, superval);
	superval[1]=thisval;
	putValue(P_ASG_69_0_0_14,superval);
}

on envVar P_ASG_69_0_0_14_3_0
{
	byte bitval;
	//thisval steht hier fuer den bitfield-wert, 
	//aus Generierungsgruenden hier keine einheitliche Bezeichnung moeglich.
	byte thisval; // AdditionalInstrumentSetup
	bitval= getValue(this);
	thisval = getValue(P_ASG_69_0_0_14_3);
	thisval = thisval&~(1<<0)|(bitval<<0);
	putValue(P_ASG_69_0_0_14_3,thisval);
}

on envVar P_ASG_69_0_0_14_3_1
{
	byte bitval;
	//thisval steht hier fuer den bitfield-wert, 
	//aus Generierungsgruenden hier keine einheitliche Bezeichnung moeglich.
	byte thisval; // AdditionalInstrumentSetup
	bitval= getValue(this);
	thisval = getValue(P_ASG_69_0_0_14_3);
	thisval = thisval&~(1<<1)|(bitval<<1);
	putValue(P_ASG_69_0_0_14_3,thisval);
}

on envVar P_ASG_69_0_0_14_3_2
{
	byte bitval;
	//thisval steht hier fuer den bitfield-wert, 
	//aus Generierungsgruenden hier keine einheitliche Bezeichnung moeglich.
	byte thisval; // AdditionalInstrumentSetup
	bitval= getValue(this);
	thisval = getValue(P_ASG_69_0_0_14_3);
	thisval = thisval&~(1<<2)|(bitval<<2);
	putValue(P_ASG_69_0_0_14_3,thisval);
}

on envVar P_ASG_69_0_0_14_3 // FSG_Setup.AdditionalInstrumentSetup
{
	byte superval[6];

	//Update Childvalue (BitField)
	byte mask=0x01;
	int i = 0;
	byte thisval; // AdditionalInstrumentSetup
	thisval = getValue(this);
	if(thisval&(mask<<0))
		putValue(P_ASG_69_0_0_14_3_0, 1);
	else
		putValue(P_ASG_69_0_0_14_3_0, 0);
	if(thisval&(mask<<1))
		putValue(P_ASG_69_0_0_14_3_1, 1);
	else
		putValue(P_ASG_69_0_0_14_3_1, 0);
	if(thisval&(mask<<2))
		putValue(P_ASG_69_0_0_14_3_2, 1);
	else
		putValue(P_ASG_69_0_0_14_3_2, 0);

    // Update superval
	getValue(P_ASG_69_0_0_14, superval);
	superval[2]=thisval;
	putValue(P_ASG_69_0_0_14,superval);
}

on envVar P_ASG_69_0_0_14_4_0
{
	byte bitval;
	//thisval steht hier fuer den bitfield-wert, 
	//aus Generierungsgruenden hier keine einheitliche Bezeichnung moeglich.
	byte thisval; // PopupSetup
	bitval= getValue(this);
	thisval = getValue(P_ASG_69_0_0_14_4);
	thisval = thisval&~(1<<0)|(bitval<<0);
	putValue(P_ASG_69_0_0_14_4,thisval);
}

on envVar P_ASG_69_0_0_14_4_1
{
	byte bitval;
	//thisval steht hier fuer den bitfield-wert, 
	//aus Generierungsgruenden hier keine einheitliche Bezeichnung moeglich.
	byte thisval; // PopupSetup
	bitval= getValue(this);
	thisval = getValue(P_ASG_69_0_0_14_4);
	thisval = thisval&~(1<<1)|(bitval<<1);
	putValue(P_ASG_69_0_0_14_4,thisval);
}

on envVar P_ASG_69_0_0_14_4_2
{
	byte bitval;
	//thisval steht hier fuer den bitfield-wert, 
	//aus Generierungsgruenden hier keine einheitliche Bezeichnung moeglich.
	byte thisval; // PopupSetup
	bitval= getValue(this);
	thisval = getValue(P_ASG_69_0_0_14_4);
	thisval = thisval&~(1<<2)|(bitval<<2);
	putValue(P_ASG_69_0_0_14_4,thisval);
}

on envVar P_ASG_69_0_0_14_4_3
{
	byte bitval;
	//thisval steht hier fuer den bitfield-wert, 
	//aus Generierungsgruenden hier keine einheitliche Bezeichnung moeglich.
	byte thisval; // PopupSetup
	bitval= getValue(this);
	thisval = getValue(P_ASG_69_0_0_14_4);
	thisval = thisval&~(1<<3)|(bitval<<3);
	putValue(P_ASG_69_0_0_14_4,thisval);
}

on envVar P_ASG_69_0_0_14_4_4
{
	byte bitval;
	//thisval steht hier fuer den bitfield-wert, 
	//aus Generierungsgruenden hier keine einheitliche Bezeichnung moeglich.
	byte thisval; // PopupSetup
	bitval= getValue(this);
	thisval = getValue(P_ASG_69_0_0_14_4);
	thisval = thisval&~(1<<4)|(bitval<<4);
	putValue(P_ASG_69_0_0_14_4,thisval);
}

on envVar P_ASG_69_0_0_14_4 // FSG_Setup.PopupSetup
{
	byte superval[6];

	//Update Childvalue (BitField)
	byte mask=0x01;
	int i = 0;
	byte thisval; // PopupSetup
	thisval = getValue(this);
	if(thisval&(mask<<0))
		putValue(P_ASG_69_0_0_14_4_0, 1);
	else
		putValue(P_ASG_69_0_0_14_4_0, 0);
	if(thisval&(mask<<1))
		putValue(P_ASG_69_0_0_14_4_1, 1);
	else
		putValue(P_ASG_69_0_0_14_4_1, 0);
	if(thisval&(mask<<2))
		putValue(P_ASG_69_0_0_14_4_2, 1);
	else
		putValue(P_ASG_69_0_0_14_4_2, 0);
	if(thisval&(mask<<3))
		putValue(P_ASG_69_0_0_14_4_3, 1);
	else
		putValue(P_ASG_69_0_0_14_4_3, 0);
	if(thisval&(mask<<4))
		putValue(P_ASG_69_0_0_14_4_4, 1);
	else
		putValue(P_ASG_69_0_0_14_4_4, 0);

    // Update superval
	getValue(P_ASG_69_0_0_14, superval);
	superval[3]=thisval;
	putValue(P_ASG_69_0_0_14,superval);
}

on envVar P_ASG_69_0_0_14_5_0
{
	byte bitval;
	//thisval steht hier fuer den bitfield-wert, 
	//aus Generierungsgruenden hier keine einheitliche Bezeichnung moeglich.
	byte thisval; // AdditionalInstrument2Setup
	bitval= getValue(this);
	thisval = getValue(P_ASG_69_0_0_14_5);
	thisval = thisval&~(1<<0)|(bitval<<0);
	putValue(P_ASG_69_0_0_14_5,thisval);
}

on envVar P_ASG_69_0_0_14_5_1
{
	byte bitval;
	//thisval steht hier fuer den bitfield-wert, 
	//aus Generierungsgruenden hier keine einheitliche Bezeichnung moeglich.
	byte thisval; // AdditionalInstrument2Setup
	bitval= getValue(this);
	thisval = getValue(P_ASG_69_0_0_14_5);
	thisval = thisval&~(1<<1)|(bitval<<1);
	putValue(P_ASG_69_0_0_14_5,thisval);
}

on envVar P_ASG_69_0_0_14_5_2
{
	byte bitval;
	//thisval steht hier fuer den bitfield-wert, 
	//aus Generierungsgruenden hier keine einheitliche Bezeichnung moeglich.
	byte thisval; // AdditionalInstrument2Setup
	bitval= getValue(this);
	thisval = getValue(P_ASG_69_0_0_14_5);
	thisval = thisval&~(1<<2)|(bitval<<2);
	putValue(P_ASG_69_0_0_14_5,thisval);
}

on envVar P_ASG_69_0_0_14_5_3
{
	byte bitval;
	//thisval steht hier fuer den bitfield-wert, 
	//aus Generierungsgruenden hier keine einheitliche Bezeichnung moeglich.
	byte thisval; // AdditionalInstrument2Setup
	bitval= getValue(this);
	thisval = getValue(P_ASG_69_0_0_14_5);
	thisval = thisval&~(1<<3)|(bitval<<3);
	putValue(P_ASG_69_0_0_14_5,thisval);
}

on envVar P_ASG_69_0_0_14_5_4
{
	byte bitval;
	//thisval steht hier fuer den bitfield-wert, 
	//aus Generierungsgruenden hier keine einheitliche Bezeichnung moeglich.
	byte thisval; // AdditionalInstrument2Setup
	bitval= getValue(this);
	thisval = getValue(P_ASG_69_0_0_14_5);
	thisval = thisval&~(1<<4)|(bitval<<4);
	putValue(P_ASG_69_0_0_14_5,thisval);
}

on envVar P_ASG_69_0_0_14_5_5
{
	byte bitval;
	//thisval steht hier fuer den bitfield-wert, 
	//aus Generierungsgruenden hier keine einheitliche Bezeichnung moeglich.
	byte thisval; // AdditionalInstrument2Setup
	bitval= getValue(this);
	thisval = getValue(P_ASG_69_0_0_14_5);
	thisval = thisval&~(1<<5)|(bitval<<5);
	putValue(P_ASG_69_0_0_14_5,thisval);
}

on envVar P_ASG_69_0_0_14_5 // FSG_Setup.AdditionalInstrument2Setup
{
	byte superval[6];

	//Update Childvalue (BitField)
	byte mask=0x01;
	int i = 0;
	byte thisval; // AdditionalInstrument2Setup
	thisval = getValue(this);
	if(thisval&(mask<<0))
		putValue(P_ASG_69_0_0_14_5_0, 1);
	else
		putValue(P_ASG_69_0_0_14_5_0, 0);
	if(thisval&(mask<<1))
		putValue(P_ASG_69_0_0_14_5_1, 1);
	else
		putValue(P_ASG_69_0_0_14_5_1, 0);
	if(thisval&(mask<<2))
		putValue(P_ASG_69_0_0_14_5_2, 1);
	else
		putValue(P_ASG_69_0_0_14_5_2, 0);
	if(thisval&(mask<<3))
		putValue(P_ASG_69_0_0_14_5_3, 1);
	else
		putValue(P_ASG_69_0_0_14_5_3, 0);
	if(thisval&(mask<<4))
		putValue(P_ASG_69_0_0_14_5_4, 1);
	else
		putValue(P_ASG_69_0_0_14_5_4, 0);
	if(thisval&(mask<<5))
		putValue(P_ASG_69_0_0_14_5_5, 1);
	else
		putValue(P_ASG_69_0_0_14_5_5, 0);

    // Update superval
	getValue(P_ASG_69_0_0_14, superval);
	superval[4]=thisval;
	putValue(P_ASG_69_0_0_14,superval);
}

// Ueberwachung der Darstellungsvariable der Range.
on envVar P_ASG_69_0_0_14_6_range // FSG_Setup.Extension1 
{
	@P_ASG_69_0_0_14_6 = @P_ASG_69_0_0_14_6_range - (0); // slider = range - min
}

on envVar P_ASG_69_0_0_14_6 // FSG_Setup.Extension1
{
	byte superval[6];

	//Update Childvalue (Number)
	byte thisval; // Extension1
	float slider_value;

	slider_value = 0; // Konstanter Parameter.
	@P_ASG_69_0_0_14_6_range = slider_value + (0); // real value := slider value + range min.
	thisval = (byte)round((slider_value + (0) - (0)) / (1.0), 1); // bus value := (slider value + min - offset) / step.

    // Update superval
	getValue(P_ASG_69_0_0_14, superval);
	superval[5]=thisval;
	putValue(P_ASG_69_0_0_14,superval);
}

on envVar P_ASG_69_0_0_15Get_BTN
{
 if (P_ASG_69_0_0_15Get_BTN_already_pressed == 0)
  {
       putValue(P_ASG_69_0_0_15_ErrCode,0);
       SetControlBackColor(panel_name,"errField_P_ASG_69_0_0_15",MakeRGB(255,255,255));
       P_ASG_69_0_0_15Get_BTN_already_pressed = 1;
 }
 else
 {
       Request_Void(LSGID, P_ASG_69_0_0_15_ID, DataGet_REQ); 
       P_ASG_69_0_0_15Get_BTN_already_pressed = 0;
 }
}
on envVar P_ASG_69_0_0_15 // bus value of FSG_OperationState (15).
{
	// opcodes: Error-Status
	byte param1; // OP_State
	// DATATYPE_UINTXX
	param1 = getValue(P_ASG_69_0_0_15);
	putValue(P_ASG_69_0_0_15_1, param1);
}

on envVar P_ASG_69_0_0_15_1 // FSG_OperationState.OP_State
{
	byte superval;

	//Update Childvalue (Enum)
	byte thisval; // OP_State
	thisval = getValue(this);

    // Update superval
	superval = getValue(P_ASG_69_0_0_15);
	superval = thisval;
	putValue(P_ASG_69_0_0_15,superval);
}

on envVar P_ASG_69_0_0_16Get_BTN
{
 if (P_ASG_69_0_0_16Get_BTN_already_pressed == 0)
  {
       putValue(P_ASG_69_0_0_16_ErrCode,0);
       SetControlBackColor(panel_name,"errField_P_ASG_69_0_0_16",MakeRGB(255,255,255));
       P_ASG_69_0_0_16Get_BTN_already_pressed = 1;
 }
 else
 {
       Request_Void(LSGID, P_ASG_69_0_0_16_ID, DataGet_REQ); 
       P_ASG_69_0_0_16Get_BTN_already_pressed = 0;
 }
}
on envVar P_ASG_69_0_0_16SetGet_BTN
{
	byte BAPTemp[2];
    if (P_ASG_69_0_0_16SetGet_BTN_already_pressed == 0)
    {
       putValue(P_ASG_69_0_0_16_ErrCode,0);
       SetControlBackColor(panel_name,"errField_P_ASG_69_0_0_16",MakeRGB(255,255,255));
       P_ASG_69_0_0_16SetGet_BTN_already_pressed = 1;
    }
    else
    {
       getValue(P_ASG_69_0_0_16, BAPTemp);
       Request_ByteSequence(LSGID, P_ASG_69_0_0_16_ID, DataSetGet_REQ, BAPTemp, getValueSize(P_ASG_69_0_0_16));
       P_ASG_69_0_0_16SetGet_BTN_already_pressed = 0;
    }
}
on envVar P_ASG_69_0_0_16 // bus value of Brightness (16).
{
	// opcodes: Error-Status
	byte param1; // Setup
	byte param2; // ModificationReason
	byte param3; // ModificationState
	// DATATYPE_BYTESEQUENCE / DATATYPE_FIXEDBYTESEQUENCE
	int i;
	byte superval[2];
	int currentPos;
	currentPos = 0;
	for( i = 0; i < 2; i++ ) {
		superval[i] = 0;
	}
	getValue(P_ASG_69_0_0_16, superval);
	///////// Start param1 - UINT8 /////////
	param1 = superval[currentPos++];
	putValue(P_ASG_69_0_0_16_1, round((param1 * 1.0) - (0) + (0), 1.0));
	///////// Start param2 - NIBBLE /////////
	param2 = (superval[currentPos] & 0xf0)>>4;
	putValue(P_ASG_69_0_0_16_2, param2);
	///////// Start param3 - NIBBLE /////////
	param3 = superval[currentPos++] & 0x0f;
	putValue(P_ASG_69_0_0_16_3, param3);
}

// Ueberwachung der Darstellungsvariable der Range.
on envVar P_ASG_69_0_0_16_1_range // Brightness.Setup 
{
	@P_ASG_69_0_0_16_1 = @P_ASG_69_0_0_16_1_range - (0); // slider = range - min
}

on envVar P_ASG_69_0_0_16_1 // Brightness.Setup
{
	byte superval[2];

	//Update Childvalue (Number)
	byte thisval; // Setup
	float slider_value;

	slider_value = round(@P_ASG_69_0_0_16_1, 1.0);
	@P_ASG_69_0_0_16_1_range = slider_value + (0); // real value := slider value + range min.
	thisval = (byte)round((slider_value + (0) - (0)) / (1.0), 1); // bus value := (slider value + min - offset) / step.

    // Update superval
	getValue(P_ASG_69_0_0_16, superval);
	superval[0]=thisval;
	putValue(P_ASG_69_0_0_16,superval);
}

on envVar P_ASG_69_0_0_16_2 // Brightness.ModificationReason
{
	byte superval[2];

	//Update Childvalue (Enum)
	byte thisval; // ModificationReason
	thisval = 0x0f & getValue(this);

    // Update superval
	getValue(P_ASG_69_0_0_16, superval);
	superval[1]= superval[1]&0x0f;
	superval[1]= superval[1]|(thisval<<4);
	putValue(P_ASG_69_0_0_16,superval);
}

on envVar P_ASG_69_0_0_16_3_0
{
	byte bitval;
	//thisval steht hier fuer den bitfield-wert, 
	//aus Generierungsgruenden hier keine einheitliche Bezeichnung moeglich.
	byte thisval; // ModificationState
	bitval= getValue(this);
	thisval = getValue(P_ASG_69_0_0_16_3);
	thisval = thisval&~(1<<0)|(bitval<<0);
	putValue(P_ASG_69_0_0_16_3,thisval);
}

on envVar P_ASG_69_0_0_16_3 // Brightness.ModificationState
{
	byte superval[2];

	//Update Childvalue (BitField)
	byte mask=0x01;
	int i = 0;
	byte thisval; // ModificationState
	thisval = getValue(this);
	if(thisval&(mask<<0))
		putValue(P_ASG_69_0_0_16_3_0, 1);
	else
		putValue(P_ASG_69_0_0_16_3_0, 0);

    // Update superval
	getValue(P_ASG_69_0_0_16, superval);
	superval[1]= superval[1]&0xf0;
	superval[1]= superval[1]|thisval;
	putValue(P_ASG_69_0_0_16,superval);
}

on envVar P_ASG_69_0_0_17Get_BTN
{
 if (P_ASG_69_0_0_17Get_BTN_already_pressed == 0)
  {
       putValue(P_ASG_69_0_0_17_ErrCode,0);
       SetControlBackColor(panel_name,"errField_P_ASG_69_0_0_17",MakeRGB(255,255,255));
       P_ASG_69_0_0_17Get_BTN_already_pressed = 1;
 }
 else
 {
       Request_Void(LSGID, P_ASG_69_0_0_17_ID, DataGet_REQ); 
       P_ASG_69_0_0_17Get_BTN_already_pressed = 0;
 }
}
on envVar P_ASG_69_0_0_17SetGet_BTN
{
	byte BAPTemp[2];
    if (P_ASG_69_0_0_17SetGet_BTN_already_pressed == 0)
    {
       putValue(P_ASG_69_0_0_17_ErrCode,0);
       SetControlBackColor(panel_name,"errField_P_ASG_69_0_0_17",MakeRGB(255,255,255));
       P_ASG_69_0_0_17SetGet_BTN_already_pressed = 1;
    }
    else
    {
       getValue(P_ASG_69_0_0_17, BAPTemp);
       Request_ByteSequence(LSGID, P_ASG_69_0_0_17_ID, DataSetGet_REQ, BAPTemp, getValueSize(P_ASG_69_0_0_17));
       P_ASG_69_0_0_17SetGet_BTN_already_pressed = 0;
    }
}
on envVar P_ASG_69_0_0_17 // bus value of Volume (17).
{
	// opcodes: Error-Status
	byte param1; // Setup
	byte param2; // ModificationReason
	byte param3; // ModificationState
	// DATATYPE_BYTESEQUENCE / DATATYPE_FIXEDBYTESEQUENCE
	int i;
	byte superval[2];
	int currentPos;
	currentPos = 0;
	for( i = 0; i < 2; i++ ) {
		superval[i] = 0;
	}
	getValue(P_ASG_69_0_0_17, superval);
	///////// Start param1 - UINT8 /////////
	param1 = superval[currentPos++];
	putValue(P_ASG_69_0_0_17_1, round((param1 * 1.0) - (0) + (0), 1.0));
	///////// Start param2 - NIBBLE /////////
	param2 = (superval[currentPos] & 0xf0)>>4;
	putValue(P_ASG_69_0_0_17_2, param2);
	///////// Start param3 - NIBBLE /////////
	param3 = superval[currentPos++] & 0x0f;
	putValue(P_ASG_69_0_0_17_3, param3);
}

// Ueberwachung der Darstellungsvariable der Range.
on envVar P_ASG_69_0_0_17_1_range // Volume.Setup 
{
	@P_ASG_69_0_0_17_1 = @P_ASG_69_0_0_17_1_range - (0); // slider = range - min
}

on envVar P_ASG_69_0_0_17_1 // Volume.Setup
{
	byte superval[2];

	//Update Childvalue (Number)
	byte thisval; // Setup
	float slider_value;

	slider_value = round(@P_ASG_69_0_0_17_1, 1.0);
	@P_ASG_69_0_0_17_1_range = slider_value + (0); // real value := slider value + range min.
	thisval = (byte)round((slider_value + (0) - (0)) / (1.0), 1); // bus value := (slider value + min - offset) / step.

    // Update superval
	getValue(P_ASG_69_0_0_17, superval);
	superval[0]=thisval;
	putValue(P_ASG_69_0_0_17,superval);
}

on envVar P_ASG_69_0_0_17_2 // Volume.ModificationReason
{
	byte superval[2];

	//Update Childvalue (Enum)
	byte thisval; // ModificationReason
	thisval = 0x0f & getValue(this);

    // Update superval
	getValue(P_ASG_69_0_0_17, superval);
	superval[1]= superval[1]&0x0f;
	superval[1]= superval[1]|(thisval<<4);
	putValue(P_ASG_69_0_0_17,superval);
}

on envVar P_ASG_69_0_0_17_3_0
{
	byte bitval;
	//thisval steht hier fuer den bitfield-wert, 
	//aus Generierungsgruenden hier keine einheitliche Bezeichnung moeglich.
	byte thisval; // ModificationState
	bitval= getValue(this);
	thisval = getValue(P_ASG_69_0_0_17_3);
	thisval = thisval&~(1<<0)|(bitval<<0);
	putValue(P_ASG_69_0_0_17_3,thisval);
}

on envVar P_ASG_69_0_0_17_3 // Volume.ModificationState
{
	byte superval[2];

	//Update Childvalue (BitField)
	byte mask=0x01;
	int i = 0;
	byte thisval; // ModificationState
	thisval = getValue(this);
	if(thisval&(mask<<0))
		putValue(P_ASG_69_0_0_17_3_0, 1);
	else
		putValue(P_ASG_69_0_0_17_3_0, 0);

    // Update superval
	getValue(P_ASG_69_0_0_17, superval);
	superval[1]= superval[1]&0xf0;
	superval[1]= superval[1]|thisval;
	putValue(P_ASG_69_0_0_17,superval);
}

on envVar A_ASG_69_0_0_18Get_BTN
{
  byte data[64]; 
  byte stringValue[64];
  byte head[5];
  int i;
  int headLength;
  long tempValue;
  word currentPos;
  word startVal;
  word elementsVal;
  byte nibbleSetted;
  if (A_ASG_69_0_0_18Get_BTN_already_pressed == 0)
  {
     putValue(A_ASG_69_0_0_18_ErrCode,0);
     SetControlBackColor(panel_name,"errField_A_ASG_69_0_0_18",MakeRGB(255,255,255));
     A_ASG_69_0_0_18Get_BTN_already_pressed = 1;
  }
  else
  {
        currentPos = 0;
        //Einzelparameter: ASG_ID
        tempValue = getValue(A_ASG_69_0_0_18_1_SetGet);
    if(nibbleSetted == 1)
    {
        //voriger Parameter war ein Nibble, => second nibble, Pos incr und Flag zuruecksetzen
        data[currentPos] = (tempValue &0x0F) | (data[currentPos] &0xF0);
        currentPos++;
        nibbleSetted = 0;
    }
    else
    {
        //first nibble, kein increment, Flag setzen
        data[currentPos] = (tempValue<<4) &0xF0;
        nibbleSetted = 1;
    }
        //Einzelparameter: TAID
        tempValue = getValue(A_ASG_69_0_0_18_2_SetGet);
    if(nibbleSetted == 1)
    {
        //voriger Parameter war ein Nibble, => second nibble, Pos incr und Flag zuruecksetzen
        data[currentPos] = (tempValue &0x0F) | (data[currentPos] &0xF0);
        currentPos++;
        nibbleSetted = 0;
    }
    else
    {
        //first nibble, kein increment, Flag setzen
        data[currentPos] = (tempValue<<4) &0xF0;
        nibbleSetted = 1;
    }
        //head Parameter
        headLength = getValueSize(A_ASG_69_0_0_18_SetGet);
        getValue(A_ASG_69_0_0_18_SetGet,head);
        for(i=0; i< headLength; i++)
        {
            data[currentPos++] = head[i];
        }

     Request_ByteSequence(LSGID, A_ASG_69_0_0_18_ID, DataGet_REQ, data, currentPos);
     if(getValue(A_ASG_69_0_0_18_IntTlgEn)) //getValue(IT))
     {
       intertelegram_err(A_ASG_69_0_0_18_ID);
     }
     if(getValue(A_ASG_69_0_0_18_SegmEn))   //getvalue(SG)
     {
         sequence_err(A_ASG_69_0_0_18_ID,getValueSize(A_ASG_69_0_0_18_SetGet));
     }
     A_ASG_69_0_0_18Get_BTN_already_pressed = 0;
  }
}
A_ASG_69_0_0_18_SetGet_GenerateSetGet()
{
    byte head[5];
    //Record Address in Byte 0 Bit 0-3 kopieren - MAX Wert = 0x0F
    if(getValue(A_ASG_69_0_0_18_SetGet_RecAdr) > 0x0F)
        putValue(A_ASG_69_0_0_18_SetGet_RecAdr , 0x0F);
    head[0] = (head[0] & 0xF0) | getValue(A_ASG_69_0_0_18_SetGet_RecAdr);
    //Shift Bit in Byte 0 Bit 4 kopieren
    if( getValue(A_ASG_69_0_0_18_SetGet_Shift) > 0) head[0] = head[0] | 0x10;
    else head[0] = head[0] & 0xEF;
    // Direction Bit in Byte 0 Bit 5 kopieren
    if( getValue(A_ASG_69_0_0_18_SetGet_Direction) > 0) head[0] = head[0] | 0x20;
    else head[0] = head[0] & 0xDF;
    // reserverd:  Byte 0 Bit 6
    if( getValue(A_ASG_69_0_0_18_SetGet_IndexSize) > 0)
    {
        // 5 Byte Header
        head[0] = head[0] | 0x80;
        head[1] =  getValue(A_ASG_69_0_0_18_SetGet_Start) & 0xFF;
        head[2] = (getValue(A_ASG_69_0_0_18_SetGet_Start) >> 8 ) & 0xFF;
        head[3] =  getValue(A_ASG_69_0_0_18_SetGet_Elements) & 0xFF;
        head[4] = (getValue(A_ASG_69_0_0_18_SetGet_Elements)  >> 8 ) & 0xFF;
        //ToDo: DATA - derzeit einfach laenge = 5
        putValue(A_ASG_69_0_0_18_SetGet, head, 5); 
    }
    else 
    {
        // 3 Byte Header
        head[0] = head[0] & 0x7F;
        head[1] = getValue(A_ASG_69_0_0_18_SetGet_Start) & 0xFF;
        head[2] = getValue(A_ASG_69_0_0_18_SetGet_Elements) & 0xFF;
        //ToDo: DATA - derzeit einfach laenge = 3
        putValue(A_ASG_69_0_0_18_SetGet, head, 3); 
    }
}

on envVar A_ASG_69_0_0_18_SetGet_RecAdr
{
    A_ASG_69_0_0_18_SetGet_GenerateSetGet();
}

on envVar A_ASG_69_0_0_18_SetGet_Shift
{
    A_ASG_69_0_0_18_SetGet_GenerateSetGet();
}

on envVar A_ASG_69_0_0_18_SetGet_Direction
{
    A_ASG_69_0_0_18_SetGet_GenerateSetGet();
}

on envVar A_ASG_69_0_0_18_SetGet_Start
{
    A_ASG_69_0_0_18_SetGet_GenerateSetGet();
}

on envVar A_ASG_69_0_0_18_SetGet_Elements
{
    A_ASG_69_0_0_18_SetGet_GenerateSetGet();
}

on envVar A_ASG_69_0_0_18_SetGet_IndexSize
{
    A_ASG_69_0_0_18_SetGet_GenerateSetGet();
}
on envVar A_ASG_69_0_0_18SetGet_BTN
{
  byte data[64]; 
  byte stringValue[64];
  byte head[5];
  int i;
  int j = 0;
  long StringLength = 0;
  int headLength;
  long tempValue;
  word currentPos;
  word startVal;
  word elementsVal;
  byte nibbleSetted;
  if (A_ASG_69_0_0_18SetGet_BTN_already_pressed == 0)
  {
     putValue(A_ASG_69_0_0_18_ErrCode,0);
     SetControlBackColor(panel_name,"errField_A_ASG_69_0_0_18",MakeRGB(255,255,255));
     A_ASG_69_0_0_18SetGet_BTN_already_pressed = 1;
  }
  else
  {
        currentPos = 0;
        //Einzelparameter: ASG_ID
        tempValue = getValue(A_ASG_69_0_0_18_1_SetGet);
    if(nibbleSetted == 1)
    {
        //voriger Parameter war ein Nibble, => second nibble, Pos incr und Flag zuruecksetzen
        data[currentPos] = (tempValue &0x0F) | (data[currentPos] &0xF0);
        currentPos++;
        nibbleSetted = 0;
    }
    else
    {
        //first nibble, kein increment, Flag setzen
        data[currentPos] = (tempValue<<4) &0xF0;
        nibbleSetted = 1;
    }
        //Einzelparameter: TAID
        tempValue = getValue(A_ASG_69_0_0_18_2_SetGet);
    if(nibbleSetted == 1)
    {
        //voriger Parameter war ein Nibble, => second nibble, Pos incr und Flag zuruecksetzen
        data[currentPos] = (tempValue &0x0F) | (data[currentPos] &0xF0);
        currentPos++;
        nibbleSetted = 0;
    }
    else
    {
        //first nibble, kein increment, Flag setzen
        data[currentPos] = (tempValue<<4) &0xF0;
        nibbleSetted = 1;
    }
        //head Parameter
        headLength = getValueSize(A_ASG_69_0_0_18_SetGet);
        getValue(A_ASG_69_0_0_18_SetGet,head);
        for(i=0; i< headLength; i++)
        {
            data[currentPos++] = head[i];
        }
    //data Parameter
     startVal = getValue(A_ASG_69_0_0_18_SetGet_Start);
     elementsVal = getValue(A_ASG_69_0_0_18_SetGet_Elements);
     nibbleSetted = 0;
    if( (head[0]&0x20) == 0)
    {
     if( (head[0] & 0x10) > 0)
     {
        startVal++;
     }
     for( i = startVal ; i < startVal + elementsVal ; i++)
     {
       if( i < 0 || i >= A_ASG_69_0_0_18_ArrayDataList_Length )
       {
         write("Array index ausserhalb der Grenzen, Fct: 18");
         break;
       }
      if(nibbleSetted == 1) currentPos++;
      nibbleSetted = 0;
     if( (head[0]&0x40) == 0){ /* Transmit_Pos = 0, keine Positionsdaten */ }
     else
     {
        if( (head[0]&0x80) == 0)
        {
           //IndexSize = 0, Pos als 1 Byte Wert
           data[currentPos++] = A_ASG_69_0_0_18_ArrayDataList[i].Param1 & 0xFF;
        }
        else
        {
           //IndexSize = 1, Pos als 2 Byte Wert
           data[currentPos++] = A_ASG_69_0_0_18_ArrayDataList[i].Param1 & 0xFF;
           data[currentPos++] = (A_ASG_69_0_0_18_ArrayDataList[i].Param1 >> 8) & 0xFF;
        }
     }
      // Check if the current value of RecAdr enables the variable Display:
      if( 0 || 1 == getValue( A_ASG_69_0_0_18_SetGet_RecAdr ) )
      {
        if(nibbleSetted == 1)
        {
            // nibble ist 2. Nibble, increment nach Parameter setzen
            data[currentPos] = (A_ASG_69_0_0_18_ArrayDataList[i].Param2) & 0x0F | (data[currentPos] &0xF0);
            currentPos++;
            nibbleSetted = 0;
        }
        else
        {
            // nibble ist 1. Nibble, kein increment
            data[currentPos] = (A_ASG_69_0_0_18_ArrayDataList[i].Param2 <<4 ) & 0xF0;
            nibbleSetted = 1;
        }
       }
      // Check if the current value of RecAdr enables the variable AdditionalInfo:
      if( 0 || 1 == getValue( A_ASG_69_0_0_18_SetGet_RecAdr ) )
      {
        if(nibbleSetted == 1)
        {
            // nibble ist 2. Nibble, increment nach Parameter setzen
            data[currentPos] = (A_ASG_69_0_0_18_ArrayDataList[i].Param3) & 0x0F | (data[currentPos] &0xF0);
            currentPos++;
            nibbleSetted = 0;
        }
        else
        {
            // nibble ist 1. Nibble, kein increment
            data[currentPos] = (A_ASG_69_0_0_18_ArrayDataList[i].Param3 <<4 ) & 0xF0;
            nibbleSetted = 1;
        }
       }
      // Check if the current value of RecAdr enables the variable Element:
      if( 0 || 1 == getValue( A_ASG_69_0_0_18_SetGet_RecAdr ) )
      {
        //Sollte vor einem 1 Byte Wert 1 Nibble kommen, muss der index um 1 incrementiert werden!
        if( nibbleSetted==1) currentPos++;
        nibbleSetted = 0;
        data[currentPos++] = (A_ASG_69_0_0_18_ArrayDataList[i].Param4 ) & 0xFF;
       }
      // Check if the current value of RecAdr enables the variable ElementContent:
      if( 0 || 1 == getValue( A_ASG_69_0_0_18_SetGet_RecAdr ) || 2 == getValue( A_ASG_69_0_0_18_SetGet_RecAdr ) )
      {
        //Sollte vor einem 1 Byte Wert 1 Nibble kommen, muss der index um 1 incrementiert werden!
        if( nibbleSetted==1) currentPos++;
        nibbleSetted = 0;
        data[currentPos++] = (A_ASG_69_0_0_18_ArrayDataList[i].Param5 ) & 0xFF;
       }
      // Check if the current value of RecAdr enables the variable Extension:
      if( 0 )
      {
        //Sollte vor einem String Wert 1 Nibble kommen, muss der index um 1 incrementiert werden!
        if( nibbleSetted==1) currentPos++;
        nibbleSetted = 0;
        StringLength =A_ASG_69_0_0_18_ArrayDataList[i].Param6_Length;
		/* Pruefung ob die Laenge-Checkbox aktiv ist */
		if (1 == A_ASG_69_0_0_18_Data_6_CntList[i] )
		{
			if(StringLength >= 0 && StringLength <= 32767 /*&& StringLength <= 2-2*/)
			{
				data[currentPos++] = ( (StringLength >> 8) & 0x7F ) | 0x80; //2Byte Flag (Bit 8) setzen + HighByte (erste 7 bit)
				data[currentPos++] = StringLength &0xFF;
			}
			else
			{
				writelineEx(gBAP_Trace, 0, "Eingegebene Laenge: %d von A_ASG_69_0_0_18_Data_6 mit Record Nr. %d ist ungueltig. Die max. erlaubte Laenge ist %d.", StringLength, i, 2-2);
				return;
			}
		}
		else if(0 == A_ASG_69_0_0_18_Data_6_CntList[i] ) /*check box deaktiviert*/
		{
			if(StringLength >= 0 && StringLength <= 127 /*&& StringLength <= 2-1*/)
			{
				data[currentPos++] = StringLength & 0x7F; //Bit 8 = 0
			}
			else
			{
				writelineEx(gBAP_Trace, 0, "Eingegebene Laenge: %d von A_ASG_69_0_0_18_Data_6 mit Record Nr. %d ist ungueltig. Die max. erlaubte Laenge ist %d. ", StringLength, i, 2-1);
				return;
			}
		}
        for(j=0; j < StringLength ; j++)
        {
            data[currentPos++] = A_ASG_69_0_0_18_ArrayDataList[i].Param6[j];
        }
       }
    //sollte der letzte Parameter ein first nibble gewesen sein, muss noch 1 increment durchgefuehrt werden
    if( nibbleSetted==1) currentPos++;
    nibbleSetted = 0;
     }
    }
    else
    {
     if( (head[0] & 0x10) > 0)
     {
        if(startVal != 0) startVal--;
        else
        {
           startVal = A_ASG_69_0_0_18_ArrayDataList_Length -1;
        }
     }
     for( i = startVal ; i > startVal - elementsVal ; i--)
     {
       if( i < 0 || i >= A_ASG_69_0_0_18_ArrayDataList_Length )
       {
         write("Array index ausserhalb der Grenzen, Fct: 18");
         break;
       }
      if(nibbleSetted == 1) currentPos++;
      nibbleSetted = 0;
     if( (head[0]&0x40) == 0){ /* Transmit_Pos = 0, keine Positionsdaten */ }
     else
     {
        if( (head[0]&0x80) == 0)
        {
           //IndexSize = 0, Pos als 1 Byte Wert
           data[currentPos++] = A_ASG_69_0_0_18_ArrayDataList[i].Param1 & 0xFF;
        }
        else
        {
           //IndexSize = 1, Pos als 2 Byte Wert
           data[currentPos++] = A_ASG_69_0_0_18_ArrayDataList[i].Param1 & 0xFF;
           data[currentPos++] = (A_ASG_69_0_0_18_ArrayDataList[i].Param1 >> 8) & 0xFF;
        }
     }
      // Check if the current value of RecAdr enables the variable Display:
      if( 0 || 1 == getValue( A_ASG_69_0_0_18_SetGet_RecAdr ) )
      {
        if(nibbleSetted == 1)
        {
            // nibble ist 2. Nibble, increment nach Parameter setzen
            data[currentPos] = (A_ASG_69_0_0_18_ArrayDataList[i].Param2) & 0x0F | (data[currentPos] &0xF0);
            currentPos++;
            nibbleSetted = 0;
        }
        else
        {
            // nibble ist 1. Nibble, kein increment
            data[currentPos] = (A_ASG_69_0_0_18_ArrayDataList[i].Param2 <<4 ) & 0xF0;
            nibbleSetted = 1;
        }
       }
      // Check if the current value of RecAdr enables the variable AdditionalInfo:
      if( 0 || 1 == getValue( A_ASG_69_0_0_18_SetGet_RecAdr ) )
      {
        if(nibbleSetted == 1)
        {
            // nibble ist 2. Nibble, increment nach Parameter setzen
            data[currentPos] = (A_ASG_69_0_0_18_ArrayDataList[i].Param3) & 0x0F | (data[currentPos] &0xF0);
            currentPos++;
            nibbleSetted = 0;
        }
        else
        {
            // nibble ist 1. Nibble, kein increment
            data[currentPos] = (A_ASG_69_0_0_18_ArrayDataList[i].Param3 <<4 ) & 0xF0;
            nibbleSetted = 1;
        }
       }
      // Check if the current value of RecAdr enables the variable Element:
      if( 0 || 1 == getValue( A_ASG_69_0_0_18_SetGet_RecAdr ) )
      {
        //Sollte vor einem 1 Byte Wert 1 Nibble kommen, muss der index um 1 incrementiert werden!
        if( nibbleSetted==1) currentPos++;
        nibbleSetted = 0;
        data[currentPos++] = (A_ASG_69_0_0_18_ArrayDataList[i].Param4 ) & 0xFF;
       }
      // Check if the current value of RecAdr enables the variable ElementContent:
      if( 0 || 1 == getValue( A_ASG_69_0_0_18_SetGet_RecAdr ) || 2 == getValue( A_ASG_69_0_0_18_SetGet_RecAdr ) )
      {
        //Sollte vor einem 1 Byte Wert 1 Nibble kommen, muss der index um 1 incrementiert werden!
        if( nibbleSetted==1) currentPos++;
        nibbleSetted = 0;
        data[currentPos++] = (A_ASG_69_0_0_18_ArrayDataList[i].Param5 ) & 0xFF;
       }
      // Check if the current value of RecAdr enables the variable Extension:
      if( 0 )
      {
        //Sollte vor einem String Wert 1 Nibble kommen, muss der index um 1 incrementiert werden!
        if( nibbleSetted==1) currentPos++;
        nibbleSetted = 0;
        StringLength =A_ASG_69_0_0_18_ArrayDataList[i].Param6_Length;
		/* Pruefung ob die Laenge-Checkbox aktiv ist */
		if (1 == A_ASG_69_0_0_18_Data_6_CntList[i] )
		{
			if(StringLength >= 0 && StringLength <= 32767 /*&& StringLength <= 2-2*/)
			{
				data[currentPos++] = ( (StringLength >> 8) & 0x7F ) | 0x80; //2Byte Flag (Bit 8) setzen + HighByte (erste 7 bit)
				data[currentPos++] = StringLength &0xFF;
			}
			else
			{
				writelineEx(gBAP_Trace, 0, "Eingegebene Laenge: %d von A_ASG_69_0_0_18_Data_6 mit Record Nr. %d ist ungueltig. Die max. erlaubte Laenge ist %d.", StringLength, i, 2-2);
				return;
			}
		}
		else if(0 == A_ASG_69_0_0_18_Data_6_CntList[i] ) /*check box deaktiviert*/
		{
			if(StringLength >= 0 && StringLength <= 127 /*&& StringLength <= 2-1*/)
			{
				data[currentPos++] = StringLength & 0x7F; //Bit 8 = 0
			}
			else
			{
				writelineEx(gBAP_Trace, 0, "Eingegebene Laenge: %d von A_ASG_69_0_0_18_Data_6 mit Record Nr. %d ist ungueltig. Die max. erlaubte Laenge ist %d. ", StringLength, i, 2-1);
				return;
			}
		}
        for(j=0; j < StringLength ; j++)
        {
            data[currentPos++] = A_ASG_69_0_0_18_ArrayDataList[i].Param6[j];
        }
       }
    //sollte der letzte Parameter ein first nibble gewesen sein, muss noch 1 increment durchgefuehrt werden
    if( nibbleSetted==1) currentPos++;
    nibbleSetted = 0;
     }
    }

     Request_ByteSequence(LSGID, A_ASG_69_0_0_18_ID, DataSetGet_REQ, data, currentPos);
     if(getValue(A_ASG_69_0_0_18_IntTlgEn)) //getValue(IT))
     {
           intertelegram_err(A_ASG_69_0_0_18_ID);
     }
     if(getValue(A_ASG_69_0_0_18_SegmEn))   //getvalue(SG)
     {
             sequence_err(A_ASG_69_0_0_18_ID,getValueSize(A_ASG_69_0_0_18_SetGet));
     }
     A_ASG_69_0_0_18SetGet_BTN_already_pressed = 0;
  }
}
on envVar A_ASG_69_0_0_18
{
    byte temp[64];
    byte head[5];
    getValue(A_ASG_69_0_0_18, head);
    putValue(A_ASG_69_0_0_18_RecAdr, 0x0F & head[0]); //Record Address = Bit 0-3 von Byte 0
    if ( (0x10 & head[0]) >0)
        putValue(A_ASG_69_0_0_18_Shift, 1); //Shift = Bit 4 von Byte 0
    else
        putValue(A_ASG_69_0_0_18_Shift, 0); //Shift = Bit 4 von Byte 0
    if ( (0x20 & head[0]) >0)
        putValue(A_ASG_69_0_0_18_Direction, 1); //Direction = Bit 5 von Byte 0
    else
        putValue(A_ASG_69_0_0_18_Direction, 0); //Direction = Bit 5 von Byte 0
    if ( (0x40 & head[0]) >0)
        putValue(A_ASG_69_0_0_18_TransPos, 1); //Transmission Pos = Bit 6 von Byte 0
    else
        putValue(A_ASG_69_0_0_18_TransPos, 0); //Transmission Pos = Bit 6 von Byte 0
    if ( (0x80 & head[0]) >0)
        putValue(A_ASG_69_0_0_18_IndexSize, 1); //IndexSize = Bit 7 von Byte 0
    else
        putValue(A_ASG_69_0_0_18_IndexSize, 0); //IndexSize = Bit 7 von Byte 0
    if(getValue(A_ASG_69_0_0_18_IndexSize))
    {
        putValue(A_ASG_69_0_0_18_Start, ((head[2]<<8)| head[1]) ); //Start Wert, 2 Byte lang
        putValue(A_ASG_69_0_0_18_Elements, ((head[4]<<8)| head[3]) ); //Elements Wert, 2 Byte lang
    }
    else
    {
        putValue(A_ASG_69_0_0_18_Start, head[1]); //Start Wert, 1 Byte lang
        putValue(A_ASG_69_0_0_18_Elements, head[2]); //Start Wert, 1 Byte lang
    }
}
on envVar A_ASG_69_0_0_18_Changed
{
    byte temp[65];
    getValue(A_ASG_69_0_0_18_Changed, temp);
    putValue(A_ASG_69_0_0_18_Changed_RecAdr, 0x0F & temp[0]); //Record Address = Bit 0-3 von Byte 0
    if ( (0x10 & temp[0]) >0)
        putValue(A_ASG_69_0_0_18_Changed_Shift, 1); //Shift = Bit 4 von Byte 0
    else
        putValue(A_ASG_69_0_0_18_Changed_Shift, 0); //Shift = Bit 4 von Byte 0
    if ( (0x20 & temp[0]) >0)
        putValue(A_ASG_69_0_0_18_Changed_Direction, 1); //Direction = Bit 5 von Byte 0
    else
        putValue(A_ASG_69_0_0_18_Changed_Direction, 0); //Direction = Bit 5 von Byte 0
    if ( (0x40 & temp[0]) >0)
        putValue(A_ASG_69_0_0_18_Changed_TransPos, 1); //Transmission Pos = Bit 6 von Byte 0
    else
        putValue(A_ASG_69_0_0_18_Changed_TransPos, 0); //Transmission Pos = Bit 6 von Byte 0
    if ( (0x80 & temp[0]) >0)
        putValue(A_ASG_69_0_0_18_Changed_IndexSize, 1); //IndexSize = Bit 7 von Byte 0
    else
        putValue(A_ASG_69_0_0_18_Changed_IndexSize, 0); //IndexSize = Bit 7 von Byte 0
    if(getValue(A_ASG_69_0_0_18_Changed_IndexSize))
    {
        putValue(A_ASG_69_0_0_18_Changed_Start, ((temp[2]<<8)| temp[1]) ); //Start Wert, 2 Byte lang
        putValue(A_ASG_69_0_0_18_Changed_Elements, ((temp[4]<<8)| temp[3]) ); //Elements Wert, 2 Byte lang
    }
    else
    {
        putValue(A_ASG_69_0_0_18_Changed_Start, temp[1]); //Start Wert, 1 Byte lang
        putValue(A_ASG_69_0_0_18_Changed_Elements, temp[2]); //Start Wert, 1 Byte lang
    }
}
on envVar A_ASG_69_0_0_18_SetGet
{
    byte temp[64];
    getValue(A_ASG_69_0_0_18_SetGet, temp);
    putValue(A_ASG_69_0_0_18_SetGet_RecAdr, 0x0F & temp[0]); //Record Address = Bit 0-3 von Byte 0
    if ( (0x10 & temp[0]) >0)
        putValue(A_ASG_69_0_0_18_SetGet_Shift, 1); //Shift = Bit 4 von Byte 0
    else
        putValue(A_ASG_69_0_0_18_SetGet_Shift, 0); //Shift = Bit 4 von Byte 0
    if ( (0x20 & temp[0]) >0)
        putValue(A_ASG_69_0_0_18_SetGet_Direction, 1); //Direction = Bit 5 von Byte 0
    else
        putValue(A_ASG_69_0_0_18_SetGet_Direction, 0); //Direction = Bit 5 von Byte 0
    // Bit 6 von Byte 0 = reserved
    if ( (0x80 & temp[0]) >0)
        putValue(A_ASG_69_0_0_18_SetGet_IndexSize, 1); //IndexSize = Bit 7 von Byte 0
    else
        putValue(A_ASG_69_0_0_18_SetGet_IndexSize, 0); //IndexSize = Bit 7 von Byte 0
    if(getValue(A_ASG_69_0_0_18_SetGet_IndexSize))
    {
        putValue(A_ASG_69_0_0_18_SetGet_Start, ((temp[2]<<8)| temp[1]) ); //Start Wert, 2 Byte lang
        putValue(A_ASG_69_0_0_18_SetGet_Elements, ((temp[4]<<8)| temp[3]) ); //Elements Wert, 2 Byte lang
    }
    else
    {
        putValue(A_ASG_69_0_0_18_SetGet_Start, temp[1]); //Start Wert, 1 Byte lang
        putValue(A_ASG_69_0_0_18_SetGet_Elements, temp[2]); //Start Wert, 1 Byte lang
    }
}
A_ASG_69_0_0_18_LoadArray()
{
	/********* Statische Deklarationen ***********/
	dword CSVfileHandle;
	dword filePos;
	dword paramPos;
	dword Num_of_csv_byte;
	dword element;
	dword current_CSV_line;
	byte buffer_byte[0xFFFF];
	dword i;
	dword j;
	char CSV_filename[255];

	/********* Param Puffer Deklarationen ***********/
	char temp1[25];
	char temp2[25];
	char temp3[25];
	char temp4[25];
	char temp5[25];

	/********* Initialisierungen ***********/
	CSVfileHandle = 0;
	filePos = 0;
	paramPos = 0;
	Num_of_csv_byte = 0;
	element = 1;
	current_CSV_line = 0;
	for(i = 0; i < A_ASG_69_0_0_18_ArrayDataList_Length; i++)
	{ /* Initialisierung von den Ziel-Strukturen */
		A_ASG_69_0_0_18_ArrayDataList[i].Param1 = 0;
		A_ASG_69_0_0_18_ArrayDataList[i].Param2 = 0;
		A_ASG_69_0_0_18_ArrayDataList[i].Param3 = 0;
		A_ASG_69_0_0_18_ArrayDataList[i].Param4 = 0;
		A_ASG_69_0_0_18_ArrayDataList[i].Param5 = 0;
		for(j=0; j<2; j++)
			A_ASG_69_0_0_18_ArrayDataList[i].Param6[j] = 0;
		A_ASG_69_0_0_18_ArrayDataList[i].Param6_Length = 0;
		A_ASG_69_0_0_18_Data_6_LenList[i] = 0;
	}

	/********* Laden der CSV-Datei ***********/
	getValue(A_ASG_69_0_0_18_fileSelector, CSV_filename);
	CSVfileHandle = openFileRead(CSV_filename, 1); //open *.csv (binary-mode ->get the ASCII/UTF-8 code)

	if (CSVfileHandle!=0) //*.csv file access successful
	{
		writelineEx(gBAP_Trace, 0,"Dateizugriff auf '%s' erfolgreich", CSV_filename);    //output result
		//get data from *.csv and store the total number of byte in *.csv-file
		Num_of_csv_byte = fileGetBinaryBlock (buffer_byte, elcount(buffer_byte), CSVfileHandle);

		for (filePos = 0; filePos < Num_of_csv_byte; filePos++) //copy data into "LastDestList"
		{
			if (buffer_byte[filePos] != 0x3B) //read data if no ";" is detected
			{
				//nextline in *.csv (next "record element" in LastDestList) -> "LF" and "CR" detected -> copy (transform string -> long) data from help values in global values
				if(buffer_byte[filePos] == 0x0D && buffer_byte[filePos+1] == 0x0A)
				{
					if(current_CSV_line > 0 && current_CSV_line < 256) //ignore first line in *.csv file
					{
						A_ASG_69_0_0_18_ArrayDataList[current_CSV_line-1].Param1 = atol(temp1); //Pos
						A_ASG_69_0_0_18_ArrayDataList[current_CSV_line-1].Param2 = atol(temp2); //Display
						A_ASG_69_0_0_18_ArrayDataList[current_CSV_line-1].Param3 = atol(temp3); //AdditionalInfo
						A_ASG_69_0_0_18_ArrayDataList[current_CSV_line-1].Param4 = atol(temp4); //Element
						A_ASG_69_0_0_18_ArrayDataList[current_CSV_line-1].Param5 = atol(temp5); //ElementContent
						for(i = 0; i < 25; i++)
						{ /* Temp-Puffer Initialisierung zur Vermeidung von Nebeneffekte */
							temp1[i]=0;
							temp2[i]=0;
							temp3[i]=0;
							temp4[i]=0;
							temp5[i]=0;
						}
					}
					current_CSV_line++; //next line in *.csv file
					element = 1; //start at 'POS' (first record element of "array data")
					paramPos = 0; //reset value
				}
 				//copy data from "buffer_byte" (data from *.csv file) in help values and "name" until end of line is not detected
				else if(current_CSV_line > 0 && current_CSV_line < 256)
				{
					//writelineEx(gBAP_Trace, 0, "Element %x  Index %x", element, j);
					switch (element)
					{
						case 1: //Pos
								if( paramPos >= elCount(temp1) ){
									writelineEx(gBAP_Trace, 0, "Param%x in Zeile %d in der Input CSV Datei, enthaelt mehr Zeichen als erlaubt. Bearbeitung abgebrochen!", element, current_CSV_line);
									return; //False
								}else{
									temp1[paramPos] = buffer_byte[filePos];
									paramPos++;
								}
							break;
						case 2: //Display
								if( paramPos >= elCount(temp2) ){
									writelineEx(gBAP_Trace, 0, "Param%x in Zeile %d in der Input CSV Datei, enthaelt mehr Zeichen als erlaubt. Bearbeitung abgebrochen!", element, current_CSV_line);
									return; //False
								}else{
									temp2[paramPos] = buffer_byte[filePos];
									paramPos++;
								}
							break;
						case 3: //AdditionalInfo
								if( paramPos >= elCount(temp3) ){
									writelineEx(gBAP_Trace, 0, "Param%x in Zeile %d in der Input CSV Datei, enthaelt mehr Zeichen als erlaubt. Bearbeitung abgebrochen!", element, current_CSV_line);
									return; //False
								}else{
									temp3[paramPos] = buffer_byte[filePos];
									paramPos++;
								}
							break;
						case 4: //Element
								if( paramPos >= elCount(temp4) ){
									writelineEx(gBAP_Trace, 0, "Param%x in Zeile %d in der Input CSV Datei, enthaelt mehr Zeichen als erlaubt. Bearbeitung abgebrochen!", element, current_CSV_line);
									return; //False
								}else{
									temp4[paramPos] = buffer_byte[filePos];
									paramPos++;
								}
							break;
						case 5: //ElementContent
								if( paramPos >= elCount(temp5) ){
									writelineEx(gBAP_Trace, 0, "Param%x in Zeile %d in der Input CSV Datei, enthaelt mehr Zeichen als erlaubt. Bearbeitung abgebrochen!", element, current_CSV_line);
									return; //False
								}else{
									temp5[paramPos] = buffer_byte[filePos];
									paramPos++;
								}
							break;
						case 6: //Extension
								if(paramPos < 1)
								{
									A_ASG_69_0_0_18_ArrayDataList[current_CSV_line-1].Param6[paramPos] = buffer_byte[filePos];
									A_ASG_69_0_0_18_ArrayDataList[current_CSV_line-1].Param6_Length = paramPos +1;
								}
								paramPos++;
						break;
						default:
						break;
					}
				}
			}
			else  // ";" is detected ->next record element of "array data"
			{
				//writelineEx(gBAP_Trace, 0, "naechstes Element %d Bytes",element);
				element++;
				paramPos=0; //reset value
			}
		}

		if(fileClose (CSVfileHandle) !=0) //close *.csv file
			writelineEx(gBAP_Trace, 0,"Datei '%s' geschlossen", CSV_filename); //output result
		else
			writelineEx(gBAP_Trace, 0,"Fehler beim Schliessen der Datei '%s'", CSV_filename);//output result
	}
	else //*.csv file access not successful
	{
		writelineEx(gBAP_Trace, 0,"Fehler beim Dateizugriff auf '%s'",CSV_filename); //output result
	}
}

on envVar A_ASG_69_0_0_18_loadArray_Btn
{
	char filePath[255];
	if (A_ASG_69_0_0_18_generateData_Btn_already_pressed == 0)
	{
		A_ASG_69_0_0_18_generateData_Btn_already_pressed = 1;
	}
	else
	{
		A_ASG_69_0_0_18_generateData_Btn_already_pressed = 0;
		getValue(A_ASG_69_0_0_18_fileSelector, filePath);
		if(0 == strlen(filePath))
		{
			writelineEx(gBAP_Trace, 0, "Invalid file path!");
		}
		else
		{
			A_ASG_69_0_0_18_LoadArray();
			writelineEx(gBAP_Trace, 0, "Load array from CSV file: %s", filePath);
		}
	}
	putValue(A_ASG_69_0_0_18_Data_1, A_ASG_69_0_0_18_ArrayDataList[ getValue( A_ASG_69_0_0_18_DataIndex) ].Param1);
	putValue(A_ASG_69_0_0_18_Data_2, A_ASG_69_0_0_18_ArrayDataList[ getValue( A_ASG_69_0_0_18_DataIndex) ].Param2);
	putValue(A_ASG_69_0_0_18_Data_3, A_ASG_69_0_0_18_ArrayDataList[ getValue( A_ASG_69_0_0_18_DataIndex) ].Param3);
	putValue(A_ASG_69_0_0_18_Data_4, A_ASG_69_0_0_18_ArrayDataList[ getValue( A_ASG_69_0_0_18_DataIndex) ].Param4);
	putValue(A_ASG_69_0_0_18_Data_5, A_ASG_69_0_0_18_ArrayDataList[ getValue( A_ASG_69_0_0_18_DataIndex) ].Param5);
	putValue(A_ASG_69_0_0_18_Data_6, A_ASG_69_0_0_18_ArrayDataList[ getValue( A_ASG_69_0_0_18_DataIndex) ].Param6, A_ASG_69_0_0_18_ArrayDataList[getValue(A_ASG_69_0_0_18_DataIndex)].Param6_Length);
}


on envVar A_ASG_69_0_0_18_generateData_Btn
{
	word i;
	dword elementsArray[7] = {1, 1, 1, 1, 1, 2, 2};
	byte elementsTypeArray[7] = {0, 0, 0, 0, 0, 0xE, 0xF};
	dword elementsMaxSizeArray[7] = {255, 2, 1, 20, 0xFF, 0, 0};
	byte tempArray[2295];
	if (A_ASG_69_0_0_18_generateData_Btn_already_pressed == 0)
	{
		A_ASG_69_0_0_18_generateData_Btn_already_pressed = 1;
	}
	else
	{
		initStruct(tempArray, elementsArray, elementsTypeArray, elementsMaxSizeArray, 18, 255 );
		for(i = 0; i < 255; i++)
		{
			memcpy(A_ASG_69_0_0_18_ArrayDataList[i], tempArray, (i * 9) );
			if(A_ASG_69_0_0_18_ArrayDataList[i].Param6_Length > 127 )
				A_ASG_69_0_0_18_Data_6_CntList[i] = 1;
		}
		A_ASG_69_0_0_18_generateData_Btn_already_pressed = 0;
	}
	putValue(A_ASG_69_0_0_18_Data_1, A_ASG_69_0_0_18_ArrayDataList[ getValue( A_ASG_69_0_0_18_DataIndex) ].Param1);
	putValue(A_ASG_69_0_0_18_Data_2, A_ASG_69_0_0_18_ArrayDataList[ getValue( A_ASG_69_0_0_18_DataIndex) ].Param2);
	putValue(A_ASG_69_0_0_18_Data_3, A_ASG_69_0_0_18_ArrayDataList[ getValue( A_ASG_69_0_0_18_DataIndex) ].Param3);
	putValue(A_ASG_69_0_0_18_Data_4, A_ASG_69_0_0_18_ArrayDataList[ getValue( A_ASG_69_0_0_18_DataIndex) ].Param4);
	putValue(A_ASG_69_0_0_18_Data_5, A_ASG_69_0_0_18_ArrayDataList[ getValue( A_ASG_69_0_0_18_DataIndex) ].Param5);
	putValue(A_ASG_69_0_0_18_Data_6, A_ASG_69_0_0_18_ArrayDataList[ getValue( A_ASG_69_0_0_18_DataIndex) ].Param6, A_ASG_69_0_0_18_ArrayDataList[getValue(A_ASG_69_0_0_18_DataIndex)].Param6_Length);
}
// HME generateCaplOnEnv (3131)
on envVar A_ASG_69_0_0_18_DataIndex
{
    long index;
    long maxIndex = 255-1;
    index = getValue(this);
    if(index >= maxIndex) index = maxIndex;
    else if(index < 0) index = 0;
    putValue(this, index);
    putValue(A_ASG_69_0_0_18_Data_1, A_ASG_69_0_0_18_ArrayDataList[index].Param1);
    putValue(A_ASG_69_0_0_18_Data_2, A_ASG_69_0_0_18_ArrayDataList[index].Param2);
    putValue(A_ASG_69_0_0_18_Data_3, A_ASG_69_0_0_18_ArrayDataList[index].Param3);
    putValue(A_ASG_69_0_0_18_Data_4, A_ASG_69_0_0_18_ArrayDataList[index].Param4);
    putValue(A_ASG_69_0_0_18_Data_5, A_ASG_69_0_0_18_ArrayDataList[index].Param5);
    putValue(A_ASG_69_0_0_18_Data_6_len, A_ASG_69_0_0_18_Data_6_LenList[index]);
    putValue(A_ASG_69_0_0_18_Data_6_cnt, A_ASG_69_0_0_18_Data_6_CntList[index]);
    putValue(A_ASG_69_0_0_18_Data_6, A_ASG_69_0_0_18_ArrayDataList[index].Param6, A_ASG_69_0_0_18_ArrayDataList[index].Param6_Length);

}
on envVar A_ASG_69_0_0_18_DataIndex_Incr
{
    long index;
    if(A_ASG_69_0_0_18_DataIndex_Incr_already_pressed == 0)
    {
        A_ASG_69_0_0_18_DataIndex_Incr_already_pressed = 1;
    }
    else
    {
        index = getValue(A_ASG_69_0_0_18_DataIndex);
        index++;
        putValue(A_ASG_69_0_0_18_DataIndex, index);
        A_ASG_69_0_0_18_DataIndex_Incr_already_pressed = 0;
    }
}
on envVar A_ASG_69_0_0_18_DataIndex_Decr
{
    long index;
    if(A_ASG_69_0_0_18_DataIndex_Decr_already_pressed == 0)
    {
        A_ASG_69_0_0_18_DataIndex_Decr_already_pressed = 1;
    }
    else
    {
        index = getValue(A_ASG_69_0_0_18_DataIndex);
        index--;
        putValue(A_ASG_69_0_0_18_DataIndex, index);
        A_ASG_69_0_0_18_DataIndex_Decr_already_pressed = 0;
    }
}
// HME generateCaplOnEnv (3160)
on envVar A_ASG_69_0_0_18_DataIndex_SetGet
{
    long index;
    long maxIndex = 255-1;
    index = getValue(this);
    if(index >= maxIndex) index = maxIndex;
    else if(index < 0) index = 0;
    putValue(this, index);
    putValue(A_ASG_69_0_0_18_Data_1_SetGet, A_ASG_69_0_0_18_ArrayDataList[index].Param1);
    putValue(A_ASG_69_0_0_18_Data_2_SetGet, A_ASG_69_0_0_18_ArrayDataList[index].Param2);
    putValue(A_ASG_69_0_0_18_Data_3_SetGet, A_ASG_69_0_0_18_ArrayDataList[index].Param3);
    putValue(A_ASG_69_0_0_18_Data_4_SetGet, A_ASG_69_0_0_18_ArrayDataList[index].Param4);
    putValue(A_ASG_69_0_0_18_Data_5_SetGet, A_ASG_69_0_0_18_ArrayDataList[index].Param5);
    putValue(A_ASG_69_0_0_18_Data_6_SetGet_len, A_ASG_69_0_0_18_Data_6_SetGet_LenList[index]);
    putValue(A_ASG_69_0_0_18_Data_6_SetGet_cnt, A_ASG_69_0_0_18_Data_6_SetGet_CntList[index]);
    putValue(A_ASG_69_0_0_18_Data_6_SetGet, A_ASG_69_0_0_18_ArrayDataList[index].Param6, A_ASG_69_0_0_18_ArrayDataList[index].Param6_Length);

}
on envVar A_ASG_69_0_0_18_DataIndex_SetGet_Incr
{
    long index;
    if(A_ASG_69_0_0_18_DataIndex_SetGet_Incr_already_pressed == 0)
    {
        A_ASG_69_0_0_18_DataIndex_SetGet_Incr_already_pressed = 1;
    }
    else
    {
        index = getValue(A_ASG_69_0_0_18_DataIndex_SetGet);
        index++;
        putValue(A_ASG_69_0_0_18_DataIndex_SetGet, index);
        A_ASG_69_0_0_18_DataIndex_SetGet_Incr_already_pressed = 0;
    }
}
on envVar A_ASG_69_0_0_18_DataIndex_SetGet_Decr
{
    long index;
    if(A_ASG_69_0_0_18_DataIndex_SetGet_Decr_already_pressed == 0)
    {
        A_ASG_69_0_0_18_DataIndex_SetGet_Decr_already_pressed = 1;
    }
    else
    {
        index = getValue(A_ASG_69_0_0_18_DataIndex_SetGet);
        index--;
        putValue(A_ASG_69_0_0_18_DataIndex_SetGet, index);
        A_ASG_69_0_0_18_DataIndex_SetGet_Decr_already_pressed = 0;
    }
}
// Man darf gleichzeitig nur Checkbox fuer SegmError oder IntertelegramError aktiviert werden
on envVar A_ASG_69_0_0_18_IntTlgEn
{
       if(getValue(this)) 
       {
           putValue(A_ASG_69_0_0_18_SegmEn,0);
           intertelegram_err(A_ASG_69_0_0_18_ID);
       }
       else
       {
           intertelegram_err_off(A_ASG_69_0_0_18_ID);
       }
}
// Man darf gleichzeitig nur Checkbox fuer SegmError oder IntertelegramError aktiviert werden
on envVar A_ASG_69_0_0_18_SegmEn
{
       if(getValue(this)) 
       {
           putValue(A_ASG_69_0_0_18_IntTlgEn,0);
           sequence_err(A_ASG_69_0_0_18_ID,getValueSize(A_ASG_69_0_0_18_SegmEn));
       }
       else
       {
              sequence_err_off(A_ASG_69_0_0_18_ID);
       }
}

// [XL] Ueberwachung der CheckBox fuer AT
on envVar A_ASG_69_0_0_18_AT
{
	if(getValue(this))
	{
		EnableControl(panel_name,"panel_A_ASG_69_0_0_18_Status",0);
	}
	else
	{
   	EnableControl(panel_name,"panel_A_ASG_69_0_0_18_Status",1);
 	}
}

A_ASG_69_0_0_18_DataInd()
{
    int currentPos;
    byte head[5];
    byte stringTempValue[65];
    int i;
    int j;
    int startVal;
    int elementsVal;
    byte recordAddressVal;
    byte transmitPosVal;
    long tempValue;
    long index;
    byte nibbleSetted;
    currentPos = 0;
    nibbleSetted = 0;
    //Einzelparameter: ASG_ID
    if(nibbleSetted == 1)
    {
        //voriger Parameter war ein Nibble, => second nibble, Pos incr und Flag zuruecksetzen
        tempValue = (gBAP_Indication_data[currentPos++] &0xF);
        nibbleSetted = 0;
    }
    else
    {
        //first nibble, kein increment, Flag setzen
        tempValue = ((gBAP_Indication_data[currentPos]>>4) &0xF);
        nibbleSetted = 1;
    }
    putValue(A_ASG_69_0_0_18_1, tempValue);
    //Einzelparameter: TAID
    if(nibbleSetted == 1)
    {
        //voriger Parameter war ein Nibble, => second nibble, Pos incr und Flag zuruecksetzen
        tempValue = (gBAP_Indication_data[currentPos++] &0xF);
        nibbleSetted = 0;
    }
    else
    {
        //first nibble, kein increment, Flag setzen
        tempValue = ((gBAP_Indication_data[currentPos]>>4) &0xF);
        nibbleSetted = 1;
    }
    putValue(A_ASG_69_0_0_18_2, tempValue);
    //Einzelparameter: TotalNumListElements
    //voriger Parameter war ein first nibble, bei 1 Byte Werten Position incr
    if(nibbleSetted == 1) currentPos++;
    nibbleSetted = 0;
    tempValue = gBAP_Indication_data[currentPos++];
    putValue(A_ASG_69_0_0_18_3, tempValue);
    //head Parameter
    if(gBAP_Indication_header[4] >= (3+currentPos))
    {
        if( (gBAP_Indication_data[currentPos] & 0x80) > 0)
            if(gBAP_Indication_header[4] >= (5+currentPos))
            {
                for(i = 0; i < 5; i++) head[i] = gBAP_Indication_data[currentPos++];
                putValue(A_ASG_69_0_0_18, head, 5);
                startVal = (head[2]<<8) | head[1];
                elementsVal = (head[4]<<8) | head[3];
            }
            else write("received Data Error");
        else
        {
            for(i = 0; i < 3; i++) head[i] = gBAP_Indication_data[currentPos++];
            putValue(A_ASG_69_0_0_18, head, 3);
                startVal = head[1];
                elementsVal = head[2];
        }
        recordAddressVal = head[0] & 0x0F;
        transmitPosVal = head[0] & 0x40;
    }
    //data Parameter
     nibbleSetted = 0;
    if( (head[0] & 0x20) == 0) { // array header: increasing indices (Direction = 0).
      if( (head[0] & 0x10) > 0) { // array header: first element is one after specified start element (Shift = 1, Direction = 0).
        startVal++;
      }
      for ( i = startVal ; i < startVal + elementsVal ; i++) {
        if ( i < 0 || i >= A_ASG_69_0_0_18_ArrayDataList_Length ) {
          write("Array index ausserhalb der Grenzen, Fct: 18");
          break;
        }
        if(nibbleSetted == 1) currentPos++;
        nibbleSetted = 0;
     if( (head[0]&0x40) == 0){ /* Transmit_Pos = 0, keine Positionsdaten */ }
     else
     {
        if( (head[0]&0x80) == 0)
        {
           //IndexSize = 0, Pos als 1 Byte Wert
           A_ASG_69_0_0_18_ArrayDataList[i].Param1 = gBAP_Indication_data[currentPos++];
        }
        else
        {
           //IndexSize = 1, Pos als 2 Byte Wert
           A_ASG_69_0_0_18_ArrayDataList[i].Param1 = ( gBAP_Indication_data[currentPos++] &0xFF) + ((gBAP_Indication_data[currentPos++] &0xFF)<<8);
        }
     }
      // 0 - es kann vorkommen, dass das if leer ist dies wuerde zum Fehler fuehren. => automatische generierung der 0
      if( 0 || 1 == recordAddressVal )
      {
        if(nibbleSetted == 1)
        {
            // second nibble, Increment und nibbleSetted reseten
            A_ASG_69_0_0_18_ArrayDataList[i].Param2= gBAP_Indication_data[currentPos] & 0x0F;
            currentPos++;
            nibbleSetted = 0;
        }
        else
        {
        // first nibble, kein Increment, nibbleSetted setzen
            A_ASG_69_0_0_18_ArrayDataList[i].Param2 = (gBAP_Indication_data[currentPos]>>4) & 0x0F;
            nibbleSetted = 1;
        }
      }
      // 0 - es kann vorkommen, dass das if leer ist dies wuerde zum Fehler fuehren. => automatische generierung der 0
      if( 0 || 1 == recordAddressVal )
      {
        if(nibbleSetted == 1)
        {
            // second nibble, Increment und nibbleSetted reseten
            A_ASG_69_0_0_18_ArrayDataList[i].Param3= gBAP_Indication_data[currentPos] & 0x0F;
            currentPos++;
            nibbleSetted = 0;
        }
        else
        {
        // first nibble, kein Increment, nibbleSetted setzen
            A_ASG_69_0_0_18_ArrayDataList[i].Param3 = (gBAP_Indication_data[currentPos]>>4) & 0x0F;
            nibbleSetted = 1;
        }
      }
      // 0 - es kann vorkommen, dass das if leer ist dies wuerde zum Fehler fuehren. => automatische generierung der 0
      if( 0 || 1 == recordAddressVal )
      {
        //Sollte vor einem 1 Byte Wert 1 Nibble kommen, muss der index um 1 incrementiert werden!
        if( nibbleSetted==1) currentPos++;
        nibbleSetted = 0;
        A_ASG_69_0_0_18_ArrayDataList[i].Param4 = (gBAP_Indication_data[currentPos++] & 0xFF);
      }
      // 0 - es kann vorkommen, dass das if leer ist dies wuerde zum Fehler fuehren. => automatische generierung der 0
      if( 0 || 1 == recordAddressVal || 2 == recordAddressVal )
      {
        //Sollte vor einem 1 Byte Wert 1 Nibble kommen, muss der index um 1 incrementiert werden!
        if( nibbleSetted==1) currentPos++;
        nibbleSetted = 0;
        A_ASG_69_0_0_18_ArrayDataList[i].Param5 = (gBAP_Indication_data[currentPos++] & 0xFF);
      }
      // 0 - es kann vorkommen, dass das if leer ist dies wuerde zum Fehler fuehren. => automatische generierung der 0
      if( 0 )
      {
        //Sollte vor einem String Wert 1 Nibble kommen, muss der index um 1 incrementiert werden!
        if( nibbleSetted==1) currentPos++;
        nibbleSetted = 0;
        if((gBAP_Indication_data[currentPos] & 0x80) >= 1)
        {
        	 A_ASG_69_0_0_18_Data_6_CntList[i] = 1;
            A_ASG_69_0_0_18_ArrayDataList[i].Param6_Length = ( (gBAP_Indication_data[currentPos++] & 0x7F) << 8) + (gBAP_Indication_data[currentPos++] & 0xFF);
        }
        else
        {
        	 A_ASG_69_0_0_18_Data_6_CntList[i] = 0;
            A_ASG_69_0_0_18_ArrayDataList[i].Param6_Length = gBAP_Indication_data[currentPos++] & 0x7F;
        }
        for(j = 0; j < A_ASG_69_0_0_18_ArrayDataList[i].Param6_Length; j++)
        {
            A_ASG_69_0_0_18_ArrayDataList[i].Param6[j] = gBAP_Indication_data[currentPos++];
        }
      }
      } // for
    } else { // array header: decreasing indices (Direction = 1).
      if( (head[0] & 0x10) > 0) { // array header: first element is one before specified start element (Shift = 1, Direction = 1).
        if(startVal != 0) {          startVal--;
        } else {
          startVal = A_ASG_69_0_0_18_ArrayDataList_Length -1;
        }
      }
      for ( i = startVal ; i > startVal - elementsVal ; i--) {
        if ( i < 0 || i >= A_ASG_69_0_0_18_ArrayDataList_Length ) {
          write("Array index ausserhalb der Grenzen, Fct: 18");
          break;
        }
        if(nibbleSetted == 1) currentPos++;
        nibbleSetted = 0;
     if( (head[0]&0x40) == 0){ /* Transmit_Pos = 0, keine Positionsdaten */ }
     else
     {
        if( (head[0]&0x80) == 0)
        {
           //IndexSize = 0, Pos als 1 Byte Wert
           A_ASG_69_0_0_18_ArrayDataList[i].Param1 = gBAP_Indication_data[currentPos++];
        }
        else
        {
           //IndexSize = 1, Pos als 2 Byte Wert
           A_ASG_69_0_0_18_ArrayDataList[i].Param1 = ( gBAP_Indication_data[currentPos++] &0xFF) + ((gBAP_Indication_data[currentPos++] &0xFF)<<8);
        }
     }
      // 0 - es kann vorkommen, dass das if leer ist dies wuerde zum Fehler fuehren. => automatische generierung der 0
      if( 0 || 1 == recordAddressVal )
      {
        if(nibbleSetted == 1)
        {
            // second nibble, Increment und nibbleSetted reseten
            A_ASG_69_0_0_18_ArrayDataList[i].Param2= gBAP_Indication_data[currentPos] & 0x0F;
            currentPos++;
            nibbleSetted = 0;
        }
        else
        {
        // first nibble, kein Increment, nibbleSetted setzen
            A_ASG_69_0_0_18_ArrayDataList[i].Param2 = (gBAP_Indication_data[currentPos]>>4) & 0x0F;
            nibbleSetted = 1;
        }
      }
      // 0 - es kann vorkommen, dass das if leer ist dies wuerde zum Fehler fuehren. => automatische generierung der 0
      if( 0 || 1 == recordAddressVal )
      {
        if(nibbleSetted == 1)
        {
            // second nibble, Increment und nibbleSetted reseten
            A_ASG_69_0_0_18_ArrayDataList[i].Param3= gBAP_Indication_data[currentPos] & 0x0F;
            currentPos++;
            nibbleSetted = 0;
        }
        else
        {
        // first nibble, kein Increment, nibbleSetted setzen
            A_ASG_69_0_0_18_ArrayDataList[i].Param3 = (gBAP_Indication_data[currentPos]>>4) & 0x0F;
            nibbleSetted = 1;
        }
      }
      // 0 - es kann vorkommen, dass das if leer ist dies wuerde zum Fehler fuehren. => automatische generierung der 0
      if( 0 || 1 == recordAddressVal )
      {
        //Sollte vor einem 1 Byte Wert 1 Nibble kommen, muss der index um 1 incrementiert werden!
        if( nibbleSetted==1) currentPos++;
        nibbleSetted = 0;
        A_ASG_69_0_0_18_ArrayDataList[i].Param4 = (gBAP_Indication_data[currentPos++] & 0xFF);
      }
      // 0 - es kann vorkommen, dass das if leer ist dies wuerde zum Fehler fuehren. => automatische generierung der 0
      if( 0 || 1 == recordAddressVal || 2 == recordAddressVal )
      {
        //Sollte vor einem 1 Byte Wert 1 Nibble kommen, muss der index um 1 incrementiert werden!
        if( nibbleSetted==1) currentPos++;
        nibbleSetted = 0;
        A_ASG_69_0_0_18_ArrayDataList[i].Param5 = (gBAP_Indication_data[currentPos++] & 0xFF);
      }
      // 0 - es kann vorkommen, dass das if leer ist dies wuerde zum Fehler fuehren. => automatische generierung der 0
      if( 0 )
      {
        //Sollte vor einem String Wert 1 Nibble kommen, muss der index um 1 incrementiert werden!
        if( nibbleSetted==1) currentPos++;
        nibbleSetted = 0;
        if((gBAP_Indication_data[currentPos] & 0x80) >= 1)
        {
        	 A_ASG_69_0_0_18_Data_6_CntList[i] = 1;
            A_ASG_69_0_0_18_ArrayDataList[i].Param6_Length = ( (gBAP_Indication_data[currentPos++] & 0x7F) << 8) + (gBAP_Indication_data[currentPos++] & 0xFF);
        }
        else
        {
        	 A_ASG_69_0_0_18_Data_6_CntList[i] = 0;
            A_ASG_69_0_0_18_ArrayDataList[i].Param6_Length = gBAP_Indication_data[currentPos++] & 0x7F;
        }
        for(j = 0; j < A_ASG_69_0_0_18_ArrayDataList[i].Param6_Length; j++)
        {
            A_ASG_69_0_0_18_ArrayDataList[i].Param6[j] = gBAP_Indication_data[currentPos++];
        }
      }
      } // for
    }
    nibbleSetted = 0;
index = getValue(A_ASG_69_0_0_18_DataIndex);
    putValue(A_ASG_69_0_0_18_Data_1, A_ASG_69_0_0_18_ArrayDataList[index].Param1);
    putValue(A_ASG_69_0_0_18_Data_2, A_ASG_69_0_0_18_ArrayDataList[index].Param2);
    putValue(A_ASG_69_0_0_18_Data_3, A_ASG_69_0_0_18_ArrayDataList[index].Param3);
    putValue(A_ASG_69_0_0_18_Data_4, A_ASG_69_0_0_18_ArrayDataList[index].Param4);
    putValue(A_ASG_69_0_0_18_Data_5, A_ASG_69_0_0_18_ArrayDataList[index].Param5);
    putValue(A_ASG_69_0_0_18_Data_6_len, A_ASG_69_0_0_18_Data_6_LenList[index]);
    putValue(A_ASG_69_0_0_18_Data_6_cnt, A_ASG_69_0_0_18_Data_6_CntList[index]);
    putValue(A_ASG_69_0_0_18_Data_6, A_ASG_69_0_0_18_ArrayDataList[index].Param6, A_ASG_69_0_0_18_ArrayDataList[index].Param6_Length);
}

A_ASG_69_0_0_18_ChangedInd()
{
    int currentPos;
    byte head[5];
    byte stringTempValue[65];
    int i;
    int j;
    int startVal;
    int elementsVal;
    byte recordAddressVal;
    byte transmitPosVal;
    long tempValue;
    long index;
    byte nibbleSetted;
    currentPos = 0;
    nibbleSetted = 0;
    //head Parameter
    if(gBAP_Indication_header[4] >= (3+currentPos))
    {
        if( (gBAP_Indication_data[currentPos] & 0x80) > 0)
            if(gBAP_Indication_header[4] >= (5+currentPos))
            {
                for(i = 0; i < 5; i++) head[i] = gBAP_Indication_data[currentPos++];
                putValue(A_ASG_69_0_0_18_Changed, head, 5);
                startVal = (head[2]<<8) | head[1];
                elementsVal = (head[4]<<8) | head[3];
            }
            else write("received Data Error");
        else
        {
            for(i = 0; i < 3; i++) head[i] = gBAP_Indication_data[currentPos++];
            putValue(A_ASG_69_0_0_18_Changed, head, 3);
                startVal = head[1];
                elementsVal = head[2];
        }
        recordAddressVal = head[0] & 0x0F;
        transmitPosVal = head[0] & 0x40;
    }
    //data Parameter
     nibbleSetted = 0;
    if( (head[0] & 0x20) == 0) { // array header: increasing indices (Direction = 0).
      if( (head[0] & 0x10) > 0) { // array header: first element is one after specified start element (Shift = 1, Direction = 0).
        startVal++;
      }
      for ( i = startVal ; i < startVal + elementsVal ; i++) {
        if ( i < 0 || i >= A_ASG_69_0_0_18_ArrayDataList_Length ) {
          write("Array index ausserhalb der Grenzen, Fct: 18");
          break;
        }
        if(nibbleSetted == 1) currentPos++;
        nibbleSetted = 0;
      } // for
    } else { // array header: decreasing indices (Direction = 1).
      if( (head[0] & 0x10) > 0) { // array header: first element is one before specified start element (Shift = 1, Direction = 1).
        if(startVal != 0) {          startVal--;
        } else {
          startVal = A_ASG_69_0_0_18_ArrayDataList_Length -1;
        }
      }
      for ( i = startVal ; i > startVal - elementsVal ; i--) {
        if ( i < 0 || i >= A_ASG_69_0_0_18_ArrayDataList_Length ) {
          write("Array index ausserhalb der Grenzen, Fct: 18");
          break;
        }
        if(nibbleSetted == 1) currentPos++;
        nibbleSetted = 0;
      } // for
    }
    nibbleSetted = 0;
index = getValue(A_ASG_69_0_0_18_DataIndex);
}




on envVar A_ASG_69_0_0_18_1
{
	byte superval[65];

	//Update Childvalue (Enum)
	byte thisval; // ASG_ID
	thisval = 0x0f & getValue(this);
}
// Ueberwachung der Darstellungsvariable der Range.
on envVar A_ASG_69_0_0_18_2_range // ElementContentSelection.TAID 
{
	@A_ASG_69_0_0_18_2 = @A_ASG_69_0_0_18_2_range - (0); // slider = range - min
}

on envVar A_ASG_69_0_0_18_2
{
	byte superval[65];

	//Update Childvalue (Number)
	byte thisval; // TAID
	float slider_value;

	slider_value = round(@A_ASG_69_0_0_18_2, 1.0);
	@A_ASG_69_0_0_18_2_range = slider_value + (0); // real value := slider value + range min.
	thisval = (byte)round((slider_value + (0) - (0)) / (1.0), 1); // bus value := (slider value + min - offset) / step.
}
// Ueberwachung der Darstellungsvariable der Range.
on envVar A_ASG_69_0_0_18_3_range // ElementContentSelection.TotalNumListElements 
{
	@A_ASG_69_0_0_18_3 = @A_ASG_69_0_0_18_3_range - (0); // slider = range - min
}

on envVar A_ASG_69_0_0_18_3
{
	byte superval[65];

	//Update Childvalue (Number)
	byte thisval; // TotalNumListElements
	float slider_value;

	slider_value = round(@A_ASG_69_0_0_18_3, 1.0);
	@A_ASG_69_0_0_18_3_range = slider_value + (0); // real value := slider value + range min.
	thisval = (byte)round((slider_value + (0) - (0)) / (1.0), 1); // bus value := (slider value + min - offset) / step.
}
// Ueberwachung der Darstellungsvariable der Range.
on envVar A_ASG_69_0_0_18_Data_1_range // ElementContentSelection.Pos 
{
	@A_ASG_69_0_0_18_Data_1 = @A_ASG_69_0_0_18_Data_1_range - (0); // slider = range - min
}

on envVar A_ASG_69_0_0_18_Data_1
{
	byte superval[65];

	//Update Childvalue (Number)
	byte thisval; // Pos
	float slider_value;

	slider_value = round(@A_ASG_69_0_0_18_Data_1, 1.0);
	@A_ASG_69_0_0_18_Data_1_range = slider_value + (0); // real value := slider value + range min.
	thisval = (byte)round((slider_value + (0) - (0)) / (1.0), 1); // bus value := (slider value + min - offset) / step.
    A_ASG_69_0_0_18_ArrayDataList[getValue(A_ASG_69_0_0_18_DataIndex)].Param1 = thisval;
}
// Ueberwachung der Darstellungsvariable der Range.
on envVar A_ASG_69_0_0_18_Data_2_range // ElementContentSelection.Display 
{
	@A_ASG_69_0_0_18_Data_2 = @A_ASG_69_0_0_18_Data_2_range - (1); // slider = range - min
}

on envVar A_ASG_69_0_0_18_Data_2
{
	byte superval[65];

	//Update Childvalue (Number)
	byte thisval; // Display
	float slider_value;

	slider_value = round(@A_ASG_69_0_0_18_Data_2, 1.0);
	@A_ASG_69_0_0_18_Data_2_range = slider_value + (1); // real value := slider value + range min.
	thisval = (byte)round((slider_value + (1) - (1)) / (1.0), 1); // bus value := (slider value + min - offset) / step.
    A_ASG_69_0_0_18_ArrayDataList[getValue(A_ASG_69_0_0_18_DataIndex)].Param2 = thisval;
}
// Ueberwachung der Darstellungsvariable der Range.
on envVar A_ASG_69_0_0_18_Data_3_range // ElementContentSelection.AdditionalInfo 
{
	@A_ASG_69_0_0_18_Data_3 = @A_ASG_69_0_0_18_Data_3_range - (1); // slider = range - min
}

on envVar A_ASG_69_0_0_18_Data_3
{
	byte superval[65];

	//Update Childvalue (Number)
	byte thisval; // AdditionalInfo
	float slider_value;

	slider_value = round(@A_ASG_69_0_0_18_Data_3, 1.0);
	@A_ASG_69_0_0_18_Data_3_range = slider_value + (1); // real value := slider value + range min.
	thisval = (byte)round((slider_value + (1) - (1)) / (1.0), 1); // bus value := (slider value + min - offset) / step.
    A_ASG_69_0_0_18_ArrayDataList[getValue(A_ASG_69_0_0_18_DataIndex)].Param3 = thisval;
}
// Ueberwachung der Darstellungsvariable der Range.
on envVar A_ASG_69_0_0_18_Data_4_range // ElementContentSelection.Element 
{
	@A_ASG_69_0_0_18_Data_4 = @A_ASG_69_0_0_18_Data_4_range - (1); // slider = range - min
}

on envVar A_ASG_69_0_0_18_Data_4
{
	byte superval[65];

	//Update Childvalue (Number)
	byte thisval; // Element
	float slider_value;

	slider_value = round(@A_ASG_69_0_0_18_Data_4, 1.0);
	@A_ASG_69_0_0_18_Data_4_range = slider_value + (1); // real value := slider value + range min.
	thisval = (byte)round((slider_value + (1) - (1)) / (1.0), 1); // bus value := (slider value + min - offset) / step.
    A_ASG_69_0_0_18_ArrayDataList[getValue(A_ASG_69_0_0_18_DataIndex)].Param4 = thisval;
}
on envVar A_ASG_69_0_0_18_Data_5
{
	byte superval[65];

	//Update Childvalue (Enum)
	byte thisval; // ElementContent
	thisval = getValue(this);
    A_ASG_69_0_0_18_ArrayDataList[getValue(A_ASG_69_0_0_18_DataIndex)].Param5 = thisval;
}

// Ueberwachung der CheckBox fuer String
on envVar  A_ASG_69_0_0_18_Data_6_cnt
{
	word len;
	byte cnt;
	len = getValue(A_ASG_69_0_0_18_Data_6_len);
	cnt = getValue(this);

    /* Cnt Wert im Array aktualisieren */
	 A_ASG_69_0_0_18_Data_6_CntList[ getValue(A_ASG_69_0_0_18_DataIndex) ] = cnt;

	/* wird nur gerufen, wenn check box deaktiviert mit Length>127*/ 
	if(cnt == 0) 
	{
		if(len > 127 )
		{
			putValue(A_ASG_69_0_0_18_Data_6_len, 127);
		}
	}

}


on envVar A_ASG_69_0_0_18_Data_6_len
{
	long thisval;
	byte cnt;
	thisval = getValue(this);
	cnt = getValue(A_ASG_69_0_0_18_Data_6_cnt);

	/* wenn die Laenge ausserhalb des erlaubten Bereich liegt, wird diese begrenzt */
	if(thisval > 1 || thisval < 0 )
	{
		writelineEx(gBAP_Trace, 0, "Eingegebene Laenge: %d von A_ASG_69_0_0_18_Data_6 ist ungueltig. Die max. erlaubte Laenge ist %d. ", thisval, 1);
		thisval = 1;
	}
	if( thisval >127)
	{
		putValue(A_ASG_69_0_0_18_Data_6_cnt, 1); /* Switch checkbox on */
	}

	A_ASG_69_0_0_18_ArrayDataList[getValue(A_ASG_69_0_0_18_DataIndex)].Param6_Length = thisval;
	A_ASG_69_0_0_18_Data_6_LenList[ getValue(A_ASG_69_0_0_18_DataIndex) ] = thisval;
	putValue(A_ASG_69_0_0_18_Data_6_len, thisval);

}

on envVar A_ASG_69_0_0_18_Data_6
{
	byte superval[65];

	//Update Childvalue (String)
	word i;
	byte thisval[2];
	getValue(this, thisval);
    for(i = 0; i < getValueSize(this); i++)
        A_ASG_69_0_0_18_ArrayDataList[getValue(A_ASG_69_0_0_18_DataIndex)].Param6[i] = thisval[i];
    A_ASG_69_0_0_18_ArrayDataList[getValue(A_ASG_69_0_0_18_DataIndex)].Param6_Length = getValueSize(this);
    A_ASG_69_0_0_18_Data_6_LenList[getValue(A_ASG_69_0_0_18_DataIndex)]= getValueSize(this);
    putValue(A_ASG_69_0_0_18_Data_6_len, getValueSize(this));
}
on envVar A_ASG_69_0_0_18_1_SetGet
{
	byte superval[64];

	//Update Childvalue (Enum)
	byte thisval; // ASG_ID
	thisval = 0x0f & getValue(this);
}
// Ueberwachung der Darstellungsvariable der Range.
on envVar A_ASG_69_0_0_18_2_SetGet_range // ElementContentSelection.TAID 
{
	@A_ASG_69_0_0_18_2_SetGet = @A_ASG_69_0_0_18_2_SetGet_range - (0); // slider = range - min
}

on envVar A_ASG_69_0_0_18_2_SetGet
{
	byte superval[64];

	//Update Childvalue (Number)
	byte thisval; // TAID
	float slider_value;

	slider_value = round(@A_ASG_69_0_0_18_2_SetGet, 1.0);
	@A_ASG_69_0_0_18_2_SetGet_range = slider_value + (0); // real value := slider value + range min.
	thisval = (byte)round((slider_value + (0) - (0)) / (1.0), 1); // bus value := (slider value + min - offset) / step.
}
// Ueberwachung der Darstellungsvariable der Range.
on envVar A_ASG_69_0_0_18_Data_1_SetGet_range // ElementContentSelection.Pos 
{
	@A_ASG_69_0_0_18_Data_1_SetGet = @A_ASG_69_0_0_18_Data_1_SetGet_range - (0); // slider = range - min
}

on envVar A_ASG_69_0_0_18_Data_1_SetGet
{
	byte superval[64];

	//Update Childvalue (Number)
	byte thisval; // Pos
	float slider_value;

	slider_value = round(@A_ASG_69_0_0_18_Data_1_SetGet, 1.0);
	@A_ASG_69_0_0_18_Data_1_SetGet_range = slider_value + (0); // real value := slider value + range min.
	thisval = (byte)round((slider_value + (0) - (0)) / (1.0), 1); // bus value := (slider value + min - offset) / step.
    A_ASG_69_0_0_18_ArrayDataList[getValue(A_ASG_69_0_0_18_DataIndex_SetGet)].Param1 = thisval;
}
// Ueberwachung der Darstellungsvariable der Range.
on envVar A_ASG_69_0_0_18_Data_2_SetGet_range // ElementContentSelection.Display 
{
	@A_ASG_69_0_0_18_Data_2_SetGet = @A_ASG_69_0_0_18_Data_2_SetGet_range - (1); // slider = range - min
}

on envVar A_ASG_69_0_0_18_Data_2_SetGet
{
	byte superval[64];

	//Update Childvalue (Number)
	byte thisval; // Display
	float slider_value;

	slider_value = round(@A_ASG_69_0_0_18_Data_2_SetGet, 1.0);
	@A_ASG_69_0_0_18_Data_2_SetGet_range = slider_value + (1); // real value := slider value + range min.
	thisval = (byte)round((slider_value + (1) - (1)) / (1.0), 1); // bus value := (slider value + min - offset) / step.
    A_ASG_69_0_0_18_ArrayDataList[getValue(A_ASG_69_0_0_18_DataIndex_SetGet)].Param2 = thisval;
}
// Ueberwachung der Darstellungsvariable der Range.
on envVar A_ASG_69_0_0_18_Data_3_SetGet_range // ElementContentSelection.AdditionalInfo 
{
	@A_ASG_69_0_0_18_Data_3_SetGet = @A_ASG_69_0_0_18_Data_3_SetGet_range - (1); // slider = range - min
}

on envVar A_ASG_69_0_0_18_Data_3_SetGet
{
	byte superval[64];

	//Update Childvalue (Number)
	byte thisval; // AdditionalInfo
	float slider_value;

	slider_value = round(@A_ASG_69_0_0_18_Data_3_SetGet, 1.0);
	@A_ASG_69_0_0_18_Data_3_SetGet_range = slider_value + (1); // real value := slider value + range min.
	thisval = (byte)round((slider_value + (1) - (1)) / (1.0), 1); // bus value := (slider value + min - offset) / step.
    A_ASG_69_0_0_18_ArrayDataList[getValue(A_ASG_69_0_0_18_DataIndex_SetGet)].Param3 = thisval;
}
// Ueberwachung der Darstellungsvariable der Range.
on envVar A_ASG_69_0_0_18_Data_4_SetGet_range // ElementContentSelection.Element 
{
	@A_ASG_69_0_0_18_Data_4_SetGet = @A_ASG_69_0_0_18_Data_4_SetGet_range - (1); // slider = range - min
}

on envVar A_ASG_69_0_0_18_Data_4_SetGet
{
	byte superval[64];

	//Update Childvalue (Number)
	byte thisval; // Element
	float slider_value;

	slider_value = round(@A_ASG_69_0_0_18_Data_4_SetGet, 1.0);
	@A_ASG_69_0_0_18_Data_4_SetGet_range = slider_value + (1); // real value := slider value + range min.
	thisval = (byte)round((slider_value + (1) - (1)) / (1.0), 1); // bus value := (slider value + min - offset) / step.
    A_ASG_69_0_0_18_ArrayDataList[getValue(A_ASG_69_0_0_18_DataIndex_SetGet)].Param4 = thisval;
}
on envVar A_ASG_69_0_0_18_Data_5_SetGet
{
	byte superval[64];

	//Update Childvalue (Enum)
	byte thisval; // ElementContent
	thisval = getValue(this);
    A_ASG_69_0_0_18_ArrayDataList[getValue(A_ASG_69_0_0_18_DataIndex_SetGet)].Param5 = thisval;
}

// Ueberwachung der CheckBox fuer String
on envVar  A_ASG_69_0_0_18_Data_6_SetGet_cnt
{
	word len;
	byte cnt;
	len = getValue(A_ASG_69_0_0_18_Data_6_SetGet_len);
	cnt = getValue(this);

    /* Cnt Wert im Array aktualisieren */
	 A_ASG_69_0_0_18_Data_6_SetGet_CntList[ getValue(A_ASG_69_0_0_18_DataIndex_SetGet) ] = cnt;

	/* wird nur gerufen, wenn check box deaktiviert mit Length>127*/ 
	if(cnt == 0) 
	{
		if(len > 127 )
		{
			putValue(A_ASG_69_0_0_18_Data_6_SetGet_len, 127);
		}
	}

}


on envVar A_ASG_69_0_0_18_Data_6_SetGet_len
{
	long thisval;
	byte cnt;
	thisval = getValue(this);
	cnt = getValue(A_ASG_69_0_0_18_Data_6_SetGet_cnt);

	/* wenn die Laenge ausserhalb des erlaubten Bereich liegt, wird diese begrenzt */
	if(thisval > 1 || thisval < 0 )
	{
		writelineEx(gBAP_Trace, 0, "Eingegebene Laenge: %d von A_ASG_69_0_0_18_Data_6_SetGet ist ungueltig. Die max. erlaubte Laenge ist %d. ", thisval, 1);
		thisval = 1;
	}
	if( thisval >127)
	{
		putValue(A_ASG_69_0_0_18_Data_6_SetGet_cnt, 1); /* Switch checkbox on */
	}

	A_ASG_69_0_0_18_ArrayDataList[getValue(A_ASG_69_0_0_18_DataIndex_SetGet)].Param6_Length = thisval;
	A_ASG_69_0_0_18_Data_6_SetGet_LenList[ getValue(A_ASG_69_0_0_18_DataIndex_SetGet) ] = thisval;
	putValue(A_ASG_69_0_0_18_Data_6_SetGet_len, thisval);

}

on envVar A_ASG_69_0_0_18_Data_6_SetGet
{
	byte superval[64];

	//Update Childvalue (String)
	word i;
	byte thisval[2];
	getValue(this, thisval);
    for(i = 0; i < getValueSize(this); i++)
        A_ASG_69_0_0_18_ArrayDataList[getValue(A_ASG_69_0_0_18_DataIndex_SetGet)].Param6[i] = thisval[i];
    A_ASG_69_0_0_18_ArrayDataList[getValue(A_ASG_69_0_0_18_DataIndex_SetGet)].Param6_Length = getValueSize(this);
    A_ASG_69_0_0_18_Data_6_SetGet_LenList[getValue(A_ASG_69_0_0_18_DataIndex_SetGet)]= getValueSize(this);
    putValue(A_ASG_69_0_0_18_Data_6_SetGet_len, getValueSize(this));
}
on envVar P_ASG_69_0_0_19Get_BTN
{
 if (P_ASG_69_0_0_19Get_BTN_already_pressed == 0)
  {
       putValue(P_ASG_69_0_0_19_ErrCode,0);
       SetControlBackColor(panel_name,"errField_P_ASG_69_0_0_19",MakeRGB(255,255,255));
       P_ASG_69_0_0_19Get_BTN_already_pressed = 1;
 }
 else
 {
       Request_Void(LSGID, P_ASG_69_0_0_19_ID, DataGet_REQ); 
       P_ASG_69_0_0_19Get_BTN_already_pressed = 0;
 }
}
on envVar P_ASG_69_0_0_19 // bus value of Display1Setup (19).
{
	// opcodes: Error-Status
	dword param1; // MainSetup
	byte param2; // DisplayedAdditionalInfos
	dword param3; // AdditionalInfo1_1
	dword param4; // AdditionalInfo1_2
	dword param5; // AdditionalInfo2_1
	dword param6; // AdditionalInfo2_2
	// DATATYPE_BYTESEQUENCE / DATATYPE_FIXEDBYTESEQUENCE
	int i;
	byte superval[21];
	int currentPos;
	currentPos = 0;
	for( i = 0; i < 21; i++ ) {
		superval[i] = 0;
	}
	getValue(P_ASG_69_0_0_19, superval);
	///////// Start param1 - UINT32 /////////
	param1 = superval[currentPos++]|(superval[currentPos++]<<8)|(superval[currentPos++]<<16)|(superval[currentPos++]<<24);
	putValue(P_ASG_69_0_0_19_1, param1);
	///////// Start param2 - UINT8 /////////
	param2 = superval[currentPos++];
	putValue(P_ASG_69_0_0_19_2, param2);
	///////// Start param3 - UINT32 /////////
	param3 = superval[currentPos++]|(superval[currentPos++]<<8)|(superval[currentPos++]<<16)|(superval[currentPos++]<<24);
	putValue(P_ASG_69_0_0_19_3, param3);
	///////// Start param4 - UINT32 /////////
	param4 = superval[currentPos++]|(superval[currentPos++]<<8)|(superval[currentPos++]<<16)|(superval[currentPos++]<<24);
	putValue(P_ASG_69_0_0_19_4, param4);
	///////// Start param5 - UINT32 /////////
	param5 = superval[currentPos++]|(superval[currentPos++]<<8)|(superval[currentPos++]<<16)|(superval[currentPos++]<<24);
	putValue(P_ASG_69_0_0_19_5, param5);
	///////// Start param6 - UINT32 /////////
	param6 = superval[currentPos++]|(superval[currentPos++]<<8)|(superval[currentPos++]<<16)|(superval[currentPos++]<<24);
	putValue(P_ASG_69_0_0_19_6, param6);
}

// Updates the bus value field and other dependencies.
P_ASG_69_0_0_19_BuildFct()
{
	dword param1; // MainSetup
	byte param2; // DisplayedAdditionalInfos
	dword param3; // AdditionalInfo1_1
	dword param4; // AdditionalInfo1_2
	dword param5; // AdditionalInfo2_1
	dword param6; // AdditionalInfo2_2

	int i;
	byte superval[21];
	int currentPos;
	currentPos = 0;
// gen_BuildFunc_SetSuperVals 
	param1 = getValue(P_ASG_69_0_0_19_1);
	@P_ASG_69_0_0_19_1_0 = (param1 & 1) > 0;
	@P_ASG_69_0_0_19_1_1 = (param1 & 2) > 0;
	@P_ASG_69_0_0_19_1_2 = (param1 & 4) > 0;
	@P_ASG_69_0_0_19_1_3 = (param1 & 8) > 0;
	@P_ASG_69_0_0_19_1_4 = (param1 & 16) > 0;
	@P_ASG_69_0_0_19_1_5 = (param1 & 32) > 0;
	@P_ASG_69_0_0_19_1_6 = (param1 & 64) > 0;
	@P_ASG_69_0_0_19_1_7 = (param1 & 128) > 0;
	@P_ASG_69_0_0_19_1_8 = (param1 & 256) > 0;
	@P_ASG_69_0_0_19_1_9 = (param1 & 512) > 0;
	@P_ASG_69_0_0_19_1_10 = (param1 & 1024) > 0;
	@P_ASG_69_0_0_19_1_11 = (param1 & 2048) > 0;
	@P_ASG_69_0_0_19_1_12 = (param1 & 4096) > 0;
	@P_ASG_69_0_0_19_1_13 = (param1 & 8192) > 0;
	@P_ASG_69_0_0_19_1_14 = (param1 & 16384) > 0;
	@P_ASG_69_0_0_19_1_15 = (param1 & 32768) > 0;
	@P_ASG_69_0_0_19_1_16 = (param1 & 65536) > 0;
	@P_ASG_69_0_0_19_1_17 = (param1 & 131072) > 0;
	@P_ASG_69_0_0_19_1_18 = (param1 & 262144) > 0;
	@P_ASG_69_0_0_19_1_19 = (param1 & 524288) > 0;
	@P_ASG_69_0_0_19_1_20 = (param1 & 1048576) > 0;
	@P_ASG_69_0_0_19_1_21 = (param1 & 2097152) > 0;
	@P_ASG_69_0_0_19_1_22 = (param1 & 4194304) > 0;
	@P_ASG_69_0_0_19_1_23 = (param1 & 8388608) > 0;
	@P_ASG_69_0_0_19_1_24 = (param1 & 16777216) > 0;
	@P_ASG_69_0_0_19_1_25 = (param1 & 33554432) > 0;
	@P_ASG_69_0_0_19_1_26 = (param1 & 67108864) > 0;
	@P_ASG_69_0_0_19_1_27 = (param1 & 134217728) > 0;
	@P_ASG_69_0_0_19_1_28 = (param1 & 268435456) > 0;
	@P_ASG_69_0_0_19_1_29 = (param1 & 536870912) > 0;
	superval[currentPos++]= param1&0x000000ff;
	superval[currentPos++]=(param1&0x0000ff00)>>8;
	superval[currentPos++]=(param1&0x00ff0000)>>16;
	superval[currentPos++]=(param1&0xff000000)>>24;
// gen_BuildFunc_SetSuperVals 
	param2 = getValue(P_ASG_69_0_0_19_2);
	@P_ASG_69_0_0_19_2_0 = (param2 & 1) > 0;
	@P_ASG_69_0_0_19_2_1 = (param2 & 2) > 0;
	superval[currentPos++]=param2;
// gen_BuildFunc_SetSuperVals 
	param3 = getValue(P_ASG_69_0_0_19_3);
	@P_ASG_69_0_0_19_3_0 = (param3 & 1) > 0;
	@P_ASG_69_0_0_19_3_1 = (param3 & 2) > 0;
	@P_ASG_69_0_0_19_3_2 = (param3 & 4) > 0;
	@P_ASG_69_0_0_19_3_3 = (param3 & 8) > 0;
	@P_ASG_69_0_0_19_3_4 = (param3 & 16) > 0;
	@P_ASG_69_0_0_19_3_5 = (param3 & 32) > 0;
	@P_ASG_69_0_0_19_3_6 = (param3 & 64) > 0;
	@P_ASG_69_0_0_19_3_7 = (param3 & 128) > 0;
	@P_ASG_69_0_0_19_3_8 = (param3 & 256) > 0;
	@P_ASG_69_0_0_19_3_9 = (param3 & 512) > 0;
	@P_ASG_69_0_0_19_3_10 = (param3 & 1024) > 0;
	@P_ASG_69_0_0_19_3_11 = (param3 & 2048) > 0;
	@P_ASG_69_0_0_19_3_12 = (param3 & 4096) > 0;
	@P_ASG_69_0_0_19_3_13 = (param3 & 8192) > 0;
	@P_ASG_69_0_0_19_3_14 = (param3 & 16384) > 0;
	@P_ASG_69_0_0_19_3_15 = (param3 & 32768) > 0;
	@P_ASG_69_0_0_19_3_16 = (param3 & 65536) > 0;
	@P_ASG_69_0_0_19_3_17 = (param3 & 131072) > 0;
	@P_ASG_69_0_0_19_3_18 = (param3 & 262144) > 0;
	@P_ASG_69_0_0_19_3_19 = (param3 & 524288) > 0;
	@P_ASG_69_0_0_19_3_20 = (param3 & 1048576) > 0;
	@P_ASG_69_0_0_19_3_21 = (param3 & 2097152) > 0;
	@P_ASG_69_0_0_19_3_22 = (param3 & 4194304) > 0;
	@P_ASG_69_0_0_19_3_23 = (param3 & 8388608) > 0;
	@P_ASG_69_0_0_19_3_24 = (param3 & 16777216) > 0;
	@P_ASG_69_0_0_19_3_25 = (param3 & 33554432) > 0;
	@P_ASG_69_0_0_19_3_26 = (param3 & 67108864) > 0;
	@P_ASG_69_0_0_19_3_27 = (param3 & 134217728) > 0;
	@P_ASG_69_0_0_19_3_28 = (param3 & 268435456) > 0;
	@P_ASG_69_0_0_19_3_29 = (param3 & 536870912) > 0;
	@P_ASG_69_0_0_19_3_30 = (param3 & 1073741824) > 0;
	@P_ASG_69_0_0_19_3_31 = (param3 & -2147483648) > 0;
	superval[currentPos++]= param3&0x000000ff;
	superval[currentPos++]=(param3&0x0000ff00)>>8;
	superval[currentPos++]=(param3&0x00ff0000)>>16;
	superval[currentPos++]=(param3&0xff000000)>>24;
// gen_BuildFunc_SetSuperVals 
	param4 = getValue(P_ASG_69_0_0_19_4);
	@P_ASG_69_0_0_19_4_0 = (param4 & 1) > 0;
	@P_ASG_69_0_0_19_4_1 = (param4 & 2) > 0;
	@P_ASG_69_0_0_19_4_2 = (param4 & 4) > 0;
	@P_ASG_69_0_0_19_4_3 = (param4 & 8) > 0;
	@P_ASG_69_0_0_19_4_4 = (param4 & 16) > 0;
	@P_ASG_69_0_0_19_4_5 = (param4 & 32) > 0;
	@P_ASG_69_0_0_19_4_6 = (param4 & 64) > 0;
	@P_ASG_69_0_0_19_4_7 = (param4 & 128) > 0;
	@P_ASG_69_0_0_19_4_8 = (param4 & 256) > 0;
	@P_ASG_69_0_0_19_4_9 = (param4 & 512) > 0;
	@P_ASG_69_0_0_19_4_10 = (param4 & 1024) > 0;
	@P_ASG_69_0_0_19_4_11 = (param4 & 2048) > 0;
	@P_ASG_69_0_0_19_4_12 = (param4 & 4096) > 0;
	@P_ASG_69_0_0_19_4_13 = (param4 & 8192) > 0;
	@P_ASG_69_0_0_19_4_14 = (param4 & 16384) > 0;
	@P_ASG_69_0_0_19_4_15 = (param4 & 32768) > 0;
	@P_ASG_69_0_0_19_4_16 = (param4 & 65536) > 0;
	@P_ASG_69_0_0_19_4_17 = (param4 & 131072) > 0;
	@P_ASG_69_0_0_19_4_18 = (param4 & 262144) > 0;
	@P_ASG_69_0_0_19_4_19 = (param4 & 524288) > 0;
	@P_ASG_69_0_0_19_4_20 = (param4 & 1048576) > 0;
	@P_ASG_69_0_0_19_4_21 = (param4 & 2097152) > 0;
	@P_ASG_69_0_0_19_4_22 = (param4 & 4194304) > 0;
	@P_ASG_69_0_0_19_4_23 = (param4 & 8388608) > 0;
	@P_ASG_69_0_0_19_4_24 = (param4 & 16777216) > 0;
	@P_ASG_69_0_0_19_4_25 = (param4 & 33554432) > 0;
	@P_ASG_69_0_0_19_4_26 = (param4 & 67108864) > 0;
	@P_ASG_69_0_0_19_4_27 = (param4 & 134217728) > 0;
	@P_ASG_69_0_0_19_4_28 = (param4 & 268435456) > 0;
	@P_ASG_69_0_0_19_4_29 = (param4 & 536870912) > 0;
	superval[currentPos++]= param4&0x000000ff;
	superval[currentPos++]=(param4&0x0000ff00)>>8;
	superval[currentPos++]=(param4&0x00ff0000)>>16;
	superval[currentPos++]=(param4&0xff000000)>>24;
// gen_BuildFunc_SetSuperVals 
	param5 = getValue(P_ASG_69_0_0_19_5);
	@P_ASG_69_0_0_19_5_0 = (param5 & 1) > 0;
	@P_ASG_69_0_0_19_5_1 = (param5 & 2) > 0;
	@P_ASG_69_0_0_19_5_2 = (param5 & 4) > 0;
	@P_ASG_69_0_0_19_5_3 = (param5 & 8) > 0;
	@P_ASG_69_0_0_19_5_4 = (param5 & 16) > 0;
	@P_ASG_69_0_0_19_5_5 = (param5 & 32) > 0;
	@P_ASG_69_0_0_19_5_6 = (param5 & 64) > 0;
	@P_ASG_69_0_0_19_5_7 = (param5 & 128) > 0;
	@P_ASG_69_0_0_19_5_8 = (param5 & 256) > 0;
	@P_ASG_69_0_0_19_5_9 = (param5 & 512) > 0;
	@P_ASG_69_0_0_19_5_10 = (param5 & 1024) > 0;
	@P_ASG_69_0_0_19_5_11 = (param5 & 2048) > 0;
	@P_ASG_69_0_0_19_5_12 = (param5 & 4096) > 0;
	@P_ASG_69_0_0_19_5_13 = (param5 & 8192) > 0;
	@P_ASG_69_0_0_19_5_14 = (param5 & 16384) > 0;
	@P_ASG_69_0_0_19_5_15 = (param5 & 32768) > 0;
	@P_ASG_69_0_0_19_5_16 = (param5 & 65536) > 0;
	@P_ASG_69_0_0_19_5_17 = (param5 & 131072) > 0;
	@P_ASG_69_0_0_19_5_18 = (param5 & 262144) > 0;
	@P_ASG_69_0_0_19_5_19 = (param5 & 524288) > 0;
	@P_ASG_69_0_0_19_5_20 = (param5 & 1048576) > 0;
	@P_ASG_69_0_0_19_5_21 = (param5 & 2097152) > 0;
	@P_ASG_69_0_0_19_5_22 = (param5 & 4194304) > 0;
	@P_ASG_69_0_0_19_5_23 = (param5 & 8388608) > 0;
	@P_ASG_69_0_0_19_5_24 = (param5 & 16777216) > 0;
	@P_ASG_69_0_0_19_5_25 = (param5 & 33554432) > 0;
	@P_ASG_69_0_0_19_5_26 = (param5 & 67108864) > 0;
	@P_ASG_69_0_0_19_5_27 = (param5 & 134217728) > 0;
	@P_ASG_69_0_0_19_5_28 = (param5 & 268435456) > 0;
	@P_ASG_69_0_0_19_5_29 = (param5 & 536870912) > 0;
	@P_ASG_69_0_0_19_5_30 = (param5 & 1073741824) > 0;
	@P_ASG_69_0_0_19_5_31 = (param5 & -2147483648) > 0;
	superval[currentPos++]= param5&0x000000ff;
	superval[currentPos++]=(param5&0x0000ff00)>>8;
	superval[currentPos++]=(param5&0x00ff0000)>>16;
	superval[currentPos++]=(param5&0xff000000)>>24;
// gen_BuildFunc_SetSuperVals 
	param6 = getValue(P_ASG_69_0_0_19_6);
	@P_ASG_69_0_0_19_6_0 = (param6 & 1) > 0;
	@P_ASG_69_0_0_19_6_1 = (param6 & 2) > 0;
	@P_ASG_69_0_0_19_6_2 = (param6 & 4) > 0;
	@P_ASG_69_0_0_19_6_3 = (param6 & 8) > 0;
	@P_ASG_69_0_0_19_6_4 = (param6 & 16) > 0;
	@P_ASG_69_0_0_19_6_5 = (param6 & 32) > 0;
	@P_ASG_69_0_0_19_6_6 = (param6 & 64) > 0;
	@P_ASG_69_0_0_19_6_7 = (param6 & 128) > 0;
	@P_ASG_69_0_0_19_6_8 = (param6 & 256) > 0;
	@P_ASG_69_0_0_19_6_9 = (param6 & 512) > 0;
	@P_ASG_69_0_0_19_6_10 = (param6 & 1024) > 0;
	@P_ASG_69_0_0_19_6_11 = (param6 & 2048) > 0;
	@P_ASG_69_0_0_19_6_12 = (param6 & 4096) > 0;
	@P_ASG_69_0_0_19_6_13 = (param6 & 8192) > 0;
	@P_ASG_69_0_0_19_6_14 = (param6 & 16384) > 0;
	@P_ASG_69_0_0_19_6_15 = (param6 & 32768) > 0;
	@P_ASG_69_0_0_19_6_16 = (param6 & 65536) > 0;
	@P_ASG_69_0_0_19_6_17 = (param6 & 131072) > 0;
	@P_ASG_69_0_0_19_6_18 = (param6 & 262144) > 0;
	@P_ASG_69_0_0_19_6_19 = (param6 & 524288) > 0;
	@P_ASG_69_0_0_19_6_20 = (param6 & 1048576) > 0;
	@P_ASG_69_0_0_19_6_21 = (param6 & 2097152) > 0;
	@P_ASG_69_0_0_19_6_22 = (param6 & 4194304) > 0;
	@P_ASG_69_0_0_19_6_23 = (param6 & 8388608) > 0;
	@P_ASG_69_0_0_19_6_24 = (param6 & 16777216) > 0;
	@P_ASG_69_0_0_19_6_25 = (param6 & 33554432) > 0;
	@P_ASG_69_0_0_19_6_26 = (param6 & 67108864) > 0;
	@P_ASG_69_0_0_19_6_27 = (param6 & 134217728) > 0;
	@P_ASG_69_0_0_19_6_28 = (param6 & 268435456) > 0;
	@P_ASG_69_0_0_19_6_29 = (param6 & 536870912) > 0;
	superval[currentPos++]= param6&0x000000ff;
	superval[currentPos++]=(param6&0x0000ff00)>>8;
	superval[currentPos++]=(param6&0x00ff0000)>>16;
	superval[currentPos++]=(param6&0xff000000)>>24;
	putValue(P_ASG_69_0_0_19, superval, currentPos);
}


on envVar P_ASG_69_0_0_19_1_0
{
	byte bitval;
	//thisval steht hier fuer den bitfield-wert, 
	//aus Generierungsgruenden hier keine einheitliche Bezeichnung moeglich.
	dword thisval; // MainSetup
	bitval= getValue(this);
	thisval = getValue(P_ASG_69_0_0_19_1);
	thisval = thisval&~(1<<0)|(bitval<<0);
	putValue(P_ASG_69_0_0_19_1,thisval);
}

on envVar P_ASG_69_0_0_19_1_1
{
	byte bitval;
	//thisval steht hier fuer den bitfield-wert, 
	//aus Generierungsgruenden hier keine einheitliche Bezeichnung moeglich.
	dword thisval; // MainSetup
	bitval= getValue(this);
	thisval = getValue(P_ASG_69_0_0_19_1);
	thisval = thisval&~(1<<1)|(bitval<<1);
	putValue(P_ASG_69_0_0_19_1,thisval);
}

on envVar P_ASG_69_0_0_19_1_2
{
	byte bitval;
	//thisval steht hier fuer den bitfield-wert, 
	//aus Generierungsgruenden hier keine einheitliche Bezeichnung moeglich.
	dword thisval; // MainSetup
	bitval= getValue(this);
	thisval = getValue(P_ASG_69_0_0_19_1);
	thisval = thisval&~(1<<2)|(bitval<<2);
	putValue(P_ASG_69_0_0_19_1,thisval);
}

on envVar P_ASG_69_0_0_19_1_3
{
	byte bitval;
	//thisval steht hier fuer den bitfield-wert, 
	//aus Generierungsgruenden hier keine einheitliche Bezeichnung moeglich.
	dword thisval; // MainSetup
	bitval= getValue(this);
	thisval = getValue(P_ASG_69_0_0_19_1);
	thisval = thisval&~(1<<3)|(bitval<<3);
	putValue(P_ASG_69_0_0_19_1,thisval);
}

on envVar P_ASG_69_0_0_19_1_4
{
	byte bitval;
	//thisval steht hier fuer den bitfield-wert, 
	//aus Generierungsgruenden hier keine einheitliche Bezeichnung moeglich.
	dword thisval; // MainSetup
	bitval= getValue(this);
	thisval = getValue(P_ASG_69_0_0_19_1);
	thisval = thisval&~(1<<4)|(bitval<<4);
	putValue(P_ASG_69_0_0_19_1,thisval);
}

on envVar P_ASG_69_0_0_19_1_5
{
	byte bitval;
	//thisval steht hier fuer den bitfield-wert, 
	//aus Generierungsgruenden hier keine einheitliche Bezeichnung moeglich.
	dword thisval; // MainSetup
	bitval= getValue(this);
	thisval = getValue(P_ASG_69_0_0_19_1);
	thisval = thisval&~(1<<5)|(bitval<<5);
	putValue(P_ASG_69_0_0_19_1,thisval);
}

on envVar P_ASG_69_0_0_19_1_6
{
	byte bitval;
	//thisval steht hier fuer den bitfield-wert, 
	//aus Generierungsgruenden hier keine einheitliche Bezeichnung moeglich.
	dword thisval; // MainSetup
	bitval= getValue(this);
	thisval = getValue(P_ASG_69_0_0_19_1);
	thisval = thisval&~(1<<6)|(bitval<<6);
	putValue(P_ASG_69_0_0_19_1,thisval);
}

on envVar P_ASG_69_0_0_19_1_7
{
	byte bitval;
	//thisval steht hier fuer den bitfield-wert, 
	//aus Generierungsgruenden hier keine einheitliche Bezeichnung moeglich.
	dword thisval; // MainSetup
	bitval= getValue(this);
	thisval = getValue(P_ASG_69_0_0_19_1);
	thisval = thisval&~(1<<7)|(bitval<<7);
	putValue(P_ASG_69_0_0_19_1,thisval);
}

on envVar P_ASG_69_0_0_19_1_8
{
	byte bitval;
	//thisval steht hier fuer den bitfield-wert, 
	//aus Generierungsgruenden hier keine einheitliche Bezeichnung moeglich.
	dword thisval; // MainSetup
	bitval= getValue(this);
	thisval = getValue(P_ASG_69_0_0_19_1);
	thisval = thisval&~(1<<8)|(bitval<<8);
	putValue(P_ASG_69_0_0_19_1,thisval);
}

on envVar P_ASG_69_0_0_19_1_9
{
	byte bitval;
	//thisval steht hier fuer den bitfield-wert, 
	//aus Generierungsgruenden hier keine einheitliche Bezeichnung moeglich.
	dword thisval; // MainSetup
	bitval= getValue(this);
	thisval = getValue(P_ASG_69_0_0_19_1);
	thisval = thisval&~(1<<9)|(bitval<<9);
	putValue(P_ASG_69_0_0_19_1,thisval);
}

on envVar P_ASG_69_0_0_19_1_10
{
	byte bitval;
	//thisval steht hier fuer den bitfield-wert, 
	//aus Generierungsgruenden hier keine einheitliche Bezeichnung moeglich.
	dword thisval; // MainSetup
	bitval= getValue(this);
	thisval = getValue(P_ASG_69_0_0_19_1);
	thisval = thisval&~(1<<10)|(bitval<<10);
	putValue(P_ASG_69_0_0_19_1,thisval);
}

on envVar P_ASG_69_0_0_19_1_11
{
	byte bitval;
	//thisval steht hier fuer den bitfield-wert, 
	//aus Generierungsgruenden hier keine einheitliche Bezeichnung moeglich.
	dword thisval; // MainSetup
	bitval= getValue(this);
	thisval = getValue(P_ASG_69_0_0_19_1);
	thisval = thisval&~(1<<11)|(bitval<<11);
	putValue(P_ASG_69_0_0_19_1,thisval);
}

on envVar P_ASG_69_0_0_19_1_12
{
	byte bitval;
	//thisval steht hier fuer den bitfield-wert, 
	//aus Generierungsgruenden hier keine einheitliche Bezeichnung moeglich.
	dword thisval; // MainSetup
	bitval= getValue(this);
	thisval = getValue(P_ASG_69_0_0_19_1);
	thisval = thisval&~(1<<12)|(bitval<<12);
	putValue(P_ASG_69_0_0_19_1,thisval);
}

on envVar P_ASG_69_0_0_19_1_13
{
	byte bitval;
	//thisval steht hier fuer den bitfield-wert, 
	//aus Generierungsgruenden hier keine einheitliche Bezeichnung moeglich.
	dword thisval; // MainSetup
	bitval= getValue(this);
	thisval = getValue(P_ASG_69_0_0_19_1);
	thisval = thisval&~(1<<13)|(bitval<<13);
	putValue(P_ASG_69_0_0_19_1,thisval);
}

on envVar P_ASG_69_0_0_19_1_14
{
	byte bitval;
	//thisval steht hier fuer den bitfield-wert, 
	//aus Generierungsgruenden hier keine einheitliche Bezeichnung moeglich.
	dword thisval; // MainSetup
	bitval= getValue(this);
	thisval = getValue(P_ASG_69_0_0_19_1);
	thisval = thisval&~(1<<14)|(bitval<<14);
	putValue(P_ASG_69_0_0_19_1,thisval);
}

on envVar P_ASG_69_0_0_19_1_15
{
	byte bitval;
	//thisval steht hier fuer den bitfield-wert, 
	//aus Generierungsgruenden hier keine einheitliche Bezeichnung moeglich.
	dword thisval; // MainSetup
	bitval= getValue(this);
	thisval = getValue(P_ASG_69_0_0_19_1);
	thisval = thisval&~(1<<15)|(bitval<<15);
	putValue(P_ASG_69_0_0_19_1,thisval);
}

on envVar P_ASG_69_0_0_19_1_16
{
	byte bitval;
	//thisval steht hier fuer den bitfield-wert, 
	//aus Generierungsgruenden hier keine einheitliche Bezeichnung moeglich.
	dword thisval; // MainSetup
	bitval= getValue(this);
	thisval = getValue(P_ASG_69_0_0_19_1);
	thisval = thisval&~(1<<16)|(bitval<<16);
	putValue(P_ASG_69_0_0_19_1,thisval);
}

on envVar P_ASG_69_0_0_19_1_17
{
	byte bitval;
	//thisval steht hier fuer den bitfield-wert, 
	//aus Generierungsgruenden hier keine einheitliche Bezeichnung moeglich.
	dword thisval; // MainSetup
	bitval= getValue(this);
	thisval = getValue(P_ASG_69_0_0_19_1);
	thisval = thisval&~(1<<17)|(bitval<<17);
	putValue(P_ASG_69_0_0_19_1,thisval);
}

on envVar P_ASG_69_0_0_19_1_18
{
	byte bitval;
	//thisval steht hier fuer den bitfield-wert, 
	//aus Generierungsgruenden hier keine einheitliche Bezeichnung moeglich.
	dword thisval; // MainSetup
	bitval= getValue(this);
	thisval = getValue(P_ASG_69_0_0_19_1);
	thisval = thisval&~(1<<18)|(bitval<<18);
	putValue(P_ASG_69_0_0_19_1,thisval);
}

on envVar P_ASG_69_0_0_19_1_19
{
	byte bitval;
	//thisval steht hier fuer den bitfield-wert, 
	//aus Generierungsgruenden hier keine einheitliche Bezeichnung moeglich.
	dword thisval; // MainSetup
	bitval= getValue(this);
	thisval = getValue(P_ASG_69_0_0_19_1);
	thisval = thisval&~(1<<19)|(bitval<<19);
	putValue(P_ASG_69_0_0_19_1,thisval);
}

on envVar P_ASG_69_0_0_19_1_20
{
	byte bitval;
	//thisval steht hier fuer den bitfield-wert, 
	//aus Generierungsgruenden hier keine einheitliche Bezeichnung moeglich.
	dword thisval; // MainSetup
	bitval= getValue(this);
	thisval = getValue(P_ASG_69_0_0_19_1);
	thisval = thisval&~(1<<20)|(bitval<<20);
	putValue(P_ASG_69_0_0_19_1,thisval);
}

on envVar P_ASG_69_0_0_19_1_21
{
	byte bitval;
	//thisval steht hier fuer den bitfield-wert, 
	//aus Generierungsgruenden hier keine einheitliche Bezeichnung moeglich.
	dword thisval; // MainSetup
	bitval= getValue(this);
	thisval = getValue(P_ASG_69_0_0_19_1);
	thisval = thisval&~(1<<21)|(bitval<<21);
	putValue(P_ASG_69_0_0_19_1,thisval);
}

on envVar P_ASG_69_0_0_19_1_22
{
	byte bitval;
	//thisval steht hier fuer den bitfield-wert, 
	//aus Generierungsgruenden hier keine einheitliche Bezeichnung moeglich.
	dword thisval; // MainSetup
	bitval= getValue(this);
	thisval = getValue(P_ASG_69_0_0_19_1);
	thisval = thisval&~(1<<22)|(bitval<<22);
	putValue(P_ASG_69_0_0_19_1,thisval);
}

on envVar P_ASG_69_0_0_19_1_23
{
	byte bitval;
	//thisval steht hier fuer den bitfield-wert, 
	//aus Generierungsgruenden hier keine einheitliche Bezeichnung moeglich.
	dword thisval; // MainSetup
	bitval= getValue(this);
	thisval = getValue(P_ASG_69_0_0_19_1);
	thisval = thisval&~(1<<23)|(bitval<<23);
	putValue(P_ASG_69_0_0_19_1,thisval);
}

on envVar P_ASG_69_0_0_19_1_24
{
	byte bitval;
	//thisval steht hier fuer den bitfield-wert, 
	//aus Generierungsgruenden hier keine einheitliche Bezeichnung moeglich.
	dword thisval; // MainSetup
	bitval= getValue(this);
	thisval = getValue(P_ASG_69_0_0_19_1);
	thisval = thisval&~(1<<24)|(bitval<<24);
	putValue(P_ASG_69_0_0_19_1,thisval);
}

on envVar P_ASG_69_0_0_19_1_25
{
	byte bitval;
	//thisval steht hier fuer den bitfield-wert, 
	//aus Generierungsgruenden hier keine einheitliche Bezeichnung moeglich.
	dword thisval; // MainSetup
	bitval= getValue(this);
	thisval = getValue(P_ASG_69_0_0_19_1);
	thisval = thisval&~(1<<25)|(bitval<<25);
	putValue(P_ASG_69_0_0_19_1,thisval);
}

on envVar P_ASG_69_0_0_19_1_26
{
	byte bitval;
	//thisval steht hier fuer den bitfield-wert, 
	//aus Generierungsgruenden hier keine einheitliche Bezeichnung moeglich.
	dword thisval; // MainSetup
	bitval= getValue(this);
	thisval = getValue(P_ASG_69_0_0_19_1);
	thisval = thisval&~(1<<26)|(bitval<<26);
	putValue(P_ASG_69_0_0_19_1,thisval);
}

on envVar P_ASG_69_0_0_19_1_27
{
	byte bitval;
	//thisval steht hier fuer den bitfield-wert, 
	//aus Generierungsgruenden hier keine einheitliche Bezeichnung moeglich.
	dword thisval; // MainSetup
	bitval= getValue(this);
	thisval = getValue(P_ASG_69_0_0_19_1);
	thisval = thisval&~(1<<27)|(bitval<<27);
	putValue(P_ASG_69_0_0_19_1,thisval);
}

on envVar P_ASG_69_0_0_19_1_28
{
	byte bitval;
	//thisval steht hier fuer den bitfield-wert, 
	//aus Generierungsgruenden hier keine einheitliche Bezeichnung moeglich.
	dword thisval; // MainSetup
	bitval= getValue(this);
	thisval = getValue(P_ASG_69_0_0_19_1);
	thisval = thisval&~(1<<28)|(bitval<<28);
	putValue(P_ASG_69_0_0_19_1,thisval);
}

on envVar P_ASG_69_0_0_19_1_29
{
	byte bitval;
	//thisval steht hier fuer den bitfield-wert, 
	//aus Generierungsgruenden hier keine einheitliche Bezeichnung moeglich.
	dword thisval; // MainSetup
	bitval= getValue(this);
	thisval = getValue(P_ASG_69_0_0_19_1);
	thisval = thisval&~(1<<29)|(bitval<<29);
	putValue(P_ASG_69_0_0_19_1,thisval);
}

on envVar P_ASG_69_0_0_19_1 // Display1Setup.MainSetup
{
	P_ASG_69_0_0_19_BuildFct();
}

on envVar P_ASG_69_0_0_19_2_0
{
	byte bitval;
	//thisval steht hier fuer den bitfield-wert, 
	//aus Generierungsgruenden hier keine einheitliche Bezeichnung moeglich.
	byte thisval; // DisplayedAdditionalInfos
	bitval= getValue(this);
	thisval = getValue(P_ASG_69_0_0_19_2);
	thisval = thisval&~(1<<0)|(bitval<<0);
	putValue(P_ASG_69_0_0_19_2,thisval);
}

on envVar P_ASG_69_0_0_19_2_1
{
	byte bitval;
	//thisval steht hier fuer den bitfield-wert, 
	//aus Generierungsgruenden hier keine einheitliche Bezeichnung moeglich.
	byte thisval; // DisplayedAdditionalInfos
	bitval= getValue(this);
	thisval = getValue(P_ASG_69_0_0_19_2);
	thisval = thisval&~(1<<1)|(bitval<<1);
	putValue(P_ASG_69_0_0_19_2,thisval);
}

on envVar P_ASG_69_0_0_19_2 // Display1Setup.DisplayedAdditionalInfos
{
	P_ASG_69_0_0_19_BuildFct();
}

on envVar P_ASG_69_0_0_19_3_0
{
	byte bitval;
	//thisval steht hier fuer den bitfield-wert, 
	//aus Generierungsgruenden hier keine einheitliche Bezeichnung moeglich.
	dword thisval; // AdditionalInfo1_1
	bitval= getValue(this);
	thisval = getValue(P_ASG_69_0_0_19_3);
	thisval = thisval&~(1<<0)|(bitval<<0);
	putValue(P_ASG_69_0_0_19_3,thisval);
}

on envVar P_ASG_69_0_0_19_3_1
{
	byte bitval;
	//thisval steht hier fuer den bitfield-wert, 
	//aus Generierungsgruenden hier keine einheitliche Bezeichnung moeglich.
	dword thisval; // AdditionalInfo1_1
	bitval= getValue(this);
	thisval = getValue(P_ASG_69_0_0_19_3);
	thisval = thisval&~(1<<1)|(bitval<<1);
	putValue(P_ASG_69_0_0_19_3,thisval);
}

on envVar P_ASG_69_0_0_19_3_2
{
	byte bitval;
	//thisval steht hier fuer den bitfield-wert, 
	//aus Generierungsgruenden hier keine einheitliche Bezeichnung moeglich.
	dword thisval; // AdditionalInfo1_1
	bitval= getValue(this);
	thisval = getValue(P_ASG_69_0_0_19_3);
	thisval = thisval&~(1<<2)|(bitval<<2);
	putValue(P_ASG_69_0_0_19_3,thisval);
}

on envVar P_ASG_69_0_0_19_3_3
{
	byte bitval;
	//thisval steht hier fuer den bitfield-wert, 
	//aus Generierungsgruenden hier keine einheitliche Bezeichnung moeglich.
	dword thisval; // AdditionalInfo1_1
	bitval= getValue(this);
	thisval = getValue(P_ASG_69_0_0_19_3);
	thisval = thisval&~(1<<3)|(bitval<<3);
	putValue(P_ASG_69_0_0_19_3,thisval);
}

on envVar P_ASG_69_0_0_19_3_4
{
	byte bitval;
	//thisval steht hier fuer den bitfield-wert, 
	//aus Generierungsgruenden hier keine einheitliche Bezeichnung moeglich.
	dword thisval; // AdditionalInfo1_1
	bitval= getValue(this);
	thisval = getValue(P_ASG_69_0_0_19_3);
	thisval = thisval&~(1<<4)|(bitval<<4);
	putValue(P_ASG_69_0_0_19_3,thisval);
}

on envVar P_ASG_69_0_0_19_3_5
{
	byte bitval;
	//thisval steht hier fuer den bitfield-wert, 
	//aus Generierungsgruenden hier keine einheitliche Bezeichnung moeglich.
	dword thisval; // AdditionalInfo1_1
	bitval= getValue(this);
	thisval = getValue(P_ASG_69_0_0_19_3);
	thisval = thisval&~(1<<5)|(bitval<<5);
	putValue(P_ASG_69_0_0_19_3,thisval);
}

on envVar P_ASG_69_0_0_19_3_6
{
	byte bitval;
	//thisval steht hier fuer den bitfield-wert, 
	//aus Generierungsgruenden hier keine einheitliche Bezeichnung moeglich.
	dword thisval; // AdditionalInfo1_1
	bitval= getValue(this);
	thisval = getValue(P_ASG_69_0_0_19_3);
	thisval = thisval&~(1<<6)|(bitval<<6);
	putValue(P_ASG_69_0_0_19_3,thisval);
}

on envVar P_ASG_69_0_0_19_3_7
{
	byte bitval;
	//thisval steht hier fuer den bitfield-wert, 
	//aus Generierungsgruenden hier keine einheitliche Bezeichnung moeglich.
	dword thisval; // AdditionalInfo1_1
	bitval= getValue(this);
	thisval = getValue(P_ASG_69_0_0_19_3);
	thisval = thisval&~(1<<7)|(bitval<<7);
	putValue(P_ASG_69_0_0_19_3,thisval);
}

on envVar P_ASG_69_0_0_19_3_8
{
	byte bitval;
	//thisval steht hier fuer den bitfield-wert, 
	//aus Generierungsgruenden hier keine einheitliche Bezeichnung moeglich.
	dword thisval; // AdditionalInfo1_1
	bitval= getValue(this);
	thisval = getValue(P_ASG_69_0_0_19_3);
	thisval = thisval&~(1<<8)|(bitval<<8);
	putValue(P_ASG_69_0_0_19_3,thisval);
}

on envVar P_ASG_69_0_0_19_3_9
{
	byte bitval;
	//thisval steht hier fuer den bitfield-wert, 
	//aus Generierungsgruenden hier keine einheitliche Bezeichnung moeglich.
	dword thisval; // AdditionalInfo1_1
	bitval= getValue(this);
	thisval = getValue(P_ASG_69_0_0_19_3);
	thisval = thisval&~(1<<9)|(bitval<<9);
	putValue(P_ASG_69_0_0_19_3,thisval);
}

on envVar P_ASG_69_0_0_19_3_10
{
	byte bitval;
	//thisval steht hier fuer den bitfield-wert, 
	//aus Generierungsgruenden hier keine einheitliche Bezeichnung moeglich.
	dword thisval; // AdditionalInfo1_1
	bitval= getValue(this);
	thisval = getValue(P_ASG_69_0_0_19_3);
	thisval = thisval&~(1<<10)|(bitval<<10);
	putValue(P_ASG_69_0_0_19_3,thisval);
}

on envVar P_ASG_69_0_0_19_3_11
{
	byte bitval;
	//thisval steht hier fuer den bitfield-wert, 
	//aus Generierungsgruenden hier keine einheitliche Bezeichnung moeglich.
	dword thisval; // AdditionalInfo1_1
	bitval= getValue(this);
	thisval = getValue(P_ASG_69_0_0_19_3);
	thisval = thisval&~(1<<11)|(bitval<<11);
	putValue(P_ASG_69_0_0_19_3,thisval);
}

on envVar P_ASG_69_0_0_19_3_12
{
	byte bitval;
	//thisval steht hier fuer den bitfield-wert, 
	//aus Generierungsgruenden hier keine einheitliche Bezeichnung moeglich.
	dword thisval; // AdditionalInfo1_1
	bitval= getValue(this);
	thisval = getValue(P_ASG_69_0_0_19_3);
	thisval = thisval&~(1<<12)|(bitval<<12);
	putValue(P_ASG_69_0_0_19_3,thisval);
}

on envVar P_ASG_69_0_0_19_3_13
{
	byte bitval;
	//thisval steht hier fuer den bitfield-wert, 
	//aus Generierungsgruenden hier keine einheitliche Bezeichnung moeglich.
	dword thisval; // AdditionalInfo1_1
	bitval= getValue(this);
	thisval = getValue(P_ASG_69_0_0_19_3);
	thisval = thisval&~(1<<13)|(bitval<<13);
	putValue(P_ASG_69_0_0_19_3,thisval);
}

on envVar P_ASG_69_0_0_19_3_14
{
	byte bitval;
	//thisval steht hier fuer den bitfield-wert, 
	//aus Generierungsgruenden hier keine einheitliche Bezeichnung moeglich.
	dword thisval; // AdditionalInfo1_1
	bitval= getValue(this);
	thisval = getValue(P_ASG_69_0_0_19_3);
	thisval = thisval&~(1<<14)|(bitval<<14);
	putValue(P_ASG_69_0_0_19_3,thisval);
}

on envVar P_ASG_69_0_0_19_3_15
{
	byte bitval;
	//thisval steht hier fuer den bitfield-wert, 
	//aus Generierungsgruenden hier keine einheitliche Bezeichnung moeglich.
	dword thisval; // AdditionalInfo1_1
	bitval= getValue(this);
	thisval = getValue(P_ASG_69_0_0_19_3);
	thisval = thisval&~(1<<15)|(bitval<<15);
	putValue(P_ASG_69_0_0_19_3,thisval);
}

on envVar P_ASG_69_0_0_19_3_16
{
	byte bitval;
	//thisval steht hier fuer den bitfield-wert, 
	//aus Generierungsgruenden hier keine einheitliche Bezeichnung moeglich.
	dword thisval; // AdditionalInfo1_1
	bitval= getValue(this);
	thisval = getValue(P_ASG_69_0_0_19_3);
	thisval = thisval&~(1<<16)|(bitval<<16);
	putValue(P_ASG_69_0_0_19_3,thisval);
}

on envVar P_ASG_69_0_0_19_3_17
{
	byte bitval;
	//thisval steht hier fuer den bitfield-wert, 
	//aus Generierungsgruenden hier keine einheitliche Bezeichnung moeglich.
	dword thisval; // AdditionalInfo1_1
	bitval= getValue(this);
	thisval = getValue(P_ASG_69_0_0_19_3);
	thisval = thisval&~(1<<17)|(bitval<<17);
	putValue(P_ASG_69_0_0_19_3,thisval);
}

on envVar P_ASG_69_0_0_19_3_18
{
	byte bitval;
	//thisval steht hier fuer den bitfield-wert, 
	//aus Generierungsgruenden hier keine einheitliche Bezeichnung moeglich.
	dword thisval; // AdditionalInfo1_1
	bitval= getValue(this);
	thisval = getValue(P_ASG_69_0_0_19_3);
	thisval = thisval&~(1<<18)|(bitval<<18);
	putValue(P_ASG_69_0_0_19_3,thisval);
}

on envVar P_ASG_69_0_0_19_3_19
{
	byte bitval;
	//thisval steht hier fuer den bitfield-wert, 
	//aus Generierungsgruenden hier keine einheitliche Bezeichnung moeglich.
	dword thisval; // AdditionalInfo1_1
	bitval= getValue(this);
	thisval = getValue(P_ASG_69_0_0_19_3);
	thisval = thisval&~(1<<19)|(bitval<<19);
	putValue(P_ASG_69_0_0_19_3,thisval);
}

on envVar P_ASG_69_0_0_19_3_20
{
	byte bitval;
	//thisval steht hier fuer den bitfield-wert, 
	//aus Generierungsgruenden hier keine einheitliche Bezeichnung moeglich.
	dword thisval; // AdditionalInfo1_1
	bitval= getValue(this);
	thisval = getValue(P_ASG_69_0_0_19_3);
	thisval = thisval&~(1<<20)|(bitval<<20);
	putValue(P_ASG_69_0_0_19_3,thisval);
}

on envVar P_ASG_69_0_0_19_3_21
{
	byte bitval;
	//thisval steht hier fuer den bitfield-wert, 
	//aus Generierungsgruenden hier keine einheitliche Bezeichnung moeglich.
	dword thisval; // AdditionalInfo1_1
	bitval= getValue(this);
	thisval = getValue(P_ASG_69_0_0_19_3);
	thisval = thisval&~(1<<21)|(bitval<<21);
	putValue(P_ASG_69_0_0_19_3,thisval);
}

on envVar P_ASG_69_0_0_19_3_22
{
	byte bitval;
	//thisval steht hier fuer den bitfield-wert, 
	//aus Generierungsgruenden hier keine einheitliche Bezeichnung moeglich.
	dword thisval; // AdditionalInfo1_1
	bitval= getValue(this);
	thisval = getValue(P_ASG_69_0_0_19_3);
	thisval = thisval&~(1<<22)|(bitval<<22);
	putValue(P_ASG_69_0_0_19_3,thisval);
}

on envVar P_ASG_69_0_0_19_3_23
{
	byte bitval;
	//thisval steht hier fuer den bitfield-wert, 
	//aus Generierungsgruenden hier keine einheitliche Bezeichnung moeglich.
	dword thisval; // AdditionalInfo1_1
	bitval= getValue(this);
	thisval = getValue(P_ASG_69_0_0_19_3);
	thisval = thisval&~(1<<23)|(bitval<<23);
	putValue(P_ASG_69_0_0_19_3,thisval);
}

on envVar P_ASG_69_0_0_19_3_24
{
	byte bitval;
	//thisval steht hier fuer den bitfield-wert, 
	//aus Generierungsgruenden hier keine einheitliche Bezeichnung moeglich.
	dword thisval; // AdditionalInfo1_1
	bitval= getValue(this);
	thisval = getValue(P_ASG_69_0_0_19_3);
	thisval = thisval&~(1<<24)|(bitval<<24);
	putValue(P_ASG_69_0_0_19_3,thisval);
}

on envVar P_ASG_69_0_0_19_3_25
{
	byte bitval;
	//thisval steht hier fuer den bitfield-wert, 
	//aus Generierungsgruenden hier keine einheitliche Bezeichnung moeglich.
	dword thisval; // AdditionalInfo1_1
	bitval= getValue(this);
	thisval = getValue(P_ASG_69_0_0_19_3);
	thisval = thisval&~(1<<25)|(bitval<<25);
	putValue(P_ASG_69_0_0_19_3,thisval);
}

on envVar P_ASG_69_0_0_19_3_26
{
	byte bitval;
	//thisval steht hier fuer den bitfield-wert, 
	//aus Generierungsgruenden hier keine einheitliche Bezeichnung moeglich.
	dword thisval; // AdditionalInfo1_1
	bitval= getValue(this);
	thisval = getValue(P_ASG_69_0_0_19_3);
	thisval = thisval&~(1<<26)|(bitval<<26);
	putValue(P_ASG_69_0_0_19_3,thisval);
}

on envVar P_ASG_69_0_0_19_3_27
{
	byte bitval;
	//thisval steht hier fuer den bitfield-wert, 
	//aus Generierungsgruenden hier keine einheitliche Bezeichnung moeglich.
	dword thisval; // AdditionalInfo1_1
	bitval= getValue(this);
	thisval = getValue(P_ASG_69_0_0_19_3);
	thisval = thisval&~(1<<27)|(bitval<<27);
	putValue(P_ASG_69_0_0_19_3,thisval);
}

on envVar P_ASG_69_0_0_19_3_28
{
	byte bitval;
	//thisval steht hier fuer den bitfield-wert, 
	//aus Generierungsgruenden hier keine einheitliche Bezeichnung moeglich.
	dword thisval; // AdditionalInfo1_1
	bitval= getValue(this);
	thisval = getValue(P_ASG_69_0_0_19_3);
	thisval = thisval&~(1<<28)|(bitval<<28);
	putValue(P_ASG_69_0_0_19_3,thisval);
}

on envVar P_ASG_69_0_0_19_3_29
{
	byte bitval;
	//thisval steht hier fuer den bitfield-wert, 
	//aus Generierungsgruenden hier keine einheitliche Bezeichnung moeglich.
	dword thisval; // AdditionalInfo1_1
	bitval= getValue(this);
	thisval = getValue(P_ASG_69_0_0_19_3);
	thisval = thisval&~(1<<29)|(bitval<<29);
	putValue(P_ASG_69_0_0_19_3,thisval);
}

on envVar P_ASG_69_0_0_19_3_30
{
	byte bitval;
	//thisval steht hier fuer den bitfield-wert, 
	//aus Generierungsgruenden hier keine einheitliche Bezeichnung moeglich.
	dword thisval; // AdditionalInfo1_1
	bitval= getValue(this);
	thisval = getValue(P_ASG_69_0_0_19_3);
	thisval = thisval&~(1<<30)|(bitval<<30);
	putValue(P_ASG_69_0_0_19_3,thisval);
}

on envVar P_ASG_69_0_0_19_3_31
{
	byte bitval;
	//thisval steht hier fuer den bitfield-wert, 
	//aus Generierungsgruenden hier keine einheitliche Bezeichnung moeglich.
	dword thisval; // AdditionalInfo1_1
	bitval= getValue(this);
	thisval = getValue(P_ASG_69_0_0_19_3);
	thisval = thisval&~(1<<31)|(bitval<<31);
	putValue(P_ASG_69_0_0_19_3,thisval);
}

on envVar P_ASG_69_0_0_19_3 // Display1Setup.AdditionalInfo1_1
{
	P_ASG_69_0_0_19_BuildFct();
}

on envVar P_ASG_69_0_0_19_4_0
{
	byte bitval;
	//thisval steht hier fuer den bitfield-wert, 
	//aus Generierungsgruenden hier keine einheitliche Bezeichnung moeglich.
	dword thisval; // AdditionalInfo1_2
	bitval= getValue(this);
	thisval = getValue(P_ASG_69_0_0_19_4);
	thisval = thisval&~(1<<0)|(bitval<<0);
	putValue(P_ASG_69_0_0_19_4,thisval);
}

on envVar P_ASG_69_0_0_19_4_1
{
	byte bitval;
	//thisval steht hier fuer den bitfield-wert, 
	//aus Generierungsgruenden hier keine einheitliche Bezeichnung moeglich.
	dword thisval; // AdditionalInfo1_2
	bitval= getValue(this);
	thisval = getValue(P_ASG_69_0_0_19_4);
	thisval = thisval&~(1<<1)|(bitval<<1);
	putValue(P_ASG_69_0_0_19_4,thisval);
}

on envVar P_ASG_69_0_0_19_4_2
{
	byte bitval;
	//thisval steht hier fuer den bitfield-wert, 
	//aus Generierungsgruenden hier keine einheitliche Bezeichnung moeglich.
	dword thisval; // AdditionalInfo1_2
	bitval= getValue(this);
	thisval = getValue(P_ASG_69_0_0_19_4);
	thisval = thisval&~(1<<2)|(bitval<<2);
	putValue(P_ASG_69_0_0_19_4,thisval);
}

on envVar P_ASG_69_0_0_19_4_3
{
	byte bitval;
	//thisval steht hier fuer den bitfield-wert, 
	//aus Generierungsgruenden hier keine einheitliche Bezeichnung moeglich.
	dword thisval; // AdditionalInfo1_2
	bitval= getValue(this);
	thisval = getValue(P_ASG_69_0_0_19_4);
	thisval = thisval&~(1<<3)|(bitval<<3);
	putValue(P_ASG_69_0_0_19_4,thisval);
}

on envVar P_ASG_69_0_0_19_4_4
{
	byte bitval;
	//thisval steht hier fuer den bitfield-wert, 
	//aus Generierungsgruenden hier keine einheitliche Bezeichnung moeglich.
	dword thisval; // AdditionalInfo1_2
	bitval= getValue(this);
	thisval = getValue(P_ASG_69_0_0_19_4);
	thisval = thisval&~(1<<4)|(bitval<<4);
	putValue(P_ASG_69_0_0_19_4,thisval);
}

on envVar P_ASG_69_0_0_19_4_5
{
	byte bitval;
	//thisval steht hier fuer den bitfield-wert, 
	//aus Generierungsgruenden hier keine einheitliche Bezeichnung moeglich.
	dword thisval; // AdditionalInfo1_2
	bitval= getValue(this);
	thisval = getValue(P_ASG_69_0_0_19_4);
	thisval = thisval&~(1<<5)|(bitval<<5);
	putValue(P_ASG_69_0_0_19_4,thisval);
}

on envVar P_ASG_69_0_0_19_4_6
{
	byte bitval;
	//thisval steht hier fuer den bitfield-wert, 
	//aus Generierungsgruenden hier keine einheitliche Bezeichnung moeglich.
	dword thisval; // AdditionalInfo1_2
	bitval= getValue(this);
	thisval = getValue(P_ASG_69_0_0_19_4);
	thisval = thisval&~(1<<6)|(bitval<<6);
	putValue(P_ASG_69_0_0_19_4,thisval);
}

on envVar P_ASG_69_0_0_19_4_7
{
	byte bitval;
	//thisval steht hier fuer den bitfield-wert, 
	//aus Generierungsgruenden hier keine einheitliche Bezeichnung moeglich.
	dword thisval; // AdditionalInfo1_2
	bitval= getValue(this);
	thisval = getValue(P_ASG_69_0_0_19_4);
	thisval = thisval&~(1<<7)|(bitval<<7);
	putValue(P_ASG_69_0_0_19_4,thisval);
}

on envVar P_ASG_69_0_0_19_4_8
{
	byte bitval;
	//thisval steht hier fuer den bitfield-wert, 
	//aus Generierungsgruenden hier keine einheitliche Bezeichnung moeglich.
	dword thisval; // AdditionalInfo1_2
	bitval= getValue(this);
	thisval = getValue(P_ASG_69_0_0_19_4);
	thisval = thisval&~(1<<8)|(bitval<<8);
	putValue(P_ASG_69_0_0_19_4,thisval);
}

on envVar P_ASG_69_0_0_19_4_9
{
	byte bitval;
	//thisval steht hier fuer den bitfield-wert, 
	//aus Generierungsgruenden hier keine einheitliche Bezeichnung moeglich.
	dword thisval; // AdditionalInfo1_2
	bitval= getValue(this);
	thisval = getValue(P_ASG_69_0_0_19_4);
	thisval = thisval&~(1<<9)|(bitval<<9);
	putValue(P_ASG_69_0_0_19_4,thisval);
}

on envVar P_ASG_69_0_0_19_4_10
{
	byte bitval;
	//thisval steht hier fuer den bitfield-wert, 
	//aus Generierungsgruenden hier keine einheitliche Bezeichnung moeglich.
	dword thisval; // AdditionalInfo1_2
	bitval= getValue(this);
	thisval = getValue(P_ASG_69_0_0_19_4);
	thisval = thisval&~(1<<10)|(bitval<<10);
	putValue(P_ASG_69_0_0_19_4,thisval);
}

on envVar P_ASG_69_0_0_19_4_11
{
	byte bitval;
	//thisval steht hier fuer den bitfield-wert, 
	//aus Generierungsgruenden hier keine einheitliche Bezeichnung moeglich.
	dword thisval; // AdditionalInfo1_2
	bitval= getValue(this);
	thisval = getValue(P_ASG_69_0_0_19_4);
	thisval = thisval&~(1<<11)|(bitval<<11);
	putValue(P_ASG_69_0_0_19_4,thisval);
}

on envVar P_ASG_69_0_0_19_4_12
{
	byte bitval;
	//thisval steht hier fuer den bitfield-wert, 
	//aus Generierungsgruenden hier keine einheitliche Bezeichnung moeglich.
	dword thisval; // AdditionalInfo1_2
	bitval= getValue(this);
	thisval = getValue(P_ASG_69_0_0_19_4);
	thisval = thisval&~(1<<12)|(bitval<<12);
	putValue(P_ASG_69_0_0_19_4,thisval);
}

on envVar P_ASG_69_0_0_19_4_13
{
	byte bitval;
	//thisval steht hier fuer den bitfield-wert, 
	//aus Generierungsgruenden hier keine einheitliche Bezeichnung moeglich.
	dword thisval; // AdditionalInfo1_2
	bitval= getValue(this);
	thisval = getValue(P_ASG_69_0_0_19_4);
	thisval = thisval&~(1<<13)|(bitval<<13);
	putValue(P_ASG_69_0_0_19_4,thisval);
}

on envVar P_ASG_69_0_0_19_4_14
{
	byte bitval;
	//thisval steht hier fuer den bitfield-wert, 
	//aus Generierungsgruenden hier keine einheitliche Bezeichnung moeglich.
	dword thisval; // AdditionalInfo1_2
	bitval= getValue(this);
	thisval = getValue(P_ASG_69_0_0_19_4);
	thisval = thisval&~(1<<14)|(bitval<<14);
	putValue(P_ASG_69_0_0_19_4,thisval);
}

on envVar P_ASG_69_0_0_19_4_15
{
	byte bitval;
	//thisval steht hier fuer den bitfield-wert, 
	//aus Generierungsgruenden hier keine einheitliche Bezeichnung moeglich.
	dword thisval; // AdditionalInfo1_2
	bitval= getValue(this);
	thisval = getValue(P_ASG_69_0_0_19_4);
	thisval = thisval&~(1<<15)|(bitval<<15);
	putValue(P_ASG_69_0_0_19_4,thisval);
}

on envVar P_ASG_69_0_0_19_4_16
{
	byte bitval;
	//thisval steht hier fuer den bitfield-wert, 
	//aus Generierungsgruenden hier keine einheitliche Bezeichnung moeglich.
	dword thisval; // AdditionalInfo1_2
	bitval= getValue(this);
	thisval = getValue(P_ASG_69_0_0_19_4);
	thisval = thisval&~(1<<16)|(bitval<<16);
	putValue(P_ASG_69_0_0_19_4,thisval);
}

on envVar P_ASG_69_0_0_19_4_17
{
	byte bitval;
	//thisval steht hier fuer den bitfield-wert, 
	//aus Generierungsgruenden hier keine einheitliche Bezeichnung moeglich.
	dword thisval; // AdditionalInfo1_2
	bitval= getValue(this);
	thisval = getValue(P_ASG_69_0_0_19_4);
	thisval = thisval&~(1<<17)|(bitval<<17);
	putValue(P_ASG_69_0_0_19_4,thisval);
}

on envVar P_ASG_69_0_0_19_4_18
{
	byte bitval;
	//thisval steht hier fuer den bitfield-wert, 
	//aus Generierungsgruenden hier keine einheitliche Bezeichnung moeglich.
	dword thisval; // AdditionalInfo1_2
	bitval= getValue(this);
	thisval = getValue(P_ASG_69_0_0_19_4);
	thisval = thisval&~(1<<18)|(bitval<<18);
	putValue(P_ASG_69_0_0_19_4,thisval);
}

on envVar P_ASG_69_0_0_19_4_19
{
	byte bitval;
	//thisval steht hier fuer den bitfield-wert, 
	//aus Generierungsgruenden hier keine einheitliche Bezeichnung moeglich.
	dword thisval; // AdditionalInfo1_2
	bitval= getValue(this);
	thisval = getValue(P_ASG_69_0_0_19_4);
	thisval = thisval&~(1<<19)|(bitval<<19);
	putValue(P_ASG_69_0_0_19_4,thisval);
}

on envVar P_ASG_69_0_0_19_4_20
{
	byte bitval;
	//thisval steht hier fuer den bitfield-wert, 
	//aus Generierungsgruenden hier keine einheitliche Bezeichnung moeglich.
	dword thisval; // AdditionalInfo1_2
	bitval= getValue(this);
	thisval = getValue(P_ASG_69_0_0_19_4);
	thisval = thisval&~(1<<20)|(bitval<<20);
	putValue(P_ASG_69_0_0_19_4,thisval);
}

on envVar P_ASG_69_0_0_19_4_21
{
	byte bitval;
	//thisval steht hier fuer den bitfield-wert, 
	//aus Generierungsgruenden hier keine einheitliche Bezeichnung moeglich.
	dword thisval; // AdditionalInfo1_2
	bitval= getValue(this);
	thisval = getValue(P_ASG_69_0_0_19_4);
	thisval = thisval&~(1<<21)|(bitval<<21);
	putValue(P_ASG_69_0_0_19_4,thisval);
}

on envVar P_ASG_69_0_0_19_4_22
{
	byte bitval;
	//thisval steht hier fuer den bitfield-wert, 
	//aus Generierungsgruenden hier keine einheitliche Bezeichnung moeglich.
	dword thisval; // AdditionalInfo1_2
	bitval= getValue(this);
	thisval = getValue(P_ASG_69_0_0_19_4);
	thisval = thisval&~(1<<22)|(bitval<<22);
	putValue(P_ASG_69_0_0_19_4,thisval);
}

on envVar P_ASG_69_0_0_19_4_23
{
	byte bitval;
	//thisval steht hier fuer den bitfield-wert, 
	//aus Generierungsgruenden hier keine einheitliche Bezeichnung moeglich.
	dword thisval; // AdditionalInfo1_2
	bitval= getValue(this);
	thisval = getValue(P_ASG_69_0_0_19_4);
	thisval = thisval&~(1<<23)|(bitval<<23);
	putValue(P_ASG_69_0_0_19_4,thisval);
}

on envVar P_ASG_69_0_0_19_4_24
{
	byte bitval;
	//thisval steht hier fuer den bitfield-wert, 
	//aus Generierungsgruenden hier keine einheitliche Bezeichnung moeglich.
	dword thisval; // AdditionalInfo1_2
	bitval= getValue(this);
	thisval = getValue(P_ASG_69_0_0_19_4);
	thisval = thisval&~(1<<24)|(bitval<<24);
	putValue(P_ASG_69_0_0_19_4,thisval);
}

on envVar P_ASG_69_0_0_19_4_25
{
	byte bitval;
	//thisval steht hier fuer den bitfield-wert, 
	//aus Generierungsgruenden hier keine einheitliche Bezeichnung moeglich.
	dword thisval; // AdditionalInfo1_2
	bitval= getValue(this);
	thisval = getValue(P_ASG_69_0_0_19_4);
	thisval = thisval&~(1<<25)|(bitval<<25);
	putValue(P_ASG_69_0_0_19_4,thisval);
}

on envVar P_ASG_69_0_0_19_4_26
{
	byte bitval;
	//thisval steht hier fuer den bitfield-wert, 
	//aus Generierungsgruenden hier keine einheitliche Bezeichnung moeglich.
	dword thisval; // AdditionalInfo1_2
	bitval= getValue(this);
	thisval = getValue(P_ASG_69_0_0_19_4);
	thisval = thisval&~(1<<26)|(bitval<<26);
	putValue(P_ASG_69_0_0_19_4,thisval);
}

on envVar P_ASG_69_0_0_19_4_27
{
	byte bitval;
	//thisval steht hier fuer den bitfield-wert, 
	//aus Generierungsgruenden hier keine einheitliche Bezeichnung moeglich.
	dword thisval; // AdditionalInfo1_2
	bitval= getValue(this);
	thisval = getValue(P_ASG_69_0_0_19_4);
	thisval = thisval&~(1<<27)|(bitval<<27);
	putValue(P_ASG_69_0_0_19_4,thisval);
}

on envVar P_ASG_69_0_0_19_4_28
{
	byte bitval;
	//thisval steht hier fuer den bitfield-wert, 
	//aus Generierungsgruenden hier keine einheitliche Bezeichnung moeglich.
	dword thisval; // AdditionalInfo1_2
	bitval= getValue(this);
	thisval = getValue(P_ASG_69_0_0_19_4);
	thisval = thisval&~(1<<28)|(bitval<<28);
	putValue(P_ASG_69_0_0_19_4,thisval);
}

on envVar P_ASG_69_0_0_19_4_29
{
	byte bitval;
	//thisval steht hier fuer den bitfield-wert, 
	//aus Generierungsgruenden hier keine einheitliche Bezeichnung moeglich.
	dword thisval; // AdditionalInfo1_2
	bitval= getValue(this);
	thisval = getValue(P_ASG_69_0_0_19_4);
	thisval = thisval&~(1<<29)|(bitval<<29);
	putValue(P_ASG_69_0_0_19_4,thisval);
}

on envVar P_ASG_69_0_0_19_4 // Display1Setup.AdditionalInfo1_2
{
	P_ASG_69_0_0_19_BuildFct();
}

on envVar P_ASG_69_0_0_19_5_0
{
	byte bitval;
	//thisval steht hier fuer den bitfield-wert, 
	//aus Generierungsgruenden hier keine einheitliche Bezeichnung moeglich.
	dword thisval; // AdditionalInfo2_1
	bitval= getValue(this);
	thisval = getValue(P_ASG_69_0_0_19_5);
	thisval = thisval&~(1<<0)|(bitval<<0);
	putValue(P_ASG_69_0_0_19_5,thisval);
}

on envVar P_ASG_69_0_0_19_5_1
{
	byte bitval;
	//thisval steht hier fuer den bitfield-wert, 
	//aus Generierungsgruenden hier keine einheitliche Bezeichnung moeglich.
	dword thisval; // AdditionalInfo2_1
	bitval= getValue(this);
	thisval = getValue(P_ASG_69_0_0_19_5);
	thisval = thisval&~(1<<1)|(bitval<<1);
	putValue(P_ASG_69_0_0_19_5,thisval);
}

on envVar P_ASG_69_0_0_19_5_2
{
	byte bitval;
	//thisval steht hier fuer den bitfield-wert, 
	//aus Generierungsgruenden hier keine einheitliche Bezeichnung moeglich.
	dword thisval; // AdditionalInfo2_1
	bitval= getValue(this);
	thisval = getValue(P_ASG_69_0_0_19_5);
	thisval = thisval&~(1<<2)|(bitval<<2);
	putValue(P_ASG_69_0_0_19_5,thisval);
}

on envVar P_ASG_69_0_0_19_5_3
{
	byte bitval;
	//thisval steht hier fuer den bitfield-wert, 
	//aus Generierungsgruenden hier keine einheitliche Bezeichnung moeglich.
	dword thisval; // AdditionalInfo2_1
	bitval= getValue(this);
	thisval = getValue(P_ASG_69_0_0_19_5);
	thisval = thisval&~(1<<3)|(bitval<<3);
	putValue(P_ASG_69_0_0_19_5,thisval);
}

on envVar P_ASG_69_0_0_19_5_4
{
	byte bitval;
	//thisval steht hier fuer den bitfield-wert, 
	//aus Generierungsgruenden hier keine einheitliche Bezeichnung moeglich.
	dword thisval; // AdditionalInfo2_1
	bitval= getValue(this);
	thisval = getValue(P_ASG_69_0_0_19_5);
	thisval = thisval&~(1<<4)|(bitval<<4);
	putValue(P_ASG_69_0_0_19_5,thisval);
}

on envVar P_ASG_69_0_0_19_5_5
{
	byte bitval;
	//thisval steht hier fuer den bitfield-wert, 
	//aus Generierungsgruenden hier keine einheitliche Bezeichnung moeglich.
	dword thisval; // AdditionalInfo2_1
	bitval= getValue(this);
	thisval = getValue(P_ASG_69_0_0_19_5);
	thisval = thisval&~(1<<5)|(bitval<<5);
	putValue(P_ASG_69_0_0_19_5,thisval);
}

on envVar P_ASG_69_0_0_19_5_6
{
	byte bitval;
	//thisval steht hier fuer den bitfield-wert, 
	//aus Generierungsgruenden hier keine einheitliche Bezeichnung moeglich.
	dword thisval; // AdditionalInfo2_1
	bitval= getValue(this);
	thisval = getValue(P_ASG_69_0_0_19_5);
	thisval = thisval&~(1<<6)|(bitval<<6);
	putValue(P_ASG_69_0_0_19_5,thisval);
}

on envVar P_ASG_69_0_0_19_5_7
{
	byte bitval;
	//thisval steht hier fuer den bitfield-wert, 
	//aus Generierungsgruenden hier keine einheitliche Bezeichnung moeglich.
	dword thisval; // AdditionalInfo2_1
	bitval= getValue(this);
	thisval = getValue(P_ASG_69_0_0_19_5);
	thisval = thisval&~(1<<7)|(bitval<<7);
	putValue(P_ASG_69_0_0_19_5,thisval);
}

on envVar P_ASG_69_0_0_19_5_8
{
	byte bitval;
	//thisval steht hier fuer den bitfield-wert, 
	//aus Generierungsgruenden hier keine einheitliche Bezeichnung moeglich.
	dword thisval; // AdditionalInfo2_1
	bitval= getValue(this);
	thisval = getValue(P_ASG_69_0_0_19_5);
	thisval = thisval&~(1<<8)|(bitval<<8);
	putValue(P_ASG_69_0_0_19_5,thisval);
}

on envVar P_ASG_69_0_0_19_5_9
{
	byte bitval;
	//thisval steht hier fuer den bitfield-wert, 
	//aus Generierungsgruenden hier keine einheitliche Bezeichnung moeglich.
	dword thisval; // AdditionalInfo2_1
	bitval= getValue(this);
	thisval = getValue(P_ASG_69_0_0_19_5);
	thisval = thisval&~(1<<9)|(bitval<<9);
	putValue(P_ASG_69_0_0_19_5,thisval);
}

on envVar P_ASG_69_0_0_19_5_10
{
	byte bitval;
	//thisval steht hier fuer den bitfield-wert, 
	//aus Generierungsgruenden hier keine einheitliche Bezeichnung moeglich.
	dword thisval; // AdditionalInfo2_1
	bitval= getValue(this);
	thisval = getValue(P_ASG_69_0_0_19_5);
	thisval = thisval&~(1<<10)|(bitval<<10);
	putValue(P_ASG_69_0_0_19_5,thisval);
}

on envVar P_ASG_69_0_0_19_5_11
{
	byte bitval;
	//thisval steht hier fuer den bitfield-wert, 
	//aus Generierungsgruenden hier keine einheitliche Bezeichnung moeglich.
	dword thisval; // AdditionalInfo2_1
	bitval= getValue(this);
	thisval = getValue(P_ASG_69_0_0_19_5);
	thisval = thisval&~(1<<11)|(bitval<<11);
	putValue(P_ASG_69_0_0_19_5,thisval);
}

on envVar P_ASG_69_0_0_19_5_12
{
	byte bitval;
	//thisval steht hier fuer den bitfield-wert, 
	//aus Generierungsgruenden hier keine einheitliche Bezeichnung moeglich.
	dword thisval; // AdditionalInfo2_1
	bitval= getValue(this);
	thisval = getValue(P_ASG_69_0_0_19_5);
	thisval = thisval&~(1<<12)|(bitval<<12);
	putValue(P_ASG_69_0_0_19_5,thisval);
}

on envVar P_ASG_69_0_0_19_5_13
{
	byte bitval;
	//thisval steht hier fuer den bitfield-wert, 
	//aus Generierungsgruenden hier keine einheitliche Bezeichnung moeglich.
	dword thisval; // AdditionalInfo2_1
	bitval= getValue(this);
	thisval = getValue(P_ASG_69_0_0_19_5);
	thisval = thisval&~(1<<13)|(bitval<<13);
	putValue(P_ASG_69_0_0_19_5,thisval);
}

on envVar P_ASG_69_0_0_19_5_14
{
	byte bitval;
	//thisval steht hier fuer den bitfield-wert, 
	//aus Generierungsgruenden hier keine einheitliche Bezeichnung moeglich.
	dword thisval; // AdditionalInfo2_1
	bitval= getValue(this);
	thisval = getValue(P_ASG_69_0_0_19_5);
	thisval = thisval&~(1<<14)|(bitval<<14);
	putValue(P_ASG_69_0_0_19_5,thisval);
}

on envVar P_ASG_69_0_0_19_5_15
{
	byte bitval;
	//thisval steht hier fuer den bitfield-wert, 
	//aus Generierungsgruenden hier keine einheitliche Bezeichnung moeglich.
	dword thisval; // AdditionalInfo2_1
	bitval= getValue(this);
	thisval = getValue(P_ASG_69_0_0_19_5);
	thisval = thisval&~(1<<15)|(bitval<<15);
	putValue(P_ASG_69_0_0_19_5,thisval);
}

on envVar P_ASG_69_0_0_19_5_16
{
	byte bitval;
	//thisval steht hier fuer den bitfield-wert, 
	//aus Generierungsgruenden hier keine einheitliche Bezeichnung moeglich.
	dword thisval; // AdditionalInfo2_1
	bitval= getValue(this);
	thisval = getValue(P_ASG_69_0_0_19_5);
	thisval = thisval&~(1<<16)|(bitval<<16);
	putValue(P_ASG_69_0_0_19_5,thisval);
}

on envVar P_ASG_69_0_0_19_5_17
{
	byte bitval;
	//thisval steht hier fuer den bitfield-wert, 
	//aus Generierungsgruenden hier keine einheitliche Bezeichnung moeglich.
	dword thisval; // AdditionalInfo2_1
	bitval= getValue(this);
	thisval = getValue(P_ASG_69_0_0_19_5);
	thisval = thisval&~(1<<17)|(bitval<<17);
	putValue(P_ASG_69_0_0_19_5,thisval);
}

on envVar P_ASG_69_0_0_19_5_18
{
	byte bitval;
	//thisval steht hier fuer den bitfield-wert, 
	//aus Generierungsgruenden hier keine einheitliche Bezeichnung moeglich.
	dword thisval; // AdditionalInfo2_1
	bitval= getValue(this);
	thisval = getValue(P_ASG_69_0_0_19_5);
	thisval = thisval&~(1<<18)|(bitval<<18);
	putValue(P_ASG_69_0_0_19_5,thisval);
}

on envVar P_ASG_69_0_0_19_5_19
{
	byte bitval;
	//thisval steht hier fuer den bitfield-wert, 
	//aus Generierungsgruenden hier keine einheitliche Bezeichnung moeglich.
	dword thisval; // AdditionalInfo2_1
	bitval= getValue(this);
	thisval = getValue(P_ASG_69_0_0_19_5);
	thisval = thisval&~(1<<19)|(bitval<<19);
	putValue(P_ASG_69_0_0_19_5,thisval);
}

on envVar P_ASG_69_0_0_19_5_20
{
	byte bitval;
	//thisval steht hier fuer den bitfield-wert, 
	//aus Generierungsgruenden hier keine einheitliche Bezeichnung moeglich.
	dword thisval; // AdditionalInfo2_1
	bitval= getValue(this);
	thisval = getValue(P_ASG_69_0_0_19_5);
	thisval = thisval&~(1<<20)|(bitval<<20);
	putValue(P_ASG_69_0_0_19_5,thisval);
}

on envVar P_ASG_69_0_0_19_5_21
{
	byte bitval;
	//thisval steht hier fuer den bitfield-wert, 
	//aus Generierungsgruenden hier keine einheitliche Bezeichnung moeglich.
	dword thisval; // AdditionalInfo2_1
	bitval= getValue(this);
	thisval = getValue(P_ASG_69_0_0_19_5);
	thisval = thisval&~(1<<21)|(bitval<<21);
	putValue(P_ASG_69_0_0_19_5,thisval);
}

on envVar P_ASG_69_0_0_19_5_22
{
	byte bitval;
	//thisval steht hier fuer den bitfield-wert, 
	//aus Generierungsgruenden hier keine einheitliche Bezeichnung moeglich.
	dword thisval; // AdditionalInfo2_1
	bitval= getValue(this);
	thisval = getValue(P_ASG_69_0_0_19_5);
	thisval = thisval&~(1<<22)|(bitval<<22);
	putValue(P_ASG_69_0_0_19_5,thisval);
}

on envVar P_ASG_69_0_0_19_5_23
{
	byte bitval;
	//thisval steht hier fuer den bitfield-wert, 
	//aus Generierungsgruenden hier keine einheitliche Bezeichnung moeglich.
	dword thisval; // AdditionalInfo2_1
	bitval= getValue(this);
	thisval = getValue(P_ASG_69_0_0_19_5);
	thisval = thisval&~(1<<23)|(bitval<<23);
	putValue(P_ASG_69_0_0_19_5,thisval);
}

on envVar P_ASG_69_0_0_19_5_24
{
	byte bitval;
	//thisval steht hier fuer den bitfield-wert, 
	//aus Generierungsgruenden hier keine einheitliche Bezeichnung moeglich.
	dword thisval; // AdditionalInfo2_1
	bitval= getValue(this);
	thisval = getValue(P_ASG_69_0_0_19_5);
	thisval = thisval&~(1<<24)|(bitval<<24);
	putValue(P_ASG_69_0_0_19_5,thisval);
}

on envVar P_ASG_69_0_0_19_5_25
{
	byte bitval;
	//thisval steht hier fuer den bitfield-wert, 
	//aus Generierungsgruenden hier keine einheitliche Bezeichnung moeglich.
	dword thisval; // AdditionalInfo2_1
	bitval= getValue(this);
	thisval = getValue(P_ASG_69_0_0_19_5);
	thisval = thisval&~(1<<25)|(bitval<<25);
	putValue(P_ASG_69_0_0_19_5,thisval);
}

on envVar P_ASG_69_0_0_19_5_26
{
	byte bitval;
	//thisval steht hier fuer den bitfield-wert, 
	//aus Generierungsgruenden hier keine einheitliche Bezeichnung moeglich.
	dword thisval; // AdditionalInfo2_1
	bitval= getValue(this);
	thisval = getValue(P_ASG_69_0_0_19_5);
	thisval = thisval&~(1<<26)|(bitval<<26);
	putValue(P_ASG_69_0_0_19_5,thisval);
}

on envVar P_ASG_69_0_0_19_5_27
{
	byte bitval;
	//thisval steht hier fuer den bitfield-wert, 
	//aus Generierungsgruenden hier keine einheitliche Bezeichnung moeglich.
	dword thisval; // AdditionalInfo2_1
	bitval= getValue(this);
	thisval = getValue(P_ASG_69_0_0_19_5);
	thisval = thisval&~(1<<27)|(bitval<<27);
	putValue(P_ASG_69_0_0_19_5,thisval);
}

on envVar P_ASG_69_0_0_19_5_28
{
	byte bitval;
	//thisval steht hier fuer den bitfield-wert, 
	//aus Generierungsgruenden hier keine einheitliche Bezeichnung moeglich.
	dword thisval; // AdditionalInfo2_1
	bitval= getValue(this);
	thisval = getValue(P_ASG_69_0_0_19_5);
	thisval = thisval&~(1<<28)|(bitval<<28);
	putValue(P_ASG_69_0_0_19_5,thisval);
}

on envVar P_ASG_69_0_0_19_5_29
{
	byte bitval;
	//thisval steht hier fuer den bitfield-wert, 
	//aus Generierungsgruenden hier keine einheitliche Bezeichnung moeglich.
	dword thisval; // AdditionalInfo2_1
	bitval= getValue(this);
	thisval = getValue(P_ASG_69_0_0_19_5);
	thisval = thisval&~(1<<29)|(bitval<<29);
	putValue(P_ASG_69_0_0_19_5,thisval);
}

on envVar P_ASG_69_0_0_19_5_30
{
	byte bitval;
	//thisval steht hier fuer den bitfield-wert, 
	//aus Generierungsgruenden hier keine einheitliche Bezeichnung moeglich.
	dword thisval; // AdditionalInfo2_1
	bitval= getValue(this);
	thisval = getValue(P_ASG_69_0_0_19_5);
	thisval = thisval&~(1<<30)|(bitval<<30);
	putValue(P_ASG_69_0_0_19_5,thisval);
}

on envVar P_ASG_69_0_0_19_5_31
{
	byte bitval;
	//thisval steht hier fuer den bitfield-wert, 
	//aus Generierungsgruenden hier keine einheitliche Bezeichnung moeglich.
	dword thisval; // AdditionalInfo2_1
	bitval= getValue(this);
	thisval = getValue(P_ASG_69_0_0_19_5);
	thisval = thisval&~(1<<31)|(bitval<<31);
	putValue(P_ASG_69_0_0_19_5,thisval);
}

on envVar P_ASG_69_0_0_19_5 // Display1Setup.AdditionalInfo2_1
{
	P_ASG_69_0_0_19_BuildFct();
}

on envVar P_ASG_69_0_0_19_6_0
{
	byte bitval;
	//thisval steht hier fuer den bitfield-wert, 
	//aus Generierungsgruenden hier keine einheitliche Bezeichnung moeglich.
	dword thisval; // AdditionalInfo2_2
	bitval= getValue(this);
	thisval = getValue(P_ASG_69_0_0_19_6);
	thisval = thisval&~(1<<0)|(bitval<<0);
	putValue(P_ASG_69_0_0_19_6,thisval);
}

on envVar P_ASG_69_0_0_19_6_1
{
	byte bitval;
	//thisval steht hier fuer den bitfield-wert, 
	//aus Generierungsgruenden hier keine einheitliche Bezeichnung moeglich.
	dword thisval; // AdditionalInfo2_2
	bitval= getValue(this);
	thisval = getValue(P_ASG_69_0_0_19_6);
	thisval = thisval&~(1<<1)|(bitval<<1);
	putValue(P_ASG_69_0_0_19_6,thisval);
}

on envVar P_ASG_69_0_0_19_6_2
{
	byte bitval;
	//thisval steht hier fuer den bitfield-wert, 
	//aus Generierungsgruenden hier keine einheitliche Bezeichnung moeglich.
	dword thisval; // AdditionalInfo2_2
	bitval= getValue(this);
	thisval = getValue(P_ASG_69_0_0_19_6);
	thisval = thisval&~(1<<2)|(bitval<<2);
	putValue(P_ASG_69_0_0_19_6,thisval);
}

on envVar P_ASG_69_0_0_19_6_3
{
	byte bitval;
	//thisval steht hier fuer den bitfield-wert, 
	//aus Generierungsgruenden hier keine einheitliche Bezeichnung moeglich.
	dword thisval; // AdditionalInfo2_2
	bitval= getValue(this);
	thisval = getValue(P_ASG_69_0_0_19_6);
	thisval = thisval&~(1<<3)|(bitval<<3);
	putValue(P_ASG_69_0_0_19_6,thisval);
}

on envVar P_ASG_69_0_0_19_6_4
{
	byte bitval;
	//thisval steht hier fuer den bitfield-wert, 
	//aus Generierungsgruenden hier keine einheitliche Bezeichnung moeglich.
	dword thisval; // AdditionalInfo2_2
	bitval= getValue(this);
	thisval = getValue(P_ASG_69_0_0_19_6);
	thisval = thisval&~(1<<4)|(bitval<<4);
	putValue(P_ASG_69_0_0_19_6,thisval);
}

on envVar P_ASG_69_0_0_19_6_5
{
	byte bitval;
	//thisval steht hier fuer den bitfield-wert, 
	//aus Generierungsgruenden hier keine einheitliche Bezeichnung moeglich.
	dword thisval; // AdditionalInfo2_2
	bitval= getValue(this);
	thisval = getValue(P_ASG_69_0_0_19_6);
	thisval = thisval&~(1<<5)|(bitval<<5);
	putValue(P_ASG_69_0_0_19_6,thisval);
}

on envVar P_ASG_69_0_0_19_6_6
{
	byte bitval;
	//thisval steht hier fuer den bitfield-wert, 
	//aus Generierungsgruenden hier keine einheitliche Bezeichnung moeglich.
	dword thisval; // AdditionalInfo2_2
	bitval= getValue(this);
	thisval = getValue(P_ASG_69_0_0_19_6);
	thisval = thisval&~(1<<6)|(bitval<<6);
	putValue(P_ASG_69_0_0_19_6,thisval);
}

on envVar P_ASG_69_0_0_19_6_7
{
	byte bitval;
	//thisval steht hier fuer den bitfield-wert, 
	//aus Generierungsgruenden hier keine einheitliche Bezeichnung moeglich.
	dword thisval; // AdditionalInfo2_2
	bitval= getValue(this);
	thisval = getValue(P_ASG_69_0_0_19_6);
	thisval = thisval&~(1<<7)|(bitval<<7);
	putValue(P_ASG_69_0_0_19_6,thisval);
}

on envVar P_ASG_69_0_0_19_6_8
{
	byte bitval;
	//thisval steht hier fuer den bitfield-wert, 
	//aus Generierungsgruenden hier keine einheitliche Bezeichnung moeglich.
	dword thisval; // AdditionalInfo2_2
	bitval= getValue(this);
	thisval = getValue(P_ASG_69_0_0_19_6);
	thisval = thisval&~(1<<8)|(bitval<<8);
	putValue(P_ASG_69_0_0_19_6,thisval);
}

on envVar P_ASG_69_0_0_19_6_9
{
	byte bitval;
	//thisval steht hier fuer den bitfield-wert, 
	//aus Generierungsgruenden hier keine einheitliche Bezeichnung moeglich.
	dword thisval; // AdditionalInfo2_2
	bitval= getValue(this);
	thisval = getValue(P_ASG_69_0_0_19_6);
	thisval = thisval&~(1<<9)|(bitval<<9);
	putValue(P_ASG_69_0_0_19_6,thisval);
}

on envVar P_ASG_69_0_0_19_6_10
{
	byte bitval;
	//thisval steht hier fuer den bitfield-wert, 
	//aus Generierungsgruenden hier keine einheitliche Bezeichnung moeglich.
	dword thisval; // AdditionalInfo2_2
	bitval= getValue(this);
	thisval = getValue(P_ASG_69_0_0_19_6);
	thisval = thisval&~(1<<10)|(bitval<<10);
	putValue(P_ASG_69_0_0_19_6,thisval);
}

on envVar P_ASG_69_0_0_19_6_11
{
	byte bitval;
	//thisval steht hier fuer den bitfield-wert, 
	//aus Generierungsgruenden hier keine einheitliche Bezeichnung moeglich.
	dword thisval; // AdditionalInfo2_2
	bitval= getValue(this);
	thisval = getValue(P_ASG_69_0_0_19_6);
	thisval = thisval&~(1<<11)|(bitval<<11);
	putValue(P_ASG_69_0_0_19_6,thisval);
}

on envVar P_ASG_69_0_0_19_6_12
{
	byte bitval;
	//thisval steht hier fuer den bitfield-wert, 
	//aus Generierungsgruenden hier keine einheitliche Bezeichnung moeglich.
	dword thisval; // AdditionalInfo2_2
	bitval= getValue(this);
	thisval = getValue(P_ASG_69_0_0_19_6);
	thisval = thisval&~(1<<12)|(bitval<<12);
	putValue(P_ASG_69_0_0_19_6,thisval);
}

on envVar P_ASG_69_0_0_19_6_13
{
	byte bitval;
	//thisval steht hier fuer den bitfield-wert, 
	//aus Generierungsgruenden hier keine einheitliche Bezeichnung moeglich.
	dword thisval; // AdditionalInfo2_2
	bitval= getValue(this);
	thisval = getValue(P_ASG_69_0_0_19_6);
	thisval = thisval&~(1<<13)|(bitval<<13);
	putValue(P_ASG_69_0_0_19_6,thisval);
}

on envVar P_ASG_69_0_0_19_6_14
{
	byte bitval;
	//thisval steht hier fuer den bitfield-wert, 
	//aus Generierungsgruenden hier keine einheitliche Bezeichnung moeglich.
	dword thisval; // AdditionalInfo2_2
	bitval= getValue(this);
	thisval = getValue(P_ASG_69_0_0_19_6);
	thisval = thisval&~(1<<14)|(bitval<<14);
	putValue(P_ASG_69_0_0_19_6,thisval);
}

on envVar P_ASG_69_0_0_19_6_15
{
	byte bitval;
	//thisval steht hier fuer den bitfield-wert, 
	//aus Generierungsgruenden hier keine einheitliche Bezeichnung moeglich.
	dword thisval; // AdditionalInfo2_2
	bitval= getValue(this);
	thisval = getValue(P_ASG_69_0_0_19_6);
	thisval = thisval&~(1<<15)|(bitval<<15);
	putValue(P_ASG_69_0_0_19_6,thisval);
}

on envVar P_ASG_69_0_0_19_6_16
{
	byte bitval;
	//thisval steht hier fuer den bitfield-wert, 
	//aus Generierungsgruenden hier keine einheitliche Bezeichnung moeglich.
	dword thisval; // AdditionalInfo2_2
	bitval= getValue(this);
	thisval = getValue(P_ASG_69_0_0_19_6);
	thisval = thisval&~(1<<16)|(bitval<<16);
	putValue(P_ASG_69_0_0_19_6,thisval);
}

on envVar P_ASG_69_0_0_19_6_17
{
	byte bitval;
	//thisval steht hier fuer den bitfield-wert, 
	//aus Generierungsgruenden hier keine einheitliche Bezeichnung moeglich.
	dword thisval; // AdditionalInfo2_2
	bitval= getValue(this);
	thisval = getValue(P_ASG_69_0_0_19_6);
	thisval = thisval&~(1<<17)|(bitval<<17);
	putValue(P_ASG_69_0_0_19_6,thisval);
}

on envVar P_ASG_69_0_0_19_6_18
{
	byte bitval;
	//thisval steht hier fuer den bitfield-wert, 
	//aus Generierungsgruenden hier keine einheitliche Bezeichnung moeglich.
	dword thisval; // AdditionalInfo2_2
	bitval= getValue(this);
	thisval = getValue(P_ASG_69_0_0_19_6);
	thisval = thisval&~(1<<18)|(bitval<<18);
	putValue(P_ASG_69_0_0_19_6,thisval);
}

on envVar P_ASG_69_0_0_19_6_19
{
	byte bitval;
	//thisval steht hier fuer den bitfield-wert, 
	//aus Generierungsgruenden hier keine einheitliche Bezeichnung moeglich.
	dword thisval; // AdditionalInfo2_2
	bitval= getValue(this);
	thisval = getValue(P_ASG_69_0_0_19_6);
	thisval = thisval&~(1<<19)|(bitval<<19);
	putValue(P_ASG_69_0_0_19_6,thisval);
}

on envVar P_ASG_69_0_0_19_6_20
{
	byte bitval;
	//thisval steht hier fuer den bitfield-wert, 
	//aus Generierungsgruenden hier keine einheitliche Bezeichnung moeglich.
	dword thisval; // AdditionalInfo2_2
	bitval= getValue(this);
	thisval = getValue(P_ASG_69_0_0_19_6);
	thisval = thisval&~(1<<20)|(bitval<<20);
	putValue(P_ASG_69_0_0_19_6,thisval);
}

on envVar P_ASG_69_0_0_19_6_21
{
	byte bitval;
	//thisval steht hier fuer den bitfield-wert, 
	//aus Generierungsgruenden hier keine einheitliche Bezeichnung moeglich.
	dword thisval; // AdditionalInfo2_2
	bitval= getValue(this);
	thisval = getValue(P_ASG_69_0_0_19_6);
	thisval = thisval&~(1<<21)|(bitval<<21);
	putValue(P_ASG_69_0_0_19_6,thisval);
}

on envVar P_ASG_69_0_0_19_6_22
{
	byte bitval;
	//thisval steht hier fuer den bitfield-wert, 
	//aus Generierungsgruenden hier keine einheitliche Bezeichnung moeglich.
	dword thisval; // AdditionalInfo2_2
	bitval= getValue(this);
	thisval = getValue(P_ASG_69_0_0_19_6);
	thisval = thisval&~(1<<22)|(bitval<<22);
	putValue(P_ASG_69_0_0_19_6,thisval);
}

on envVar P_ASG_69_0_0_19_6_23
{
	byte bitval;
	//thisval steht hier fuer den bitfield-wert, 
	//aus Generierungsgruenden hier keine einheitliche Bezeichnung moeglich.
	dword thisval; // AdditionalInfo2_2
	bitval= getValue(this);
	thisval = getValue(P_ASG_69_0_0_19_6);
	thisval = thisval&~(1<<23)|(bitval<<23);
	putValue(P_ASG_69_0_0_19_6,thisval);
}

on envVar P_ASG_69_0_0_19_6_24
{
	byte bitval;
	//thisval steht hier fuer den bitfield-wert, 
	//aus Generierungsgruenden hier keine einheitliche Bezeichnung moeglich.
	dword thisval; // AdditionalInfo2_2
	bitval= getValue(this);
	thisval = getValue(P_ASG_69_0_0_19_6);
	thisval = thisval&~(1<<24)|(bitval<<24);
	putValue(P_ASG_69_0_0_19_6,thisval);
}

on envVar P_ASG_69_0_0_19_6_25
{
	byte bitval;
	//thisval steht hier fuer den bitfield-wert, 
	//aus Generierungsgruenden hier keine einheitliche Bezeichnung moeglich.
	dword thisval; // AdditionalInfo2_2
	bitval= getValue(this);
	thisval = getValue(P_ASG_69_0_0_19_6);
	thisval = thisval&~(1<<25)|(bitval<<25);
	putValue(P_ASG_69_0_0_19_6,thisval);
}

on envVar P_ASG_69_0_0_19_6_26
{
	byte bitval;
	//thisval steht hier fuer den bitfield-wert, 
	//aus Generierungsgruenden hier keine einheitliche Bezeichnung moeglich.
	dword thisval; // AdditionalInfo2_2
	bitval= getValue(this);
	thisval = getValue(P_ASG_69_0_0_19_6);
	thisval = thisval&~(1<<26)|(bitval<<26);
	putValue(P_ASG_69_0_0_19_6,thisval);
}

on envVar P_ASG_69_0_0_19_6_27
{
	byte bitval;
	//thisval steht hier fuer den bitfield-wert, 
	//aus Generierungsgruenden hier keine einheitliche Bezeichnung moeglich.
	dword thisval; // AdditionalInfo2_2
	bitval= getValue(this);
	thisval = getValue(P_ASG_69_0_0_19_6);
	thisval = thisval&~(1<<27)|(bitval<<27);
	putValue(P_ASG_69_0_0_19_6,thisval);
}

on envVar P_ASG_69_0_0_19_6_28
{
	byte bitval;
	//thisval steht hier fuer den bitfield-wert, 
	//aus Generierungsgruenden hier keine einheitliche Bezeichnung moeglich.
	dword thisval; // AdditionalInfo2_2
	bitval= getValue(this);
	thisval = getValue(P_ASG_69_0_0_19_6);
	thisval = thisval&~(1<<28)|(bitval<<28);
	putValue(P_ASG_69_0_0_19_6,thisval);
}

on envVar P_ASG_69_0_0_19_6_29
{
	byte bitval;
	//thisval steht hier fuer den bitfield-wert, 
	//aus Generierungsgruenden hier keine einheitliche Bezeichnung moeglich.
	dword thisval; // AdditionalInfo2_2
	bitval= getValue(this);
	thisval = getValue(P_ASG_69_0_0_19_6);
	thisval = thisval&~(1<<29)|(bitval<<29);
	putValue(P_ASG_69_0_0_19_6,thisval);
}

on envVar P_ASG_69_0_0_19_6 // Display1Setup.AdditionalInfo2_2
{
	P_ASG_69_0_0_19_BuildFct();
}

on envVar P_ASG_69_0_0_20Get_BTN
{
 if (P_ASG_69_0_0_20Get_BTN_already_pressed == 0)
  {
       putValue(P_ASG_69_0_0_20_ErrCode,0);
       SetControlBackColor(panel_name,"errField_P_ASG_69_0_0_20",MakeRGB(255,255,255));
       P_ASG_69_0_0_20Get_BTN_already_pressed = 1;
 }
 else
 {
       Request_Void(LSGID, P_ASG_69_0_0_20_ID, DataGet_REQ); 
       P_ASG_69_0_0_20Get_BTN_already_pressed = 0;
 }
}
on envVar P_ASG_69_0_0_20SetGet_BTN
{
	byte BAPTemp[5];
    if (P_ASG_69_0_0_20SetGet_BTN_already_pressed == 0)
    {
       putValue(P_ASG_69_0_0_20_ErrCode,0);
       SetControlBackColor(panel_name,"errField_P_ASG_69_0_0_20",MakeRGB(255,255,255));
       P_ASG_69_0_0_20SetGet_BTN_already_pressed = 1;
    }
    else
    {
       getValue(P_ASG_69_0_0_20, BAPTemp);
       Request_ByteSequence(LSGID, P_ASG_69_0_0_20_ID, DataSetGet_REQ, BAPTemp, getValueSize(P_ASG_69_0_0_20));
       P_ASG_69_0_0_20SetGet_BTN_already_pressed = 0;
    }
}
on envVar P_ASG_69_0_0_20 // bus value of Display1MainSelection (20).
{
	// opcodes: Error-Status
	dword param1; // MainSelection
	byte param2; // Extension1
	byte param3; // Extension2
	// DATATYPE_BYTESEQUENCE / DATATYPE_FIXEDBYTESEQUENCE
	int i;
	byte superval[5];
	int currentPos;
	currentPos = 0;
	for( i = 0; i < 5; i++ ) {
		superval[i] = 0;
	}
	getValue(P_ASG_69_0_0_20, superval);
	///////// Start param1 - UINT32 /////////
	param1 = superval[currentPos++]|(superval[currentPos++]<<8)|(superval[currentPos++]<<16)|(superval[currentPos++]<<24);
	putValue(P_ASG_69_0_0_20_1, param1);
	///////// Start param2 - NIBBLE /////////
	param2 = (superval[currentPos] & 0xf0)>>4;
	putValue(P_ASG_69_0_0_20_2, round((param2 * 1.0) - (0) + (0), 1.0));
	///////// Start param3 - NIBBLE /////////
	param3 = superval[currentPos++] & 0x0f;
	putValue(P_ASG_69_0_0_20_3, round((param3 * 1.0) - (0) + (0), 1.0));
}

on envVar P_ASG_69_0_0_20_1_0
{
	byte bitval;
	//thisval steht hier fuer den bitfield-wert, 
	//aus Generierungsgruenden hier keine einheitliche Bezeichnung moeglich.
	dword thisval; // MainSelection
	bitval= getValue(this);
	thisval = getValue(P_ASG_69_0_0_20_1);
	thisval = thisval&~(1<<0)|(bitval<<0);
	putValue(P_ASG_69_0_0_20_1,thisval);
}

on envVar P_ASG_69_0_0_20_1_1
{
	byte bitval;
	//thisval steht hier fuer den bitfield-wert, 
	//aus Generierungsgruenden hier keine einheitliche Bezeichnung moeglich.
	dword thisval; // MainSelection
	bitval= getValue(this);
	thisval = getValue(P_ASG_69_0_0_20_1);
	thisval = thisval&~(1<<1)|(bitval<<1);
	putValue(P_ASG_69_0_0_20_1,thisval);
}

on envVar P_ASG_69_0_0_20_1_2
{
	byte bitval;
	//thisval steht hier fuer den bitfield-wert, 
	//aus Generierungsgruenden hier keine einheitliche Bezeichnung moeglich.
	dword thisval; // MainSelection
	bitval= getValue(this);
	thisval = getValue(P_ASG_69_0_0_20_1);
	thisval = thisval&~(1<<2)|(bitval<<2);
	putValue(P_ASG_69_0_0_20_1,thisval);
}

on envVar P_ASG_69_0_0_20_1_3
{
	byte bitval;
	//thisval steht hier fuer den bitfield-wert, 
	//aus Generierungsgruenden hier keine einheitliche Bezeichnung moeglich.
	dword thisval; // MainSelection
	bitval= getValue(this);
	thisval = getValue(P_ASG_69_0_0_20_1);
	thisval = thisval&~(1<<3)|(bitval<<3);
	putValue(P_ASG_69_0_0_20_1,thisval);
}

on envVar P_ASG_69_0_0_20_1_4
{
	byte bitval;
	//thisval steht hier fuer den bitfield-wert, 
	//aus Generierungsgruenden hier keine einheitliche Bezeichnung moeglich.
	dword thisval; // MainSelection
	bitval= getValue(this);
	thisval = getValue(P_ASG_69_0_0_20_1);
	thisval = thisval&~(1<<4)|(bitval<<4);
	putValue(P_ASG_69_0_0_20_1,thisval);
}

on envVar P_ASG_69_0_0_20_1_5
{
	byte bitval;
	//thisval steht hier fuer den bitfield-wert, 
	//aus Generierungsgruenden hier keine einheitliche Bezeichnung moeglich.
	dword thisval; // MainSelection
	bitval= getValue(this);
	thisval = getValue(P_ASG_69_0_0_20_1);
	thisval = thisval&~(1<<5)|(bitval<<5);
	putValue(P_ASG_69_0_0_20_1,thisval);
}

on envVar P_ASG_69_0_0_20_1_6
{
	byte bitval;
	//thisval steht hier fuer den bitfield-wert, 
	//aus Generierungsgruenden hier keine einheitliche Bezeichnung moeglich.
	dword thisval; // MainSelection
	bitval= getValue(this);
	thisval = getValue(P_ASG_69_0_0_20_1);
	thisval = thisval&~(1<<6)|(bitval<<6);
	putValue(P_ASG_69_0_0_20_1,thisval);
}

on envVar P_ASG_69_0_0_20_1_7
{
	byte bitval;
	//thisval steht hier fuer den bitfield-wert, 
	//aus Generierungsgruenden hier keine einheitliche Bezeichnung moeglich.
	dword thisval; // MainSelection
	bitval= getValue(this);
	thisval = getValue(P_ASG_69_0_0_20_1);
	thisval = thisval&~(1<<7)|(bitval<<7);
	putValue(P_ASG_69_0_0_20_1,thisval);
}

on envVar P_ASG_69_0_0_20_1_8
{
	byte bitval;
	//thisval steht hier fuer den bitfield-wert, 
	//aus Generierungsgruenden hier keine einheitliche Bezeichnung moeglich.
	dword thisval; // MainSelection
	bitval= getValue(this);
	thisval = getValue(P_ASG_69_0_0_20_1);
	thisval = thisval&~(1<<8)|(bitval<<8);
	putValue(P_ASG_69_0_0_20_1,thisval);
}

on envVar P_ASG_69_0_0_20_1_9
{
	byte bitval;
	//thisval steht hier fuer den bitfield-wert, 
	//aus Generierungsgruenden hier keine einheitliche Bezeichnung moeglich.
	dword thisval; // MainSelection
	bitval= getValue(this);
	thisval = getValue(P_ASG_69_0_0_20_1);
	thisval = thisval&~(1<<9)|(bitval<<9);
	putValue(P_ASG_69_0_0_20_1,thisval);
}

on envVar P_ASG_69_0_0_20_1_10
{
	byte bitval;
	//thisval steht hier fuer den bitfield-wert, 
	//aus Generierungsgruenden hier keine einheitliche Bezeichnung moeglich.
	dword thisval; // MainSelection
	bitval= getValue(this);
	thisval = getValue(P_ASG_69_0_0_20_1);
	thisval = thisval&~(1<<10)|(bitval<<10);
	putValue(P_ASG_69_0_0_20_1,thisval);
}

on envVar P_ASG_69_0_0_20_1_11
{
	byte bitval;
	//thisval steht hier fuer den bitfield-wert, 
	//aus Generierungsgruenden hier keine einheitliche Bezeichnung moeglich.
	dword thisval; // MainSelection
	bitval= getValue(this);
	thisval = getValue(P_ASG_69_0_0_20_1);
	thisval = thisval&~(1<<11)|(bitval<<11);
	putValue(P_ASG_69_0_0_20_1,thisval);
}

on envVar P_ASG_69_0_0_20_1_12
{
	byte bitval;
	//thisval steht hier fuer den bitfield-wert, 
	//aus Generierungsgruenden hier keine einheitliche Bezeichnung moeglich.
	dword thisval; // MainSelection
	bitval= getValue(this);
	thisval = getValue(P_ASG_69_0_0_20_1);
	thisval = thisval&~(1<<12)|(bitval<<12);
	putValue(P_ASG_69_0_0_20_1,thisval);
}

on envVar P_ASG_69_0_0_20_1_13
{
	byte bitval;
	//thisval steht hier fuer den bitfield-wert, 
	//aus Generierungsgruenden hier keine einheitliche Bezeichnung moeglich.
	dword thisval; // MainSelection
	bitval= getValue(this);
	thisval = getValue(P_ASG_69_0_0_20_1);
	thisval = thisval&~(1<<13)|(bitval<<13);
	putValue(P_ASG_69_0_0_20_1,thisval);
}

on envVar P_ASG_69_0_0_20_1_14
{
	byte bitval;
	//thisval steht hier fuer den bitfield-wert, 
	//aus Generierungsgruenden hier keine einheitliche Bezeichnung moeglich.
	dword thisval; // MainSelection
	bitval= getValue(this);
	thisval = getValue(P_ASG_69_0_0_20_1);
	thisval = thisval&~(1<<14)|(bitval<<14);
	putValue(P_ASG_69_0_0_20_1,thisval);
}

on envVar P_ASG_69_0_0_20_1_15
{
	byte bitval;
	//thisval steht hier fuer den bitfield-wert, 
	//aus Generierungsgruenden hier keine einheitliche Bezeichnung moeglich.
	dword thisval; // MainSelection
	bitval= getValue(this);
	thisval = getValue(P_ASG_69_0_0_20_1);
	thisval = thisval&~(1<<15)|(bitval<<15);
	putValue(P_ASG_69_0_0_20_1,thisval);
}

on envVar P_ASG_69_0_0_20_1_16
{
	byte bitval;
	//thisval steht hier fuer den bitfield-wert, 
	//aus Generierungsgruenden hier keine einheitliche Bezeichnung moeglich.
	dword thisval; // MainSelection
	bitval= getValue(this);
	thisval = getValue(P_ASG_69_0_0_20_1);
	thisval = thisval&~(1<<16)|(bitval<<16);
	putValue(P_ASG_69_0_0_20_1,thisval);
}

on envVar P_ASG_69_0_0_20_1_17
{
	byte bitval;
	//thisval steht hier fuer den bitfield-wert, 
	//aus Generierungsgruenden hier keine einheitliche Bezeichnung moeglich.
	dword thisval; // MainSelection
	bitval= getValue(this);
	thisval = getValue(P_ASG_69_0_0_20_1);
	thisval = thisval&~(1<<17)|(bitval<<17);
	putValue(P_ASG_69_0_0_20_1,thisval);
}

on envVar P_ASG_69_0_0_20_1_18
{
	byte bitval;
	//thisval steht hier fuer den bitfield-wert, 
	//aus Generierungsgruenden hier keine einheitliche Bezeichnung moeglich.
	dword thisval; // MainSelection
	bitval= getValue(this);
	thisval = getValue(P_ASG_69_0_0_20_1);
	thisval = thisval&~(1<<18)|(bitval<<18);
	putValue(P_ASG_69_0_0_20_1,thisval);
}

on envVar P_ASG_69_0_0_20_1_19
{
	byte bitval;
	//thisval steht hier fuer den bitfield-wert, 
	//aus Generierungsgruenden hier keine einheitliche Bezeichnung moeglich.
	dword thisval; // MainSelection
	bitval= getValue(this);
	thisval = getValue(P_ASG_69_0_0_20_1);
	thisval = thisval&~(1<<19)|(bitval<<19);
	putValue(P_ASG_69_0_0_20_1,thisval);
}

on envVar P_ASG_69_0_0_20_1_20
{
	byte bitval;
	//thisval steht hier fuer den bitfield-wert, 
	//aus Generierungsgruenden hier keine einheitliche Bezeichnung moeglich.
	dword thisval; // MainSelection
	bitval= getValue(this);
	thisval = getValue(P_ASG_69_0_0_20_1);
	thisval = thisval&~(1<<20)|(bitval<<20);
	putValue(P_ASG_69_0_0_20_1,thisval);
}

on envVar P_ASG_69_0_0_20_1_21
{
	byte bitval;
	//thisval steht hier fuer den bitfield-wert, 
	//aus Generierungsgruenden hier keine einheitliche Bezeichnung moeglich.
	dword thisval; // MainSelection
	bitval= getValue(this);
	thisval = getValue(P_ASG_69_0_0_20_1);
	thisval = thisval&~(1<<21)|(bitval<<21);
	putValue(P_ASG_69_0_0_20_1,thisval);
}

on envVar P_ASG_69_0_0_20_1_22
{
	byte bitval;
	//thisval steht hier fuer den bitfield-wert, 
	//aus Generierungsgruenden hier keine einheitliche Bezeichnung moeglich.
	dword thisval; // MainSelection
	bitval= getValue(this);
	thisval = getValue(P_ASG_69_0_0_20_1);
	thisval = thisval&~(1<<22)|(bitval<<22);
	putValue(P_ASG_69_0_0_20_1,thisval);
}

on envVar P_ASG_69_0_0_20_1_23
{
	byte bitval;
	//thisval steht hier fuer den bitfield-wert, 
	//aus Generierungsgruenden hier keine einheitliche Bezeichnung moeglich.
	dword thisval; // MainSelection
	bitval= getValue(this);
	thisval = getValue(P_ASG_69_0_0_20_1);
	thisval = thisval&~(1<<23)|(bitval<<23);
	putValue(P_ASG_69_0_0_20_1,thisval);
}

on envVar P_ASG_69_0_0_20_1_24
{
	byte bitval;
	//thisval steht hier fuer den bitfield-wert, 
	//aus Generierungsgruenden hier keine einheitliche Bezeichnung moeglich.
	dword thisval; // MainSelection
	bitval= getValue(this);
	thisval = getValue(P_ASG_69_0_0_20_1);
	thisval = thisval&~(1<<24)|(bitval<<24);
	putValue(P_ASG_69_0_0_20_1,thisval);
}

on envVar P_ASG_69_0_0_20_1_25
{
	byte bitval;
	//thisval steht hier fuer den bitfield-wert, 
	//aus Generierungsgruenden hier keine einheitliche Bezeichnung moeglich.
	dword thisval; // MainSelection
	bitval= getValue(this);
	thisval = getValue(P_ASG_69_0_0_20_1);
	thisval = thisval&~(1<<25)|(bitval<<25);
	putValue(P_ASG_69_0_0_20_1,thisval);
}

on envVar P_ASG_69_0_0_20_1_26
{
	byte bitval;
	//thisval steht hier fuer den bitfield-wert, 
	//aus Generierungsgruenden hier keine einheitliche Bezeichnung moeglich.
	dword thisval; // MainSelection
	bitval= getValue(this);
	thisval = getValue(P_ASG_69_0_0_20_1);
	thisval = thisval&~(1<<26)|(bitval<<26);
	putValue(P_ASG_69_0_0_20_1,thisval);
}

on envVar P_ASG_69_0_0_20_1_27
{
	byte bitval;
	//thisval steht hier fuer den bitfield-wert, 
	//aus Generierungsgruenden hier keine einheitliche Bezeichnung moeglich.
	dword thisval; // MainSelection
	bitval= getValue(this);
	thisval = getValue(P_ASG_69_0_0_20_1);
	thisval = thisval&~(1<<27)|(bitval<<27);
	putValue(P_ASG_69_0_0_20_1,thisval);
}

on envVar P_ASG_69_0_0_20_1_28
{
	byte bitval;
	//thisval steht hier fuer den bitfield-wert, 
	//aus Generierungsgruenden hier keine einheitliche Bezeichnung moeglich.
	dword thisval; // MainSelection
	bitval= getValue(this);
	thisval = getValue(P_ASG_69_0_0_20_1);
	thisval = thisval&~(1<<28)|(bitval<<28);
	putValue(P_ASG_69_0_0_20_1,thisval);
}

on envVar P_ASG_69_0_0_20_1_29
{
	byte bitval;
	//thisval steht hier fuer den bitfield-wert, 
	//aus Generierungsgruenden hier keine einheitliche Bezeichnung moeglich.
	dword thisval; // MainSelection
	bitval= getValue(this);
	thisval = getValue(P_ASG_69_0_0_20_1);
	thisval = thisval&~(1<<29)|(bitval<<29);
	putValue(P_ASG_69_0_0_20_1,thisval);
}

on envVar P_ASG_69_0_0_20_1 // Display1MainSelection.MainSelection
{
	byte superval[5];

	//Update Childvalue (BitField)
	byte mask=0x01;
	int i = 0;
	dword thisval; // MainSelection
	thisval = getValue(this);
	if(thisval&(mask<<0))
		putValue(P_ASG_69_0_0_20_1_0, 1);
	else
		putValue(P_ASG_69_0_0_20_1_0, 0);
	if(thisval&(mask<<1))
		putValue(P_ASG_69_0_0_20_1_1, 1);
	else
		putValue(P_ASG_69_0_0_20_1_1, 0);
	if(thisval&(mask<<2))
		putValue(P_ASG_69_0_0_20_1_2, 1);
	else
		putValue(P_ASG_69_0_0_20_1_2, 0);
	if(thisval&(mask<<3))
		putValue(P_ASG_69_0_0_20_1_3, 1);
	else
		putValue(P_ASG_69_0_0_20_1_3, 0);
	if(thisval&(mask<<4))
		putValue(P_ASG_69_0_0_20_1_4, 1);
	else
		putValue(P_ASG_69_0_0_20_1_4, 0);
	if(thisval&(mask<<5))
		putValue(P_ASG_69_0_0_20_1_5, 1);
	else
		putValue(P_ASG_69_0_0_20_1_5, 0);
	if(thisval&(mask<<6))
		putValue(P_ASG_69_0_0_20_1_6, 1);
	else
		putValue(P_ASG_69_0_0_20_1_6, 0);
	if(thisval&(mask<<7))
		putValue(P_ASG_69_0_0_20_1_7, 1);
	else
		putValue(P_ASG_69_0_0_20_1_7, 0);
	if(thisval&(mask<<8))
		putValue(P_ASG_69_0_0_20_1_8, 1);
	else
		putValue(P_ASG_69_0_0_20_1_8, 0);
	if(thisval&(mask<<9))
		putValue(P_ASG_69_0_0_20_1_9, 1);
	else
		putValue(P_ASG_69_0_0_20_1_9, 0);
	if(thisval&(mask<<10))
		putValue(P_ASG_69_0_0_20_1_10, 1);
	else
		putValue(P_ASG_69_0_0_20_1_10, 0);
	if(thisval&(mask<<11))
		putValue(P_ASG_69_0_0_20_1_11, 1);
	else
		putValue(P_ASG_69_0_0_20_1_11, 0);
	if(thisval&(mask<<12))
		putValue(P_ASG_69_0_0_20_1_12, 1);
	else
		putValue(P_ASG_69_0_0_20_1_12, 0);
	if(thisval&(mask<<13))
		putValue(P_ASG_69_0_0_20_1_13, 1);
	else
		putValue(P_ASG_69_0_0_20_1_13, 0);
	if(thisval&(mask<<14))
		putValue(P_ASG_69_0_0_20_1_14, 1);
	else
		putValue(P_ASG_69_0_0_20_1_14, 0);
	if(thisval&(mask<<15))
		putValue(P_ASG_69_0_0_20_1_15, 1);
	else
		putValue(P_ASG_69_0_0_20_1_15, 0);
	if(thisval&(mask<<16))
		putValue(P_ASG_69_0_0_20_1_16, 1);
	else
		putValue(P_ASG_69_0_0_20_1_16, 0);
	if(thisval&(mask<<17))
		putValue(P_ASG_69_0_0_20_1_17, 1);
	else
		putValue(P_ASG_69_0_0_20_1_17, 0);
	if(thisval&(mask<<18))
		putValue(P_ASG_69_0_0_20_1_18, 1);
	else
		putValue(P_ASG_69_0_0_20_1_18, 0);
	if(thisval&(mask<<19))
		putValue(P_ASG_69_0_0_20_1_19, 1);
	else
		putValue(P_ASG_69_0_0_20_1_19, 0);
	if(thisval&(mask<<20))
		putValue(P_ASG_69_0_0_20_1_20, 1);
	else
		putValue(P_ASG_69_0_0_20_1_20, 0);
	if(thisval&(mask<<21))
		putValue(P_ASG_69_0_0_20_1_21, 1);
	else
		putValue(P_ASG_69_0_0_20_1_21, 0);
	if(thisval&(mask<<22))
		putValue(P_ASG_69_0_0_20_1_22, 1);
	else
		putValue(P_ASG_69_0_0_20_1_22, 0);
	if(thisval&(mask<<23))
		putValue(P_ASG_69_0_0_20_1_23, 1);
	else
		putValue(P_ASG_69_0_0_20_1_23, 0);
	if(thisval&(mask<<24))
		putValue(P_ASG_69_0_0_20_1_24, 1);
	else
		putValue(P_ASG_69_0_0_20_1_24, 0);
	if(thisval&(mask<<25))
		putValue(P_ASG_69_0_0_20_1_25, 1);
	else
		putValue(P_ASG_69_0_0_20_1_25, 0);
	if(thisval&(mask<<26))
		putValue(P_ASG_69_0_0_20_1_26, 1);
	else
		putValue(P_ASG_69_0_0_20_1_26, 0);
	if(thisval&(mask<<27))
		putValue(P_ASG_69_0_0_20_1_27, 1);
	else
		putValue(P_ASG_69_0_0_20_1_27, 0);
	if(thisval&(mask<<28))
		putValue(P_ASG_69_0_0_20_1_28, 1);
	else
		putValue(P_ASG_69_0_0_20_1_28, 0);
	if(thisval&(mask<<29))
		putValue(P_ASG_69_0_0_20_1_29, 1);
	else
		putValue(P_ASG_69_0_0_20_1_29, 0);

    // Update superval
	getValue(P_ASG_69_0_0_20, superval);
	superval[0]= thisval&0x000000ff;
	superval[1]=(thisval&0x0000ff00)>>8;
	superval[2]=(thisval&0x00ff0000)>>16;
	superval[3]=(thisval&0xff000000)>>24;
	putValue(P_ASG_69_0_0_20,superval);
}

// Ueberwachung der Darstellungsvariable der Range.
on envVar P_ASG_69_0_0_20_2_range // Display1MainSelection.Extension1 
{
	@P_ASG_69_0_0_20_2 = @P_ASG_69_0_0_20_2_range - (0); // slider = range - min
}

on envVar P_ASG_69_0_0_20_2 // Display1MainSelection.Extension1
{
	byte superval[5];

	//Update Childvalue (Number)
	byte thisval; // Extension1
	float slider_value;

	slider_value = 0; // Konstanter Parameter.
	@P_ASG_69_0_0_20_2_range = slider_value + (0); // real value := slider value + range min.
	thisval = (byte)round((slider_value + (0) - (0)) / (1.0), 1); // bus value := (slider value + min - offset) / step.

    // Update superval
	getValue(P_ASG_69_0_0_20, superval);
	superval[4]= superval[4]&0x0f;
	superval[4]= superval[4]|(thisval<<4);
	putValue(P_ASG_69_0_0_20,superval);
}

// Ueberwachung der Darstellungsvariable der Range.
on envVar P_ASG_69_0_0_20_3_range // Display1MainSelection.Extension2 
{
	@P_ASG_69_0_0_20_3 = @P_ASG_69_0_0_20_3_range - (0); // slider = range - min
}

on envVar P_ASG_69_0_0_20_3 // Display1MainSelection.Extension2
{
	byte superval[5];

	//Update Childvalue (Number)
	byte thisval; // Extension2
	float slider_value;

	slider_value = 0; // Konstanter Parameter.
	@P_ASG_69_0_0_20_3_range = slider_value + (0); // real value := slider value + range min.
	thisval = (byte)round((slider_value + (0) - (0)) / (1.0), 1); // bus value := (slider value + min - offset) / step.

    // Update superval
	getValue(P_ASG_69_0_0_20, superval);
	superval[4]= superval[4]&0xf0;
	superval[4]= superval[4]|thisval;
	putValue(P_ASG_69_0_0_20,superval);
}

on envVar P_ASG_69_0_0_21Get_BTN
{
 if (P_ASG_69_0_0_21Get_BTN_already_pressed == 0)
  {
       putValue(P_ASG_69_0_0_21_ErrCode,0);
       SetControlBackColor(panel_name,"errField_P_ASG_69_0_0_21",MakeRGB(255,255,255));
       P_ASG_69_0_0_21Get_BTN_already_pressed = 1;
 }
 else
 {
       Request_Void(LSGID, P_ASG_69_0_0_21_ID, DataGet_REQ); 
       P_ASG_69_0_0_21Get_BTN_already_pressed = 0;
 }
}
on envVar P_ASG_69_0_0_21 // bus value of Display2Setup (21).
{
	// opcodes: Error-Status
	dword param1; // MainSetup
	byte param2; // DisplayedAdditionalInfos
	dword param3; // AdditionalInfo1_1
	dword param4; // AdditionalInfo1_2
	dword param5; // AdditionalInfo2_1
	dword param6; // AdditionalInfo2_2
	// DATATYPE_BYTESEQUENCE / DATATYPE_FIXEDBYTESEQUENCE
	int i;
	byte superval[21];
	int currentPos;
	currentPos = 0;
	for( i = 0; i < 21; i++ ) {
		superval[i] = 0;
	}
	getValue(P_ASG_69_0_0_21, superval);
	///////// Start param1 - UINT32 /////////
	param1 = superval[currentPos++]|(superval[currentPos++]<<8)|(superval[currentPos++]<<16)|(superval[currentPos++]<<24);
	putValue(P_ASG_69_0_0_21_1, param1);
	///////// Start param2 - UINT8 /////////
	param2 = superval[currentPos++];
	putValue(P_ASG_69_0_0_21_2, param2);
	///////// Start param3 - UINT32 /////////
	param3 = superval[currentPos++]|(superval[currentPos++]<<8)|(superval[currentPos++]<<16)|(superval[currentPos++]<<24);
	putValue(P_ASG_69_0_0_21_3, param3);
	///////// Start param4 - UINT32 /////////
	param4 = superval[currentPos++]|(superval[currentPos++]<<8)|(superval[currentPos++]<<16)|(superval[currentPos++]<<24);
	putValue(P_ASG_69_0_0_21_4, param4);
	///////// Start param5 - UINT32 /////////
	param5 = superval[currentPos++]|(superval[currentPos++]<<8)|(superval[currentPos++]<<16)|(superval[currentPos++]<<24);
	putValue(P_ASG_69_0_0_21_5, param5);
	///////// Start param6 - UINT32 /////////
	param6 = superval[currentPos++]|(superval[currentPos++]<<8)|(superval[currentPos++]<<16)|(superval[currentPos++]<<24);
	putValue(P_ASG_69_0_0_21_6, param6);
}

// Updates the bus value field and other dependencies.
P_ASG_69_0_0_21_BuildFct()
{
	dword param1; // MainSetup
	byte param2; // DisplayedAdditionalInfos
	dword param3; // AdditionalInfo1_1
	dword param4; // AdditionalInfo1_2
	dword param5; // AdditionalInfo2_1
	dword param6; // AdditionalInfo2_2

	int i;
	byte superval[21];
	int currentPos;
	currentPos = 0;
// gen_BuildFunc_SetSuperVals 
	param1 = getValue(P_ASG_69_0_0_21_1);
	@P_ASG_69_0_0_21_1_0 = (param1 & 1) > 0;
	@P_ASG_69_0_0_21_1_1 = (param1 & 2) > 0;
	@P_ASG_69_0_0_21_1_2 = (param1 & 4) > 0;
	@P_ASG_69_0_0_21_1_3 = (param1 & 8) > 0;
	@P_ASG_69_0_0_21_1_4 = (param1 & 16) > 0;
	@P_ASG_69_0_0_21_1_5 = (param1 & 32) > 0;
	@P_ASG_69_0_0_21_1_6 = (param1 & 64) > 0;
	@P_ASG_69_0_0_21_1_7 = (param1 & 128) > 0;
	@P_ASG_69_0_0_21_1_8 = (param1 & 256) > 0;
	@P_ASG_69_0_0_21_1_9 = (param1 & 512) > 0;
	@P_ASG_69_0_0_21_1_10 = (param1 & 1024) > 0;
	@P_ASG_69_0_0_21_1_11 = (param1 & 2048) > 0;
	@P_ASG_69_0_0_21_1_12 = (param1 & 4096) > 0;
	@P_ASG_69_0_0_21_1_13 = (param1 & 8192) > 0;
	@P_ASG_69_0_0_21_1_14 = (param1 & 16384) > 0;
	@P_ASG_69_0_0_21_1_15 = (param1 & 32768) > 0;
	@P_ASG_69_0_0_21_1_16 = (param1 & 65536) > 0;
	@P_ASG_69_0_0_21_1_17 = (param1 & 131072) > 0;
	@P_ASG_69_0_0_21_1_18 = (param1 & 262144) > 0;
	@P_ASG_69_0_0_21_1_19 = (param1 & 524288) > 0;
	@P_ASG_69_0_0_21_1_20 = (param1 & 1048576) > 0;
	@P_ASG_69_0_0_21_1_21 = (param1 & 2097152) > 0;
	@P_ASG_69_0_0_21_1_22 = (param1 & 4194304) > 0;
	@P_ASG_69_0_0_21_1_23 = (param1 & 8388608) > 0;
	@P_ASG_69_0_0_21_1_24 = (param1 & 16777216) > 0;
	@P_ASG_69_0_0_21_1_25 = (param1 & 33554432) > 0;
	@P_ASG_69_0_0_21_1_26 = (param1 & 67108864) > 0;
	@P_ASG_69_0_0_21_1_27 = (param1 & 134217728) > 0;
	@P_ASG_69_0_0_21_1_28 = (param1 & 268435456) > 0;
	@P_ASG_69_0_0_21_1_29 = (param1 & 536870912) > 0;
	superval[currentPos++]= param1&0x000000ff;
	superval[currentPos++]=(param1&0x0000ff00)>>8;
	superval[currentPos++]=(param1&0x00ff0000)>>16;
	superval[currentPos++]=(param1&0xff000000)>>24;
// gen_BuildFunc_SetSuperVals 
	param2 = getValue(P_ASG_69_0_0_21_2);
	@P_ASG_69_0_0_21_2_0 = (param2 & 1) > 0;
	@P_ASG_69_0_0_21_2_1 = (param2 & 2) > 0;
	superval[currentPos++]=param2;
// gen_BuildFunc_SetSuperVals 
	param3 = getValue(P_ASG_69_0_0_21_3);
	@P_ASG_69_0_0_21_3_0 = (param3 & 1) > 0;
	@P_ASG_69_0_0_21_3_1 = (param3 & 2) > 0;
	@P_ASG_69_0_0_21_3_2 = (param3 & 4) > 0;
	@P_ASG_69_0_0_21_3_3 = (param3 & 8) > 0;
	@P_ASG_69_0_0_21_3_4 = (param3 & 16) > 0;
	@P_ASG_69_0_0_21_3_5 = (param3 & 32) > 0;
	@P_ASG_69_0_0_21_3_6 = (param3 & 64) > 0;
	@P_ASG_69_0_0_21_3_7 = (param3 & 128) > 0;
	@P_ASG_69_0_0_21_3_8 = (param3 & 256) > 0;
	@P_ASG_69_0_0_21_3_9 = (param3 & 512) > 0;
	@P_ASG_69_0_0_21_3_10 = (param3 & 1024) > 0;
	@P_ASG_69_0_0_21_3_11 = (param3 & 2048) > 0;
	@P_ASG_69_0_0_21_3_12 = (param3 & 4096) > 0;
	@P_ASG_69_0_0_21_3_13 = (param3 & 8192) > 0;
	@P_ASG_69_0_0_21_3_14 = (param3 & 16384) > 0;
	@P_ASG_69_0_0_21_3_15 = (param3 & 32768) > 0;
	@P_ASG_69_0_0_21_3_16 = (param3 & 65536) > 0;
	@P_ASG_69_0_0_21_3_17 = (param3 & 131072) > 0;
	@P_ASG_69_0_0_21_3_18 = (param3 & 262144) > 0;
	@P_ASG_69_0_0_21_3_19 = (param3 & 524288) > 0;
	@P_ASG_69_0_0_21_3_20 = (param3 & 1048576) > 0;
	@P_ASG_69_0_0_21_3_21 = (param3 & 2097152) > 0;
	@P_ASG_69_0_0_21_3_22 = (param3 & 4194304) > 0;
	@P_ASG_69_0_0_21_3_23 = (param3 & 8388608) > 0;
	@P_ASG_69_0_0_21_3_24 = (param3 & 16777216) > 0;
	@P_ASG_69_0_0_21_3_25 = (param3 & 33554432) > 0;
	@P_ASG_69_0_0_21_3_26 = (param3 & 67108864) > 0;
	@P_ASG_69_0_0_21_3_27 = (param3 & 134217728) > 0;
	@P_ASG_69_0_0_21_3_28 = (param3 & 268435456) > 0;
	@P_ASG_69_0_0_21_3_29 = (param3 & 536870912) > 0;
	@P_ASG_69_0_0_21_3_30 = (param3 & 1073741824) > 0;
	@P_ASG_69_0_0_21_3_31 = (param3 & -2147483648) > 0;
	superval[currentPos++]= param3&0x000000ff;
	superval[currentPos++]=(param3&0x0000ff00)>>8;
	superval[currentPos++]=(param3&0x00ff0000)>>16;
	superval[currentPos++]=(param3&0xff000000)>>24;
// gen_BuildFunc_SetSuperVals 
	param4 = getValue(P_ASG_69_0_0_21_4);
	@P_ASG_69_0_0_21_4_0 = (param4 & 1) > 0;
	@P_ASG_69_0_0_21_4_1 = (param4 & 2) > 0;
	@P_ASG_69_0_0_21_4_2 = (param4 & 4) > 0;
	@P_ASG_69_0_0_21_4_3 = (param4 & 8) > 0;
	@P_ASG_69_0_0_21_4_4 = (param4 & 16) > 0;
	@P_ASG_69_0_0_21_4_5 = (param4 & 32) > 0;
	@P_ASG_69_0_0_21_4_6 = (param4 & 64) > 0;
	@P_ASG_69_0_0_21_4_7 = (param4 & 128) > 0;
	@P_ASG_69_0_0_21_4_8 = (param4 & 256) > 0;
	@P_ASG_69_0_0_21_4_9 = (param4 & 512) > 0;
	@P_ASG_69_0_0_21_4_10 = (param4 & 1024) > 0;
	@P_ASG_69_0_0_21_4_11 = (param4 & 2048) > 0;
	@P_ASG_69_0_0_21_4_12 = (param4 & 4096) > 0;
	@P_ASG_69_0_0_21_4_13 = (param4 & 8192) > 0;
	@P_ASG_69_0_0_21_4_14 = (param4 & 16384) > 0;
	@P_ASG_69_0_0_21_4_15 = (param4 & 32768) > 0;
	@P_ASG_69_0_0_21_4_16 = (param4 & 65536) > 0;
	@P_ASG_69_0_0_21_4_17 = (param4 & 131072) > 0;
	@P_ASG_69_0_0_21_4_18 = (param4 & 262144) > 0;
	@P_ASG_69_0_0_21_4_19 = (param4 & 524288) > 0;
	@P_ASG_69_0_0_21_4_20 = (param4 & 1048576) > 0;
	@P_ASG_69_0_0_21_4_21 = (param4 & 2097152) > 0;
	@P_ASG_69_0_0_21_4_22 = (param4 & 4194304) > 0;
	@P_ASG_69_0_0_21_4_23 = (param4 & 8388608) > 0;
	@P_ASG_69_0_0_21_4_24 = (param4 & 16777216) > 0;
	@P_ASG_69_0_0_21_4_25 = (param4 & 33554432) > 0;
	@P_ASG_69_0_0_21_4_26 = (param4 & 67108864) > 0;
	@P_ASG_69_0_0_21_4_27 = (param4 & 134217728) > 0;
	@P_ASG_69_0_0_21_4_28 = (param4 & 268435456) > 0;
	@P_ASG_69_0_0_21_4_29 = (param4 & 536870912) > 0;
	superval[currentPos++]= param4&0x000000ff;
	superval[currentPos++]=(param4&0x0000ff00)>>8;
	superval[currentPos++]=(param4&0x00ff0000)>>16;
	superval[currentPos++]=(param4&0xff000000)>>24;
// gen_BuildFunc_SetSuperVals 
	param5 = getValue(P_ASG_69_0_0_21_5);
	@P_ASG_69_0_0_21_5_0 = (param5 & 1) > 0;
	@P_ASG_69_0_0_21_5_1 = (param5 & 2) > 0;
	@P_ASG_69_0_0_21_5_2 = (param5 & 4) > 0;
	@P_ASG_69_0_0_21_5_3 = (param5 & 8) > 0;
	@P_ASG_69_0_0_21_5_4 = (param5 & 16) > 0;
	@P_ASG_69_0_0_21_5_5 = (param5 & 32) > 0;
	@P_ASG_69_0_0_21_5_6 = (param5 & 64) > 0;
	@P_ASG_69_0_0_21_5_7 = (param5 & 128) > 0;
	@P_ASG_69_0_0_21_5_8 = (param5 & 256) > 0;
	@P_ASG_69_0_0_21_5_9 = (param5 & 512) > 0;
	@P_ASG_69_0_0_21_5_10 = (param5 & 1024) > 0;
	@P_ASG_69_0_0_21_5_11 = (param5 & 2048) > 0;
	@P_ASG_69_0_0_21_5_12 = (param5 & 4096) > 0;
	@P_ASG_69_0_0_21_5_13 = (param5 & 8192) > 0;
	@P_ASG_69_0_0_21_5_14 = (param5 & 16384) > 0;
	@P_ASG_69_0_0_21_5_15 = (param5 & 32768) > 0;
	@P_ASG_69_0_0_21_5_16 = (param5 & 65536) > 0;
	@P_ASG_69_0_0_21_5_17 = (param5 & 131072) > 0;
	@P_ASG_69_0_0_21_5_18 = (param5 & 262144) > 0;
	@P_ASG_69_0_0_21_5_19 = (param5 & 524288) > 0;
	@P_ASG_69_0_0_21_5_20 = (param5 & 1048576) > 0;
	@P_ASG_69_0_0_21_5_21 = (param5 & 2097152) > 0;
	@P_ASG_69_0_0_21_5_22 = (param5 & 4194304) > 0;
	@P_ASG_69_0_0_21_5_23 = (param5 & 8388608) > 0;
	@P_ASG_69_0_0_21_5_24 = (param5 & 16777216) > 0;
	@P_ASG_69_0_0_21_5_25 = (param5 & 33554432) > 0;
	@P_ASG_69_0_0_21_5_26 = (param5 & 67108864) > 0;
	@P_ASG_69_0_0_21_5_27 = (param5 & 134217728) > 0;
	@P_ASG_69_0_0_21_5_28 = (param5 & 268435456) > 0;
	@P_ASG_69_0_0_21_5_29 = (param5 & 536870912) > 0;
	@P_ASG_69_0_0_21_5_30 = (param5 & 1073741824) > 0;
	@P_ASG_69_0_0_21_5_31 = (param5 & -2147483648) > 0;
	superval[currentPos++]= param5&0x000000ff;
	superval[currentPos++]=(param5&0x0000ff00)>>8;
	superval[currentPos++]=(param5&0x00ff0000)>>16;
	superval[currentPos++]=(param5&0xff000000)>>24;
// gen_BuildFunc_SetSuperVals 
	param6 = getValue(P_ASG_69_0_0_21_6);
	@P_ASG_69_0_0_21_6_0 = (param6 & 1) > 0;
	@P_ASG_69_0_0_21_6_1 = (param6 & 2) > 0;
	@P_ASG_69_0_0_21_6_2 = (param6 & 4) > 0;
	@P_ASG_69_0_0_21_6_3 = (param6 & 8) > 0;
	@P_ASG_69_0_0_21_6_4 = (param6 & 16) > 0;
	@P_ASG_69_0_0_21_6_5 = (param6 & 32) > 0;
	@P_ASG_69_0_0_21_6_6 = (param6 & 64) > 0;
	@P_ASG_69_0_0_21_6_7 = (param6 & 128) > 0;
	@P_ASG_69_0_0_21_6_8 = (param6 & 256) > 0;
	@P_ASG_69_0_0_21_6_9 = (param6 & 512) > 0;
	@P_ASG_69_0_0_21_6_10 = (param6 & 1024) > 0;
	@P_ASG_69_0_0_21_6_11 = (param6 & 2048) > 0;
	@P_ASG_69_0_0_21_6_12 = (param6 & 4096) > 0;
	@P_ASG_69_0_0_21_6_13 = (param6 & 8192) > 0;
	@P_ASG_69_0_0_21_6_14 = (param6 & 16384) > 0;
	@P_ASG_69_0_0_21_6_15 = (param6 & 32768) > 0;
	@P_ASG_69_0_0_21_6_16 = (param6 & 65536) > 0;
	@P_ASG_69_0_0_21_6_17 = (param6 & 131072) > 0;
	@P_ASG_69_0_0_21_6_18 = (param6 & 262144) > 0;
	@P_ASG_69_0_0_21_6_19 = (param6 & 524288) > 0;
	@P_ASG_69_0_0_21_6_20 = (param6 & 1048576) > 0;
	@P_ASG_69_0_0_21_6_21 = (param6 & 2097152) > 0;
	@P_ASG_69_0_0_21_6_22 = (param6 & 4194304) > 0;
	@P_ASG_69_0_0_21_6_23 = (param6 & 8388608) > 0;
	@P_ASG_69_0_0_21_6_24 = (param6 & 16777216) > 0;
	@P_ASG_69_0_0_21_6_25 = (param6 & 33554432) > 0;
	@P_ASG_69_0_0_21_6_26 = (param6 & 67108864) > 0;
	@P_ASG_69_0_0_21_6_27 = (param6 & 134217728) > 0;
	@P_ASG_69_0_0_21_6_28 = (param6 & 268435456) > 0;
	@P_ASG_69_0_0_21_6_29 = (param6 & 536870912) > 0;
	superval[currentPos++]= param6&0x000000ff;
	superval[currentPos++]=(param6&0x0000ff00)>>8;
	superval[currentPos++]=(param6&0x00ff0000)>>16;
	superval[currentPos++]=(param6&0xff000000)>>24;
	putValue(P_ASG_69_0_0_21, superval, currentPos);
}


on envVar P_ASG_69_0_0_21_1_0
{
	byte bitval;
	//thisval steht hier fuer den bitfield-wert, 
	//aus Generierungsgruenden hier keine einheitliche Bezeichnung moeglich.
	dword thisval; // MainSetup
	bitval= getValue(this);
	thisval = getValue(P_ASG_69_0_0_21_1);
	thisval = thisval&~(1<<0)|(bitval<<0);
	putValue(P_ASG_69_0_0_21_1,thisval);
}

on envVar P_ASG_69_0_0_21_1_1
{
	byte bitval;
	//thisval steht hier fuer den bitfield-wert, 
	//aus Generierungsgruenden hier keine einheitliche Bezeichnung moeglich.
	dword thisval; // MainSetup
	bitval= getValue(this);
	thisval = getValue(P_ASG_69_0_0_21_1);
	thisval = thisval&~(1<<1)|(bitval<<1);
	putValue(P_ASG_69_0_0_21_1,thisval);
}

on envVar P_ASG_69_0_0_21_1_2
{
	byte bitval;
	//thisval steht hier fuer den bitfield-wert, 
	//aus Generierungsgruenden hier keine einheitliche Bezeichnung moeglich.
	dword thisval; // MainSetup
	bitval= getValue(this);
	thisval = getValue(P_ASG_69_0_0_21_1);
	thisval = thisval&~(1<<2)|(bitval<<2);
	putValue(P_ASG_69_0_0_21_1,thisval);
}

on envVar P_ASG_69_0_0_21_1_3
{
	byte bitval;
	//thisval steht hier fuer den bitfield-wert, 
	//aus Generierungsgruenden hier keine einheitliche Bezeichnung moeglich.
	dword thisval; // MainSetup
	bitval= getValue(this);
	thisval = getValue(P_ASG_69_0_0_21_1);
	thisval = thisval&~(1<<3)|(bitval<<3);
	putValue(P_ASG_69_0_0_21_1,thisval);
}

on envVar P_ASG_69_0_0_21_1_4
{
	byte bitval;
	//thisval steht hier fuer den bitfield-wert, 
	//aus Generierungsgruenden hier keine einheitliche Bezeichnung moeglich.
	dword thisval; // MainSetup
	bitval= getValue(this);
	thisval = getValue(P_ASG_69_0_0_21_1);
	thisval = thisval&~(1<<4)|(bitval<<4);
	putValue(P_ASG_69_0_0_21_1,thisval);
}

on envVar P_ASG_69_0_0_21_1_5
{
	byte bitval;
	//thisval steht hier fuer den bitfield-wert, 
	//aus Generierungsgruenden hier keine einheitliche Bezeichnung moeglich.
	dword thisval; // MainSetup
	bitval= getValue(this);
	thisval = getValue(P_ASG_69_0_0_21_1);
	thisval = thisval&~(1<<5)|(bitval<<5);
	putValue(P_ASG_69_0_0_21_1,thisval);
}

on envVar P_ASG_69_0_0_21_1_6
{
	byte bitval;
	//thisval steht hier fuer den bitfield-wert, 
	//aus Generierungsgruenden hier keine einheitliche Bezeichnung moeglich.
	dword thisval; // MainSetup
	bitval= getValue(this);
	thisval = getValue(P_ASG_69_0_0_21_1);
	thisval = thisval&~(1<<6)|(bitval<<6);
	putValue(P_ASG_69_0_0_21_1,thisval);
}

on envVar P_ASG_69_0_0_21_1_7
{
	byte bitval;
	//thisval steht hier fuer den bitfield-wert, 
	//aus Generierungsgruenden hier keine einheitliche Bezeichnung moeglich.
	dword thisval; // MainSetup
	bitval= getValue(this);
	thisval = getValue(P_ASG_69_0_0_21_1);
	thisval = thisval&~(1<<7)|(bitval<<7);
	putValue(P_ASG_69_0_0_21_1,thisval);
}

on envVar P_ASG_69_0_0_21_1_8
{
	byte bitval;
	//thisval steht hier fuer den bitfield-wert, 
	//aus Generierungsgruenden hier keine einheitliche Bezeichnung moeglich.
	dword thisval; // MainSetup
	bitval= getValue(this);
	thisval = getValue(P_ASG_69_0_0_21_1);
	thisval = thisval&~(1<<8)|(bitval<<8);
	putValue(P_ASG_69_0_0_21_1,thisval);
}

on envVar P_ASG_69_0_0_21_1_9
{
	byte bitval;
	//thisval steht hier fuer den bitfield-wert, 
	//aus Generierungsgruenden hier keine einheitliche Bezeichnung moeglich.
	dword thisval; // MainSetup
	bitval= getValue(this);
	thisval = getValue(P_ASG_69_0_0_21_1);
	thisval = thisval&~(1<<9)|(bitval<<9);
	putValue(P_ASG_69_0_0_21_1,thisval);
}

on envVar P_ASG_69_0_0_21_1_10
{
	byte bitval;
	//thisval steht hier fuer den bitfield-wert, 
	//aus Generierungsgruenden hier keine einheitliche Bezeichnung moeglich.
	dword thisval; // MainSetup
	bitval= getValue(this);
	thisval = getValue(P_ASG_69_0_0_21_1);
	thisval = thisval&~(1<<10)|(bitval<<10);
	putValue(P_ASG_69_0_0_21_1,thisval);
}

on envVar P_ASG_69_0_0_21_1_11
{
	byte bitval;
	//thisval steht hier fuer den bitfield-wert, 
	//aus Generierungsgruenden hier keine einheitliche Bezeichnung moeglich.
	dword thisval; // MainSetup
	bitval= getValue(this);
	thisval = getValue(P_ASG_69_0_0_21_1);
	thisval = thisval&~(1<<11)|(bitval<<11);
	putValue(P_ASG_69_0_0_21_1,thisval);
}

on envVar P_ASG_69_0_0_21_1_12
{
	byte bitval;
	//thisval steht hier fuer den bitfield-wert, 
	//aus Generierungsgruenden hier keine einheitliche Bezeichnung moeglich.
	dword thisval; // MainSetup
	bitval= getValue(this);
	thisval = getValue(P_ASG_69_0_0_21_1);
	thisval = thisval&~(1<<12)|(bitval<<12);
	putValue(P_ASG_69_0_0_21_1,thisval);
}

on envVar P_ASG_69_0_0_21_1_13
{
	byte bitval;
	//thisval steht hier fuer den bitfield-wert, 
	//aus Generierungsgruenden hier keine einheitliche Bezeichnung moeglich.
	dword thisval; // MainSetup
	bitval= getValue(this);
	thisval = getValue(P_ASG_69_0_0_21_1);
	thisval = thisval&~(1<<13)|(bitval<<13);
	putValue(P_ASG_69_0_0_21_1,thisval);
}

on envVar P_ASG_69_0_0_21_1_14
{
	byte bitval;
	//thisval steht hier fuer den bitfield-wert, 
	//aus Generierungsgruenden hier keine einheitliche Bezeichnung moeglich.
	dword thisval; // MainSetup
	bitval= getValue(this);
	thisval = getValue(P_ASG_69_0_0_21_1);
	thisval = thisval&~(1<<14)|(bitval<<14);
	putValue(P_ASG_69_0_0_21_1,thisval);
}

on envVar P_ASG_69_0_0_21_1_15
{
	byte bitval;
	//thisval steht hier fuer den bitfield-wert, 
	//aus Generierungsgruenden hier keine einheitliche Bezeichnung moeglich.
	dword thisval; // MainSetup
	bitval= getValue(this);
	thisval = getValue(P_ASG_69_0_0_21_1);
	thisval = thisval&~(1<<15)|(bitval<<15);
	putValue(P_ASG_69_0_0_21_1,thisval);
}

on envVar P_ASG_69_0_0_21_1_16
{
	byte bitval;
	//thisval steht hier fuer den bitfield-wert, 
	//aus Generierungsgruenden hier keine einheitliche Bezeichnung moeglich.
	dword thisval; // MainSetup
	bitval= getValue(this);
	thisval = getValue(P_ASG_69_0_0_21_1);
	thisval = thisval&~(1<<16)|(bitval<<16);
	putValue(P_ASG_69_0_0_21_1,thisval);
}

on envVar P_ASG_69_0_0_21_1_17
{
	byte bitval;
	//thisval steht hier fuer den bitfield-wert, 
	//aus Generierungsgruenden hier keine einheitliche Bezeichnung moeglich.
	dword thisval; // MainSetup
	bitval= getValue(this);
	thisval = getValue(P_ASG_69_0_0_21_1);
	thisval = thisval&~(1<<17)|(bitval<<17);
	putValue(P_ASG_69_0_0_21_1,thisval);
}

on envVar P_ASG_69_0_0_21_1_18
{
	byte bitval;
	//thisval steht hier fuer den bitfield-wert, 
	//aus Generierungsgruenden hier keine einheitliche Bezeichnung moeglich.
	dword thisval; // MainSetup
	bitval= getValue(this);
	thisval = getValue(P_ASG_69_0_0_21_1);
	thisval = thisval&~(1<<18)|(bitval<<18);
	putValue(P_ASG_69_0_0_21_1,thisval);
}

on envVar P_ASG_69_0_0_21_1_19
{
	byte bitval;
	//thisval steht hier fuer den bitfield-wert, 
	//aus Generierungsgruenden hier keine einheitliche Bezeichnung moeglich.
	dword thisval; // MainSetup
	bitval= getValue(this);
	thisval = getValue(P_ASG_69_0_0_21_1);
	thisval = thisval&~(1<<19)|(bitval<<19);
	putValue(P_ASG_69_0_0_21_1,thisval);
}

on envVar P_ASG_69_0_0_21_1_20
{
	byte bitval;
	//thisval steht hier fuer den bitfield-wert, 
	//aus Generierungsgruenden hier keine einheitliche Bezeichnung moeglich.
	dword thisval; // MainSetup
	bitval= getValue(this);
	thisval = getValue(P_ASG_69_0_0_21_1);
	thisval = thisval&~(1<<20)|(bitval<<20);
	putValue(P_ASG_69_0_0_21_1,thisval);
}

on envVar P_ASG_69_0_0_21_1_21
{
	byte bitval;
	//thisval steht hier fuer den bitfield-wert, 
	//aus Generierungsgruenden hier keine einheitliche Bezeichnung moeglich.
	dword thisval; // MainSetup
	bitval= getValue(this);
	thisval = getValue(P_ASG_69_0_0_21_1);
	thisval = thisval&~(1<<21)|(bitval<<21);
	putValue(P_ASG_69_0_0_21_1,thisval);
}

on envVar P_ASG_69_0_0_21_1_22
{
	byte bitval;
	//thisval steht hier fuer den bitfield-wert, 
	//aus Generierungsgruenden hier keine einheitliche Bezeichnung moeglich.
	dword thisval; // MainSetup
	bitval= getValue(this);
	thisval = getValue(P_ASG_69_0_0_21_1);
	thisval = thisval&~(1<<22)|(bitval<<22);
	putValue(P_ASG_69_0_0_21_1,thisval);
}

on envVar P_ASG_69_0_0_21_1_23
{
	byte bitval;
	//thisval steht hier fuer den bitfield-wert, 
	//aus Generierungsgruenden hier keine einheitliche Bezeichnung moeglich.
	dword thisval; // MainSetup
	bitval= getValue(this);
	thisval = getValue(P_ASG_69_0_0_21_1);
	thisval = thisval&~(1<<23)|(bitval<<23);
	putValue(P_ASG_69_0_0_21_1,thisval);
}

on envVar P_ASG_69_0_0_21_1_24
{
	byte bitval;
	//thisval steht hier fuer den bitfield-wert, 
	//aus Generierungsgruenden hier keine einheitliche Bezeichnung moeglich.
	dword thisval; // MainSetup
	bitval= getValue(this);
	thisval = getValue(P_ASG_69_0_0_21_1);
	thisval = thisval&~(1<<24)|(bitval<<24);
	putValue(P_ASG_69_0_0_21_1,thisval);
}

on envVar P_ASG_69_0_0_21_1_25
{
	byte bitval;
	//thisval steht hier fuer den bitfield-wert, 
	//aus Generierungsgruenden hier keine einheitliche Bezeichnung moeglich.
	dword thisval; // MainSetup
	bitval= getValue(this);
	thisval = getValue(P_ASG_69_0_0_21_1);
	thisval = thisval&~(1<<25)|(bitval<<25);
	putValue(P_ASG_69_0_0_21_1,thisval);
}

on envVar P_ASG_69_0_0_21_1_26
{
	byte bitval;
	//thisval steht hier fuer den bitfield-wert, 
	//aus Generierungsgruenden hier keine einheitliche Bezeichnung moeglich.
	dword thisval; // MainSetup
	bitval= getValue(this);
	thisval = getValue(P_ASG_69_0_0_21_1);
	thisval = thisval&~(1<<26)|(bitval<<26);
	putValue(P_ASG_69_0_0_21_1,thisval);
}

on envVar P_ASG_69_0_0_21_1_27
{
	byte bitval;
	//thisval steht hier fuer den bitfield-wert, 
	//aus Generierungsgruenden hier keine einheitliche Bezeichnung moeglich.
	dword thisval; // MainSetup
	bitval= getValue(this);
	thisval = getValue(P_ASG_69_0_0_21_1);
	thisval = thisval&~(1<<27)|(bitval<<27);
	putValue(P_ASG_69_0_0_21_1,thisval);
}

on envVar P_ASG_69_0_0_21_1_28
{
	byte bitval;
	//thisval steht hier fuer den bitfield-wert, 
	//aus Generierungsgruenden hier keine einheitliche Bezeichnung moeglich.
	dword thisval; // MainSetup
	bitval= getValue(this);
	thisval = getValue(P_ASG_69_0_0_21_1);
	thisval = thisval&~(1<<28)|(bitval<<28);
	putValue(P_ASG_69_0_0_21_1,thisval);
}

on envVar P_ASG_69_0_0_21_1_29
{
	byte bitval;
	//thisval steht hier fuer den bitfield-wert, 
	//aus Generierungsgruenden hier keine einheitliche Bezeichnung moeglich.
	dword thisval; // MainSetup
	bitval= getValue(this);
	thisval = getValue(P_ASG_69_0_0_21_1);
	thisval = thisval&~(1<<29)|(bitval<<29);
	putValue(P_ASG_69_0_0_21_1,thisval);
}

on envVar P_ASG_69_0_0_21_1 // Display2Setup.MainSetup
{
	P_ASG_69_0_0_21_BuildFct();
}

on envVar P_ASG_69_0_0_21_2_0
{
	byte bitval;
	//thisval steht hier fuer den bitfield-wert, 
	//aus Generierungsgruenden hier keine einheitliche Bezeichnung moeglich.
	byte thisval; // DisplayedAdditionalInfos
	bitval= getValue(this);
	thisval = getValue(P_ASG_69_0_0_21_2);
	thisval = thisval&~(1<<0)|(bitval<<0);
	putValue(P_ASG_69_0_0_21_2,thisval);
}

on envVar P_ASG_69_0_0_21_2_1
{
	byte bitval;
	//thisval steht hier fuer den bitfield-wert, 
	//aus Generierungsgruenden hier keine einheitliche Bezeichnung moeglich.
	byte thisval; // DisplayedAdditionalInfos
	bitval= getValue(this);
	thisval = getValue(P_ASG_69_0_0_21_2);
	thisval = thisval&~(1<<1)|(bitval<<1);
	putValue(P_ASG_69_0_0_21_2,thisval);
}

on envVar P_ASG_69_0_0_21_2 // Display2Setup.DisplayedAdditionalInfos
{
	P_ASG_69_0_0_21_BuildFct();
}

on envVar P_ASG_69_0_0_21_3_0
{
	byte bitval;
	//thisval steht hier fuer den bitfield-wert, 
	//aus Generierungsgruenden hier keine einheitliche Bezeichnung moeglich.
	dword thisval; // AdditionalInfo1_1
	bitval= getValue(this);
	thisval = getValue(P_ASG_69_0_0_21_3);
	thisval = thisval&~(1<<0)|(bitval<<0);
	putValue(P_ASG_69_0_0_21_3,thisval);
}

on envVar P_ASG_69_0_0_21_3_1
{
	byte bitval;
	//thisval steht hier fuer den bitfield-wert, 
	//aus Generierungsgruenden hier keine einheitliche Bezeichnung moeglich.
	dword thisval; // AdditionalInfo1_1
	bitval= getValue(this);
	thisval = getValue(P_ASG_69_0_0_21_3);
	thisval = thisval&~(1<<1)|(bitval<<1);
	putValue(P_ASG_69_0_0_21_3,thisval);
}

on envVar P_ASG_69_0_0_21_3_2
{
	byte bitval;
	//thisval steht hier fuer den bitfield-wert, 
	//aus Generierungsgruenden hier keine einheitliche Bezeichnung moeglich.
	dword thisval; // AdditionalInfo1_1
	bitval= getValue(this);
	thisval = getValue(P_ASG_69_0_0_21_3);
	thisval = thisval&~(1<<2)|(bitval<<2);
	putValue(P_ASG_69_0_0_21_3,thisval);
}

on envVar P_ASG_69_0_0_21_3_3
{
	byte bitval;
	//thisval steht hier fuer den bitfield-wert, 
	//aus Generierungsgruenden hier keine einheitliche Bezeichnung moeglich.
	dword thisval; // AdditionalInfo1_1
	bitval= getValue(this);
	thisval = getValue(P_ASG_69_0_0_21_3);
	thisval = thisval&~(1<<3)|(bitval<<3);
	putValue(P_ASG_69_0_0_21_3,thisval);
}

on envVar P_ASG_69_0_0_21_3_4
{
	byte bitval;
	//thisval steht hier fuer den bitfield-wert, 
	//aus Generierungsgruenden hier keine einheitliche Bezeichnung moeglich.
	dword thisval; // AdditionalInfo1_1
	bitval= getValue(this);
	thisval = getValue(P_ASG_69_0_0_21_3);
	thisval = thisval&~(1<<4)|(bitval<<4);
	putValue(P_ASG_69_0_0_21_3,thisval);
}

on envVar P_ASG_69_0_0_21_3_5
{
	byte bitval;
	//thisval steht hier fuer den bitfield-wert, 
	//aus Generierungsgruenden hier keine einheitliche Bezeichnung moeglich.
	dword thisval; // AdditionalInfo1_1
	bitval= getValue(this);
	thisval = getValue(P_ASG_69_0_0_21_3);
	thisval = thisval&~(1<<5)|(bitval<<5);
	putValue(P_ASG_69_0_0_21_3,thisval);
}

on envVar P_ASG_69_0_0_21_3_6
{
	byte bitval;
	//thisval steht hier fuer den bitfield-wert, 
	//aus Generierungsgruenden hier keine einheitliche Bezeichnung moeglich.
	dword thisval; // AdditionalInfo1_1
	bitval= getValue(this);
	thisval = getValue(P_ASG_69_0_0_21_3);
	thisval = thisval&~(1<<6)|(bitval<<6);
	putValue(P_ASG_69_0_0_21_3,thisval);
}

on envVar P_ASG_69_0_0_21_3_7
{
	byte bitval;
	//thisval steht hier fuer den bitfield-wert, 
	//aus Generierungsgruenden hier keine einheitliche Bezeichnung moeglich.
	dword thisval; // AdditionalInfo1_1
	bitval= getValue(this);
	thisval = getValue(P_ASG_69_0_0_21_3);
	thisval = thisval&~(1<<7)|(bitval<<7);
	putValue(P_ASG_69_0_0_21_3,thisval);
}

on envVar P_ASG_69_0_0_21_3_8
{
	byte bitval;
	//thisval steht hier fuer den bitfield-wert, 
	//aus Generierungsgruenden hier keine einheitliche Bezeichnung moeglich.
	dword thisval; // AdditionalInfo1_1
	bitval= getValue(this);
	thisval = getValue(P_ASG_69_0_0_21_3);
	thisval = thisval&~(1<<8)|(bitval<<8);
	putValue(P_ASG_69_0_0_21_3,thisval);
}

on envVar P_ASG_69_0_0_21_3_9
{
	byte bitval;
	//thisval steht hier fuer den bitfield-wert, 
	//aus Generierungsgruenden hier keine einheitliche Bezeichnung moeglich.
	dword thisval; // AdditionalInfo1_1
	bitval= getValue(this);
	thisval = getValue(P_ASG_69_0_0_21_3);
	thisval = thisval&~(1<<9)|(bitval<<9);
	putValue(P_ASG_69_0_0_21_3,thisval);
}

on envVar P_ASG_69_0_0_21_3_10
{
	byte bitval;
	//thisval steht hier fuer den bitfield-wert, 
	//aus Generierungsgruenden hier keine einheitliche Bezeichnung moeglich.
	dword thisval; // AdditionalInfo1_1
	bitval= getValue(this);
	thisval = getValue(P_ASG_69_0_0_21_3);
	thisval = thisval&~(1<<10)|(bitval<<10);
	putValue(P_ASG_69_0_0_21_3,thisval);
}

on envVar P_ASG_69_0_0_21_3_11
{
	byte bitval;
	//thisval steht hier fuer den bitfield-wert, 
	//aus Generierungsgruenden hier keine einheitliche Bezeichnung moeglich.
	dword thisval; // AdditionalInfo1_1
	bitval= getValue(this);
	thisval = getValue(P_ASG_69_0_0_21_3);
	thisval = thisval&~(1<<11)|(bitval<<11);
	putValue(P_ASG_69_0_0_21_3,thisval);
}

on envVar P_ASG_69_0_0_21_3_12
{
	byte bitval;
	//thisval steht hier fuer den bitfield-wert, 
	//aus Generierungsgruenden hier keine einheitliche Bezeichnung moeglich.
	dword thisval; // AdditionalInfo1_1
	bitval= getValue(this);
	thisval = getValue(P_ASG_69_0_0_21_3);
	thisval = thisval&~(1<<12)|(bitval<<12);
	putValue(P_ASG_69_0_0_21_3,thisval);
}

on envVar P_ASG_69_0_0_21_3_13
{
	byte bitval;
	//thisval steht hier fuer den bitfield-wert, 
	//aus Generierungsgruenden hier keine einheitliche Bezeichnung moeglich.
	dword thisval; // AdditionalInfo1_1
	bitval= getValue(this);
	thisval = getValue(P_ASG_69_0_0_21_3);
	thisval = thisval&~(1<<13)|(bitval<<13);
	putValue(P_ASG_69_0_0_21_3,thisval);
}

on envVar P_ASG_69_0_0_21_3_14
{
	byte bitval;
	//thisval steht hier fuer den bitfield-wert, 
	//aus Generierungsgruenden hier keine einheitliche Bezeichnung moeglich.
	dword thisval; // AdditionalInfo1_1
	bitval= getValue(this);
	thisval = getValue(P_ASG_69_0_0_21_3);
	thisval = thisval&~(1<<14)|(bitval<<14);
	putValue(P_ASG_69_0_0_21_3,thisval);
}

on envVar P_ASG_69_0_0_21_3_15
{
	byte bitval;
	//thisval steht hier fuer den bitfield-wert, 
	//aus Generierungsgruenden hier keine einheitliche Bezeichnung moeglich.
	dword thisval; // AdditionalInfo1_1
	bitval= getValue(this);
	thisval = getValue(P_ASG_69_0_0_21_3);
	thisval = thisval&~(1<<15)|(bitval<<15);
	putValue(P_ASG_69_0_0_21_3,thisval);
}

on envVar P_ASG_69_0_0_21_3_16
{
	byte bitval;
	//thisval steht hier fuer den bitfield-wert, 
	//aus Generierungsgruenden hier keine einheitliche Bezeichnung moeglich.
	dword thisval; // AdditionalInfo1_1
	bitval= getValue(this);
	thisval = getValue(P_ASG_69_0_0_21_3);
	thisval = thisval&~(1<<16)|(bitval<<16);
	putValue(P_ASG_69_0_0_21_3,thisval);
}

on envVar P_ASG_69_0_0_21_3_17
{
	byte bitval;
	//thisval steht hier fuer den bitfield-wert, 
	//aus Generierungsgruenden hier keine einheitliche Bezeichnung moeglich.
	dword thisval; // AdditionalInfo1_1
	bitval= getValue(this);
	thisval = getValue(P_ASG_69_0_0_21_3);
	thisval = thisval&~(1<<17)|(bitval<<17);
	putValue(P_ASG_69_0_0_21_3,thisval);
}

on envVar P_ASG_69_0_0_21_3_18
{
	byte bitval;
	//thisval steht hier fuer den bitfield-wert, 
	//aus Generierungsgruenden hier keine einheitliche Bezeichnung moeglich.
	dword thisval; // AdditionalInfo1_1
	bitval= getValue(this);
	thisval = getValue(P_ASG_69_0_0_21_3);
	thisval = thisval&~(1<<18)|(bitval<<18);
	putValue(P_ASG_69_0_0_21_3,thisval);
}

on envVar P_ASG_69_0_0_21_3_19
{
	byte bitval;
	//thisval steht hier fuer den bitfield-wert, 
	//aus Generierungsgruenden hier keine einheitliche Bezeichnung moeglich.
	dword thisval; // AdditionalInfo1_1
	bitval= getValue(this);
	thisval = getValue(P_ASG_69_0_0_21_3);
	thisval = thisval&~(1<<19)|(bitval<<19);
	putValue(P_ASG_69_0_0_21_3,thisval);
}

on envVar P_ASG_69_0_0_21_3_20
{
	byte bitval;
	//thisval steht hier fuer den bitfield-wert, 
	//aus Generierungsgruenden hier keine einheitliche Bezeichnung moeglich.
	dword thisval; // AdditionalInfo1_1
	bitval= getValue(this);
	thisval = getValue(P_ASG_69_0_0_21_3);
	thisval = thisval&~(1<<20)|(bitval<<20);
	putValue(P_ASG_69_0_0_21_3,thisval);
}

on envVar P_ASG_69_0_0_21_3_21
{
	byte bitval;
	//thisval steht hier fuer den bitfield-wert, 
	//aus Generierungsgruenden hier keine einheitliche Bezeichnung moeglich.
	dword thisval; // AdditionalInfo1_1
	bitval= getValue(this);
	thisval = getValue(P_ASG_69_0_0_21_3);
	thisval = thisval&~(1<<21)|(bitval<<21);
	putValue(P_ASG_69_0_0_21_3,thisval);
}

on envVar P_ASG_69_0_0_21_3_22
{
	byte bitval;
	//thisval steht hier fuer den bitfield-wert, 
	//aus Generierungsgruenden hier keine einheitliche Bezeichnung moeglich.
	dword thisval; // AdditionalInfo1_1
	bitval= getValue(this);
	thisval = getValue(P_ASG_69_0_0_21_3);
	thisval = thisval&~(1<<22)|(bitval<<22);
	putValue(P_ASG_69_0_0_21_3,thisval);
}

on envVar P_ASG_69_0_0_21_3_23
{
	byte bitval;
	//thisval steht hier fuer den bitfield-wert, 
	//aus Generierungsgruenden hier keine einheitliche Bezeichnung moeglich.
	dword thisval; // AdditionalInfo1_1
	bitval= getValue(this);
	thisval = getValue(P_ASG_69_0_0_21_3);
	thisval = thisval&~(1<<23)|(bitval<<23);
	putValue(P_ASG_69_0_0_21_3,thisval);
}

on envVar P_ASG_69_0_0_21_3_24
{
	byte bitval;
	//thisval steht hier fuer den bitfield-wert, 
	//aus Generierungsgruenden hier keine einheitliche Bezeichnung moeglich.
	dword thisval; // AdditionalInfo1_1
	bitval= getValue(this);
	thisval = getValue(P_ASG_69_0_0_21_3);
	thisval = thisval&~(1<<24)|(bitval<<24);
	putValue(P_ASG_69_0_0_21_3,thisval);
}

on envVar P_ASG_69_0_0_21_3_25
{
	byte bitval;
	//thisval steht hier fuer den bitfield-wert, 
	//aus Generierungsgruenden hier keine einheitliche Bezeichnung moeglich.
	dword thisval; // AdditionalInfo1_1
	bitval= getValue(this);
	thisval = getValue(P_ASG_69_0_0_21_3);
	thisval = thisval&~(1<<25)|(bitval<<25);
	putValue(P_ASG_69_0_0_21_3,thisval);
}

on envVar P_ASG_69_0_0_21_3_26
{
	byte bitval;
	//thisval steht hier fuer den bitfield-wert, 
	//aus Generierungsgruenden hier keine einheitliche Bezeichnung moeglich.
	dword thisval; // AdditionalInfo1_1
	bitval= getValue(this);
	thisval = getValue(P_ASG_69_0_0_21_3);
	thisval = thisval&~(1<<26)|(bitval<<26);
	putValue(P_ASG_69_0_0_21_3,thisval);
}

on envVar P_ASG_69_0_0_21_3_27
{
	byte bitval;
	//thisval steht hier fuer den bitfield-wert, 
	//aus Generierungsgruenden hier keine einheitliche Bezeichnung moeglich.
	dword thisval; // AdditionalInfo1_1
	bitval= getValue(this);
	thisval = getValue(P_ASG_69_0_0_21_3);
	thisval = thisval&~(1<<27)|(bitval<<27);
	putValue(P_ASG_69_0_0_21_3,thisval);
}

on envVar P_ASG_69_0_0_21_3_28
{
	byte bitval;
	//thisval steht hier fuer den bitfield-wert, 
	//aus Generierungsgruenden hier keine einheitliche Bezeichnung moeglich.
	dword thisval; // AdditionalInfo1_1
	bitval= getValue(this);
	thisval = getValue(P_ASG_69_0_0_21_3);
	thisval = thisval&~(1<<28)|(bitval<<28);
	putValue(P_ASG_69_0_0_21_3,thisval);
}

on envVar P_ASG_69_0_0_21_3_29
{
	byte bitval;
	//thisval steht hier fuer den bitfield-wert, 
	//aus Generierungsgruenden hier keine einheitliche Bezeichnung moeglich.
	dword thisval; // AdditionalInfo1_1
	bitval= getValue(this);
	thisval = getValue(P_ASG_69_0_0_21_3);
	thisval = thisval&~(1<<29)|(bitval<<29);
	putValue(P_ASG_69_0_0_21_3,thisval);
}

on envVar P_ASG_69_0_0_21_3_30
{
	byte bitval;
	//thisval steht hier fuer den bitfield-wert, 
	//aus Generierungsgruenden hier keine einheitliche Bezeichnung moeglich.
	dword thisval; // AdditionalInfo1_1
	bitval= getValue(this);
	thisval = getValue(P_ASG_69_0_0_21_3);
	thisval = thisval&~(1<<30)|(bitval<<30);
	putValue(P_ASG_69_0_0_21_3,thisval);
}

on envVar P_ASG_69_0_0_21_3_31
{
	byte bitval;
	//thisval steht hier fuer den bitfield-wert, 
	//aus Generierungsgruenden hier keine einheitliche Bezeichnung moeglich.
	dword thisval; // AdditionalInfo1_1
	bitval= getValue(this);
	thisval = getValue(P_ASG_69_0_0_21_3);
	thisval = thisval&~(1<<31)|(bitval<<31);
	putValue(P_ASG_69_0_0_21_3,thisval);
}

on envVar P_ASG_69_0_0_21_3 // Display2Setup.AdditionalInfo1_1
{
	P_ASG_69_0_0_21_BuildFct();
}

on envVar P_ASG_69_0_0_21_4_0
{
	byte bitval;
	//thisval steht hier fuer den bitfield-wert, 
	//aus Generierungsgruenden hier keine einheitliche Bezeichnung moeglich.
	dword thisval; // AdditionalInfo1_2
	bitval= getValue(this);
	thisval = getValue(P_ASG_69_0_0_21_4);
	thisval = thisval&~(1<<0)|(bitval<<0);
	putValue(P_ASG_69_0_0_21_4,thisval);
}

on envVar P_ASG_69_0_0_21_4_1
{
	byte bitval;
	//thisval steht hier fuer den bitfield-wert, 
	//aus Generierungsgruenden hier keine einheitliche Bezeichnung moeglich.
	dword thisval; // AdditionalInfo1_2
	bitval= getValue(this);
	thisval = getValue(P_ASG_69_0_0_21_4);
	thisval = thisval&~(1<<1)|(bitval<<1);
	putValue(P_ASG_69_0_0_21_4,thisval);
}

on envVar P_ASG_69_0_0_21_4_2
{
	byte bitval;
	//thisval steht hier fuer den bitfield-wert, 
	//aus Generierungsgruenden hier keine einheitliche Bezeichnung moeglich.
	dword thisval; // AdditionalInfo1_2
	bitval= getValue(this);
	thisval = getValue(P_ASG_69_0_0_21_4);
	thisval = thisval&~(1<<2)|(bitval<<2);
	putValue(P_ASG_69_0_0_21_4,thisval);
}

on envVar P_ASG_69_0_0_21_4_3
{
	byte bitval;
	//thisval steht hier fuer den bitfield-wert, 
	//aus Generierungsgruenden hier keine einheitliche Bezeichnung moeglich.
	dword thisval; // AdditionalInfo1_2
	bitval= getValue(this);
	thisval = getValue(P_ASG_69_0_0_21_4);
	thisval = thisval&~(1<<3)|(bitval<<3);
	putValue(P_ASG_69_0_0_21_4,thisval);
}

on envVar P_ASG_69_0_0_21_4_4
{
	byte bitval;
	//thisval steht hier fuer den bitfield-wert, 
	//aus Generierungsgruenden hier keine einheitliche Bezeichnung moeglich.
	dword thisval; // AdditionalInfo1_2
	bitval= getValue(this);
	thisval = getValue(P_ASG_69_0_0_21_4);
	thisval = thisval&~(1<<4)|(bitval<<4);
	putValue(P_ASG_69_0_0_21_4,thisval);
}

on envVar P_ASG_69_0_0_21_4_5
{
	byte bitval;
	//thisval steht hier fuer den bitfield-wert, 
	//aus Generierungsgruenden hier keine einheitliche Bezeichnung moeglich.
	dword thisval; // AdditionalInfo1_2
	bitval= getValue(this);
	thisval = getValue(P_ASG_69_0_0_21_4);
	thisval = thisval&~(1<<5)|(bitval<<5);
	putValue(P_ASG_69_0_0_21_4,thisval);
}

on envVar P_ASG_69_0_0_21_4_6
{
	byte bitval;
	//thisval steht hier fuer den bitfield-wert, 
	//aus Generierungsgruenden hier keine einheitliche Bezeichnung moeglich.
	dword thisval; // AdditionalInfo1_2
	bitval= getValue(this);
	thisval = getValue(P_ASG_69_0_0_21_4);
	thisval = thisval&~(1<<6)|(bitval<<6);
	putValue(P_ASG_69_0_0_21_4,thisval);
}

on envVar P_ASG_69_0_0_21_4_7
{
	byte bitval;
	//thisval steht hier fuer den bitfield-wert, 
	//aus Generierungsgruenden hier keine einheitliche Bezeichnung moeglich.
	dword thisval; // AdditionalInfo1_2
	bitval= getValue(this);
	thisval = getValue(P_ASG_69_0_0_21_4);
	thisval = thisval&~(1<<7)|(bitval<<7);
	putValue(P_ASG_69_0_0_21_4,thisval);
}

on envVar P_ASG_69_0_0_21_4_8
{
	byte bitval;
	//thisval steht hier fuer den bitfield-wert, 
	//aus Generierungsgruenden hier keine einheitliche Bezeichnung moeglich.
	dword thisval; // AdditionalInfo1_2
	bitval= getValue(this);
	thisval = getValue(P_ASG_69_0_0_21_4);
	thisval = thisval&~(1<<8)|(bitval<<8);
	putValue(P_ASG_69_0_0_21_4,thisval);
}

on envVar P_ASG_69_0_0_21_4_9
{
	byte bitval;
	//thisval steht hier fuer den bitfield-wert, 
	//aus Generierungsgruenden hier keine einheitliche Bezeichnung moeglich.
	dword thisval; // AdditionalInfo1_2
	bitval= getValue(this);
	thisval = getValue(P_ASG_69_0_0_21_4);
	thisval = thisval&~(1<<9)|(bitval<<9);
	putValue(P_ASG_69_0_0_21_4,thisval);
}

on envVar P_ASG_69_0_0_21_4_10
{
	byte bitval;
	//thisval steht hier fuer den bitfield-wert, 
	//aus Generierungsgruenden hier keine einheitliche Bezeichnung moeglich.
	dword thisval; // AdditionalInfo1_2
	bitval= getValue(this);
	thisval = getValue(P_ASG_69_0_0_21_4);
	thisval = thisval&~(1<<10)|(bitval<<10);
	putValue(P_ASG_69_0_0_21_4,thisval);
}

on envVar P_ASG_69_0_0_21_4_11
{
	byte bitval;
	//thisval steht hier fuer den bitfield-wert, 
	//aus Generierungsgruenden hier keine einheitliche Bezeichnung moeglich.
	dword thisval; // AdditionalInfo1_2
	bitval= getValue(this);
	thisval = getValue(P_ASG_69_0_0_21_4);
	thisval = thisval&~(1<<11)|(bitval<<11);
	putValue(P_ASG_69_0_0_21_4,thisval);
}

on envVar P_ASG_69_0_0_21_4_12
{
	byte bitval;
	//thisval steht hier fuer den bitfield-wert, 
	//aus Generierungsgruenden hier keine einheitliche Bezeichnung moeglich.
	dword thisval; // AdditionalInfo1_2
	bitval= getValue(this);
	thisval = getValue(P_ASG_69_0_0_21_4);
	thisval = thisval&~(1<<12)|(bitval<<12);
	putValue(P_ASG_69_0_0_21_4,thisval);
}

on envVar P_ASG_69_0_0_21_4_13
{
	byte bitval;
	//thisval steht hier fuer den bitfield-wert, 
	//aus Generierungsgruenden hier keine einheitliche Bezeichnung moeglich.
	dword thisval; // AdditionalInfo1_2
	bitval= getValue(this);
	thisval = getValue(P_ASG_69_0_0_21_4);
	thisval = thisval&~(1<<13)|(bitval<<13);
	putValue(P_ASG_69_0_0_21_4,thisval);
}

on envVar P_ASG_69_0_0_21_4_14
{
	byte bitval;
	//thisval steht hier fuer den bitfield-wert, 
	//aus Generierungsgruenden hier keine einheitliche Bezeichnung moeglich.
	dword thisval; // AdditionalInfo1_2
	bitval= getValue(this);
	thisval = getValue(P_ASG_69_0_0_21_4);
	thisval = thisval&~(1<<14)|(bitval<<14);
	putValue(P_ASG_69_0_0_21_4,thisval);
}

on envVar P_ASG_69_0_0_21_4_15
{
	byte bitval;
	//thisval steht hier fuer den bitfield-wert, 
	//aus Generierungsgruenden hier keine einheitliche Bezeichnung moeglich.
	dword thisval; // AdditionalInfo1_2
	bitval= getValue(this);
	thisval = getValue(P_ASG_69_0_0_21_4);
	thisval = thisval&~(1<<15)|(bitval<<15);
	putValue(P_ASG_69_0_0_21_4,thisval);
}

on envVar P_ASG_69_0_0_21_4_16
{
	byte bitval;
	//thisval steht hier fuer den bitfield-wert, 
	//aus Generierungsgruenden hier keine einheitliche Bezeichnung moeglich.
	dword thisval; // AdditionalInfo1_2
	bitval= getValue(this);
	thisval = getValue(P_ASG_69_0_0_21_4);
	thisval = thisval&~(1<<16)|(bitval<<16);
	putValue(P_ASG_69_0_0_21_4,thisval);
}

on envVar P_ASG_69_0_0_21_4_17
{
	byte bitval;
	//thisval steht hier fuer den bitfield-wert, 
	//aus Generierungsgruenden hier keine einheitliche Bezeichnung moeglich.
	dword thisval; // AdditionalInfo1_2
	bitval= getValue(this);
	thisval = getValue(P_ASG_69_0_0_21_4);
	thisval = thisval&~(1<<17)|(bitval<<17);
	putValue(P_ASG_69_0_0_21_4,thisval);
}

on envVar P_ASG_69_0_0_21_4_18
{
	byte bitval;
	//thisval steht hier fuer den bitfield-wert, 
	//aus Generierungsgruenden hier keine einheitliche Bezeichnung moeglich.
	dword thisval; // AdditionalInfo1_2
	bitval= getValue(this);
	thisval = getValue(P_ASG_69_0_0_21_4);
	thisval = thisval&~(1<<18)|(bitval<<18);
	putValue(P_ASG_69_0_0_21_4,thisval);
}

on envVar P_ASG_69_0_0_21_4_19
{
	byte bitval;
	//thisval steht hier fuer den bitfield-wert, 
	//aus Generierungsgruenden hier keine einheitliche Bezeichnung moeglich.
	dword thisval; // AdditionalInfo1_2
	bitval= getValue(this);
	thisval = getValue(P_ASG_69_0_0_21_4);
	thisval = thisval&~(1<<19)|(bitval<<19);
	putValue(P_ASG_69_0_0_21_4,thisval);
}

on envVar P_ASG_69_0_0_21_4_20
{
	byte bitval;
	//thisval steht hier fuer den bitfield-wert, 
	//aus Generierungsgruenden hier keine einheitliche Bezeichnung moeglich.
	dword thisval; // AdditionalInfo1_2
	bitval= getValue(this);
	thisval = getValue(P_ASG_69_0_0_21_4);
	thisval = thisval&~(1<<20)|(bitval<<20);
	putValue(P_ASG_69_0_0_21_4,thisval);
}

on envVar P_ASG_69_0_0_21_4_21
{
	byte bitval;
	//thisval steht hier fuer den bitfield-wert, 
	//aus Generierungsgruenden hier keine einheitliche Bezeichnung moeglich.
	dword thisval; // AdditionalInfo1_2
	bitval= getValue(this);
	thisval = getValue(P_ASG_69_0_0_21_4);
	thisval = thisval&~(1<<21)|(bitval<<21);
	putValue(P_ASG_69_0_0_21_4,thisval);
}

on envVar P_ASG_69_0_0_21_4_22
{
	byte bitval;
	//thisval steht hier fuer den bitfield-wert, 
	//aus Generierungsgruenden hier keine einheitliche Bezeichnung moeglich.
	dword thisval; // AdditionalInfo1_2
	bitval= getValue(this);
	thisval = getValue(P_ASG_69_0_0_21_4);
	thisval = thisval&~(1<<22)|(bitval<<22);
	putValue(P_ASG_69_0_0_21_4,thisval);
}

on envVar P_ASG_69_0_0_21_4_23
{
	byte bitval;
	//thisval steht hier fuer den bitfield-wert, 
	//aus Generierungsgruenden hier keine einheitliche Bezeichnung moeglich.
	dword thisval; // AdditionalInfo1_2
	bitval= getValue(this);
	thisval = getValue(P_ASG_69_0_0_21_4);
	thisval = thisval&~(1<<23)|(bitval<<23);
	putValue(P_ASG_69_0_0_21_4,thisval);
}

on envVar P_ASG_69_0_0_21_4_24
{
	byte bitval;
	//thisval steht hier fuer den bitfield-wert, 
	//aus Generierungsgruenden hier keine einheitliche Bezeichnung moeglich.
	dword thisval; // AdditionalInfo1_2
	bitval= getValue(this);
	thisval = getValue(P_ASG_69_0_0_21_4);
	thisval = thisval&~(1<<24)|(bitval<<24);
	putValue(P_ASG_69_0_0_21_4,thisval);
}

on envVar P_ASG_69_0_0_21_4_25
{
	byte bitval;
	//thisval steht hier fuer den bitfield-wert, 
	//aus Generierungsgruenden hier keine einheitliche Bezeichnung moeglich.
	dword thisval; // AdditionalInfo1_2
	bitval= getValue(this);
	thisval = getValue(P_ASG_69_0_0_21_4);
	thisval = thisval&~(1<<25)|(bitval<<25);
	putValue(P_ASG_69_0_0_21_4,thisval);
}

on envVar P_ASG_69_0_0_21_4_26
{
	byte bitval;
	//thisval steht hier fuer den bitfield-wert, 
	//aus Generierungsgruenden hier keine einheitliche Bezeichnung moeglich.
	dword thisval; // AdditionalInfo1_2
	bitval= getValue(this);
	thisval = getValue(P_ASG_69_0_0_21_4);
	thisval = thisval&~(1<<26)|(bitval<<26);
	putValue(P_ASG_69_0_0_21_4,thisval);
}

on envVar P_ASG_69_0_0_21_4_27
{
	byte bitval;
	//thisval steht hier fuer den bitfield-wert, 
	//aus Generierungsgruenden hier keine einheitliche Bezeichnung moeglich.
	dword thisval; // AdditionalInfo1_2
	bitval= getValue(this);
	thisval = getValue(P_ASG_69_0_0_21_4);
	thisval = thisval&~(1<<27)|(bitval<<27);
	putValue(P_ASG_69_0_0_21_4,thisval);
}

on envVar P_ASG_69_0_0_21_4_28
{
	byte bitval;
	//thisval steht hier fuer den bitfield-wert, 
	//aus Generierungsgruenden hier keine einheitliche Bezeichnung moeglich.
	dword thisval; // AdditionalInfo1_2
	bitval= getValue(this);
	thisval = getValue(P_ASG_69_0_0_21_4);
	thisval = thisval&~(1<<28)|(bitval<<28);
	putValue(P_ASG_69_0_0_21_4,thisval);
}

on envVar P_ASG_69_0_0_21_4_29
{
	byte bitval;
	//thisval steht hier fuer den bitfield-wert, 
	//aus Generierungsgruenden hier keine einheitliche Bezeichnung moeglich.
	dword thisval; // AdditionalInfo1_2
	bitval= getValue(this);
	thisval = getValue(P_ASG_69_0_0_21_4);
	thisval = thisval&~(1<<29)|(bitval<<29);
	putValue(P_ASG_69_0_0_21_4,thisval);
}

on envVar P_ASG_69_0_0_21_4 // Display2Setup.AdditionalInfo1_2
{
	P_ASG_69_0_0_21_BuildFct();
}

on envVar P_ASG_69_0_0_21_5_0
{
	byte bitval;
	//thisval steht hier fuer den bitfield-wert, 
	//aus Generierungsgruenden hier keine einheitliche Bezeichnung moeglich.
	dword thisval; // AdditionalInfo2_1
	bitval= getValue(this);
	thisval = getValue(P_ASG_69_0_0_21_5);
	thisval = thisval&~(1<<0)|(bitval<<0);
	putValue(P_ASG_69_0_0_21_5,thisval);
}

on envVar P_ASG_69_0_0_21_5_1
{
	byte bitval;
	//thisval steht hier fuer den bitfield-wert, 
	//aus Generierungsgruenden hier keine einheitliche Bezeichnung moeglich.
	dword thisval; // AdditionalInfo2_1
	bitval= getValue(this);
	thisval = getValue(P_ASG_69_0_0_21_5);
	thisval = thisval&~(1<<1)|(bitval<<1);
	putValue(P_ASG_69_0_0_21_5,thisval);
}

on envVar P_ASG_69_0_0_21_5_2
{
	byte bitval;
	//thisval steht hier fuer den bitfield-wert, 
	//aus Generierungsgruenden hier keine einheitliche Bezeichnung moeglich.
	dword thisval; // AdditionalInfo2_1
	bitval= getValue(this);
	thisval = getValue(P_ASG_69_0_0_21_5);
	thisval = thisval&~(1<<2)|(bitval<<2);
	putValue(P_ASG_69_0_0_21_5,thisval);
}

on envVar P_ASG_69_0_0_21_5_3
{
	byte bitval;
	//thisval steht hier fuer den bitfield-wert, 
	//aus Generierungsgruenden hier keine einheitliche Bezeichnung moeglich.
	dword thisval; // AdditionalInfo2_1
	bitval= getValue(this);
	thisval = getValue(P_ASG_69_0_0_21_5);
	thisval = thisval&~(1<<3)|(bitval<<3);
	putValue(P_ASG_69_0_0_21_5,thisval);
}

on envVar P_ASG_69_0_0_21_5_4
{
	byte bitval;
	//thisval steht hier fuer den bitfield-wert, 
	//aus Generierungsgruenden hier keine einheitliche Bezeichnung moeglich.
	dword thisval; // AdditionalInfo2_1
	bitval= getValue(this);
	thisval = getValue(P_ASG_69_0_0_21_5);
	thisval = thisval&~(1<<4)|(bitval<<4);
	putValue(P_ASG_69_0_0_21_5,thisval);
}

on envVar P_ASG_69_0_0_21_5_5
{
	byte bitval;
	//thisval steht hier fuer den bitfield-wert, 
	//aus Generierungsgruenden hier keine einheitliche Bezeichnung moeglich.
	dword thisval; // AdditionalInfo2_1
	bitval= getValue(this);
	thisval = getValue(P_ASG_69_0_0_21_5);
	thisval = thisval&~(1<<5)|(bitval<<5);
	putValue(P_ASG_69_0_0_21_5,thisval);
}

on envVar P_ASG_69_0_0_21_5_6
{
	byte bitval;
	//thisval steht hier fuer den bitfield-wert, 
	//aus Generierungsgruenden hier keine einheitliche Bezeichnung moeglich.
	dword thisval; // AdditionalInfo2_1
	bitval= getValue(this);
	thisval = getValue(P_ASG_69_0_0_21_5);
	thisval = thisval&~(1<<6)|(bitval<<6);
	putValue(P_ASG_69_0_0_21_5,thisval);
}

on envVar P_ASG_69_0_0_21_5_7
{
	byte bitval;
	//thisval steht hier fuer den bitfield-wert, 
	//aus Generierungsgruenden hier keine einheitliche Bezeichnung moeglich.
	dword thisval; // AdditionalInfo2_1
	bitval= getValue(this);
	thisval = getValue(P_ASG_69_0_0_21_5);
	thisval = thisval&~(1<<7)|(bitval<<7);
	putValue(P_ASG_69_0_0_21_5,thisval);
}

on envVar P_ASG_69_0_0_21_5_8
{
	byte bitval;
	//thisval steht hier fuer den bitfield-wert, 
	//aus Generierungsgruenden hier keine einheitliche Bezeichnung moeglich.
	dword thisval; // AdditionalInfo2_1
	bitval= getValue(this);
	thisval = getValue(P_ASG_69_0_0_21_5);
	thisval = thisval&~(1<<8)|(bitval<<8);
	putValue(P_ASG_69_0_0_21_5,thisval);
}

on envVar P_ASG_69_0_0_21_5_9
{
	byte bitval;
	//thisval steht hier fuer den bitfield-wert, 
	//aus Generierungsgruenden hier keine einheitliche Bezeichnung moeglich.
	dword thisval; // AdditionalInfo2_1
	bitval= getValue(this);
	thisval = getValue(P_ASG_69_0_0_21_5);
	thisval = thisval&~(1<<9)|(bitval<<9);
	putValue(P_ASG_69_0_0_21_5,thisval);
}

on envVar P_ASG_69_0_0_21_5_10
{
	byte bitval;
	//thisval steht hier fuer den bitfield-wert, 
	//aus Generierungsgruenden hier keine einheitliche Bezeichnung moeglich.
	dword thisval; // AdditionalInfo2_1
	bitval= getValue(this);
	thisval = getValue(P_ASG_69_0_0_21_5);
	thisval = thisval&~(1<<10)|(bitval<<10);
	putValue(P_ASG_69_0_0_21_5,thisval);
}

on envVar P_ASG_69_0_0_21_5_11
{
	byte bitval;
	//thisval steht hier fuer den bitfield-wert, 
	//aus Generierungsgruenden hier keine einheitliche Bezeichnung moeglich.
	dword thisval; // AdditionalInfo2_1
	bitval= getValue(this);
	thisval = getValue(P_ASG_69_0_0_21_5);
	thisval = thisval&~(1<<11)|(bitval<<11);
	putValue(P_ASG_69_0_0_21_5,thisval);
}

on envVar P_ASG_69_0_0_21_5_12
{
	byte bitval;
	//thisval steht hier fuer den bitfield-wert, 
	//aus Generierungsgruenden hier keine einheitliche Bezeichnung moeglich.
	dword thisval; // AdditionalInfo2_1
	bitval= getValue(this);
	thisval = getValue(P_ASG_69_0_0_21_5);
	thisval = thisval&~(1<<12)|(bitval<<12);
	putValue(P_ASG_69_0_0_21_5,thisval);
}

on envVar P_ASG_69_0_0_21_5_13
{
	byte bitval;
	//thisval steht hier fuer den bitfield-wert, 
	//aus Generierungsgruenden hier keine einheitliche Bezeichnung moeglich.
	dword thisval; // AdditionalInfo2_1
	bitval= getValue(this);
	thisval = getValue(P_ASG_69_0_0_21_5);
	thisval = thisval&~(1<<13)|(bitval<<13);
	putValue(P_ASG_69_0_0_21_5,thisval);
}

on envVar P_ASG_69_0_0_21_5_14
{
	byte bitval;
	//thisval steht hier fuer den bitfield-wert, 
	//aus Generierungsgruenden hier keine einheitliche Bezeichnung moeglich.
	dword thisval; // AdditionalInfo2_1
	bitval= getValue(this);
	thisval = getValue(P_ASG_69_0_0_21_5);
	thisval = thisval&~(1<<14)|(bitval<<14);
	putValue(P_ASG_69_0_0_21_5,thisval);
}

on envVar P_ASG_69_0_0_21_5_15
{
	byte bitval;
	//thisval steht hier fuer den bitfield-wert, 
	//aus Generierungsgruenden hier keine einheitliche Bezeichnung moeglich.
	dword thisval; // AdditionalInfo2_1
	bitval= getValue(this);
	thisval = getValue(P_ASG_69_0_0_21_5);
	thisval = thisval&~(1<<15)|(bitval<<15);
	putValue(P_ASG_69_0_0_21_5,thisval);
}

on envVar P_ASG_69_0_0_21_5_16
{
	byte bitval;
	//thisval steht hier fuer den bitfield-wert, 
	//aus Generierungsgruenden hier keine einheitliche Bezeichnung moeglich.
	dword thisval; // AdditionalInfo2_1
	bitval= getValue(this);
	thisval = getValue(P_ASG_69_0_0_21_5);
	thisval = thisval&~(1<<16)|(bitval<<16);
	putValue(P_ASG_69_0_0_21_5,thisval);
}

on envVar P_ASG_69_0_0_21_5_17
{
	byte bitval;
	//thisval steht hier fuer den bitfield-wert, 
	//aus Generierungsgruenden hier keine einheitliche Bezeichnung moeglich.
	dword thisval; // AdditionalInfo2_1
	bitval= getValue(this);
	thisval = getValue(P_ASG_69_0_0_21_5);
	thisval = thisval&~(1<<17)|(bitval<<17);
	putValue(P_ASG_69_0_0_21_5,thisval);
}

on envVar P_ASG_69_0_0_21_5_18
{
	byte bitval;
	//thisval steht hier fuer den bitfield-wert, 
	//aus Generierungsgruenden hier keine einheitliche Bezeichnung moeglich.
	dword thisval; // AdditionalInfo2_1
	bitval= getValue(this);
	thisval = getValue(P_ASG_69_0_0_21_5);
	thisval = thisval&~(1<<18)|(bitval<<18);
	putValue(P_ASG_69_0_0_21_5,thisval);
}

on envVar P_ASG_69_0_0_21_5_19
{
	byte bitval;
	//thisval steht hier fuer den bitfield-wert, 
	//aus Generierungsgruenden hier keine einheitliche Bezeichnung moeglich.
	dword thisval; // AdditionalInfo2_1
	bitval= getValue(this);
	thisval = getValue(P_ASG_69_0_0_21_5);
	thisval = thisval&~(1<<19)|(bitval<<19);
	putValue(P_ASG_69_0_0_21_5,thisval);
}

on envVar P_ASG_69_0_0_21_5_20
{
	byte bitval;
	//thisval steht hier fuer den bitfield-wert, 
	//aus Generierungsgruenden hier keine einheitliche Bezeichnung moeglich.
	dword thisval; // AdditionalInfo2_1
	bitval= getValue(this);
	thisval = getValue(P_ASG_69_0_0_21_5);
	thisval = thisval&~(1<<20)|(bitval<<20);
	putValue(P_ASG_69_0_0_21_5,thisval);
}

on envVar P_ASG_69_0_0_21_5_21
{
	byte bitval;
	//thisval steht hier fuer den bitfield-wert, 
	//aus Generierungsgruenden hier keine einheitliche Bezeichnung moeglich.
	dword thisval; // AdditionalInfo2_1
	bitval= getValue(this);
	thisval = getValue(P_ASG_69_0_0_21_5);
	thisval = thisval&~(1<<21)|(bitval<<21);
	putValue(P_ASG_69_0_0_21_5,thisval);
}

on envVar P_ASG_69_0_0_21_5_22
{
	byte bitval;
	//thisval steht hier fuer den bitfield-wert, 
	//aus Generierungsgruenden hier keine einheitliche Bezeichnung moeglich.
	dword thisval; // AdditionalInfo2_1
	bitval= getValue(this);
	thisval = getValue(P_ASG_69_0_0_21_5);
	thisval = thisval&~(1<<22)|(bitval<<22);
	putValue(P_ASG_69_0_0_21_5,thisval);
}

on envVar P_ASG_69_0_0_21_5_23
{
	byte bitval;
	//thisval steht hier fuer den bitfield-wert, 
	//aus Generierungsgruenden hier keine einheitliche Bezeichnung moeglich.
	dword thisval; // AdditionalInfo2_1
	bitval= getValue(this);
	thisval = getValue(P_ASG_69_0_0_21_5);
	thisval = thisval&~(1<<23)|(bitval<<23);
	putValue(P_ASG_69_0_0_21_5,thisval);
}

on envVar P_ASG_69_0_0_21_5_24
{
	byte bitval;
	//thisval steht hier fuer den bitfield-wert, 
	//aus Generierungsgruenden hier keine einheitliche Bezeichnung moeglich.
	dword thisval; // AdditionalInfo2_1
	bitval= getValue(this);
	thisval = getValue(P_ASG_69_0_0_21_5);
	thisval = thisval&~(1<<24)|(bitval<<24);
	putValue(P_ASG_69_0_0_21_5,thisval);
}

on envVar P_ASG_69_0_0_21_5_25
{
	byte bitval;
	//thisval steht hier fuer den bitfield-wert, 
	//aus Generierungsgruenden hier keine einheitliche Bezeichnung moeglich.
	dword thisval; // AdditionalInfo2_1
	bitval= getValue(this);
	thisval = getValue(P_ASG_69_0_0_21_5);
	thisval = thisval&~(1<<25)|(bitval<<25);
	putValue(P_ASG_69_0_0_21_5,thisval);
}

on envVar P_ASG_69_0_0_21_5_26
{
	byte bitval;
	//thisval steht hier fuer den bitfield-wert, 
	//aus Generierungsgruenden hier keine einheitliche Bezeichnung moeglich.
	dword thisval; // AdditionalInfo2_1
	bitval= getValue(this);
	thisval = getValue(P_ASG_69_0_0_21_5);
	thisval = thisval&~(1<<26)|(bitval<<26);
	putValue(P_ASG_69_0_0_21_5,thisval);
}

on envVar P_ASG_69_0_0_21_5_27
{
	byte bitval;
	//thisval steht hier fuer den bitfield-wert, 
	//aus Generierungsgruenden hier keine einheitliche Bezeichnung moeglich.
	dword thisval; // AdditionalInfo2_1
	bitval= getValue(this);
	thisval = getValue(P_ASG_69_0_0_21_5);
	thisval = thisval&~(1<<27)|(bitval<<27);
	putValue(P_ASG_69_0_0_21_5,thisval);
}

on envVar P_ASG_69_0_0_21_5_28
{
	byte bitval;
	//thisval steht hier fuer den bitfield-wert, 
	//aus Generierungsgruenden hier keine einheitliche Bezeichnung moeglich.
	dword thisval; // AdditionalInfo2_1
	bitval= getValue(this);
	thisval = getValue(P_ASG_69_0_0_21_5);
	thisval = thisval&~(1<<28)|(bitval<<28);
	putValue(P_ASG_69_0_0_21_5,thisval);
}

on envVar P_ASG_69_0_0_21_5_29
{
	byte bitval;
	//thisval steht hier fuer den bitfield-wert, 
	//aus Generierungsgruenden hier keine einheitliche Bezeichnung moeglich.
	dword thisval; // AdditionalInfo2_1
	bitval= getValue(this);
	thisval = getValue(P_ASG_69_0_0_21_5);
	thisval = thisval&~(1<<29)|(bitval<<29);
	putValue(P_ASG_69_0_0_21_5,thisval);
}

on envVar P_ASG_69_0_0_21_5_30
{
	byte bitval;
	//thisval steht hier fuer den bitfield-wert, 
	//aus Generierungsgruenden hier keine einheitliche Bezeichnung moeglich.
	dword thisval; // AdditionalInfo2_1
	bitval= getValue(this);
	thisval = getValue(P_ASG_69_0_0_21_5);
	thisval = thisval&~(1<<30)|(bitval<<30);
	putValue(P_ASG_69_0_0_21_5,thisval);
}

on envVar P_ASG_69_0_0_21_5_31
{
	byte bitval;
	//thisval steht hier fuer den bitfield-wert, 
	//aus Generierungsgruenden hier keine einheitliche Bezeichnung moeglich.
	dword thisval; // AdditionalInfo2_1
	bitval= getValue(this);
	thisval = getValue(P_ASG_69_0_0_21_5);
	thisval = thisval&~(1<<31)|(bitval<<31);
	putValue(P_ASG_69_0_0_21_5,thisval);
}

on envVar P_ASG_69_0_0_21_5 // Display2Setup.AdditionalInfo2_1
{
	P_ASG_69_0_0_21_BuildFct();
}

on envVar P_ASG_69_0_0_21_6_0
{
	byte bitval;
	//thisval steht hier fuer den bitfield-wert, 
	//aus Generierungsgruenden hier keine einheitliche Bezeichnung moeglich.
	dword thisval; // AdditionalInfo2_2
	bitval= getValue(this);
	thisval = getValue(P_ASG_69_0_0_21_6);
	thisval = thisval&~(1<<0)|(bitval<<0);
	putValue(P_ASG_69_0_0_21_6,thisval);
}

on envVar P_ASG_69_0_0_21_6_1
{
	byte bitval;
	//thisval steht hier fuer den bitfield-wert, 
	//aus Generierungsgruenden hier keine einheitliche Bezeichnung moeglich.
	dword thisval; // AdditionalInfo2_2
	bitval= getValue(this);
	thisval = getValue(P_ASG_69_0_0_21_6);
	thisval = thisval&~(1<<1)|(bitval<<1);
	putValue(P_ASG_69_0_0_21_6,thisval);
}

on envVar P_ASG_69_0_0_21_6_2
{
	byte bitval;
	//thisval steht hier fuer den bitfield-wert, 
	//aus Generierungsgruenden hier keine einheitliche Bezeichnung moeglich.
	dword thisval; // AdditionalInfo2_2
	bitval= getValue(this);
	thisval = getValue(P_ASG_69_0_0_21_6);
	thisval = thisval&~(1<<2)|(bitval<<2);
	putValue(P_ASG_69_0_0_21_6,thisval);
}

on envVar P_ASG_69_0_0_21_6_3
{
	byte bitval;
	//thisval steht hier fuer den bitfield-wert, 
	//aus Generierungsgruenden hier keine einheitliche Bezeichnung moeglich.
	dword thisval; // AdditionalInfo2_2
	bitval= getValue(this);
	thisval = getValue(P_ASG_69_0_0_21_6);
	thisval = thisval&~(1<<3)|(bitval<<3);
	putValue(P_ASG_69_0_0_21_6,thisval);
}

on envVar P_ASG_69_0_0_21_6_4
{
	byte bitval;
	//thisval steht hier fuer den bitfield-wert, 
	//aus Generierungsgruenden hier keine einheitliche Bezeichnung moeglich.
	dword thisval; // AdditionalInfo2_2
	bitval= getValue(this);
	thisval = getValue(P_ASG_69_0_0_21_6);
	thisval = thisval&~(1<<4)|(bitval<<4);
	putValue(P_ASG_69_0_0_21_6,thisval);
}

on envVar P_ASG_69_0_0_21_6_5
{
	byte bitval;
	//thisval steht hier fuer den bitfield-wert, 
	//aus Generierungsgruenden hier keine einheitliche Bezeichnung moeglich.
	dword thisval; // AdditionalInfo2_2
	bitval= getValue(this);
	thisval = getValue(P_ASG_69_0_0_21_6);
	thisval = thisval&~(1<<5)|(bitval<<5);
	putValue(P_ASG_69_0_0_21_6,thisval);
}

on envVar P_ASG_69_0_0_21_6_6
{
	byte bitval;
	//thisval steht hier fuer den bitfield-wert, 
	//aus Generierungsgruenden hier keine einheitliche Bezeichnung moeglich.
	dword thisval; // AdditionalInfo2_2
	bitval= getValue(this);
	thisval = getValue(P_ASG_69_0_0_21_6);
	thisval = thisval&~(1<<6)|(bitval<<6);
	putValue(P_ASG_69_0_0_21_6,thisval);
}

on envVar P_ASG_69_0_0_21_6_7
{
	byte bitval;
	//thisval steht hier fuer den bitfield-wert, 
	//aus Generierungsgruenden hier keine einheitliche Bezeichnung moeglich.
	dword thisval; // AdditionalInfo2_2
	bitval= getValue(this);
	thisval = getValue(P_ASG_69_0_0_21_6);
	thisval = thisval&~(1<<7)|(bitval<<7);
	putValue(P_ASG_69_0_0_21_6,thisval);
}

on envVar P_ASG_69_0_0_21_6_8
{
	byte bitval;
	//thisval steht hier fuer den bitfield-wert, 
	//aus Generierungsgruenden hier keine einheitliche Bezeichnung moeglich.
	dword thisval; // AdditionalInfo2_2
	bitval= getValue(this);
	thisval = getValue(P_ASG_69_0_0_21_6);
	thisval = thisval&~(1<<8)|(bitval<<8);
	putValue(P_ASG_69_0_0_21_6,thisval);
}

on envVar P_ASG_69_0_0_21_6_9
{
	byte bitval;
	//thisval steht hier fuer den bitfield-wert, 
	//aus Generierungsgruenden hier keine einheitliche Bezeichnung moeglich.
	dword thisval; // AdditionalInfo2_2
	bitval= getValue(this);
	thisval = getValue(P_ASG_69_0_0_21_6);
	thisval = thisval&~(1<<9)|(bitval<<9);
	putValue(P_ASG_69_0_0_21_6,thisval);
}

on envVar P_ASG_69_0_0_21_6_10
{
	byte bitval;
	//thisval steht hier fuer den bitfield-wert, 
	//aus Generierungsgruenden hier keine einheitliche Bezeichnung moeglich.
	dword thisval; // AdditionalInfo2_2
	bitval= getValue(this);
	thisval = getValue(P_ASG_69_0_0_21_6);
	thisval = thisval&~(1<<10)|(bitval<<10);
	putValue(P_ASG_69_0_0_21_6,thisval);
}

on envVar P_ASG_69_0_0_21_6_11
{
	byte bitval;
	//thisval steht hier fuer den bitfield-wert, 
	//aus Generierungsgruenden hier keine einheitliche Bezeichnung moeglich.
	dword thisval; // AdditionalInfo2_2
	bitval= getValue(this);
	thisval = getValue(P_ASG_69_0_0_21_6);
	thisval = thisval&~(1<<11)|(bitval<<11);
	putValue(P_ASG_69_0_0_21_6,thisval);
}

on envVar P_ASG_69_0_0_21_6_12
{
	byte bitval;
	//thisval steht hier fuer den bitfield-wert, 
	//aus Generierungsgruenden hier keine einheitliche Bezeichnung moeglich.
	dword thisval; // AdditionalInfo2_2
	bitval= getValue(this);
	thisval = getValue(P_ASG_69_0_0_21_6);
	thisval = thisval&~(1<<12)|(bitval<<12);
	putValue(P_ASG_69_0_0_21_6,thisval);
}

on envVar P_ASG_69_0_0_21_6_13
{
	byte bitval;
	//thisval steht hier fuer den bitfield-wert, 
	//aus Generierungsgruenden hier keine einheitliche Bezeichnung moeglich.
	dword thisval; // AdditionalInfo2_2
	bitval= getValue(this);
	thisval = getValue(P_ASG_69_0_0_21_6);
	thisval = thisval&~(1<<13)|(bitval<<13);
	putValue(P_ASG_69_0_0_21_6,thisval);
}

on envVar P_ASG_69_0_0_21_6_14
{
	byte bitval;
	//thisval steht hier fuer den bitfield-wert, 
	//aus Generierungsgruenden hier keine einheitliche Bezeichnung moeglich.
	dword thisval; // AdditionalInfo2_2
	bitval= getValue(this);
	thisval = getValue(P_ASG_69_0_0_21_6);
	thisval = thisval&~(1<<14)|(bitval<<14);
	putValue(P_ASG_69_0_0_21_6,thisval);
}

on envVar P_ASG_69_0_0_21_6_15
{
	byte bitval;
	//thisval steht hier fuer den bitfield-wert, 
	//aus Generierungsgruenden hier keine einheitliche Bezeichnung moeglich.
	dword thisval; // AdditionalInfo2_2
	bitval= getValue(this);
	thisval = getValue(P_ASG_69_0_0_21_6);
	thisval = thisval&~(1<<15)|(bitval<<15);
	putValue(P_ASG_69_0_0_21_6,thisval);
}

on envVar P_ASG_69_0_0_21_6_16
{
	byte bitval;
	//thisval steht hier fuer den bitfield-wert, 
	//aus Generierungsgruenden hier keine einheitliche Bezeichnung moeglich.
	dword thisval; // AdditionalInfo2_2
	bitval= getValue(this);
	thisval = getValue(P_ASG_69_0_0_21_6);
	thisval = thisval&~(1<<16)|(bitval<<16);
	putValue(P_ASG_69_0_0_21_6,thisval);
}

on envVar P_ASG_69_0_0_21_6_17
{
	byte bitval;
	//thisval steht hier fuer den bitfield-wert, 
	//aus Generierungsgruenden hier keine einheitliche Bezeichnung moeglich.
	dword thisval; // AdditionalInfo2_2
	bitval= getValue(this);
	thisval = getValue(P_ASG_69_0_0_21_6);
	thisval = thisval&~(1<<17)|(bitval<<17);
	putValue(P_ASG_69_0_0_21_6,thisval);
}

on envVar P_ASG_69_0_0_21_6_18
{
	byte bitval;
	//thisval steht hier fuer den bitfield-wert, 
	//aus Generierungsgruenden hier keine einheitliche Bezeichnung moeglich.
	dword thisval; // AdditionalInfo2_2
	bitval= getValue(this);
	thisval = getValue(P_ASG_69_0_0_21_6);
	thisval = thisval&~(1<<18)|(bitval<<18);
	putValue(P_ASG_69_0_0_21_6,thisval);
}

on envVar P_ASG_69_0_0_21_6_19
{
	byte bitval;
	//thisval steht hier fuer den bitfield-wert, 
	//aus Generierungsgruenden hier keine einheitliche Bezeichnung moeglich.
	dword thisval; // AdditionalInfo2_2
	bitval= getValue(this);
	thisval = getValue(P_ASG_69_0_0_21_6);
	thisval = thisval&~(1<<19)|(bitval<<19);
	putValue(P_ASG_69_0_0_21_6,thisval);
}

on envVar P_ASG_69_0_0_21_6_20
{
	byte bitval;
	//thisval steht hier fuer den bitfield-wert, 
	//aus Generierungsgruenden hier keine einheitliche Bezeichnung moeglich.
	dword thisval; // AdditionalInfo2_2
	bitval= getValue(this);
	thisval = getValue(P_ASG_69_0_0_21_6);
	thisval = thisval&~(1<<20)|(bitval<<20);
	putValue(P_ASG_69_0_0_21_6,thisval);
}

on envVar P_ASG_69_0_0_21_6_21
{
	byte bitval;
	//thisval steht hier fuer den bitfield-wert, 
	//aus Generierungsgruenden hier keine einheitliche Bezeichnung moeglich.
	dword thisval; // AdditionalInfo2_2
	bitval= getValue(this);
	thisval = getValue(P_ASG_69_0_0_21_6);
	thisval = thisval&~(1<<21)|(bitval<<21);
	putValue(P_ASG_69_0_0_21_6,thisval);
}

on envVar P_ASG_69_0_0_21_6_22
{
	byte bitval;
	//thisval steht hier fuer den bitfield-wert, 
	//aus Generierungsgruenden hier keine einheitliche Bezeichnung moeglich.
	dword thisval; // AdditionalInfo2_2
	bitval= getValue(this);
	thisval = getValue(P_ASG_69_0_0_21_6);
	thisval = thisval&~(1<<22)|(bitval<<22);
	putValue(P_ASG_69_0_0_21_6,thisval);
}

on envVar P_ASG_69_0_0_21_6_23
{
	byte bitval;
	//thisval steht hier fuer den bitfield-wert, 
	//aus Generierungsgruenden hier keine einheitliche Bezeichnung moeglich.
	dword thisval; // AdditionalInfo2_2
	bitval= getValue(this);
	thisval = getValue(P_ASG_69_0_0_21_6);
	thisval = thisval&~(1<<23)|(bitval<<23);
	putValue(P_ASG_69_0_0_21_6,thisval);
}

on envVar P_ASG_69_0_0_21_6_24
{
	byte bitval;
	//thisval steht hier fuer den bitfield-wert, 
	//aus Generierungsgruenden hier keine einheitliche Bezeichnung moeglich.
	dword thisval; // AdditionalInfo2_2
	bitval= getValue(this);
	thisval = getValue(P_ASG_69_0_0_21_6);
	thisval = thisval&~(1<<24)|(bitval<<24);
	putValue(P_ASG_69_0_0_21_6,thisval);
}

on envVar P_ASG_69_0_0_21_6_25
{
	byte bitval;
	//thisval steht hier fuer den bitfield-wert, 
	//aus Generierungsgruenden hier keine einheitliche Bezeichnung moeglich.
	dword thisval; // AdditionalInfo2_2
	bitval= getValue(this);
	thisval = getValue(P_ASG_69_0_0_21_6);
	thisval = thisval&~(1<<25)|(bitval<<25);
	putValue(P_ASG_69_0_0_21_6,thisval);
}

on envVar P_ASG_69_0_0_21_6_26
{
	byte bitval;
	//thisval steht hier fuer den bitfield-wert, 
	//aus Generierungsgruenden hier keine einheitliche Bezeichnung moeglich.
	dword thisval; // AdditionalInfo2_2
	bitval= getValue(this);
	thisval = getValue(P_ASG_69_0_0_21_6);
	thisval = thisval&~(1<<26)|(bitval<<26);
	putValue(P_ASG_69_0_0_21_6,thisval);
}

on envVar P_ASG_69_0_0_21_6_27
{
	byte bitval;
	//thisval steht hier fuer den bitfield-wert, 
	//aus Generierungsgruenden hier keine einheitliche Bezeichnung moeglich.
	dword thisval; // AdditionalInfo2_2
	bitval= getValue(this);
	thisval = getValue(P_ASG_69_0_0_21_6);
	thisval = thisval&~(1<<27)|(bitval<<27);
	putValue(P_ASG_69_0_0_21_6,thisval);
}

on envVar P_ASG_69_0_0_21_6_28
{
	byte bitval;
	//thisval steht hier fuer den bitfield-wert, 
	//aus Generierungsgruenden hier keine einheitliche Bezeichnung moeglich.
	dword thisval; // AdditionalInfo2_2
	bitval= getValue(this);
	thisval = getValue(P_ASG_69_0_0_21_6);
	thisval = thisval&~(1<<28)|(bitval<<28);
	putValue(P_ASG_69_0_0_21_6,thisval);
}

on envVar P_ASG_69_0_0_21_6_29
{
	byte bitval;
	//thisval steht hier fuer den bitfield-wert, 
	//aus Generierungsgruenden hier keine einheitliche Bezeichnung moeglich.
	dword thisval; // AdditionalInfo2_2
	bitval= getValue(this);
	thisval = getValue(P_ASG_69_0_0_21_6);
	thisval = thisval&~(1<<29)|(bitval<<29);
	putValue(P_ASG_69_0_0_21_6,thisval);
}

on envVar P_ASG_69_0_0_21_6 // Display2Setup.AdditionalInfo2_2
{
	P_ASG_69_0_0_21_BuildFct();
}

on envVar P_ASG_69_0_0_22Get_BTN
{
 if (P_ASG_69_0_0_22Get_BTN_already_pressed == 0)
  {
       putValue(P_ASG_69_0_0_22_ErrCode,0);
       SetControlBackColor(panel_name,"errField_P_ASG_69_0_0_22",MakeRGB(255,255,255));
       P_ASG_69_0_0_22Get_BTN_already_pressed = 1;
 }
 else
 {
       Request_Void(LSGID, P_ASG_69_0_0_22_ID, DataGet_REQ); 
       P_ASG_69_0_0_22Get_BTN_already_pressed = 0;
 }
}
on envVar P_ASG_69_0_0_22SetGet_BTN
{
	byte BAPTemp[5];
    if (P_ASG_69_0_0_22SetGet_BTN_already_pressed == 0)
    {
       putValue(P_ASG_69_0_0_22_ErrCode,0);
       SetControlBackColor(panel_name,"errField_P_ASG_69_0_0_22",MakeRGB(255,255,255));
       P_ASG_69_0_0_22SetGet_BTN_already_pressed = 1;
    }
    else
    {
       getValue(P_ASG_69_0_0_22, BAPTemp);
       Request_ByteSequence(LSGID, P_ASG_69_0_0_22_ID, DataSetGet_REQ, BAPTemp, getValueSize(P_ASG_69_0_0_22));
       P_ASG_69_0_0_22SetGet_BTN_already_pressed = 0;
    }
}
on envVar P_ASG_69_0_0_22 // bus value of Display2MainSelection (22).
{
	// opcodes: Error-Status
	dword param1; // MainSelection
	byte param2; // Extension1
	byte param3; // Extension2
	// DATATYPE_BYTESEQUENCE / DATATYPE_FIXEDBYTESEQUENCE
	int i;
	byte superval[5];
	int currentPos;
	currentPos = 0;
	for( i = 0; i < 5; i++ ) {
		superval[i] = 0;
	}
	getValue(P_ASG_69_0_0_22, superval);
	///////// Start param1 - UINT32 /////////
	param1 = superval[currentPos++]|(superval[currentPos++]<<8)|(superval[currentPos++]<<16)|(superval[currentPos++]<<24);
	putValue(P_ASG_69_0_0_22_1, param1);
	///////// Start param2 - NIBBLE /////////
	param2 = (superval[currentPos] & 0xf0)>>4;
	putValue(P_ASG_69_0_0_22_2, round((param2 * 1.0) - (0) + (0), 1.0));
	///////// Start param3 - NIBBLE /////////
	param3 = superval[currentPos++] & 0x0f;
	putValue(P_ASG_69_0_0_22_3, round((param3 * 1.0) - (0) + (0), 1.0));
}

on envVar P_ASG_69_0_0_22_1_0
{
	byte bitval;
	//thisval steht hier fuer den bitfield-wert, 
	//aus Generierungsgruenden hier keine einheitliche Bezeichnung moeglich.
	dword thisval; // MainSelection
	bitval= getValue(this);
	thisval = getValue(P_ASG_69_0_0_22_1);
	thisval = thisval&~(1<<0)|(bitval<<0);
	putValue(P_ASG_69_0_0_22_1,thisval);
}

on envVar P_ASG_69_0_0_22_1_1
{
	byte bitval;
	//thisval steht hier fuer den bitfield-wert, 
	//aus Generierungsgruenden hier keine einheitliche Bezeichnung moeglich.
	dword thisval; // MainSelection
	bitval= getValue(this);
	thisval = getValue(P_ASG_69_0_0_22_1);
	thisval = thisval&~(1<<1)|(bitval<<1);
	putValue(P_ASG_69_0_0_22_1,thisval);
}

on envVar P_ASG_69_0_0_22_1_2
{
	byte bitval;
	//thisval steht hier fuer den bitfield-wert, 
	//aus Generierungsgruenden hier keine einheitliche Bezeichnung moeglich.
	dword thisval; // MainSelection
	bitval= getValue(this);
	thisval = getValue(P_ASG_69_0_0_22_1);
	thisval = thisval&~(1<<2)|(bitval<<2);
	putValue(P_ASG_69_0_0_22_1,thisval);
}

on envVar P_ASG_69_0_0_22_1_3
{
	byte bitval;
	//thisval steht hier fuer den bitfield-wert, 
	//aus Generierungsgruenden hier keine einheitliche Bezeichnung moeglich.
	dword thisval; // MainSelection
	bitval= getValue(this);
	thisval = getValue(P_ASG_69_0_0_22_1);
	thisval = thisval&~(1<<3)|(bitval<<3);
	putValue(P_ASG_69_0_0_22_1,thisval);
}

on envVar P_ASG_69_0_0_22_1_4
{
	byte bitval;
	//thisval steht hier fuer den bitfield-wert, 
	//aus Generierungsgruenden hier keine einheitliche Bezeichnung moeglich.
	dword thisval; // MainSelection
	bitval= getValue(this);
	thisval = getValue(P_ASG_69_0_0_22_1);
	thisval = thisval&~(1<<4)|(bitval<<4);
	putValue(P_ASG_69_0_0_22_1,thisval);
}

on envVar P_ASG_69_0_0_22_1_5
{
	byte bitval;
	//thisval steht hier fuer den bitfield-wert, 
	//aus Generierungsgruenden hier keine einheitliche Bezeichnung moeglich.
	dword thisval; // MainSelection
	bitval= getValue(this);
	thisval = getValue(P_ASG_69_0_0_22_1);
	thisval = thisval&~(1<<5)|(bitval<<5);
	putValue(P_ASG_69_0_0_22_1,thisval);
}

on envVar P_ASG_69_0_0_22_1_6
{
	byte bitval;
	//thisval steht hier fuer den bitfield-wert, 
	//aus Generierungsgruenden hier keine einheitliche Bezeichnung moeglich.
	dword thisval; // MainSelection
	bitval= getValue(this);
	thisval = getValue(P_ASG_69_0_0_22_1);
	thisval = thisval&~(1<<6)|(bitval<<6);
	putValue(P_ASG_69_0_0_22_1,thisval);
}

on envVar P_ASG_69_0_0_22_1_7
{
	byte bitval;
	//thisval steht hier fuer den bitfield-wert, 
	//aus Generierungsgruenden hier keine einheitliche Bezeichnung moeglich.
	dword thisval; // MainSelection
	bitval= getValue(this);
	thisval = getValue(P_ASG_69_0_0_22_1);
	thisval = thisval&~(1<<7)|(bitval<<7);
	putValue(P_ASG_69_0_0_22_1,thisval);
}

on envVar P_ASG_69_0_0_22_1_8
{
	byte bitval;
	//thisval steht hier fuer den bitfield-wert, 
	//aus Generierungsgruenden hier keine einheitliche Bezeichnung moeglich.
	dword thisval; // MainSelection
	bitval= getValue(this);
	thisval = getValue(P_ASG_69_0_0_22_1);
	thisval = thisval&~(1<<8)|(bitval<<8);
	putValue(P_ASG_69_0_0_22_1,thisval);
}

on envVar P_ASG_69_0_0_22_1_9
{
	byte bitval;
	//thisval steht hier fuer den bitfield-wert, 
	//aus Generierungsgruenden hier keine einheitliche Bezeichnung moeglich.
	dword thisval; // MainSelection
	bitval= getValue(this);
	thisval = getValue(P_ASG_69_0_0_22_1);
	thisval = thisval&~(1<<9)|(bitval<<9);
	putValue(P_ASG_69_0_0_22_1,thisval);
}

on envVar P_ASG_69_0_0_22_1_10
{
	byte bitval;
	//thisval steht hier fuer den bitfield-wert, 
	//aus Generierungsgruenden hier keine einheitliche Bezeichnung moeglich.
	dword thisval; // MainSelection
	bitval= getValue(this);
	thisval = getValue(P_ASG_69_0_0_22_1);
	thisval = thisval&~(1<<10)|(bitval<<10);
	putValue(P_ASG_69_0_0_22_1,thisval);
}

on envVar P_ASG_69_0_0_22_1_11
{
	byte bitval;
	//thisval steht hier fuer den bitfield-wert, 
	//aus Generierungsgruenden hier keine einheitliche Bezeichnung moeglich.
	dword thisval; // MainSelection
	bitval= getValue(this);
	thisval = getValue(P_ASG_69_0_0_22_1);
	thisval = thisval&~(1<<11)|(bitval<<11);
	putValue(P_ASG_69_0_0_22_1,thisval);
}

on envVar P_ASG_69_0_0_22_1_12
{
	byte bitval;
	//thisval steht hier fuer den bitfield-wert, 
	//aus Generierungsgruenden hier keine einheitliche Bezeichnung moeglich.
	dword thisval; // MainSelection
	bitval= getValue(this);
	thisval = getValue(P_ASG_69_0_0_22_1);
	thisval = thisval&~(1<<12)|(bitval<<12);
	putValue(P_ASG_69_0_0_22_1,thisval);
}

on envVar P_ASG_69_0_0_22_1_13
{
	byte bitval;
	//thisval steht hier fuer den bitfield-wert, 
	//aus Generierungsgruenden hier keine einheitliche Bezeichnung moeglich.
	dword thisval; // MainSelection
	bitval= getValue(this);
	thisval = getValue(P_ASG_69_0_0_22_1);
	thisval = thisval&~(1<<13)|(bitval<<13);
	putValue(P_ASG_69_0_0_22_1,thisval);
}

on envVar P_ASG_69_0_0_22_1_14
{
	byte bitval;
	//thisval steht hier fuer den bitfield-wert, 
	//aus Generierungsgruenden hier keine einheitliche Bezeichnung moeglich.
	dword thisval; // MainSelection
	bitval= getValue(this);
	thisval = getValue(P_ASG_69_0_0_22_1);
	thisval = thisval&~(1<<14)|(bitval<<14);
	putValue(P_ASG_69_0_0_22_1,thisval);
}

on envVar P_ASG_69_0_0_22_1_15
{
	byte bitval;
	//thisval steht hier fuer den bitfield-wert, 
	//aus Generierungsgruenden hier keine einheitliche Bezeichnung moeglich.
	dword thisval; // MainSelection
	bitval= getValue(this);
	thisval = getValue(P_ASG_69_0_0_22_1);
	thisval = thisval&~(1<<15)|(bitval<<15);
	putValue(P_ASG_69_0_0_22_1,thisval);
}

on envVar P_ASG_69_0_0_22_1_16
{
	byte bitval;
	//thisval steht hier fuer den bitfield-wert, 
	//aus Generierungsgruenden hier keine einheitliche Bezeichnung moeglich.
	dword thisval; // MainSelection
	bitval= getValue(this);
	thisval = getValue(P_ASG_69_0_0_22_1);
	thisval = thisval&~(1<<16)|(bitval<<16);
	putValue(P_ASG_69_0_0_22_1,thisval);
}

on envVar P_ASG_69_0_0_22_1_17
{
	byte bitval;
	//thisval steht hier fuer den bitfield-wert, 
	//aus Generierungsgruenden hier keine einheitliche Bezeichnung moeglich.
	dword thisval; // MainSelection
	bitval= getValue(this);
	thisval = getValue(P_ASG_69_0_0_22_1);
	thisval = thisval&~(1<<17)|(bitval<<17);
	putValue(P_ASG_69_0_0_22_1,thisval);
}

on envVar P_ASG_69_0_0_22_1_18
{
	byte bitval;
	//thisval steht hier fuer den bitfield-wert, 
	//aus Generierungsgruenden hier keine einheitliche Bezeichnung moeglich.
	dword thisval; // MainSelection
	bitval= getValue(this);
	thisval = getValue(P_ASG_69_0_0_22_1);
	thisval = thisval&~(1<<18)|(bitval<<18);
	putValue(P_ASG_69_0_0_22_1,thisval);
}

on envVar P_ASG_69_0_0_22_1_19
{
	byte bitval;
	//thisval steht hier fuer den bitfield-wert, 
	//aus Generierungsgruenden hier keine einheitliche Bezeichnung moeglich.
	dword thisval; // MainSelection
	bitval= getValue(this);
	thisval = getValue(P_ASG_69_0_0_22_1);
	thisval = thisval&~(1<<19)|(bitval<<19);
	putValue(P_ASG_69_0_0_22_1,thisval);
}

on envVar P_ASG_69_0_0_22_1_20
{
	byte bitval;
	//thisval steht hier fuer den bitfield-wert, 
	//aus Generierungsgruenden hier keine einheitliche Bezeichnung moeglich.
	dword thisval; // MainSelection
	bitval= getValue(this);
	thisval = getValue(P_ASG_69_0_0_22_1);
	thisval = thisval&~(1<<20)|(bitval<<20);
	putValue(P_ASG_69_0_0_22_1,thisval);
}

on envVar P_ASG_69_0_0_22_1_21
{
	byte bitval;
	//thisval steht hier fuer den bitfield-wert, 
	//aus Generierungsgruenden hier keine einheitliche Bezeichnung moeglich.
	dword thisval; // MainSelection
	bitval= getValue(this);
	thisval = getValue(P_ASG_69_0_0_22_1);
	thisval = thisval&~(1<<21)|(bitval<<21);
	putValue(P_ASG_69_0_0_22_1,thisval);
}

on envVar P_ASG_69_0_0_22_1_22
{
	byte bitval;
	//thisval steht hier fuer den bitfield-wert, 
	//aus Generierungsgruenden hier keine einheitliche Bezeichnung moeglich.
	dword thisval; // MainSelection
	bitval= getValue(this);
	thisval = getValue(P_ASG_69_0_0_22_1);
	thisval = thisval&~(1<<22)|(bitval<<22);
	putValue(P_ASG_69_0_0_22_1,thisval);
}

on envVar P_ASG_69_0_0_22_1_23
{
	byte bitval;
	//thisval steht hier fuer den bitfield-wert, 
	//aus Generierungsgruenden hier keine einheitliche Bezeichnung moeglich.
	dword thisval; // MainSelection
	bitval= getValue(this);
	thisval = getValue(P_ASG_69_0_0_22_1);
	thisval = thisval&~(1<<23)|(bitval<<23);
	putValue(P_ASG_69_0_0_22_1,thisval);
}

on envVar P_ASG_69_0_0_22_1_24
{
	byte bitval;
	//thisval steht hier fuer den bitfield-wert, 
	//aus Generierungsgruenden hier keine einheitliche Bezeichnung moeglich.
	dword thisval; // MainSelection
	bitval= getValue(this);
	thisval = getValue(P_ASG_69_0_0_22_1);
	thisval = thisval&~(1<<24)|(bitval<<24);
	putValue(P_ASG_69_0_0_22_1,thisval);
}

on envVar P_ASG_69_0_0_22_1_25
{
	byte bitval;
	//thisval steht hier fuer den bitfield-wert, 
	//aus Generierungsgruenden hier keine einheitliche Bezeichnung moeglich.
	dword thisval; // MainSelection
	bitval= getValue(this);
	thisval = getValue(P_ASG_69_0_0_22_1);
	thisval = thisval&~(1<<25)|(bitval<<25);
	putValue(P_ASG_69_0_0_22_1,thisval);
}

on envVar P_ASG_69_0_0_22_1_26
{
	byte bitval;
	//thisval steht hier fuer den bitfield-wert, 
	//aus Generierungsgruenden hier keine einheitliche Bezeichnung moeglich.
	dword thisval; // MainSelection
	bitval= getValue(this);
	thisval = getValue(P_ASG_69_0_0_22_1);
	thisval = thisval&~(1<<26)|(bitval<<26);
	putValue(P_ASG_69_0_0_22_1,thisval);
}

on envVar P_ASG_69_0_0_22_1_27
{
	byte bitval;
	//thisval steht hier fuer den bitfield-wert, 
	//aus Generierungsgruenden hier keine einheitliche Bezeichnung moeglich.
	dword thisval; // MainSelection
	bitval= getValue(this);
	thisval = getValue(P_ASG_69_0_0_22_1);
	thisval = thisval&~(1<<27)|(bitval<<27);
	putValue(P_ASG_69_0_0_22_1,thisval);
}

on envVar P_ASG_69_0_0_22_1_28
{
	byte bitval;
	//thisval steht hier fuer den bitfield-wert, 
	//aus Generierungsgruenden hier keine einheitliche Bezeichnung moeglich.
	dword thisval; // MainSelection
	bitval= getValue(this);
	thisval = getValue(P_ASG_69_0_0_22_1);
	thisval = thisval&~(1<<28)|(bitval<<28);
	putValue(P_ASG_69_0_0_22_1,thisval);
}

on envVar P_ASG_69_0_0_22_1_29
{
	byte bitval;
	//thisval steht hier fuer den bitfield-wert, 
	//aus Generierungsgruenden hier keine einheitliche Bezeichnung moeglich.
	dword thisval; // MainSelection
	bitval= getValue(this);
	thisval = getValue(P_ASG_69_0_0_22_1);
	thisval = thisval&~(1<<29)|(bitval<<29);
	putValue(P_ASG_69_0_0_22_1,thisval);
}

on envVar P_ASG_69_0_0_22_1 // Display2MainSelection.MainSelection
{
	byte superval[5];

	//Update Childvalue (BitField)
	byte mask=0x01;
	int i = 0;
	dword thisval; // MainSelection
	thisval = getValue(this);
	if(thisval&(mask<<0))
		putValue(P_ASG_69_0_0_22_1_0, 1);
	else
		putValue(P_ASG_69_0_0_22_1_0, 0);
	if(thisval&(mask<<1))
		putValue(P_ASG_69_0_0_22_1_1, 1);
	else
		putValue(P_ASG_69_0_0_22_1_1, 0);
	if(thisval&(mask<<2))
		putValue(P_ASG_69_0_0_22_1_2, 1);
	else
		putValue(P_ASG_69_0_0_22_1_2, 0);
	if(thisval&(mask<<3))
		putValue(P_ASG_69_0_0_22_1_3, 1);
	else
		putValue(P_ASG_69_0_0_22_1_3, 0);
	if(thisval&(mask<<4))
		putValue(P_ASG_69_0_0_22_1_4, 1);
	else
		putValue(P_ASG_69_0_0_22_1_4, 0);
	if(thisval&(mask<<5))
		putValue(P_ASG_69_0_0_22_1_5, 1);
	else
		putValue(P_ASG_69_0_0_22_1_5, 0);
	if(thisval&(mask<<6))
		putValue(P_ASG_69_0_0_22_1_6, 1);
	else
		putValue(P_ASG_69_0_0_22_1_6, 0);
	if(thisval&(mask<<7))
		putValue(P_ASG_69_0_0_22_1_7, 1);
	else
		putValue(P_ASG_69_0_0_22_1_7, 0);
	if(thisval&(mask<<8))
		putValue(P_ASG_69_0_0_22_1_8, 1);
	else
		putValue(P_ASG_69_0_0_22_1_8, 0);
	if(thisval&(mask<<9))
		putValue(P_ASG_69_0_0_22_1_9, 1);
	else
		putValue(P_ASG_69_0_0_22_1_9, 0);
	if(thisval&(mask<<10))
		putValue(P_ASG_69_0_0_22_1_10, 1);
	else
		putValue(P_ASG_69_0_0_22_1_10, 0);
	if(thisval&(mask<<11))
		putValue(P_ASG_69_0_0_22_1_11, 1);
	else
		putValue(P_ASG_69_0_0_22_1_11, 0);
	if(thisval&(mask<<12))
		putValue(P_ASG_69_0_0_22_1_12, 1);
	else
		putValue(P_ASG_69_0_0_22_1_12, 0);
	if(thisval&(mask<<13))
		putValue(P_ASG_69_0_0_22_1_13, 1);
	else
		putValue(P_ASG_69_0_0_22_1_13, 0);
	if(thisval&(mask<<14))
		putValue(P_ASG_69_0_0_22_1_14, 1);
	else
		putValue(P_ASG_69_0_0_22_1_14, 0);
	if(thisval&(mask<<15))
		putValue(P_ASG_69_0_0_22_1_15, 1);
	else
		putValue(P_ASG_69_0_0_22_1_15, 0);
	if(thisval&(mask<<16))
		putValue(P_ASG_69_0_0_22_1_16, 1);
	else
		putValue(P_ASG_69_0_0_22_1_16, 0);
	if(thisval&(mask<<17))
		putValue(P_ASG_69_0_0_22_1_17, 1);
	else
		putValue(P_ASG_69_0_0_22_1_17, 0);
	if(thisval&(mask<<18))
		putValue(P_ASG_69_0_0_22_1_18, 1);
	else
		putValue(P_ASG_69_0_0_22_1_18, 0);
	if(thisval&(mask<<19))
		putValue(P_ASG_69_0_0_22_1_19, 1);
	else
		putValue(P_ASG_69_0_0_22_1_19, 0);
	if(thisval&(mask<<20))
		putValue(P_ASG_69_0_0_22_1_20, 1);
	else
		putValue(P_ASG_69_0_0_22_1_20, 0);
	if(thisval&(mask<<21))
		putValue(P_ASG_69_0_0_22_1_21, 1);
	else
		putValue(P_ASG_69_0_0_22_1_21, 0);
	if(thisval&(mask<<22))
		putValue(P_ASG_69_0_0_22_1_22, 1);
	else
		putValue(P_ASG_69_0_0_22_1_22, 0);
	if(thisval&(mask<<23))
		putValue(P_ASG_69_0_0_22_1_23, 1);
	else
		putValue(P_ASG_69_0_0_22_1_23, 0);
	if(thisval&(mask<<24))
		putValue(P_ASG_69_0_0_22_1_24, 1);
	else
		putValue(P_ASG_69_0_0_22_1_24, 0);
	if(thisval&(mask<<25))
		putValue(P_ASG_69_0_0_22_1_25, 1);
	else
		putValue(P_ASG_69_0_0_22_1_25, 0);
	if(thisval&(mask<<26))
		putValue(P_ASG_69_0_0_22_1_26, 1);
	else
		putValue(P_ASG_69_0_0_22_1_26, 0);
	if(thisval&(mask<<27))
		putValue(P_ASG_69_0_0_22_1_27, 1);
	else
		putValue(P_ASG_69_0_0_22_1_27, 0);
	if(thisval&(mask<<28))
		putValue(P_ASG_69_0_0_22_1_28, 1);
	else
		putValue(P_ASG_69_0_0_22_1_28, 0);
	if(thisval&(mask<<29))
		putValue(P_ASG_69_0_0_22_1_29, 1);
	else
		putValue(P_ASG_69_0_0_22_1_29, 0);

    // Update superval
	getValue(P_ASG_69_0_0_22, superval);
	superval[0]= thisval&0x000000ff;
	superval[1]=(thisval&0x0000ff00)>>8;
	superval[2]=(thisval&0x00ff0000)>>16;
	superval[3]=(thisval&0xff000000)>>24;
	putValue(P_ASG_69_0_0_22,superval);
}

// Ueberwachung der Darstellungsvariable der Range.
on envVar P_ASG_69_0_0_22_2_range // Display2MainSelection.Extension1 
{
	@P_ASG_69_0_0_22_2 = @P_ASG_69_0_0_22_2_range - (0); // slider = range - min
}

on envVar P_ASG_69_0_0_22_2 // Display2MainSelection.Extension1
{
	byte superval[5];

	//Update Childvalue (Number)
	byte thisval; // Extension1
	float slider_value;

	slider_value = 0; // Konstanter Parameter.
	@P_ASG_69_0_0_22_2_range = slider_value + (0); // real value := slider value + range min.
	thisval = (byte)round((slider_value + (0) - (0)) / (1.0), 1); // bus value := (slider value + min - offset) / step.

    // Update superval
	getValue(P_ASG_69_0_0_22, superval);
	superval[4]= superval[4]&0x0f;
	superval[4]= superval[4]|(thisval<<4);
	putValue(P_ASG_69_0_0_22,superval);
}

// Ueberwachung der Darstellungsvariable der Range.
on envVar P_ASG_69_0_0_22_3_range // Display2MainSelection.Extension2 
{
	@P_ASG_69_0_0_22_3 = @P_ASG_69_0_0_22_3_range - (0); // slider = range - min
}

on envVar P_ASG_69_0_0_22_3 // Display2MainSelection.Extension2
{
	byte superval[5];

	//Update Childvalue (Number)
	byte thisval; // Extension2
	float slider_value;

	slider_value = 0; // Konstanter Parameter.
	@P_ASG_69_0_0_22_3_range = slider_value + (0); // real value := slider value + range min.
	thisval = (byte)round((slider_value + (0) - (0)) / (1.0), 1); // bus value := (slider value + min - offset) / step.

    // Update superval
	getValue(P_ASG_69_0_0_22, superval);
	superval[4]= superval[4]&0xf0;
	superval[4]= superval[4]|thisval;
	putValue(P_ASG_69_0_0_22,superval);
}

on envVar P_ASG_69_0_0_23Get_BTN
{
 if (P_ASG_69_0_0_23Get_BTN_already_pressed == 0)
  {
       putValue(P_ASG_69_0_0_23_ErrCode,0);
       SetControlBackColor(panel_name,"errField_P_ASG_69_0_0_23",MakeRGB(255,255,255));
       P_ASG_69_0_0_23Get_BTN_already_pressed = 1;
 }
 else
 {
       Request_Void(LSGID, P_ASG_69_0_0_23_ID, DataGet_REQ); 
       P_ASG_69_0_0_23Get_BTN_already_pressed = 0;
 }
}
on envVar P_ASG_69_0_0_23 // bus value of Display3Setup (23).
{
	// opcodes: Error-Status
	dword param1; // MainSetup
	byte param2; // DisplayedAdditionalInfos
	dword param3; // AdditionalInfo1_1
	dword param4; // AdditionalInfo1_2
	dword param5; // AdditionalInfo2_1
	dword param6; // AdditionalInfo2_2
	// DATATYPE_BYTESEQUENCE / DATATYPE_FIXEDBYTESEQUENCE
	int i;
	byte superval[21];
	int currentPos;
	currentPos = 0;
	for( i = 0; i < 21; i++ ) {
		superval[i] = 0;
	}
	getValue(P_ASG_69_0_0_23, superval);
	///////// Start param1 - UINT32 /////////
	param1 = superval[currentPos++]|(superval[currentPos++]<<8)|(superval[currentPos++]<<16)|(superval[currentPos++]<<24);
	putValue(P_ASG_69_0_0_23_1, param1);
	///////// Start param2 - UINT8 /////////
	param2 = superval[currentPos++];
	putValue(P_ASG_69_0_0_23_2, param2);
	///////// Start param3 - UINT32 /////////
	param3 = superval[currentPos++]|(superval[currentPos++]<<8)|(superval[currentPos++]<<16)|(superval[currentPos++]<<24);
	putValue(P_ASG_69_0_0_23_3, param3);
	///////// Start param4 - UINT32 /////////
	param4 = superval[currentPos++]|(superval[currentPos++]<<8)|(superval[currentPos++]<<16)|(superval[currentPos++]<<24);
	putValue(P_ASG_69_0_0_23_4, param4);
	///////// Start param5 - UINT32 /////////
	param5 = superval[currentPos++]|(superval[currentPos++]<<8)|(superval[currentPos++]<<16)|(superval[currentPos++]<<24);
	putValue(P_ASG_69_0_0_23_5, param5);
	///////// Start param6 - UINT32 /////////
	param6 = superval[currentPos++]|(superval[currentPos++]<<8)|(superval[currentPos++]<<16)|(superval[currentPos++]<<24);
	putValue(P_ASG_69_0_0_23_6, param6);
}

// Updates the bus value field and other dependencies.
P_ASG_69_0_0_23_BuildFct()
{
	dword param1; // MainSetup
	byte param2; // DisplayedAdditionalInfos
	dword param3; // AdditionalInfo1_1
	dword param4; // AdditionalInfo1_2
	dword param5; // AdditionalInfo2_1
	dword param6; // AdditionalInfo2_2

	int i;
	byte superval[21];
	int currentPos;
	currentPos = 0;
// gen_BuildFunc_SetSuperVals 
	param1 = getValue(P_ASG_69_0_0_23_1);
	@P_ASG_69_0_0_23_1_0 = (param1 & 1) > 0;
	@P_ASG_69_0_0_23_1_1 = (param1 & 2) > 0;
	@P_ASG_69_0_0_23_1_2 = (param1 & 4) > 0;
	@P_ASG_69_0_0_23_1_3 = (param1 & 8) > 0;
	@P_ASG_69_0_0_23_1_4 = (param1 & 16) > 0;
	@P_ASG_69_0_0_23_1_5 = (param1 & 32) > 0;
	@P_ASG_69_0_0_23_1_6 = (param1 & 64) > 0;
	@P_ASG_69_0_0_23_1_7 = (param1 & 128) > 0;
	@P_ASG_69_0_0_23_1_8 = (param1 & 256) > 0;
	@P_ASG_69_0_0_23_1_9 = (param1 & 512) > 0;
	@P_ASG_69_0_0_23_1_10 = (param1 & 1024) > 0;
	@P_ASG_69_0_0_23_1_11 = (param1 & 2048) > 0;
	@P_ASG_69_0_0_23_1_12 = (param1 & 4096) > 0;
	@P_ASG_69_0_0_23_1_13 = (param1 & 8192) > 0;
	@P_ASG_69_0_0_23_1_14 = (param1 & 16384) > 0;
	@P_ASG_69_0_0_23_1_15 = (param1 & 32768) > 0;
	@P_ASG_69_0_0_23_1_16 = (param1 & 65536) > 0;
	@P_ASG_69_0_0_23_1_17 = (param1 & 131072) > 0;
	@P_ASG_69_0_0_23_1_18 = (param1 & 262144) > 0;
	@P_ASG_69_0_0_23_1_19 = (param1 & 524288) > 0;
	@P_ASG_69_0_0_23_1_20 = (param1 & 1048576) > 0;
	@P_ASG_69_0_0_23_1_21 = (param1 & 2097152) > 0;
	@P_ASG_69_0_0_23_1_22 = (param1 & 4194304) > 0;
	@P_ASG_69_0_0_23_1_23 = (param1 & 8388608) > 0;
	@P_ASG_69_0_0_23_1_24 = (param1 & 16777216) > 0;
	@P_ASG_69_0_0_23_1_25 = (param1 & 33554432) > 0;
	@P_ASG_69_0_0_23_1_26 = (param1 & 67108864) > 0;
	@P_ASG_69_0_0_23_1_27 = (param1 & 134217728) > 0;
	@P_ASG_69_0_0_23_1_28 = (param1 & 268435456) > 0;
	@P_ASG_69_0_0_23_1_29 = (param1 & 536870912) > 0;
	superval[currentPos++]= param1&0x000000ff;
	superval[currentPos++]=(param1&0x0000ff00)>>8;
	superval[currentPos++]=(param1&0x00ff0000)>>16;
	superval[currentPos++]=(param1&0xff000000)>>24;
// gen_BuildFunc_SetSuperVals 
	param2 = getValue(P_ASG_69_0_0_23_2);
	@P_ASG_69_0_0_23_2_0 = (param2 & 1) > 0;
	@P_ASG_69_0_0_23_2_1 = (param2 & 2) > 0;
	superval[currentPos++]=param2;
// gen_BuildFunc_SetSuperVals 
	param3 = getValue(P_ASG_69_0_0_23_3);
	@P_ASG_69_0_0_23_3_0 = (param3 & 1) > 0;
	@P_ASG_69_0_0_23_3_1 = (param3 & 2) > 0;
	@P_ASG_69_0_0_23_3_2 = (param3 & 4) > 0;
	@P_ASG_69_0_0_23_3_3 = (param3 & 8) > 0;
	@P_ASG_69_0_0_23_3_4 = (param3 & 16) > 0;
	@P_ASG_69_0_0_23_3_5 = (param3 & 32) > 0;
	@P_ASG_69_0_0_23_3_6 = (param3 & 64) > 0;
	@P_ASG_69_0_0_23_3_7 = (param3 & 128) > 0;
	@P_ASG_69_0_0_23_3_8 = (param3 & 256) > 0;
	@P_ASG_69_0_0_23_3_9 = (param3 & 512) > 0;
	@P_ASG_69_0_0_23_3_10 = (param3 & 1024) > 0;
	@P_ASG_69_0_0_23_3_11 = (param3 & 2048) > 0;
	@P_ASG_69_0_0_23_3_12 = (param3 & 4096) > 0;
	@P_ASG_69_0_0_23_3_13 = (param3 & 8192) > 0;
	@P_ASG_69_0_0_23_3_14 = (param3 & 16384) > 0;
	@P_ASG_69_0_0_23_3_15 = (param3 & 32768) > 0;
	@P_ASG_69_0_0_23_3_16 = (param3 & 65536) > 0;
	@P_ASG_69_0_0_23_3_17 = (param3 & 131072) > 0;
	@P_ASG_69_0_0_23_3_18 = (param3 & 262144) > 0;
	@P_ASG_69_0_0_23_3_19 = (param3 & 524288) > 0;
	@P_ASG_69_0_0_23_3_20 = (param3 & 1048576) > 0;
	@P_ASG_69_0_0_23_3_21 = (param3 & 2097152) > 0;
	@P_ASG_69_0_0_23_3_22 = (param3 & 4194304) > 0;
	@P_ASG_69_0_0_23_3_23 = (param3 & 8388608) > 0;
	@P_ASG_69_0_0_23_3_24 = (param3 & 16777216) > 0;
	@P_ASG_69_0_0_23_3_25 = (param3 & 33554432) > 0;
	@P_ASG_69_0_0_23_3_26 = (param3 & 67108864) > 0;
	@P_ASG_69_0_0_23_3_27 = (param3 & 134217728) > 0;
	@P_ASG_69_0_0_23_3_28 = (param3 & 268435456) > 0;
	@P_ASG_69_0_0_23_3_29 = (param3 & 536870912) > 0;
	@P_ASG_69_0_0_23_3_30 = (param3 & 1073741824) > 0;
	@P_ASG_69_0_0_23_3_31 = (param3 & -2147483648) > 0;
	superval[currentPos++]= param3&0x000000ff;
	superval[currentPos++]=(param3&0x0000ff00)>>8;
	superval[currentPos++]=(param3&0x00ff0000)>>16;
	superval[currentPos++]=(param3&0xff000000)>>24;
// gen_BuildFunc_SetSuperVals 
	param4 = getValue(P_ASG_69_0_0_23_4);
	@P_ASG_69_0_0_23_4_0 = (param4 & 1) > 0;
	@P_ASG_69_0_0_23_4_1 = (param4 & 2) > 0;
	@P_ASG_69_0_0_23_4_2 = (param4 & 4) > 0;
	@P_ASG_69_0_0_23_4_3 = (param4 & 8) > 0;
	@P_ASG_69_0_0_23_4_4 = (param4 & 16) > 0;
	@P_ASG_69_0_0_23_4_5 = (param4 & 32) > 0;
	@P_ASG_69_0_0_23_4_6 = (param4 & 64) > 0;
	@P_ASG_69_0_0_23_4_7 = (param4 & 128) > 0;
	@P_ASG_69_0_0_23_4_8 = (param4 & 256) > 0;
	@P_ASG_69_0_0_23_4_9 = (param4 & 512) > 0;
	@P_ASG_69_0_0_23_4_10 = (param4 & 1024) > 0;
	@P_ASG_69_0_0_23_4_11 = (param4 & 2048) > 0;
	@P_ASG_69_0_0_23_4_12 = (param4 & 4096) > 0;
	@P_ASG_69_0_0_23_4_13 = (param4 & 8192) > 0;
	@P_ASG_69_0_0_23_4_14 = (param4 & 16384) > 0;
	@P_ASG_69_0_0_23_4_15 = (param4 & 32768) > 0;
	@P_ASG_69_0_0_23_4_16 = (param4 & 65536) > 0;
	@P_ASG_69_0_0_23_4_17 = (param4 & 131072) > 0;
	@P_ASG_69_0_0_23_4_18 = (param4 & 262144) > 0;
	@P_ASG_69_0_0_23_4_19 = (param4 & 524288) > 0;
	@P_ASG_69_0_0_23_4_20 = (param4 & 1048576) > 0;
	@P_ASG_69_0_0_23_4_21 = (param4 & 2097152) > 0;
	@P_ASG_69_0_0_23_4_22 = (param4 & 4194304) > 0;
	@P_ASG_69_0_0_23_4_23 = (param4 & 8388608) > 0;
	@P_ASG_69_0_0_23_4_24 = (param4 & 16777216) > 0;
	@P_ASG_69_0_0_23_4_25 = (param4 & 33554432) > 0;
	@P_ASG_69_0_0_23_4_26 = (param4 & 67108864) > 0;
	@P_ASG_69_0_0_23_4_27 = (param4 & 134217728) > 0;
	@P_ASG_69_0_0_23_4_28 = (param4 & 268435456) > 0;
	@P_ASG_69_0_0_23_4_29 = (param4 & 536870912) > 0;
	superval[currentPos++]= param4&0x000000ff;
	superval[currentPos++]=(param4&0x0000ff00)>>8;
	superval[currentPos++]=(param4&0x00ff0000)>>16;
	superval[currentPos++]=(param4&0xff000000)>>24;
// gen_BuildFunc_SetSuperVals 
	param5 = getValue(P_ASG_69_0_0_23_5);
	@P_ASG_69_0_0_23_5_0 = (param5 & 1) > 0;
	@P_ASG_69_0_0_23_5_1 = (param5 & 2) > 0;
	@P_ASG_69_0_0_23_5_2 = (param5 & 4) > 0;
	@P_ASG_69_0_0_23_5_3 = (param5 & 8) > 0;
	@P_ASG_69_0_0_23_5_4 = (param5 & 16) > 0;
	@P_ASG_69_0_0_23_5_5 = (param5 & 32) > 0;
	@P_ASG_69_0_0_23_5_6 = (param5 & 64) > 0;
	@P_ASG_69_0_0_23_5_7 = (param5 & 128) > 0;
	@P_ASG_69_0_0_23_5_8 = (param5 & 256) > 0;
	@P_ASG_69_0_0_23_5_9 = (param5 & 512) > 0;
	@P_ASG_69_0_0_23_5_10 = (param5 & 1024) > 0;
	@P_ASG_69_0_0_23_5_11 = (param5 & 2048) > 0;
	@P_ASG_69_0_0_23_5_12 = (param5 & 4096) > 0;
	@P_ASG_69_0_0_23_5_13 = (param5 & 8192) > 0;
	@P_ASG_69_0_0_23_5_14 = (param5 & 16384) > 0;
	@P_ASG_69_0_0_23_5_15 = (param5 & 32768) > 0;
	@P_ASG_69_0_0_23_5_16 = (param5 & 65536) > 0;
	@P_ASG_69_0_0_23_5_17 = (param5 & 131072) > 0;
	@P_ASG_69_0_0_23_5_18 = (param5 & 262144) > 0;
	@P_ASG_69_0_0_23_5_19 = (param5 & 524288) > 0;
	@P_ASG_69_0_0_23_5_20 = (param5 & 1048576) > 0;
	@P_ASG_69_0_0_23_5_21 = (param5 & 2097152) > 0;
	@P_ASG_69_0_0_23_5_22 = (param5 & 4194304) > 0;
	@P_ASG_69_0_0_23_5_23 = (param5 & 8388608) > 0;
	@P_ASG_69_0_0_23_5_24 = (param5 & 16777216) > 0;
	@P_ASG_69_0_0_23_5_25 = (param5 & 33554432) > 0;
	@P_ASG_69_0_0_23_5_26 = (param5 & 67108864) > 0;
	@P_ASG_69_0_0_23_5_27 = (param5 & 134217728) > 0;
	@P_ASG_69_0_0_23_5_28 = (param5 & 268435456) > 0;
	@P_ASG_69_0_0_23_5_29 = (param5 & 536870912) > 0;
	@P_ASG_69_0_0_23_5_30 = (param5 & 1073741824) > 0;
	@P_ASG_69_0_0_23_5_31 = (param5 & -2147483648) > 0;
	superval[currentPos++]= param5&0x000000ff;
	superval[currentPos++]=(param5&0x0000ff00)>>8;
	superval[currentPos++]=(param5&0x00ff0000)>>16;
	superval[currentPos++]=(param5&0xff000000)>>24;
// gen_BuildFunc_SetSuperVals 
	param6 = getValue(P_ASG_69_0_0_23_6);
	@P_ASG_69_0_0_23_6_0 = (param6 & 1) > 0;
	@P_ASG_69_0_0_23_6_1 = (param6 & 2) > 0;
	@P_ASG_69_0_0_23_6_2 = (param6 & 4) > 0;
	@P_ASG_69_0_0_23_6_3 = (param6 & 8) > 0;
	@P_ASG_69_0_0_23_6_4 = (param6 & 16) > 0;
	@P_ASG_69_0_0_23_6_5 = (param6 & 32) > 0;
	@P_ASG_69_0_0_23_6_6 = (param6 & 64) > 0;
	@P_ASG_69_0_0_23_6_7 = (param6 & 128) > 0;
	@P_ASG_69_0_0_23_6_8 = (param6 & 256) > 0;
	@P_ASG_69_0_0_23_6_9 = (param6 & 512) > 0;
	@P_ASG_69_0_0_23_6_10 = (param6 & 1024) > 0;
	@P_ASG_69_0_0_23_6_11 = (param6 & 2048) > 0;
	@P_ASG_69_0_0_23_6_12 = (param6 & 4096) > 0;
	@P_ASG_69_0_0_23_6_13 = (param6 & 8192) > 0;
	@P_ASG_69_0_0_23_6_14 = (param6 & 16384) > 0;
	@P_ASG_69_0_0_23_6_15 = (param6 & 32768) > 0;
	@P_ASG_69_0_0_23_6_16 = (param6 & 65536) > 0;
	@P_ASG_69_0_0_23_6_17 = (param6 & 131072) > 0;
	@P_ASG_69_0_0_23_6_18 = (param6 & 262144) > 0;
	@P_ASG_69_0_0_23_6_19 = (param6 & 524288) > 0;
	@P_ASG_69_0_0_23_6_20 = (param6 & 1048576) > 0;
	@P_ASG_69_0_0_23_6_21 = (param6 & 2097152) > 0;
	@P_ASG_69_0_0_23_6_22 = (param6 & 4194304) > 0;
	@P_ASG_69_0_0_23_6_23 = (param6 & 8388608) > 0;
	@P_ASG_69_0_0_23_6_24 = (param6 & 16777216) > 0;
	@P_ASG_69_0_0_23_6_25 = (param6 & 33554432) > 0;
	@P_ASG_69_0_0_23_6_26 = (param6 & 67108864) > 0;
	@P_ASG_69_0_0_23_6_27 = (param6 & 134217728) > 0;
	@P_ASG_69_0_0_23_6_28 = (param6 & 268435456) > 0;
	@P_ASG_69_0_0_23_6_29 = (param6 & 536870912) > 0;
	superval[currentPos++]= param6&0x000000ff;
	superval[currentPos++]=(param6&0x0000ff00)>>8;
	superval[currentPos++]=(param6&0x00ff0000)>>16;
	superval[currentPos++]=(param6&0xff000000)>>24;
	putValue(P_ASG_69_0_0_23, superval, currentPos);
}


on envVar P_ASG_69_0_0_23_1_0
{
	byte bitval;
	//thisval steht hier fuer den bitfield-wert, 
	//aus Generierungsgruenden hier keine einheitliche Bezeichnung moeglich.
	dword thisval; // MainSetup
	bitval= getValue(this);
	thisval = getValue(P_ASG_69_0_0_23_1);
	thisval = thisval&~(1<<0)|(bitval<<0);
	putValue(P_ASG_69_0_0_23_1,thisval);
}

on envVar P_ASG_69_0_0_23_1_1
{
	byte bitval;
	//thisval steht hier fuer den bitfield-wert, 
	//aus Generierungsgruenden hier keine einheitliche Bezeichnung moeglich.
	dword thisval; // MainSetup
	bitval= getValue(this);
	thisval = getValue(P_ASG_69_0_0_23_1);
	thisval = thisval&~(1<<1)|(bitval<<1);
	putValue(P_ASG_69_0_0_23_1,thisval);
}

on envVar P_ASG_69_0_0_23_1_2
{
	byte bitval;
	//thisval steht hier fuer den bitfield-wert, 
	//aus Generierungsgruenden hier keine einheitliche Bezeichnung moeglich.
	dword thisval; // MainSetup
	bitval= getValue(this);
	thisval = getValue(P_ASG_69_0_0_23_1);
	thisval = thisval&~(1<<2)|(bitval<<2);
	putValue(P_ASG_69_0_0_23_1,thisval);
}

on envVar P_ASG_69_0_0_23_1_3
{
	byte bitval;
	//thisval steht hier fuer den bitfield-wert, 
	//aus Generierungsgruenden hier keine einheitliche Bezeichnung moeglich.
	dword thisval; // MainSetup
	bitval= getValue(this);
	thisval = getValue(P_ASG_69_0_0_23_1);
	thisval = thisval&~(1<<3)|(bitval<<3);
	putValue(P_ASG_69_0_0_23_1,thisval);
}

on envVar P_ASG_69_0_0_23_1_4
{
	byte bitval;
	//thisval steht hier fuer den bitfield-wert, 
	//aus Generierungsgruenden hier keine einheitliche Bezeichnung moeglich.
	dword thisval; // MainSetup
	bitval= getValue(this);
	thisval = getValue(P_ASG_69_0_0_23_1);
	thisval = thisval&~(1<<4)|(bitval<<4);
	putValue(P_ASG_69_0_0_23_1,thisval);
}

on envVar P_ASG_69_0_0_23_1_5
{
	byte bitval;
	//thisval steht hier fuer den bitfield-wert, 
	//aus Generierungsgruenden hier keine einheitliche Bezeichnung moeglich.
	dword thisval; // MainSetup
	bitval= getValue(this);
	thisval = getValue(P_ASG_69_0_0_23_1);
	thisval = thisval&~(1<<5)|(bitval<<5);
	putValue(P_ASG_69_0_0_23_1,thisval);
}

on envVar P_ASG_69_0_0_23_1_6
{
	byte bitval;
	//thisval steht hier fuer den bitfield-wert, 
	//aus Generierungsgruenden hier keine einheitliche Bezeichnung moeglich.
	dword thisval; // MainSetup
	bitval= getValue(this);
	thisval = getValue(P_ASG_69_0_0_23_1);
	thisval = thisval&~(1<<6)|(bitval<<6);
	putValue(P_ASG_69_0_0_23_1,thisval);
}

on envVar P_ASG_69_0_0_23_1_7
{
	byte bitval;
	//thisval steht hier fuer den bitfield-wert, 
	//aus Generierungsgruenden hier keine einheitliche Bezeichnung moeglich.
	dword thisval; // MainSetup
	bitval= getValue(this);
	thisval = getValue(P_ASG_69_0_0_23_1);
	thisval = thisval&~(1<<7)|(bitval<<7);
	putValue(P_ASG_69_0_0_23_1,thisval);
}

on envVar P_ASG_69_0_0_23_1_8
{
	byte bitval;
	//thisval steht hier fuer den bitfield-wert, 
	//aus Generierungsgruenden hier keine einheitliche Bezeichnung moeglich.
	dword thisval; // MainSetup
	bitval= getValue(this);
	thisval = getValue(P_ASG_69_0_0_23_1);
	thisval = thisval&~(1<<8)|(bitval<<8);
	putValue(P_ASG_69_0_0_23_1,thisval);
}

on envVar P_ASG_69_0_0_23_1_9
{
	byte bitval;
	//thisval steht hier fuer den bitfield-wert, 
	//aus Generierungsgruenden hier keine einheitliche Bezeichnung moeglich.
	dword thisval; // MainSetup
	bitval= getValue(this);
	thisval = getValue(P_ASG_69_0_0_23_1);
	thisval = thisval&~(1<<9)|(bitval<<9);
	putValue(P_ASG_69_0_0_23_1,thisval);
}

on envVar P_ASG_69_0_0_23_1_10
{
	byte bitval;
	//thisval steht hier fuer den bitfield-wert, 
	//aus Generierungsgruenden hier keine einheitliche Bezeichnung moeglich.
	dword thisval; // MainSetup
	bitval= getValue(this);
	thisval = getValue(P_ASG_69_0_0_23_1);
	thisval = thisval&~(1<<10)|(bitval<<10);
	putValue(P_ASG_69_0_0_23_1,thisval);
}

on envVar P_ASG_69_0_0_23_1_11
{
	byte bitval;
	//thisval steht hier fuer den bitfield-wert, 
	//aus Generierungsgruenden hier keine einheitliche Bezeichnung moeglich.
	dword thisval; // MainSetup
	bitval= getValue(this);
	thisval = getValue(P_ASG_69_0_0_23_1);
	thisval = thisval&~(1<<11)|(bitval<<11);
	putValue(P_ASG_69_0_0_23_1,thisval);
}

on envVar P_ASG_69_0_0_23_1_12
{
	byte bitval;
	//thisval steht hier fuer den bitfield-wert, 
	//aus Generierungsgruenden hier keine einheitliche Bezeichnung moeglich.
	dword thisval; // MainSetup
	bitval= getValue(this);
	thisval = getValue(P_ASG_69_0_0_23_1);
	thisval = thisval&~(1<<12)|(bitval<<12);
	putValue(P_ASG_69_0_0_23_1,thisval);
}

on envVar P_ASG_69_0_0_23_1_13
{
	byte bitval;
	//thisval steht hier fuer den bitfield-wert, 
	//aus Generierungsgruenden hier keine einheitliche Bezeichnung moeglich.
	dword thisval; // MainSetup
	bitval= getValue(this);
	thisval = getValue(P_ASG_69_0_0_23_1);
	thisval = thisval&~(1<<13)|(bitval<<13);
	putValue(P_ASG_69_0_0_23_1,thisval);
}

on envVar P_ASG_69_0_0_23_1_14
{
	byte bitval;
	//thisval steht hier fuer den bitfield-wert, 
	//aus Generierungsgruenden hier keine einheitliche Bezeichnung moeglich.
	dword thisval; // MainSetup
	bitval= getValue(this);
	thisval = getValue(P_ASG_69_0_0_23_1);
	thisval = thisval&~(1<<14)|(bitval<<14);
	putValue(P_ASG_69_0_0_23_1,thisval);
}

on envVar P_ASG_69_0_0_23_1_15
{
	byte bitval;
	//thisval steht hier fuer den bitfield-wert, 
	//aus Generierungsgruenden hier keine einheitliche Bezeichnung moeglich.
	dword thisval; // MainSetup
	bitval= getValue(this);
	thisval = getValue(P_ASG_69_0_0_23_1);
	thisval = thisval&~(1<<15)|(bitval<<15);
	putValue(P_ASG_69_0_0_23_1,thisval);
}

on envVar P_ASG_69_0_0_23_1_16
{
	byte bitval;
	//thisval steht hier fuer den bitfield-wert, 
	//aus Generierungsgruenden hier keine einheitliche Bezeichnung moeglich.
	dword thisval; // MainSetup
	bitval= getValue(this);
	thisval = getValue(P_ASG_69_0_0_23_1);
	thisval = thisval&~(1<<16)|(bitval<<16);
	putValue(P_ASG_69_0_0_23_1,thisval);
}

on envVar P_ASG_69_0_0_23_1_17
{
	byte bitval;
	//thisval steht hier fuer den bitfield-wert, 
	//aus Generierungsgruenden hier keine einheitliche Bezeichnung moeglich.
	dword thisval; // MainSetup
	bitval= getValue(this);
	thisval = getValue(P_ASG_69_0_0_23_1);
	thisval = thisval&~(1<<17)|(bitval<<17);
	putValue(P_ASG_69_0_0_23_1,thisval);
}

on envVar P_ASG_69_0_0_23_1_18
{
	byte bitval;
	//thisval steht hier fuer den bitfield-wert, 
	//aus Generierungsgruenden hier keine einheitliche Bezeichnung moeglich.
	dword thisval; // MainSetup
	bitval= getValue(this);
	thisval = getValue(P_ASG_69_0_0_23_1);
	thisval = thisval&~(1<<18)|(bitval<<18);
	putValue(P_ASG_69_0_0_23_1,thisval);
}

on envVar P_ASG_69_0_0_23_1_19
{
	byte bitval;
	//thisval steht hier fuer den bitfield-wert, 
	//aus Generierungsgruenden hier keine einheitliche Bezeichnung moeglich.
	dword thisval; // MainSetup
	bitval= getValue(this);
	thisval = getValue(P_ASG_69_0_0_23_1);
	thisval = thisval&~(1<<19)|(bitval<<19);
	putValue(P_ASG_69_0_0_23_1,thisval);
}

on envVar P_ASG_69_0_0_23_1_20
{
	byte bitval;
	//thisval steht hier fuer den bitfield-wert, 
	//aus Generierungsgruenden hier keine einheitliche Bezeichnung moeglich.
	dword thisval; // MainSetup
	bitval= getValue(this);
	thisval = getValue(P_ASG_69_0_0_23_1);
	thisval = thisval&~(1<<20)|(bitval<<20);
	putValue(P_ASG_69_0_0_23_1,thisval);
}

on envVar P_ASG_69_0_0_23_1_21
{
	byte bitval;
	//thisval steht hier fuer den bitfield-wert, 
	//aus Generierungsgruenden hier keine einheitliche Bezeichnung moeglich.
	dword thisval; // MainSetup
	bitval= getValue(this);
	thisval = getValue(P_ASG_69_0_0_23_1);
	thisval = thisval&~(1<<21)|(bitval<<21);
	putValue(P_ASG_69_0_0_23_1,thisval);
}

on envVar P_ASG_69_0_0_23_1_22
{
	byte bitval;
	//thisval steht hier fuer den bitfield-wert, 
	//aus Generierungsgruenden hier keine einheitliche Bezeichnung moeglich.
	dword thisval; // MainSetup
	bitval= getValue(this);
	thisval = getValue(P_ASG_69_0_0_23_1);
	thisval = thisval&~(1<<22)|(bitval<<22);
	putValue(P_ASG_69_0_0_23_1,thisval);
}

on envVar P_ASG_69_0_0_23_1_23
{
	byte bitval;
	//thisval steht hier fuer den bitfield-wert, 
	//aus Generierungsgruenden hier keine einheitliche Bezeichnung moeglich.
	dword thisval; // MainSetup
	bitval= getValue(this);
	thisval = getValue(P_ASG_69_0_0_23_1);
	thisval = thisval&~(1<<23)|(bitval<<23);
	putValue(P_ASG_69_0_0_23_1,thisval);
}

on envVar P_ASG_69_0_0_23_1_24
{
	byte bitval;
	//thisval steht hier fuer den bitfield-wert, 
	//aus Generierungsgruenden hier keine einheitliche Bezeichnung moeglich.
	dword thisval; // MainSetup
	bitval= getValue(this);
	thisval = getValue(P_ASG_69_0_0_23_1);
	thisval = thisval&~(1<<24)|(bitval<<24);
	putValue(P_ASG_69_0_0_23_1,thisval);
}

on envVar P_ASG_69_0_0_23_1_25
{
	byte bitval;
	//thisval steht hier fuer den bitfield-wert, 
	//aus Generierungsgruenden hier keine einheitliche Bezeichnung moeglich.
	dword thisval; // MainSetup
	bitval= getValue(this);
	thisval = getValue(P_ASG_69_0_0_23_1);
	thisval = thisval&~(1<<25)|(bitval<<25);
	putValue(P_ASG_69_0_0_23_1,thisval);
}

on envVar P_ASG_69_0_0_23_1_26
{
	byte bitval;
	//thisval steht hier fuer den bitfield-wert, 
	//aus Generierungsgruenden hier keine einheitliche Bezeichnung moeglich.
	dword thisval; // MainSetup
	bitval= getValue(this);
	thisval = getValue(P_ASG_69_0_0_23_1);
	thisval = thisval&~(1<<26)|(bitval<<26);
	putValue(P_ASG_69_0_0_23_1,thisval);
}

on envVar P_ASG_69_0_0_23_1_27
{
	byte bitval;
	//thisval steht hier fuer den bitfield-wert, 
	//aus Generierungsgruenden hier keine einheitliche Bezeichnung moeglich.
	dword thisval; // MainSetup
	bitval= getValue(this);
	thisval = getValue(P_ASG_69_0_0_23_1);
	thisval = thisval&~(1<<27)|(bitval<<27);
	putValue(P_ASG_69_0_0_23_1,thisval);
}

on envVar P_ASG_69_0_0_23_1_28
{
	byte bitval;
	//thisval steht hier fuer den bitfield-wert, 
	//aus Generierungsgruenden hier keine einheitliche Bezeichnung moeglich.
	dword thisval; // MainSetup
	bitval= getValue(this);
	thisval = getValue(P_ASG_69_0_0_23_1);
	thisval = thisval&~(1<<28)|(bitval<<28);
	putValue(P_ASG_69_0_0_23_1,thisval);
}

on envVar P_ASG_69_0_0_23_1_29
{
	byte bitval;
	//thisval steht hier fuer den bitfield-wert, 
	//aus Generierungsgruenden hier keine einheitliche Bezeichnung moeglich.
	dword thisval; // MainSetup
	bitval= getValue(this);
	thisval = getValue(P_ASG_69_0_0_23_1);
	thisval = thisval&~(1<<29)|(bitval<<29);
	putValue(P_ASG_69_0_0_23_1,thisval);
}

on envVar P_ASG_69_0_0_23_1 // Display3Setup.MainSetup
{
	P_ASG_69_0_0_23_BuildFct();
}

on envVar P_ASG_69_0_0_23_2_0
{
	byte bitval;
	//thisval steht hier fuer den bitfield-wert, 
	//aus Generierungsgruenden hier keine einheitliche Bezeichnung moeglich.
	byte thisval; // DisplayedAdditionalInfos
	bitval= getValue(this);
	thisval = getValue(P_ASG_69_0_0_23_2);
	thisval = thisval&~(1<<0)|(bitval<<0);
	putValue(P_ASG_69_0_0_23_2,thisval);
}

on envVar P_ASG_69_0_0_23_2_1
{
	byte bitval;
	//thisval steht hier fuer den bitfield-wert, 
	//aus Generierungsgruenden hier keine einheitliche Bezeichnung moeglich.
	byte thisval; // DisplayedAdditionalInfos
	bitval= getValue(this);
	thisval = getValue(P_ASG_69_0_0_23_2);
	thisval = thisval&~(1<<1)|(bitval<<1);
	putValue(P_ASG_69_0_0_23_2,thisval);
}

on envVar P_ASG_69_0_0_23_2 // Display3Setup.DisplayedAdditionalInfos
{
	P_ASG_69_0_0_23_BuildFct();
}

on envVar P_ASG_69_0_0_23_3_0
{
	byte bitval;
	//thisval steht hier fuer den bitfield-wert, 
	//aus Generierungsgruenden hier keine einheitliche Bezeichnung moeglich.
	dword thisval; // AdditionalInfo1_1
	bitval= getValue(this);
	thisval = getValue(P_ASG_69_0_0_23_3);
	thisval = thisval&~(1<<0)|(bitval<<0);
	putValue(P_ASG_69_0_0_23_3,thisval);
}

on envVar P_ASG_69_0_0_23_3_1
{
	byte bitval;
	//thisval steht hier fuer den bitfield-wert, 
	//aus Generierungsgruenden hier keine einheitliche Bezeichnung moeglich.
	dword thisval; // AdditionalInfo1_1
	bitval= getValue(this);
	thisval = getValue(P_ASG_69_0_0_23_3);
	thisval = thisval&~(1<<1)|(bitval<<1);
	putValue(P_ASG_69_0_0_23_3,thisval);
}

on envVar P_ASG_69_0_0_23_3_2
{
	byte bitval;
	//thisval steht hier fuer den bitfield-wert, 
	//aus Generierungsgruenden hier keine einheitliche Bezeichnung moeglich.
	dword thisval; // AdditionalInfo1_1
	bitval= getValue(this);
	thisval = getValue(P_ASG_69_0_0_23_3);
	thisval = thisval&~(1<<2)|(bitval<<2);
	putValue(P_ASG_69_0_0_23_3,thisval);
}

on envVar P_ASG_69_0_0_23_3_3
{
	byte bitval;
	//thisval steht hier fuer den bitfield-wert, 
	//aus Generierungsgruenden hier keine einheitliche Bezeichnung moeglich.
	dword thisval; // AdditionalInfo1_1
	bitval= getValue(this);
	thisval = getValue(P_ASG_69_0_0_23_3);
	thisval = thisval&~(1<<3)|(bitval<<3);
	putValue(P_ASG_69_0_0_23_3,thisval);
}

on envVar P_ASG_69_0_0_23_3_4
{
	byte bitval;
	//thisval steht hier fuer den bitfield-wert, 
	//aus Generierungsgruenden hier keine einheitliche Bezeichnung moeglich.
	dword thisval; // AdditionalInfo1_1
	bitval= getValue(this);
	thisval = getValue(P_ASG_69_0_0_23_3);
	thisval = thisval&~(1<<4)|(bitval<<4);
	putValue(P_ASG_69_0_0_23_3,thisval);
}

on envVar P_ASG_69_0_0_23_3_5
{
	byte bitval;
	//thisval steht hier fuer den bitfield-wert, 
	//aus Generierungsgruenden hier keine einheitliche Bezeichnung moeglich.
	dword thisval; // AdditionalInfo1_1
	bitval= getValue(this);
	thisval = getValue(P_ASG_69_0_0_23_3);
	thisval = thisval&~(1<<5)|(bitval<<5);
	putValue(P_ASG_69_0_0_23_3,thisval);
}

on envVar P_ASG_69_0_0_23_3_6
{
	byte bitval;
	//thisval steht hier fuer den bitfield-wert, 
	//aus Generierungsgruenden hier keine einheitliche Bezeichnung moeglich.
	dword thisval; // AdditionalInfo1_1
	bitval= getValue(this);
	thisval = getValue(P_ASG_69_0_0_23_3);
	thisval = thisval&~(1<<6)|(bitval<<6);
	putValue(P_ASG_69_0_0_23_3,thisval);
}

on envVar P_ASG_69_0_0_23_3_7
{
	byte bitval;
	//thisval steht hier fuer den bitfield-wert, 
	//aus Generierungsgruenden hier keine einheitliche Bezeichnung moeglich.
	dword thisval; // AdditionalInfo1_1
	bitval= getValue(this);
	thisval = getValue(P_ASG_69_0_0_23_3);
	thisval = thisval&~(1<<7)|(bitval<<7);
	putValue(P_ASG_69_0_0_23_3,thisval);
}

on envVar P_ASG_69_0_0_23_3_8
{
	byte bitval;
	//thisval steht hier fuer den bitfield-wert, 
	//aus Generierungsgruenden hier keine einheitliche Bezeichnung moeglich.
	dword thisval; // AdditionalInfo1_1
	bitval= getValue(this);
	thisval = getValue(P_ASG_69_0_0_23_3);
	thisval = thisval&~(1<<8)|(bitval<<8);
	putValue(P_ASG_69_0_0_23_3,thisval);
}

on envVar P_ASG_69_0_0_23_3_9
{
	byte bitval;
	//thisval steht hier fuer den bitfield-wert, 
	//aus Generierungsgruenden hier keine einheitliche Bezeichnung moeglich.
	dword thisval; // AdditionalInfo1_1
	bitval= getValue(this);
	thisval = getValue(P_ASG_69_0_0_23_3);
	thisval = thisval&~(1<<9)|(bitval<<9);
	putValue(P_ASG_69_0_0_23_3,thisval);
}

on envVar P_ASG_69_0_0_23_3_10
{
	byte bitval;
	//thisval steht hier fuer den bitfield-wert, 
	//aus Generierungsgruenden hier keine einheitliche Bezeichnung moeglich.
	dword thisval; // AdditionalInfo1_1
	bitval= getValue(this);
	thisval = getValue(P_ASG_69_0_0_23_3);
	thisval = thisval&~(1<<10)|(bitval<<10);
	putValue(P_ASG_69_0_0_23_3,thisval);
}

on envVar P_ASG_69_0_0_23_3_11
{
	byte bitval;
	//thisval steht hier fuer den bitfield-wert, 
	//aus Generierungsgruenden hier keine einheitliche Bezeichnung moeglich.
	dword thisval; // AdditionalInfo1_1
	bitval= getValue(this);
	thisval = getValue(P_ASG_69_0_0_23_3);
	thisval = thisval&~(1<<11)|(bitval<<11);
	putValue(P_ASG_69_0_0_23_3,thisval);
}

on envVar P_ASG_69_0_0_23_3_12
{
	byte bitval;
	//thisval steht hier fuer den bitfield-wert, 
	//aus Generierungsgruenden hier keine einheitliche Bezeichnung moeglich.
	dword thisval; // AdditionalInfo1_1
	bitval= getValue(this);
	thisval = getValue(P_ASG_69_0_0_23_3);
	thisval = thisval&~(1<<12)|(bitval<<12);
	putValue(P_ASG_69_0_0_23_3,thisval);
}

on envVar P_ASG_69_0_0_23_3_13
{
	byte bitval;
	//thisval steht hier fuer den bitfield-wert, 
	//aus Generierungsgruenden hier keine einheitliche Bezeichnung moeglich.
	dword thisval; // AdditionalInfo1_1
	bitval= getValue(this);
	thisval = getValue(P_ASG_69_0_0_23_3);
	thisval = thisval&~(1<<13)|(bitval<<13);
	putValue(P_ASG_69_0_0_23_3,thisval);
}

on envVar P_ASG_69_0_0_23_3_14
{
	byte bitval;
	//thisval steht hier fuer den bitfield-wert, 
	//aus Generierungsgruenden hier keine einheitliche Bezeichnung moeglich.
	dword thisval; // AdditionalInfo1_1
	bitval= getValue(this);
	thisval = getValue(P_ASG_69_0_0_23_3);
	thisval = thisval&~(1<<14)|(bitval<<14);
	putValue(P_ASG_69_0_0_23_3,thisval);
}

on envVar P_ASG_69_0_0_23_3_15
{
	byte bitval;
	//thisval steht hier fuer den bitfield-wert, 
	//aus Generierungsgruenden hier keine einheitliche Bezeichnung moeglich.
	dword thisval; // AdditionalInfo1_1
	bitval= getValue(this);
	thisval = getValue(P_ASG_69_0_0_23_3);
	thisval = thisval&~(1<<15)|(bitval<<15);
	putValue(P_ASG_69_0_0_23_3,thisval);
}

on envVar P_ASG_69_0_0_23_3_16
{
	byte bitval;
	//thisval steht hier fuer den bitfield-wert, 
	//aus Generierungsgruenden hier keine einheitliche Bezeichnung moeglich.
	dword thisval; // AdditionalInfo1_1
	bitval= getValue(this);
	thisval = getValue(P_ASG_69_0_0_23_3);
	thisval = thisval&~(1<<16)|(bitval<<16);
	putValue(P_ASG_69_0_0_23_3,thisval);
}

on envVar P_ASG_69_0_0_23_3_17
{
	byte bitval;
	//thisval steht hier fuer den bitfield-wert, 
	//aus Generierungsgruenden hier keine einheitliche Bezeichnung moeglich.
	dword thisval; // AdditionalInfo1_1
	bitval= getValue(this);
	thisval = getValue(P_ASG_69_0_0_23_3);
	thisval = thisval&~(1<<17)|(bitval<<17);
	putValue(P_ASG_69_0_0_23_3,thisval);
}

on envVar P_ASG_69_0_0_23_3_18
{
	byte bitval;
	//thisval steht hier fuer den bitfield-wert, 
	//aus Generierungsgruenden hier keine einheitliche Bezeichnung moeglich.
	dword thisval; // AdditionalInfo1_1
	bitval= getValue(this);
	thisval = getValue(P_ASG_69_0_0_23_3);
	thisval = thisval&~(1<<18)|(bitval<<18);
	putValue(P_ASG_69_0_0_23_3,thisval);
}

on envVar P_ASG_69_0_0_23_3_19
{
	byte bitval;
	//thisval steht hier fuer den bitfield-wert, 
	//aus Generierungsgruenden hier keine einheitliche Bezeichnung moeglich.
	dword thisval; // AdditionalInfo1_1
	bitval= getValue(this);
	thisval = getValue(P_ASG_69_0_0_23_3);
	thisval = thisval&~(1<<19)|(bitval<<19);
	putValue(P_ASG_69_0_0_23_3,thisval);
}

on envVar P_ASG_69_0_0_23_3_20
{
	byte bitval;
	//thisval steht hier fuer den bitfield-wert, 
	//aus Generierungsgruenden hier keine einheitliche Bezeichnung moeglich.
	dword thisval; // AdditionalInfo1_1
	bitval= getValue(this);
	thisval = getValue(P_ASG_69_0_0_23_3);
	thisval = thisval&~(1<<20)|(bitval<<20);
	putValue(P_ASG_69_0_0_23_3,thisval);
}

on envVar P_ASG_69_0_0_23_3_21
{
	byte bitval;
	//thisval steht hier fuer den bitfield-wert, 
	//aus Generierungsgruenden hier keine einheitliche Bezeichnung moeglich.
	dword thisval; // AdditionalInfo1_1
	bitval= getValue(this);
	thisval = getValue(P_ASG_69_0_0_23_3);
	thisval = thisval&~(1<<21)|(bitval<<21);
	putValue(P_ASG_69_0_0_23_3,thisval);
}

on envVar P_ASG_69_0_0_23_3_22
{
	byte bitval;
	//thisval steht hier fuer den bitfield-wert, 
	//aus Generierungsgruenden hier keine einheitliche Bezeichnung moeglich.
	dword thisval; // AdditionalInfo1_1
	bitval= getValue(this);
	thisval = getValue(P_ASG_69_0_0_23_3);
	thisval = thisval&~(1<<22)|(bitval<<22);
	putValue(P_ASG_69_0_0_23_3,thisval);
}

on envVar P_ASG_69_0_0_23_3_23
{
	byte bitval;
	//thisval steht hier fuer den bitfield-wert, 
	//aus Generierungsgruenden hier keine einheitliche Bezeichnung moeglich.
	dword thisval; // AdditionalInfo1_1
	bitval= getValue(this);
	thisval = getValue(P_ASG_69_0_0_23_3);
	thisval = thisval&~(1<<23)|(bitval<<23);
	putValue(P_ASG_69_0_0_23_3,thisval);
}

on envVar P_ASG_69_0_0_23_3_24
{
	byte bitval;
	//thisval steht hier fuer den bitfield-wert, 
	//aus Generierungsgruenden hier keine einheitliche Bezeichnung moeglich.
	dword thisval; // AdditionalInfo1_1
	bitval= getValue(this);
	thisval = getValue(P_ASG_69_0_0_23_3);
	thisval = thisval&~(1<<24)|(bitval<<24);
	putValue(P_ASG_69_0_0_23_3,thisval);
}

on envVar P_ASG_69_0_0_23_3_25
{
	byte bitval;
	//thisval steht hier fuer den bitfield-wert, 
	//aus Generierungsgruenden hier keine einheitliche Bezeichnung moeglich.
	dword thisval; // AdditionalInfo1_1
	bitval= getValue(this);
	thisval = getValue(P_ASG_69_0_0_23_3);
	thisval = thisval&~(1<<25)|(bitval<<25);
	putValue(P_ASG_69_0_0_23_3,thisval);
}

on envVar P_ASG_69_0_0_23_3_26
{
	byte bitval;
	//thisval steht hier fuer den bitfield-wert, 
	//aus Generierungsgruenden hier keine einheitliche Bezeichnung moeglich.
	dword thisval; // AdditionalInfo1_1
	bitval= getValue(this);
	thisval = getValue(P_ASG_69_0_0_23_3);
	thisval = thisval&~(1<<26)|(bitval<<26);
	putValue(P_ASG_69_0_0_23_3,thisval);
}

on envVar P_ASG_69_0_0_23_3_27
{
	byte bitval;
	//thisval steht hier fuer den bitfield-wert, 
	//aus Generierungsgruenden hier keine einheitliche Bezeichnung moeglich.
	dword thisval; // AdditionalInfo1_1
	bitval= getValue(this);
	thisval = getValue(P_ASG_69_0_0_23_3);
	thisval = thisval&~(1<<27)|(bitval<<27);
	putValue(P_ASG_69_0_0_23_3,thisval);
}

on envVar P_ASG_69_0_0_23_3_28
{
	byte bitval;
	//thisval steht hier fuer den bitfield-wert, 
	//aus Generierungsgruenden hier keine einheitliche Bezeichnung moeglich.
	dword thisval; // AdditionalInfo1_1
	bitval= getValue(this);
	thisval = getValue(P_ASG_69_0_0_23_3);
	thisval = thisval&~(1<<28)|(bitval<<28);
	putValue(P_ASG_69_0_0_23_3,thisval);
}

on envVar P_ASG_69_0_0_23_3_29
{
	byte bitval;
	//thisval steht hier fuer den bitfield-wert, 
	//aus Generierungsgruenden hier keine einheitliche Bezeichnung moeglich.
	dword thisval; // AdditionalInfo1_1
	bitval= getValue(this);
	thisval = getValue(P_ASG_69_0_0_23_3);
	thisval = thisval&~(1<<29)|(bitval<<29);
	putValue(P_ASG_69_0_0_23_3,thisval);
}

on envVar P_ASG_69_0_0_23_3_30
{
	byte bitval;
	//thisval steht hier fuer den bitfield-wert, 
	//aus Generierungsgruenden hier keine einheitliche Bezeichnung moeglich.
	dword thisval; // AdditionalInfo1_1
	bitval= getValue(this);
	thisval = getValue(P_ASG_69_0_0_23_3);
	thisval = thisval&~(1<<30)|(bitval<<30);
	putValue(P_ASG_69_0_0_23_3,thisval);
}

on envVar P_ASG_69_0_0_23_3_31
{
	byte bitval;
	//thisval steht hier fuer den bitfield-wert, 
	//aus Generierungsgruenden hier keine einheitliche Bezeichnung moeglich.
	dword thisval; // AdditionalInfo1_1
	bitval= getValue(this);
	thisval = getValue(P_ASG_69_0_0_23_3);
	thisval = thisval&~(1<<31)|(bitval<<31);
	putValue(P_ASG_69_0_0_23_3,thisval);
}

on envVar P_ASG_69_0_0_23_3 // Display3Setup.AdditionalInfo1_1
{
	P_ASG_69_0_0_23_BuildFct();
}

on envVar P_ASG_69_0_0_23_4_0
{
	byte bitval;
	//thisval steht hier fuer den bitfield-wert, 
	//aus Generierungsgruenden hier keine einheitliche Bezeichnung moeglich.
	dword thisval; // AdditionalInfo1_2
	bitval= getValue(this);
	thisval = getValue(P_ASG_69_0_0_23_4);
	thisval = thisval&~(1<<0)|(bitval<<0);
	putValue(P_ASG_69_0_0_23_4,thisval);
}

on envVar P_ASG_69_0_0_23_4_1
{
	byte bitval;
	//thisval steht hier fuer den bitfield-wert, 
	//aus Generierungsgruenden hier keine einheitliche Bezeichnung moeglich.
	dword thisval; // AdditionalInfo1_2
	bitval= getValue(this);
	thisval = getValue(P_ASG_69_0_0_23_4);
	thisval = thisval&~(1<<1)|(bitval<<1);
	putValue(P_ASG_69_0_0_23_4,thisval);
}

on envVar P_ASG_69_0_0_23_4_2
{
	byte bitval;
	//thisval steht hier fuer den bitfield-wert, 
	//aus Generierungsgruenden hier keine einheitliche Bezeichnung moeglich.
	dword thisval; // AdditionalInfo1_2
	bitval= getValue(this);
	thisval = getValue(P_ASG_69_0_0_23_4);
	thisval = thisval&~(1<<2)|(bitval<<2);
	putValue(P_ASG_69_0_0_23_4,thisval);
}

on envVar P_ASG_69_0_0_23_4_3
{
	byte bitval;
	//thisval steht hier fuer den bitfield-wert, 
	//aus Generierungsgruenden hier keine einheitliche Bezeichnung moeglich.
	dword thisval; // AdditionalInfo1_2
	bitval= getValue(this);
	thisval = getValue(P_ASG_69_0_0_23_4);
	thisval = thisval&~(1<<3)|(bitval<<3);
	putValue(P_ASG_69_0_0_23_4,thisval);
}

on envVar P_ASG_69_0_0_23_4_4
{
	byte bitval;
	//thisval steht hier fuer den bitfield-wert, 
	//aus Generierungsgruenden hier keine einheitliche Bezeichnung moeglich.
	dword thisval; // AdditionalInfo1_2
	bitval= getValue(this);
	thisval = getValue(P_ASG_69_0_0_23_4);
	thisval = thisval&~(1<<4)|(bitval<<4);
	putValue(P_ASG_69_0_0_23_4,thisval);
}

on envVar P_ASG_69_0_0_23_4_5
{
	byte bitval;
	//thisval steht hier fuer den bitfield-wert, 
	//aus Generierungsgruenden hier keine einheitliche Bezeichnung moeglich.
	dword thisval; // AdditionalInfo1_2
	bitval= getValue(this);
	thisval = getValue(P_ASG_69_0_0_23_4);
	thisval = thisval&~(1<<5)|(bitval<<5);
	putValue(P_ASG_69_0_0_23_4,thisval);
}

on envVar P_ASG_69_0_0_23_4_6
{
	byte bitval;
	//thisval steht hier fuer den bitfield-wert, 
	//aus Generierungsgruenden hier keine einheitliche Bezeichnung moeglich.
	dword thisval; // AdditionalInfo1_2
	bitval= getValue(this);
	thisval = getValue(P_ASG_69_0_0_23_4);
	thisval = thisval&~(1<<6)|(bitval<<6);
	putValue(P_ASG_69_0_0_23_4,thisval);
}

on envVar P_ASG_69_0_0_23_4_7
{
	byte bitval;
	//thisval steht hier fuer den bitfield-wert, 
	//aus Generierungsgruenden hier keine einheitliche Bezeichnung moeglich.
	dword thisval; // AdditionalInfo1_2
	bitval= getValue(this);
	thisval = getValue(P_ASG_69_0_0_23_4);
	thisval = thisval&~(1<<7)|(bitval<<7);
	putValue(P_ASG_69_0_0_23_4,thisval);
}

on envVar P_ASG_69_0_0_23_4_8
{
	byte bitval;
	//thisval steht hier fuer den bitfield-wert, 
	//aus Generierungsgruenden hier keine einheitliche Bezeichnung moeglich.
	dword thisval; // AdditionalInfo1_2
	bitval= getValue(this);
	thisval = getValue(P_ASG_69_0_0_23_4);
	thisval = thisval&~(1<<8)|(bitval<<8);
	putValue(P_ASG_69_0_0_23_4,thisval);
}

on envVar P_ASG_69_0_0_23_4_9
{
	byte bitval;
	//thisval steht hier fuer den bitfield-wert, 
	//aus Generierungsgruenden hier keine einheitliche Bezeichnung moeglich.
	dword thisval; // AdditionalInfo1_2
	bitval= getValue(this);
	thisval = getValue(P_ASG_69_0_0_23_4);
	thisval = thisval&~(1<<9)|(bitval<<9);
	putValue(P_ASG_69_0_0_23_4,thisval);
}

on envVar P_ASG_69_0_0_23_4_10
{
	byte bitval;
	//thisval steht hier fuer den bitfield-wert, 
	//aus Generierungsgruenden hier keine einheitliche Bezeichnung moeglich.
	dword thisval; // AdditionalInfo1_2
	bitval= getValue(this);
	thisval = getValue(P_ASG_69_0_0_23_4);
	thisval = thisval&~(1<<10)|(bitval<<10);
	putValue(P_ASG_69_0_0_23_4,thisval);
}

on envVar P_ASG_69_0_0_23_4_11
{
	byte bitval;
	//thisval steht hier fuer den bitfield-wert, 
	//aus Generierungsgruenden hier keine einheitliche Bezeichnung moeglich.
	dword thisval; // AdditionalInfo1_2
	bitval= getValue(this);
	thisval = getValue(P_ASG_69_0_0_23_4);
	thisval = thisval&~(1<<11)|(bitval<<11);
	putValue(P_ASG_69_0_0_23_4,thisval);
}

on envVar P_ASG_69_0_0_23_4_12
{
	byte bitval;
	//thisval steht hier fuer den bitfield-wert, 
	//aus Generierungsgruenden hier keine einheitliche Bezeichnung moeglich.
	dword thisval; // AdditionalInfo1_2
	bitval= getValue(this);
	thisval = getValue(P_ASG_69_0_0_23_4);
	thisval = thisval&~(1<<12)|(bitval<<12);
	putValue(P_ASG_69_0_0_23_4,thisval);
}

on envVar P_ASG_69_0_0_23_4_13
{
	byte bitval;
	//thisval steht hier fuer den bitfield-wert, 
	//aus Generierungsgruenden hier keine einheitliche Bezeichnung moeglich.
	dword thisval; // AdditionalInfo1_2
	bitval= getValue(this);
	thisval = getValue(P_ASG_69_0_0_23_4);
	thisval = thisval&~(1<<13)|(bitval<<13);
	putValue(P_ASG_69_0_0_23_4,thisval);
}

on envVar P_ASG_69_0_0_23_4_14
{
	byte bitval;
	//thisval steht hier fuer den bitfield-wert, 
	//aus Generierungsgruenden hier keine einheitliche Bezeichnung moeglich.
	dword thisval; // AdditionalInfo1_2
	bitval= getValue(this);
	thisval = getValue(P_ASG_69_0_0_23_4);
	thisval = thisval&~(1<<14)|(bitval<<14);
	putValue(P_ASG_69_0_0_23_4,thisval);
}

on envVar P_ASG_69_0_0_23_4_15
{
	byte bitval;
	//thisval steht hier fuer den bitfield-wert, 
	//aus Generierungsgruenden hier keine einheitliche Bezeichnung moeglich.
	dword thisval; // AdditionalInfo1_2
	bitval= getValue(this);
	thisval = getValue(P_ASG_69_0_0_23_4);
	thisval = thisval&~(1<<15)|(bitval<<15);
	putValue(P_ASG_69_0_0_23_4,thisval);
}

on envVar P_ASG_69_0_0_23_4_16
{
	byte bitval;
	//thisval steht hier fuer den bitfield-wert, 
	//aus Generierungsgruenden hier keine einheitliche Bezeichnung moeglich.
	dword thisval; // AdditionalInfo1_2
	bitval= getValue(this);
	thisval = getValue(P_ASG_69_0_0_23_4);
	thisval = thisval&~(1<<16)|(bitval<<16);
	putValue(P_ASG_69_0_0_23_4,thisval);
}

on envVar P_ASG_69_0_0_23_4_17
{
	byte bitval;
	//thisval steht hier fuer den bitfield-wert, 
	//aus Generierungsgruenden hier keine einheitliche Bezeichnung moeglich.
	dword thisval; // AdditionalInfo1_2
	bitval= getValue(this);
	thisval = getValue(P_ASG_69_0_0_23_4);
	thisval = thisval&~(1<<17)|(bitval<<17);
	putValue(P_ASG_69_0_0_23_4,thisval);
}

on envVar P_ASG_69_0_0_23_4_18
{
	byte bitval;
	//thisval steht hier fuer den bitfield-wert, 
	//aus Generierungsgruenden hier keine einheitliche Bezeichnung moeglich.
	dword thisval; // AdditionalInfo1_2
	bitval= getValue(this);
	thisval = getValue(P_ASG_69_0_0_23_4);
	thisval = thisval&~(1<<18)|(bitval<<18);
	putValue(P_ASG_69_0_0_23_4,thisval);
}

on envVar P_ASG_69_0_0_23_4_19
{
	byte bitval;
	//thisval steht hier fuer den bitfield-wert, 
	//aus Generierungsgruenden hier keine einheitliche Bezeichnung moeglich.
	dword thisval; // AdditionalInfo1_2
	bitval= getValue(this);
	thisval = getValue(P_ASG_69_0_0_23_4);
	thisval = thisval&~(1<<19)|(bitval<<19);
	putValue(P_ASG_69_0_0_23_4,thisval);
}

on envVar P_ASG_69_0_0_23_4_20
{
	byte bitval;
	//thisval steht hier fuer den bitfield-wert, 
	//aus Generierungsgruenden hier keine einheitliche Bezeichnung moeglich.
	dword thisval; // AdditionalInfo1_2
	bitval= getValue(this);
	thisval = getValue(P_ASG_69_0_0_23_4);
	thisval = thisval&~(1<<20)|(bitval<<20);
	putValue(P_ASG_69_0_0_23_4,thisval);
}

on envVar P_ASG_69_0_0_23_4_21
{
	byte bitval;
	//thisval steht hier fuer den bitfield-wert, 
	//aus Generierungsgruenden hier keine einheitliche Bezeichnung moeglich.
	dword thisval; // AdditionalInfo1_2
	bitval= getValue(this);
	thisval = getValue(P_ASG_69_0_0_23_4);
	thisval = thisval&~(1<<21)|(bitval<<21);
	putValue(P_ASG_69_0_0_23_4,thisval);
}

on envVar P_ASG_69_0_0_23_4_22
{
	byte bitval;
	//thisval steht hier fuer den bitfield-wert, 
	//aus Generierungsgruenden hier keine einheitliche Bezeichnung moeglich.
	dword thisval; // AdditionalInfo1_2
	bitval= getValue(this);
	thisval = getValue(P_ASG_69_0_0_23_4);
	thisval = thisval&~(1<<22)|(bitval<<22);
	putValue(P_ASG_69_0_0_23_4,thisval);
}

on envVar P_ASG_69_0_0_23_4_23
{
	byte bitval;
	//thisval steht hier fuer den bitfield-wert, 
	//aus Generierungsgruenden hier keine einheitliche Bezeichnung moeglich.
	dword thisval; // AdditionalInfo1_2
	bitval= getValue(this);
	thisval = getValue(P_ASG_69_0_0_23_4);
	thisval = thisval&~(1<<23)|(bitval<<23);
	putValue(P_ASG_69_0_0_23_4,thisval);
}

on envVar P_ASG_69_0_0_23_4_24
{
	byte bitval;
	//thisval steht hier fuer den bitfield-wert, 
	//aus Generierungsgruenden hier keine einheitliche Bezeichnung moeglich.
	dword thisval; // AdditionalInfo1_2
	bitval= getValue(this);
	thisval = getValue(P_ASG_69_0_0_23_4);
	thisval = thisval&~(1<<24)|(bitval<<24);
	putValue(P_ASG_69_0_0_23_4,thisval);
}

on envVar P_ASG_69_0_0_23_4_25
{
	byte bitval;
	//thisval steht hier fuer den bitfield-wert, 
	//aus Generierungsgruenden hier keine einheitliche Bezeichnung moeglich.
	dword thisval; // AdditionalInfo1_2
	bitval= getValue(this);
	thisval = getValue(P_ASG_69_0_0_23_4);
	thisval = thisval&~(1<<25)|(bitval<<25);
	putValue(P_ASG_69_0_0_23_4,thisval);
}

on envVar P_ASG_69_0_0_23_4_26
{
	byte bitval;
	//thisval steht hier fuer den bitfield-wert, 
	//aus Generierungsgruenden hier keine einheitliche Bezeichnung moeglich.
	dword thisval; // AdditionalInfo1_2
	bitval= getValue(this);
	thisval = getValue(P_ASG_69_0_0_23_4);
	thisval = thisval&~(1<<26)|(bitval<<26);
	putValue(P_ASG_69_0_0_23_4,thisval);
}

on envVar P_ASG_69_0_0_23_4_27
{
	byte bitval;
	//thisval steht hier fuer den bitfield-wert, 
	//aus Generierungsgruenden hier keine einheitliche Bezeichnung moeglich.
	dword thisval; // AdditionalInfo1_2
	bitval= getValue(this);
	thisval = getValue(P_ASG_69_0_0_23_4);
	thisval = thisval&~(1<<27)|(bitval<<27);
	putValue(P_ASG_69_0_0_23_4,thisval);
}

on envVar P_ASG_69_0_0_23_4_28
{
	byte bitval;
	//thisval steht hier fuer den bitfield-wert, 
	//aus Generierungsgruenden hier keine einheitliche Bezeichnung moeglich.
	dword thisval; // AdditionalInfo1_2
	bitval= getValue(this);
	thisval = getValue(P_ASG_69_0_0_23_4);
	thisval = thisval&~(1<<28)|(bitval<<28);
	putValue(P_ASG_69_0_0_23_4,thisval);
}

on envVar P_ASG_69_0_0_23_4_29
{
	byte bitval;
	//thisval steht hier fuer den bitfield-wert, 
	//aus Generierungsgruenden hier keine einheitliche Bezeichnung moeglich.
	dword thisval; // AdditionalInfo1_2
	bitval= getValue(this);
	thisval = getValue(P_ASG_69_0_0_23_4);
	thisval = thisval&~(1<<29)|(bitval<<29);
	putValue(P_ASG_69_0_0_23_4,thisval);
}

on envVar P_ASG_69_0_0_23_4 // Display3Setup.AdditionalInfo1_2
{
	P_ASG_69_0_0_23_BuildFct();
}

on envVar P_ASG_69_0_0_23_5_0
{
	byte bitval;
	//thisval steht hier fuer den bitfield-wert, 
	//aus Generierungsgruenden hier keine einheitliche Bezeichnung moeglich.
	dword thisval; // AdditionalInfo2_1
	bitval= getValue(this);
	thisval = getValue(P_ASG_69_0_0_23_5);
	thisval = thisval&~(1<<0)|(bitval<<0);
	putValue(P_ASG_69_0_0_23_5,thisval);
}

on envVar P_ASG_69_0_0_23_5_1
{
	byte bitval;
	//thisval steht hier fuer den bitfield-wert, 
	//aus Generierungsgruenden hier keine einheitliche Bezeichnung moeglich.
	dword thisval; // AdditionalInfo2_1
	bitval= getValue(this);
	thisval = getValue(P_ASG_69_0_0_23_5);
	thisval = thisval&~(1<<1)|(bitval<<1);
	putValue(P_ASG_69_0_0_23_5,thisval);
}

on envVar P_ASG_69_0_0_23_5_2
{
	byte bitval;
	//thisval steht hier fuer den bitfield-wert, 
	//aus Generierungsgruenden hier keine einheitliche Bezeichnung moeglich.
	dword thisval; // AdditionalInfo2_1
	bitval= getValue(this);
	thisval = getValue(P_ASG_69_0_0_23_5);
	thisval = thisval&~(1<<2)|(bitval<<2);
	putValue(P_ASG_69_0_0_23_5,thisval);
}

on envVar P_ASG_69_0_0_23_5_3
{
	byte bitval;
	//thisval steht hier fuer den bitfield-wert, 
	//aus Generierungsgruenden hier keine einheitliche Bezeichnung moeglich.
	dword thisval; // AdditionalInfo2_1
	bitval= getValue(this);
	thisval = getValue(P_ASG_69_0_0_23_5);
	thisval = thisval&~(1<<3)|(bitval<<3);
	putValue(P_ASG_69_0_0_23_5,thisval);
}

on envVar P_ASG_69_0_0_23_5_4
{
	byte bitval;
	//thisval steht hier fuer den bitfield-wert, 
	//aus Generierungsgruenden hier keine einheitliche Bezeichnung moeglich.
	dword thisval; // AdditionalInfo2_1
	bitval= getValue(this);
	thisval = getValue(P_ASG_69_0_0_23_5);
	thisval = thisval&~(1<<4)|(bitval<<4);
	putValue(P_ASG_69_0_0_23_5,thisval);
}

on envVar P_ASG_69_0_0_23_5_5
{
	byte bitval;
	//thisval steht hier fuer den bitfield-wert, 
	//aus Generierungsgruenden hier keine einheitliche Bezeichnung moeglich.
	dword thisval; // AdditionalInfo2_1
	bitval= getValue(this);
	thisval = getValue(P_ASG_69_0_0_23_5);
	thisval = thisval&~(1<<5)|(bitval<<5);
	putValue(P_ASG_69_0_0_23_5,thisval);
}

on envVar P_ASG_69_0_0_23_5_6
{
	byte bitval;
	//thisval steht hier fuer den bitfield-wert, 
	//aus Generierungsgruenden hier keine einheitliche Bezeichnung moeglich.
	dword thisval; // AdditionalInfo2_1
	bitval= getValue(this);
	thisval = getValue(P_ASG_69_0_0_23_5);
	thisval = thisval&~(1<<6)|(bitval<<6);
	putValue(P_ASG_69_0_0_23_5,thisval);
}

on envVar P_ASG_69_0_0_23_5_7
{
	byte bitval;
	//thisval steht hier fuer den bitfield-wert, 
	//aus Generierungsgruenden hier keine einheitliche Bezeichnung moeglich.
	dword thisval; // AdditionalInfo2_1
	bitval= getValue(this);
	thisval = getValue(P_ASG_69_0_0_23_5);
	thisval = thisval&~(1<<7)|(bitval<<7);
	putValue(P_ASG_69_0_0_23_5,thisval);
}

on envVar P_ASG_69_0_0_23_5_8
{
	byte bitval;
	//thisval steht hier fuer den bitfield-wert, 
	//aus Generierungsgruenden hier keine einheitliche Bezeichnung moeglich.
	dword thisval; // AdditionalInfo2_1
	bitval= getValue(this);
	thisval = getValue(P_ASG_69_0_0_23_5);
	thisval = thisval&~(1<<8)|(bitval<<8);
	putValue(P_ASG_69_0_0_23_5,thisval);
}

on envVar P_ASG_69_0_0_23_5_9
{
	byte bitval;
	//thisval steht hier fuer den bitfield-wert, 
	//aus Generierungsgruenden hier keine einheitliche Bezeichnung moeglich.
	dword thisval; // AdditionalInfo2_1
	bitval= getValue(this);
	thisval = getValue(P_ASG_69_0_0_23_5);
	thisval = thisval&~(1<<9)|(bitval<<9);
	putValue(P_ASG_69_0_0_23_5,thisval);
}

on envVar P_ASG_69_0_0_23_5_10
{
	byte bitval;
	//thisval steht hier fuer den bitfield-wert, 
	//aus Generierungsgruenden hier keine einheitliche Bezeichnung moeglich.
	dword thisval; // AdditionalInfo2_1
	bitval= getValue(this);
	thisval = getValue(P_ASG_69_0_0_23_5);
	thisval = thisval&~(1<<10)|(bitval<<10);
	putValue(P_ASG_69_0_0_23_5,thisval);
}

on envVar P_ASG_69_0_0_23_5_11
{
	byte bitval;
	//thisval steht hier fuer den bitfield-wert, 
	//aus Generierungsgruenden hier keine einheitliche Bezeichnung moeglich.
	dword thisval; // AdditionalInfo2_1
	bitval= getValue(this);
	thisval = getValue(P_ASG_69_0_0_23_5);
	thisval = thisval&~(1<<11)|(bitval<<11);
	putValue(P_ASG_69_0_0_23_5,thisval);
}

on envVar P_ASG_69_0_0_23_5_12
{
	byte bitval;
	//thisval steht hier fuer den bitfield-wert, 
	//aus Generierungsgruenden hier keine einheitliche Bezeichnung moeglich.
	dword thisval; // AdditionalInfo2_1
	bitval= getValue(this);
	thisval = getValue(P_ASG_69_0_0_23_5);
	thisval = thisval&~(1<<12)|(bitval<<12);
	putValue(P_ASG_69_0_0_23_5,thisval);
}

on envVar P_ASG_69_0_0_23_5_13
{
	byte bitval;
	//thisval steht hier fuer den bitfield-wert, 
	//aus Generierungsgruenden hier keine einheitliche Bezeichnung moeglich.
	dword thisval; // AdditionalInfo2_1
	bitval= getValue(this);
	thisval = getValue(P_ASG_69_0_0_23_5);
	thisval = thisval&~(1<<13)|(bitval<<13);
	putValue(P_ASG_69_0_0_23_5,thisval);
}

on envVar P_ASG_69_0_0_23_5_14
{
	byte bitval;
	//thisval steht hier fuer den bitfield-wert, 
	//aus Generierungsgruenden hier keine einheitliche Bezeichnung moeglich.
	dword thisval; // AdditionalInfo2_1
	bitval= getValue(this);
	thisval = getValue(P_ASG_69_0_0_23_5);
	thisval = thisval&~(1<<14)|(bitval<<14);
	putValue(P_ASG_69_0_0_23_5,thisval);
}

on envVar P_ASG_69_0_0_23_5_15
{
	byte bitval;
	//thisval steht hier fuer den bitfield-wert, 
	//aus Generierungsgruenden hier keine einheitliche Bezeichnung moeglich.
	dword thisval; // AdditionalInfo2_1
	bitval= getValue(this);
	thisval = getValue(P_ASG_69_0_0_23_5);
	thisval = thisval&~(1<<15)|(bitval<<15);
	putValue(P_ASG_69_0_0_23_5,thisval);
}

on envVar P_ASG_69_0_0_23_5_16
{
	byte bitval;
	//thisval steht hier fuer den bitfield-wert, 
	//aus Generierungsgruenden hier keine einheitliche Bezeichnung moeglich.
	dword thisval; // AdditionalInfo2_1
	bitval= getValue(this);
	thisval = getValue(P_ASG_69_0_0_23_5);
	thisval = thisval&~(1<<16)|(bitval<<16);
	putValue(P_ASG_69_0_0_23_5,thisval);
}

on envVar P_ASG_69_0_0_23_5_17
{
	byte bitval;
	//thisval steht hier fuer den bitfield-wert, 
	//aus Generierungsgruenden hier keine einheitliche Bezeichnung moeglich.
	dword thisval; // AdditionalInfo2_1
	bitval= getValue(this);
	thisval = getValue(P_ASG_69_0_0_23_5);
	thisval = thisval&~(1<<17)|(bitval<<17);
	putValue(P_ASG_69_0_0_23_5,thisval);
}

on envVar P_ASG_69_0_0_23_5_18
{
	byte bitval;
	//thisval steht hier fuer den bitfield-wert, 
	//aus Generierungsgruenden hier keine einheitliche Bezeichnung moeglich.
	dword thisval; // AdditionalInfo2_1
	bitval= getValue(this);
	thisval = getValue(P_ASG_69_0_0_23_5);
	thisval = thisval&~(1<<18)|(bitval<<18);
	putValue(P_ASG_69_0_0_23_5,thisval);
}

on envVar P_ASG_69_0_0_23_5_19
{
	byte bitval;
	//thisval steht hier fuer den bitfield-wert, 
	//aus Generierungsgruenden hier keine einheitliche Bezeichnung moeglich.
	dword thisval; // AdditionalInfo2_1
	bitval= getValue(this);
	thisval = getValue(P_ASG_69_0_0_23_5);
	thisval = thisval&~(1<<19)|(bitval<<19);
	putValue(P_ASG_69_0_0_23_5,thisval);
}

on envVar P_ASG_69_0_0_23_5_20
{
	byte bitval;
	//thisval steht hier fuer den bitfield-wert, 
	//aus Generierungsgruenden hier keine einheitliche Bezeichnung moeglich.
	dword thisval; // AdditionalInfo2_1
	bitval= getValue(this);
	thisval = getValue(P_ASG_69_0_0_23_5);
	thisval = thisval&~(1<<20)|(bitval<<20);
	putValue(P_ASG_69_0_0_23_5,thisval);
}

on envVar P_ASG_69_0_0_23_5_21
{
	byte bitval;
	//thisval steht hier fuer den bitfield-wert, 
	//aus Generierungsgruenden hier keine einheitliche Bezeichnung moeglich.
	dword thisval; // AdditionalInfo2_1
	bitval= getValue(this);
	thisval = getValue(P_ASG_69_0_0_23_5);
	thisval = thisval&~(1<<21)|(bitval<<21);
	putValue(P_ASG_69_0_0_23_5,thisval);
}

on envVar P_ASG_69_0_0_23_5_22
{
	byte bitval;
	//thisval steht hier fuer den bitfield-wert, 
	//aus Generierungsgruenden hier keine einheitliche Bezeichnung moeglich.
	dword thisval; // AdditionalInfo2_1
	bitval= getValue(this);
	thisval = getValue(P_ASG_69_0_0_23_5);
	thisval = thisval&~(1<<22)|(bitval<<22);
	putValue(P_ASG_69_0_0_23_5,thisval);
}

on envVar P_ASG_69_0_0_23_5_23
{
	byte bitval;
	//thisval steht hier fuer den bitfield-wert, 
	//aus Generierungsgruenden hier keine einheitliche Bezeichnung moeglich.
	dword thisval; // AdditionalInfo2_1
	bitval= getValue(this);
	thisval = getValue(P_ASG_69_0_0_23_5);
	thisval = thisval&~(1<<23)|(bitval<<23);
	putValue(P_ASG_69_0_0_23_5,thisval);
}

on envVar P_ASG_69_0_0_23_5_24
{
	byte bitval;
	//thisval steht hier fuer den bitfield-wert, 
	//aus Generierungsgruenden hier keine einheitliche Bezeichnung moeglich.
	dword thisval; // AdditionalInfo2_1
	bitval= getValue(this);
	thisval = getValue(P_ASG_69_0_0_23_5);
	thisval = thisval&~(1<<24)|(bitval<<24);
	putValue(P_ASG_69_0_0_23_5,thisval);
}

on envVar P_ASG_69_0_0_23_5_25
{
	byte bitval;
	//thisval steht hier fuer den bitfield-wert, 
	//aus Generierungsgruenden hier keine einheitliche Bezeichnung moeglich.
	dword thisval; // AdditionalInfo2_1
	bitval= getValue(this);
	thisval = getValue(P_ASG_69_0_0_23_5);
	thisval = thisval&~(1<<25)|(bitval<<25);
	putValue(P_ASG_69_0_0_23_5,thisval);
}

on envVar P_ASG_69_0_0_23_5_26
{
	byte bitval;
	//thisval steht hier fuer den bitfield-wert, 
	//aus Generierungsgruenden hier keine einheitliche Bezeichnung moeglich.
	dword thisval; // AdditionalInfo2_1
	bitval= getValue(this);
	thisval = getValue(P_ASG_69_0_0_23_5);
	thisval = thisval&~(1<<26)|(bitval<<26);
	putValue(P_ASG_69_0_0_23_5,thisval);
}

on envVar P_ASG_69_0_0_23_5_27
{
	byte bitval;
	//thisval steht hier fuer den bitfield-wert, 
	//aus Generierungsgruenden hier keine einheitliche Bezeichnung moeglich.
	dword thisval; // AdditionalInfo2_1
	bitval= getValue(this);
	thisval = getValue(P_ASG_69_0_0_23_5);
	thisval = thisval&~(1<<27)|(bitval<<27);
	putValue(P_ASG_69_0_0_23_5,thisval);
}

on envVar P_ASG_69_0_0_23_5_28
{
	byte bitval;
	//thisval steht hier fuer den bitfield-wert, 
	//aus Generierungsgruenden hier keine einheitliche Bezeichnung moeglich.
	dword thisval; // AdditionalInfo2_1
	bitval= getValue(this);
	thisval = getValue(P_ASG_69_0_0_23_5);
	thisval = thisval&~(1<<28)|(bitval<<28);
	putValue(P_ASG_69_0_0_23_5,thisval);
}

on envVar P_ASG_69_0_0_23_5_29
{
	byte bitval;
	//thisval steht hier fuer den bitfield-wert, 
	//aus Generierungsgruenden hier keine einheitliche Bezeichnung moeglich.
	dword thisval; // AdditionalInfo2_1
	bitval= getValue(this);
	thisval = getValue(P_ASG_69_0_0_23_5);
	thisval = thisval&~(1<<29)|(bitval<<29);
	putValue(P_ASG_69_0_0_23_5,thisval);
}

on envVar P_ASG_69_0_0_23_5_30
{
	byte bitval;
	//thisval steht hier fuer den bitfield-wert, 
	//aus Generierungsgruenden hier keine einheitliche Bezeichnung moeglich.
	dword thisval; // AdditionalInfo2_1
	bitval= getValue(this);
	thisval = getValue(P_ASG_69_0_0_23_5);
	thisval = thisval&~(1<<30)|(bitval<<30);
	putValue(P_ASG_69_0_0_23_5,thisval);
}

on envVar P_ASG_69_0_0_23_5_31
{
	byte bitval;
	//thisval steht hier fuer den bitfield-wert, 
	//aus Generierungsgruenden hier keine einheitliche Bezeichnung moeglich.
	dword thisval; // AdditionalInfo2_1
	bitval= getValue(this);
	thisval = getValue(P_ASG_69_0_0_23_5);
	thisval = thisval&~(1<<31)|(bitval<<31);
	putValue(P_ASG_69_0_0_23_5,thisval);
}

on envVar P_ASG_69_0_0_23_5 // Display3Setup.AdditionalInfo2_1
{
	P_ASG_69_0_0_23_BuildFct();
}

on envVar P_ASG_69_0_0_23_6_0
{
	byte bitval;
	//thisval steht hier fuer den bitfield-wert, 
	//aus Generierungsgruenden hier keine einheitliche Bezeichnung moeglich.
	dword thisval; // AdditionalInfo2_2
	bitval= getValue(this);
	thisval = getValue(P_ASG_69_0_0_23_6);
	thisval = thisval&~(1<<0)|(bitval<<0);
	putValue(P_ASG_69_0_0_23_6,thisval);
}

on envVar P_ASG_69_0_0_23_6_1
{
	byte bitval;
	//thisval steht hier fuer den bitfield-wert, 
	//aus Generierungsgruenden hier keine einheitliche Bezeichnung moeglich.
	dword thisval; // AdditionalInfo2_2
	bitval= getValue(this);
	thisval = getValue(P_ASG_69_0_0_23_6);
	thisval = thisval&~(1<<1)|(bitval<<1);
	putValue(P_ASG_69_0_0_23_6,thisval);
}

on envVar P_ASG_69_0_0_23_6_2
{
	byte bitval;
	//thisval steht hier fuer den bitfield-wert, 
	//aus Generierungsgruenden hier keine einheitliche Bezeichnung moeglich.
	dword thisval; // AdditionalInfo2_2
	bitval= getValue(this);
	thisval = getValue(P_ASG_69_0_0_23_6);
	thisval = thisval&~(1<<2)|(bitval<<2);
	putValue(P_ASG_69_0_0_23_6,thisval);
}

on envVar P_ASG_69_0_0_23_6_3
{
	byte bitval;
	//thisval steht hier fuer den bitfield-wert, 
	//aus Generierungsgruenden hier keine einheitliche Bezeichnung moeglich.
	dword thisval; // AdditionalInfo2_2
	bitval= getValue(this);
	thisval = getValue(P_ASG_69_0_0_23_6);
	thisval = thisval&~(1<<3)|(bitval<<3);
	putValue(P_ASG_69_0_0_23_6,thisval);
}

on envVar P_ASG_69_0_0_23_6_4
{
	byte bitval;
	//thisval steht hier fuer den bitfield-wert, 
	//aus Generierungsgruenden hier keine einheitliche Bezeichnung moeglich.
	dword thisval; // AdditionalInfo2_2
	bitval= getValue(this);
	thisval = getValue(P_ASG_69_0_0_23_6);
	thisval = thisval&~(1<<4)|(bitval<<4);
	putValue(P_ASG_69_0_0_23_6,thisval);
}

on envVar P_ASG_69_0_0_23_6_5
{
	byte bitval;
	//thisval steht hier fuer den bitfield-wert, 
	//aus Generierungsgruenden hier keine einheitliche Bezeichnung moeglich.
	dword thisval; // AdditionalInfo2_2
	bitval= getValue(this);
	thisval = getValue(P_ASG_69_0_0_23_6);
	thisval = thisval&~(1<<5)|(bitval<<5);
	putValue(P_ASG_69_0_0_23_6,thisval);
}

on envVar P_ASG_69_0_0_23_6_6
{
	byte bitval;
	//thisval steht hier fuer den bitfield-wert, 
	//aus Generierungsgruenden hier keine einheitliche Bezeichnung moeglich.
	dword thisval; // AdditionalInfo2_2
	bitval= getValue(this);
	thisval = getValue(P_ASG_69_0_0_23_6);
	thisval = thisval&~(1<<6)|(bitval<<6);
	putValue(P_ASG_69_0_0_23_6,thisval);
}

on envVar P_ASG_69_0_0_23_6_7
{
	byte bitval;
	//thisval steht hier fuer den bitfield-wert, 
	//aus Generierungsgruenden hier keine einheitliche Bezeichnung moeglich.
	dword thisval; // AdditionalInfo2_2
	bitval= getValue(this);
	thisval = getValue(P_ASG_69_0_0_23_6);
	thisval = thisval&~(1<<7)|(bitval<<7);
	putValue(P_ASG_69_0_0_23_6,thisval);
}

on envVar P_ASG_69_0_0_23_6_8
{
	byte bitval;
	//thisval steht hier fuer den bitfield-wert, 
	//aus Generierungsgruenden hier keine einheitliche Bezeichnung moeglich.
	dword thisval; // AdditionalInfo2_2
	bitval= getValue(this);
	thisval = getValue(P_ASG_69_0_0_23_6);
	thisval = thisval&~(1<<8)|(bitval<<8);
	putValue(P_ASG_69_0_0_23_6,thisval);
}

on envVar P_ASG_69_0_0_23_6_9
{
	byte bitval;
	//thisval steht hier fuer den bitfield-wert, 
	//aus Generierungsgruenden hier keine einheitliche Bezeichnung moeglich.
	dword thisval; // AdditionalInfo2_2
	bitval= getValue(this);
	thisval = getValue(P_ASG_69_0_0_23_6);
	thisval = thisval&~(1<<9)|(bitval<<9);
	putValue(P_ASG_69_0_0_23_6,thisval);
}

on envVar P_ASG_69_0_0_23_6_10
{
	byte bitval;
	//thisval steht hier fuer den bitfield-wert, 
	//aus Generierungsgruenden hier keine einheitliche Bezeichnung moeglich.
	dword thisval; // AdditionalInfo2_2
	bitval= getValue(this);
	thisval = getValue(P_ASG_69_0_0_23_6);
	thisval = thisval&~(1<<10)|(bitval<<10);
	putValue(P_ASG_69_0_0_23_6,thisval);
}

on envVar P_ASG_69_0_0_23_6_11
{
	byte bitval;
	//thisval steht hier fuer den bitfield-wert, 
	//aus Generierungsgruenden hier keine einheitliche Bezeichnung moeglich.
	dword thisval; // AdditionalInfo2_2
	bitval= getValue(this);
	thisval = getValue(P_ASG_69_0_0_23_6);
	thisval = thisval&~(1<<11)|(bitval<<11);
	putValue(P_ASG_69_0_0_23_6,thisval);
}

on envVar P_ASG_69_0_0_23_6_12
{
	byte bitval;
	//thisval steht hier fuer den bitfield-wert, 
	//aus Generierungsgruenden hier keine einheitliche Bezeichnung moeglich.
	dword thisval; // AdditionalInfo2_2
	bitval= getValue(this);
	thisval = getValue(P_ASG_69_0_0_23_6);
	thisval = thisval&~(1<<12)|(bitval<<12);
	putValue(P_ASG_69_0_0_23_6,thisval);
}

on envVar P_ASG_69_0_0_23_6_13
{
	byte bitval;
	//thisval steht hier fuer den bitfield-wert, 
	//aus Generierungsgruenden hier keine einheitliche Bezeichnung moeglich.
	dword thisval; // AdditionalInfo2_2
	bitval= getValue(this);
	thisval = getValue(P_ASG_69_0_0_23_6);
	thisval = thisval&~(1<<13)|(bitval<<13);
	putValue(P_ASG_69_0_0_23_6,thisval);
}

on envVar P_ASG_69_0_0_23_6_14
{
	byte bitval;
	//thisval steht hier fuer den bitfield-wert, 
	//aus Generierungsgruenden hier keine einheitliche Bezeichnung moeglich.
	dword thisval; // AdditionalInfo2_2
	bitval= getValue(this);
	thisval = getValue(P_ASG_69_0_0_23_6);
	thisval = thisval&~(1<<14)|(bitval<<14);
	putValue(P_ASG_69_0_0_23_6,thisval);
}

on envVar P_ASG_69_0_0_23_6_15
{
	byte bitval;
	//thisval steht hier fuer den bitfield-wert, 
	//aus Generierungsgruenden hier keine einheitliche Bezeichnung moeglich.
	dword thisval; // AdditionalInfo2_2
	bitval= getValue(this);
	thisval = getValue(P_ASG_69_0_0_23_6);
	thisval = thisval&~(1<<15)|(bitval<<15);
	putValue(P_ASG_69_0_0_23_6,thisval);
}

on envVar P_ASG_69_0_0_23_6_16
{
	byte bitval;
	//thisval steht hier fuer den bitfield-wert, 
	//aus Generierungsgruenden hier keine einheitliche Bezeichnung moeglich.
	dword thisval; // AdditionalInfo2_2
	bitval= getValue(this);
	thisval = getValue(P_ASG_69_0_0_23_6);
	thisval = thisval&~(1<<16)|(bitval<<16);
	putValue(P_ASG_69_0_0_23_6,thisval);
}

on envVar P_ASG_69_0_0_23_6_17
{
	byte bitval;
	//thisval steht hier fuer den bitfield-wert, 
	//aus Generierungsgruenden hier keine einheitliche Bezeichnung moeglich.
	dword thisval; // AdditionalInfo2_2
	bitval= getValue(this);
	thisval = getValue(P_ASG_69_0_0_23_6);
	thisval = thisval&~(1<<17)|(bitval<<17);
	putValue(P_ASG_69_0_0_23_6,thisval);
}

on envVar P_ASG_69_0_0_23_6_18
{
	byte bitval;
	//thisval steht hier fuer den bitfield-wert, 
	//aus Generierungsgruenden hier keine einheitliche Bezeichnung moeglich.
	dword thisval; // AdditionalInfo2_2
	bitval= getValue(this);
	thisval = getValue(P_ASG_69_0_0_23_6);
	thisval = thisval&~(1<<18)|(bitval<<18);
	putValue(P_ASG_69_0_0_23_6,thisval);
}

on envVar P_ASG_69_0_0_23_6_19
{
	byte bitval;
	//thisval steht hier fuer den bitfield-wert, 
	//aus Generierungsgruenden hier keine einheitliche Bezeichnung moeglich.
	dword thisval; // AdditionalInfo2_2
	bitval= getValue(this);
	thisval = getValue(P_ASG_69_0_0_23_6);
	thisval = thisval&~(1<<19)|(bitval<<19);
	putValue(P_ASG_69_0_0_23_6,thisval);
}

on envVar P_ASG_69_0_0_23_6_20
{
	byte bitval;
	//thisval steht hier fuer den bitfield-wert, 
	//aus Generierungsgruenden hier keine einheitliche Bezeichnung moeglich.
	dword thisval; // AdditionalInfo2_2
	bitval= getValue(this);
	thisval = getValue(P_ASG_69_0_0_23_6);
	thisval = thisval&~(1<<20)|(bitval<<20);
	putValue(P_ASG_69_0_0_23_6,thisval);
}

on envVar P_ASG_69_0_0_23_6_21
{
	byte bitval;
	//thisval steht hier fuer den bitfield-wert, 
	//aus Generierungsgruenden hier keine einheitliche Bezeichnung moeglich.
	dword thisval; // AdditionalInfo2_2
	bitval= getValue(this);
	thisval = getValue(P_ASG_69_0_0_23_6);
	thisval = thisval&~(1<<21)|(bitval<<21);
	putValue(P_ASG_69_0_0_23_6,thisval);
}

on envVar P_ASG_69_0_0_23_6_22
{
	byte bitval;
	//thisval steht hier fuer den bitfield-wert, 
	//aus Generierungsgruenden hier keine einheitliche Bezeichnung moeglich.
	dword thisval; // AdditionalInfo2_2
	bitval= getValue(this);
	thisval = getValue(P_ASG_69_0_0_23_6);
	thisval = thisval&~(1<<22)|(bitval<<22);
	putValue(P_ASG_69_0_0_23_6,thisval);
}

on envVar P_ASG_69_0_0_23_6_23
{
	byte bitval;
	//thisval steht hier fuer den bitfield-wert, 
	//aus Generierungsgruenden hier keine einheitliche Bezeichnung moeglich.
	dword thisval; // AdditionalInfo2_2
	bitval= getValue(this);
	thisval = getValue(P_ASG_69_0_0_23_6);
	thisval = thisval&~(1<<23)|(bitval<<23);
	putValue(P_ASG_69_0_0_23_6,thisval);
}

on envVar P_ASG_69_0_0_23_6_24
{
	byte bitval;
	//thisval steht hier fuer den bitfield-wert, 
	//aus Generierungsgruenden hier keine einheitliche Bezeichnung moeglich.
	dword thisval; // AdditionalInfo2_2
	bitval= getValue(this);
	thisval = getValue(P_ASG_69_0_0_23_6);
	thisval = thisval&~(1<<24)|(bitval<<24);
	putValue(P_ASG_69_0_0_23_6,thisval);
}

on envVar P_ASG_69_0_0_23_6_25
{
	byte bitval;
	//thisval steht hier fuer den bitfield-wert, 
	//aus Generierungsgruenden hier keine einheitliche Bezeichnung moeglich.
	dword thisval; // AdditionalInfo2_2
	bitval= getValue(this);
	thisval = getValue(P_ASG_69_0_0_23_6);
	thisval = thisval&~(1<<25)|(bitval<<25);
	putValue(P_ASG_69_0_0_23_6,thisval);
}

on envVar P_ASG_69_0_0_23_6_26
{
	byte bitval;
	//thisval steht hier fuer den bitfield-wert, 
	//aus Generierungsgruenden hier keine einheitliche Bezeichnung moeglich.
	dword thisval; // AdditionalInfo2_2
	bitval= getValue(this);
	thisval = getValue(P_ASG_69_0_0_23_6);
	thisval = thisval&~(1<<26)|(bitval<<26);
	putValue(P_ASG_69_0_0_23_6,thisval);
}

on envVar P_ASG_69_0_0_23_6_27
{
	byte bitval;
	//thisval steht hier fuer den bitfield-wert, 
	//aus Generierungsgruenden hier keine einheitliche Bezeichnung moeglich.
	dword thisval; // AdditionalInfo2_2
	bitval= getValue(this);
	thisval = getValue(P_ASG_69_0_0_23_6);
	thisval = thisval&~(1<<27)|(bitval<<27);
	putValue(P_ASG_69_0_0_23_6,thisval);
}

on envVar P_ASG_69_0_0_23_6_28
{
	byte bitval;
	//thisval steht hier fuer den bitfield-wert, 
	//aus Generierungsgruenden hier keine einheitliche Bezeichnung moeglich.
	dword thisval; // AdditionalInfo2_2
	bitval= getValue(this);
	thisval = getValue(P_ASG_69_0_0_23_6);
	thisval = thisval&~(1<<28)|(bitval<<28);
	putValue(P_ASG_69_0_0_23_6,thisval);
}

on envVar P_ASG_69_0_0_23_6_29
{
	byte bitval;
	//thisval steht hier fuer den bitfield-wert, 
	//aus Generierungsgruenden hier keine einheitliche Bezeichnung moeglich.
	dword thisval; // AdditionalInfo2_2
	bitval= getValue(this);
	thisval = getValue(P_ASG_69_0_0_23_6);
	thisval = thisval&~(1<<29)|(bitval<<29);
	putValue(P_ASG_69_0_0_23_6,thisval);
}

on envVar P_ASG_69_0_0_23_6 // Display3Setup.AdditionalInfo2_2
{
	P_ASG_69_0_0_23_BuildFct();
}

on envVar P_ASG_69_0_0_24Get_BTN
{
 if (P_ASG_69_0_0_24Get_BTN_already_pressed == 0)
  {
       putValue(P_ASG_69_0_0_24_ErrCode,0);
       SetControlBackColor(panel_name,"errField_P_ASG_69_0_0_24",MakeRGB(255,255,255));
       P_ASG_69_0_0_24Get_BTN_already_pressed = 1;
 }
 else
 {
       Request_Void(LSGID, P_ASG_69_0_0_24_ID, DataGet_REQ); 
       P_ASG_69_0_0_24Get_BTN_already_pressed = 0;
 }
}
on envVar P_ASG_69_0_0_24SetGet_BTN
{
	byte BAPTemp[5];
    if (P_ASG_69_0_0_24SetGet_BTN_already_pressed == 0)
    {
       putValue(P_ASG_69_0_0_24_ErrCode,0);
       SetControlBackColor(panel_name,"errField_P_ASG_69_0_0_24",MakeRGB(255,255,255));
       P_ASG_69_0_0_24SetGet_BTN_already_pressed = 1;
    }
    else
    {
       getValue(P_ASG_69_0_0_24, BAPTemp);
       Request_ByteSequence(LSGID, P_ASG_69_0_0_24_ID, DataSetGet_REQ, BAPTemp, getValueSize(P_ASG_69_0_0_24));
       P_ASG_69_0_0_24SetGet_BTN_already_pressed = 0;
    }
}
on envVar P_ASG_69_0_0_24 // bus value of Display3MainSelection (24).
{
	// opcodes: Error-Status
	dword param1; // MainSelection
	byte param2; // Extension1
	byte param3; // Extension2
	// DATATYPE_BYTESEQUENCE / DATATYPE_FIXEDBYTESEQUENCE
	int i;
	byte superval[5];
	int currentPos;
	currentPos = 0;
	for( i = 0; i < 5; i++ ) {
		superval[i] = 0;
	}
	getValue(P_ASG_69_0_0_24, superval);
	///////// Start param1 - UINT32 /////////
	param1 = superval[currentPos++]|(superval[currentPos++]<<8)|(superval[currentPos++]<<16)|(superval[currentPos++]<<24);
	putValue(P_ASG_69_0_0_24_1, param1);
	///////// Start param2 - NIBBLE /////////
	param2 = (superval[currentPos] & 0xf0)>>4;
	putValue(P_ASG_69_0_0_24_2, round((param2 * 1.0) - (0) + (0), 1.0));
	///////// Start param3 - NIBBLE /////////
	param3 = superval[currentPos++] & 0x0f;
	putValue(P_ASG_69_0_0_24_3, round((param3 * 1.0) - (0) + (0), 1.0));
}

on envVar P_ASG_69_0_0_24_1_0
{
	byte bitval;
	//thisval steht hier fuer den bitfield-wert, 
	//aus Generierungsgruenden hier keine einheitliche Bezeichnung moeglich.
	dword thisval; // MainSelection
	bitval= getValue(this);
	thisval = getValue(P_ASG_69_0_0_24_1);
	thisval = thisval&~(1<<0)|(bitval<<0);
	putValue(P_ASG_69_0_0_24_1,thisval);
}

on envVar P_ASG_69_0_0_24_1_1
{
	byte bitval;
	//thisval steht hier fuer den bitfield-wert, 
	//aus Generierungsgruenden hier keine einheitliche Bezeichnung moeglich.
	dword thisval; // MainSelection
	bitval= getValue(this);
	thisval = getValue(P_ASG_69_0_0_24_1);
	thisval = thisval&~(1<<1)|(bitval<<1);
	putValue(P_ASG_69_0_0_24_1,thisval);
}

on envVar P_ASG_69_0_0_24_1_2
{
	byte bitval;
	//thisval steht hier fuer den bitfield-wert, 
	//aus Generierungsgruenden hier keine einheitliche Bezeichnung moeglich.
	dword thisval; // MainSelection
	bitval= getValue(this);
	thisval = getValue(P_ASG_69_0_0_24_1);
	thisval = thisval&~(1<<2)|(bitval<<2);
	putValue(P_ASG_69_0_0_24_1,thisval);
}

on envVar P_ASG_69_0_0_24_1_3
{
	byte bitval;
	//thisval steht hier fuer den bitfield-wert, 
	//aus Generierungsgruenden hier keine einheitliche Bezeichnung moeglich.
	dword thisval; // MainSelection
	bitval= getValue(this);
	thisval = getValue(P_ASG_69_0_0_24_1);
	thisval = thisval&~(1<<3)|(bitval<<3);
	putValue(P_ASG_69_0_0_24_1,thisval);
}

on envVar P_ASG_69_0_0_24_1_4
{
	byte bitval;
	//thisval steht hier fuer den bitfield-wert, 
	//aus Generierungsgruenden hier keine einheitliche Bezeichnung moeglich.
	dword thisval; // MainSelection
	bitval= getValue(this);
	thisval = getValue(P_ASG_69_0_0_24_1);
	thisval = thisval&~(1<<4)|(bitval<<4);
	putValue(P_ASG_69_0_0_24_1,thisval);
}

on envVar P_ASG_69_0_0_24_1_5
{
	byte bitval;
	//thisval steht hier fuer den bitfield-wert, 
	//aus Generierungsgruenden hier keine einheitliche Bezeichnung moeglich.
	dword thisval; // MainSelection
	bitval= getValue(this);
	thisval = getValue(P_ASG_69_0_0_24_1);
	thisval = thisval&~(1<<5)|(bitval<<5);
	putValue(P_ASG_69_0_0_24_1,thisval);
}

on envVar P_ASG_69_0_0_24_1_6
{
	byte bitval;
	//thisval steht hier fuer den bitfield-wert, 
	//aus Generierungsgruenden hier keine einheitliche Bezeichnung moeglich.
	dword thisval; // MainSelection
	bitval= getValue(this);
	thisval = getValue(P_ASG_69_0_0_24_1);
	thisval = thisval&~(1<<6)|(bitval<<6);
	putValue(P_ASG_69_0_0_24_1,thisval);
}

on envVar P_ASG_69_0_0_24_1_7
{
	byte bitval;
	//thisval steht hier fuer den bitfield-wert, 
	//aus Generierungsgruenden hier keine einheitliche Bezeichnung moeglich.
	dword thisval; // MainSelection
	bitval= getValue(this);
	thisval = getValue(P_ASG_69_0_0_24_1);
	thisval = thisval&~(1<<7)|(bitval<<7);
	putValue(P_ASG_69_0_0_24_1,thisval);
}

on envVar P_ASG_69_0_0_24_1_8
{
	byte bitval;
	//thisval steht hier fuer den bitfield-wert, 
	//aus Generierungsgruenden hier keine einheitliche Bezeichnung moeglich.
	dword thisval; // MainSelection
	bitval= getValue(this);
	thisval = getValue(P_ASG_69_0_0_24_1);
	thisval = thisval&~(1<<8)|(bitval<<8);
	putValue(P_ASG_69_0_0_24_1,thisval);
}

on envVar P_ASG_69_0_0_24_1_9
{
	byte bitval;
	//thisval steht hier fuer den bitfield-wert, 
	//aus Generierungsgruenden hier keine einheitliche Bezeichnung moeglich.
	dword thisval; // MainSelection
	bitval= getValue(this);
	thisval = getValue(P_ASG_69_0_0_24_1);
	thisval = thisval&~(1<<9)|(bitval<<9);
	putValue(P_ASG_69_0_0_24_1,thisval);
}

on envVar P_ASG_69_0_0_24_1_10
{
	byte bitval;
	//thisval steht hier fuer den bitfield-wert, 
	//aus Generierungsgruenden hier keine einheitliche Bezeichnung moeglich.
	dword thisval; // MainSelection
	bitval= getValue(this);
	thisval = getValue(P_ASG_69_0_0_24_1);
	thisval = thisval&~(1<<10)|(bitval<<10);
	putValue(P_ASG_69_0_0_24_1,thisval);
}

on envVar P_ASG_69_0_0_24_1_11
{
	byte bitval;
	//thisval steht hier fuer den bitfield-wert, 
	//aus Generierungsgruenden hier keine einheitliche Bezeichnung moeglich.
	dword thisval; // MainSelection
	bitval= getValue(this);
	thisval = getValue(P_ASG_69_0_0_24_1);
	thisval = thisval&~(1<<11)|(bitval<<11);
	putValue(P_ASG_69_0_0_24_1,thisval);
}

on envVar P_ASG_69_0_0_24_1_12
{
	byte bitval;
	//thisval steht hier fuer den bitfield-wert, 
	//aus Generierungsgruenden hier keine einheitliche Bezeichnung moeglich.
	dword thisval; // MainSelection
	bitval= getValue(this);
	thisval = getValue(P_ASG_69_0_0_24_1);
	thisval = thisval&~(1<<12)|(bitval<<12);
	putValue(P_ASG_69_0_0_24_1,thisval);
}

on envVar P_ASG_69_0_0_24_1_13
{
	byte bitval;
	//thisval steht hier fuer den bitfield-wert, 
	//aus Generierungsgruenden hier keine einheitliche Bezeichnung moeglich.
	dword thisval; // MainSelection
	bitval= getValue(this);
	thisval = getValue(P_ASG_69_0_0_24_1);
	thisval = thisval&~(1<<13)|(bitval<<13);
	putValue(P_ASG_69_0_0_24_1,thisval);
}

on envVar P_ASG_69_0_0_24_1_14
{
	byte bitval;
	//thisval steht hier fuer den bitfield-wert, 
	//aus Generierungsgruenden hier keine einheitliche Bezeichnung moeglich.
	dword thisval; // MainSelection
	bitval= getValue(this);
	thisval = getValue(P_ASG_69_0_0_24_1);
	thisval = thisval&~(1<<14)|(bitval<<14);
	putValue(P_ASG_69_0_0_24_1,thisval);
}

on envVar P_ASG_69_0_0_24_1_15
{
	byte bitval;
	//thisval steht hier fuer den bitfield-wert, 
	//aus Generierungsgruenden hier keine einheitliche Bezeichnung moeglich.
	dword thisval; // MainSelection
	bitval= getValue(this);
	thisval = getValue(P_ASG_69_0_0_24_1);
	thisval = thisval&~(1<<15)|(bitval<<15);
	putValue(P_ASG_69_0_0_24_1,thisval);
}

on envVar P_ASG_69_0_0_24_1_16
{
	byte bitval;
	//thisval steht hier fuer den bitfield-wert, 
	//aus Generierungsgruenden hier keine einheitliche Bezeichnung moeglich.
	dword thisval; // MainSelection
	bitval= getValue(this);
	thisval = getValue(P_ASG_69_0_0_24_1);
	thisval = thisval&~(1<<16)|(bitval<<16);
	putValue(P_ASG_69_0_0_24_1,thisval);
}

on envVar P_ASG_69_0_0_24_1_17
{
	byte bitval;
	//thisval steht hier fuer den bitfield-wert, 
	//aus Generierungsgruenden hier keine einheitliche Bezeichnung moeglich.
	dword thisval; // MainSelection
	bitval= getValue(this);
	thisval = getValue(P_ASG_69_0_0_24_1);
	thisval = thisval&~(1<<17)|(bitval<<17);
	putValue(P_ASG_69_0_0_24_1,thisval);
}

on envVar P_ASG_69_0_0_24_1_18
{
	byte bitval;
	//thisval steht hier fuer den bitfield-wert, 
	//aus Generierungsgruenden hier keine einheitliche Bezeichnung moeglich.
	dword thisval; // MainSelection
	bitval= getValue(this);
	thisval = getValue(P_ASG_69_0_0_24_1);
	thisval = thisval&~(1<<18)|(bitval<<18);
	putValue(P_ASG_69_0_0_24_1,thisval);
}

on envVar P_ASG_69_0_0_24_1_19
{
	byte bitval;
	//thisval steht hier fuer den bitfield-wert, 
	//aus Generierungsgruenden hier keine einheitliche Bezeichnung moeglich.
	dword thisval; // MainSelection
	bitval= getValue(this);
	thisval = getValue(P_ASG_69_0_0_24_1);
	thisval = thisval&~(1<<19)|(bitval<<19);
	putValue(P_ASG_69_0_0_24_1,thisval);
}

on envVar P_ASG_69_0_0_24_1_20
{
	byte bitval;
	//thisval steht hier fuer den bitfield-wert, 
	//aus Generierungsgruenden hier keine einheitliche Bezeichnung moeglich.
	dword thisval; // MainSelection
	bitval= getValue(this);
	thisval = getValue(P_ASG_69_0_0_24_1);
	thisval = thisval&~(1<<20)|(bitval<<20);
	putValue(P_ASG_69_0_0_24_1,thisval);
}

on envVar P_ASG_69_0_0_24_1_21
{
	byte bitval;
	//thisval steht hier fuer den bitfield-wert, 
	//aus Generierungsgruenden hier keine einheitliche Bezeichnung moeglich.
	dword thisval; // MainSelection
	bitval= getValue(this);
	thisval = getValue(P_ASG_69_0_0_24_1);
	thisval = thisval&~(1<<21)|(bitval<<21);
	putValue(P_ASG_69_0_0_24_1,thisval);
}

on envVar P_ASG_69_0_0_24_1_22
{
	byte bitval;
	//thisval steht hier fuer den bitfield-wert, 
	//aus Generierungsgruenden hier keine einheitliche Bezeichnung moeglich.
	dword thisval; // MainSelection
	bitval= getValue(this);
	thisval = getValue(P_ASG_69_0_0_24_1);
	thisval = thisval&~(1<<22)|(bitval<<22);
	putValue(P_ASG_69_0_0_24_1,thisval);
}

on envVar P_ASG_69_0_0_24_1_23
{
	byte bitval;
	//thisval steht hier fuer den bitfield-wert, 
	//aus Generierungsgruenden hier keine einheitliche Bezeichnung moeglich.
	dword thisval; // MainSelection
	bitval= getValue(this);
	thisval = getValue(P_ASG_69_0_0_24_1);
	thisval = thisval&~(1<<23)|(bitval<<23);
	putValue(P_ASG_69_0_0_24_1,thisval);
}

on envVar P_ASG_69_0_0_24_1_24
{
	byte bitval;
	//thisval steht hier fuer den bitfield-wert, 
	//aus Generierungsgruenden hier keine einheitliche Bezeichnung moeglich.
	dword thisval; // MainSelection
	bitval= getValue(this);
	thisval = getValue(P_ASG_69_0_0_24_1);
	thisval = thisval&~(1<<24)|(bitval<<24);
	putValue(P_ASG_69_0_0_24_1,thisval);
}

on envVar P_ASG_69_0_0_24_1_25
{
	byte bitval;
	//thisval steht hier fuer den bitfield-wert, 
	//aus Generierungsgruenden hier keine einheitliche Bezeichnung moeglich.
	dword thisval; // MainSelection
	bitval= getValue(this);
	thisval = getValue(P_ASG_69_0_0_24_1);
	thisval = thisval&~(1<<25)|(bitval<<25);
	putValue(P_ASG_69_0_0_24_1,thisval);
}

on envVar P_ASG_69_0_0_24_1_26
{
	byte bitval;
	//thisval steht hier fuer den bitfield-wert, 
	//aus Generierungsgruenden hier keine einheitliche Bezeichnung moeglich.
	dword thisval; // MainSelection
	bitval= getValue(this);
	thisval = getValue(P_ASG_69_0_0_24_1);
	thisval = thisval&~(1<<26)|(bitval<<26);
	putValue(P_ASG_69_0_0_24_1,thisval);
}

on envVar P_ASG_69_0_0_24_1_27
{
	byte bitval;
	//thisval steht hier fuer den bitfield-wert, 
	//aus Generierungsgruenden hier keine einheitliche Bezeichnung moeglich.
	dword thisval; // MainSelection
	bitval= getValue(this);
	thisval = getValue(P_ASG_69_0_0_24_1);
	thisval = thisval&~(1<<27)|(bitval<<27);
	putValue(P_ASG_69_0_0_24_1,thisval);
}

on envVar P_ASG_69_0_0_24_1_28
{
	byte bitval;
	//thisval steht hier fuer den bitfield-wert, 
	//aus Generierungsgruenden hier keine einheitliche Bezeichnung moeglich.
	dword thisval; // MainSelection
	bitval= getValue(this);
	thisval = getValue(P_ASG_69_0_0_24_1);
	thisval = thisval&~(1<<28)|(bitval<<28);
	putValue(P_ASG_69_0_0_24_1,thisval);
}

on envVar P_ASG_69_0_0_24_1_29
{
	byte bitval;
	//thisval steht hier fuer den bitfield-wert, 
	//aus Generierungsgruenden hier keine einheitliche Bezeichnung moeglich.
	dword thisval; // MainSelection
	bitval= getValue(this);
	thisval = getValue(P_ASG_69_0_0_24_1);
	thisval = thisval&~(1<<29)|(bitval<<29);
	putValue(P_ASG_69_0_0_24_1,thisval);
}

on envVar P_ASG_69_0_0_24_1 // Display3MainSelection.MainSelection
{
	byte superval[5];

	//Update Childvalue (BitField)
	byte mask=0x01;
	int i = 0;
	dword thisval; // MainSelection
	thisval = getValue(this);
	if(thisval&(mask<<0))
		putValue(P_ASG_69_0_0_24_1_0, 1);
	else
		putValue(P_ASG_69_0_0_24_1_0, 0);
	if(thisval&(mask<<1))
		putValue(P_ASG_69_0_0_24_1_1, 1);
	else
		putValue(P_ASG_69_0_0_24_1_1, 0);
	if(thisval&(mask<<2))
		putValue(P_ASG_69_0_0_24_1_2, 1);
	else
		putValue(P_ASG_69_0_0_24_1_2, 0);
	if(thisval&(mask<<3))
		putValue(P_ASG_69_0_0_24_1_3, 1);
	else
		putValue(P_ASG_69_0_0_24_1_3, 0);
	if(thisval&(mask<<4))
		putValue(P_ASG_69_0_0_24_1_4, 1);
	else
		putValue(P_ASG_69_0_0_24_1_4, 0);
	if(thisval&(mask<<5))
		putValue(P_ASG_69_0_0_24_1_5, 1);
	else
		putValue(P_ASG_69_0_0_24_1_5, 0);
	if(thisval&(mask<<6))
		putValue(P_ASG_69_0_0_24_1_6, 1);
	else
		putValue(P_ASG_69_0_0_24_1_6, 0);
	if(thisval&(mask<<7))
		putValue(P_ASG_69_0_0_24_1_7, 1);
	else
		putValue(P_ASG_69_0_0_24_1_7, 0);
	if(thisval&(mask<<8))
		putValue(P_ASG_69_0_0_24_1_8, 1);
	else
		putValue(P_ASG_69_0_0_24_1_8, 0);
	if(thisval&(mask<<9))
		putValue(P_ASG_69_0_0_24_1_9, 1);
	else
		putValue(P_ASG_69_0_0_24_1_9, 0);
	if(thisval&(mask<<10))
		putValue(P_ASG_69_0_0_24_1_10, 1);
	else
		putValue(P_ASG_69_0_0_24_1_10, 0);
	if(thisval&(mask<<11))
		putValue(P_ASG_69_0_0_24_1_11, 1);
	else
		putValue(P_ASG_69_0_0_24_1_11, 0);
	if(thisval&(mask<<12))
		putValue(P_ASG_69_0_0_24_1_12, 1);
	else
		putValue(P_ASG_69_0_0_24_1_12, 0);
	if(thisval&(mask<<13))
		putValue(P_ASG_69_0_0_24_1_13, 1);
	else
		putValue(P_ASG_69_0_0_24_1_13, 0);
	if(thisval&(mask<<14))
		putValue(P_ASG_69_0_0_24_1_14, 1);
	else
		putValue(P_ASG_69_0_0_24_1_14, 0);
	if(thisval&(mask<<15))
		putValue(P_ASG_69_0_0_24_1_15, 1);
	else
		putValue(P_ASG_69_0_0_24_1_15, 0);
	if(thisval&(mask<<16))
		putValue(P_ASG_69_0_0_24_1_16, 1);
	else
		putValue(P_ASG_69_0_0_24_1_16, 0);
	if(thisval&(mask<<17))
		putValue(P_ASG_69_0_0_24_1_17, 1);
	else
		putValue(P_ASG_69_0_0_24_1_17, 0);
	if(thisval&(mask<<18))
		putValue(P_ASG_69_0_0_24_1_18, 1);
	else
		putValue(P_ASG_69_0_0_24_1_18, 0);
	if(thisval&(mask<<19))
		putValue(P_ASG_69_0_0_24_1_19, 1);
	else
		putValue(P_ASG_69_0_0_24_1_19, 0);
	if(thisval&(mask<<20))
		putValue(P_ASG_69_0_0_24_1_20, 1);
	else
		putValue(P_ASG_69_0_0_24_1_20, 0);
	if(thisval&(mask<<21))
		putValue(P_ASG_69_0_0_24_1_21, 1);
	else
		putValue(P_ASG_69_0_0_24_1_21, 0);
	if(thisval&(mask<<22))
		putValue(P_ASG_69_0_0_24_1_22, 1);
	else
		putValue(P_ASG_69_0_0_24_1_22, 0);
	if(thisval&(mask<<23))
		putValue(P_ASG_69_0_0_24_1_23, 1);
	else
		putValue(P_ASG_69_0_0_24_1_23, 0);
	if(thisval&(mask<<24))
		putValue(P_ASG_69_0_0_24_1_24, 1);
	else
		putValue(P_ASG_69_0_0_24_1_24, 0);
	if(thisval&(mask<<25))
		putValue(P_ASG_69_0_0_24_1_25, 1);
	else
		putValue(P_ASG_69_0_0_24_1_25, 0);
	if(thisval&(mask<<26))
		putValue(P_ASG_69_0_0_24_1_26, 1);
	else
		putValue(P_ASG_69_0_0_24_1_26, 0);
	if(thisval&(mask<<27))
		putValue(P_ASG_69_0_0_24_1_27, 1);
	else
		putValue(P_ASG_69_0_0_24_1_27, 0);
	if(thisval&(mask<<28))
		putValue(P_ASG_69_0_0_24_1_28, 1);
	else
		putValue(P_ASG_69_0_0_24_1_28, 0);
	if(thisval&(mask<<29))
		putValue(P_ASG_69_0_0_24_1_29, 1);
	else
		putValue(P_ASG_69_0_0_24_1_29, 0);

    // Update superval
	getValue(P_ASG_69_0_0_24, superval);
	superval[0]= thisval&0x000000ff;
	superval[1]=(thisval&0x0000ff00)>>8;
	superval[2]=(thisval&0x00ff0000)>>16;
	superval[3]=(thisval&0xff000000)>>24;
	putValue(P_ASG_69_0_0_24,superval);
}

// Ueberwachung der Darstellungsvariable der Range.
on envVar P_ASG_69_0_0_24_2_range // Display3MainSelection.Extension1 
{
	@P_ASG_69_0_0_24_2 = @P_ASG_69_0_0_24_2_range - (0); // slider = range - min
}

on envVar P_ASG_69_0_0_24_2 // Display3MainSelection.Extension1
{
	byte superval[5];

	//Update Childvalue (Number)
	byte thisval; // Extension1
	float slider_value;

	slider_value = 0; // Konstanter Parameter.
	@P_ASG_69_0_0_24_2_range = slider_value + (0); // real value := slider value + range min.
	thisval = (byte)round((slider_value + (0) - (0)) / (1.0), 1); // bus value := (slider value + min - offset) / step.

    // Update superval
	getValue(P_ASG_69_0_0_24, superval);
	superval[4]= superval[4]&0x0f;
	superval[4]= superval[4]|(thisval<<4);
	putValue(P_ASG_69_0_0_24,superval);
}

// Ueberwachung der Darstellungsvariable der Range.
on envVar P_ASG_69_0_0_24_3_range // Display3MainSelection.Extension2 
{
	@P_ASG_69_0_0_24_3 = @P_ASG_69_0_0_24_3_range - (0); // slider = range - min
}

on envVar P_ASG_69_0_0_24_3 // Display3MainSelection.Extension2
{
	byte superval[5];

	//Update Childvalue (Number)
	byte thisval; // Extension2
	float slider_value;

	slider_value = 0; // Konstanter Parameter.
	@P_ASG_69_0_0_24_3_range = slider_value + (0); // real value := slider value + range min.
	thisval = (byte)round((slider_value + (0) - (0)) / (1.0), 1); // bus value := (slider value + min - offset) / step.

    // Update superval
	getValue(P_ASG_69_0_0_24, superval);
	superval[4]= superval[4]&0xf0;
	superval[4]= superval[4]|thisval;
	putValue(P_ASG_69_0_0_24,superval);
}

on envVar P_ASG_69_0_0_25Get_BTN
{
 if (P_ASG_69_0_0_25Get_BTN_already_pressed == 0)
  {
       putValue(P_ASG_69_0_0_25_ErrCode,0);
       SetControlBackColor(panel_name,"errField_P_ASG_69_0_0_25",MakeRGB(255,255,255));
       P_ASG_69_0_0_25Get_BTN_already_pressed = 1;
 }
 else
 {
       Request_Void(LSGID, P_ASG_69_0_0_25_ID, DataGet_REQ); 
       P_ASG_69_0_0_25Get_BTN_already_pressed = 0;
 }
}
on envVar P_ASG_69_0_0_25SetGet_BTN
{
	byte BAPTemp[3];
    if (P_ASG_69_0_0_25SetGet_BTN_already_pressed == 0)
    {
       putValue(P_ASG_69_0_0_25_ErrCode,0);
       SetControlBackColor(panel_name,"errField_P_ASG_69_0_0_25",MakeRGB(255,255,255));
       P_ASG_69_0_0_25SetGet_BTN_already_pressed = 1;
    }
    else
    {
       getValue(P_ASG_69_0_0_25, BAPTemp);
       Request_ByteSequence(LSGID, P_ASG_69_0_0_25_ID, DataSetGet_REQ, BAPTemp, getValueSize(P_ASG_69_0_0_25));
       P_ASG_69_0_0_25SetGet_BTN_already_pressed = 0;
    }
}
on envVar P_ASG_69_0_0_25 // bus value of AdditionalInstrument (25).
{
	// opcodes: Error-Status
	byte param1; // Setup
	byte param2; // Brightness
	byte param3; // ModificationReason
	byte param4; // ModificationState
	// DATATYPE_BYTESEQUENCE / DATATYPE_FIXEDBYTESEQUENCE
	int i;
	byte superval[3];
	int currentPos;
	currentPos = 0;
	for( i = 0; i < 3; i++ ) {
		superval[i] = 0;
	}
	getValue(P_ASG_69_0_0_25, superval);
	///////// Start param1 - UINT8 /////////
	param1 = superval[currentPos++];
	putValue(P_ASG_69_0_0_25_1, param1);
	///////// Start param2 - UINT8 /////////
	param2 = superval[currentPos++];
	putValue(P_ASG_69_0_0_25_2, round((param2 * 1.0) - (0) + (0), 1.0));
	///////// Start param3 - NIBBLE /////////
	param3 = (superval[currentPos] & 0xf0)>>4;
	putValue(P_ASG_69_0_0_25_3, param3);
	///////// Start param4 - NIBBLE /////////
	param4 = superval[currentPos++] & 0x0f;
	putValue(P_ASG_69_0_0_25_4, param4);
}

on envVar P_ASG_69_0_0_25_1_0
{
	byte bitval;
	//thisval steht hier fuer den bitfield-wert, 
	//aus Generierungsgruenden hier keine einheitliche Bezeichnung moeglich.
	byte thisval; // Setup
	bitval= getValue(this);
	thisval = getValue(P_ASG_69_0_0_25_1);
	thisval = thisval&~(1<<0)|(bitval<<0);
	putValue(P_ASG_69_0_0_25_1,thisval);
}

on envVar P_ASG_69_0_0_25_1_1
{
	byte bitval;
	//thisval steht hier fuer den bitfield-wert, 
	//aus Generierungsgruenden hier keine einheitliche Bezeichnung moeglich.
	byte thisval; // Setup
	bitval= getValue(this);
	thisval = getValue(P_ASG_69_0_0_25_1);
	thisval = thisval&~(1<<1)|(bitval<<1);
	putValue(P_ASG_69_0_0_25_1,thisval);
}

on envVar P_ASG_69_0_0_25_1_2
{
	byte bitval;
	//thisval steht hier fuer den bitfield-wert, 
	//aus Generierungsgruenden hier keine einheitliche Bezeichnung moeglich.
	byte thisval; // Setup
	bitval= getValue(this);
	thisval = getValue(P_ASG_69_0_0_25_1);
	thisval = thisval&~(1<<2)|(bitval<<2);
	putValue(P_ASG_69_0_0_25_1,thisval);
}

on envVar P_ASG_69_0_0_25_1 // AdditionalInstrument.Setup
{
	byte superval[3];

	//Update Childvalue (BitField)
	byte mask=0x01;
	int i = 0;
	byte thisval; // Setup
	thisval = getValue(this);
	if(thisval&(mask<<0))
		putValue(P_ASG_69_0_0_25_1_0, 1);
	else
		putValue(P_ASG_69_0_0_25_1_0, 0);
	if(thisval&(mask<<1))
		putValue(P_ASG_69_0_0_25_1_1, 1);
	else
		putValue(P_ASG_69_0_0_25_1_1, 0);
	if(thisval&(mask<<2))
		putValue(P_ASG_69_0_0_25_1_2, 1);
	else
		putValue(P_ASG_69_0_0_25_1_2, 0);

    // Update superval
	getValue(P_ASG_69_0_0_25, superval);
	superval[0]=thisval;
	putValue(P_ASG_69_0_0_25,superval);
}

// Ueberwachung der Darstellungsvariable der Range.
on envVar P_ASG_69_0_0_25_2_range // AdditionalInstrument.Brightness 
{
	@P_ASG_69_0_0_25_2 = @P_ASG_69_0_0_25_2_range - (0); // slider = range - min
}

on envVar P_ASG_69_0_0_25_2 // AdditionalInstrument.Brightness
{
	byte superval[3];

	//Update Childvalue (Number)
	byte thisval; // Brightness
	float slider_value;

	slider_value = round(@P_ASG_69_0_0_25_2, 1.0);
	@P_ASG_69_0_0_25_2_range = slider_value + (0); // real value := slider value + range min.
	thisval = (byte)round((slider_value + (0) - (0)) / (1.0), 1); // bus value := (slider value + min - offset) / step.

    // Update superval
	getValue(P_ASG_69_0_0_25, superval);
	superval[1]=thisval;
	putValue(P_ASG_69_0_0_25,superval);
}

on envVar P_ASG_69_0_0_25_3 // AdditionalInstrument.ModificationReason
{
	byte superval[3];

	//Update Childvalue (Enum)
	byte thisval; // ModificationReason
	thisval = 0x0f & getValue(this);

    // Update superval
	getValue(P_ASG_69_0_0_25, superval);
	superval[2]= superval[2]&0x0f;
	superval[2]= superval[2]|(thisval<<4);
	putValue(P_ASG_69_0_0_25,superval);
}

on envVar P_ASG_69_0_0_25_4_0
{
	byte bitval;
	//thisval steht hier fuer den bitfield-wert, 
	//aus Generierungsgruenden hier keine einheitliche Bezeichnung moeglich.
	byte thisval; // ModificationState
	bitval= getValue(this);
	thisval = getValue(P_ASG_69_0_0_25_4);
	thisval = thisval&~(1<<0)|(bitval<<0);
	putValue(P_ASG_69_0_0_25_4,thisval);
}

on envVar P_ASG_69_0_0_25_4 // AdditionalInstrument.ModificationState
{
	byte superval[3];

	//Update Childvalue (BitField)
	byte mask=0x01;
	int i = 0;
	byte thisval; // ModificationState
	thisval = getValue(this);
	if(thisval&(mask<<0))
		putValue(P_ASG_69_0_0_25_4_0, 1);
	else
		putValue(P_ASG_69_0_0_25_4_0, 0);

    // Update superval
	getValue(P_ASG_69_0_0_25, superval);
	superval[2]= superval[2]&0xf0;
	superval[2]= superval[2]|thisval;
	putValue(P_ASG_69_0_0_25,superval);
}

on envVar P_ASG_69_0_0_26Get_BTN
{
 if (P_ASG_69_0_0_26Get_BTN_already_pressed == 0)
  {
       putValue(P_ASG_69_0_0_26_ErrCode,0);
       SetControlBackColor(panel_name,"errField_P_ASG_69_0_0_26",MakeRGB(255,255,255));
       P_ASG_69_0_0_26Get_BTN_already_pressed = 1;
 }
 else
 {
       Request_Void(LSGID, P_ASG_69_0_0_26_ID, DataGet_REQ); 
       P_ASG_69_0_0_26Get_BTN_already_pressed = 0;
 }
}
on envVar P_ASG_69_0_0_26SetGet_BTN
{
    if (P_ASG_69_0_0_26SetGet_BTN_already_pressed == 0)
    {
       putValue(P_ASG_69_0_0_26_ErrCode,0);
       SetControlBackColor(panel_name,"errField_P_ASG_69_0_0_26",MakeRGB(255,255,255));
       P_ASG_69_0_0_26SetGet_BTN_already_pressed = 1;
    }
    else
    {
       Request_Int8(LSGID, P_ASG_69_0_0_26_ID, DataSetGet_REQ, getValue(P_ASG_69_0_0_26));
       P_ASG_69_0_0_26SetGet_BTN_already_pressed = 0;
    }
}
on envVar P_ASG_69_0_0_26 // bus value of AdditionalInstrument2 (26).
{
	// opcodes: Error-Status
	byte param1; // Setup
	// DATATYPE_UINTXX
	param1 = getValue(P_ASG_69_0_0_26);
	putValue(P_ASG_69_0_0_26_1, param1);
}

on envVar P_ASG_69_0_0_26_1_0
{
	byte bitval;
	//thisval steht hier fuer den bitfield-wert, 
	//aus Generierungsgruenden hier keine einheitliche Bezeichnung moeglich.
	byte thisval; // Setup
	bitval= getValue(this);
	thisval = getValue(P_ASG_69_0_0_26_1);
	thisval = thisval&~(1<<0)|(bitval<<0);
	putValue(P_ASG_69_0_0_26_1,thisval);
}

on envVar P_ASG_69_0_0_26_1_1
{
	byte bitval;
	//thisval steht hier fuer den bitfield-wert, 
	//aus Generierungsgruenden hier keine einheitliche Bezeichnung moeglich.
	byte thisval; // Setup
	bitval= getValue(this);
	thisval = getValue(P_ASG_69_0_0_26_1);
	thisval = thisval&~(1<<1)|(bitval<<1);
	putValue(P_ASG_69_0_0_26_1,thisval);
}

on envVar P_ASG_69_0_0_26_1_2
{
	byte bitval;
	//thisval steht hier fuer den bitfield-wert, 
	//aus Generierungsgruenden hier keine einheitliche Bezeichnung moeglich.
	byte thisval; // Setup
	bitval= getValue(this);
	thisval = getValue(P_ASG_69_0_0_26_1);
	thisval = thisval&~(1<<2)|(bitval<<2);
	putValue(P_ASG_69_0_0_26_1,thisval);
}

on envVar P_ASG_69_0_0_26_1_3
{
	byte bitval;
	//thisval steht hier fuer den bitfield-wert, 
	//aus Generierungsgruenden hier keine einheitliche Bezeichnung moeglich.
	byte thisval; // Setup
	bitval= getValue(this);
	thisval = getValue(P_ASG_69_0_0_26_1);
	thisval = thisval&~(1<<3)|(bitval<<3);
	putValue(P_ASG_69_0_0_26_1,thisval);
}

on envVar P_ASG_69_0_0_26_1_4
{
	byte bitval;
	//thisval steht hier fuer den bitfield-wert, 
	//aus Generierungsgruenden hier keine einheitliche Bezeichnung moeglich.
	byte thisval; // Setup
	bitval= getValue(this);
	thisval = getValue(P_ASG_69_0_0_26_1);
	thisval = thisval&~(1<<4)|(bitval<<4);
	putValue(P_ASG_69_0_0_26_1,thisval);
}

on envVar P_ASG_69_0_0_26_1_5
{
	byte bitval;
	//thisval steht hier fuer den bitfield-wert, 
	//aus Generierungsgruenden hier keine einheitliche Bezeichnung moeglich.
	byte thisval; // Setup
	bitval= getValue(this);
	thisval = getValue(P_ASG_69_0_0_26_1);
	thisval = thisval&~(1<<5)|(bitval<<5);
	putValue(P_ASG_69_0_0_26_1,thisval);
}

on envVar P_ASG_69_0_0_26_1 // AdditionalInstrument2.Setup
{
	byte superval;

	//Update Childvalue (BitField)
	byte mask=0x01;
	int i = 0;
	byte thisval; // Setup
	thisval = getValue(this);
	if(thisval&(mask<<0))
		putValue(P_ASG_69_0_0_26_1_0, 1);
	else
		putValue(P_ASG_69_0_0_26_1_0, 0);
	if(thisval&(mask<<1))
		putValue(P_ASG_69_0_0_26_1_1, 1);
	else
		putValue(P_ASG_69_0_0_26_1_1, 0);
	if(thisval&(mask<<2))
		putValue(P_ASG_69_0_0_26_1_2, 1);
	else
		putValue(P_ASG_69_0_0_26_1_2, 0);
	if(thisval&(mask<<3))
		putValue(P_ASG_69_0_0_26_1_3, 1);
	else
		putValue(P_ASG_69_0_0_26_1_3, 0);
	if(thisval&(mask<<4))
		putValue(P_ASG_69_0_0_26_1_4, 1);
	else
		putValue(P_ASG_69_0_0_26_1_4, 0);
	if(thisval&(mask<<5))
		putValue(P_ASG_69_0_0_26_1_5, 1);
	else
		putValue(P_ASG_69_0_0_26_1_5, 0);

    // Update superval
	superval = getValue(P_ASG_69_0_0_26);
	superval = thisval;
	putValue(P_ASG_69_0_0_26,superval);
}

on envVar A_ASG_69_0_0_27Get_BTN
{
  byte data[664]; 
  byte stringValue[664];
  byte head[5];
  int i;
  int headLength;
  long tempValue;
  word currentPos;
  word startVal;
  word elementsVal;
  byte nibbleSetted;
  if (A_ASG_69_0_0_27Get_BTN_already_pressed == 0)
  {
     putValue(A_ASG_69_0_0_27_ErrCode,0);
     SetControlBackColor(panel_name,"errField_A_ASG_69_0_0_27",MakeRGB(255,255,255));
     A_ASG_69_0_0_27Get_BTN_already_pressed = 1;
  }
  else
  {
        currentPos = 0;
        //Einzelparameter: ASG_ID
        tempValue = getValue(A_ASG_69_0_0_27_1_SetGet);
    if(nibbleSetted == 1)
    {
        //voriger Parameter war ein Nibble, => second nibble, Pos incr und Flag zuruecksetzen
        data[currentPos] = (tempValue &0x0F) | (data[currentPos] &0xF0);
        currentPos++;
        nibbleSetted = 0;
    }
    else
    {
        //first nibble, kein increment, Flag setzen
        data[currentPos] = (tempValue<<4) &0xF0;
        nibbleSetted = 1;
    }
        //Einzelparameter: TAID
        tempValue = getValue(A_ASG_69_0_0_27_2_SetGet);
    if(nibbleSetted == 1)
    {
        //voriger Parameter war ein Nibble, => second nibble, Pos incr und Flag zuruecksetzen
        data[currentPos] = (tempValue &0x0F) | (data[currentPos] &0xF0);
        currentPos++;
        nibbleSetted = 0;
    }
    else
    {
        //first nibble, kein increment, Flag setzen
        data[currentPos] = (tempValue<<4) &0xF0;
        nibbleSetted = 1;
    }
        //head Parameter
        headLength = getValueSize(A_ASG_69_0_0_27_SetGet);
        getValue(A_ASG_69_0_0_27_SetGet,head);
        for(i=0; i< headLength; i++)
        {
            data[currentPos++] = head[i];
        }

     Request_ByteSequence(LSGID, A_ASG_69_0_0_27_ID, DataGet_REQ, data, currentPos);
     if(getValue(A_ASG_69_0_0_27_IntTlgEn)) //getValue(IT))
     {
       intertelegram_err(A_ASG_69_0_0_27_ID);
     }
     if(getValue(A_ASG_69_0_0_27_SegmEn))   //getvalue(SG)
     {
         sequence_err(A_ASG_69_0_0_27_ID,getValueSize(A_ASG_69_0_0_27_SetGet));
     }
     A_ASG_69_0_0_27Get_BTN_already_pressed = 0;
  }
}
A_ASG_69_0_0_27_SetGet_GenerateSetGet()
{
    byte head[5];
    //Record Address in Byte 0 Bit 0-3 kopieren - MAX Wert = 0x0F
    if(getValue(A_ASG_69_0_0_27_SetGet_RecAdr) > 0x0F)
        putValue(A_ASG_69_0_0_27_SetGet_RecAdr , 0x0F);
    head[0] = (head[0] & 0xF0) | getValue(A_ASG_69_0_0_27_SetGet_RecAdr);
    //Shift Bit in Byte 0 Bit 4 kopieren
    if( getValue(A_ASG_69_0_0_27_SetGet_Shift) > 0) head[0] = head[0] | 0x10;
    else head[0] = head[0] & 0xEF;
    // Direction Bit in Byte 0 Bit 5 kopieren
    if( getValue(A_ASG_69_0_0_27_SetGet_Direction) > 0) head[0] = head[0] | 0x20;
    else head[0] = head[0] & 0xDF;
    // reserverd:  Byte 0 Bit 6
    if( getValue(A_ASG_69_0_0_27_SetGet_IndexSize) > 0)
    {
        // 5 Byte Header
        head[0] = head[0] | 0x80;
        head[1] =  getValue(A_ASG_69_0_0_27_SetGet_Start) & 0xFF;
        head[2] = (getValue(A_ASG_69_0_0_27_SetGet_Start) >> 8 ) & 0xFF;
        head[3] =  getValue(A_ASG_69_0_0_27_SetGet_Elements) & 0xFF;
        head[4] = (getValue(A_ASG_69_0_0_27_SetGet_Elements)  >> 8 ) & 0xFF;
        //ToDo: DATA - derzeit einfach laenge = 5
        putValue(A_ASG_69_0_0_27_SetGet, head, 5); 
    }
    else 
    {
        // 3 Byte Header
        head[0] = head[0] & 0x7F;
        head[1] = getValue(A_ASG_69_0_0_27_SetGet_Start) & 0xFF;
        head[2] = getValue(A_ASG_69_0_0_27_SetGet_Elements) & 0xFF;
        //ToDo: DATA - derzeit einfach laenge = 3
        putValue(A_ASG_69_0_0_27_SetGet, head, 3); 
    }
}

on envVar A_ASG_69_0_0_27_SetGet_RecAdr
{
    A_ASG_69_0_0_27_SetGet_GenerateSetGet();
}

on envVar A_ASG_69_0_0_27_SetGet_Shift
{
    A_ASG_69_0_0_27_SetGet_GenerateSetGet();
}

on envVar A_ASG_69_0_0_27_SetGet_Direction
{
    A_ASG_69_0_0_27_SetGet_GenerateSetGet();
}

on envVar A_ASG_69_0_0_27_SetGet_Start
{
    A_ASG_69_0_0_27_SetGet_GenerateSetGet();
}

on envVar A_ASG_69_0_0_27_SetGet_Elements
{
    A_ASG_69_0_0_27_SetGet_GenerateSetGet();
}

on envVar A_ASG_69_0_0_27_SetGet_IndexSize
{
    A_ASG_69_0_0_27_SetGet_GenerateSetGet();
}
on envVar A_ASG_69_0_0_27SetGet_BTN
{
  byte data[664]; 
  byte stringValue[664];
  byte head[5];
  int i;
  int j = 0;
  long StringLength = 0;
  int headLength;
  long tempValue;
  word currentPos;
  word startVal;
  word elementsVal;
  byte nibbleSetted;
  if (A_ASG_69_0_0_27SetGet_BTN_already_pressed == 0)
  {
     putValue(A_ASG_69_0_0_27_ErrCode,0);
     SetControlBackColor(panel_name,"errField_A_ASG_69_0_0_27",MakeRGB(255,255,255));
     A_ASG_69_0_0_27SetGet_BTN_already_pressed = 1;
  }
  else
  {
        currentPos = 0;
        //Einzelparameter: ASG_ID
        tempValue = getValue(A_ASG_69_0_0_27_1_SetGet);
    if(nibbleSetted == 1)
    {
        //voriger Parameter war ein Nibble, => second nibble, Pos incr und Flag zuruecksetzen
        data[currentPos] = (tempValue &0x0F) | (data[currentPos] &0xF0);
        currentPos++;
        nibbleSetted = 0;
    }
    else
    {
        //first nibble, kein increment, Flag setzen
        data[currentPos] = (tempValue<<4) &0xF0;
        nibbleSetted = 1;
    }
        //Einzelparameter: TAID
        tempValue = getValue(A_ASG_69_0_0_27_2_SetGet);
    if(nibbleSetted == 1)
    {
        //voriger Parameter war ein Nibble, => second nibble, Pos incr und Flag zuruecksetzen
        data[currentPos] = (tempValue &0x0F) | (data[currentPos] &0xF0);
        currentPos++;
        nibbleSetted = 0;
    }
    else
    {
        //first nibble, kein increment, Flag setzen
        data[currentPos] = (tempValue<<4) &0xF0;
        nibbleSetted = 1;
    }
        //head Parameter
        headLength = getValueSize(A_ASG_69_0_0_27_SetGet);
        getValue(A_ASG_69_0_0_27_SetGet,head);
        for(i=0; i< headLength; i++)
        {
            data[currentPos++] = head[i];
        }
    //data Parameter
     startVal = getValue(A_ASG_69_0_0_27_SetGet_Start);
     elementsVal = getValue(A_ASG_69_0_0_27_SetGet_Elements);
     nibbleSetted = 0;
    if( (head[0]&0x20) == 0)
    {
     if( (head[0] & 0x10) > 0)
     {
        startVal++;
     }
     for( i = startVal ; i < startVal + elementsVal ; i++)
     {
       if( i < 0 || i >= A_ASG_69_0_0_27_ArrayDataList_Length )
       {
         write("Array index ausserhalb der Grenzen, Fct: 27");
         break;
       }
      if(nibbleSetted == 1) currentPos++;
      nibbleSetted = 0;
     if( (head[0]&0x40) == 0){ /* Transmit_Pos = 0, keine Positionsdaten */ }
     else
     {
        if( (head[0]&0x80) == 0)
        {
           //IndexSize = 0, Pos als 1 Byte Wert
           data[currentPos++] = A_ASG_69_0_0_27_ArrayDataList[i].Param1 & 0xFF;
        }
        else
        {
           //IndexSize = 1, Pos als 2 Byte Wert
           data[currentPos++] = A_ASG_69_0_0_27_ArrayDataList[i].Param1 & 0xFF;
           data[currentPos++] = (A_ASG_69_0_0_27_ArrayDataList[i].Param1 >> 8) & 0xFF;
        }
     }
      // Check if the current value of RecAdr enables the variable State:
      if( 0 || 1 == getValue( A_ASG_69_0_0_27_SetGet_RecAdr ) || 2 == getValue( A_ASG_69_0_0_27_SetGet_RecAdr ) )
      {
        //Sollte vor einem 1 Byte Wert 1 Nibble kommen, muss der index um 1 incrementiert werden!
        if( nibbleSetted==1) currentPos++;
        nibbleSetted = 0;
        data[currentPos++] = (A_ASG_69_0_0_27_ArrayDataList[i].Param2 ) & 0xFF;
       }
      // Check if the current value of RecAdr enables the variable DisplayPresetType:
      if( 0 || 1 == getValue( A_ASG_69_0_0_27_SetGet_RecAdr ) || 2 == getValue( A_ASG_69_0_0_27_SetGet_RecAdr ) )
      {
        //Sollte vor einem 1 Byte Wert 1 Nibble kommen, muss der index um 1 incrementiert werden!
        if( nibbleSetted==1) currentPos++;
        nibbleSetted = 0;
        data[currentPos++] = (A_ASG_69_0_0_27_ArrayDataList[i].Param3 ) & 0xFF;
       }
      // Check if the current value of RecAdr enables the variable DisplayPresetInstance:
      if( 0 || 1 == getValue( A_ASG_69_0_0_27_SetGet_RecAdr ) || 2 == getValue( A_ASG_69_0_0_27_SetGet_RecAdr ) )
      {
        //Sollte vor einem 1 Byte Wert 1 Nibble kommen, muss der index um 1 incrementiert werden!
        if( nibbleSetted==1) currentPos++;
        nibbleSetted = 0;
        data[currentPos++] = (A_ASG_69_0_0_27_ArrayDataList[i].Param4 ) & 0xFF;
       }
      // Check if the current value of RecAdr enables the variable Display1MainSelection:
      if( 0 || 1 == getValue( A_ASG_69_0_0_27_SetGet_RecAdr ) || 2 == getValue( A_ASG_69_0_0_27_SetGet_RecAdr ) )
      {
        //Sollte vor einem 4 Byte Wert 1 Nibble kommen, muss der index um 1 incrementiert werden!
        if( nibbleSetted==1) currentPos++;
        nibbleSetted = 0;
        data[currentPos++] = (A_ASG_69_0_0_27_ArrayDataList[i].Param5      ) & 0xFF;
        data[currentPos++] = (A_ASG_69_0_0_27_ArrayDataList[i].Param5 >>  8) & 0xFF;
        data[currentPos++] = (A_ASG_69_0_0_27_ArrayDataList[i].Param5 >> 16) & 0xFF;
        data[currentPos++] = (A_ASG_69_0_0_27_ArrayDataList[i].Param5 >> 24) & 0xFF;
       }
      // Check if the current value of RecAdr enables the variable Display1AdditionalInfo1_1:
      if( 0 || 1 == getValue( A_ASG_69_0_0_27_SetGet_RecAdr ) || 2 == getValue( A_ASG_69_0_0_27_SetGet_RecAdr ) )
      {
        //Sollte vor einem 4 Byte Wert 1 Nibble kommen, muss der index um 1 incrementiert werden!
        if( nibbleSetted==1) currentPos++;
        nibbleSetted = 0;
        data[currentPos++] = (A_ASG_69_0_0_27_ArrayDataList[i].Param6      ) & 0xFF;
        data[currentPos++] = (A_ASG_69_0_0_27_ArrayDataList[i].Param6 >>  8) & 0xFF;
        data[currentPos++] = (A_ASG_69_0_0_27_ArrayDataList[i].Param6 >> 16) & 0xFF;
        data[currentPos++] = (A_ASG_69_0_0_27_ArrayDataList[i].Param6 >> 24) & 0xFF;
       }
      // Check if the current value of RecAdr enables the variable Display1AdditionalInfo1_2:
      if( 0 || 1 == getValue( A_ASG_69_0_0_27_SetGet_RecAdr ) || 2 == getValue( A_ASG_69_0_0_27_SetGet_RecAdr ) )
      {
        //Sollte vor einem 4 Byte Wert 1 Nibble kommen, muss der index um 1 incrementiert werden!
        if( nibbleSetted==1) currentPos++;
        nibbleSetted = 0;
        data[currentPos++] = (A_ASG_69_0_0_27_ArrayDataList[i].Param7      ) & 0xFF;
        data[currentPos++] = (A_ASG_69_0_0_27_ArrayDataList[i].Param7 >>  8) & 0xFF;
        data[currentPos++] = (A_ASG_69_0_0_27_ArrayDataList[i].Param7 >> 16) & 0xFF;
        data[currentPos++] = (A_ASG_69_0_0_27_ArrayDataList[i].Param7 >> 24) & 0xFF;
       }
      // Check if the current value of RecAdr enables the variable Display1AdditionalInfo2_1:
      if( 0 || 1 == getValue( A_ASG_69_0_0_27_SetGet_RecAdr ) || 2 == getValue( A_ASG_69_0_0_27_SetGet_RecAdr ) )
      {
        //Sollte vor einem 4 Byte Wert 1 Nibble kommen, muss der index um 1 incrementiert werden!
        if( nibbleSetted==1) currentPos++;
        nibbleSetted = 0;
        data[currentPos++] = (A_ASG_69_0_0_27_ArrayDataList[i].Param8      ) & 0xFF;
        data[currentPos++] = (A_ASG_69_0_0_27_ArrayDataList[i].Param8 >>  8) & 0xFF;
        data[currentPos++] = (A_ASG_69_0_0_27_ArrayDataList[i].Param8 >> 16) & 0xFF;
        data[currentPos++] = (A_ASG_69_0_0_27_ArrayDataList[i].Param8 >> 24) & 0xFF;
       }
      // Check if the current value of RecAdr enables the variable Display1AdditionalInfo2_2:
      if( 0 || 1 == getValue( A_ASG_69_0_0_27_SetGet_RecAdr ) || 2 == getValue( A_ASG_69_0_0_27_SetGet_RecAdr ) )
      {
        //Sollte vor einem 4 Byte Wert 1 Nibble kommen, muss der index um 1 incrementiert werden!
        if( nibbleSetted==1) currentPos++;
        nibbleSetted = 0;
        data[currentPos++] = (A_ASG_69_0_0_27_ArrayDataList[i].Param9      ) & 0xFF;
        data[currentPos++] = (A_ASG_69_0_0_27_ArrayDataList[i].Param9 >>  8) & 0xFF;
        data[currentPos++] = (A_ASG_69_0_0_27_ArrayDataList[i].Param9 >> 16) & 0xFF;
        data[currentPos++] = (A_ASG_69_0_0_27_ArrayDataList[i].Param9 >> 24) & 0xFF;
       }
      // Check if the current value of RecAdr enables the variable Display2MainSelection:
      if( 0 || 1 == getValue( A_ASG_69_0_0_27_SetGet_RecAdr ) || 2 == getValue( A_ASG_69_0_0_27_SetGet_RecAdr ) )
      {
        //Sollte vor einem 4 Byte Wert 1 Nibble kommen, muss der index um 1 incrementiert werden!
        if( nibbleSetted==1) currentPos++;
        nibbleSetted = 0;
        data[currentPos++] = (A_ASG_69_0_0_27_ArrayDataList[i].Param10      ) & 0xFF;
        data[currentPos++] = (A_ASG_69_0_0_27_ArrayDataList[i].Param10 >>  8) & 0xFF;
        data[currentPos++] = (A_ASG_69_0_0_27_ArrayDataList[i].Param10 >> 16) & 0xFF;
        data[currentPos++] = (A_ASG_69_0_0_27_ArrayDataList[i].Param10 >> 24) & 0xFF;
       }
      // Check if the current value of RecAdr enables the variable Display2AdditionalInfo1_1:
      if( 0 || 1 == getValue( A_ASG_69_0_0_27_SetGet_RecAdr ) || 2 == getValue( A_ASG_69_0_0_27_SetGet_RecAdr ) )
      {
        //Sollte vor einem 4 Byte Wert 1 Nibble kommen, muss der index um 1 incrementiert werden!
        if( nibbleSetted==1) currentPos++;
        nibbleSetted = 0;
        data[currentPos++] = (A_ASG_69_0_0_27_ArrayDataList[i].Param11      ) & 0xFF;
        data[currentPos++] = (A_ASG_69_0_0_27_ArrayDataList[i].Param11 >>  8) & 0xFF;
        data[currentPos++] = (A_ASG_69_0_0_27_ArrayDataList[i].Param11 >> 16) & 0xFF;
        data[currentPos++] = (A_ASG_69_0_0_27_ArrayDataList[i].Param11 >> 24) & 0xFF;
       }
      // Check if the current value of RecAdr enables the variable Display2AdditionalInfo1_2:
      if( 0 || 1 == getValue( A_ASG_69_0_0_27_SetGet_RecAdr ) || 2 == getValue( A_ASG_69_0_0_27_SetGet_RecAdr ) )
      {
        //Sollte vor einem 4 Byte Wert 1 Nibble kommen, muss der index um 1 incrementiert werden!
        if( nibbleSetted==1) currentPos++;
        nibbleSetted = 0;
        data[currentPos++] = (A_ASG_69_0_0_27_ArrayDataList[i].Param12      ) & 0xFF;
        data[currentPos++] = (A_ASG_69_0_0_27_ArrayDataList[i].Param12 >>  8) & 0xFF;
        data[currentPos++] = (A_ASG_69_0_0_27_ArrayDataList[i].Param12 >> 16) & 0xFF;
        data[currentPos++] = (A_ASG_69_0_0_27_ArrayDataList[i].Param12 >> 24) & 0xFF;
       }
      // Check if the current value of RecAdr enables the variable Display2AdditionalInfo2_1:
      if( 0 || 1 == getValue( A_ASG_69_0_0_27_SetGet_RecAdr ) || 2 == getValue( A_ASG_69_0_0_27_SetGet_RecAdr ) )
      {
        //Sollte vor einem 4 Byte Wert 1 Nibble kommen, muss der index um 1 incrementiert werden!
        if( nibbleSetted==1) currentPos++;
        nibbleSetted = 0;
        data[currentPos++] = (A_ASG_69_0_0_27_ArrayDataList[i].Param13      ) & 0xFF;
        data[currentPos++] = (A_ASG_69_0_0_27_ArrayDataList[i].Param13 >>  8) & 0xFF;
        data[currentPos++] = (A_ASG_69_0_0_27_ArrayDataList[i].Param13 >> 16) & 0xFF;
        data[currentPos++] = (A_ASG_69_0_0_27_ArrayDataList[i].Param13 >> 24) & 0xFF;
       }
      // Check if the current value of RecAdr enables the variable Display2AdditionalInfo2_2:
      if( 0 || 1 == getValue( A_ASG_69_0_0_27_SetGet_RecAdr ) || 2 == getValue( A_ASG_69_0_0_27_SetGet_RecAdr ) )
      {
        //Sollte vor einem 4 Byte Wert 1 Nibble kommen, muss der index um 1 incrementiert werden!
        if( nibbleSetted==1) currentPos++;
        nibbleSetted = 0;
        data[currentPos++] = (A_ASG_69_0_0_27_ArrayDataList[i].Param14      ) & 0xFF;
        data[currentPos++] = (A_ASG_69_0_0_27_ArrayDataList[i].Param14 >>  8) & 0xFF;
        data[currentPos++] = (A_ASG_69_0_0_27_ArrayDataList[i].Param14 >> 16) & 0xFF;
        data[currentPos++] = (A_ASG_69_0_0_27_ArrayDataList[i].Param14 >> 24) & 0xFF;
       }
      // Check if the current value of RecAdr enables the variable Display3MainSelection:
      if( 0 || 1 == getValue( A_ASG_69_0_0_27_SetGet_RecAdr ) )
      {
        //Sollte vor einem 4 Byte Wert 1 Nibble kommen, muss der index um 1 incrementiert werden!
        if( nibbleSetted==1) currentPos++;
        nibbleSetted = 0;
        data[currentPos++] = (A_ASG_69_0_0_27_ArrayDataList[i].Param15      ) & 0xFF;
        data[currentPos++] = (A_ASG_69_0_0_27_ArrayDataList[i].Param15 >>  8) & 0xFF;
        data[currentPos++] = (A_ASG_69_0_0_27_ArrayDataList[i].Param15 >> 16) & 0xFF;
        data[currentPos++] = (A_ASG_69_0_0_27_ArrayDataList[i].Param15 >> 24) & 0xFF;
       }
      // Check if the current value of RecAdr enables the variable Display3AdditionalInfo1_1:
      if( 0 || 1 == getValue( A_ASG_69_0_0_27_SetGet_RecAdr ) )
      {
        //Sollte vor einem 4 Byte Wert 1 Nibble kommen, muss der index um 1 incrementiert werden!
        if( nibbleSetted==1) currentPos++;
        nibbleSetted = 0;
        data[currentPos++] = (A_ASG_69_0_0_27_ArrayDataList[i].Param16      ) & 0xFF;
        data[currentPos++] = (A_ASG_69_0_0_27_ArrayDataList[i].Param16 >>  8) & 0xFF;
        data[currentPos++] = (A_ASG_69_0_0_27_ArrayDataList[i].Param16 >> 16) & 0xFF;
        data[currentPos++] = (A_ASG_69_0_0_27_ArrayDataList[i].Param16 >> 24) & 0xFF;
       }
      // Check if the current value of RecAdr enables the variable Display3AdditionalInfo1_2:
      if( 0 || 1 == getValue( A_ASG_69_0_0_27_SetGet_RecAdr ) )
      {
        //Sollte vor einem 4 Byte Wert 1 Nibble kommen, muss der index um 1 incrementiert werden!
        if( nibbleSetted==1) currentPos++;
        nibbleSetted = 0;
        data[currentPos++] = (A_ASG_69_0_0_27_ArrayDataList[i].Param17      ) & 0xFF;
        data[currentPos++] = (A_ASG_69_0_0_27_ArrayDataList[i].Param17 >>  8) & 0xFF;
        data[currentPos++] = (A_ASG_69_0_0_27_ArrayDataList[i].Param17 >> 16) & 0xFF;
        data[currentPos++] = (A_ASG_69_0_0_27_ArrayDataList[i].Param17 >> 24) & 0xFF;
       }
      // Check if the current value of RecAdr enables the variable Display3AdditionalInfo2_1:
      if( 0 || 1 == getValue( A_ASG_69_0_0_27_SetGet_RecAdr ) )
      {
        //Sollte vor einem 4 Byte Wert 1 Nibble kommen, muss der index um 1 incrementiert werden!
        if( nibbleSetted==1) currentPos++;
        nibbleSetted = 0;
        data[currentPos++] = (A_ASG_69_0_0_27_ArrayDataList[i].Param18      ) & 0xFF;
        data[currentPos++] = (A_ASG_69_0_0_27_ArrayDataList[i].Param18 >>  8) & 0xFF;
        data[currentPos++] = (A_ASG_69_0_0_27_ArrayDataList[i].Param18 >> 16) & 0xFF;
        data[currentPos++] = (A_ASG_69_0_0_27_ArrayDataList[i].Param18 >> 24) & 0xFF;
       }
      // Check if the current value of RecAdr enables the variable Display3AdditionalInfo2_2:
      if( 0 || 1 == getValue( A_ASG_69_0_0_27_SetGet_RecAdr ) )
      {
        //Sollte vor einem 4 Byte Wert 1 Nibble kommen, muss der index um 1 incrementiert werden!
        if( nibbleSetted==1) currentPos++;
        nibbleSetted = 0;
        data[currentPos++] = (A_ASG_69_0_0_27_ArrayDataList[i].Param19      ) & 0xFF;
        data[currentPos++] = (A_ASG_69_0_0_27_ArrayDataList[i].Param19 >>  8) & 0xFF;
        data[currentPos++] = (A_ASG_69_0_0_27_ArrayDataList[i].Param19 >> 16) & 0xFF;
        data[currentPos++] = (A_ASG_69_0_0_27_ArrayDataList[i].Param19 >> 24) & 0xFF;
       }
      // Check if the current value of RecAdr enables the variable Extension:
      if( 0 )
      {
        //Sollte vor einem String Wert 1 Nibble kommen, muss der index um 1 incrementiert werden!
        if( nibbleSetted==1) currentPos++;
        nibbleSetted = 0;
        StringLength =A_ASG_69_0_0_27_ArrayDataList[i].Param20_Length;
		/* Pruefung ob die Laenge-Checkbox aktiv ist */
		if (1 == A_ASG_69_0_0_27_Data_20_CntList[i] )
		{
			if(StringLength >= 0 && StringLength <= 32767 /*&& StringLength <= 2-2*/)
			{
				data[currentPos++] = ( (StringLength >> 8) & 0x7F ) | 0x80; //2Byte Flag (Bit 8) setzen + HighByte (erste 7 bit)
				data[currentPos++] = StringLength &0xFF;
			}
			else
			{
				writelineEx(gBAP_Trace, 0, "Eingegebene Laenge: %d von A_ASG_69_0_0_27_Data_20 mit Record Nr. %d ist ungueltig. Die max. erlaubte Laenge ist %d.", StringLength, i, 2-2);
				return;
			}
		}
		else if(0 == A_ASG_69_0_0_27_Data_20_CntList[i] ) /*check box deaktiviert*/
		{
			if(StringLength >= 0 && StringLength <= 127 /*&& StringLength <= 2-1*/)
			{
				data[currentPos++] = StringLength & 0x7F; //Bit 8 = 0
			}
			else
			{
				writelineEx(gBAP_Trace, 0, "Eingegebene Laenge: %d von A_ASG_69_0_0_27_Data_20 mit Record Nr. %d ist ungueltig. Die max. erlaubte Laenge ist %d. ", StringLength, i, 2-1);
				return;
			}
		}
        for(j=0; j < StringLength ; j++)
        {
            data[currentPos++] = A_ASG_69_0_0_27_ArrayDataList[i].Param20[j];
        }
       }
    //sollte der letzte Parameter ein first nibble gewesen sein, muss noch 1 increment durchgefuehrt werden
    if( nibbleSetted==1) currentPos++;
    nibbleSetted = 0;
     }
    }
    else
    {
     if( (head[0] & 0x10) > 0)
     {
        if(startVal != 0) startVal--;
        else
        {
           startVal = A_ASG_69_0_0_27_ArrayDataList_Length -1;
        }
     }
     for( i = startVal ; i > startVal - elementsVal ; i--)
     {
       if( i < 0 || i >= A_ASG_69_0_0_27_ArrayDataList_Length )
       {
         write("Array index ausserhalb der Grenzen, Fct: 27");
         break;
       }
      if(nibbleSetted == 1) currentPos++;
      nibbleSetted = 0;
     if( (head[0]&0x40) == 0){ /* Transmit_Pos = 0, keine Positionsdaten */ }
     else
     {
        if( (head[0]&0x80) == 0)
        {
           //IndexSize = 0, Pos als 1 Byte Wert
           data[currentPos++] = A_ASG_69_0_0_27_ArrayDataList[i].Param1 & 0xFF;
        }
        else
        {
           //IndexSize = 1, Pos als 2 Byte Wert
           data[currentPos++] = A_ASG_69_0_0_27_ArrayDataList[i].Param1 & 0xFF;
           data[currentPos++] = (A_ASG_69_0_0_27_ArrayDataList[i].Param1 >> 8) & 0xFF;
        }
     }
      // Check if the current value of RecAdr enables the variable State:
      if( 0 || 1 == getValue( A_ASG_69_0_0_27_SetGet_RecAdr ) || 2 == getValue( A_ASG_69_0_0_27_SetGet_RecAdr ) )
      {
        //Sollte vor einem 1 Byte Wert 1 Nibble kommen, muss der index um 1 incrementiert werden!
        if( nibbleSetted==1) currentPos++;
        nibbleSetted = 0;
        data[currentPos++] = (A_ASG_69_0_0_27_ArrayDataList[i].Param2 ) & 0xFF;
       }
      // Check if the current value of RecAdr enables the variable DisplayPresetType:
      if( 0 || 1 == getValue( A_ASG_69_0_0_27_SetGet_RecAdr ) || 2 == getValue( A_ASG_69_0_0_27_SetGet_RecAdr ) )
      {
        //Sollte vor einem 1 Byte Wert 1 Nibble kommen, muss der index um 1 incrementiert werden!
        if( nibbleSetted==1) currentPos++;
        nibbleSetted = 0;
        data[currentPos++] = (A_ASG_69_0_0_27_ArrayDataList[i].Param3 ) & 0xFF;
       }
      // Check if the current value of RecAdr enables the variable DisplayPresetInstance:
      if( 0 || 1 == getValue( A_ASG_69_0_0_27_SetGet_RecAdr ) || 2 == getValue( A_ASG_69_0_0_27_SetGet_RecAdr ) )
      {
        //Sollte vor einem 1 Byte Wert 1 Nibble kommen, muss der index um 1 incrementiert werden!
        if( nibbleSetted==1) currentPos++;
        nibbleSetted = 0;
        data[currentPos++] = (A_ASG_69_0_0_27_ArrayDataList[i].Param4 ) & 0xFF;
       }
      // Check if the current value of RecAdr enables the variable Display1MainSelection:
      if( 0 || 1 == getValue( A_ASG_69_0_0_27_SetGet_RecAdr ) || 2 == getValue( A_ASG_69_0_0_27_SetGet_RecAdr ) )
      {
        //Sollte vor einem 4 Byte Wert 1 Nibble kommen, muss der index um 1 incrementiert werden!
        if( nibbleSetted==1) currentPos++;
        nibbleSetted = 0;
        data[currentPos++] = (A_ASG_69_0_0_27_ArrayDataList[i].Param5      ) & 0xFF;
        data[currentPos++] = (A_ASG_69_0_0_27_ArrayDataList[i].Param5 >>  8) & 0xFF;
        data[currentPos++] = (A_ASG_69_0_0_27_ArrayDataList[i].Param5 >> 16) & 0xFF;
        data[currentPos++] = (A_ASG_69_0_0_27_ArrayDataList[i].Param5 >> 24) & 0xFF;
       }
      // Check if the current value of RecAdr enables the variable Display1AdditionalInfo1_1:
      if( 0 || 1 == getValue( A_ASG_69_0_0_27_SetGet_RecAdr ) || 2 == getValue( A_ASG_69_0_0_27_SetGet_RecAdr ) )
      {
        //Sollte vor einem 4 Byte Wert 1 Nibble kommen, muss der index um 1 incrementiert werden!
        if( nibbleSetted==1) currentPos++;
        nibbleSetted = 0;
        data[currentPos++] = (A_ASG_69_0_0_27_ArrayDataList[i].Param6      ) & 0xFF;
        data[currentPos++] = (A_ASG_69_0_0_27_ArrayDataList[i].Param6 >>  8) & 0xFF;
        data[currentPos++] = (A_ASG_69_0_0_27_ArrayDataList[i].Param6 >> 16) & 0xFF;
        data[currentPos++] = (A_ASG_69_0_0_27_ArrayDataList[i].Param6 >> 24) & 0xFF;
       }
      // Check if the current value of RecAdr enables the variable Display1AdditionalInfo1_2:
      if( 0 || 1 == getValue( A_ASG_69_0_0_27_SetGet_RecAdr ) || 2 == getValue( A_ASG_69_0_0_27_SetGet_RecAdr ) )
      {
        //Sollte vor einem 4 Byte Wert 1 Nibble kommen, muss der index um 1 incrementiert werden!
        if( nibbleSetted==1) currentPos++;
        nibbleSetted = 0;
        data[currentPos++] = (A_ASG_69_0_0_27_ArrayDataList[i].Param7      ) & 0xFF;
        data[currentPos++] = (A_ASG_69_0_0_27_ArrayDataList[i].Param7 >>  8) & 0xFF;
        data[currentPos++] = (A_ASG_69_0_0_27_ArrayDataList[i].Param7 >> 16) & 0xFF;
        data[currentPos++] = (A_ASG_69_0_0_27_ArrayDataList[i].Param7 >> 24) & 0xFF;
       }
      // Check if the current value of RecAdr enables the variable Display1AdditionalInfo2_1:
      if( 0 || 1 == getValue( A_ASG_69_0_0_27_SetGet_RecAdr ) || 2 == getValue( A_ASG_69_0_0_27_SetGet_RecAdr ) )
      {
        //Sollte vor einem 4 Byte Wert 1 Nibble kommen, muss der index um 1 incrementiert werden!
        if( nibbleSetted==1) currentPos++;
        nibbleSetted = 0;
        data[currentPos++] = (A_ASG_69_0_0_27_ArrayDataList[i].Param8      ) & 0xFF;
        data[currentPos++] = (A_ASG_69_0_0_27_ArrayDataList[i].Param8 >>  8) & 0xFF;
        data[currentPos++] = (A_ASG_69_0_0_27_ArrayDataList[i].Param8 >> 16) & 0xFF;
        data[currentPos++] = (A_ASG_69_0_0_27_ArrayDataList[i].Param8 >> 24) & 0xFF;
       }
      // Check if the current value of RecAdr enables the variable Display1AdditionalInfo2_2:
      if( 0 || 1 == getValue( A_ASG_69_0_0_27_SetGet_RecAdr ) || 2 == getValue( A_ASG_69_0_0_27_SetGet_RecAdr ) )
      {
        //Sollte vor einem 4 Byte Wert 1 Nibble kommen, muss der index um 1 incrementiert werden!
        if( nibbleSetted==1) currentPos++;
        nibbleSetted = 0;
        data[currentPos++] = (A_ASG_69_0_0_27_ArrayDataList[i].Param9      ) & 0xFF;
        data[currentPos++] = (A_ASG_69_0_0_27_ArrayDataList[i].Param9 >>  8) & 0xFF;
        data[currentPos++] = (A_ASG_69_0_0_27_ArrayDataList[i].Param9 >> 16) & 0xFF;
        data[currentPos++] = (A_ASG_69_0_0_27_ArrayDataList[i].Param9 >> 24) & 0xFF;
       }
      // Check if the current value of RecAdr enables the variable Display2MainSelection:
      if( 0 || 1 == getValue( A_ASG_69_0_0_27_SetGet_RecAdr ) || 2 == getValue( A_ASG_69_0_0_27_SetGet_RecAdr ) )
      {
        //Sollte vor einem 4 Byte Wert 1 Nibble kommen, muss der index um 1 incrementiert werden!
        if( nibbleSetted==1) currentPos++;
        nibbleSetted = 0;
        data[currentPos++] = (A_ASG_69_0_0_27_ArrayDataList[i].Param10      ) & 0xFF;
        data[currentPos++] = (A_ASG_69_0_0_27_ArrayDataList[i].Param10 >>  8) & 0xFF;
        data[currentPos++] = (A_ASG_69_0_0_27_ArrayDataList[i].Param10 >> 16) & 0xFF;
        data[currentPos++] = (A_ASG_69_0_0_27_ArrayDataList[i].Param10 >> 24) & 0xFF;
       }
      // Check if the current value of RecAdr enables the variable Display2AdditionalInfo1_1:
      if( 0 || 1 == getValue( A_ASG_69_0_0_27_SetGet_RecAdr ) || 2 == getValue( A_ASG_69_0_0_27_SetGet_RecAdr ) )
      {
        //Sollte vor einem 4 Byte Wert 1 Nibble kommen, muss der index um 1 incrementiert werden!
        if( nibbleSetted==1) currentPos++;
        nibbleSetted = 0;
        data[currentPos++] = (A_ASG_69_0_0_27_ArrayDataList[i].Param11      ) & 0xFF;
        data[currentPos++] = (A_ASG_69_0_0_27_ArrayDataList[i].Param11 >>  8) & 0xFF;
        data[currentPos++] = (A_ASG_69_0_0_27_ArrayDataList[i].Param11 >> 16) & 0xFF;
        data[currentPos++] = (A_ASG_69_0_0_27_ArrayDataList[i].Param11 >> 24) & 0xFF;
       }
      // Check if the current value of RecAdr enables the variable Display2AdditionalInfo1_2:
      if( 0 || 1 == getValue( A_ASG_69_0_0_27_SetGet_RecAdr ) || 2 == getValue( A_ASG_69_0_0_27_SetGet_RecAdr ) )
      {
        //Sollte vor einem 4 Byte Wert 1 Nibble kommen, muss der index um 1 incrementiert werden!
        if( nibbleSetted==1) currentPos++;
        nibbleSetted = 0;
        data[currentPos++] = (A_ASG_69_0_0_27_ArrayDataList[i].Param12      ) & 0xFF;
        data[currentPos++] = (A_ASG_69_0_0_27_ArrayDataList[i].Param12 >>  8) & 0xFF;
        data[currentPos++] = (A_ASG_69_0_0_27_ArrayDataList[i].Param12 >> 16) & 0xFF;
        data[currentPos++] = (A_ASG_69_0_0_27_ArrayDataList[i].Param12 >> 24) & 0xFF;
       }
      // Check if the current value of RecAdr enables the variable Display2AdditionalInfo2_1:
      if( 0 || 1 == getValue( A_ASG_69_0_0_27_SetGet_RecAdr ) || 2 == getValue( A_ASG_69_0_0_27_SetGet_RecAdr ) )
      {
        //Sollte vor einem 4 Byte Wert 1 Nibble kommen, muss der index um 1 incrementiert werden!
        if( nibbleSetted==1) currentPos++;
        nibbleSetted = 0;
        data[currentPos++] = (A_ASG_69_0_0_27_ArrayDataList[i].Param13      ) & 0xFF;
        data[currentPos++] = (A_ASG_69_0_0_27_ArrayDataList[i].Param13 >>  8) & 0xFF;
        data[currentPos++] = (A_ASG_69_0_0_27_ArrayDataList[i].Param13 >> 16) & 0xFF;
        data[currentPos++] = (A_ASG_69_0_0_27_ArrayDataList[i].Param13 >> 24) & 0xFF;
       }
      // Check if the current value of RecAdr enables the variable Display2AdditionalInfo2_2:
      if( 0 || 1 == getValue( A_ASG_69_0_0_27_SetGet_RecAdr ) || 2 == getValue( A_ASG_69_0_0_27_SetGet_RecAdr ) )
      {
        //Sollte vor einem 4 Byte Wert 1 Nibble kommen, muss der index um 1 incrementiert werden!
        if( nibbleSetted==1) currentPos++;
        nibbleSetted = 0;
        data[currentPos++] = (A_ASG_69_0_0_27_ArrayDataList[i].Param14      ) & 0xFF;
        data[currentPos++] = (A_ASG_69_0_0_27_ArrayDataList[i].Param14 >>  8) & 0xFF;
        data[currentPos++] = (A_ASG_69_0_0_27_ArrayDataList[i].Param14 >> 16) & 0xFF;
        data[currentPos++] = (A_ASG_69_0_0_27_ArrayDataList[i].Param14 >> 24) & 0xFF;
       }
      // Check if the current value of RecAdr enables the variable Display3MainSelection:
      if( 0 || 1 == getValue( A_ASG_69_0_0_27_SetGet_RecAdr ) )
      {
        //Sollte vor einem 4 Byte Wert 1 Nibble kommen, muss der index um 1 incrementiert werden!
        if( nibbleSetted==1) currentPos++;
        nibbleSetted = 0;
        data[currentPos++] = (A_ASG_69_0_0_27_ArrayDataList[i].Param15      ) & 0xFF;
        data[currentPos++] = (A_ASG_69_0_0_27_ArrayDataList[i].Param15 >>  8) & 0xFF;
        data[currentPos++] = (A_ASG_69_0_0_27_ArrayDataList[i].Param15 >> 16) & 0xFF;
        data[currentPos++] = (A_ASG_69_0_0_27_ArrayDataList[i].Param15 >> 24) & 0xFF;
       }
      // Check if the current value of RecAdr enables the variable Display3AdditionalInfo1_1:
      if( 0 || 1 == getValue( A_ASG_69_0_0_27_SetGet_RecAdr ) )
      {
        //Sollte vor einem 4 Byte Wert 1 Nibble kommen, muss der index um 1 incrementiert werden!
        if( nibbleSetted==1) currentPos++;
        nibbleSetted = 0;
        data[currentPos++] = (A_ASG_69_0_0_27_ArrayDataList[i].Param16      ) & 0xFF;
        data[currentPos++] = (A_ASG_69_0_0_27_ArrayDataList[i].Param16 >>  8) & 0xFF;
        data[currentPos++] = (A_ASG_69_0_0_27_ArrayDataList[i].Param16 >> 16) & 0xFF;
        data[currentPos++] = (A_ASG_69_0_0_27_ArrayDataList[i].Param16 >> 24) & 0xFF;
       }
      // Check if the current value of RecAdr enables the variable Display3AdditionalInfo1_2:
      if( 0 || 1 == getValue( A_ASG_69_0_0_27_SetGet_RecAdr ) )
      {
        //Sollte vor einem 4 Byte Wert 1 Nibble kommen, muss der index um 1 incrementiert werden!
        if( nibbleSetted==1) currentPos++;
        nibbleSetted = 0;
        data[currentPos++] = (A_ASG_69_0_0_27_ArrayDataList[i].Param17      ) & 0xFF;
        data[currentPos++] = (A_ASG_69_0_0_27_ArrayDataList[i].Param17 >>  8) & 0xFF;
        data[currentPos++] = (A_ASG_69_0_0_27_ArrayDataList[i].Param17 >> 16) & 0xFF;
        data[currentPos++] = (A_ASG_69_0_0_27_ArrayDataList[i].Param17 >> 24) & 0xFF;
       }
      // Check if the current value of RecAdr enables the variable Display3AdditionalInfo2_1:
      if( 0 || 1 == getValue( A_ASG_69_0_0_27_SetGet_RecAdr ) )
      {
        //Sollte vor einem 4 Byte Wert 1 Nibble kommen, muss der index um 1 incrementiert werden!
        if( nibbleSetted==1) currentPos++;
        nibbleSetted = 0;
        data[currentPos++] = (A_ASG_69_0_0_27_ArrayDataList[i].Param18      ) & 0xFF;
        data[currentPos++] = (A_ASG_69_0_0_27_ArrayDataList[i].Param18 >>  8) & 0xFF;
        data[currentPos++] = (A_ASG_69_0_0_27_ArrayDataList[i].Param18 >> 16) & 0xFF;
        data[currentPos++] = (A_ASG_69_0_0_27_ArrayDataList[i].Param18 >> 24) & 0xFF;
       }
      // Check if the current value of RecAdr enables the variable Display3AdditionalInfo2_2:
      if( 0 || 1 == getValue( A_ASG_69_0_0_27_SetGet_RecAdr ) )
      {
        //Sollte vor einem 4 Byte Wert 1 Nibble kommen, muss der index um 1 incrementiert werden!
        if( nibbleSetted==1) currentPos++;
        nibbleSetted = 0;
        data[currentPos++] = (A_ASG_69_0_0_27_ArrayDataList[i].Param19      ) & 0xFF;
        data[currentPos++] = (A_ASG_69_0_0_27_ArrayDataList[i].Param19 >>  8) & 0xFF;
        data[currentPos++] = (A_ASG_69_0_0_27_ArrayDataList[i].Param19 >> 16) & 0xFF;
        data[currentPos++] = (A_ASG_69_0_0_27_ArrayDataList[i].Param19 >> 24) & 0xFF;
       }
      // Check if the current value of RecAdr enables the variable Extension:
      if( 0 )
      {
        //Sollte vor einem String Wert 1 Nibble kommen, muss der index um 1 incrementiert werden!
        if( nibbleSetted==1) currentPos++;
        nibbleSetted = 0;
        StringLength =A_ASG_69_0_0_27_ArrayDataList[i].Param20_Length;
		/* Pruefung ob die Laenge-Checkbox aktiv ist */
		if (1 == A_ASG_69_0_0_27_Data_20_CntList[i] )
		{
			if(StringLength >= 0 && StringLength <= 32767 /*&& StringLength <= 2-2*/)
			{
				data[currentPos++] = ( (StringLength >> 8) & 0x7F ) | 0x80; //2Byte Flag (Bit 8) setzen + HighByte (erste 7 bit)
				data[currentPos++] = StringLength &0xFF;
			}
			else
			{
				writelineEx(gBAP_Trace, 0, "Eingegebene Laenge: %d von A_ASG_69_0_0_27_Data_20 mit Record Nr. %d ist ungueltig. Die max. erlaubte Laenge ist %d.", StringLength, i, 2-2);
				return;
			}
		}
		else if(0 == A_ASG_69_0_0_27_Data_20_CntList[i] ) /*check box deaktiviert*/
		{
			if(StringLength >= 0 && StringLength <= 127 /*&& StringLength <= 2-1*/)
			{
				data[currentPos++] = StringLength & 0x7F; //Bit 8 = 0
			}
			else
			{
				writelineEx(gBAP_Trace, 0, "Eingegebene Laenge: %d von A_ASG_69_0_0_27_Data_20 mit Record Nr. %d ist ungueltig. Die max. erlaubte Laenge ist %d. ", StringLength, i, 2-1);
				return;
			}
		}
        for(j=0; j < StringLength ; j++)
        {
            data[currentPos++] = A_ASG_69_0_0_27_ArrayDataList[i].Param20[j];
        }
       }
    //sollte der letzte Parameter ein first nibble gewesen sein, muss noch 1 increment durchgefuehrt werden
    if( nibbleSetted==1) currentPos++;
    nibbleSetted = 0;
     }
    }

     Request_ByteSequence(LSGID, A_ASG_69_0_0_27_ID, DataSetGet_REQ, data, currentPos);
     if(getValue(A_ASG_69_0_0_27_IntTlgEn)) //getValue(IT))
     {
           intertelegram_err(A_ASG_69_0_0_27_ID);
     }
     if(getValue(A_ASG_69_0_0_27_SegmEn))   //getvalue(SG)
     {
             sequence_err(A_ASG_69_0_0_27_ID,getValueSize(A_ASG_69_0_0_27_SetGet));
     }
     A_ASG_69_0_0_27SetGet_BTN_already_pressed = 0;
  }
}
on envVar A_ASG_69_0_0_27
{
    byte temp[664];
    byte head[5];
    getValue(A_ASG_69_0_0_27, head);
    putValue(A_ASG_69_0_0_27_RecAdr, 0x0F & head[0]); //Record Address = Bit 0-3 von Byte 0
    if ( (0x10 & head[0]) >0)
        putValue(A_ASG_69_0_0_27_Shift, 1); //Shift = Bit 4 von Byte 0
    else
        putValue(A_ASG_69_0_0_27_Shift, 0); //Shift = Bit 4 von Byte 0
    if ( (0x20 & head[0]) >0)
        putValue(A_ASG_69_0_0_27_Direction, 1); //Direction = Bit 5 von Byte 0
    else
        putValue(A_ASG_69_0_0_27_Direction, 0); //Direction = Bit 5 von Byte 0
    if ( (0x40 & head[0]) >0)
        putValue(A_ASG_69_0_0_27_TransPos, 1); //Transmission Pos = Bit 6 von Byte 0
    else
        putValue(A_ASG_69_0_0_27_TransPos, 0); //Transmission Pos = Bit 6 von Byte 0
    if ( (0x80 & head[0]) >0)
        putValue(A_ASG_69_0_0_27_IndexSize, 1); //IndexSize = Bit 7 von Byte 0
    else
        putValue(A_ASG_69_0_0_27_IndexSize, 0); //IndexSize = Bit 7 von Byte 0
    if(getValue(A_ASG_69_0_0_27_IndexSize))
    {
        putValue(A_ASG_69_0_0_27_Start, ((head[2]<<8)| head[1]) ); //Start Wert, 2 Byte lang
        putValue(A_ASG_69_0_0_27_Elements, ((head[4]<<8)| head[3]) ); //Elements Wert, 2 Byte lang
    }
    else
    {
        putValue(A_ASG_69_0_0_27_Start, head[1]); //Start Wert, 1 Byte lang
        putValue(A_ASG_69_0_0_27_Elements, head[2]); //Start Wert, 1 Byte lang
    }
}
on envVar A_ASG_69_0_0_27_Changed
{
    byte temp[665];
    getValue(A_ASG_69_0_0_27_Changed, temp);
    putValue(A_ASG_69_0_0_27_Changed_RecAdr, 0x0F & temp[0]); //Record Address = Bit 0-3 von Byte 0
    if ( (0x10 & temp[0]) >0)
        putValue(A_ASG_69_0_0_27_Changed_Shift, 1); //Shift = Bit 4 von Byte 0
    else
        putValue(A_ASG_69_0_0_27_Changed_Shift, 0); //Shift = Bit 4 von Byte 0
    if ( (0x20 & temp[0]) >0)
        putValue(A_ASG_69_0_0_27_Changed_Direction, 1); //Direction = Bit 5 von Byte 0
    else
        putValue(A_ASG_69_0_0_27_Changed_Direction, 0); //Direction = Bit 5 von Byte 0
    if ( (0x40 & temp[0]) >0)
        putValue(A_ASG_69_0_0_27_Changed_TransPos, 1); //Transmission Pos = Bit 6 von Byte 0
    else
        putValue(A_ASG_69_0_0_27_Changed_TransPos, 0); //Transmission Pos = Bit 6 von Byte 0
    if ( (0x80 & temp[0]) >0)
        putValue(A_ASG_69_0_0_27_Changed_IndexSize, 1); //IndexSize = Bit 7 von Byte 0
    else
        putValue(A_ASG_69_0_0_27_Changed_IndexSize, 0); //IndexSize = Bit 7 von Byte 0
    if(getValue(A_ASG_69_0_0_27_Changed_IndexSize))
    {
        putValue(A_ASG_69_0_0_27_Changed_Start, ((temp[2]<<8)| temp[1]) ); //Start Wert, 2 Byte lang
        putValue(A_ASG_69_0_0_27_Changed_Elements, ((temp[4]<<8)| temp[3]) ); //Elements Wert, 2 Byte lang
    }
    else
    {
        putValue(A_ASG_69_0_0_27_Changed_Start, temp[1]); //Start Wert, 1 Byte lang
        putValue(A_ASG_69_0_0_27_Changed_Elements, temp[2]); //Start Wert, 1 Byte lang
    }
}
on envVar A_ASG_69_0_0_27_SetGet
{
    byte temp[664];
    getValue(A_ASG_69_0_0_27_SetGet, temp);
    putValue(A_ASG_69_0_0_27_SetGet_RecAdr, 0x0F & temp[0]); //Record Address = Bit 0-3 von Byte 0
    if ( (0x10 & temp[0]) >0)
        putValue(A_ASG_69_0_0_27_SetGet_Shift, 1); //Shift = Bit 4 von Byte 0
    else
        putValue(A_ASG_69_0_0_27_SetGet_Shift, 0); //Shift = Bit 4 von Byte 0
    if ( (0x20 & temp[0]) >0)
        putValue(A_ASG_69_0_0_27_SetGet_Direction, 1); //Direction = Bit 5 von Byte 0
    else
        putValue(A_ASG_69_0_0_27_SetGet_Direction, 0); //Direction = Bit 5 von Byte 0
    // Bit 6 von Byte 0 = reserved
    if ( (0x80 & temp[0]) >0)
        putValue(A_ASG_69_0_0_27_SetGet_IndexSize, 1); //IndexSize = Bit 7 von Byte 0
    else
        putValue(A_ASG_69_0_0_27_SetGet_IndexSize, 0); //IndexSize = Bit 7 von Byte 0
    if(getValue(A_ASG_69_0_0_27_SetGet_IndexSize))
    {
        putValue(A_ASG_69_0_0_27_SetGet_Start, ((temp[2]<<8)| temp[1]) ); //Start Wert, 2 Byte lang
        putValue(A_ASG_69_0_0_27_SetGet_Elements, ((temp[4]<<8)| temp[3]) ); //Elements Wert, 2 Byte lang
    }
    else
    {
        putValue(A_ASG_69_0_0_27_SetGet_Start, temp[1]); //Start Wert, 1 Byte lang
        putValue(A_ASG_69_0_0_27_SetGet_Elements, temp[2]); //Start Wert, 1 Byte lang
    }
}
A_ASG_69_0_0_27_LoadArray()
{
	/********* Statische Deklarationen ***********/
	dword CSVfileHandle;
	dword filePos;
	dword paramPos;
	dword Num_of_csv_byte;
	dword element;
	dword current_CSV_line;
	byte buffer_byte[0xFFFF];
	dword i;
	dword j;
	char CSV_filename[255];

	/********* Param Puffer Deklarationen ***********/
	char temp1[25];
	char temp2[25];
	char temp3[25];
	char temp4[25];
	char temp5[25];
	char temp6[25];
	char temp7[25];
	char temp8[25];
	char temp9[25];
	char temp10[25];
	char temp11[25];
	char temp12[25];
	char temp13[25];
	char temp14[25];
	char temp15[25];
	char temp16[25];
	char temp17[25];
	char temp18[25];
	char temp19[25];

	/********* Initialisierungen ***********/
	CSVfileHandle = 0;
	filePos = 0;
	paramPos = 0;
	Num_of_csv_byte = 0;
	element = 1;
	current_CSV_line = 0;
	for(i = 0; i < A_ASG_69_0_0_27_ArrayDataList_Length; i++)
	{ /* Initialisierung von den Ziel-Strukturen */
		A_ASG_69_0_0_27_ArrayDataList[i].Param1 = 0;
		A_ASG_69_0_0_27_ArrayDataList[i].Param2 = 0;
		A_ASG_69_0_0_27_ArrayDataList[i].Param3 = 0;
		A_ASG_69_0_0_27_ArrayDataList[i].Param4 = 0;
		A_ASG_69_0_0_27_ArrayDataList[i].Param5 = 0;
		A_ASG_69_0_0_27_ArrayDataList[i].Param6 = 0;
		A_ASG_69_0_0_27_ArrayDataList[i].Param7 = 0;
		A_ASG_69_0_0_27_ArrayDataList[i].Param8 = 0;
		A_ASG_69_0_0_27_ArrayDataList[i].Param9 = 0;
		A_ASG_69_0_0_27_ArrayDataList[i].Param10 = 0;
		A_ASG_69_0_0_27_ArrayDataList[i].Param11 = 0;
		A_ASG_69_0_0_27_ArrayDataList[i].Param12 = 0;
		A_ASG_69_0_0_27_ArrayDataList[i].Param13 = 0;
		A_ASG_69_0_0_27_ArrayDataList[i].Param14 = 0;
		A_ASG_69_0_0_27_ArrayDataList[i].Param15 = 0;
		A_ASG_69_0_0_27_ArrayDataList[i].Param16 = 0;
		A_ASG_69_0_0_27_ArrayDataList[i].Param17 = 0;
		A_ASG_69_0_0_27_ArrayDataList[i].Param18 = 0;
		A_ASG_69_0_0_27_ArrayDataList[i].Param19 = 0;
		for(j=0; j<2; j++)
			A_ASG_69_0_0_27_ArrayDataList[i].Param20[j] = 0;
		A_ASG_69_0_0_27_ArrayDataList[i].Param20_Length = 0;
		A_ASG_69_0_0_27_Data_20_LenList[i] = 0;
	}

	/********* Laden der CSV-Datei ***********/
	getValue(A_ASG_69_0_0_27_fileSelector, CSV_filename);
	CSVfileHandle = openFileRead(CSV_filename, 1); //open *.csv (binary-mode ->get the ASCII/UTF-8 code)

	if (CSVfileHandle!=0) //*.csv file access successful
	{
		writelineEx(gBAP_Trace, 0,"Dateizugriff auf '%s' erfolgreich", CSV_filename);    //output result
		//get data from *.csv and store the total number of byte in *.csv-file
		Num_of_csv_byte = fileGetBinaryBlock (buffer_byte, elcount(buffer_byte), CSVfileHandle);

		for (filePos = 0; filePos < Num_of_csv_byte; filePos++) //copy data into "LastDestList"
		{
			if (buffer_byte[filePos] != 0x3B) //read data if no ";" is detected
			{
				//nextline in *.csv (next "record element" in LastDestList) -> "LF" and "CR" detected -> copy (transform string -> long) data from help values in global values
				if(buffer_byte[filePos] == 0x0D && buffer_byte[filePos+1] == 0x0A)
				{
					if(current_CSV_line > 0 && current_CSV_line < 255) //ignore first line in *.csv file
					{
						A_ASG_69_0_0_27_ArrayDataList[current_CSV_line-1].Param1 = atol(temp1); //Pos
						A_ASG_69_0_0_27_ArrayDataList[current_CSV_line-1].Param2 = atol(temp2); //State
						A_ASG_69_0_0_27_ArrayDataList[current_CSV_line-1].Param3 = atol(temp3); //DisplayPresetType
						A_ASG_69_0_0_27_ArrayDataList[current_CSV_line-1].Param4 = atol(temp4); //DisplayPresetInstance
						A_ASG_69_0_0_27_ArrayDataList[current_CSV_line-1].Param5 = atol(temp5); //Display1MainSelection
						A_ASG_69_0_0_27_ArrayDataList[current_CSV_line-1].Param6 = atol(temp6); //Display1AdditionalInfo1_1
						A_ASG_69_0_0_27_ArrayDataList[current_CSV_line-1].Param7 = atol(temp7); //Display1AdditionalInfo1_2
						A_ASG_69_0_0_27_ArrayDataList[current_CSV_line-1].Param8 = atol(temp8); //Display1AdditionalInfo2_1
						A_ASG_69_0_0_27_ArrayDataList[current_CSV_line-1].Param9 = atol(temp9); //Display1AdditionalInfo2_2
						A_ASG_69_0_0_27_ArrayDataList[current_CSV_line-1].Param10 = atol(temp10); //Display2MainSelection
						A_ASG_69_0_0_27_ArrayDataList[current_CSV_line-1].Param11 = atol(temp11); //Display2AdditionalInfo1_1
						A_ASG_69_0_0_27_ArrayDataList[current_CSV_line-1].Param12 = atol(temp12); //Display2AdditionalInfo1_2
						A_ASG_69_0_0_27_ArrayDataList[current_CSV_line-1].Param13 = atol(temp13); //Display2AdditionalInfo2_1
						A_ASG_69_0_0_27_ArrayDataList[current_CSV_line-1].Param14 = atol(temp14); //Display2AdditionalInfo2_2
						A_ASG_69_0_0_27_ArrayDataList[current_CSV_line-1].Param15 = atol(temp15); //Display3MainSelection
						A_ASG_69_0_0_27_ArrayDataList[current_CSV_line-1].Param16 = atol(temp16); //Display3AdditionalInfo1_1
						A_ASG_69_0_0_27_ArrayDataList[current_CSV_line-1].Param17 = atol(temp17); //Display3AdditionalInfo1_2
						A_ASG_69_0_0_27_ArrayDataList[current_CSV_line-1].Param18 = atol(temp18); //Display3AdditionalInfo2_1
						A_ASG_69_0_0_27_ArrayDataList[current_CSV_line-1].Param19 = atol(temp19); //Display3AdditionalInfo2_2
						for(i = 0; i < 25; i++)
						{ /* Temp-Puffer Initialisierung zur Vermeidung von Nebeneffekte */
							temp1[i]=0;
							temp2[i]=0;
							temp3[i]=0;
							temp4[i]=0;
							temp5[i]=0;
							temp6[i]=0;
							temp7[i]=0;
							temp8[i]=0;
							temp9[i]=0;
							temp10[i]=0;
							temp11[i]=0;
							temp12[i]=0;
							temp13[i]=0;
							temp14[i]=0;
							temp15[i]=0;
							temp16[i]=0;
							temp17[i]=0;
							temp18[i]=0;
							temp19[i]=0;
						}
					}
					current_CSV_line++; //next line in *.csv file
					element = 1; //start at 'POS' (first record element of "array data")
					paramPos = 0; //reset value
				}
 				//copy data from "buffer_byte" (data from *.csv file) in help values and "name" until end of line is not detected
				else if(current_CSV_line > 0 && current_CSV_line < 255)
				{
					//writelineEx(gBAP_Trace, 0, "Element %x  Index %x", element, j);
					switch (element)
					{
						case 1: //Pos
								if( paramPos >= elCount(temp1) ){
									writelineEx(gBAP_Trace, 0, "Param%x in Zeile %d in der Input CSV Datei, enthaelt mehr Zeichen als erlaubt. Bearbeitung abgebrochen!", element, current_CSV_line);
									return; //False
								}else{
									temp1[paramPos] = buffer_byte[filePos];
									paramPos++;
								}
							break;
						case 2: //State
								if( paramPos >= elCount(temp2) ){
									writelineEx(gBAP_Trace, 0, "Param%x in Zeile %d in der Input CSV Datei, enthaelt mehr Zeichen als erlaubt. Bearbeitung abgebrochen!", element, current_CSV_line);
									return; //False
								}else{
									temp2[paramPos] = buffer_byte[filePos];
									paramPos++;
								}
							break;
						case 3: //DisplayPresetType
								if( paramPos >= elCount(temp3) ){
									writelineEx(gBAP_Trace, 0, "Param%x in Zeile %d in der Input CSV Datei, enthaelt mehr Zeichen als erlaubt. Bearbeitung abgebrochen!", element, current_CSV_line);
									return; //False
								}else{
									temp3[paramPos] = buffer_byte[filePos];
									paramPos++;
								}
							break;
						case 4: //DisplayPresetInstance
								if( paramPos >= elCount(temp4) ){
									writelineEx(gBAP_Trace, 0, "Param%x in Zeile %d in der Input CSV Datei, enthaelt mehr Zeichen als erlaubt. Bearbeitung abgebrochen!", element, current_CSV_line);
									return; //False
								}else{
									temp4[paramPos] = buffer_byte[filePos];
									paramPos++;
								}
							break;
						case 5: //Display1MainSelection
								if( paramPos >= elCount(temp5) ){
									writelineEx(gBAP_Trace, 0, "Param%x in Zeile %d in der Input CSV Datei, enthaelt mehr Zeichen als erlaubt. Bearbeitung abgebrochen!", element, current_CSV_line);
									return; //False
								}else{
									temp5[paramPos] = buffer_byte[filePos];
									paramPos++;
								}
							break;
						case 6: //Display1AdditionalInfo1_1
								if( paramPos >= elCount(temp6) ){
									writelineEx(gBAP_Trace, 0, "Param%x in Zeile %d in der Input CSV Datei, enthaelt mehr Zeichen als erlaubt. Bearbeitung abgebrochen!", element, current_CSV_line);
									return; //False
								}else{
									temp6[paramPos] = buffer_byte[filePos];
									paramPos++;
								}
							break;
						case 7: //Display1AdditionalInfo1_2
								if( paramPos >= elCount(temp7) ){
									writelineEx(gBAP_Trace, 0, "Param%x in Zeile %d in der Input CSV Datei, enthaelt mehr Zeichen als erlaubt. Bearbeitung abgebrochen!", element, current_CSV_line);
									return; //False
								}else{
									temp7[paramPos] = buffer_byte[filePos];
									paramPos++;
								}
							break;
						case 8: //Display1AdditionalInfo2_1
								if( paramPos >= elCount(temp8) ){
									writelineEx(gBAP_Trace, 0, "Param%x in Zeile %d in der Input CSV Datei, enthaelt mehr Zeichen als erlaubt. Bearbeitung abgebrochen!", element, current_CSV_line);
									return; //False
								}else{
									temp8[paramPos] = buffer_byte[filePos];
									paramPos++;
								}
							break;
						case 9: //Display1AdditionalInfo2_2
								if( paramPos >= elCount(temp9) ){
									writelineEx(gBAP_Trace, 0, "Param%x in Zeile %d in der Input CSV Datei, enthaelt mehr Zeichen als erlaubt. Bearbeitung abgebrochen!", element, current_CSV_line);
									return; //False
								}else{
									temp9[paramPos] = buffer_byte[filePos];
									paramPos++;
								}
							break;
						case 10: //Display2MainSelection
								if( paramPos >= elCount(temp10) ){
									writelineEx(gBAP_Trace, 0, "Param%x in Zeile %d in der Input CSV Datei, enthaelt mehr Zeichen als erlaubt. Bearbeitung abgebrochen!", element, current_CSV_line);
									return; //False
								}else{
									temp10[paramPos] = buffer_byte[filePos];
									paramPos++;
								}
							break;
						case 11: //Display2AdditionalInfo1_1
								if( paramPos >= elCount(temp11) ){
									writelineEx(gBAP_Trace, 0, "Param%x in Zeile %d in der Input CSV Datei, enthaelt mehr Zeichen als erlaubt. Bearbeitung abgebrochen!", element, current_CSV_line);
									return; //False
								}else{
									temp11[paramPos] = buffer_byte[filePos];
									paramPos++;
								}
							break;
						case 12: //Display2AdditionalInfo1_2
								if( paramPos >= elCount(temp12) ){
									writelineEx(gBAP_Trace, 0, "Param%x in Zeile %d in der Input CSV Datei, enthaelt mehr Zeichen als erlaubt. Bearbeitung abgebrochen!", element, current_CSV_line);
									return; //False
								}else{
									temp12[paramPos] = buffer_byte[filePos];
									paramPos++;
								}
							break;
						case 13: //Display2AdditionalInfo2_1
								if( paramPos >= elCount(temp13) ){
									writelineEx(gBAP_Trace, 0, "Param%x in Zeile %d in der Input CSV Datei, enthaelt mehr Zeichen als erlaubt. Bearbeitung abgebrochen!", element, current_CSV_line);
									return; //False
								}else{
									temp13[paramPos] = buffer_byte[filePos];
									paramPos++;
								}
							break;
						case 14: //Display2AdditionalInfo2_2
								if( paramPos >= elCount(temp14) ){
									writelineEx(gBAP_Trace, 0, "Param%x in Zeile %d in der Input CSV Datei, enthaelt mehr Zeichen als erlaubt. Bearbeitung abgebrochen!", element, current_CSV_line);
									return; //False
								}else{
									temp14[paramPos] = buffer_byte[filePos];
									paramPos++;
								}
							break;
						case 15: //Display3MainSelection
								if( paramPos >= elCount(temp15) ){
									writelineEx(gBAP_Trace, 0, "Param%x in Zeile %d in der Input CSV Datei, enthaelt mehr Zeichen als erlaubt. Bearbeitung abgebrochen!", element, current_CSV_line);
									return; //False
								}else{
									temp15[paramPos] = buffer_byte[filePos];
									paramPos++;
								}
							break;
						case 16: //Display3AdditionalInfo1_1
								if( paramPos >= elCount(temp16) ){
									writelineEx(gBAP_Trace, 0, "Param%x in Zeile %d in der Input CSV Datei, enthaelt mehr Zeichen als erlaubt. Bearbeitung abgebrochen!", element, current_CSV_line);
									return; //False
								}else{
									temp16[paramPos] = buffer_byte[filePos];
									paramPos++;
								}
							break;
						case 17: //Display3AdditionalInfo1_2
								if( paramPos >= elCount(temp17) ){
									writelineEx(gBAP_Trace, 0, "Param%x in Zeile %d in der Input CSV Datei, enthaelt mehr Zeichen als erlaubt. Bearbeitung abgebrochen!", element, current_CSV_line);
									return; //False
								}else{
									temp17[paramPos] = buffer_byte[filePos];
									paramPos++;
								}
							break;
						case 18: //Display3AdditionalInfo2_1
								if( paramPos >= elCount(temp18) ){
									writelineEx(gBAP_Trace, 0, "Param%x in Zeile %d in der Input CSV Datei, enthaelt mehr Zeichen als erlaubt. Bearbeitung abgebrochen!", element, current_CSV_line);
									return; //False
								}else{
									temp18[paramPos] = buffer_byte[filePos];
									paramPos++;
								}
							break;
						case 19: //Display3AdditionalInfo2_2
								if( paramPos >= elCount(temp19) ){
									writelineEx(gBAP_Trace, 0, "Param%x in Zeile %d in der Input CSV Datei, enthaelt mehr Zeichen als erlaubt. Bearbeitung abgebrochen!", element, current_CSV_line);
									return; //False
								}else{
									temp19[paramPos] = buffer_byte[filePos];
									paramPos++;
								}
							break;
						case 20: //Extension
								if(paramPos < 1)
								{
									A_ASG_69_0_0_27_ArrayDataList[current_CSV_line-1].Param20[paramPos] = buffer_byte[filePos];
									A_ASG_69_0_0_27_ArrayDataList[current_CSV_line-1].Param20_Length = paramPos +1;
								}
								paramPos++;
						break;
						default:
						break;
					}
				}
			}
			else  // ";" is detected ->next record element of "array data"
			{
				//writelineEx(gBAP_Trace, 0, "naechstes Element %d Bytes",element);
				element++;
				paramPos=0; //reset value
			}
		}

		if(fileClose (CSVfileHandle) !=0) //close *.csv file
			writelineEx(gBAP_Trace, 0,"Datei '%s' geschlossen", CSV_filename); //output result
		else
			writelineEx(gBAP_Trace, 0,"Fehler beim Schliessen der Datei '%s'", CSV_filename);//output result
	}
	else //*.csv file access not successful
	{
		writelineEx(gBAP_Trace, 0,"Fehler beim Dateizugriff auf '%s'",CSV_filename); //output result
	}
}

on envVar A_ASG_69_0_0_27_loadArray_Btn
{
	char filePath[255];
	if (A_ASG_69_0_0_27_generateData_Btn_already_pressed == 0)
	{
		A_ASG_69_0_0_27_generateData_Btn_already_pressed = 1;
	}
	else
	{
		A_ASG_69_0_0_27_generateData_Btn_already_pressed = 0;
		getValue(A_ASG_69_0_0_27_fileSelector, filePath);
		if(0 == strlen(filePath))
		{
			writelineEx(gBAP_Trace, 0, "Invalid file path!");
		}
		else
		{
			A_ASG_69_0_0_27_LoadArray();
			writelineEx(gBAP_Trace, 0, "Load array from CSV file: %s", filePath);
		}
	}
	putValue(A_ASG_69_0_0_27_Data_1, A_ASG_69_0_0_27_ArrayDataList[ getValue( A_ASG_69_0_0_27_DataIndex) ].Param1);
	putValue(A_ASG_69_0_0_27_Data_2, A_ASG_69_0_0_27_ArrayDataList[ getValue( A_ASG_69_0_0_27_DataIndex) ].Param2);
	putValue(A_ASG_69_0_0_27_Data_3, A_ASG_69_0_0_27_ArrayDataList[ getValue( A_ASG_69_0_0_27_DataIndex) ].Param3);
	putValue(A_ASG_69_0_0_27_Data_4, A_ASG_69_0_0_27_ArrayDataList[ getValue( A_ASG_69_0_0_27_DataIndex) ].Param4);
	putValue(A_ASG_69_0_0_27_Data_5, A_ASG_69_0_0_27_ArrayDataList[ getValue( A_ASG_69_0_0_27_DataIndex) ].Param5);
	putValue(A_ASG_69_0_0_27_Data_6, A_ASG_69_0_0_27_ArrayDataList[ getValue( A_ASG_69_0_0_27_DataIndex) ].Param6);
	putValue(A_ASG_69_0_0_27_Data_7, A_ASG_69_0_0_27_ArrayDataList[ getValue( A_ASG_69_0_0_27_DataIndex) ].Param7);
	putValue(A_ASG_69_0_0_27_Data_8, A_ASG_69_0_0_27_ArrayDataList[ getValue( A_ASG_69_0_0_27_DataIndex) ].Param8);
	putValue(A_ASG_69_0_0_27_Data_9, A_ASG_69_0_0_27_ArrayDataList[ getValue( A_ASG_69_0_0_27_DataIndex) ].Param9);
	putValue(A_ASG_69_0_0_27_Data_10, A_ASG_69_0_0_27_ArrayDataList[ getValue( A_ASG_69_0_0_27_DataIndex) ].Param10);
	putValue(A_ASG_69_0_0_27_Data_11, A_ASG_69_0_0_27_ArrayDataList[ getValue( A_ASG_69_0_0_27_DataIndex) ].Param11);
	putValue(A_ASG_69_0_0_27_Data_12, A_ASG_69_0_0_27_ArrayDataList[ getValue( A_ASG_69_0_0_27_DataIndex) ].Param12);
	putValue(A_ASG_69_0_0_27_Data_13, A_ASG_69_0_0_27_ArrayDataList[ getValue( A_ASG_69_0_0_27_DataIndex) ].Param13);
	putValue(A_ASG_69_0_0_27_Data_14, A_ASG_69_0_0_27_ArrayDataList[ getValue( A_ASG_69_0_0_27_DataIndex) ].Param14);
	putValue(A_ASG_69_0_0_27_Data_15, A_ASG_69_0_0_27_ArrayDataList[ getValue( A_ASG_69_0_0_27_DataIndex) ].Param15);
	putValue(A_ASG_69_0_0_27_Data_16, A_ASG_69_0_0_27_ArrayDataList[ getValue( A_ASG_69_0_0_27_DataIndex) ].Param16);
	putValue(A_ASG_69_0_0_27_Data_17, A_ASG_69_0_0_27_ArrayDataList[ getValue( A_ASG_69_0_0_27_DataIndex) ].Param17);
	putValue(A_ASG_69_0_0_27_Data_18, A_ASG_69_0_0_27_ArrayDataList[ getValue( A_ASG_69_0_0_27_DataIndex) ].Param18);
	putValue(A_ASG_69_0_0_27_Data_19, A_ASG_69_0_0_27_ArrayDataList[ getValue( A_ASG_69_0_0_27_DataIndex) ].Param19);
	putValue(A_ASG_69_0_0_27_Data_20, A_ASG_69_0_0_27_ArrayDataList[ getValue( A_ASG_69_0_0_27_DataIndex) ].Param20, A_ASG_69_0_0_27_ArrayDataList[getValue(A_ASG_69_0_0_27_DataIndex)].Param20_Length);
}


on envVar A_ASG_69_0_0_27_generateData_Btn
{
	word i;
	dword elementsArray[21] = {1, 1, 1, 1, 4, 4, 4, 4, 4, 4, 4, 4, 4, 4, 4, 4, 4, 4, 4, 2, 2};
	byte elementsTypeArray[21] = {0, 0, 0, 0, 0, 0, 0, 0, 0, 0, 0, 0, 0, 0, 0, 0, 0, 0, 0, 0xE, 0xF};
	dword elementsMaxSizeArray[21] = {254, 0xFF, 0xFF, 255, 0xFFFFFFFF, 0xFFFFFFFF, 0xFFFFFFFF, 0xFFFFFFFF, 0xFFFFFFFF, 0xFFFFFFFF, 0xFFFFFFFF, 0xFFFFFFFF, 0xFFFFFFFF, 0xFFFFFFFF, 0xFFFFFFFF, 0xFFFFFFFF, 0xFFFFFFFF, 0xFFFFFFFF, 0xFFFFFFFF, 0, 0};
	byte tempArray[17272];
	if (A_ASG_69_0_0_27_generateData_Btn_already_pressed == 0)
	{
		A_ASG_69_0_0_27_generateData_Btn_already_pressed = 1;
	}
	else
	{
		initStruct(tempArray, elementsArray, elementsTypeArray, elementsMaxSizeArray, 27, 254 );
		for(i = 0; i < 254; i++)
		{
			memcpy(A_ASG_69_0_0_27_ArrayDataList[i], tempArray, (i * 68) );
			if(A_ASG_69_0_0_27_ArrayDataList[i].Param20_Length > 127 )
				A_ASG_69_0_0_27_Data_20_CntList[i] = 1;
		}
		A_ASG_69_0_0_27_generateData_Btn_already_pressed = 0;
	}
	putValue(A_ASG_69_0_0_27_Data_1, A_ASG_69_0_0_27_ArrayDataList[ getValue( A_ASG_69_0_0_27_DataIndex) ].Param1);
	putValue(A_ASG_69_0_0_27_Data_2, A_ASG_69_0_0_27_ArrayDataList[ getValue( A_ASG_69_0_0_27_DataIndex) ].Param2);
	putValue(A_ASG_69_0_0_27_Data_3, A_ASG_69_0_0_27_ArrayDataList[ getValue( A_ASG_69_0_0_27_DataIndex) ].Param3);
	putValue(A_ASG_69_0_0_27_Data_4, A_ASG_69_0_0_27_ArrayDataList[ getValue( A_ASG_69_0_0_27_DataIndex) ].Param4);
	putValue(A_ASG_69_0_0_27_Data_5, A_ASG_69_0_0_27_ArrayDataList[ getValue( A_ASG_69_0_0_27_DataIndex) ].Param5);
	putValue(A_ASG_69_0_0_27_Data_6, A_ASG_69_0_0_27_ArrayDataList[ getValue( A_ASG_69_0_0_27_DataIndex) ].Param6);
	putValue(A_ASG_69_0_0_27_Data_7, A_ASG_69_0_0_27_ArrayDataList[ getValue( A_ASG_69_0_0_27_DataIndex) ].Param7);
	putValue(A_ASG_69_0_0_27_Data_8, A_ASG_69_0_0_27_ArrayDataList[ getValue( A_ASG_69_0_0_27_DataIndex) ].Param8);
	putValue(A_ASG_69_0_0_27_Data_9, A_ASG_69_0_0_27_ArrayDataList[ getValue( A_ASG_69_0_0_27_DataIndex) ].Param9);
	putValue(A_ASG_69_0_0_27_Data_10, A_ASG_69_0_0_27_ArrayDataList[ getValue( A_ASG_69_0_0_27_DataIndex) ].Param10);
	putValue(A_ASG_69_0_0_27_Data_11, A_ASG_69_0_0_27_ArrayDataList[ getValue( A_ASG_69_0_0_27_DataIndex) ].Param11);
	putValue(A_ASG_69_0_0_27_Data_12, A_ASG_69_0_0_27_ArrayDataList[ getValue( A_ASG_69_0_0_27_DataIndex) ].Param12);
	putValue(A_ASG_69_0_0_27_Data_13, A_ASG_69_0_0_27_ArrayDataList[ getValue( A_ASG_69_0_0_27_DataIndex) ].Param13);
	putValue(A_ASG_69_0_0_27_Data_14, A_ASG_69_0_0_27_ArrayDataList[ getValue( A_ASG_69_0_0_27_DataIndex) ].Param14);
	putValue(A_ASG_69_0_0_27_Data_15, A_ASG_69_0_0_27_ArrayDataList[ getValue( A_ASG_69_0_0_27_DataIndex) ].Param15);
	putValue(A_ASG_69_0_0_27_Data_16, A_ASG_69_0_0_27_ArrayDataList[ getValue( A_ASG_69_0_0_27_DataIndex) ].Param16);
	putValue(A_ASG_69_0_0_27_Data_17, A_ASG_69_0_0_27_ArrayDataList[ getValue( A_ASG_69_0_0_27_DataIndex) ].Param17);
	putValue(A_ASG_69_0_0_27_Data_18, A_ASG_69_0_0_27_ArrayDataList[ getValue( A_ASG_69_0_0_27_DataIndex) ].Param18);
	putValue(A_ASG_69_0_0_27_Data_19, A_ASG_69_0_0_27_ArrayDataList[ getValue( A_ASG_69_0_0_27_DataIndex) ].Param19);
	putValue(A_ASG_69_0_0_27_Data_20, A_ASG_69_0_0_27_ArrayDataList[ getValue( A_ASG_69_0_0_27_DataIndex) ].Param20, A_ASG_69_0_0_27_ArrayDataList[getValue(A_ASG_69_0_0_27_DataIndex)].Param20_Length);
}
// HME generateCaplOnEnv (3131)
on envVar A_ASG_69_0_0_27_DataIndex
{
    long index;
    long maxIndex = 254-1;
    index = getValue(this);
    if(index >= maxIndex) index = maxIndex;
    else if(index < 0) index = 0;
    putValue(this, index);
    putValue(A_ASG_69_0_0_27_Data_1, A_ASG_69_0_0_27_ArrayDataList[index].Param1);
    putValue(A_ASG_69_0_0_27_Data_2, A_ASG_69_0_0_27_ArrayDataList[index].Param2);
    putValue(A_ASG_69_0_0_27_Data_3, A_ASG_69_0_0_27_ArrayDataList[index].Param3);
    putValue(A_ASG_69_0_0_27_Data_4, A_ASG_69_0_0_27_ArrayDataList[index].Param4);
    putValue(A_ASG_69_0_0_27_Data_5, A_ASG_69_0_0_27_ArrayDataList[index].Param5);
    putValue(A_ASG_69_0_0_27_Data_6, A_ASG_69_0_0_27_ArrayDataList[index].Param6);
    putValue(A_ASG_69_0_0_27_Data_7, A_ASG_69_0_0_27_ArrayDataList[index].Param7);
    putValue(A_ASG_69_0_0_27_Data_8, A_ASG_69_0_0_27_ArrayDataList[index].Param8);
    putValue(A_ASG_69_0_0_27_Data_9, A_ASG_69_0_0_27_ArrayDataList[index].Param9);
    putValue(A_ASG_69_0_0_27_Data_10, A_ASG_69_0_0_27_ArrayDataList[index].Param10);
    putValue(A_ASG_69_0_0_27_Data_11, A_ASG_69_0_0_27_ArrayDataList[index].Param11);
    putValue(A_ASG_69_0_0_27_Data_12, A_ASG_69_0_0_27_ArrayDataList[index].Param12);
    putValue(A_ASG_69_0_0_27_Data_13, A_ASG_69_0_0_27_ArrayDataList[index].Param13);
    putValue(A_ASG_69_0_0_27_Data_14, A_ASG_69_0_0_27_ArrayDataList[index].Param14);
    putValue(A_ASG_69_0_0_27_Data_15, A_ASG_69_0_0_27_ArrayDataList[index].Param15);
    putValue(A_ASG_69_0_0_27_Data_16, A_ASG_69_0_0_27_ArrayDataList[index].Param16);
    putValue(A_ASG_69_0_0_27_Data_17, A_ASG_69_0_0_27_ArrayDataList[index].Param17);
    putValue(A_ASG_69_0_0_27_Data_18, A_ASG_69_0_0_27_ArrayDataList[index].Param18);
    putValue(A_ASG_69_0_0_27_Data_19, A_ASG_69_0_0_27_ArrayDataList[index].Param19);
    putValue(A_ASG_69_0_0_27_Data_20_len, A_ASG_69_0_0_27_Data_20_LenList[index]);
    putValue(A_ASG_69_0_0_27_Data_20_cnt, A_ASG_69_0_0_27_Data_20_CntList[index]);
    putValue(A_ASG_69_0_0_27_Data_20, A_ASG_69_0_0_27_ArrayDataList[index].Param20, A_ASG_69_0_0_27_ArrayDataList[index].Param20_Length);

}
on envVar A_ASG_69_0_0_27_DataIndex_Incr
{
    long index;
    if(A_ASG_69_0_0_27_DataIndex_Incr_already_pressed == 0)
    {
        A_ASG_69_0_0_27_DataIndex_Incr_already_pressed = 1;
    }
    else
    {
        index = getValue(A_ASG_69_0_0_27_DataIndex);
        index++;
        putValue(A_ASG_69_0_0_27_DataIndex, index);
        A_ASG_69_0_0_27_DataIndex_Incr_already_pressed = 0;
    }
}
on envVar A_ASG_69_0_0_27_DataIndex_Decr
{
    long index;
    if(A_ASG_69_0_0_27_DataIndex_Decr_already_pressed == 0)
    {
        A_ASG_69_0_0_27_DataIndex_Decr_already_pressed = 1;
    }
    else
    {
        index = getValue(A_ASG_69_0_0_27_DataIndex);
        index--;
        putValue(A_ASG_69_0_0_27_DataIndex, index);
        A_ASG_69_0_0_27_DataIndex_Decr_already_pressed = 0;
    }
}
// HME generateCaplOnEnv (3160)
on envVar A_ASG_69_0_0_27_DataIndex_SetGet
{
    long index;
    long maxIndex = 254-1;
    index = getValue(this);
    if(index >= maxIndex) index = maxIndex;
    else if(index < 0) index = 0;
    putValue(this, index);
    putValue(A_ASG_69_0_0_27_Data_1_SetGet, A_ASG_69_0_0_27_ArrayDataList[index].Param1);
    putValue(A_ASG_69_0_0_27_Data_2_SetGet, A_ASG_69_0_0_27_ArrayDataList[index].Param2);
    putValue(A_ASG_69_0_0_27_Data_3_SetGet, A_ASG_69_0_0_27_ArrayDataList[index].Param3);
    putValue(A_ASG_69_0_0_27_Data_4_SetGet, A_ASG_69_0_0_27_ArrayDataList[index].Param4);
    putValue(A_ASG_69_0_0_27_Data_5_SetGet, A_ASG_69_0_0_27_ArrayDataList[index].Param5);
    putValue(A_ASG_69_0_0_27_Data_6_SetGet, A_ASG_69_0_0_27_ArrayDataList[index].Param6);
    putValue(A_ASG_69_0_0_27_Data_7_SetGet, A_ASG_69_0_0_27_ArrayDataList[index].Param7);
    putValue(A_ASG_69_0_0_27_Data_8_SetGet, A_ASG_69_0_0_27_ArrayDataList[index].Param8);
    putValue(A_ASG_69_0_0_27_Data_9_SetGet, A_ASG_69_0_0_27_ArrayDataList[index].Param9);
    putValue(A_ASG_69_0_0_27_Data_10_SetGet, A_ASG_69_0_0_27_ArrayDataList[index].Param10);
    putValue(A_ASG_69_0_0_27_Data_11_SetGet, A_ASG_69_0_0_27_ArrayDataList[index].Param11);
    putValue(A_ASG_69_0_0_27_Data_12_SetGet, A_ASG_69_0_0_27_ArrayDataList[index].Param12);
    putValue(A_ASG_69_0_0_27_Data_13_SetGet, A_ASG_69_0_0_27_ArrayDataList[index].Param13);
    putValue(A_ASG_69_0_0_27_Data_14_SetGet, A_ASG_69_0_0_27_ArrayDataList[index].Param14);
    putValue(A_ASG_69_0_0_27_Data_15_SetGet, A_ASG_69_0_0_27_ArrayDataList[index].Param15);
    putValue(A_ASG_69_0_0_27_Data_16_SetGet, A_ASG_69_0_0_27_ArrayDataList[index].Param16);
    putValue(A_ASG_69_0_0_27_Data_17_SetGet, A_ASG_69_0_0_27_ArrayDataList[index].Param17);
    putValue(A_ASG_69_0_0_27_Data_18_SetGet, A_ASG_69_0_0_27_ArrayDataList[index].Param18);
    putValue(A_ASG_69_0_0_27_Data_19_SetGet, A_ASG_69_0_0_27_ArrayDataList[index].Param19);
    putValue(A_ASG_69_0_0_27_Data_20_SetGet_len, A_ASG_69_0_0_27_Data_20_SetGet_LenList[index]);
    putValue(A_ASG_69_0_0_27_Data_20_SetGet_cnt, A_ASG_69_0_0_27_Data_20_SetGet_CntList[index]);
    putValue(A_ASG_69_0_0_27_Data_20_SetGet, A_ASG_69_0_0_27_ArrayDataList[index].Param20, A_ASG_69_0_0_27_ArrayDataList[index].Param20_Length);

}
on envVar A_ASG_69_0_0_27_DataIndex_SetGet_Incr
{
    long index;
    if(A_ASG_69_0_0_27_DataIndex_SetGet_Incr_already_pressed == 0)
    {
        A_ASG_69_0_0_27_DataIndex_SetGet_Incr_already_pressed = 1;
    }
    else
    {
        index = getValue(A_ASG_69_0_0_27_DataIndex_SetGet);
        index++;
        putValue(A_ASG_69_0_0_27_DataIndex_SetGet, index);
        A_ASG_69_0_0_27_DataIndex_SetGet_Incr_already_pressed = 0;
    }
}
on envVar A_ASG_69_0_0_27_DataIndex_SetGet_Decr
{
    long index;
    if(A_ASG_69_0_0_27_DataIndex_SetGet_Decr_already_pressed == 0)
    {
        A_ASG_69_0_0_27_DataIndex_SetGet_Decr_already_pressed = 1;
    }
    else
    {
        index = getValue(A_ASG_69_0_0_27_DataIndex_SetGet);
        index--;
        putValue(A_ASG_69_0_0_27_DataIndex_SetGet, index);
        A_ASG_69_0_0_27_DataIndex_SetGet_Decr_already_pressed = 0;
    }
}
// Man darf gleichzeitig nur Checkbox fuer SegmError oder IntertelegramError aktiviert werden
on envVar A_ASG_69_0_0_27_IntTlgEn
{
       if(getValue(this)) 
       {
           putValue(A_ASG_69_0_0_27_SegmEn,0);
           intertelegram_err(A_ASG_69_0_0_27_ID);
       }
       else
       {
           intertelegram_err_off(A_ASG_69_0_0_27_ID);
       }
}
// Man darf gleichzeitig nur Checkbox fuer SegmError oder IntertelegramError aktiviert werden
on envVar A_ASG_69_0_0_27_SegmEn
{
       if(getValue(this)) 
       {
           putValue(A_ASG_69_0_0_27_IntTlgEn,0);
           sequence_err(A_ASG_69_0_0_27_ID,getValueSize(A_ASG_69_0_0_27_SegmEn));
       }
       else
       {
              sequence_err_off(A_ASG_69_0_0_27_ID);
       }
}

// [XL] Ueberwachung der CheckBox fuer AT
on envVar A_ASG_69_0_0_27_AT
{
	if(getValue(this))
	{
		EnableControl(panel_name,"panel_A_ASG_69_0_0_27_Status",0);
	}
	else
	{
   	EnableControl(panel_name,"panel_A_ASG_69_0_0_27_Status",1);
 	}
}

A_ASG_69_0_0_27_DataInd()
{
    int currentPos;
    byte head[5];
    byte stringTempValue[665];
    int i;
    int j;
    int startVal;
    int elementsVal;
    byte recordAddressVal;
    byte transmitPosVal;
    long tempValue;
    long index;
    byte nibbleSetted;
    currentPos = 0;
    nibbleSetted = 0;
    //Einzelparameter: ASG_ID
    if(nibbleSetted == 1)
    {
        //voriger Parameter war ein Nibble, => second nibble, Pos incr und Flag zuruecksetzen
        tempValue = (gBAP_Indication_data[currentPos++] &0xF);
        nibbleSetted = 0;
    }
    else
    {
        //first nibble, kein increment, Flag setzen
        tempValue = ((gBAP_Indication_data[currentPos]>>4) &0xF);
        nibbleSetted = 1;
    }
    putValue(A_ASG_69_0_0_27_1, tempValue);
    //Einzelparameter: TAID
    if(nibbleSetted == 1)
    {
        //voriger Parameter war ein Nibble, => second nibble, Pos incr und Flag zuruecksetzen
        tempValue = (gBAP_Indication_data[currentPos++] &0xF);
        nibbleSetted = 0;
    }
    else
    {
        //first nibble, kein increment, Flag setzen
        tempValue = ((gBAP_Indication_data[currentPos]>>4) &0xF);
        nibbleSetted = 1;
    }
    putValue(A_ASG_69_0_0_27_2, tempValue);
    //Einzelparameter: TotalNumListElements
    //voriger Parameter war ein first nibble, bei 1 Byte Werten Position incr
    if(nibbleSetted == 1) currentPos++;
    nibbleSetted = 0;
    tempValue = gBAP_Indication_data[currentPos++];
    putValue(A_ASG_69_0_0_27_3, tempValue);
    //head Parameter
    if(gBAP_Indication_header[4] >= (3+currentPos))
    {
        if( (gBAP_Indication_data[currentPos] & 0x80) > 0)
            if(gBAP_Indication_header[4] >= (5+currentPos))
            {
                for(i = 0; i < 5; i++) head[i] = gBAP_Indication_data[currentPos++];
                putValue(A_ASG_69_0_0_27, head, 5);
                startVal = (head[2]<<8) | head[1];
                elementsVal = (head[4]<<8) | head[3];
            }
            else write("received Data Error");
        else
        {
            for(i = 0; i < 3; i++) head[i] = gBAP_Indication_data[currentPos++];
            putValue(A_ASG_69_0_0_27, head, 3);
                startVal = head[1];
                elementsVal = head[2];
        }
        recordAddressVal = head[0] & 0x0F;
        transmitPosVal = head[0] & 0x40;
    }
    //data Parameter
     nibbleSetted = 0;
    if( (head[0] & 0x20) == 0) { // array header: increasing indices (Direction = 0).
      if( (head[0] & 0x10) > 0) { // array header: first element is one after specified start element (Shift = 1, Direction = 0).
        startVal++;
      }
      for ( i = startVal ; i < startVal + elementsVal ; i++) {
        if ( i < 0 || i >= A_ASG_69_0_0_27_ArrayDataList_Length ) {
          write("Array index ausserhalb der Grenzen, Fct: 27");
          break;
        }
        if(nibbleSetted == 1) currentPos++;
        nibbleSetted = 0;
     if( (head[0]&0x40) == 0){ /* Transmit_Pos = 0, keine Positionsdaten */ }
     else
     {
        if( (head[0]&0x80) == 0)
        {
           //IndexSize = 0, Pos als 1 Byte Wert
           A_ASG_69_0_0_27_ArrayDataList[i].Param1 = gBAP_Indication_data[currentPos++];
        }
        else
        {
           //IndexSize = 1, Pos als 2 Byte Wert
           A_ASG_69_0_0_27_ArrayDataList[i].Param1 = ( gBAP_Indication_data[currentPos++] &0xFF) + ((gBAP_Indication_data[currentPos++] &0xFF)<<8);
        }
     }
      // 0 - es kann vorkommen, dass das if leer ist dies wuerde zum Fehler fuehren. => automatische generierung der 0
      if( 0 || 1 == recordAddressVal || 2 == recordAddressVal )
      {
        //Sollte vor einem 1 Byte Wert 1 Nibble kommen, muss der index um 1 incrementiert werden!
        if( nibbleSetted==1) currentPos++;
        nibbleSetted = 0;
        A_ASG_69_0_0_27_ArrayDataList[i].Param2 = (gBAP_Indication_data[currentPos++] & 0xFF);
      }
      // 0 - es kann vorkommen, dass das if leer ist dies wuerde zum Fehler fuehren. => automatische generierung der 0
      if( 0 || 1 == recordAddressVal || 2 == recordAddressVal )
      {
        //Sollte vor einem 1 Byte Wert 1 Nibble kommen, muss der index um 1 incrementiert werden!
        if( nibbleSetted==1) currentPos++;
        nibbleSetted = 0;
        A_ASG_69_0_0_27_ArrayDataList[i].Param3 = (gBAP_Indication_data[currentPos++] & 0xFF);
      }
      // 0 - es kann vorkommen, dass das if leer ist dies wuerde zum Fehler fuehren. => automatische generierung der 0
      if( 0 || 1 == recordAddressVal || 2 == recordAddressVal )
      {
        //Sollte vor einem 1 Byte Wert 1 Nibble kommen, muss der index um 1 incrementiert werden!
        if( nibbleSetted==1) currentPos++;
        nibbleSetted = 0;
        A_ASG_69_0_0_27_ArrayDataList[i].Param4 = (gBAP_Indication_data[currentPos++] & 0xFF);
      }
      // 0 - es kann vorkommen, dass das if leer ist dies wuerde zum Fehler fuehren. => automatische generierung der 0
      if( 0 || 1 == recordAddressVal || 2 == recordAddressVal )
      {
        //Sollte vor einem 4 Byte Wert 1 Nibble kommen, muss der index um 1 incrementiert werden!
        if( nibbleSetted==1) currentPos++;
        nibbleSetted = 0;
        A_ASG_69_0_0_27_ArrayDataList[i].Param5 = (gBAP_Indication_data[currentPos++] & 0xFF) + ((gBAP_Indication_data[currentPos++] & 0xFF) <<8) + ((gBAP_Indication_data[currentPos++] & 0xFF) <<16) + ((gBAP_Indication_data[currentPos++] & 0xFF) <<24);
      }
      // 0 - es kann vorkommen, dass das if leer ist dies wuerde zum Fehler fuehren. => automatische generierung der 0
      if( 0 || 1 == recordAddressVal || 2 == recordAddressVal )
      {
        //Sollte vor einem 4 Byte Wert 1 Nibble kommen, muss der index um 1 incrementiert werden!
        if( nibbleSetted==1) currentPos++;
        nibbleSetted = 0;
        A_ASG_69_0_0_27_ArrayDataList[i].Param6 = (gBAP_Indication_data[currentPos++] & 0xFF) + ((gBAP_Indication_data[currentPos++] & 0xFF) <<8) + ((gBAP_Indication_data[currentPos++] & 0xFF) <<16) + ((gBAP_Indication_data[currentPos++] & 0xFF) <<24);
      }
      // 0 - es kann vorkommen, dass das if leer ist dies wuerde zum Fehler fuehren. => automatische generierung der 0
      if( 0 || 1 == recordAddressVal || 2 == recordAddressVal )
      {
        //Sollte vor einem 4 Byte Wert 1 Nibble kommen, muss der index um 1 incrementiert werden!
        if( nibbleSetted==1) currentPos++;
        nibbleSetted = 0;
        A_ASG_69_0_0_27_ArrayDataList[i].Param7 = (gBAP_Indication_data[currentPos++] & 0xFF) + ((gBAP_Indication_data[currentPos++] & 0xFF) <<8) + ((gBAP_Indication_data[currentPos++] & 0xFF) <<16) + ((gBAP_Indication_data[currentPos++] & 0xFF) <<24);
      }
      // 0 - es kann vorkommen, dass das if leer ist dies wuerde zum Fehler fuehren. => automatische generierung der 0
      if( 0 || 1 == recordAddressVal || 2 == recordAddressVal )
      {
        //Sollte vor einem 4 Byte Wert 1 Nibble kommen, muss der index um 1 incrementiert werden!
        if( nibbleSetted==1) currentPos++;
        nibbleSetted = 0;
        A_ASG_69_0_0_27_ArrayDataList[i].Param8 = (gBAP_Indication_data[currentPos++] & 0xFF) + ((gBAP_Indication_data[currentPos++] & 0xFF) <<8) + ((gBAP_Indication_data[currentPos++] & 0xFF) <<16) + ((gBAP_Indication_data[currentPos++] & 0xFF) <<24);
      }
      // 0 - es kann vorkommen, dass das if leer ist dies wuerde zum Fehler fuehren. => automatische generierung der 0
      if( 0 || 1 == recordAddressVal || 2 == recordAddressVal )
      {
        //Sollte vor einem 4 Byte Wert 1 Nibble kommen, muss der index um 1 incrementiert werden!
        if( nibbleSetted==1) currentPos++;
        nibbleSetted = 0;
        A_ASG_69_0_0_27_ArrayDataList[i].Param9 = (gBAP_Indication_data[currentPos++] & 0xFF) + ((gBAP_Indication_data[currentPos++] & 0xFF) <<8) + ((gBAP_Indication_data[currentPos++] & 0xFF) <<16) + ((gBAP_Indication_data[currentPos++] & 0xFF) <<24);
      }
      // 0 - es kann vorkommen, dass das if leer ist dies wuerde zum Fehler fuehren. => automatische generierung der 0
      if( 0 || 1 == recordAddressVal || 2 == recordAddressVal )
      {
        //Sollte vor einem 4 Byte Wert 1 Nibble kommen, muss der index um 1 incrementiert werden!
        if( nibbleSetted==1) currentPos++;
        nibbleSetted = 0;
        A_ASG_69_0_0_27_ArrayDataList[i].Param10 = (gBAP_Indication_data[currentPos++] & 0xFF) + ((gBAP_Indication_data[currentPos++] & 0xFF) <<8) + ((gBAP_Indication_data[currentPos++] & 0xFF) <<16) + ((gBAP_Indication_data[currentPos++] & 0xFF) <<24);
      }
      // 0 - es kann vorkommen, dass das if leer ist dies wuerde zum Fehler fuehren. => automatische generierung der 0
      if( 0 || 1 == recordAddressVal || 2 == recordAddressVal )
      {
        //Sollte vor einem 4 Byte Wert 1 Nibble kommen, muss der index um 1 incrementiert werden!
        if( nibbleSetted==1) currentPos++;
        nibbleSetted = 0;
        A_ASG_69_0_0_27_ArrayDataList[i].Param11 = (gBAP_Indication_data[currentPos++] & 0xFF) + ((gBAP_Indication_data[currentPos++] & 0xFF) <<8) + ((gBAP_Indication_data[currentPos++] & 0xFF) <<16) + ((gBAP_Indication_data[currentPos++] & 0xFF) <<24);
      }
      // 0 - es kann vorkommen, dass das if leer ist dies wuerde zum Fehler fuehren. => automatische generierung der 0
      if( 0 || 1 == recordAddressVal || 2 == recordAddressVal )
      {
        //Sollte vor einem 4 Byte Wert 1 Nibble kommen, muss der index um 1 incrementiert werden!
        if( nibbleSetted==1) currentPos++;
        nibbleSetted = 0;
        A_ASG_69_0_0_27_ArrayDataList[i].Param12 = (gBAP_Indication_data[currentPos++] & 0xFF) + ((gBAP_Indication_data[currentPos++] & 0xFF) <<8) + ((gBAP_Indication_data[currentPos++] & 0xFF) <<16) + ((gBAP_Indication_data[currentPos++] & 0xFF) <<24);
      }
      // 0 - es kann vorkommen, dass das if leer ist dies wuerde zum Fehler fuehren. => automatische generierung der 0
      if( 0 || 1 == recordAddressVal || 2 == recordAddressVal )
      {
        //Sollte vor einem 4 Byte Wert 1 Nibble kommen, muss der index um 1 incrementiert werden!
        if( nibbleSetted==1) currentPos++;
        nibbleSetted = 0;
        A_ASG_69_0_0_27_ArrayDataList[i].Param13 = (gBAP_Indication_data[currentPos++] & 0xFF) + ((gBAP_Indication_data[currentPos++] & 0xFF) <<8) + ((gBAP_Indication_data[currentPos++] & 0xFF) <<16) + ((gBAP_Indication_data[currentPos++] & 0xFF) <<24);
      }
      // 0 - es kann vorkommen, dass das if leer ist dies wuerde zum Fehler fuehren. => automatische generierung der 0
      if( 0 || 1 == recordAddressVal || 2 == recordAddressVal )
      {
        //Sollte vor einem 4 Byte Wert 1 Nibble kommen, muss der index um 1 incrementiert werden!
        if( nibbleSetted==1) currentPos++;
        nibbleSetted = 0;
        A_ASG_69_0_0_27_ArrayDataList[i].Param14 = (gBAP_Indication_data[currentPos++] & 0xFF) + ((gBAP_Indication_data[currentPos++] & 0xFF) <<8) + ((gBAP_Indication_data[currentPos++] & 0xFF) <<16) + ((gBAP_Indication_data[currentPos++] & 0xFF) <<24);
      }
      // 0 - es kann vorkommen, dass das if leer ist dies wuerde zum Fehler fuehren. => automatische generierung der 0
      if( 0 || 1 == recordAddressVal )
      {
        //Sollte vor einem 4 Byte Wert 1 Nibble kommen, muss der index um 1 incrementiert werden!
        if( nibbleSetted==1) currentPos++;
        nibbleSetted = 0;
        A_ASG_69_0_0_27_ArrayDataList[i].Param15 = (gBAP_Indication_data[currentPos++] & 0xFF) + ((gBAP_Indication_data[currentPos++] & 0xFF) <<8) + ((gBAP_Indication_data[currentPos++] & 0xFF) <<16) + ((gBAP_Indication_data[currentPos++] & 0xFF) <<24);
      }
      // 0 - es kann vorkommen, dass das if leer ist dies wuerde zum Fehler fuehren. => automatische generierung der 0
      if( 0 || 1 == recordAddressVal )
      {
        //Sollte vor einem 4 Byte Wert 1 Nibble kommen, muss der index um 1 incrementiert werden!
        if( nibbleSetted==1) currentPos++;
        nibbleSetted = 0;
        A_ASG_69_0_0_27_ArrayDataList[i].Param16 = (gBAP_Indication_data[currentPos++] & 0xFF) + ((gBAP_Indication_data[currentPos++] & 0xFF) <<8) + ((gBAP_Indication_data[currentPos++] & 0xFF) <<16) + ((gBAP_Indication_data[currentPos++] & 0xFF) <<24);
      }
      // 0 - es kann vorkommen, dass das if leer ist dies wuerde zum Fehler fuehren. => automatische generierung der 0
      if( 0 || 1 == recordAddressVal )
      {
        //Sollte vor einem 4 Byte Wert 1 Nibble kommen, muss der index um 1 incrementiert werden!
        if( nibbleSetted==1) currentPos++;
        nibbleSetted = 0;
        A_ASG_69_0_0_27_ArrayDataList[i].Param17 = (gBAP_Indication_data[currentPos++] & 0xFF) + ((gBAP_Indication_data[currentPos++] & 0xFF) <<8) + ((gBAP_Indication_data[currentPos++] & 0xFF) <<16) + ((gBAP_Indication_data[currentPos++] & 0xFF) <<24);
      }
      // 0 - es kann vorkommen, dass das if leer ist dies wuerde zum Fehler fuehren. => automatische generierung der 0
      if( 0 || 1 == recordAddressVal )
      {
        //Sollte vor einem 4 Byte Wert 1 Nibble kommen, muss der index um 1 incrementiert werden!
        if( nibbleSetted==1) currentPos++;
        nibbleSetted = 0;
        A_ASG_69_0_0_27_ArrayDataList[i].Param18 = (gBAP_Indication_data[currentPos++] & 0xFF) + ((gBAP_Indication_data[currentPos++] & 0xFF) <<8) + ((gBAP_Indication_data[currentPos++] & 0xFF) <<16) + ((gBAP_Indication_data[currentPos++] & 0xFF) <<24);
      }
      // 0 - es kann vorkommen, dass das if leer ist dies wuerde zum Fehler fuehren. => automatische generierung der 0
      if( 0 || 1 == recordAddressVal )
      {
        //Sollte vor einem 4 Byte Wert 1 Nibble kommen, muss der index um 1 incrementiert werden!
        if( nibbleSetted==1) currentPos++;
        nibbleSetted = 0;
        A_ASG_69_0_0_27_ArrayDataList[i].Param19 = (gBAP_Indication_data[currentPos++] & 0xFF) + ((gBAP_Indication_data[currentPos++] & 0xFF) <<8) + ((gBAP_Indication_data[currentPos++] & 0xFF) <<16) + ((gBAP_Indication_data[currentPos++] & 0xFF) <<24);
      }
      // 0 - es kann vorkommen, dass das if leer ist dies wuerde zum Fehler fuehren. => automatische generierung der 0
      if( 0 )
      {
        //Sollte vor einem String Wert 1 Nibble kommen, muss der index um 1 incrementiert werden!
        if( nibbleSetted==1) currentPos++;
        nibbleSetted = 0;
        if((gBAP_Indication_data[currentPos] & 0x80) >= 1)
        {
        	 A_ASG_69_0_0_27_Data_20_CntList[i] = 1;
            A_ASG_69_0_0_27_ArrayDataList[i].Param20_Length = ( (gBAP_Indication_data[currentPos++] & 0x7F) << 8) + (gBAP_Indication_data[currentPos++] & 0xFF);
        }
        else
        {
        	 A_ASG_69_0_0_27_Data_20_CntList[i] = 0;
            A_ASG_69_0_0_27_ArrayDataList[i].Param20_Length = gBAP_Indication_data[currentPos++] & 0x7F;
        }
        for(j = 0; j < A_ASG_69_0_0_27_ArrayDataList[i].Param20_Length; j++)
        {
            A_ASG_69_0_0_27_ArrayDataList[i].Param20[j] = gBAP_Indication_data[currentPos++];
        }
      }
      } // for
    } else { // array header: decreasing indices (Direction = 1).
      if( (head[0] & 0x10) > 0) { // array header: first element is one before specified start element (Shift = 1, Direction = 1).
        if(startVal != 0) {          startVal--;
        } else {
          startVal = A_ASG_69_0_0_27_ArrayDataList_Length -1;
        }
      }
      for ( i = startVal ; i > startVal - elementsVal ; i--) {
        if ( i < 0 || i >= A_ASG_69_0_0_27_ArrayDataList_Length ) {
          write("Array index ausserhalb der Grenzen, Fct: 27");
          break;
        }
        if(nibbleSetted == 1) currentPos++;
        nibbleSetted = 0;
     if( (head[0]&0x40) == 0){ /* Transmit_Pos = 0, keine Positionsdaten */ }
     else
     {
        if( (head[0]&0x80) == 0)
        {
           //IndexSize = 0, Pos als 1 Byte Wert
           A_ASG_69_0_0_27_ArrayDataList[i].Param1 = gBAP_Indication_data[currentPos++];
        }
        else
        {
           //IndexSize = 1, Pos als 2 Byte Wert
           A_ASG_69_0_0_27_ArrayDataList[i].Param1 = ( gBAP_Indication_data[currentPos++] &0xFF) + ((gBAP_Indication_data[currentPos++] &0xFF)<<8);
        }
     }
      // 0 - es kann vorkommen, dass das if leer ist dies wuerde zum Fehler fuehren. => automatische generierung der 0
      if( 0 || 1 == recordAddressVal || 2 == recordAddressVal )
      {
        //Sollte vor einem 1 Byte Wert 1 Nibble kommen, muss der index um 1 incrementiert werden!
        if( nibbleSetted==1) currentPos++;
        nibbleSetted = 0;
        A_ASG_69_0_0_27_ArrayDataList[i].Param2 = (gBAP_Indication_data[currentPos++] & 0xFF);
      }
      // 0 - es kann vorkommen, dass das if leer ist dies wuerde zum Fehler fuehren. => automatische generierung der 0
      if( 0 || 1 == recordAddressVal || 2 == recordAddressVal )
      {
        //Sollte vor einem 1 Byte Wert 1 Nibble kommen, muss der index um 1 incrementiert werden!
        if( nibbleSetted==1) currentPos++;
        nibbleSetted = 0;
        A_ASG_69_0_0_27_ArrayDataList[i].Param3 = (gBAP_Indication_data[currentPos++] & 0xFF);
      }
      // 0 - es kann vorkommen, dass das if leer ist dies wuerde zum Fehler fuehren. => automatische generierung der 0
      if( 0 || 1 == recordAddressVal || 2 == recordAddressVal )
      {
        //Sollte vor einem 1 Byte Wert 1 Nibble kommen, muss der index um 1 incrementiert werden!
        if( nibbleSetted==1) currentPos++;
        nibbleSetted = 0;
        A_ASG_69_0_0_27_ArrayDataList[i].Param4 = (gBAP_Indication_data[currentPos++] & 0xFF);
      }
      // 0 - es kann vorkommen, dass das if leer ist dies wuerde zum Fehler fuehren. => automatische generierung der 0
      if( 0 || 1 == recordAddressVal || 2 == recordAddressVal )
      {
        //Sollte vor einem 4 Byte Wert 1 Nibble kommen, muss der index um 1 incrementiert werden!
        if( nibbleSetted==1) currentPos++;
        nibbleSetted = 0;
        A_ASG_69_0_0_27_ArrayDataList[i].Param5 = (gBAP_Indication_data[currentPos++] & 0xFF) + ((gBAP_Indication_data[currentPos++] & 0xFF) <<8) + ((gBAP_Indication_data[currentPos++] & 0xFF) <<16) + ((gBAP_Indication_data[currentPos++] & 0xFF) <<24);
      }
      // 0 - es kann vorkommen, dass das if leer ist dies wuerde zum Fehler fuehren. => automatische generierung der 0
      if( 0 || 1 == recordAddressVal || 2 == recordAddressVal )
      {
        //Sollte vor einem 4 Byte Wert 1 Nibble kommen, muss der index um 1 incrementiert werden!
        if( nibbleSetted==1) currentPos++;
        nibbleSetted = 0;
        A_ASG_69_0_0_27_ArrayDataList[i].Param6 = (gBAP_Indication_data[currentPos++] & 0xFF) + ((gBAP_Indication_data[currentPos++] & 0xFF) <<8) + ((gBAP_Indication_data[currentPos++] & 0xFF) <<16) + ((gBAP_Indication_data[currentPos++] & 0xFF) <<24);
      }
      // 0 - es kann vorkommen, dass das if leer ist dies wuerde zum Fehler fuehren. => automatische generierung der 0
      if( 0 || 1 == recordAddressVal || 2 == recordAddressVal )
      {
        //Sollte vor einem 4 Byte Wert 1 Nibble kommen, muss der index um 1 incrementiert werden!
        if( nibbleSetted==1) currentPos++;
        nibbleSetted = 0;
        A_ASG_69_0_0_27_ArrayDataList[i].Param7 = (gBAP_Indication_data[currentPos++] & 0xFF) + ((gBAP_Indication_data[currentPos++] & 0xFF) <<8) + ((gBAP_Indication_data[currentPos++] & 0xFF) <<16) + ((gBAP_Indication_data[currentPos++] & 0xFF) <<24);
      }
      // 0 - es kann vorkommen, dass das if leer ist dies wuerde zum Fehler fuehren. => automatische generierung der 0
      if( 0 || 1 == recordAddressVal || 2 == recordAddressVal )
      {
        //Sollte vor einem 4 Byte Wert 1 Nibble kommen, muss der index um 1 incrementiert werden!
        if( nibbleSetted==1) currentPos++;
        nibbleSetted = 0;
        A_ASG_69_0_0_27_ArrayDataList[i].Param8 = (gBAP_Indication_data[currentPos++] & 0xFF) + ((gBAP_Indication_data[currentPos++] & 0xFF) <<8) + ((gBAP_Indication_data[currentPos++] & 0xFF) <<16) + ((gBAP_Indication_data[currentPos++] & 0xFF) <<24);
      }
      // 0 - es kann vorkommen, dass das if leer ist dies wuerde zum Fehler fuehren. => automatische generierung der 0
      if( 0 || 1 == recordAddressVal || 2 == recordAddressVal )
      {
        //Sollte vor einem 4 Byte Wert 1 Nibble kommen, muss der index um 1 incrementiert werden!
        if( nibbleSetted==1) currentPos++;
        nibbleSetted = 0;
        A_ASG_69_0_0_27_ArrayDataList[i].Param9 = (gBAP_Indication_data[currentPos++] & 0xFF) + ((gBAP_Indication_data[currentPos++] & 0xFF) <<8) + ((gBAP_Indication_data[currentPos++] & 0xFF) <<16) + ((gBAP_Indication_data[currentPos++] & 0xFF) <<24);
      }
      // 0 - es kann vorkommen, dass das if leer ist dies wuerde zum Fehler fuehren. => automatische generierung der 0
      if( 0 || 1 == recordAddressVal || 2 == recordAddressVal )
      {
        //Sollte vor einem 4 Byte Wert 1 Nibble kommen, muss der index um 1 incrementiert werden!
        if( nibbleSetted==1) currentPos++;
        nibbleSetted = 0;
        A_ASG_69_0_0_27_ArrayDataList[i].Param10 = (gBAP_Indication_data[currentPos++] & 0xFF) + ((gBAP_Indication_data[currentPos++] & 0xFF) <<8) + ((gBAP_Indication_data[currentPos++] & 0xFF) <<16) + ((gBAP_Indication_data[currentPos++] & 0xFF) <<24);
      }
      // 0 - es kann vorkommen, dass das if leer ist dies wuerde zum Fehler fuehren. => automatische generierung der 0
      if( 0 || 1 == recordAddressVal || 2 == recordAddressVal )
      {
        //Sollte vor einem 4 Byte Wert 1 Nibble kommen, muss der index um 1 incrementiert werden!
        if( nibbleSetted==1) currentPos++;
        nibbleSetted = 0;
        A_ASG_69_0_0_27_ArrayDataList[i].Param11 = (gBAP_Indication_data[currentPos++] & 0xFF) + ((gBAP_Indication_data[currentPos++] & 0xFF) <<8) + ((gBAP_Indication_data[currentPos++] & 0xFF) <<16) + ((gBAP_Indication_data[currentPos++] & 0xFF) <<24);
      }
      // 0 - es kann vorkommen, dass das if leer ist dies wuerde zum Fehler fuehren. => automatische generierung der 0
      if( 0 || 1 == recordAddressVal || 2 == recordAddressVal )
      {
        //Sollte vor einem 4 Byte Wert 1 Nibble kommen, muss der index um 1 incrementiert werden!
        if( nibbleSetted==1) currentPos++;
        nibbleSetted = 0;
        A_ASG_69_0_0_27_ArrayDataList[i].Param12 = (gBAP_Indication_data[currentPos++] & 0xFF) + ((gBAP_Indication_data[currentPos++] & 0xFF) <<8) + ((gBAP_Indication_data[currentPos++] & 0xFF) <<16) + ((gBAP_Indication_data[currentPos++] & 0xFF) <<24);
      }
      // 0 - es kann vorkommen, dass das if leer ist dies wuerde zum Fehler fuehren. => automatische generierung der 0
      if( 0 || 1 == recordAddressVal || 2 == recordAddressVal )
      {
        //Sollte vor einem 4 Byte Wert 1 Nibble kommen, muss der index um 1 incrementiert werden!
        if( nibbleSetted==1) currentPos++;
        nibbleSetted = 0;
        A_ASG_69_0_0_27_ArrayDataList[i].Param13 = (gBAP_Indication_data[currentPos++] & 0xFF) + ((gBAP_Indication_data[currentPos++] & 0xFF) <<8) + ((gBAP_Indication_data[currentPos++] & 0xFF) <<16) + ((gBAP_Indication_data[currentPos++] & 0xFF) <<24);
      }
      // 0 - es kann vorkommen, dass das if leer ist dies wuerde zum Fehler fuehren. => automatische generierung der 0
      if( 0 || 1 == recordAddressVal || 2 == recordAddressVal )
      {
        //Sollte vor einem 4 Byte Wert 1 Nibble kommen, muss der index um 1 incrementiert werden!
        if( nibbleSetted==1) currentPos++;
        nibbleSetted = 0;
        A_ASG_69_0_0_27_ArrayDataList[i].Param14 = (gBAP_Indication_data[currentPos++] & 0xFF) + ((gBAP_Indication_data[currentPos++] & 0xFF) <<8) + ((gBAP_Indication_data[currentPos++] & 0xFF) <<16) + ((gBAP_Indication_data[currentPos++] & 0xFF) <<24);
      }
      // 0 - es kann vorkommen, dass das if leer ist dies wuerde zum Fehler fuehren. => automatische generierung der 0
      if( 0 || 1 == recordAddressVal )
      {
        //Sollte vor einem 4 Byte Wert 1 Nibble kommen, muss der index um 1 incrementiert werden!
        if( nibbleSetted==1) currentPos++;
        nibbleSetted = 0;
        A_ASG_69_0_0_27_ArrayDataList[i].Param15 = (gBAP_Indication_data[currentPos++] & 0xFF) + ((gBAP_Indication_data[currentPos++] & 0xFF) <<8) + ((gBAP_Indication_data[currentPos++] & 0xFF) <<16) + ((gBAP_Indication_data[currentPos++] & 0xFF) <<24);
      }
      // 0 - es kann vorkommen, dass das if leer ist dies wuerde zum Fehler fuehren. => automatische generierung der 0
      if( 0 || 1 == recordAddressVal )
      {
        //Sollte vor einem 4 Byte Wert 1 Nibble kommen, muss der index um 1 incrementiert werden!
        if( nibbleSetted==1) currentPos++;
        nibbleSetted = 0;
        A_ASG_69_0_0_27_ArrayDataList[i].Param16 = (gBAP_Indication_data[currentPos++] & 0xFF) + ((gBAP_Indication_data[currentPos++] & 0xFF) <<8) + ((gBAP_Indication_data[currentPos++] & 0xFF) <<16) + ((gBAP_Indication_data[currentPos++] & 0xFF) <<24);
      }
      // 0 - es kann vorkommen, dass das if leer ist dies wuerde zum Fehler fuehren. => automatische generierung der 0
      if( 0 || 1 == recordAddressVal )
      {
        //Sollte vor einem 4 Byte Wert 1 Nibble kommen, muss der index um 1 incrementiert werden!
        if( nibbleSetted==1) currentPos++;
        nibbleSetted = 0;
        A_ASG_69_0_0_27_ArrayDataList[i].Param17 = (gBAP_Indication_data[currentPos++] & 0xFF) + ((gBAP_Indication_data[currentPos++] & 0xFF) <<8) + ((gBAP_Indication_data[currentPos++] & 0xFF) <<16) + ((gBAP_Indication_data[currentPos++] & 0xFF) <<24);
      }
      // 0 - es kann vorkommen, dass das if leer ist dies wuerde zum Fehler fuehren. => automatische generierung der 0
      if( 0 || 1 == recordAddressVal )
      {
        //Sollte vor einem 4 Byte Wert 1 Nibble kommen, muss der index um 1 incrementiert werden!
        if( nibbleSetted==1) currentPos++;
        nibbleSetted = 0;
        A_ASG_69_0_0_27_ArrayDataList[i].Param18 = (gBAP_Indication_data[currentPos++] & 0xFF) + ((gBAP_Indication_data[currentPos++] & 0xFF) <<8) + ((gBAP_Indication_data[currentPos++] & 0xFF) <<16) + ((gBAP_Indication_data[currentPos++] & 0xFF) <<24);
      }
      // 0 - es kann vorkommen, dass das if leer ist dies wuerde zum Fehler fuehren. => automatische generierung der 0
      if( 0 || 1 == recordAddressVal )
      {
        //Sollte vor einem 4 Byte Wert 1 Nibble kommen, muss der index um 1 incrementiert werden!
        if( nibbleSetted==1) currentPos++;
        nibbleSetted = 0;
        A_ASG_69_0_0_27_ArrayDataList[i].Param19 = (gBAP_Indication_data[currentPos++] & 0xFF) + ((gBAP_Indication_data[currentPos++] & 0xFF) <<8) + ((gBAP_Indication_data[currentPos++] & 0xFF) <<16) + ((gBAP_Indication_data[currentPos++] & 0xFF) <<24);
      }
      // 0 - es kann vorkommen, dass das if leer ist dies wuerde zum Fehler fuehren. => automatische generierung der 0
      if( 0 )
      {
        //Sollte vor einem String Wert 1 Nibble kommen, muss der index um 1 incrementiert werden!
        if( nibbleSetted==1) currentPos++;
        nibbleSetted = 0;
        if((gBAP_Indication_data[currentPos] & 0x80) >= 1)
        {
        	 A_ASG_69_0_0_27_Data_20_CntList[i] = 1;
            A_ASG_69_0_0_27_ArrayDataList[i].Param20_Length = ( (gBAP_Indication_data[currentPos++] & 0x7F) << 8) + (gBAP_Indication_data[currentPos++] & 0xFF);
        }
        else
        {
        	 A_ASG_69_0_0_27_Data_20_CntList[i] = 0;
            A_ASG_69_0_0_27_ArrayDataList[i].Param20_Length = gBAP_Indication_data[currentPos++] & 0x7F;
        }
        for(j = 0; j < A_ASG_69_0_0_27_ArrayDataList[i].Param20_Length; j++)
        {
            A_ASG_69_0_0_27_ArrayDataList[i].Param20[j] = gBAP_Indication_data[currentPos++];
        }
      }
      } // for
    }
    nibbleSetted = 0;
index = getValue(A_ASG_69_0_0_27_DataIndex);
    putValue(A_ASG_69_0_0_27_Data_1, A_ASG_69_0_0_27_ArrayDataList[index].Param1);
    putValue(A_ASG_69_0_0_27_Data_2, A_ASG_69_0_0_27_ArrayDataList[index].Param2);
    putValue(A_ASG_69_0_0_27_Data_3, A_ASG_69_0_0_27_ArrayDataList[index].Param3);
    putValue(A_ASG_69_0_0_27_Data_4, A_ASG_69_0_0_27_ArrayDataList[index].Param4);
    putValue(A_ASG_69_0_0_27_Data_5, A_ASG_69_0_0_27_ArrayDataList[index].Param5);
    putValue(A_ASG_69_0_0_27_Data_6, A_ASG_69_0_0_27_ArrayDataList[index].Param6);
    putValue(A_ASG_69_0_0_27_Data_7, A_ASG_69_0_0_27_ArrayDataList[index].Param7);
    putValue(A_ASG_69_0_0_27_Data_8, A_ASG_69_0_0_27_ArrayDataList[index].Param8);
    putValue(A_ASG_69_0_0_27_Data_9, A_ASG_69_0_0_27_ArrayDataList[index].Param9);
    putValue(A_ASG_69_0_0_27_Data_10, A_ASG_69_0_0_27_ArrayDataList[index].Param10);
    putValue(A_ASG_69_0_0_27_Data_11, A_ASG_69_0_0_27_ArrayDataList[index].Param11);
    putValue(A_ASG_69_0_0_27_Data_12, A_ASG_69_0_0_27_ArrayDataList[index].Param12);
    putValue(A_ASG_69_0_0_27_Data_13, A_ASG_69_0_0_27_ArrayDataList[index].Param13);
    putValue(A_ASG_69_0_0_27_Data_14, A_ASG_69_0_0_27_ArrayDataList[index].Param14);
    putValue(A_ASG_69_0_0_27_Data_15, A_ASG_69_0_0_27_ArrayDataList[index].Param15);
    putValue(A_ASG_69_0_0_27_Data_16, A_ASG_69_0_0_27_ArrayDataList[index].Param16);
    putValue(A_ASG_69_0_0_27_Data_17, A_ASG_69_0_0_27_ArrayDataList[index].Param17);
    putValue(A_ASG_69_0_0_27_Data_18, A_ASG_69_0_0_27_ArrayDataList[index].Param18);
    putValue(A_ASG_69_0_0_27_Data_19, A_ASG_69_0_0_27_ArrayDataList[index].Param19);
    putValue(A_ASG_69_0_0_27_Data_20_len, A_ASG_69_0_0_27_Data_20_LenList[index]);
    putValue(A_ASG_69_0_0_27_Data_20_cnt, A_ASG_69_0_0_27_Data_20_CntList[index]);
    putValue(A_ASG_69_0_0_27_Data_20, A_ASG_69_0_0_27_ArrayDataList[index].Param20, A_ASG_69_0_0_27_ArrayDataList[index].Param20_Length);
}

A_ASG_69_0_0_27_ChangedInd()
{
    int currentPos;
    byte head[5];
    byte stringTempValue[665];
    int i;
    int j;
    int startVal;
    int elementsVal;
    byte recordAddressVal;
    byte transmitPosVal;
    long tempValue;
    long index;
    byte nibbleSetted;
    currentPos = 0;
    nibbleSetted = 0;
    //head Parameter
    if(gBAP_Indication_header[4] >= (3+currentPos))
    {
        if( (gBAP_Indication_data[currentPos] & 0x80) > 0)
            if(gBAP_Indication_header[4] >= (5+currentPos))
            {
                for(i = 0; i < 5; i++) head[i] = gBAP_Indication_data[currentPos++];
                putValue(A_ASG_69_0_0_27_Changed, head, 5);
                startVal = (head[2]<<8) | head[1];
                elementsVal = (head[4]<<8) | head[3];
            }
            else write("received Data Error");
        else
        {
            for(i = 0; i < 3; i++) head[i] = gBAP_Indication_data[currentPos++];
            putValue(A_ASG_69_0_0_27_Changed, head, 3);
                startVal = head[1];
                elementsVal = head[2];
        }
        recordAddressVal = head[0] & 0x0F;
        transmitPosVal = head[0] & 0x40;
    }
    //data Parameter
     nibbleSetted = 0;
    if( (head[0] & 0x20) == 0) { // array header: increasing indices (Direction = 0).
      if( (head[0] & 0x10) > 0) { // array header: first element is one after specified start element (Shift = 1, Direction = 0).
        startVal++;
      }
      for ( i = startVal ; i < startVal + elementsVal ; i++) {
        if ( i < 0 || i >= A_ASG_69_0_0_27_ArrayDataList_Length ) {
          write("Array index ausserhalb der Grenzen, Fct: 27");
          break;
        }
        if(nibbleSetted == 1) currentPos++;
        nibbleSetted = 0;
      } // for
    } else { // array header: decreasing indices (Direction = 1).
      if( (head[0] & 0x10) > 0) { // array header: first element is one before specified start element (Shift = 1, Direction = 1).
        if(startVal != 0) {          startVal--;
        } else {
          startVal = A_ASG_69_0_0_27_ArrayDataList_Length -1;
        }
      }
      for ( i = startVal ; i > startVal - elementsVal ; i--) {
        if ( i < 0 || i >= A_ASG_69_0_0_27_ArrayDataList_Length ) {
          write("Array index ausserhalb der Grenzen, Fct: 27");
          break;
        }
        if(nibbleSetted == 1) currentPos++;
        nibbleSetted = 0;
      } // for
    }
    nibbleSetted = 0;
index = getValue(A_ASG_69_0_0_27_DataIndex);
}




on envVar A_ASG_69_0_0_27_1
{
	byte superval[665];

	//Update Childvalue (Enum)
	byte thisval; // ASG_ID
	thisval = 0x0f & getValue(this);
}
// Ueberwachung der Darstellungsvariable der Range.
on envVar A_ASG_69_0_0_27_2_range // DisplayPresets.TAID 
{
	@A_ASG_69_0_0_27_2 = @A_ASG_69_0_0_27_2_range - (0); // slider = range - min
}

on envVar A_ASG_69_0_0_27_2
{
	byte superval[665];

	//Update Childvalue (Number)
	byte thisval; // TAID
	float slider_value;

	slider_value = round(@A_ASG_69_0_0_27_2, 1.0);
	@A_ASG_69_0_0_27_2_range = slider_value + (0); // real value := slider value + range min.
	thisval = (byte)round((slider_value + (0) - (0)) / (1.0), 1); // bus value := (slider value + min - offset) / step.
}
// Ueberwachung der Darstellungsvariable der Range.
on envVar A_ASG_69_0_0_27_3_range // DisplayPresets.TotalNumListElements 
{
	@A_ASG_69_0_0_27_3 = @A_ASG_69_0_0_27_3_range - (0); // slider = range - min
}

on envVar A_ASG_69_0_0_27_3
{
	byte superval[665];

	//Update Childvalue (Number)
	byte thisval; // TotalNumListElements
	float slider_value;

	slider_value = round(@A_ASG_69_0_0_27_3, 1.0);
	@A_ASG_69_0_0_27_3_range = slider_value + (0); // real value := slider value + range min.
	thisval = (byte)round((slider_value + (0) - (0)) / (1.0), 1); // bus value := (slider value + min - offset) / step.
}
// Ueberwachung der Darstellungsvariable der Range.
on envVar A_ASG_69_0_0_27_Data_1_range // DisplayPresets.Pos 
{
	@A_ASG_69_0_0_27_Data_1 = @A_ASG_69_0_0_27_Data_1_range - (0); // slider = range - min
}

on envVar A_ASG_69_0_0_27_Data_1
{
	byte superval[665];

	//Update Childvalue (Number)
	byte thisval; // Pos
	float slider_value;

	slider_value = round(@A_ASG_69_0_0_27_Data_1, 1.0);
	@A_ASG_69_0_0_27_Data_1_range = slider_value + (0); // real value := slider value + range min.
	thisval = (byte)round((slider_value + (0) - (0)) / (1.0), 1); // bus value := (slider value + min - offset) / step.
    A_ASG_69_0_0_27_ArrayDataList[getValue(A_ASG_69_0_0_27_DataIndex)].Param1 = thisval;
}
on envVar A_ASG_69_0_0_27_Data_2
{
	byte superval[665];

	//Update Childvalue (Enum)
	byte thisval; // State
	thisval = getValue(this);
    A_ASG_69_0_0_27_ArrayDataList[getValue(A_ASG_69_0_0_27_DataIndex)].Param2 = thisval;
}
on envVar A_ASG_69_0_0_27_Data_3
{
	byte superval[665];

	//Update Childvalue (Enum)
	byte thisval; // DisplayPresetType
	thisval = getValue(this);
    A_ASG_69_0_0_27_ArrayDataList[getValue(A_ASG_69_0_0_27_DataIndex)].Param3 = thisval;
}
// Ueberwachung der Darstellungsvariable der Range.
on envVar A_ASG_69_0_0_27_Data_4_range // DisplayPresets.DisplayPresetInstance 
{
	@A_ASG_69_0_0_27_Data_4 = @A_ASG_69_0_0_27_Data_4_range - (0); // slider = range - min
}

on envVar A_ASG_69_0_0_27_Data_4
{
	byte superval[665];

	//Update Childvalue (Number)
	byte thisval; // DisplayPresetInstance
	float slider_value;

	slider_value = round(@A_ASG_69_0_0_27_Data_4, 1.0);
	@A_ASG_69_0_0_27_Data_4_range = slider_value + (0); // real value := slider value + range min.
	thisval = (byte)round((slider_value + (0) - (0)) / (1.0), 1); // bus value := (slider value + min - offset) / step.
    A_ASG_69_0_0_27_ArrayDataList[getValue(A_ASG_69_0_0_27_DataIndex)].Param4 = thisval;
}
on envVar A_ASG_69_0_0_27_Data_5_0
{
	byte bitval;
	//thisval steht hier fuer den bitfield-wert, 
	//aus Generierungsgruenden hier keine einheitliche Bezeichnung moeglich.
	dword thisval; // Display1MainSelection
	bitval= getValue(this);
	thisval = getValue(A_ASG_69_0_0_27_Data_5);
	thisval = thisval&~(1<<0)|(bitval<<0);
	putValue(A_ASG_69_0_0_27_Data_5,thisval);
}

on envVar A_ASG_69_0_0_27_Data_5_1
{
	byte bitval;
	//thisval steht hier fuer den bitfield-wert, 
	//aus Generierungsgruenden hier keine einheitliche Bezeichnung moeglich.
	dword thisval; // Display1MainSelection
	bitval= getValue(this);
	thisval = getValue(A_ASG_69_0_0_27_Data_5);
	thisval = thisval&~(1<<1)|(bitval<<1);
	putValue(A_ASG_69_0_0_27_Data_5,thisval);
}

on envVar A_ASG_69_0_0_27_Data_5_2
{
	byte bitval;
	//thisval steht hier fuer den bitfield-wert, 
	//aus Generierungsgruenden hier keine einheitliche Bezeichnung moeglich.
	dword thisval; // Display1MainSelection
	bitval= getValue(this);
	thisval = getValue(A_ASG_69_0_0_27_Data_5);
	thisval = thisval&~(1<<2)|(bitval<<2);
	putValue(A_ASG_69_0_0_27_Data_5,thisval);
}

on envVar A_ASG_69_0_0_27_Data_5_3
{
	byte bitval;
	//thisval steht hier fuer den bitfield-wert, 
	//aus Generierungsgruenden hier keine einheitliche Bezeichnung moeglich.
	dword thisval; // Display1MainSelection
	bitval= getValue(this);
	thisval = getValue(A_ASG_69_0_0_27_Data_5);
	thisval = thisval&~(1<<3)|(bitval<<3);
	putValue(A_ASG_69_0_0_27_Data_5,thisval);
}

on envVar A_ASG_69_0_0_27_Data_5_4
{
	byte bitval;
	//thisval steht hier fuer den bitfield-wert, 
	//aus Generierungsgruenden hier keine einheitliche Bezeichnung moeglich.
	dword thisval; // Display1MainSelection
	bitval= getValue(this);
	thisval = getValue(A_ASG_69_0_0_27_Data_5);
	thisval = thisval&~(1<<4)|(bitval<<4);
	putValue(A_ASG_69_0_0_27_Data_5,thisval);
}

on envVar A_ASG_69_0_0_27_Data_5_5
{
	byte bitval;
	//thisval steht hier fuer den bitfield-wert, 
	//aus Generierungsgruenden hier keine einheitliche Bezeichnung moeglich.
	dword thisval; // Display1MainSelection
	bitval= getValue(this);
	thisval = getValue(A_ASG_69_0_0_27_Data_5);
	thisval = thisval&~(1<<5)|(bitval<<5);
	putValue(A_ASG_69_0_0_27_Data_5,thisval);
}

on envVar A_ASG_69_0_0_27_Data_5_6
{
	byte bitval;
	//thisval steht hier fuer den bitfield-wert, 
	//aus Generierungsgruenden hier keine einheitliche Bezeichnung moeglich.
	dword thisval; // Display1MainSelection
	bitval= getValue(this);
	thisval = getValue(A_ASG_69_0_0_27_Data_5);
	thisval = thisval&~(1<<6)|(bitval<<6);
	putValue(A_ASG_69_0_0_27_Data_5,thisval);
}

on envVar A_ASG_69_0_0_27_Data_5_7
{
	byte bitval;
	//thisval steht hier fuer den bitfield-wert, 
	//aus Generierungsgruenden hier keine einheitliche Bezeichnung moeglich.
	dword thisval; // Display1MainSelection
	bitval= getValue(this);
	thisval = getValue(A_ASG_69_0_0_27_Data_5);
	thisval = thisval&~(1<<7)|(bitval<<7);
	putValue(A_ASG_69_0_0_27_Data_5,thisval);
}

on envVar A_ASG_69_0_0_27_Data_5_8
{
	byte bitval;
	//thisval steht hier fuer den bitfield-wert, 
	//aus Generierungsgruenden hier keine einheitliche Bezeichnung moeglich.
	dword thisval; // Display1MainSelection
	bitval= getValue(this);
	thisval = getValue(A_ASG_69_0_0_27_Data_5);
	thisval = thisval&~(1<<8)|(bitval<<8);
	putValue(A_ASG_69_0_0_27_Data_5,thisval);
}

on envVar A_ASG_69_0_0_27_Data_5_9
{
	byte bitval;
	//thisval steht hier fuer den bitfield-wert, 
	//aus Generierungsgruenden hier keine einheitliche Bezeichnung moeglich.
	dword thisval; // Display1MainSelection
	bitval= getValue(this);
	thisval = getValue(A_ASG_69_0_0_27_Data_5);
	thisval = thisval&~(1<<9)|(bitval<<9);
	putValue(A_ASG_69_0_0_27_Data_5,thisval);
}

on envVar A_ASG_69_0_0_27_Data_5_10
{
	byte bitval;
	//thisval steht hier fuer den bitfield-wert, 
	//aus Generierungsgruenden hier keine einheitliche Bezeichnung moeglich.
	dword thisval; // Display1MainSelection
	bitval= getValue(this);
	thisval = getValue(A_ASG_69_0_0_27_Data_5);
	thisval = thisval&~(1<<10)|(bitval<<10);
	putValue(A_ASG_69_0_0_27_Data_5,thisval);
}

on envVar A_ASG_69_0_0_27_Data_5_11
{
	byte bitval;
	//thisval steht hier fuer den bitfield-wert, 
	//aus Generierungsgruenden hier keine einheitliche Bezeichnung moeglich.
	dword thisval; // Display1MainSelection
	bitval= getValue(this);
	thisval = getValue(A_ASG_69_0_0_27_Data_5);
	thisval = thisval&~(1<<11)|(bitval<<11);
	putValue(A_ASG_69_0_0_27_Data_5,thisval);
}

on envVar A_ASG_69_0_0_27_Data_5_12
{
	byte bitval;
	//thisval steht hier fuer den bitfield-wert, 
	//aus Generierungsgruenden hier keine einheitliche Bezeichnung moeglich.
	dword thisval; // Display1MainSelection
	bitval= getValue(this);
	thisval = getValue(A_ASG_69_0_0_27_Data_5);
	thisval = thisval&~(1<<12)|(bitval<<12);
	putValue(A_ASG_69_0_0_27_Data_5,thisval);
}

on envVar A_ASG_69_0_0_27_Data_5_13
{
	byte bitval;
	//thisval steht hier fuer den bitfield-wert, 
	//aus Generierungsgruenden hier keine einheitliche Bezeichnung moeglich.
	dword thisval; // Display1MainSelection
	bitval= getValue(this);
	thisval = getValue(A_ASG_69_0_0_27_Data_5);
	thisval = thisval&~(1<<13)|(bitval<<13);
	putValue(A_ASG_69_0_0_27_Data_5,thisval);
}

on envVar A_ASG_69_0_0_27_Data_5_14
{
	byte bitval;
	//thisval steht hier fuer den bitfield-wert, 
	//aus Generierungsgruenden hier keine einheitliche Bezeichnung moeglich.
	dword thisval; // Display1MainSelection
	bitval= getValue(this);
	thisval = getValue(A_ASG_69_0_0_27_Data_5);
	thisval = thisval&~(1<<14)|(bitval<<14);
	putValue(A_ASG_69_0_0_27_Data_5,thisval);
}

on envVar A_ASG_69_0_0_27_Data_5_15
{
	byte bitval;
	//thisval steht hier fuer den bitfield-wert, 
	//aus Generierungsgruenden hier keine einheitliche Bezeichnung moeglich.
	dword thisval; // Display1MainSelection
	bitval= getValue(this);
	thisval = getValue(A_ASG_69_0_0_27_Data_5);
	thisval = thisval&~(1<<15)|(bitval<<15);
	putValue(A_ASG_69_0_0_27_Data_5,thisval);
}

on envVar A_ASG_69_0_0_27_Data_5_16
{
	byte bitval;
	//thisval steht hier fuer den bitfield-wert, 
	//aus Generierungsgruenden hier keine einheitliche Bezeichnung moeglich.
	dword thisval; // Display1MainSelection
	bitval= getValue(this);
	thisval = getValue(A_ASG_69_0_0_27_Data_5);
	thisval = thisval&~(1<<16)|(bitval<<16);
	putValue(A_ASG_69_0_0_27_Data_5,thisval);
}

on envVar A_ASG_69_0_0_27_Data_5_17
{
	byte bitval;
	//thisval steht hier fuer den bitfield-wert, 
	//aus Generierungsgruenden hier keine einheitliche Bezeichnung moeglich.
	dword thisval; // Display1MainSelection
	bitval= getValue(this);
	thisval = getValue(A_ASG_69_0_0_27_Data_5);
	thisval = thisval&~(1<<17)|(bitval<<17);
	putValue(A_ASG_69_0_0_27_Data_5,thisval);
}

on envVar A_ASG_69_0_0_27_Data_5_18
{
	byte bitval;
	//thisval steht hier fuer den bitfield-wert, 
	//aus Generierungsgruenden hier keine einheitliche Bezeichnung moeglich.
	dword thisval; // Display1MainSelection
	bitval= getValue(this);
	thisval = getValue(A_ASG_69_0_0_27_Data_5);
	thisval = thisval&~(1<<18)|(bitval<<18);
	putValue(A_ASG_69_0_0_27_Data_5,thisval);
}

on envVar A_ASG_69_0_0_27_Data_5_19
{
	byte bitval;
	//thisval steht hier fuer den bitfield-wert, 
	//aus Generierungsgruenden hier keine einheitliche Bezeichnung moeglich.
	dword thisval; // Display1MainSelection
	bitval= getValue(this);
	thisval = getValue(A_ASG_69_0_0_27_Data_5);
	thisval = thisval&~(1<<19)|(bitval<<19);
	putValue(A_ASG_69_0_0_27_Data_5,thisval);
}

on envVar A_ASG_69_0_0_27_Data_5_20
{
	byte bitval;
	//thisval steht hier fuer den bitfield-wert, 
	//aus Generierungsgruenden hier keine einheitliche Bezeichnung moeglich.
	dword thisval; // Display1MainSelection
	bitval= getValue(this);
	thisval = getValue(A_ASG_69_0_0_27_Data_5);
	thisval = thisval&~(1<<20)|(bitval<<20);
	putValue(A_ASG_69_0_0_27_Data_5,thisval);
}

on envVar A_ASG_69_0_0_27_Data_5_21
{
	byte bitval;
	//thisval steht hier fuer den bitfield-wert, 
	//aus Generierungsgruenden hier keine einheitliche Bezeichnung moeglich.
	dword thisval; // Display1MainSelection
	bitval= getValue(this);
	thisval = getValue(A_ASG_69_0_0_27_Data_5);
	thisval = thisval&~(1<<21)|(bitval<<21);
	putValue(A_ASG_69_0_0_27_Data_5,thisval);
}

on envVar A_ASG_69_0_0_27_Data_5_22
{
	byte bitval;
	//thisval steht hier fuer den bitfield-wert, 
	//aus Generierungsgruenden hier keine einheitliche Bezeichnung moeglich.
	dword thisval; // Display1MainSelection
	bitval= getValue(this);
	thisval = getValue(A_ASG_69_0_0_27_Data_5);
	thisval = thisval&~(1<<22)|(bitval<<22);
	putValue(A_ASG_69_0_0_27_Data_5,thisval);
}

on envVar A_ASG_69_0_0_27_Data_5_23
{
	byte bitval;
	//thisval steht hier fuer den bitfield-wert, 
	//aus Generierungsgruenden hier keine einheitliche Bezeichnung moeglich.
	dword thisval; // Display1MainSelection
	bitval= getValue(this);
	thisval = getValue(A_ASG_69_0_0_27_Data_5);
	thisval = thisval&~(1<<23)|(bitval<<23);
	putValue(A_ASG_69_0_0_27_Data_5,thisval);
}

on envVar A_ASG_69_0_0_27_Data_5_24
{
	byte bitval;
	//thisval steht hier fuer den bitfield-wert, 
	//aus Generierungsgruenden hier keine einheitliche Bezeichnung moeglich.
	dword thisval; // Display1MainSelection
	bitval= getValue(this);
	thisval = getValue(A_ASG_69_0_0_27_Data_5);
	thisval = thisval&~(1<<24)|(bitval<<24);
	putValue(A_ASG_69_0_0_27_Data_5,thisval);
}

on envVar A_ASG_69_0_0_27_Data_5_25
{
	byte bitval;
	//thisval steht hier fuer den bitfield-wert, 
	//aus Generierungsgruenden hier keine einheitliche Bezeichnung moeglich.
	dword thisval; // Display1MainSelection
	bitval= getValue(this);
	thisval = getValue(A_ASG_69_0_0_27_Data_5);
	thisval = thisval&~(1<<25)|(bitval<<25);
	putValue(A_ASG_69_0_0_27_Data_5,thisval);
}

on envVar A_ASG_69_0_0_27_Data_5_26
{
	byte bitval;
	//thisval steht hier fuer den bitfield-wert, 
	//aus Generierungsgruenden hier keine einheitliche Bezeichnung moeglich.
	dword thisval; // Display1MainSelection
	bitval= getValue(this);
	thisval = getValue(A_ASG_69_0_0_27_Data_5);
	thisval = thisval&~(1<<26)|(bitval<<26);
	putValue(A_ASG_69_0_0_27_Data_5,thisval);
}

on envVar A_ASG_69_0_0_27_Data_5_27
{
	byte bitval;
	//thisval steht hier fuer den bitfield-wert, 
	//aus Generierungsgruenden hier keine einheitliche Bezeichnung moeglich.
	dword thisval; // Display1MainSelection
	bitval= getValue(this);
	thisval = getValue(A_ASG_69_0_0_27_Data_5);
	thisval = thisval&~(1<<27)|(bitval<<27);
	putValue(A_ASG_69_0_0_27_Data_5,thisval);
}

on envVar A_ASG_69_0_0_27_Data_5
{
	byte superval[665];

	//Update Childvalue (BitField)
	byte mask=0x01;
	int i = 0;
	dword thisval; // Display1MainSelection
	thisval = getValue(this);
	if(thisval&(mask<<0))
		putValue(A_ASG_69_0_0_27_Data_5_0, 1);
	else
		putValue(A_ASG_69_0_0_27_Data_5_0, 0);
	if(thisval&(mask<<1))
		putValue(A_ASG_69_0_0_27_Data_5_1, 1);
	else
		putValue(A_ASG_69_0_0_27_Data_5_1, 0);
	if(thisval&(mask<<2))
		putValue(A_ASG_69_0_0_27_Data_5_2, 1);
	else
		putValue(A_ASG_69_0_0_27_Data_5_2, 0);
	if(thisval&(mask<<3))
		putValue(A_ASG_69_0_0_27_Data_5_3, 1);
	else
		putValue(A_ASG_69_0_0_27_Data_5_3, 0);
	if(thisval&(mask<<4))
		putValue(A_ASG_69_0_0_27_Data_5_4, 1);
	else
		putValue(A_ASG_69_0_0_27_Data_5_4, 0);
	if(thisval&(mask<<5))
		putValue(A_ASG_69_0_0_27_Data_5_5, 1);
	else
		putValue(A_ASG_69_0_0_27_Data_5_5, 0);
	if(thisval&(mask<<6))
		putValue(A_ASG_69_0_0_27_Data_5_6, 1);
	else
		putValue(A_ASG_69_0_0_27_Data_5_6, 0);
	if(thisval&(mask<<7))
		putValue(A_ASG_69_0_0_27_Data_5_7, 1);
	else
		putValue(A_ASG_69_0_0_27_Data_5_7, 0);
	if(thisval&(mask<<8))
		putValue(A_ASG_69_0_0_27_Data_5_8, 1);
	else
		putValue(A_ASG_69_0_0_27_Data_5_8, 0);
	if(thisval&(mask<<9))
		putValue(A_ASG_69_0_0_27_Data_5_9, 1);
	else
		putValue(A_ASG_69_0_0_27_Data_5_9, 0);
	if(thisval&(mask<<10))
		putValue(A_ASG_69_0_0_27_Data_5_10, 1);
	else
		putValue(A_ASG_69_0_0_27_Data_5_10, 0);
	if(thisval&(mask<<11))
		putValue(A_ASG_69_0_0_27_Data_5_11, 1);
	else
		putValue(A_ASG_69_0_0_27_Data_5_11, 0);
	if(thisval&(mask<<12))
		putValue(A_ASG_69_0_0_27_Data_5_12, 1);
	else
		putValue(A_ASG_69_0_0_27_Data_5_12, 0);
	if(thisval&(mask<<13))
		putValue(A_ASG_69_0_0_27_Data_5_13, 1);
	else
		putValue(A_ASG_69_0_0_27_Data_5_13, 0);
	if(thisval&(mask<<14))
		putValue(A_ASG_69_0_0_27_Data_5_14, 1);
	else
		putValue(A_ASG_69_0_0_27_Data_5_14, 0);
	if(thisval&(mask<<15))
		putValue(A_ASG_69_0_0_27_Data_5_15, 1);
	else
		putValue(A_ASG_69_0_0_27_Data_5_15, 0);
	if(thisval&(mask<<16))
		putValue(A_ASG_69_0_0_27_Data_5_16, 1);
	else
		putValue(A_ASG_69_0_0_27_Data_5_16, 0);
	if(thisval&(mask<<17))
		putValue(A_ASG_69_0_0_27_Data_5_17, 1);
	else
		putValue(A_ASG_69_0_0_27_Data_5_17, 0);
	if(thisval&(mask<<18))
		putValue(A_ASG_69_0_0_27_Data_5_18, 1);
	else
		putValue(A_ASG_69_0_0_27_Data_5_18, 0);
	if(thisval&(mask<<19))
		putValue(A_ASG_69_0_0_27_Data_5_19, 1);
	else
		putValue(A_ASG_69_0_0_27_Data_5_19, 0);
	if(thisval&(mask<<20))
		putValue(A_ASG_69_0_0_27_Data_5_20, 1);
	else
		putValue(A_ASG_69_0_0_27_Data_5_20, 0);
	if(thisval&(mask<<21))
		putValue(A_ASG_69_0_0_27_Data_5_21, 1);
	else
		putValue(A_ASG_69_0_0_27_Data_5_21, 0);
	if(thisval&(mask<<22))
		putValue(A_ASG_69_0_0_27_Data_5_22, 1);
	else
		putValue(A_ASG_69_0_0_27_Data_5_22, 0);
	if(thisval&(mask<<23))
		putValue(A_ASG_69_0_0_27_Data_5_23, 1);
	else
		putValue(A_ASG_69_0_0_27_Data_5_23, 0);
	if(thisval&(mask<<24))
		putValue(A_ASG_69_0_0_27_Data_5_24, 1);
	else
		putValue(A_ASG_69_0_0_27_Data_5_24, 0);
	if(thisval&(mask<<25))
		putValue(A_ASG_69_0_0_27_Data_5_25, 1);
	else
		putValue(A_ASG_69_0_0_27_Data_5_25, 0);
	if(thisval&(mask<<26))
		putValue(A_ASG_69_0_0_27_Data_5_26, 1);
	else
		putValue(A_ASG_69_0_0_27_Data_5_26, 0);
	if(thisval&(mask<<27))
		putValue(A_ASG_69_0_0_27_Data_5_27, 1);
	else
		putValue(A_ASG_69_0_0_27_Data_5_27, 0);
    A_ASG_69_0_0_27_ArrayDataList[getValue(A_ASG_69_0_0_27_DataIndex)].Param5 = thisval;
}
on envVar A_ASG_69_0_0_27_Data_6_0
{
	byte bitval;
	//thisval steht hier fuer den bitfield-wert, 
	//aus Generierungsgruenden hier keine einheitliche Bezeichnung moeglich.
	dword thisval; // Display1AdditionalInfo1_1
	bitval= getValue(this);
	thisval = getValue(A_ASG_69_0_0_27_Data_6);
	thisval = thisval&~(1<<0)|(bitval<<0);
	putValue(A_ASG_69_0_0_27_Data_6,thisval);
}

on envVar A_ASG_69_0_0_27_Data_6_1
{
	byte bitval;
	//thisval steht hier fuer den bitfield-wert, 
	//aus Generierungsgruenden hier keine einheitliche Bezeichnung moeglich.
	dword thisval; // Display1AdditionalInfo1_1
	bitval= getValue(this);
	thisval = getValue(A_ASG_69_0_0_27_Data_6);
	thisval = thisval&~(1<<1)|(bitval<<1);
	putValue(A_ASG_69_0_0_27_Data_6,thisval);
}

on envVar A_ASG_69_0_0_27_Data_6_2
{
	byte bitval;
	//thisval steht hier fuer den bitfield-wert, 
	//aus Generierungsgruenden hier keine einheitliche Bezeichnung moeglich.
	dword thisval; // Display1AdditionalInfo1_1
	bitval= getValue(this);
	thisval = getValue(A_ASG_69_0_0_27_Data_6);
	thisval = thisval&~(1<<2)|(bitval<<2);
	putValue(A_ASG_69_0_0_27_Data_6,thisval);
}

on envVar A_ASG_69_0_0_27_Data_6_3
{
	byte bitval;
	//thisval steht hier fuer den bitfield-wert, 
	//aus Generierungsgruenden hier keine einheitliche Bezeichnung moeglich.
	dword thisval; // Display1AdditionalInfo1_1
	bitval= getValue(this);
	thisval = getValue(A_ASG_69_0_0_27_Data_6);
	thisval = thisval&~(1<<3)|(bitval<<3);
	putValue(A_ASG_69_0_0_27_Data_6,thisval);
}

on envVar A_ASG_69_0_0_27_Data_6_4
{
	byte bitval;
	//thisval steht hier fuer den bitfield-wert, 
	//aus Generierungsgruenden hier keine einheitliche Bezeichnung moeglich.
	dword thisval; // Display1AdditionalInfo1_1
	bitval= getValue(this);
	thisval = getValue(A_ASG_69_0_0_27_Data_6);
	thisval = thisval&~(1<<4)|(bitval<<4);
	putValue(A_ASG_69_0_0_27_Data_6,thisval);
}

on envVar A_ASG_69_0_0_27_Data_6_5
{
	byte bitval;
	//thisval steht hier fuer den bitfield-wert, 
	//aus Generierungsgruenden hier keine einheitliche Bezeichnung moeglich.
	dword thisval; // Display1AdditionalInfo1_1
	bitval= getValue(this);
	thisval = getValue(A_ASG_69_0_0_27_Data_6);
	thisval = thisval&~(1<<5)|(bitval<<5);
	putValue(A_ASG_69_0_0_27_Data_6,thisval);
}

on envVar A_ASG_69_0_0_27_Data_6_6
{
	byte bitval;
	//thisval steht hier fuer den bitfield-wert, 
	//aus Generierungsgruenden hier keine einheitliche Bezeichnung moeglich.
	dword thisval; // Display1AdditionalInfo1_1
	bitval= getValue(this);
	thisval = getValue(A_ASG_69_0_0_27_Data_6);
	thisval = thisval&~(1<<6)|(bitval<<6);
	putValue(A_ASG_69_0_0_27_Data_6,thisval);
}

on envVar A_ASG_69_0_0_27_Data_6_7
{
	byte bitval;
	//thisval steht hier fuer den bitfield-wert, 
	//aus Generierungsgruenden hier keine einheitliche Bezeichnung moeglich.
	dword thisval; // Display1AdditionalInfo1_1
	bitval= getValue(this);
	thisval = getValue(A_ASG_69_0_0_27_Data_6);
	thisval = thisval&~(1<<7)|(bitval<<7);
	putValue(A_ASG_69_0_0_27_Data_6,thisval);
}

on envVar A_ASG_69_0_0_27_Data_6_8
{
	byte bitval;
	//thisval steht hier fuer den bitfield-wert, 
	//aus Generierungsgruenden hier keine einheitliche Bezeichnung moeglich.
	dword thisval; // Display1AdditionalInfo1_1
	bitval= getValue(this);
	thisval = getValue(A_ASG_69_0_0_27_Data_6);
	thisval = thisval&~(1<<8)|(bitval<<8);
	putValue(A_ASG_69_0_0_27_Data_6,thisval);
}

on envVar A_ASG_69_0_0_27_Data_6_9
{
	byte bitval;
	//thisval steht hier fuer den bitfield-wert, 
	//aus Generierungsgruenden hier keine einheitliche Bezeichnung moeglich.
	dword thisval; // Display1AdditionalInfo1_1
	bitval= getValue(this);
	thisval = getValue(A_ASG_69_0_0_27_Data_6);
	thisval = thisval&~(1<<9)|(bitval<<9);
	putValue(A_ASG_69_0_0_27_Data_6,thisval);
}

on envVar A_ASG_69_0_0_27_Data_6_10
{
	byte bitval;
	//thisval steht hier fuer den bitfield-wert, 
	//aus Generierungsgruenden hier keine einheitliche Bezeichnung moeglich.
	dword thisval; // Display1AdditionalInfo1_1
	bitval= getValue(this);
	thisval = getValue(A_ASG_69_0_0_27_Data_6);
	thisval = thisval&~(1<<10)|(bitval<<10);
	putValue(A_ASG_69_0_0_27_Data_6,thisval);
}

on envVar A_ASG_69_0_0_27_Data_6_11
{
	byte bitval;
	//thisval steht hier fuer den bitfield-wert, 
	//aus Generierungsgruenden hier keine einheitliche Bezeichnung moeglich.
	dword thisval; // Display1AdditionalInfo1_1
	bitval= getValue(this);
	thisval = getValue(A_ASG_69_0_0_27_Data_6);
	thisval = thisval&~(1<<11)|(bitval<<11);
	putValue(A_ASG_69_0_0_27_Data_6,thisval);
}

on envVar A_ASG_69_0_0_27_Data_6_12
{
	byte bitval;
	//thisval steht hier fuer den bitfield-wert, 
	//aus Generierungsgruenden hier keine einheitliche Bezeichnung moeglich.
	dword thisval; // Display1AdditionalInfo1_1
	bitval= getValue(this);
	thisval = getValue(A_ASG_69_0_0_27_Data_6);
	thisval = thisval&~(1<<12)|(bitval<<12);
	putValue(A_ASG_69_0_0_27_Data_6,thisval);
}

on envVar A_ASG_69_0_0_27_Data_6_13
{
	byte bitval;
	//thisval steht hier fuer den bitfield-wert, 
	//aus Generierungsgruenden hier keine einheitliche Bezeichnung moeglich.
	dword thisval; // Display1AdditionalInfo1_1
	bitval= getValue(this);
	thisval = getValue(A_ASG_69_0_0_27_Data_6);
	thisval = thisval&~(1<<13)|(bitval<<13);
	putValue(A_ASG_69_0_0_27_Data_6,thisval);
}

on envVar A_ASG_69_0_0_27_Data_6_14
{
	byte bitval;
	//thisval steht hier fuer den bitfield-wert, 
	//aus Generierungsgruenden hier keine einheitliche Bezeichnung moeglich.
	dword thisval; // Display1AdditionalInfo1_1
	bitval= getValue(this);
	thisval = getValue(A_ASG_69_0_0_27_Data_6);
	thisval = thisval&~(1<<14)|(bitval<<14);
	putValue(A_ASG_69_0_0_27_Data_6,thisval);
}

on envVar A_ASG_69_0_0_27_Data_6_15
{
	byte bitval;
	//thisval steht hier fuer den bitfield-wert, 
	//aus Generierungsgruenden hier keine einheitliche Bezeichnung moeglich.
	dword thisval; // Display1AdditionalInfo1_1
	bitval= getValue(this);
	thisval = getValue(A_ASG_69_0_0_27_Data_6);
	thisval = thisval&~(1<<15)|(bitval<<15);
	putValue(A_ASG_69_0_0_27_Data_6,thisval);
}

on envVar A_ASG_69_0_0_27_Data_6_16
{
	byte bitval;
	//thisval steht hier fuer den bitfield-wert, 
	//aus Generierungsgruenden hier keine einheitliche Bezeichnung moeglich.
	dword thisval; // Display1AdditionalInfo1_1
	bitval= getValue(this);
	thisval = getValue(A_ASG_69_0_0_27_Data_6);
	thisval = thisval&~(1<<16)|(bitval<<16);
	putValue(A_ASG_69_0_0_27_Data_6,thisval);
}

on envVar A_ASG_69_0_0_27_Data_6_17
{
	byte bitval;
	//thisval steht hier fuer den bitfield-wert, 
	//aus Generierungsgruenden hier keine einheitliche Bezeichnung moeglich.
	dword thisval; // Display1AdditionalInfo1_1
	bitval= getValue(this);
	thisval = getValue(A_ASG_69_0_0_27_Data_6);
	thisval = thisval&~(1<<17)|(bitval<<17);
	putValue(A_ASG_69_0_0_27_Data_6,thisval);
}

on envVar A_ASG_69_0_0_27_Data_6_18
{
	byte bitval;
	//thisval steht hier fuer den bitfield-wert, 
	//aus Generierungsgruenden hier keine einheitliche Bezeichnung moeglich.
	dword thisval; // Display1AdditionalInfo1_1
	bitval= getValue(this);
	thisval = getValue(A_ASG_69_0_0_27_Data_6);
	thisval = thisval&~(1<<18)|(bitval<<18);
	putValue(A_ASG_69_0_0_27_Data_6,thisval);
}

on envVar A_ASG_69_0_0_27_Data_6_19
{
	byte bitval;
	//thisval steht hier fuer den bitfield-wert, 
	//aus Generierungsgruenden hier keine einheitliche Bezeichnung moeglich.
	dword thisval; // Display1AdditionalInfo1_1
	bitval= getValue(this);
	thisval = getValue(A_ASG_69_0_0_27_Data_6);
	thisval = thisval&~(1<<19)|(bitval<<19);
	putValue(A_ASG_69_0_0_27_Data_6,thisval);
}

on envVar A_ASG_69_0_0_27_Data_6_20
{
	byte bitval;
	//thisval steht hier fuer den bitfield-wert, 
	//aus Generierungsgruenden hier keine einheitliche Bezeichnung moeglich.
	dword thisval; // Display1AdditionalInfo1_1
	bitval= getValue(this);
	thisval = getValue(A_ASG_69_0_0_27_Data_6);
	thisval = thisval&~(1<<20)|(bitval<<20);
	putValue(A_ASG_69_0_0_27_Data_6,thisval);
}

on envVar A_ASG_69_0_0_27_Data_6_21
{
	byte bitval;
	//thisval steht hier fuer den bitfield-wert, 
	//aus Generierungsgruenden hier keine einheitliche Bezeichnung moeglich.
	dword thisval; // Display1AdditionalInfo1_1
	bitval= getValue(this);
	thisval = getValue(A_ASG_69_0_0_27_Data_6);
	thisval = thisval&~(1<<21)|(bitval<<21);
	putValue(A_ASG_69_0_0_27_Data_6,thisval);
}

on envVar A_ASG_69_0_0_27_Data_6_22
{
	byte bitval;
	//thisval steht hier fuer den bitfield-wert, 
	//aus Generierungsgruenden hier keine einheitliche Bezeichnung moeglich.
	dword thisval; // Display1AdditionalInfo1_1
	bitval= getValue(this);
	thisval = getValue(A_ASG_69_0_0_27_Data_6);
	thisval = thisval&~(1<<22)|(bitval<<22);
	putValue(A_ASG_69_0_0_27_Data_6,thisval);
}

on envVar A_ASG_69_0_0_27_Data_6_23
{
	byte bitval;
	//thisval steht hier fuer den bitfield-wert, 
	//aus Generierungsgruenden hier keine einheitliche Bezeichnung moeglich.
	dword thisval; // Display1AdditionalInfo1_1
	bitval= getValue(this);
	thisval = getValue(A_ASG_69_0_0_27_Data_6);
	thisval = thisval&~(1<<23)|(bitval<<23);
	putValue(A_ASG_69_0_0_27_Data_6,thisval);
}

on envVar A_ASG_69_0_0_27_Data_6_24
{
	byte bitval;
	//thisval steht hier fuer den bitfield-wert, 
	//aus Generierungsgruenden hier keine einheitliche Bezeichnung moeglich.
	dword thisval; // Display1AdditionalInfo1_1
	bitval= getValue(this);
	thisval = getValue(A_ASG_69_0_0_27_Data_6);
	thisval = thisval&~(1<<24)|(bitval<<24);
	putValue(A_ASG_69_0_0_27_Data_6,thisval);
}

on envVar A_ASG_69_0_0_27_Data_6_25
{
	byte bitval;
	//thisval steht hier fuer den bitfield-wert, 
	//aus Generierungsgruenden hier keine einheitliche Bezeichnung moeglich.
	dword thisval; // Display1AdditionalInfo1_1
	bitval= getValue(this);
	thisval = getValue(A_ASG_69_0_0_27_Data_6);
	thisval = thisval&~(1<<25)|(bitval<<25);
	putValue(A_ASG_69_0_0_27_Data_6,thisval);
}

on envVar A_ASG_69_0_0_27_Data_6_26
{
	byte bitval;
	//thisval steht hier fuer den bitfield-wert, 
	//aus Generierungsgruenden hier keine einheitliche Bezeichnung moeglich.
	dword thisval; // Display1AdditionalInfo1_1
	bitval= getValue(this);
	thisval = getValue(A_ASG_69_0_0_27_Data_6);
	thisval = thisval&~(1<<26)|(bitval<<26);
	putValue(A_ASG_69_0_0_27_Data_6,thisval);
}

on envVar A_ASG_69_0_0_27_Data_6_27
{
	byte bitval;
	//thisval steht hier fuer den bitfield-wert, 
	//aus Generierungsgruenden hier keine einheitliche Bezeichnung moeglich.
	dword thisval; // Display1AdditionalInfo1_1
	bitval= getValue(this);
	thisval = getValue(A_ASG_69_0_0_27_Data_6);
	thisval = thisval&~(1<<27)|(bitval<<27);
	putValue(A_ASG_69_0_0_27_Data_6,thisval);
}

on envVar A_ASG_69_0_0_27_Data_6_28
{
	byte bitval;
	//thisval steht hier fuer den bitfield-wert, 
	//aus Generierungsgruenden hier keine einheitliche Bezeichnung moeglich.
	dword thisval; // Display1AdditionalInfo1_1
	bitval= getValue(this);
	thisval = getValue(A_ASG_69_0_0_27_Data_6);
	thisval = thisval&~(1<<28)|(bitval<<28);
	putValue(A_ASG_69_0_0_27_Data_6,thisval);
}

on envVar A_ASG_69_0_0_27_Data_6_29
{
	byte bitval;
	//thisval steht hier fuer den bitfield-wert, 
	//aus Generierungsgruenden hier keine einheitliche Bezeichnung moeglich.
	dword thisval; // Display1AdditionalInfo1_1
	bitval= getValue(this);
	thisval = getValue(A_ASG_69_0_0_27_Data_6);
	thisval = thisval&~(1<<29)|(bitval<<29);
	putValue(A_ASG_69_0_0_27_Data_6,thisval);
}

on envVar A_ASG_69_0_0_27_Data_6_30
{
	byte bitval;
	//thisval steht hier fuer den bitfield-wert, 
	//aus Generierungsgruenden hier keine einheitliche Bezeichnung moeglich.
	dword thisval; // Display1AdditionalInfo1_1
	bitval= getValue(this);
	thisval = getValue(A_ASG_69_0_0_27_Data_6);
	thisval = thisval&~(1<<30)|(bitval<<30);
	putValue(A_ASG_69_0_0_27_Data_6,thisval);
}

on envVar A_ASG_69_0_0_27_Data_6_31
{
	byte bitval;
	//thisval steht hier fuer den bitfield-wert, 
	//aus Generierungsgruenden hier keine einheitliche Bezeichnung moeglich.
	dword thisval; // Display1AdditionalInfo1_1
	bitval= getValue(this);
	thisval = getValue(A_ASG_69_0_0_27_Data_6);
	thisval = thisval&~(1<<31)|(bitval<<31);
	putValue(A_ASG_69_0_0_27_Data_6,thisval);
}

on envVar A_ASG_69_0_0_27_Data_6
{
	byte superval[665];

	//Update Childvalue (BitField)
	byte mask=0x01;
	int i = 0;
	dword thisval; // Display1AdditionalInfo1_1
	thisval = getValue(this);
	if(thisval&(mask<<0))
		putValue(A_ASG_69_0_0_27_Data_6_0, 1);
	else
		putValue(A_ASG_69_0_0_27_Data_6_0, 0);
	if(thisval&(mask<<1))
		putValue(A_ASG_69_0_0_27_Data_6_1, 1);
	else
		putValue(A_ASG_69_0_0_27_Data_6_1, 0);
	if(thisval&(mask<<2))
		putValue(A_ASG_69_0_0_27_Data_6_2, 1);
	else
		putValue(A_ASG_69_0_0_27_Data_6_2, 0);
	if(thisval&(mask<<3))
		putValue(A_ASG_69_0_0_27_Data_6_3, 1);
	else
		putValue(A_ASG_69_0_0_27_Data_6_3, 0);
	if(thisval&(mask<<4))
		putValue(A_ASG_69_0_0_27_Data_6_4, 1);
	else
		putValue(A_ASG_69_0_0_27_Data_6_4, 0);
	if(thisval&(mask<<5))
		putValue(A_ASG_69_0_0_27_Data_6_5, 1);
	else
		putValue(A_ASG_69_0_0_27_Data_6_5, 0);
	if(thisval&(mask<<6))
		putValue(A_ASG_69_0_0_27_Data_6_6, 1);
	else
		putValue(A_ASG_69_0_0_27_Data_6_6, 0);
	if(thisval&(mask<<7))
		putValue(A_ASG_69_0_0_27_Data_6_7, 1);
	else
		putValue(A_ASG_69_0_0_27_Data_6_7, 0);
	if(thisval&(mask<<8))
		putValue(A_ASG_69_0_0_27_Data_6_8, 1);
	else
		putValue(A_ASG_69_0_0_27_Data_6_8, 0);
	if(thisval&(mask<<9))
		putValue(A_ASG_69_0_0_27_Data_6_9, 1);
	else
		putValue(A_ASG_69_0_0_27_Data_6_9, 0);
	if(thisval&(mask<<10))
		putValue(A_ASG_69_0_0_27_Data_6_10, 1);
	else
		putValue(A_ASG_69_0_0_27_Data_6_10, 0);
	if(thisval&(mask<<11))
		putValue(A_ASG_69_0_0_27_Data_6_11, 1);
	else
		putValue(A_ASG_69_0_0_27_Data_6_11, 0);
	if(thisval&(mask<<12))
		putValue(A_ASG_69_0_0_27_Data_6_12, 1);
	else
		putValue(A_ASG_69_0_0_27_Data_6_12, 0);
	if(thisval&(mask<<13))
		putValue(A_ASG_69_0_0_27_Data_6_13, 1);
	else
		putValue(A_ASG_69_0_0_27_Data_6_13, 0);
	if(thisval&(mask<<14))
		putValue(A_ASG_69_0_0_27_Data_6_14, 1);
	else
		putValue(A_ASG_69_0_0_27_Data_6_14, 0);
	if(thisval&(mask<<15))
		putValue(A_ASG_69_0_0_27_Data_6_15, 1);
	else
		putValue(A_ASG_69_0_0_27_Data_6_15, 0);
	if(thisval&(mask<<16))
		putValue(A_ASG_69_0_0_27_Data_6_16, 1);
	else
		putValue(A_ASG_69_0_0_27_Data_6_16, 0);
	if(thisval&(mask<<17))
		putValue(A_ASG_69_0_0_27_Data_6_17, 1);
	else
		putValue(A_ASG_69_0_0_27_Data_6_17, 0);
	if(thisval&(mask<<18))
		putValue(A_ASG_69_0_0_27_Data_6_18, 1);
	else
		putValue(A_ASG_69_0_0_27_Data_6_18, 0);
	if(thisval&(mask<<19))
		putValue(A_ASG_69_0_0_27_Data_6_19, 1);
	else
		putValue(A_ASG_69_0_0_27_Data_6_19, 0);
	if(thisval&(mask<<20))
		putValue(A_ASG_69_0_0_27_Data_6_20, 1);
	else
		putValue(A_ASG_69_0_0_27_Data_6_20, 0);
	if(thisval&(mask<<21))
		putValue(A_ASG_69_0_0_27_Data_6_21, 1);
	else
		putValue(A_ASG_69_0_0_27_Data_6_21, 0);
	if(thisval&(mask<<22))
		putValue(A_ASG_69_0_0_27_Data_6_22, 1);
	else
		putValue(A_ASG_69_0_0_27_Data_6_22, 0);
	if(thisval&(mask<<23))
		putValue(A_ASG_69_0_0_27_Data_6_23, 1);
	else
		putValue(A_ASG_69_0_0_27_Data_6_23, 0);
	if(thisval&(mask<<24))
		putValue(A_ASG_69_0_0_27_Data_6_24, 1);
	else
		putValue(A_ASG_69_0_0_27_Data_6_24, 0);
	if(thisval&(mask<<25))
		putValue(A_ASG_69_0_0_27_Data_6_25, 1);
	else
		putValue(A_ASG_69_0_0_27_Data_6_25, 0);
	if(thisval&(mask<<26))
		putValue(A_ASG_69_0_0_27_Data_6_26, 1);
	else
		putValue(A_ASG_69_0_0_27_Data_6_26, 0);
	if(thisval&(mask<<27))
		putValue(A_ASG_69_0_0_27_Data_6_27, 1);
	else
		putValue(A_ASG_69_0_0_27_Data_6_27, 0);
	if(thisval&(mask<<28))
		putValue(A_ASG_69_0_0_27_Data_6_28, 1);
	else
		putValue(A_ASG_69_0_0_27_Data_6_28, 0);
	if(thisval&(mask<<29))
		putValue(A_ASG_69_0_0_27_Data_6_29, 1);
	else
		putValue(A_ASG_69_0_0_27_Data_6_29, 0);
	if(thisval&(mask<<30))
		putValue(A_ASG_69_0_0_27_Data_6_30, 1);
	else
		putValue(A_ASG_69_0_0_27_Data_6_30, 0);
	if(thisval&(mask<<31))
		putValue(A_ASG_69_0_0_27_Data_6_31, 1);
	else
		putValue(A_ASG_69_0_0_27_Data_6_31, 0);
    A_ASG_69_0_0_27_ArrayDataList[getValue(A_ASG_69_0_0_27_DataIndex)].Param6 = thisval;
}
on envVar A_ASG_69_0_0_27_Data_7_0
{
	byte bitval;
	//thisval steht hier fuer den bitfield-wert, 
	//aus Generierungsgruenden hier keine einheitliche Bezeichnung moeglich.
	dword thisval; // Display1AdditionalInfo1_2
	bitval= getValue(this);
	thisval = getValue(A_ASG_69_0_0_27_Data_7);
	thisval = thisval&~(1<<0)|(bitval<<0);
	putValue(A_ASG_69_0_0_27_Data_7,thisval);
}

on envVar A_ASG_69_0_0_27_Data_7_1
{
	byte bitval;
	//thisval steht hier fuer den bitfield-wert, 
	//aus Generierungsgruenden hier keine einheitliche Bezeichnung moeglich.
	dword thisval; // Display1AdditionalInfo1_2
	bitval= getValue(this);
	thisval = getValue(A_ASG_69_0_0_27_Data_7);
	thisval = thisval&~(1<<1)|(bitval<<1);
	putValue(A_ASG_69_0_0_27_Data_7,thisval);
}

on envVar A_ASG_69_0_0_27_Data_7_2
{
	byte bitval;
	//thisval steht hier fuer den bitfield-wert, 
	//aus Generierungsgruenden hier keine einheitliche Bezeichnung moeglich.
	dword thisval; // Display1AdditionalInfo1_2
	bitval= getValue(this);
	thisval = getValue(A_ASG_69_0_0_27_Data_7);
	thisval = thisval&~(1<<2)|(bitval<<2);
	putValue(A_ASG_69_0_0_27_Data_7,thisval);
}

on envVar A_ASG_69_0_0_27_Data_7_3
{
	byte bitval;
	//thisval steht hier fuer den bitfield-wert, 
	//aus Generierungsgruenden hier keine einheitliche Bezeichnung moeglich.
	dword thisval; // Display1AdditionalInfo1_2
	bitval= getValue(this);
	thisval = getValue(A_ASG_69_0_0_27_Data_7);
	thisval = thisval&~(1<<3)|(bitval<<3);
	putValue(A_ASG_69_0_0_27_Data_7,thisval);
}

on envVar A_ASG_69_0_0_27_Data_7_4
{
	byte bitval;
	//thisval steht hier fuer den bitfield-wert, 
	//aus Generierungsgruenden hier keine einheitliche Bezeichnung moeglich.
	dword thisval; // Display1AdditionalInfo1_2
	bitval= getValue(this);
	thisval = getValue(A_ASG_69_0_0_27_Data_7);
	thisval = thisval&~(1<<4)|(bitval<<4);
	putValue(A_ASG_69_0_0_27_Data_7,thisval);
}

on envVar A_ASG_69_0_0_27_Data_7_5
{
	byte bitval;
	//thisval steht hier fuer den bitfield-wert, 
	//aus Generierungsgruenden hier keine einheitliche Bezeichnung moeglich.
	dword thisval; // Display1AdditionalInfo1_2
	bitval= getValue(this);
	thisval = getValue(A_ASG_69_0_0_27_Data_7);
	thisval = thisval&~(1<<5)|(bitval<<5);
	putValue(A_ASG_69_0_0_27_Data_7,thisval);
}

on envVar A_ASG_69_0_0_27_Data_7_6
{
	byte bitval;
	//thisval steht hier fuer den bitfield-wert, 
	//aus Generierungsgruenden hier keine einheitliche Bezeichnung moeglich.
	dword thisval; // Display1AdditionalInfo1_2
	bitval= getValue(this);
	thisval = getValue(A_ASG_69_0_0_27_Data_7);
	thisval = thisval&~(1<<6)|(bitval<<6);
	putValue(A_ASG_69_0_0_27_Data_7,thisval);
}

on envVar A_ASG_69_0_0_27_Data_7_7
{
	byte bitval;
	//thisval steht hier fuer den bitfield-wert, 
	//aus Generierungsgruenden hier keine einheitliche Bezeichnung moeglich.
	dword thisval; // Display1AdditionalInfo1_2
	bitval= getValue(this);
	thisval = getValue(A_ASG_69_0_0_27_Data_7);
	thisval = thisval&~(1<<7)|(bitval<<7);
	putValue(A_ASG_69_0_0_27_Data_7,thisval);
}

on envVar A_ASG_69_0_0_27_Data_7_8
{
	byte bitval;
	//thisval steht hier fuer den bitfield-wert, 
	//aus Generierungsgruenden hier keine einheitliche Bezeichnung moeglich.
	dword thisval; // Display1AdditionalInfo1_2
	bitval= getValue(this);
	thisval = getValue(A_ASG_69_0_0_27_Data_7);
	thisval = thisval&~(1<<8)|(bitval<<8);
	putValue(A_ASG_69_0_0_27_Data_7,thisval);
}

on envVar A_ASG_69_0_0_27_Data_7_9
{
	byte bitval;
	//thisval steht hier fuer den bitfield-wert, 
	//aus Generierungsgruenden hier keine einheitliche Bezeichnung moeglich.
	dword thisval; // Display1AdditionalInfo1_2
	bitval= getValue(this);
	thisval = getValue(A_ASG_69_0_0_27_Data_7);
	thisval = thisval&~(1<<9)|(bitval<<9);
	putValue(A_ASG_69_0_0_27_Data_7,thisval);
}

on envVar A_ASG_69_0_0_27_Data_7_10
{
	byte bitval;
	//thisval steht hier fuer den bitfield-wert, 
	//aus Generierungsgruenden hier keine einheitliche Bezeichnung moeglich.
	dword thisval; // Display1AdditionalInfo1_2
	bitval= getValue(this);
	thisval = getValue(A_ASG_69_0_0_27_Data_7);
	thisval = thisval&~(1<<10)|(bitval<<10);
	putValue(A_ASG_69_0_0_27_Data_7,thisval);
}

on envVar A_ASG_69_0_0_27_Data_7_11
{
	byte bitval;
	//thisval steht hier fuer den bitfield-wert, 
	//aus Generierungsgruenden hier keine einheitliche Bezeichnung moeglich.
	dword thisval; // Display1AdditionalInfo1_2
	bitval= getValue(this);
	thisval = getValue(A_ASG_69_0_0_27_Data_7);
	thisval = thisval&~(1<<11)|(bitval<<11);
	putValue(A_ASG_69_0_0_27_Data_7,thisval);
}

on envVar A_ASG_69_0_0_27_Data_7_12
{
	byte bitval;
	//thisval steht hier fuer den bitfield-wert, 
	//aus Generierungsgruenden hier keine einheitliche Bezeichnung moeglich.
	dword thisval; // Display1AdditionalInfo1_2
	bitval= getValue(this);
	thisval = getValue(A_ASG_69_0_0_27_Data_7);
	thisval = thisval&~(1<<12)|(bitval<<12);
	putValue(A_ASG_69_0_0_27_Data_7,thisval);
}

on envVar A_ASG_69_0_0_27_Data_7_13
{
	byte bitval;
	//thisval steht hier fuer den bitfield-wert, 
	//aus Generierungsgruenden hier keine einheitliche Bezeichnung moeglich.
	dword thisval; // Display1AdditionalInfo1_2
	bitval= getValue(this);
	thisval = getValue(A_ASG_69_0_0_27_Data_7);
	thisval = thisval&~(1<<13)|(bitval<<13);
	putValue(A_ASG_69_0_0_27_Data_7,thisval);
}

on envVar A_ASG_69_0_0_27_Data_7_14
{
	byte bitval;
	//thisval steht hier fuer den bitfield-wert, 
	//aus Generierungsgruenden hier keine einheitliche Bezeichnung moeglich.
	dword thisval; // Display1AdditionalInfo1_2
	bitval= getValue(this);
	thisval = getValue(A_ASG_69_0_0_27_Data_7);
	thisval = thisval&~(1<<14)|(bitval<<14);
	putValue(A_ASG_69_0_0_27_Data_7,thisval);
}

on envVar A_ASG_69_0_0_27_Data_7_15
{
	byte bitval;
	//thisval steht hier fuer den bitfield-wert, 
	//aus Generierungsgruenden hier keine einheitliche Bezeichnung moeglich.
	dword thisval; // Display1AdditionalInfo1_2
	bitval= getValue(this);
	thisval = getValue(A_ASG_69_0_0_27_Data_7);
	thisval = thisval&~(1<<15)|(bitval<<15);
	putValue(A_ASG_69_0_0_27_Data_7,thisval);
}

on envVar A_ASG_69_0_0_27_Data_7_16
{
	byte bitval;
	//thisval steht hier fuer den bitfield-wert, 
	//aus Generierungsgruenden hier keine einheitliche Bezeichnung moeglich.
	dword thisval; // Display1AdditionalInfo1_2
	bitval= getValue(this);
	thisval = getValue(A_ASG_69_0_0_27_Data_7);
	thisval = thisval&~(1<<16)|(bitval<<16);
	putValue(A_ASG_69_0_0_27_Data_7,thisval);
}

on envVar A_ASG_69_0_0_27_Data_7_17
{
	byte bitval;
	//thisval steht hier fuer den bitfield-wert, 
	//aus Generierungsgruenden hier keine einheitliche Bezeichnung moeglich.
	dword thisval; // Display1AdditionalInfo1_2
	bitval= getValue(this);
	thisval = getValue(A_ASG_69_0_0_27_Data_7);
	thisval = thisval&~(1<<17)|(bitval<<17);
	putValue(A_ASG_69_0_0_27_Data_7,thisval);
}

on envVar A_ASG_69_0_0_27_Data_7_18
{
	byte bitval;
	//thisval steht hier fuer den bitfield-wert, 
	//aus Generierungsgruenden hier keine einheitliche Bezeichnung moeglich.
	dword thisval; // Display1AdditionalInfo1_2
	bitval= getValue(this);
	thisval = getValue(A_ASG_69_0_0_27_Data_7);
	thisval = thisval&~(1<<18)|(bitval<<18);
	putValue(A_ASG_69_0_0_27_Data_7,thisval);
}

on envVar A_ASG_69_0_0_27_Data_7_19
{
	byte bitval;
	//thisval steht hier fuer den bitfield-wert, 
	//aus Generierungsgruenden hier keine einheitliche Bezeichnung moeglich.
	dword thisval; // Display1AdditionalInfo1_2
	bitval= getValue(this);
	thisval = getValue(A_ASG_69_0_0_27_Data_7);
	thisval = thisval&~(1<<19)|(bitval<<19);
	putValue(A_ASG_69_0_0_27_Data_7,thisval);
}

on envVar A_ASG_69_0_0_27_Data_7_20
{
	byte bitval;
	//thisval steht hier fuer den bitfield-wert, 
	//aus Generierungsgruenden hier keine einheitliche Bezeichnung moeglich.
	dword thisval; // Display1AdditionalInfo1_2
	bitval= getValue(this);
	thisval = getValue(A_ASG_69_0_0_27_Data_7);
	thisval = thisval&~(1<<20)|(bitval<<20);
	putValue(A_ASG_69_0_0_27_Data_7,thisval);
}

on envVar A_ASG_69_0_0_27_Data_7_21
{
	byte bitval;
	//thisval steht hier fuer den bitfield-wert, 
	//aus Generierungsgruenden hier keine einheitliche Bezeichnung moeglich.
	dword thisval; // Display1AdditionalInfo1_2
	bitval= getValue(this);
	thisval = getValue(A_ASG_69_0_0_27_Data_7);
	thisval = thisval&~(1<<21)|(bitval<<21);
	putValue(A_ASG_69_0_0_27_Data_7,thisval);
}

on envVar A_ASG_69_0_0_27_Data_7_22
{
	byte bitval;
	//thisval steht hier fuer den bitfield-wert, 
	//aus Generierungsgruenden hier keine einheitliche Bezeichnung moeglich.
	dword thisval; // Display1AdditionalInfo1_2
	bitval= getValue(this);
	thisval = getValue(A_ASG_69_0_0_27_Data_7);
	thisval = thisval&~(1<<22)|(bitval<<22);
	putValue(A_ASG_69_0_0_27_Data_7,thisval);
}

on envVar A_ASG_69_0_0_27_Data_7_23
{
	byte bitval;
	//thisval steht hier fuer den bitfield-wert, 
	//aus Generierungsgruenden hier keine einheitliche Bezeichnung moeglich.
	dword thisval; // Display1AdditionalInfo1_2
	bitval= getValue(this);
	thisval = getValue(A_ASG_69_0_0_27_Data_7);
	thisval = thisval&~(1<<23)|(bitval<<23);
	putValue(A_ASG_69_0_0_27_Data_7,thisval);
}

on envVar A_ASG_69_0_0_27_Data_7_24
{
	byte bitval;
	//thisval steht hier fuer den bitfield-wert, 
	//aus Generierungsgruenden hier keine einheitliche Bezeichnung moeglich.
	dword thisval; // Display1AdditionalInfo1_2
	bitval= getValue(this);
	thisval = getValue(A_ASG_69_0_0_27_Data_7);
	thisval = thisval&~(1<<24)|(bitval<<24);
	putValue(A_ASG_69_0_0_27_Data_7,thisval);
}

on envVar A_ASG_69_0_0_27_Data_7_25
{
	byte bitval;
	//thisval steht hier fuer den bitfield-wert, 
	//aus Generierungsgruenden hier keine einheitliche Bezeichnung moeglich.
	dword thisval; // Display1AdditionalInfo1_2
	bitval= getValue(this);
	thisval = getValue(A_ASG_69_0_0_27_Data_7);
	thisval = thisval&~(1<<25)|(bitval<<25);
	putValue(A_ASG_69_0_0_27_Data_7,thisval);
}

on envVar A_ASG_69_0_0_27_Data_7_26
{
	byte bitval;
	//thisval steht hier fuer den bitfield-wert, 
	//aus Generierungsgruenden hier keine einheitliche Bezeichnung moeglich.
	dword thisval; // Display1AdditionalInfo1_2
	bitval= getValue(this);
	thisval = getValue(A_ASG_69_0_0_27_Data_7);
	thisval = thisval&~(1<<26)|(bitval<<26);
	putValue(A_ASG_69_0_0_27_Data_7,thisval);
}

on envVar A_ASG_69_0_0_27_Data_7_27
{
	byte bitval;
	//thisval steht hier fuer den bitfield-wert, 
	//aus Generierungsgruenden hier keine einheitliche Bezeichnung moeglich.
	dword thisval; // Display1AdditionalInfo1_2
	bitval= getValue(this);
	thisval = getValue(A_ASG_69_0_0_27_Data_7);
	thisval = thisval&~(1<<27)|(bitval<<27);
	putValue(A_ASG_69_0_0_27_Data_7,thisval);
}

on envVar A_ASG_69_0_0_27_Data_7_28
{
	byte bitval;
	//thisval steht hier fuer den bitfield-wert, 
	//aus Generierungsgruenden hier keine einheitliche Bezeichnung moeglich.
	dword thisval; // Display1AdditionalInfo1_2
	bitval= getValue(this);
	thisval = getValue(A_ASG_69_0_0_27_Data_7);
	thisval = thisval&~(1<<28)|(bitval<<28);
	putValue(A_ASG_69_0_0_27_Data_7,thisval);
}

on envVar A_ASG_69_0_0_27_Data_7_29
{
	byte bitval;
	//thisval steht hier fuer den bitfield-wert, 
	//aus Generierungsgruenden hier keine einheitliche Bezeichnung moeglich.
	dword thisval; // Display1AdditionalInfo1_2
	bitval= getValue(this);
	thisval = getValue(A_ASG_69_0_0_27_Data_7);
	thisval = thisval&~(1<<29)|(bitval<<29);
	putValue(A_ASG_69_0_0_27_Data_7,thisval);
}

on envVar A_ASG_69_0_0_27_Data_7
{
	byte superval[665];

	//Update Childvalue (BitField)
	byte mask=0x01;
	int i = 0;
	dword thisval; // Display1AdditionalInfo1_2
	thisval = getValue(this);
	if(thisval&(mask<<0))
		putValue(A_ASG_69_0_0_27_Data_7_0, 1);
	else
		putValue(A_ASG_69_0_0_27_Data_7_0, 0);
	if(thisval&(mask<<1))
		putValue(A_ASG_69_0_0_27_Data_7_1, 1);
	else
		putValue(A_ASG_69_0_0_27_Data_7_1, 0);
	if(thisval&(mask<<2))
		putValue(A_ASG_69_0_0_27_Data_7_2, 1);
	else
		putValue(A_ASG_69_0_0_27_Data_7_2, 0);
	if(thisval&(mask<<3))
		putValue(A_ASG_69_0_0_27_Data_7_3, 1);
	else
		putValue(A_ASG_69_0_0_27_Data_7_3, 0);
	if(thisval&(mask<<4))
		putValue(A_ASG_69_0_0_27_Data_7_4, 1);
	else
		putValue(A_ASG_69_0_0_27_Data_7_4, 0);
	if(thisval&(mask<<5))
		putValue(A_ASG_69_0_0_27_Data_7_5, 1);
	else
		putValue(A_ASG_69_0_0_27_Data_7_5, 0);
	if(thisval&(mask<<6))
		putValue(A_ASG_69_0_0_27_Data_7_6, 1);
	else
		putValue(A_ASG_69_0_0_27_Data_7_6, 0);
	if(thisval&(mask<<7))
		putValue(A_ASG_69_0_0_27_Data_7_7, 1);
	else
		putValue(A_ASG_69_0_0_27_Data_7_7, 0);
	if(thisval&(mask<<8))
		putValue(A_ASG_69_0_0_27_Data_7_8, 1);
	else
		putValue(A_ASG_69_0_0_27_Data_7_8, 0);
	if(thisval&(mask<<9))
		putValue(A_ASG_69_0_0_27_Data_7_9, 1);
	else
		putValue(A_ASG_69_0_0_27_Data_7_9, 0);
	if(thisval&(mask<<10))
		putValue(A_ASG_69_0_0_27_Data_7_10, 1);
	else
		putValue(A_ASG_69_0_0_27_Data_7_10, 0);
	if(thisval&(mask<<11))
		putValue(A_ASG_69_0_0_27_Data_7_11, 1);
	else
		putValue(A_ASG_69_0_0_27_Data_7_11, 0);
	if(thisval&(mask<<12))
		putValue(A_ASG_69_0_0_27_Data_7_12, 1);
	else
		putValue(A_ASG_69_0_0_27_Data_7_12, 0);
	if(thisval&(mask<<13))
		putValue(A_ASG_69_0_0_27_Data_7_13, 1);
	else
		putValue(A_ASG_69_0_0_27_Data_7_13, 0);
	if(thisval&(mask<<14))
		putValue(A_ASG_69_0_0_27_Data_7_14, 1);
	else
		putValue(A_ASG_69_0_0_27_Data_7_14, 0);
	if(thisval&(mask<<15))
		putValue(A_ASG_69_0_0_27_Data_7_15, 1);
	else
		putValue(A_ASG_69_0_0_27_Data_7_15, 0);
	if(thisval&(mask<<16))
		putValue(A_ASG_69_0_0_27_Data_7_16, 1);
	else
		putValue(A_ASG_69_0_0_27_Data_7_16, 0);
	if(thisval&(mask<<17))
		putValue(A_ASG_69_0_0_27_Data_7_17, 1);
	else
		putValue(A_ASG_69_0_0_27_Data_7_17, 0);
	if(thisval&(mask<<18))
		putValue(A_ASG_69_0_0_27_Data_7_18, 1);
	else
		putValue(A_ASG_69_0_0_27_Data_7_18, 0);
	if(thisval&(mask<<19))
		putValue(A_ASG_69_0_0_27_Data_7_19, 1);
	else
		putValue(A_ASG_69_0_0_27_Data_7_19, 0);
	if(thisval&(mask<<20))
		putValue(A_ASG_69_0_0_27_Data_7_20, 1);
	else
		putValue(A_ASG_69_0_0_27_Data_7_20, 0);
	if(thisval&(mask<<21))
		putValue(A_ASG_69_0_0_27_Data_7_21, 1);
	else
		putValue(A_ASG_69_0_0_27_Data_7_21, 0);
	if(thisval&(mask<<22))
		putValue(A_ASG_69_0_0_27_Data_7_22, 1);
	else
		putValue(A_ASG_69_0_0_27_Data_7_22, 0);
	if(thisval&(mask<<23))
		putValue(A_ASG_69_0_0_27_Data_7_23, 1);
	else
		putValue(A_ASG_69_0_0_27_Data_7_23, 0);
	if(thisval&(mask<<24))
		putValue(A_ASG_69_0_0_27_Data_7_24, 1);
	else
		putValue(A_ASG_69_0_0_27_Data_7_24, 0);
	if(thisval&(mask<<25))
		putValue(A_ASG_69_0_0_27_Data_7_25, 1);
	else
		putValue(A_ASG_69_0_0_27_Data_7_25, 0);
	if(thisval&(mask<<26))
		putValue(A_ASG_69_0_0_27_Data_7_26, 1);
	else
		putValue(A_ASG_69_0_0_27_Data_7_26, 0);
	if(thisval&(mask<<27))
		putValue(A_ASG_69_0_0_27_Data_7_27, 1);
	else
		putValue(A_ASG_69_0_0_27_Data_7_27, 0);
	if(thisval&(mask<<28))
		putValue(A_ASG_69_0_0_27_Data_7_28, 1);
	else
		putValue(A_ASG_69_0_0_27_Data_7_28, 0);
	if(thisval&(mask<<29))
		putValue(A_ASG_69_0_0_27_Data_7_29, 1);
	else
		putValue(A_ASG_69_0_0_27_Data_7_29, 0);
    A_ASG_69_0_0_27_ArrayDataList[getValue(A_ASG_69_0_0_27_DataIndex)].Param7 = thisval;
}
on envVar A_ASG_69_0_0_27_Data_8_0
{
	byte bitval;
	//thisval steht hier fuer den bitfield-wert, 
	//aus Generierungsgruenden hier keine einheitliche Bezeichnung moeglich.
	dword thisval; // Display1AdditionalInfo2_1
	bitval= getValue(this);
	thisval = getValue(A_ASG_69_0_0_27_Data_8);
	thisval = thisval&~(1<<0)|(bitval<<0);
	putValue(A_ASG_69_0_0_27_Data_8,thisval);
}

on envVar A_ASG_69_0_0_27_Data_8_1
{
	byte bitval;
	//thisval steht hier fuer den bitfield-wert, 
	//aus Generierungsgruenden hier keine einheitliche Bezeichnung moeglich.
	dword thisval; // Display1AdditionalInfo2_1
	bitval= getValue(this);
	thisval = getValue(A_ASG_69_0_0_27_Data_8);
	thisval = thisval&~(1<<1)|(bitval<<1);
	putValue(A_ASG_69_0_0_27_Data_8,thisval);
}

on envVar A_ASG_69_0_0_27_Data_8_2
{
	byte bitval;
	//thisval steht hier fuer den bitfield-wert, 
	//aus Generierungsgruenden hier keine einheitliche Bezeichnung moeglich.
	dword thisval; // Display1AdditionalInfo2_1
	bitval= getValue(this);
	thisval = getValue(A_ASG_69_0_0_27_Data_8);
	thisval = thisval&~(1<<2)|(bitval<<2);
	putValue(A_ASG_69_0_0_27_Data_8,thisval);
}

on envVar A_ASG_69_0_0_27_Data_8_3
{
	byte bitval;
	//thisval steht hier fuer den bitfield-wert, 
	//aus Generierungsgruenden hier keine einheitliche Bezeichnung moeglich.
	dword thisval; // Display1AdditionalInfo2_1
	bitval= getValue(this);
	thisval = getValue(A_ASG_69_0_0_27_Data_8);
	thisval = thisval&~(1<<3)|(bitval<<3);
	putValue(A_ASG_69_0_0_27_Data_8,thisval);
}

on envVar A_ASG_69_0_0_27_Data_8_4
{
	byte bitval;
	//thisval steht hier fuer den bitfield-wert, 
	//aus Generierungsgruenden hier keine einheitliche Bezeichnung moeglich.
	dword thisval; // Display1AdditionalInfo2_1
	bitval= getValue(this);
	thisval = getValue(A_ASG_69_0_0_27_Data_8);
	thisval = thisval&~(1<<4)|(bitval<<4);
	putValue(A_ASG_69_0_0_27_Data_8,thisval);
}

on envVar A_ASG_69_0_0_27_Data_8_5
{
	byte bitval;
	//thisval steht hier fuer den bitfield-wert, 
	//aus Generierungsgruenden hier keine einheitliche Bezeichnung moeglich.
	dword thisval; // Display1AdditionalInfo2_1
	bitval= getValue(this);
	thisval = getValue(A_ASG_69_0_0_27_Data_8);
	thisval = thisval&~(1<<5)|(bitval<<5);
	putValue(A_ASG_69_0_0_27_Data_8,thisval);
}

on envVar A_ASG_69_0_0_27_Data_8_6
{
	byte bitval;
	//thisval steht hier fuer den bitfield-wert, 
	//aus Generierungsgruenden hier keine einheitliche Bezeichnung moeglich.
	dword thisval; // Display1AdditionalInfo2_1
	bitval= getValue(this);
	thisval = getValue(A_ASG_69_0_0_27_Data_8);
	thisval = thisval&~(1<<6)|(bitval<<6);
	putValue(A_ASG_69_0_0_27_Data_8,thisval);
}

on envVar A_ASG_69_0_0_27_Data_8_7
{
	byte bitval;
	//thisval steht hier fuer den bitfield-wert, 
	//aus Generierungsgruenden hier keine einheitliche Bezeichnung moeglich.
	dword thisval; // Display1AdditionalInfo2_1
	bitval= getValue(this);
	thisval = getValue(A_ASG_69_0_0_27_Data_8);
	thisval = thisval&~(1<<7)|(bitval<<7);
	putValue(A_ASG_69_0_0_27_Data_8,thisval);
}

on envVar A_ASG_69_0_0_27_Data_8_8
{
	byte bitval;
	//thisval steht hier fuer den bitfield-wert, 
	//aus Generierungsgruenden hier keine einheitliche Bezeichnung moeglich.
	dword thisval; // Display1AdditionalInfo2_1
	bitval= getValue(this);
	thisval = getValue(A_ASG_69_0_0_27_Data_8);
	thisval = thisval&~(1<<8)|(bitval<<8);
	putValue(A_ASG_69_0_0_27_Data_8,thisval);
}

on envVar A_ASG_69_0_0_27_Data_8_9
{
	byte bitval;
	//thisval steht hier fuer den bitfield-wert, 
	//aus Generierungsgruenden hier keine einheitliche Bezeichnung moeglich.
	dword thisval; // Display1AdditionalInfo2_1
	bitval= getValue(this);
	thisval = getValue(A_ASG_69_0_0_27_Data_8);
	thisval = thisval&~(1<<9)|(bitval<<9);
	putValue(A_ASG_69_0_0_27_Data_8,thisval);
}

on envVar A_ASG_69_0_0_27_Data_8_10
{
	byte bitval;
	//thisval steht hier fuer den bitfield-wert, 
	//aus Generierungsgruenden hier keine einheitliche Bezeichnung moeglich.
	dword thisval; // Display1AdditionalInfo2_1
	bitval= getValue(this);
	thisval = getValue(A_ASG_69_0_0_27_Data_8);
	thisval = thisval&~(1<<10)|(bitval<<10);
	putValue(A_ASG_69_0_0_27_Data_8,thisval);
}

on envVar A_ASG_69_0_0_27_Data_8_11
{
	byte bitval;
	//thisval steht hier fuer den bitfield-wert, 
	//aus Generierungsgruenden hier keine einheitliche Bezeichnung moeglich.
	dword thisval; // Display1AdditionalInfo2_1
	bitval= getValue(this);
	thisval = getValue(A_ASG_69_0_0_27_Data_8);
	thisval = thisval&~(1<<11)|(bitval<<11);
	putValue(A_ASG_69_0_0_27_Data_8,thisval);
}

on envVar A_ASG_69_0_0_27_Data_8_12
{
	byte bitval;
	//thisval steht hier fuer den bitfield-wert, 
	//aus Generierungsgruenden hier keine einheitliche Bezeichnung moeglich.
	dword thisval; // Display1AdditionalInfo2_1
	bitval= getValue(this);
	thisval = getValue(A_ASG_69_0_0_27_Data_8);
	thisval = thisval&~(1<<12)|(bitval<<12);
	putValue(A_ASG_69_0_0_27_Data_8,thisval);
}

on envVar A_ASG_69_0_0_27_Data_8_13
{
	byte bitval;
	//thisval steht hier fuer den bitfield-wert, 
	//aus Generierungsgruenden hier keine einheitliche Bezeichnung moeglich.
	dword thisval; // Display1AdditionalInfo2_1
	bitval= getValue(this);
	thisval = getValue(A_ASG_69_0_0_27_Data_8);
	thisval = thisval&~(1<<13)|(bitval<<13);
	putValue(A_ASG_69_0_0_27_Data_8,thisval);
}

on envVar A_ASG_69_0_0_27_Data_8_14
{
	byte bitval;
	//thisval steht hier fuer den bitfield-wert, 
	//aus Generierungsgruenden hier keine einheitliche Bezeichnung moeglich.
	dword thisval; // Display1AdditionalInfo2_1
	bitval= getValue(this);
	thisval = getValue(A_ASG_69_0_0_27_Data_8);
	thisval = thisval&~(1<<14)|(bitval<<14);
	putValue(A_ASG_69_0_0_27_Data_8,thisval);
}

on envVar A_ASG_69_0_0_27_Data_8_15
{
	byte bitval;
	//thisval steht hier fuer den bitfield-wert, 
	//aus Generierungsgruenden hier keine einheitliche Bezeichnung moeglich.
	dword thisval; // Display1AdditionalInfo2_1
	bitval= getValue(this);
	thisval = getValue(A_ASG_69_0_0_27_Data_8);
	thisval = thisval&~(1<<15)|(bitval<<15);
	putValue(A_ASG_69_0_0_27_Data_8,thisval);
}

on envVar A_ASG_69_0_0_27_Data_8_16
{
	byte bitval;
	//thisval steht hier fuer den bitfield-wert, 
	//aus Generierungsgruenden hier keine einheitliche Bezeichnung moeglich.
	dword thisval; // Display1AdditionalInfo2_1
	bitval= getValue(this);
	thisval = getValue(A_ASG_69_0_0_27_Data_8);
	thisval = thisval&~(1<<16)|(bitval<<16);
	putValue(A_ASG_69_0_0_27_Data_8,thisval);
}

on envVar A_ASG_69_0_0_27_Data_8_17
{
	byte bitval;
	//thisval steht hier fuer den bitfield-wert, 
	//aus Generierungsgruenden hier keine einheitliche Bezeichnung moeglich.
	dword thisval; // Display1AdditionalInfo2_1
	bitval= getValue(this);
	thisval = getValue(A_ASG_69_0_0_27_Data_8);
	thisval = thisval&~(1<<17)|(bitval<<17);
	putValue(A_ASG_69_0_0_27_Data_8,thisval);
}

on envVar A_ASG_69_0_0_27_Data_8_18
{
	byte bitval;
	//thisval steht hier fuer den bitfield-wert, 
	//aus Generierungsgruenden hier keine einheitliche Bezeichnung moeglich.
	dword thisval; // Display1AdditionalInfo2_1
	bitval= getValue(this);
	thisval = getValue(A_ASG_69_0_0_27_Data_8);
	thisval = thisval&~(1<<18)|(bitval<<18);
	putValue(A_ASG_69_0_0_27_Data_8,thisval);
}

on envVar A_ASG_69_0_0_27_Data_8_19
{
	byte bitval;
	//thisval steht hier fuer den bitfield-wert, 
	//aus Generierungsgruenden hier keine einheitliche Bezeichnung moeglich.
	dword thisval; // Display1AdditionalInfo2_1
	bitval= getValue(this);
	thisval = getValue(A_ASG_69_0_0_27_Data_8);
	thisval = thisval&~(1<<19)|(bitval<<19);
	putValue(A_ASG_69_0_0_27_Data_8,thisval);
}

on envVar A_ASG_69_0_0_27_Data_8_20
{
	byte bitval;
	//thisval steht hier fuer den bitfield-wert, 
	//aus Generierungsgruenden hier keine einheitliche Bezeichnung moeglich.
	dword thisval; // Display1AdditionalInfo2_1
	bitval= getValue(this);
	thisval = getValue(A_ASG_69_0_0_27_Data_8);
	thisval = thisval&~(1<<20)|(bitval<<20);
	putValue(A_ASG_69_0_0_27_Data_8,thisval);
}

on envVar A_ASG_69_0_0_27_Data_8_21
{
	byte bitval;
	//thisval steht hier fuer den bitfield-wert, 
	//aus Generierungsgruenden hier keine einheitliche Bezeichnung moeglich.
	dword thisval; // Display1AdditionalInfo2_1
	bitval= getValue(this);
	thisval = getValue(A_ASG_69_0_0_27_Data_8);
	thisval = thisval&~(1<<21)|(bitval<<21);
	putValue(A_ASG_69_0_0_27_Data_8,thisval);
}

on envVar A_ASG_69_0_0_27_Data_8_22
{
	byte bitval;
	//thisval steht hier fuer den bitfield-wert, 
	//aus Generierungsgruenden hier keine einheitliche Bezeichnung moeglich.
	dword thisval; // Display1AdditionalInfo2_1
	bitval= getValue(this);
	thisval = getValue(A_ASG_69_0_0_27_Data_8);
	thisval = thisval&~(1<<22)|(bitval<<22);
	putValue(A_ASG_69_0_0_27_Data_8,thisval);
}

on envVar A_ASG_69_0_0_27_Data_8_23
{
	byte bitval;
	//thisval steht hier fuer den bitfield-wert, 
	//aus Generierungsgruenden hier keine einheitliche Bezeichnung moeglich.
	dword thisval; // Display1AdditionalInfo2_1
	bitval= getValue(this);
	thisval = getValue(A_ASG_69_0_0_27_Data_8);
	thisval = thisval&~(1<<23)|(bitval<<23);
	putValue(A_ASG_69_0_0_27_Data_8,thisval);
}

on envVar A_ASG_69_0_0_27_Data_8_24
{
	byte bitval;
	//thisval steht hier fuer den bitfield-wert, 
	//aus Generierungsgruenden hier keine einheitliche Bezeichnung moeglich.
	dword thisval; // Display1AdditionalInfo2_1
	bitval= getValue(this);
	thisval = getValue(A_ASG_69_0_0_27_Data_8);
	thisval = thisval&~(1<<24)|(bitval<<24);
	putValue(A_ASG_69_0_0_27_Data_8,thisval);
}

on envVar A_ASG_69_0_0_27_Data_8_25
{
	byte bitval;
	//thisval steht hier fuer den bitfield-wert, 
	//aus Generierungsgruenden hier keine einheitliche Bezeichnung moeglich.
	dword thisval; // Display1AdditionalInfo2_1
	bitval= getValue(this);
	thisval = getValue(A_ASG_69_0_0_27_Data_8);
	thisval = thisval&~(1<<25)|(bitval<<25);
	putValue(A_ASG_69_0_0_27_Data_8,thisval);
}

on envVar A_ASG_69_0_0_27_Data_8_26
{
	byte bitval;
	//thisval steht hier fuer den bitfield-wert, 
	//aus Generierungsgruenden hier keine einheitliche Bezeichnung moeglich.
	dword thisval; // Display1AdditionalInfo2_1
	bitval= getValue(this);
	thisval = getValue(A_ASG_69_0_0_27_Data_8);
	thisval = thisval&~(1<<26)|(bitval<<26);
	putValue(A_ASG_69_0_0_27_Data_8,thisval);
}

on envVar A_ASG_69_0_0_27_Data_8_27
{
	byte bitval;
	//thisval steht hier fuer den bitfield-wert, 
	//aus Generierungsgruenden hier keine einheitliche Bezeichnung moeglich.
	dword thisval; // Display1AdditionalInfo2_1
	bitval= getValue(this);
	thisval = getValue(A_ASG_69_0_0_27_Data_8);
	thisval = thisval&~(1<<27)|(bitval<<27);
	putValue(A_ASG_69_0_0_27_Data_8,thisval);
}

on envVar A_ASG_69_0_0_27_Data_8_28
{
	byte bitval;
	//thisval steht hier fuer den bitfield-wert, 
	//aus Generierungsgruenden hier keine einheitliche Bezeichnung moeglich.
	dword thisval; // Display1AdditionalInfo2_1
	bitval= getValue(this);
	thisval = getValue(A_ASG_69_0_0_27_Data_8);
	thisval = thisval&~(1<<28)|(bitval<<28);
	putValue(A_ASG_69_0_0_27_Data_8,thisval);
}

on envVar A_ASG_69_0_0_27_Data_8_29
{
	byte bitval;
	//thisval steht hier fuer den bitfield-wert, 
	//aus Generierungsgruenden hier keine einheitliche Bezeichnung moeglich.
	dword thisval; // Display1AdditionalInfo2_1
	bitval= getValue(this);
	thisval = getValue(A_ASG_69_0_0_27_Data_8);
	thisval = thisval&~(1<<29)|(bitval<<29);
	putValue(A_ASG_69_0_0_27_Data_8,thisval);
}

on envVar A_ASG_69_0_0_27_Data_8_30
{
	byte bitval;
	//thisval steht hier fuer den bitfield-wert, 
	//aus Generierungsgruenden hier keine einheitliche Bezeichnung moeglich.
	dword thisval; // Display1AdditionalInfo2_1
	bitval= getValue(this);
	thisval = getValue(A_ASG_69_0_0_27_Data_8);
	thisval = thisval&~(1<<30)|(bitval<<30);
	putValue(A_ASG_69_0_0_27_Data_8,thisval);
}

on envVar A_ASG_69_0_0_27_Data_8_31
{
	byte bitval;
	//thisval steht hier fuer den bitfield-wert, 
	//aus Generierungsgruenden hier keine einheitliche Bezeichnung moeglich.
	dword thisval; // Display1AdditionalInfo2_1
	bitval= getValue(this);
	thisval = getValue(A_ASG_69_0_0_27_Data_8);
	thisval = thisval&~(1<<31)|(bitval<<31);
	putValue(A_ASG_69_0_0_27_Data_8,thisval);
}

on envVar A_ASG_69_0_0_27_Data_8
{
	byte superval[665];

	//Update Childvalue (BitField)
	byte mask=0x01;
	int i = 0;
	dword thisval; // Display1AdditionalInfo2_1
	thisval = getValue(this);
	if(thisval&(mask<<0))
		putValue(A_ASG_69_0_0_27_Data_8_0, 1);
	else
		putValue(A_ASG_69_0_0_27_Data_8_0, 0);
	if(thisval&(mask<<1))
		putValue(A_ASG_69_0_0_27_Data_8_1, 1);
	else
		putValue(A_ASG_69_0_0_27_Data_8_1, 0);
	if(thisval&(mask<<2))
		putValue(A_ASG_69_0_0_27_Data_8_2, 1);
	else
		putValue(A_ASG_69_0_0_27_Data_8_2, 0);
	if(thisval&(mask<<3))
		putValue(A_ASG_69_0_0_27_Data_8_3, 1);
	else
		putValue(A_ASG_69_0_0_27_Data_8_3, 0);
	if(thisval&(mask<<4))
		putValue(A_ASG_69_0_0_27_Data_8_4, 1);
	else
		putValue(A_ASG_69_0_0_27_Data_8_4, 0);
	if(thisval&(mask<<5))
		putValue(A_ASG_69_0_0_27_Data_8_5, 1);
	else
		putValue(A_ASG_69_0_0_27_Data_8_5, 0);
	if(thisval&(mask<<6))
		putValue(A_ASG_69_0_0_27_Data_8_6, 1);
	else
		putValue(A_ASG_69_0_0_27_Data_8_6, 0);
	if(thisval&(mask<<7))
		putValue(A_ASG_69_0_0_27_Data_8_7, 1);
	else
		putValue(A_ASG_69_0_0_27_Data_8_7, 0);
	if(thisval&(mask<<8))
		putValue(A_ASG_69_0_0_27_Data_8_8, 1);
	else
		putValue(A_ASG_69_0_0_27_Data_8_8, 0);
	if(thisval&(mask<<9))
		putValue(A_ASG_69_0_0_27_Data_8_9, 1);
	else
		putValue(A_ASG_69_0_0_27_Data_8_9, 0);
	if(thisval&(mask<<10))
		putValue(A_ASG_69_0_0_27_Data_8_10, 1);
	else
		putValue(A_ASG_69_0_0_27_Data_8_10, 0);
	if(thisval&(mask<<11))
		putValue(A_ASG_69_0_0_27_Data_8_11, 1);
	else
		putValue(A_ASG_69_0_0_27_Data_8_11, 0);
	if(thisval&(mask<<12))
		putValue(A_ASG_69_0_0_27_Data_8_12, 1);
	else
		putValue(A_ASG_69_0_0_27_Data_8_12, 0);
	if(thisval&(mask<<13))
		putValue(A_ASG_69_0_0_27_Data_8_13, 1);
	else
		putValue(A_ASG_69_0_0_27_Data_8_13, 0);
	if(thisval&(mask<<14))
		putValue(A_ASG_69_0_0_27_Data_8_14, 1);
	else
		putValue(A_ASG_69_0_0_27_Data_8_14, 0);
	if(thisval&(mask<<15))
		putValue(A_ASG_69_0_0_27_Data_8_15, 1);
	else
		putValue(A_ASG_69_0_0_27_Data_8_15, 0);
	if(thisval&(mask<<16))
		putValue(A_ASG_69_0_0_27_Data_8_16, 1);
	else
		putValue(A_ASG_69_0_0_27_Data_8_16, 0);
	if(thisval&(mask<<17))
		putValue(A_ASG_69_0_0_27_Data_8_17, 1);
	else
		putValue(A_ASG_69_0_0_27_Data_8_17, 0);
	if(thisval&(mask<<18))
		putValue(A_ASG_69_0_0_27_Data_8_18, 1);
	else
		putValue(A_ASG_69_0_0_27_Data_8_18, 0);
	if(thisval&(mask<<19))
		putValue(A_ASG_69_0_0_27_Data_8_19, 1);
	else
		putValue(A_ASG_69_0_0_27_Data_8_19, 0);
	if(thisval&(mask<<20))
		putValue(A_ASG_69_0_0_27_Data_8_20, 1);
	else
		putValue(A_ASG_69_0_0_27_Data_8_20, 0);
	if(thisval&(mask<<21))
		putValue(A_ASG_69_0_0_27_Data_8_21, 1);
	else
		putValue(A_ASG_69_0_0_27_Data_8_21, 0);
	if(thisval&(mask<<22))
		putValue(A_ASG_69_0_0_27_Data_8_22, 1);
	else
		putValue(A_ASG_69_0_0_27_Data_8_22, 0);
	if(thisval&(mask<<23))
		putValue(A_ASG_69_0_0_27_Data_8_23, 1);
	else
		putValue(A_ASG_69_0_0_27_Data_8_23, 0);
	if(thisval&(mask<<24))
		putValue(A_ASG_69_0_0_27_Data_8_24, 1);
	else
		putValue(A_ASG_69_0_0_27_Data_8_24, 0);
	if(thisval&(mask<<25))
		putValue(A_ASG_69_0_0_27_Data_8_25, 1);
	else
		putValue(A_ASG_69_0_0_27_Data_8_25, 0);
	if(thisval&(mask<<26))
		putValue(A_ASG_69_0_0_27_Data_8_26, 1);
	else
		putValue(A_ASG_69_0_0_27_Data_8_26, 0);
	if(thisval&(mask<<27))
		putValue(A_ASG_69_0_0_27_Data_8_27, 1);
	else
		putValue(A_ASG_69_0_0_27_Data_8_27, 0);
	if(thisval&(mask<<28))
		putValue(A_ASG_69_0_0_27_Data_8_28, 1);
	else
		putValue(A_ASG_69_0_0_27_Data_8_28, 0);
	if(thisval&(mask<<29))
		putValue(A_ASG_69_0_0_27_Data_8_29, 1);
	else
		putValue(A_ASG_69_0_0_27_Data_8_29, 0);
	if(thisval&(mask<<30))
		putValue(A_ASG_69_0_0_27_Data_8_30, 1);
	else
		putValue(A_ASG_69_0_0_27_Data_8_30, 0);
	if(thisval&(mask<<31))
		putValue(A_ASG_69_0_0_27_Data_8_31, 1);
	else
		putValue(A_ASG_69_0_0_27_Data_8_31, 0);
    A_ASG_69_0_0_27_ArrayDataList[getValue(A_ASG_69_0_0_27_DataIndex)].Param8 = thisval;
}
on envVar A_ASG_69_0_0_27_Data_9_0
{
	byte bitval;
	//thisval steht hier fuer den bitfield-wert, 
	//aus Generierungsgruenden hier keine einheitliche Bezeichnung moeglich.
	dword thisval; // Display1AdditionalInfo2_2
	bitval= getValue(this);
	thisval = getValue(A_ASG_69_0_0_27_Data_9);
	thisval = thisval&~(1<<0)|(bitval<<0);
	putValue(A_ASG_69_0_0_27_Data_9,thisval);
}

on envVar A_ASG_69_0_0_27_Data_9_1
{
	byte bitval;
	//thisval steht hier fuer den bitfield-wert, 
	//aus Generierungsgruenden hier keine einheitliche Bezeichnung moeglich.
	dword thisval; // Display1AdditionalInfo2_2
	bitval= getValue(this);
	thisval = getValue(A_ASG_69_0_0_27_Data_9);
	thisval = thisval&~(1<<1)|(bitval<<1);
	putValue(A_ASG_69_0_0_27_Data_9,thisval);
}

on envVar A_ASG_69_0_0_27_Data_9_2
{
	byte bitval;
	//thisval steht hier fuer den bitfield-wert, 
	//aus Generierungsgruenden hier keine einheitliche Bezeichnung moeglich.
	dword thisval; // Display1AdditionalInfo2_2
	bitval= getValue(this);
	thisval = getValue(A_ASG_69_0_0_27_Data_9);
	thisval = thisval&~(1<<2)|(bitval<<2);
	putValue(A_ASG_69_0_0_27_Data_9,thisval);
}

on envVar A_ASG_69_0_0_27_Data_9_3
{
	byte bitval;
	//thisval steht hier fuer den bitfield-wert, 
	//aus Generierungsgruenden hier keine einheitliche Bezeichnung moeglich.
	dword thisval; // Display1AdditionalInfo2_2
	bitval= getValue(this);
	thisval = getValue(A_ASG_69_0_0_27_Data_9);
	thisval = thisval&~(1<<3)|(bitval<<3);
	putValue(A_ASG_69_0_0_27_Data_9,thisval);
}

on envVar A_ASG_69_0_0_27_Data_9_4
{
	byte bitval;
	//thisval steht hier fuer den bitfield-wert, 
	//aus Generierungsgruenden hier keine einheitliche Bezeichnung moeglich.
	dword thisval; // Display1AdditionalInfo2_2
	bitval= getValue(this);
	thisval = getValue(A_ASG_69_0_0_27_Data_9);
	thisval = thisval&~(1<<4)|(bitval<<4);
	putValue(A_ASG_69_0_0_27_Data_9,thisval);
}

on envVar A_ASG_69_0_0_27_Data_9_5
{
	byte bitval;
	//thisval steht hier fuer den bitfield-wert, 
	//aus Generierungsgruenden hier keine einheitliche Bezeichnung moeglich.
	dword thisval; // Display1AdditionalInfo2_2
	bitval= getValue(this);
	thisval = getValue(A_ASG_69_0_0_27_Data_9);
	thisval = thisval&~(1<<5)|(bitval<<5);
	putValue(A_ASG_69_0_0_27_Data_9,thisval);
}

on envVar A_ASG_69_0_0_27_Data_9_6
{
	byte bitval;
	//thisval steht hier fuer den bitfield-wert, 
	//aus Generierungsgruenden hier keine einheitliche Bezeichnung moeglich.
	dword thisval; // Display1AdditionalInfo2_2
	bitval= getValue(this);
	thisval = getValue(A_ASG_69_0_0_27_Data_9);
	thisval = thisval&~(1<<6)|(bitval<<6);
	putValue(A_ASG_69_0_0_27_Data_9,thisval);
}

on envVar A_ASG_69_0_0_27_Data_9_7
{
	byte bitval;
	//thisval steht hier fuer den bitfield-wert, 
	//aus Generierungsgruenden hier keine einheitliche Bezeichnung moeglich.
	dword thisval; // Display1AdditionalInfo2_2
	bitval= getValue(this);
	thisval = getValue(A_ASG_69_0_0_27_Data_9);
	thisval = thisval&~(1<<7)|(bitval<<7);
	putValue(A_ASG_69_0_0_27_Data_9,thisval);
}

on envVar A_ASG_69_0_0_27_Data_9_8
{
	byte bitval;
	//thisval steht hier fuer den bitfield-wert, 
	//aus Generierungsgruenden hier keine einheitliche Bezeichnung moeglich.
	dword thisval; // Display1AdditionalInfo2_2
	bitval= getValue(this);
	thisval = getValue(A_ASG_69_0_0_27_Data_9);
	thisval = thisval&~(1<<8)|(bitval<<8);
	putValue(A_ASG_69_0_0_27_Data_9,thisval);
}

on envVar A_ASG_69_0_0_27_Data_9_9
{
	byte bitval;
	//thisval steht hier fuer den bitfield-wert, 
	//aus Generierungsgruenden hier keine einheitliche Bezeichnung moeglich.
	dword thisval; // Display1AdditionalInfo2_2
	bitval= getValue(this);
	thisval = getValue(A_ASG_69_0_0_27_Data_9);
	thisval = thisval&~(1<<9)|(bitval<<9);
	putValue(A_ASG_69_0_0_27_Data_9,thisval);
}

on envVar A_ASG_69_0_0_27_Data_9_10
{
	byte bitval;
	//thisval steht hier fuer den bitfield-wert, 
	//aus Generierungsgruenden hier keine einheitliche Bezeichnung moeglich.
	dword thisval; // Display1AdditionalInfo2_2
	bitval= getValue(this);
	thisval = getValue(A_ASG_69_0_0_27_Data_9);
	thisval = thisval&~(1<<10)|(bitval<<10);
	putValue(A_ASG_69_0_0_27_Data_9,thisval);
}

on envVar A_ASG_69_0_0_27_Data_9_11
{
	byte bitval;
	//thisval steht hier fuer den bitfield-wert, 
	//aus Generierungsgruenden hier keine einheitliche Bezeichnung moeglich.
	dword thisval; // Display1AdditionalInfo2_2
	bitval= getValue(this);
	thisval = getValue(A_ASG_69_0_0_27_Data_9);
	thisval = thisval&~(1<<11)|(bitval<<11);
	putValue(A_ASG_69_0_0_27_Data_9,thisval);
}

on envVar A_ASG_69_0_0_27_Data_9_12
{
	byte bitval;
	//thisval steht hier fuer den bitfield-wert, 
	//aus Generierungsgruenden hier keine einheitliche Bezeichnung moeglich.
	dword thisval; // Display1AdditionalInfo2_2
	bitval= getValue(this);
	thisval = getValue(A_ASG_69_0_0_27_Data_9);
	thisval = thisval&~(1<<12)|(bitval<<12);
	putValue(A_ASG_69_0_0_27_Data_9,thisval);
}

on envVar A_ASG_69_0_0_27_Data_9_13
{
	byte bitval;
	//thisval steht hier fuer den bitfield-wert, 
	//aus Generierungsgruenden hier keine einheitliche Bezeichnung moeglich.
	dword thisval; // Display1AdditionalInfo2_2
	bitval= getValue(this);
	thisval = getValue(A_ASG_69_0_0_27_Data_9);
	thisval = thisval&~(1<<13)|(bitval<<13);
	putValue(A_ASG_69_0_0_27_Data_9,thisval);
}

on envVar A_ASG_69_0_0_27_Data_9_14
{
	byte bitval;
	//thisval steht hier fuer den bitfield-wert, 
	//aus Generierungsgruenden hier keine einheitliche Bezeichnung moeglich.
	dword thisval; // Display1AdditionalInfo2_2
	bitval= getValue(this);
	thisval = getValue(A_ASG_69_0_0_27_Data_9);
	thisval = thisval&~(1<<14)|(bitval<<14);
	putValue(A_ASG_69_0_0_27_Data_9,thisval);
}

on envVar A_ASG_69_0_0_27_Data_9_15
{
	byte bitval;
	//thisval steht hier fuer den bitfield-wert, 
	//aus Generierungsgruenden hier keine einheitliche Bezeichnung moeglich.
	dword thisval; // Display1AdditionalInfo2_2
	bitval= getValue(this);
	thisval = getValue(A_ASG_69_0_0_27_Data_9);
	thisval = thisval&~(1<<15)|(bitval<<15);
	putValue(A_ASG_69_0_0_27_Data_9,thisval);
}

on envVar A_ASG_69_0_0_27_Data_9_16
{
	byte bitval;
	//thisval steht hier fuer den bitfield-wert, 
	//aus Generierungsgruenden hier keine einheitliche Bezeichnung moeglich.
	dword thisval; // Display1AdditionalInfo2_2
	bitval= getValue(this);
	thisval = getValue(A_ASG_69_0_0_27_Data_9);
	thisval = thisval&~(1<<16)|(bitval<<16);
	putValue(A_ASG_69_0_0_27_Data_9,thisval);
}

on envVar A_ASG_69_0_0_27_Data_9_17
{
	byte bitval;
	//thisval steht hier fuer den bitfield-wert, 
	//aus Generierungsgruenden hier keine einheitliche Bezeichnung moeglich.
	dword thisval; // Display1AdditionalInfo2_2
	bitval= getValue(this);
	thisval = getValue(A_ASG_69_0_0_27_Data_9);
	thisval = thisval&~(1<<17)|(bitval<<17);
	putValue(A_ASG_69_0_0_27_Data_9,thisval);
}

on envVar A_ASG_69_0_0_27_Data_9_18
{
	byte bitval;
	//thisval steht hier fuer den bitfield-wert, 
	//aus Generierungsgruenden hier keine einheitliche Bezeichnung moeglich.
	dword thisval; // Display1AdditionalInfo2_2
	bitval= getValue(this);
	thisval = getValue(A_ASG_69_0_0_27_Data_9);
	thisval = thisval&~(1<<18)|(bitval<<18);
	putValue(A_ASG_69_0_0_27_Data_9,thisval);
}

on envVar A_ASG_69_0_0_27_Data_9_19
{
	byte bitval;
	//thisval steht hier fuer den bitfield-wert, 
	//aus Generierungsgruenden hier keine einheitliche Bezeichnung moeglich.
	dword thisval; // Display1AdditionalInfo2_2
	bitval= getValue(this);
	thisval = getValue(A_ASG_69_0_0_27_Data_9);
	thisval = thisval&~(1<<19)|(bitval<<19);
	putValue(A_ASG_69_0_0_27_Data_9,thisval);
}

on envVar A_ASG_69_0_0_27_Data_9_20
{
	byte bitval;
	//thisval steht hier fuer den bitfield-wert, 
	//aus Generierungsgruenden hier keine einheitliche Bezeichnung moeglich.
	dword thisval; // Display1AdditionalInfo2_2
	bitval= getValue(this);
	thisval = getValue(A_ASG_69_0_0_27_Data_9);
	thisval = thisval&~(1<<20)|(bitval<<20);
	putValue(A_ASG_69_0_0_27_Data_9,thisval);
}

on envVar A_ASG_69_0_0_27_Data_9_21
{
	byte bitval;
	//thisval steht hier fuer den bitfield-wert, 
	//aus Generierungsgruenden hier keine einheitliche Bezeichnung moeglich.
	dword thisval; // Display1AdditionalInfo2_2
	bitval= getValue(this);
	thisval = getValue(A_ASG_69_0_0_27_Data_9);
	thisval = thisval&~(1<<21)|(bitval<<21);
	putValue(A_ASG_69_0_0_27_Data_9,thisval);
}

on envVar A_ASG_69_0_0_27_Data_9_22
{
	byte bitval;
	//thisval steht hier fuer den bitfield-wert, 
	//aus Generierungsgruenden hier keine einheitliche Bezeichnung moeglich.
	dword thisval; // Display1AdditionalInfo2_2
	bitval= getValue(this);
	thisval = getValue(A_ASG_69_0_0_27_Data_9);
	thisval = thisval&~(1<<22)|(bitval<<22);
	putValue(A_ASG_69_0_0_27_Data_9,thisval);
}

on envVar A_ASG_69_0_0_27_Data_9_23
{
	byte bitval;
	//thisval steht hier fuer den bitfield-wert, 
	//aus Generierungsgruenden hier keine einheitliche Bezeichnung moeglich.
	dword thisval; // Display1AdditionalInfo2_2
	bitval= getValue(this);
	thisval = getValue(A_ASG_69_0_0_27_Data_9);
	thisval = thisval&~(1<<23)|(bitval<<23);
	putValue(A_ASG_69_0_0_27_Data_9,thisval);
}

on envVar A_ASG_69_0_0_27_Data_9_24
{
	byte bitval;
	//thisval steht hier fuer den bitfield-wert, 
	//aus Generierungsgruenden hier keine einheitliche Bezeichnung moeglich.
	dword thisval; // Display1AdditionalInfo2_2
	bitval= getValue(this);
	thisval = getValue(A_ASG_69_0_0_27_Data_9);
	thisval = thisval&~(1<<24)|(bitval<<24);
	putValue(A_ASG_69_0_0_27_Data_9,thisval);
}

on envVar A_ASG_69_0_0_27_Data_9_25
{
	byte bitval;
	//thisval steht hier fuer den bitfield-wert, 
	//aus Generierungsgruenden hier keine einheitliche Bezeichnung moeglich.
	dword thisval; // Display1AdditionalInfo2_2
	bitval= getValue(this);
	thisval = getValue(A_ASG_69_0_0_27_Data_9);
	thisval = thisval&~(1<<25)|(bitval<<25);
	putValue(A_ASG_69_0_0_27_Data_9,thisval);
}

on envVar A_ASG_69_0_0_27_Data_9_26
{
	byte bitval;
	//thisval steht hier fuer den bitfield-wert, 
	//aus Generierungsgruenden hier keine einheitliche Bezeichnung moeglich.
	dword thisval; // Display1AdditionalInfo2_2
	bitval= getValue(this);
	thisval = getValue(A_ASG_69_0_0_27_Data_9);
	thisval = thisval&~(1<<26)|(bitval<<26);
	putValue(A_ASG_69_0_0_27_Data_9,thisval);
}

on envVar A_ASG_69_0_0_27_Data_9_27
{
	byte bitval;
	//thisval steht hier fuer den bitfield-wert, 
	//aus Generierungsgruenden hier keine einheitliche Bezeichnung moeglich.
	dword thisval; // Display1AdditionalInfo2_2
	bitval= getValue(this);
	thisval = getValue(A_ASG_69_0_0_27_Data_9);
	thisval = thisval&~(1<<27)|(bitval<<27);
	putValue(A_ASG_69_0_0_27_Data_9,thisval);
}

on envVar A_ASG_69_0_0_27_Data_9_28
{
	byte bitval;
	//thisval steht hier fuer den bitfield-wert, 
	//aus Generierungsgruenden hier keine einheitliche Bezeichnung moeglich.
	dword thisval; // Display1AdditionalInfo2_2
	bitval= getValue(this);
	thisval = getValue(A_ASG_69_0_0_27_Data_9);
	thisval = thisval&~(1<<28)|(bitval<<28);
	putValue(A_ASG_69_0_0_27_Data_9,thisval);
}

on envVar A_ASG_69_0_0_27_Data_9_29
{
	byte bitval;
	//thisval steht hier fuer den bitfield-wert, 
	//aus Generierungsgruenden hier keine einheitliche Bezeichnung moeglich.
	dword thisval; // Display1AdditionalInfo2_2
	bitval= getValue(this);
	thisval = getValue(A_ASG_69_0_0_27_Data_9);
	thisval = thisval&~(1<<29)|(bitval<<29);
	putValue(A_ASG_69_0_0_27_Data_9,thisval);
}

on envVar A_ASG_69_0_0_27_Data_9
{
	byte superval[665];

	//Update Childvalue (BitField)
	byte mask=0x01;
	int i = 0;
	dword thisval; // Display1AdditionalInfo2_2
	thisval = getValue(this);
	if(thisval&(mask<<0))
		putValue(A_ASG_69_0_0_27_Data_9_0, 1);
	else
		putValue(A_ASG_69_0_0_27_Data_9_0, 0);
	if(thisval&(mask<<1))
		putValue(A_ASG_69_0_0_27_Data_9_1, 1);
	else
		putValue(A_ASG_69_0_0_27_Data_9_1, 0);
	if(thisval&(mask<<2))
		putValue(A_ASG_69_0_0_27_Data_9_2, 1);
	else
		putValue(A_ASG_69_0_0_27_Data_9_2, 0);
	if(thisval&(mask<<3))
		putValue(A_ASG_69_0_0_27_Data_9_3, 1);
	else
		putValue(A_ASG_69_0_0_27_Data_9_3, 0);
	if(thisval&(mask<<4))
		putValue(A_ASG_69_0_0_27_Data_9_4, 1);
	else
		putValue(A_ASG_69_0_0_27_Data_9_4, 0);
	if(thisval&(mask<<5))
		putValue(A_ASG_69_0_0_27_Data_9_5, 1);
	else
		putValue(A_ASG_69_0_0_27_Data_9_5, 0);
	if(thisval&(mask<<6))
		putValue(A_ASG_69_0_0_27_Data_9_6, 1);
	else
		putValue(A_ASG_69_0_0_27_Data_9_6, 0);
	if(thisval&(mask<<7))
		putValue(A_ASG_69_0_0_27_Data_9_7, 1);
	else
		putValue(A_ASG_69_0_0_27_Data_9_7, 0);
	if(thisval&(mask<<8))
		putValue(A_ASG_69_0_0_27_Data_9_8, 1);
	else
		putValue(A_ASG_69_0_0_27_Data_9_8, 0);
	if(thisval&(mask<<9))
		putValue(A_ASG_69_0_0_27_Data_9_9, 1);
	else
		putValue(A_ASG_69_0_0_27_Data_9_9, 0);
	if(thisval&(mask<<10))
		putValue(A_ASG_69_0_0_27_Data_9_10, 1);
	else
		putValue(A_ASG_69_0_0_27_Data_9_10, 0);
	if(thisval&(mask<<11))
		putValue(A_ASG_69_0_0_27_Data_9_11, 1);
	else
		putValue(A_ASG_69_0_0_27_Data_9_11, 0);
	if(thisval&(mask<<12))
		putValue(A_ASG_69_0_0_27_Data_9_12, 1);
	else
		putValue(A_ASG_69_0_0_27_Data_9_12, 0);
	if(thisval&(mask<<13))
		putValue(A_ASG_69_0_0_27_Data_9_13, 1);
	else
		putValue(A_ASG_69_0_0_27_Data_9_13, 0);
	if(thisval&(mask<<14))
		putValue(A_ASG_69_0_0_27_Data_9_14, 1);
	else
		putValue(A_ASG_69_0_0_27_Data_9_14, 0);
	if(thisval&(mask<<15))
		putValue(A_ASG_69_0_0_27_Data_9_15, 1);
	else
		putValue(A_ASG_69_0_0_27_Data_9_15, 0);
	if(thisval&(mask<<16))
		putValue(A_ASG_69_0_0_27_Data_9_16, 1);
	else
		putValue(A_ASG_69_0_0_27_Data_9_16, 0);
	if(thisval&(mask<<17))
		putValue(A_ASG_69_0_0_27_Data_9_17, 1);
	else
		putValue(A_ASG_69_0_0_27_Data_9_17, 0);
	if(thisval&(mask<<18))
		putValue(A_ASG_69_0_0_27_Data_9_18, 1);
	else
		putValue(A_ASG_69_0_0_27_Data_9_18, 0);
	if(thisval&(mask<<19))
		putValue(A_ASG_69_0_0_27_Data_9_19, 1);
	else
		putValue(A_ASG_69_0_0_27_Data_9_19, 0);
	if(thisval&(mask<<20))
		putValue(A_ASG_69_0_0_27_Data_9_20, 1);
	else
		putValue(A_ASG_69_0_0_27_Data_9_20, 0);
	if(thisval&(mask<<21))
		putValue(A_ASG_69_0_0_27_Data_9_21, 1);
	else
		putValue(A_ASG_69_0_0_27_Data_9_21, 0);
	if(thisval&(mask<<22))
		putValue(A_ASG_69_0_0_27_Data_9_22, 1);
	else
		putValue(A_ASG_69_0_0_27_Data_9_22, 0);
	if(thisval&(mask<<23))
		putValue(A_ASG_69_0_0_27_Data_9_23, 1);
	else
		putValue(A_ASG_69_0_0_27_Data_9_23, 0);
	if(thisval&(mask<<24))
		putValue(A_ASG_69_0_0_27_Data_9_24, 1);
	else
		putValue(A_ASG_69_0_0_27_Data_9_24, 0);
	if(thisval&(mask<<25))
		putValue(A_ASG_69_0_0_27_Data_9_25, 1);
	else
		putValue(A_ASG_69_0_0_27_Data_9_25, 0);
	if(thisval&(mask<<26))
		putValue(A_ASG_69_0_0_27_Data_9_26, 1);
	else
		putValue(A_ASG_69_0_0_27_Data_9_26, 0);
	if(thisval&(mask<<27))
		putValue(A_ASG_69_0_0_27_Data_9_27, 1);
	else
		putValue(A_ASG_69_0_0_27_Data_9_27, 0);
	if(thisval&(mask<<28))
		putValue(A_ASG_69_0_0_27_Data_9_28, 1);
	else
		putValue(A_ASG_69_0_0_27_Data_9_28, 0);
	if(thisval&(mask<<29))
		putValue(A_ASG_69_0_0_27_Data_9_29, 1);
	else
		putValue(A_ASG_69_0_0_27_Data_9_29, 0);
    A_ASG_69_0_0_27_ArrayDataList[getValue(A_ASG_69_0_0_27_DataIndex)].Param9 = thisval;
}
on envVar A_ASG_69_0_0_27_Data_10_0
{
	byte bitval;
	//thisval steht hier fuer den bitfield-wert, 
	//aus Generierungsgruenden hier keine einheitliche Bezeichnung moeglich.
	dword thisval; // Display2MainSelection
	bitval= getValue(this);
	thisval = getValue(A_ASG_69_0_0_27_Data_10);
	thisval = thisval&~(1<<0)|(bitval<<0);
	putValue(A_ASG_69_0_0_27_Data_10,thisval);
}

on envVar A_ASG_69_0_0_27_Data_10_1
{
	byte bitval;
	//thisval steht hier fuer den bitfield-wert, 
	//aus Generierungsgruenden hier keine einheitliche Bezeichnung moeglich.
	dword thisval; // Display2MainSelection
	bitval= getValue(this);
	thisval = getValue(A_ASG_69_0_0_27_Data_10);
	thisval = thisval&~(1<<1)|(bitval<<1);
	putValue(A_ASG_69_0_0_27_Data_10,thisval);
}

on envVar A_ASG_69_0_0_27_Data_10_2
{
	byte bitval;
	//thisval steht hier fuer den bitfield-wert, 
	//aus Generierungsgruenden hier keine einheitliche Bezeichnung moeglich.
	dword thisval; // Display2MainSelection
	bitval= getValue(this);
	thisval = getValue(A_ASG_69_0_0_27_Data_10);
	thisval = thisval&~(1<<2)|(bitval<<2);
	putValue(A_ASG_69_0_0_27_Data_10,thisval);
}

on envVar A_ASG_69_0_0_27_Data_10_3
{
	byte bitval;
	//thisval steht hier fuer den bitfield-wert, 
	//aus Generierungsgruenden hier keine einheitliche Bezeichnung moeglich.
	dword thisval; // Display2MainSelection
	bitval= getValue(this);
	thisval = getValue(A_ASG_69_0_0_27_Data_10);
	thisval = thisval&~(1<<3)|(bitval<<3);
	putValue(A_ASG_69_0_0_27_Data_10,thisval);
}

on envVar A_ASG_69_0_0_27_Data_10_4
{
	byte bitval;
	//thisval steht hier fuer den bitfield-wert, 
	//aus Generierungsgruenden hier keine einheitliche Bezeichnung moeglich.
	dword thisval; // Display2MainSelection
	bitval= getValue(this);
	thisval = getValue(A_ASG_69_0_0_27_Data_10);
	thisval = thisval&~(1<<4)|(bitval<<4);
	putValue(A_ASG_69_0_0_27_Data_10,thisval);
}

on envVar A_ASG_69_0_0_27_Data_10_5
{
	byte bitval;
	//thisval steht hier fuer den bitfield-wert, 
	//aus Generierungsgruenden hier keine einheitliche Bezeichnung moeglich.
	dword thisval; // Display2MainSelection
	bitval= getValue(this);
	thisval = getValue(A_ASG_69_0_0_27_Data_10);
	thisval = thisval&~(1<<5)|(bitval<<5);
	putValue(A_ASG_69_0_0_27_Data_10,thisval);
}

on envVar A_ASG_69_0_0_27_Data_10_6
{
	byte bitval;
	//thisval steht hier fuer den bitfield-wert, 
	//aus Generierungsgruenden hier keine einheitliche Bezeichnung moeglich.
	dword thisval; // Display2MainSelection
	bitval= getValue(this);
	thisval = getValue(A_ASG_69_0_0_27_Data_10);
	thisval = thisval&~(1<<6)|(bitval<<6);
	putValue(A_ASG_69_0_0_27_Data_10,thisval);
}

on envVar A_ASG_69_0_0_27_Data_10_7
{
	byte bitval;
	//thisval steht hier fuer den bitfield-wert, 
	//aus Generierungsgruenden hier keine einheitliche Bezeichnung moeglich.
	dword thisval; // Display2MainSelection
	bitval= getValue(this);
	thisval = getValue(A_ASG_69_0_0_27_Data_10);
	thisval = thisval&~(1<<7)|(bitval<<7);
	putValue(A_ASG_69_0_0_27_Data_10,thisval);
}

on envVar A_ASG_69_0_0_27_Data_10_8
{
	byte bitval;
	//thisval steht hier fuer den bitfield-wert, 
	//aus Generierungsgruenden hier keine einheitliche Bezeichnung moeglich.
	dword thisval; // Display2MainSelection
	bitval= getValue(this);
	thisval = getValue(A_ASG_69_0_0_27_Data_10);
	thisval = thisval&~(1<<8)|(bitval<<8);
	putValue(A_ASG_69_0_0_27_Data_10,thisval);
}

on envVar A_ASG_69_0_0_27_Data_10_9
{
	byte bitval;
	//thisval steht hier fuer den bitfield-wert, 
	//aus Generierungsgruenden hier keine einheitliche Bezeichnung moeglich.
	dword thisval; // Display2MainSelection
	bitval= getValue(this);
	thisval = getValue(A_ASG_69_0_0_27_Data_10);
	thisval = thisval&~(1<<9)|(bitval<<9);
	putValue(A_ASG_69_0_0_27_Data_10,thisval);
}

on envVar A_ASG_69_0_0_27_Data_10_10
{
	byte bitval;
	//thisval steht hier fuer den bitfield-wert, 
	//aus Generierungsgruenden hier keine einheitliche Bezeichnung moeglich.
	dword thisval; // Display2MainSelection
	bitval= getValue(this);
	thisval = getValue(A_ASG_69_0_0_27_Data_10);
	thisval = thisval&~(1<<10)|(bitval<<10);
	putValue(A_ASG_69_0_0_27_Data_10,thisval);
}

on envVar A_ASG_69_0_0_27_Data_10_11
{
	byte bitval;
	//thisval steht hier fuer den bitfield-wert, 
	//aus Generierungsgruenden hier keine einheitliche Bezeichnung moeglich.
	dword thisval; // Display2MainSelection
	bitval= getValue(this);
	thisval = getValue(A_ASG_69_0_0_27_Data_10);
	thisval = thisval&~(1<<11)|(bitval<<11);
	putValue(A_ASG_69_0_0_27_Data_10,thisval);
}

on envVar A_ASG_69_0_0_27_Data_10_12
{
	byte bitval;
	//thisval steht hier fuer den bitfield-wert, 
	//aus Generierungsgruenden hier keine einheitliche Bezeichnung moeglich.
	dword thisval; // Display2MainSelection
	bitval= getValue(this);
	thisval = getValue(A_ASG_69_0_0_27_Data_10);
	thisval = thisval&~(1<<12)|(bitval<<12);
	putValue(A_ASG_69_0_0_27_Data_10,thisval);
}

on envVar A_ASG_69_0_0_27_Data_10_13
{
	byte bitval;
	//thisval steht hier fuer den bitfield-wert, 
	//aus Generierungsgruenden hier keine einheitliche Bezeichnung moeglich.
	dword thisval; // Display2MainSelection
	bitval= getValue(this);
	thisval = getValue(A_ASG_69_0_0_27_Data_10);
	thisval = thisval&~(1<<13)|(bitval<<13);
	putValue(A_ASG_69_0_0_27_Data_10,thisval);
}

on envVar A_ASG_69_0_0_27_Data_10_14
{
	byte bitval;
	//thisval steht hier fuer den bitfield-wert, 
	//aus Generierungsgruenden hier keine einheitliche Bezeichnung moeglich.
	dword thisval; // Display2MainSelection
	bitval= getValue(this);
	thisval = getValue(A_ASG_69_0_0_27_Data_10);
	thisval = thisval&~(1<<14)|(bitval<<14);
	putValue(A_ASG_69_0_0_27_Data_10,thisval);
}

on envVar A_ASG_69_0_0_27_Data_10_15
{
	byte bitval;
	//thisval steht hier fuer den bitfield-wert, 
	//aus Generierungsgruenden hier keine einheitliche Bezeichnung moeglich.
	dword thisval; // Display2MainSelection
	bitval= getValue(this);
	thisval = getValue(A_ASG_69_0_0_27_Data_10);
	thisval = thisval&~(1<<15)|(bitval<<15);
	putValue(A_ASG_69_0_0_27_Data_10,thisval);
}

on envVar A_ASG_69_0_0_27_Data_10_16
{
	byte bitval;
	//thisval steht hier fuer den bitfield-wert, 
	//aus Generierungsgruenden hier keine einheitliche Bezeichnung moeglich.
	dword thisval; // Display2MainSelection
	bitval= getValue(this);
	thisval = getValue(A_ASG_69_0_0_27_Data_10);
	thisval = thisval&~(1<<16)|(bitval<<16);
	putValue(A_ASG_69_0_0_27_Data_10,thisval);
}

on envVar A_ASG_69_0_0_27_Data_10_17
{
	byte bitval;
	//thisval steht hier fuer den bitfield-wert, 
	//aus Generierungsgruenden hier keine einheitliche Bezeichnung moeglich.
	dword thisval; // Display2MainSelection
	bitval= getValue(this);
	thisval = getValue(A_ASG_69_0_0_27_Data_10);
	thisval = thisval&~(1<<17)|(bitval<<17);
	putValue(A_ASG_69_0_0_27_Data_10,thisval);
}

on envVar A_ASG_69_0_0_27_Data_10_18
{
	byte bitval;
	//thisval steht hier fuer den bitfield-wert, 
	//aus Generierungsgruenden hier keine einheitliche Bezeichnung moeglich.
	dword thisval; // Display2MainSelection
	bitval= getValue(this);
	thisval = getValue(A_ASG_69_0_0_27_Data_10);
	thisval = thisval&~(1<<18)|(bitval<<18);
	putValue(A_ASG_69_0_0_27_Data_10,thisval);
}

on envVar A_ASG_69_0_0_27_Data_10_19
{
	byte bitval;
	//thisval steht hier fuer den bitfield-wert, 
	//aus Generierungsgruenden hier keine einheitliche Bezeichnung moeglich.
	dword thisval; // Display2MainSelection
	bitval= getValue(this);
	thisval = getValue(A_ASG_69_0_0_27_Data_10);
	thisval = thisval&~(1<<19)|(bitval<<19);
	putValue(A_ASG_69_0_0_27_Data_10,thisval);
}

on envVar A_ASG_69_0_0_27_Data_10_20
{
	byte bitval;
	//thisval steht hier fuer den bitfield-wert, 
	//aus Generierungsgruenden hier keine einheitliche Bezeichnung moeglich.
	dword thisval; // Display2MainSelection
	bitval= getValue(this);
	thisval = getValue(A_ASG_69_0_0_27_Data_10);
	thisval = thisval&~(1<<20)|(bitval<<20);
	putValue(A_ASG_69_0_0_27_Data_10,thisval);
}

on envVar A_ASG_69_0_0_27_Data_10_21
{
	byte bitval;
	//thisval steht hier fuer den bitfield-wert, 
	//aus Generierungsgruenden hier keine einheitliche Bezeichnung moeglich.
	dword thisval; // Display2MainSelection
	bitval= getValue(this);
	thisval = getValue(A_ASG_69_0_0_27_Data_10);
	thisval = thisval&~(1<<21)|(bitval<<21);
	putValue(A_ASG_69_0_0_27_Data_10,thisval);
}

on envVar A_ASG_69_0_0_27_Data_10_22
{
	byte bitval;
	//thisval steht hier fuer den bitfield-wert, 
	//aus Generierungsgruenden hier keine einheitliche Bezeichnung moeglich.
	dword thisval; // Display2MainSelection
	bitval= getValue(this);
	thisval = getValue(A_ASG_69_0_0_27_Data_10);
	thisval = thisval&~(1<<22)|(bitval<<22);
	putValue(A_ASG_69_0_0_27_Data_10,thisval);
}

on envVar A_ASG_69_0_0_27_Data_10_23
{
	byte bitval;
	//thisval steht hier fuer den bitfield-wert, 
	//aus Generierungsgruenden hier keine einheitliche Bezeichnung moeglich.
	dword thisval; // Display2MainSelection
	bitval= getValue(this);
	thisval = getValue(A_ASG_69_0_0_27_Data_10);
	thisval = thisval&~(1<<23)|(bitval<<23);
	putValue(A_ASG_69_0_0_27_Data_10,thisval);
}

on envVar A_ASG_69_0_0_27_Data_10_24
{
	byte bitval;
	//thisval steht hier fuer den bitfield-wert, 
	//aus Generierungsgruenden hier keine einheitliche Bezeichnung moeglich.
	dword thisval; // Display2MainSelection
	bitval= getValue(this);
	thisval = getValue(A_ASG_69_0_0_27_Data_10);
	thisval = thisval&~(1<<24)|(bitval<<24);
	putValue(A_ASG_69_0_0_27_Data_10,thisval);
}

on envVar A_ASG_69_0_0_27_Data_10_25
{
	byte bitval;
	//thisval steht hier fuer den bitfield-wert, 
	//aus Generierungsgruenden hier keine einheitliche Bezeichnung moeglich.
	dword thisval; // Display2MainSelection
	bitval= getValue(this);
	thisval = getValue(A_ASG_69_0_0_27_Data_10);
	thisval = thisval&~(1<<25)|(bitval<<25);
	putValue(A_ASG_69_0_0_27_Data_10,thisval);
}

on envVar A_ASG_69_0_0_27_Data_10_26
{
	byte bitval;
	//thisval steht hier fuer den bitfield-wert, 
	//aus Generierungsgruenden hier keine einheitliche Bezeichnung moeglich.
	dword thisval; // Display2MainSelection
	bitval= getValue(this);
	thisval = getValue(A_ASG_69_0_0_27_Data_10);
	thisval = thisval&~(1<<26)|(bitval<<26);
	putValue(A_ASG_69_0_0_27_Data_10,thisval);
}

on envVar A_ASG_69_0_0_27_Data_10_27
{
	byte bitval;
	//thisval steht hier fuer den bitfield-wert, 
	//aus Generierungsgruenden hier keine einheitliche Bezeichnung moeglich.
	dword thisval; // Display2MainSelection
	bitval= getValue(this);
	thisval = getValue(A_ASG_69_0_0_27_Data_10);
	thisval = thisval&~(1<<27)|(bitval<<27);
	putValue(A_ASG_69_0_0_27_Data_10,thisval);
}

on envVar A_ASG_69_0_0_27_Data_10
{
	byte superval[665];

	//Update Childvalue (BitField)
	byte mask=0x01;
	int i = 0;
	dword thisval; // Display2MainSelection
	thisval = getValue(this);
	if(thisval&(mask<<0))
		putValue(A_ASG_69_0_0_27_Data_10_0, 1);
	else
		putValue(A_ASG_69_0_0_27_Data_10_0, 0);
	if(thisval&(mask<<1))
		putValue(A_ASG_69_0_0_27_Data_10_1, 1);
	else
		putValue(A_ASG_69_0_0_27_Data_10_1, 0);
	if(thisval&(mask<<2))
		putValue(A_ASG_69_0_0_27_Data_10_2, 1);
	else
		putValue(A_ASG_69_0_0_27_Data_10_2, 0);
	if(thisval&(mask<<3))
		putValue(A_ASG_69_0_0_27_Data_10_3, 1);
	else
		putValue(A_ASG_69_0_0_27_Data_10_3, 0);
	if(thisval&(mask<<4))
		putValue(A_ASG_69_0_0_27_Data_10_4, 1);
	else
		putValue(A_ASG_69_0_0_27_Data_10_4, 0);
	if(thisval&(mask<<5))
		putValue(A_ASG_69_0_0_27_Data_10_5, 1);
	else
		putValue(A_ASG_69_0_0_27_Data_10_5, 0);
	if(thisval&(mask<<6))
		putValue(A_ASG_69_0_0_27_Data_10_6, 1);
	else
		putValue(A_ASG_69_0_0_27_Data_10_6, 0);
	if(thisval&(mask<<7))
		putValue(A_ASG_69_0_0_27_Data_10_7, 1);
	else
		putValue(A_ASG_69_0_0_27_Data_10_7, 0);
	if(thisval&(mask<<8))
		putValue(A_ASG_69_0_0_27_Data_10_8, 1);
	else
		putValue(A_ASG_69_0_0_27_Data_10_8, 0);
	if(thisval&(mask<<9))
		putValue(A_ASG_69_0_0_27_Data_10_9, 1);
	else
		putValue(A_ASG_69_0_0_27_Data_10_9, 0);
	if(thisval&(mask<<10))
		putValue(A_ASG_69_0_0_27_Data_10_10, 1);
	else
		putValue(A_ASG_69_0_0_27_Data_10_10, 0);
	if(thisval&(mask<<11))
		putValue(A_ASG_69_0_0_27_Data_10_11, 1);
	else
		putValue(A_ASG_69_0_0_27_Data_10_11, 0);
	if(thisval&(mask<<12))
		putValue(A_ASG_69_0_0_27_Data_10_12, 1);
	else
		putValue(A_ASG_69_0_0_27_Data_10_12, 0);
	if(thisval&(mask<<13))
		putValue(A_ASG_69_0_0_27_Data_10_13, 1);
	else
		putValue(A_ASG_69_0_0_27_Data_10_13, 0);
	if(thisval&(mask<<14))
		putValue(A_ASG_69_0_0_27_Data_10_14, 1);
	else
		putValue(A_ASG_69_0_0_27_Data_10_14, 0);
	if(thisval&(mask<<15))
		putValue(A_ASG_69_0_0_27_Data_10_15, 1);
	else
		putValue(A_ASG_69_0_0_27_Data_10_15, 0);
	if(thisval&(mask<<16))
		putValue(A_ASG_69_0_0_27_Data_10_16, 1);
	else
		putValue(A_ASG_69_0_0_27_Data_10_16, 0);
	if(thisval&(mask<<17))
		putValue(A_ASG_69_0_0_27_Data_10_17, 1);
	else
		putValue(A_ASG_69_0_0_27_Data_10_17, 0);
	if(thisval&(mask<<18))
		putValue(A_ASG_69_0_0_27_Data_10_18, 1);
	else
		putValue(A_ASG_69_0_0_27_Data_10_18, 0);
	if(thisval&(mask<<19))
		putValue(A_ASG_69_0_0_27_Data_10_19, 1);
	else
		putValue(A_ASG_69_0_0_27_Data_10_19, 0);
	if(thisval&(mask<<20))
		putValue(A_ASG_69_0_0_27_Data_10_20, 1);
	else
		putValue(A_ASG_69_0_0_27_Data_10_20, 0);
	if(thisval&(mask<<21))
		putValue(A_ASG_69_0_0_27_Data_10_21, 1);
	else
		putValue(A_ASG_69_0_0_27_Data_10_21, 0);
	if(thisval&(mask<<22))
		putValue(A_ASG_69_0_0_27_Data_10_22, 1);
	else
		putValue(A_ASG_69_0_0_27_Data_10_22, 0);
	if(thisval&(mask<<23))
		putValue(A_ASG_69_0_0_27_Data_10_23, 1);
	else
		putValue(A_ASG_69_0_0_27_Data_10_23, 0);
	if(thisval&(mask<<24))
		putValue(A_ASG_69_0_0_27_Data_10_24, 1);
	else
		putValue(A_ASG_69_0_0_27_Data_10_24, 0);
	if(thisval&(mask<<25))
		putValue(A_ASG_69_0_0_27_Data_10_25, 1);
	else
		putValue(A_ASG_69_0_0_27_Data_10_25, 0);
	if(thisval&(mask<<26))
		putValue(A_ASG_69_0_0_27_Data_10_26, 1);
	else
		putValue(A_ASG_69_0_0_27_Data_10_26, 0);
	if(thisval&(mask<<27))
		putValue(A_ASG_69_0_0_27_Data_10_27, 1);
	else
		putValue(A_ASG_69_0_0_27_Data_10_27, 0);
    A_ASG_69_0_0_27_ArrayDataList[getValue(A_ASG_69_0_0_27_DataIndex)].Param10 = thisval;
}
on envVar A_ASG_69_0_0_27_Data_11_0
{
	byte bitval;
	//thisval steht hier fuer den bitfield-wert, 
	//aus Generierungsgruenden hier keine einheitliche Bezeichnung moeglich.
	dword thisval; // Display2AdditionalInfo1_1
	bitval= getValue(this);
	thisval = getValue(A_ASG_69_0_0_27_Data_11);
	thisval = thisval&~(1<<0)|(bitval<<0);
	putValue(A_ASG_69_0_0_27_Data_11,thisval);
}

on envVar A_ASG_69_0_0_27_Data_11_1
{
	byte bitval;
	//thisval steht hier fuer den bitfield-wert, 
	//aus Generierungsgruenden hier keine einheitliche Bezeichnung moeglich.
	dword thisval; // Display2AdditionalInfo1_1
	bitval= getValue(this);
	thisval = getValue(A_ASG_69_0_0_27_Data_11);
	thisval = thisval&~(1<<1)|(bitval<<1);
	putValue(A_ASG_69_0_0_27_Data_11,thisval);
}

on envVar A_ASG_69_0_0_27_Data_11_2
{
	byte bitval;
	//thisval steht hier fuer den bitfield-wert, 
	//aus Generierungsgruenden hier keine einheitliche Bezeichnung moeglich.
	dword thisval; // Display2AdditionalInfo1_1
	bitval= getValue(this);
	thisval = getValue(A_ASG_69_0_0_27_Data_11);
	thisval = thisval&~(1<<2)|(bitval<<2);
	putValue(A_ASG_69_0_0_27_Data_11,thisval);
}

on envVar A_ASG_69_0_0_27_Data_11_3
{
	byte bitval;
	//thisval steht hier fuer den bitfield-wert, 
	//aus Generierungsgruenden hier keine einheitliche Bezeichnung moeglich.
	dword thisval; // Display2AdditionalInfo1_1
	bitval= getValue(this);
	thisval = getValue(A_ASG_69_0_0_27_Data_11);
	thisval = thisval&~(1<<3)|(bitval<<3);
	putValue(A_ASG_69_0_0_27_Data_11,thisval);
}

on envVar A_ASG_69_0_0_27_Data_11_4
{
	byte bitval;
	//thisval steht hier fuer den bitfield-wert, 
	//aus Generierungsgruenden hier keine einheitliche Bezeichnung moeglich.
	dword thisval; // Display2AdditionalInfo1_1
	bitval= getValue(this);
	thisval = getValue(A_ASG_69_0_0_27_Data_11);
	thisval = thisval&~(1<<4)|(bitval<<4);
	putValue(A_ASG_69_0_0_27_Data_11,thisval);
}

on envVar A_ASG_69_0_0_27_Data_11_5
{
	byte bitval;
	//thisval steht hier fuer den bitfield-wert, 
	//aus Generierungsgruenden hier keine einheitliche Bezeichnung moeglich.
	dword thisval; // Display2AdditionalInfo1_1
	bitval= getValue(this);
	thisval = getValue(A_ASG_69_0_0_27_Data_11);
	thisval = thisval&~(1<<5)|(bitval<<5);
	putValue(A_ASG_69_0_0_27_Data_11,thisval);
}

on envVar A_ASG_69_0_0_27_Data_11_6
{
	byte bitval;
	//thisval steht hier fuer den bitfield-wert, 
	//aus Generierungsgruenden hier keine einheitliche Bezeichnung moeglich.
	dword thisval; // Display2AdditionalInfo1_1
	bitval= getValue(this);
	thisval = getValue(A_ASG_69_0_0_27_Data_11);
	thisval = thisval&~(1<<6)|(bitval<<6);
	putValue(A_ASG_69_0_0_27_Data_11,thisval);
}

on envVar A_ASG_69_0_0_27_Data_11_7
{
	byte bitval;
	//thisval steht hier fuer den bitfield-wert, 
	//aus Generierungsgruenden hier keine einheitliche Bezeichnung moeglich.
	dword thisval; // Display2AdditionalInfo1_1
	bitval= getValue(this);
	thisval = getValue(A_ASG_69_0_0_27_Data_11);
	thisval = thisval&~(1<<7)|(bitval<<7);
	putValue(A_ASG_69_0_0_27_Data_11,thisval);
}

on envVar A_ASG_69_0_0_27_Data_11_8
{
	byte bitval;
	//thisval steht hier fuer den bitfield-wert, 
	//aus Generierungsgruenden hier keine einheitliche Bezeichnung moeglich.
	dword thisval; // Display2AdditionalInfo1_1
	bitval= getValue(this);
	thisval = getValue(A_ASG_69_0_0_27_Data_11);
	thisval = thisval&~(1<<8)|(bitval<<8);
	putValue(A_ASG_69_0_0_27_Data_11,thisval);
}

on envVar A_ASG_69_0_0_27_Data_11_9
{
	byte bitval;
	//thisval steht hier fuer den bitfield-wert, 
	//aus Generierungsgruenden hier keine einheitliche Bezeichnung moeglich.
	dword thisval; // Display2AdditionalInfo1_1
	bitval= getValue(this);
	thisval = getValue(A_ASG_69_0_0_27_Data_11);
	thisval = thisval&~(1<<9)|(bitval<<9);
	putValue(A_ASG_69_0_0_27_Data_11,thisval);
}

on envVar A_ASG_69_0_0_27_Data_11_10
{
	byte bitval;
	//thisval steht hier fuer den bitfield-wert, 
	//aus Generierungsgruenden hier keine einheitliche Bezeichnung moeglich.
	dword thisval; // Display2AdditionalInfo1_1
	bitval= getValue(this);
	thisval = getValue(A_ASG_69_0_0_27_Data_11);
	thisval = thisval&~(1<<10)|(bitval<<10);
	putValue(A_ASG_69_0_0_27_Data_11,thisval);
}

on envVar A_ASG_69_0_0_27_Data_11_11
{
	byte bitval;
	//thisval steht hier fuer den bitfield-wert, 
	//aus Generierungsgruenden hier keine einheitliche Bezeichnung moeglich.
	dword thisval; // Display2AdditionalInfo1_1
	bitval= getValue(this);
	thisval = getValue(A_ASG_69_0_0_27_Data_11);
	thisval = thisval&~(1<<11)|(bitval<<11);
	putValue(A_ASG_69_0_0_27_Data_11,thisval);
}

on envVar A_ASG_69_0_0_27_Data_11_12
{
	byte bitval;
	//thisval steht hier fuer den bitfield-wert, 
	//aus Generierungsgruenden hier keine einheitliche Bezeichnung moeglich.
	dword thisval; // Display2AdditionalInfo1_1
	bitval= getValue(this);
	thisval = getValue(A_ASG_69_0_0_27_Data_11);
	thisval = thisval&~(1<<12)|(bitval<<12);
	putValue(A_ASG_69_0_0_27_Data_11,thisval);
}

on envVar A_ASG_69_0_0_27_Data_11_13
{
	byte bitval;
	//thisval steht hier fuer den bitfield-wert, 
	//aus Generierungsgruenden hier keine einheitliche Bezeichnung moeglich.
	dword thisval; // Display2AdditionalInfo1_1
	bitval= getValue(this);
	thisval = getValue(A_ASG_69_0_0_27_Data_11);
	thisval = thisval&~(1<<13)|(bitval<<13);
	putValue(A_ASG_69_0_0_27_Data_11,thisval);
}

on envVar A_ASG_69_0_0_27_Data_11_14
{
	byte bitval;
	//thisval steht hier fuer den bitfield-wert, 
	//aus Generierungsgruenden hier keine einheitliche Bezeichnung moeglich.
	dword thisval; // Display2AdditionalInfo1_1
	bitval= getValue(this);
	thisval = getValue(A_ASG_69_0_0_27_Data_11);
	thisval = thisval&~(1<<14)|(bitval<<14);
	putValue(A_ASG_69_0_0_27_Data_11,thisval);
}

on envVar A_ASG_69_0_0_27_Data_11_15
{
	byte bitval;
	//thisval steht hier fuer den bitfield-wert, 
	//aus Generierungsgruenden hier keine einheitliche Bezeichnung moeglich.
	dword thisval; // Display2AdditionalInfo1_1
	bitval= getValue(this);
	thisval = getValue(A_ASG_69_0_0_27_Data_11);
	thisval = thisval&~(1<<15)|(bitval<<15);
	putValue(A_ASG_69_0_0_27_Data_11,thisval);
}

on envVar A_ASG_69_0_0_27_Data_11_16
{
	byte bitval;
	//thisval steht hier fuer den bitfield-wert, 
	//aus Generierungsgruenden hier keine einheitliche Bezeichnung moeglich.
	dword thisval; // Display2AdditionalInfo1_1
	bitval= getValue(this);
	thisval = getValue(A_ASG_69_0_0_27_Data_11);
	thisval = thisval&~(1<<16)|(bitval<<16);
	putValue(A_ASG_69_0_0_27_Data_11,thisval);
}

on envVar A_ASG_69_0_0_27_Data_11_17
{
	byte bitval;
	//thisval steht hier fuer den bitfield-wert, 
	//aus Generierungsgruenden hier keine einheitliche Bezeichnung moeglich.
	dword thisval; // Display2AdditionalInfo1_1
	bitval= getValue(this);
	thisval = getValue(A_ASG_69_0_0_27_Data_11);
	thisval = thisval&~(1<<17)|(bitval<<17);
	putValue(A_ASG_69_0_0_27_Data_11,thisval);
}

on envVar A_ASG_69_0_0_27_Data_11_18
{
	byte bitval;
	//thisval steht hier fuer den bitfield-wert, 
	//aus Generierungsgruenden hier keine einheitliche Bezeichnung moeglich.
	dword thisval; // Display2AdditionalInfo1_1
	bitval= getValue(this);
	thisval = getValue(A_ASG_69_0_0_27_Data_11);
	thisval = thisval&~(1<<18)|(bitval<<18);
	putValue(A_ASG_69_0_0_27_Data_11,thisval);
}

on envVar A_ASG_69_0_0_27_Data_11_19
{
	byte bitval;
	//thisval steht hier fuer den bitfield-wert, 
	//aus Generierungsgruenden hier keine einheitliche Bezeichnung moeglich.
	dword thisval; // Display2AdditionalInfo1_1
	bitval= getValue(this);
	thisval = getValue(A_ASG_69_0_0_27_Data_11);
	thisval = thisval&~(1<<19)|(bitval<<19);
	putValue(A_ASG_69_0_0_27_Data_11,thisval);
}

on envVar A_ASG_69_0_0_27_Data_11_20
{
	byte bitval;
	//thisval steht hier fuer den bitfield-wert, 
	//aus Generierungsgruenden hier keine einheitliche Bezeichnung moeglich.
	dword thisval; // Display2AdditionalInfo1_1
	bitval= getValue(this);
	thisval = getValue(A_ASG_69_0_0_27_Data_11);
	thisval = thisval&~(1<<20)|(bitval<<20);
	putValue(A_ASG_69_0_0_27_Data_11,thisval);
}

on envVar A_ASG_69_0_0_27_Data_11_21
{
	byte bitval;
	//thisval steht hier fuer den bitfield-wert, 
	//aus Generierungsgruenden hier keine einheitliche Bezeichnung moeglich.
	dword thisval; // Display2AdditionalInfo1_1
	bitval= getValue(this);
	thisval = getValue(A_ASG_69_0_0_27_Data_11);
	thisval = thisval&~(1<<21)|(bitval<<21);
	putValue(A_ASG_69_0_0_27_Data_11,thisval);
}

on envVar A_ASG_69_0_0_27_Data_11_22
{
	byte bitval;
	//thisval steht hier fuer den bitfield-wert, 
	//aus Generierungsgruenden hier keine einheitliche Bezeichnung moeglich.
	dword thisval; // Display2AdditionalInfo1_1
	bitval= getValue(this);
	thisval = getValue(A_ASG_69_0_0_27_Data_11);
	thisval = thisval&~(1<<22)|(bitval<<22);
	putValue(A_ASG_69_0_0_27_Data_11,thisval);
}

on envVar A_ASG_69_0_0_27_Data_11_23
{
	byte bitval;
	//thisval steht hier fuer den bitfield-wert, 
	//aus Generierungsgruenden hier keine einheitliche Bezeichnung moeglich.
	dword thisval; // Display2AdditionalInfo1_1
	bitval= getValue(this);
	thisval = getValue(A_ASG_69_0_0_27_Data_11);
	thisval = thisval&~(1<<23)|(bitval<<23);
	putValue(A_ASG_69_0_0_27_Data_11,thisval);
}

on envVar A_ASG_69_0_0_27_Data_11_24
{
	byte bitval;
	//thisval steht hier fuer den bitfield-wert, 
	//aus Generierungsgruenden hier keine einheitliche Bezeichnung moeglich.
	dword thisval; // Display2AdditionalInfo1_1
	bitval= getValue(this);
	thisval = getValue(A_ASG_69_0_0_27_Data_11);
	thisval = thisval&~(1<<24)|(bitval<<24);
	putValue(A_ASG_69_0_0_27_Data_11,thisval);
}

on envVar A_ASG_69_0_0_27_Data_11_25
{
	byte bitval;
	//thisval steht hier fuer den bitfield-wert, 
	//aus Generierungsgruenden hier keine einheitliche Bezeichnung moeglich.
	dword thisval; // Display2AdditionalInfo1_1
	bitval= getValue(this);
	thisval = getValue(A_ASG_69_0_0_27_Data_11);
	thisval = thisval&~(1<<25)|(bitval<<25);
	putValue(A_ASG_69_0_0_27_Data_11,thisval);
}

on envVar A_ASG_69_0_0_27_Data_11_26
{
	byte bitval;
	//thisval steht hier fuer den bitfield-wert, 
	//aus Generierungsgruenden hier keine einheitliche Bezeichnung moeglich.
	dword thisval; // Display2AdditionalInfo1_1
	bitval= getValue(this);
	thisval = getValue(A_ASG_69_0_0_27_Data_11);
	thisval = thisval&~(1<<26)|(bitval<<26);
	putValue(A_ASG_69_0_0_27_Data_11,thisval);
}

on envVar A_ASG_69_0_0_27_Data_11_27
{
	byte bitval;
	//thisval steht hier fuer den bitfield-wert, 
	//aus Generierungsgruenden hier keine einheitliche Bezeichnung moeglich.
	dword thisval; // Display2AdditionalInfo1_1
	bitval= getValue(this);
	thisval = getValue(A_ASG_69_0_0_27_Data_11);
	thisval = thisval&~(1<<27)|(bitval<<27);
	putValue(A_ASG_69_0_0_27_Data_11,thisval);
}

on envVar A_ASG_69_0_0_27_Data_11_28
{
	byte bitval;
	//thisval steht hier fuer den bitfield-wert, 
	//aus Generierungsgruenden hier keine einheitliche Bezeichnung moeglich.
	dword thisval; // Display2AdditionalInfo1_1
	bitval= getValue(this);
	thisval = getValue(A_ASG_69_0_0_27_Data_11);
	thisval = thisval&~(1<<28)|(bitval<<28);
	putValue(A_ASG_69_0_0_27_Data_11,thisval);
}

on envVar A_ASG_69_0_0_27_Data_11_29
{
	byte bitval;
	//thisval steht hier fuer den bitfield-wert, 
	//aus Generierungsgruenden hier keine einheitliche Bezeichnung moeglich.
	dword thisval; // Display2AdditionalInfo1_1
	bitval= getValue(this);
	thisval = getValue(A_ASG_69_0_0_27_Data_11);
	thisval = thisval&~(1<<29)|(bitval<<29);
	putValue(A_ASG_69_0_0_27_Data_11,thisval);
}

on envVar A_ASG_69_0_0_27_Data_11_30
{
	byte bitval;
	//thisval steht hier fuer den bitfield-wert, 
	//aus Generierungsgruenden hier keine einheitliche Bezeichnung moeglich.
	dword thisval; // Display2AdditionalInfo1_1
	bitval= getValue(this);
	thisval = getValue(A_ASG_69_0_0_27_Data_11);
	thisval = thisval&~(1<<30)|(bitval<<30);
	putValue(A_ASG_69_0_0_27_Data_11,thisval);
}

on envVar A_ASG_69_0_0_27_Data_11_31
{
	byte bitval;
	//thisval steht hier fuer den bitfield-wert, 
	//aus Generierungsgruenden hier keine einheitliche Bezeichnung moeglich.
	dword thisval; // Display2AdditionalInfo1_1
	bitval= getValue(this);
	thisval = getValue(A_ASG_69_0_0_27_Data_11);
	thisval = thisval&~(1<<31)|(bitval<<31);
	putValue(A_ASG_69_0_0_27_Data_11,thisval);
}

on envVar A_ASG_69_0_0_27_Data_11
{
	byte superval[665];

	//Update Childvalue (BitField)
	byte mask=0x01;
	int i = 0;
	dword thisval; // Display2AdditionalInfo1_1
	thisval = getValue(this);
	if(thisval&(mask<<0))
		putValue(A_ASG_69_0_0_27_Data_11_0, 1);
	else
		putValue(A_ASG_69_0_0_27_Data_11_0, 0);
	if(thisval&(mask<<1))
		putValue(A_ASG_69_0_0_27_Data_11_1, 1);
	else
		putValue(A_ASG_69_0_0_27_Data_11_1, 0);
	if(thisval&(mask<<2))
		putValue(A_ASG_69_0_0_27_Data_11_2, 1);
	else
		putValue(A_ASG_69_0_0_27_Data_11_2, 0);
	if(thisval&(mask<<3))
		putValue(A_ASG_69_0_0_27_Data_11_3, 1);
	else
		putValue(A_ASG_69_0_0_27_Data_11_3, 0);
	if(thisval&(mask<<4))
		putValue(A_ASG_69_0_0_27_Data_11_4, 1);
	else
		putValue(A_ASG_69_0_0_27_Data_11_4, 0);
	if(thisval&(mask<<5))
		putValue(A_ASG_69_0_0_27_Data_11_5, 1);
	else
		putValue(A_ASG_69_0_0_27_Data_11_5, 0);
	if(thisval&(mask<<6))
		putValue(A_ASG_69_0_0_27_Data_11_6, 1);
	else
		putValue(A_ASG_69_0_0_27_Data_11_6, 0);
	if(thisval&(mask<<7))
		putValue(A_ASG_69_0_0_27_Data_11_7, 1);
	else
		putValue(A_ASG_69_0_0_27_Data_11_7, 0);
	if(thisval&(mask<<8))
		putValue(A_ASG_69_0_0_27_Data_11_8, 1);
	else
		putValue(A_ASG_69_0_0_27_Data_11_8, 0);
	if(thisval&(mask<<9))
		putValue(A_ASG_69_0_0_27_Data_11_9, 1);
	else
		putValue(A_ASG_69_0_0_27_Data_11_9, 0);
	if(thisval&(mask<<10))
		putValue(A_ASG_69_0_0_27_Data_11_10, 1);
	else
		putValue(A_ASG_69_0_0_27_Data_11_10, 0);
	if(thisval&(mask<<11))
		putValue(A_ASG_69_0_0_27_Data_11_11, 1);
	else
		putValue(A_ASG_69_0_0_27_Data_11_11, 0);
	if(thisval&(mask<<12))
		putValue(A_ASG_69_0_0_27_Data_11_12, 1);
	else
		putValue(A_ASG_69_0_0_27_Data_11_12, 0);
	if(thisval&(mask<<13))
		putValue(A_ASG_69_0_0_27_Data_11_13, 1);
	else
		putValue(A_ASG_69_0_0_27_Data_11_13, 0);
	if(thisval&(mask<<14))
		putValue(A_ASG_69_0_0_27_Data_11_14, 1);
	else
		putValue(A_ASG_69_0_0_27_Data_11_14, 0);
	if(thisval&(mask<<15))
		putValue(A_ASG_69_0_0_27_Data_11_15, 1);
	else
		putValue(A_ASG_69_0_0_27_Data_11_15, 0);
	if(thisval&(mask<<16))
		putValue(A_ASG_69_0_0_27_Data_11_16, 1);
	else
		putValue(A_ASG_69_0_0_27_Data_11_16, 0);
	if(thisval&(mask<<17))
		putValue(A_ASG_69_0_0_27_Data_11_17, 1);
	else
		putValue(A_ASG_69_0_0_27_Data_11_17, 0);
	if(thisval&(mask<<18))
		putValue(A_ASG_69_0_0_27_Data_11_18, 1);
	else
		putValue(A_ASG_69_0_0_27_Data_11_18, 0);
	if(thisval&(mask<<19))
		putValue(A_ASG_69_0_0_27_Data_11_19, 1);
	else
		putValue(A_ASG_69_0_0_27_Data_11_19, 0);
	if(thisval&(mask<<20))
		putValue(A_ASG_69_0_0_27_Data_11_20, 1);
	else
		putValue(A_ASG_69_0_0_27_Data_11_20, 0);
	if(thisval&(mask<<21))
		putValue(A_ASG_69_0_0_27_Data_11_21, 1);
	else
		putValue(A_ASG_69_0_0_27_Data_11_21, 0);
	if(thisval&(mask<<22))
		putValue(A_ASG_69_0_0_27_Data_11_22, 1);
	else
		putValue(A_ASG_69_0_0_27_Data_11_22, 0);
	if(thisval&(mask<<23))
		putValue(A_ASG_69_0_0_27_Data_11_23, 1);
	else
		putValue(A_ASG_69_0_0_27_Data_11_23, 0);
	if(thisval&(mask<<24))
		putValue(A_ASG_69_0_0_27_Data_11_24, 1);
	else
		putValue(A_ASG_69_0_0_27_Data_11_24, 0);
	if(thisval&(mask<<25))
		putValue(A_ASG_69_0_0_27_Data_11_25, 1);
	else
		putValue(A_ASG_69_0_0_27_Data_11_25, 0);
	if(thisval&(mask<<26))
		putValue(A_ASG_69_0_0_27_Data_11_26, 1);
	else
		putValue(A_ASG_69_0_0_27_Data_11_26, 0);
	if(thisval&(mask<<27))
		putValue(A_ASG_69_0_0_27_Data_11_27, 1);
	else
		putValue(A_ASG_69_0_0_27_Data_11_27, 0);
	if(thisval&(mask<<28))
		putValue(A_ASG_69_0_0_27_Data_11_28, 1);
	else
		putValue(A_ASG_69_0_0_27_Data_11_28, 0);
	if(thisval&(mask<<29))
		putValue(A_ASG_69_0_0_27_Data_11_29, 1);
	else
		putValue(A_ASG_69_0_0_27_Data_11_29, 0);
	if(thisval&(mask<<30))
		putValue(A_ASG_69_0_0_27_Data_11_30, 1);
	else
		putValue(A_ASG_69_0_0_27_Data_11_30, 0);
	if(thisval&(mask<<31))
		putValue(A_ASG_69_0_0_27_Data_11_31, 1);
	else
		putValue(A_ASG_69_0_0_27_Data_11_31, 0);
    A_ASG_69_0_0_27_ArrayDataList[getValue(A_ASG_69_0_0_27_DataIndex)].Param11 = thisval;
}
on envVar A_ASG_69_0_0_27_Data_12_0
{
	byte bitval;
	//thisval steht hier fuer den bitfield-wert, 
	//aus Generierungsgruenden hier keine einheitliche Bezeichnung moeglich.
	dword thisval; // Display2AdditionalInfo1_2
	bitval= getValue(this);
	thisval = getValue(A_ASG_69_0_0_27_Data_12);
	thisval = thisval&~(1<<0)|(bitval<<0);
	putValue(A_ASG_69_0_0_27_Data_12,thisval);
}

on envVar A_ASG_69_0_0_27_Data_12_1
{
	byte bitval;
	//thisval steht hier fuer den bitfield-wert, 
	//aus Generierungsgruenden hier keine einheitliche Bezeichnung moeglich.
	dword thisval; // Display2AdditionalInfo1_2
	bitval= getValue(this);
	thisval = getValue(A_ASG_69_0_0_27_Data_12);
	thisval = thisval&~(1<<1)|(bitval<<1);
	putValue(A_ASG_69_0_0_27_Data_12,thisval);
}

on envVar A_ASG_69_0_0_27_Data_12_2
{
	byte bitval;
	//thisval steht hier fuer den bitfield-wert, 
	//aus Generierungsgruenden hier keine einheitliche Bezeichnung moeglich.
	dword thisval; // Display2AdditionalInfo1_2
	bitval= getValue(this);
	thisval = getValue(A_ASG_69_0_0_27_Data_12);
	thisval = thisval&~(1<<2)|(bitval<<2);
	putValue(A_ASG_69_0_0_27_Data_12,thisval);
}

on envVar A_ASG_69_0_0_27_Data_12_3
{
	byte bitval;
	//thisval steht hier fuer den bitfield-wert, 
	//aus Generierungsgruenden hier keine einheitliche Bezeichnung moeglich.
	dword thisval; // Display2AdditionalInfo1_2
	bitval= getValue(this);
	thisval = getValue(A_ASG_69_0_0_27_Data_12);
	thisval = thisval&~(1<<3)|(bitval<<3);
	putValue(A_ASG_69_0_0_27_Data_12,thisval);
}

on envVar A_ASG_69_0_0_27_Data_12_4
{
	byte bitval;
	//thisval steht hier fuer den bitfield-wert, 
	//aus Generierungsgruenden hier keine einheitliche Bezeichnung moeglich.
	dword thisval; // Display2AdditionalInfo1_2
	bitval= getValue(this);
	thisval = getValue(A_ASG_69_0_0_27_Data_12);
	thisval = thisval&~(1<<4)|(bitval<<4);
	putValue(A_ASG_69_0_0_27_Data_12,thisval);
}

on envVar A_ASG_69_0_0_27_Data_12_5
{
	byte bitval;
	//thisval steht hier fuer den bitfield-wert, 
	//aus Generierungsgruenden hier keine einheitliche Bezeichnung moeglich.
	dword thisval; // Display2AdditionalInfo1_2
	bitval= getValue(this);
	thisval = getValue(A_ASG_69_0_0_27_Data_12);
	thisval = thisval&~(1<<5)|(bitval<<5);
	putValue(A_ASG_69_0_0_27_Data_12,thisval);
}

on envVar A_ASG_69_0_0_27_Data_12_6
{
	byte bitval;
	//thisval steht hier fuer den bitfield-wert, 
	//aus Generierungsgruenden hier keine einheitliche Bezeichnung moeglich.
	dword thisval; // Display2AdditionalInfo1_2
	bitval= getValue(this);
	thisval = getValue(A_ASG_69_0_0_27_Data_12);
	thisval = thisval&~(1<<6)|(bitval<<6);
	putValue(A_ASG_69_0_0_27_Data_12,thisval);
}

on envVar A_ASG_69_0_0_27_Data_12_7
{
	byte bitval;
	//thisval steht hier fuer den bitfield-wert, 
	//aus Generierungsgruenden hier keine einheitliche Bezeichnung moeglich.
	dword thisval; // Display2AdditionalInfo1_2
	bitval= getValue(this);
	thisval = getValue(A_ASG_69_0_0_27_Data_12);
	thisval = thisval&~(1<<7)|(bitval<<7);
	putValue(A_ASG_69_0_0_27_Data_12,thisval);
}

on envVar A_ASG_69_0_0_27_Data_12_8
{
	byte bitval;
	//thisval steht hier fuer den bitfield-wert, 
	//aus Generierungsgruenden hier keine einheitliche Bezeichnung moeglich.
	dword thisval; // Display2AdditionalInfo1_2
	bitval= getValue(this);
	thisval = getValue(A_ASG_69_0_0_27_Data_12);
	thisval = thisval&~(1<<8)|(bitval<<8);
	putValue(A_ASG_69_0_0_27_Data_12,thisval);
}

on envVar A_ASG_69_0_0_27_Data_12_9
{
	byte bitval;
	//thisval steht hier fuer den bitfield-wert, 
	//aus Generierungsgruenden hier keine einheitliche Bezeichnung moeglich.
	dword thisval; // Display2AdditionalInfo1_2
	bitval= getValue(this);
	thisval = getValue(A_ASG_69_0_0_27_Data_12);
	thisval = thisval&~(1<<9)|(bitval<<9);
	putValue(A_ASG_69_0_0_27_Data_12,thisval);
}

on envVar A_ASG_69_0_0_27_Data_12_10
{
	byte bitval;
	//thisval steht hier fuer den bitfield-wert, 
	//aus Generierungsgruenden hier keine einheitliche Bezeichnung moeglich.
	dword thisval; // Display2AdditionalInfo1_2
	bitval= getValue(this);
	thisval = getValue(A_ASG_69_0_0_27_Data_12);
	thisval = thisval&~(1<<10)|(bitval<<10);
	putValue(A_ASG_69_0_0_27_Data_12,thisval);
}

on envVar A_ASG_69_0_0_27_Data_12_11
{
	byte bitval;
	//thisval steht hier fuer den bitfield-wert, 
	//aus Generierungsgruenden hier keine einheitliche Bezeichnung moeglich.
	dword thisval; // Display2AdditionalInfo1_2
	bitval= getValue(this);
	thisval = getValue(A_ASG_69_0_0_27_Data_12);
	thisval = thisval&~(1<<11)|(bitval<<11);
	putValue(A_ASG_69_0_0_27_Data_12,thisval);
}

on envVar A_ASG_69_0_0_27_Data_12_12
{
	byte bitval;
	//thisval steht hier fuer den bitfield-wert, 
	//aus Generierungsgruenden hier keine einheitliche Bezeichnung moeglich.
	dword thisval; // Display2AdditionalInfo1_2
	bitval= getValue(this);
	thisval = getValue(A_ASG_69_0_0_27_Data_12);
	thisval = thisval&~(1<<12)|(bitval<<12);
	putValue(A_ASG_69_0_0_27_Data_12,thisval);
}

on envVar A_ASG_69_0_0_27_Data_12_13
{
	byte bitval;
	//thisval steht hier fuer den bitfield-wert, 
	//aus Generierungsgruenden hier keine einheitliche Bezeichnung moeglich.
	dword thisval; // Display2AdditionalInfo1_2
	bitval= getValue(this);
	thisval = getValue(A_ASG_69_0_0_27_Data_12);
	thisval = thisval&~(1<<13)|(bitval<<13);
	putValue(A_ASG_69_0_0_27_Data_12,thisval);
}

on envVar A_ASG_69_0_0_27_Data_12_14
{
	byte bitval;
	//thisval steht hier fuer den bitfield-wert, 
	//aus Generierungsgruenden hier keine einheitliche Bezeichnung moeglich.
	dword thisval; // Display2AdditionalInfo1_2
	bitval= getValue(this);
	thisval = getValue(A_ASG_69_0_0_27_Data_12);
	thisval = thisval&~(1<<14)|(bitval<<14);
	putValue(A_ASG_69_0_0_27_Data_12,thisval);
}

on envVar A_ASG_69_0_0_27_Data_12_15
{
	byte bitval;
	//thisval steht hier fuer den bitfield-wert, 
	//aus Generierungsgruenden hier keine einheitliche Bezeichnung moeglich.
	dword thisval; // Display2AdditionalInfo1_2
	bitval= getValue(this);
	thisval = getValue(A_ASG_69_0_0_27_Data_12);
	thisval = thisval&~(1<<15)|(bitval<<15);
	putValue(A_ASG_69_0_0_27_Data_12,thisval);
}

on envVar A_ASG_69_0_0_27_Data_12_16
{
	byte bitval;
	//thisval steht hier fuer den bitfield-wert, 
	//aus Generierungsgruenden hier keine einheitliche Bezeichnung moeglich.
	dword thisval; // Display2AdditionalInfo1_2
	bitval= getValue(this);
	thisval = getValue(A_ASG_69_0_0_27_Data_12);
	thisval = thisval&~(1<<16)|(bitval<<16);
	putValue(A_ASG_69_0_0_27_Data_12,thisval);
}

on envVar A_ASG_69_0_0_27_Data_12_17
{
	byte bitval;
	//thisval steht hier fuer den bitfield-wert, 
	//aus Generierungsgruenden hier keine einheitliche Bezeichnung moeglich.
	dword thisval; // Display2AdditionalInfo1_2
	bitval= getValue(this);
	thisval = getValue(A_ASG_69_0_0_27_Data_12);
	thisval = thisval&~(1<<17)|(bitval<<17);
	putValue(A_ASG_69_0_0_27_Data_12,thisval);
}

on envVar A_ASG_69_0_0_27_Data_12_18
{
	byte bitval;
	//thisval steht hier fuer den bitfield-wert, 
	//aus Generierungsgruenden hier keine einheitliche Bezeichnung moeglich.
	dword thisval; // Display2AdditionalInfo1_2
	bitval= getValue(this);
	thisval = getValue(A_ASG_69_0_0_27_Data_12);
	thisval = thisval&~(1<<18)|(bitval<<18);
	putValue(A_ASG_69_0_0_27_Data_12,thisval);
}

on envVar A_ASG_69_0_0_27_Data_12_19
{
	byte bitval;
	//thisval steht hier fuer den bitfield-wert, 
	//aus Generierungsgruenden hier keine einheitliche Bezeichnung moeglich.
	dword thisval; // Display2AdditionalInfo1_2
	bitval= getValue(this);
	thisval = getValue(A_ASG_69_0_0_27_Data_12);
	thisval = thisval&~(1<<19)|(bitval<<19);
	putValue(A_ASG_69_0_0_27_Data_12,thisval);
}

on envVar A_ASG_69_0_0_27_Data_12_20
{
	byte bitval;
	//thisval steht hier fuer den bitfield-wert, 
	//aus Generierungsgruenden hier keine einheitliche Bezeichnung moeglich.
	dword thisval; // Display2AdditionalInfo1_2
	bitval= getValue(this);
	thisval = getValue(A_ASG_69_0_0_27_Data_12);
	thisval = thisval&~(1<<20)|(bitval<<20);
	putValue(A_ASG_69_0_0_27_Data_12,thisval);
}

on envVar A_ASG_69_0_0_27_Data_12_21
{
	byte bitval;
	//thisval steht hier fuer den bitfield-wert, 
	//aus Generierungsgruenden hier keine einheitliche Bezeichnung moeglich.
	dword thisval; // Display2AdditionalInfo1_2
	bitval= getValue(this);
	thisval = getValue(A_ASG_69_0_0_27_Data_12);
	thisval = thisval&~(1<<21)|(bitval<<21);
	putValue(A_ASG_69_0_0_27_Data_12,thisval);
}

on envVar A_ASG_69_0_0_27_Data_12_22
{
	byte bitval;
	//thisval steht hier fuer den bitfield-wert, 
	//aus Generierungsgruenden hier keine einheitliche Bezeichnung moeglich.
	dword thisval; // Display2AdditionalInfo1_2
	bitval= getValue(this);
	thisval = getValue(A_ASG_69_0_0_27_Data_12);
	thisval = thisval&~(1<<22)|(bitval<<22);
	putValue(A_ASG_69_0_0_27_Data_12,thisval);
}

on envVar A_ASG_69_0_0_27_Data_12_23
{
	byte bitval;
	//thisval steht hier fuer den bitfield-wert, 
	//aus Generierungsgruenden hier keine einheitliche Bezeichnung moeglich.
	dword thisval; // Display2AdditionalInfo1_2
	bitval= getValue(this);
	thisval = getValue(A_ASG_69_0_0_27_Data_12);
	thisval = thisval&~(1<<23)|(bitval<<23);
	putValue(A_ASG_69_0_0_27_Data_12,thisval);
}

on envVar A_ASG_69_0_0_27_Data_12_24
{
	byte bitval;
	//thisval steht hier fuer den bitfield-wert, 
	//aus Generierungsgruenden hier keine einheitliche Bezeichnung moeglich.
	dword thisval; // Display2AdditionalInfo1_2
	bitval= getValue(this);
	thisval = getValue(A_ASG_69_0_0_27_Data_12);
	thisval = thisval&~(1<<24)|(bitval<<24);
	putValue(A_ASG_69_0_0_27_Data_12,thisval);
}

on envVar A_ASG_69_0_0_27_Data_12_25
{
	byte bitval;
	//thisval steht hier fuer den bitfield-wert, 
	//aus Generierungsgruenden hier keine einheitliche Bezeichnung moeglich.
	dword thisval; // Display2AdditionalInfo1_2
	bitval= getValue(this);
	thisval = getValue(A_ASG_69_0_0_27_Data_12);
	thisval = thisval&~(1<<25)|(bitval<<25);
	putValue(A_ASG_69_0_0_27_Data_12,thisval);
}

on envVar A_ASG_69_0_0_27_Data_12_26
{
	byte bitval;
	//thisval steht hier fuer den bitfield-wert, 
	//aus Generierungsgruenden hier keine einheitliche Bezeichnung moeglich.
	dword thisval; // Display2AdditionalInfo1_2
	bitval= getValue(this);
	thisval = getValue(A_ASG_69_0_0_27_Data_12);
	thisval = thisval&~(1<<26)|(bitval<<26);
	putValue(A_ASG_69_0_0_27_Data_12,thisval);
}

on envVar A_ASG_69_0_0_27_Data_12_27
{
	byte bitval;
	//thisval steht hier fuer den bitfield-wert, 
	//aus Generierungsgruenden hier keine einheitliche Bezeichnung moeglich.
	dword thisval; // Display2AdditionalInfo1_2
	bitval= getValue(this);
	thisval = getValue(A_ASG_69_0_0_27_Data_12);
	thisval = thisval&~(1<<27)|(bitval<<27);
	putValue(A_ASG_69_0_0_27_Data_12,thisval);
}

on envVar A_ASG_69_0_0_27_Data_12_28
{
	byte bitval;
	//thisval steht hier fuer den bitfield-wert, 
	//aus Generierungsgruenden hier keine einheitliche Bezeichnung moeglich.
	dword thisval; // Display2AdditionalInfo1_2
	bitval= getValue(this);
	thisval = getValue(A_ASG_69_0_0_27_Data_12);
	thisval = thisval&~(1<<28)|(bitval<<28);
	putValue(A_ASG_69_0_0_27_Data_12,thisval);
}

on envVar A_ASG_69_0_0_27_Data_12_29
{
	byte bitval;
	//thisval steht hier fuer den bitfield-wert, 
	//aus Generierungsgruenden hier keine einheitliche Bezeichnung moeglich.
	dword thisval; // Display2AdditionalInfo1_2
	bitval= getValue(this);
	thisval = getValue(A_ASG_69_0_0_27_Data_12);
	thisval = thisval&~(1<<29)|(bitval<<29);
	putValue(A_ASG_69_0_0_27_Data_12,thisval);
}

on envVar A_ASG_69_0_0_27_Data_12
{
	byte superval[665];

	//Update Childvalue (BitField)
	byte mask=0x01;
	int i = 0;
	dword thisval; // Display2AdditionalInfo1_2
	thisval = getValue(this);
	if(thisval&(mask<<0))
		putValue(A_ASG_69_0_0_27_Data_12_0, 1);
	else
		putValue(A_ASG_69_0_0_27_Data_12_0, 0);
	if(thisval&(mask<<1))
		putValue(A_ASG_69_0_0_27_Data_12_1, 1);
	else
		putValue(A_ASG_69_0_0_27_Data_12_1, 0);
	if(thisval&(mask<<2))
		putValue(A_ASG_69_0_0_27_Data_12_2, 1);
	else
		putValue(A_ASG_69_0_0_27_Data_12_2, 0);
	if(thisval&(mask<<3))
		putValue(A_ASG_69_0_0_27_Data_12_3, 1);
	else
		putValue(A_ASG_69_0_0_27_Data_12_3, 0);
	if(thisval&(mask<<4))
		putValue(A_ASG_69_0_0_27_Data_12_4, 1);
	else
		putValue(A_ASG_69_0_0_27_Data_12_4, 0);
	if(thisval&(mask<<5))
		putValue(A_ASG_69_0_0_27_Data_12_5, 1);
	else
		putValue(A_ASG_69_0_0_27_Data_12_5, 0);
	if(thisval&(mask<<6))
		putValue(A_ASG_69_0_0_27_Data_12_6, 1);
	else
		putValue(A_ASG_69_0_0_27_Data_12_6, 0);
	if(thisval&(mask<<7))
		putValue(A_ASG_69_0_0_27_Data_12_7, 1);
	else
		putValue(A_ASG_69_0_0_27_Data_12_7, 0);
	if(thisval&(mask<<8))
		putValue(A_ASG_69_0_0_27_Data_12_8, 1);
	else
		putValue(A_ASG_69_0_0_27_Data_12_8, 0);
	if(thisval&(mask<<9))
		putValue(A_ASG_69_0_0_27_Data_12_9, 1);
	else
		putValue(A_ASG_69_0_0_27_Data_12_9, 0);
	if(thisval&(mask<<10))
		putValue(A_ASG_69_0_0_27_Data_12_10, 1);
	else
		putValue(A_ASG_69_0_0_27_Data_12_10, 0);
	if(thisval&(mask<<11))
		putValue(A_ASG_69_0_0_27_Data_12_11, 1);
	else
		putValue(A_ASG_69_0_0_27_Data_12_11, 0);
	if(thisval&(mask<<12))
		putValue(A_ASG_69_0_0_27_Data_12_12, 1);
	else
		putValue(A_ASG_69_0_0_27_Data_12_12, 0);
	if(thisval&(mask<<13))
		putValue(A_ASG_69_0_0_27_Data_12_13, 1);
	else
		putValue(A_ASG_69_0_0_27_Data_12_13, 0);
	if(thisval&(mask<<14))
		putValue(A_ASG_69_0_0_27_Data_12_14, 1);
	else
		putValue(A_ASG_69_0_0_27_Data_12_14, 0);
	if(thisval&(mask<<15))
		putValue(A_ASG_69_0_0_27_Data_12_15, 1);
	else
		putValue(A_ASG_69_0_0_27_Data_12_15, 0);
	if(thisval&(mask<<16))
		putValue(A_ASG_69_0_0_27_Data_12_16, 1);
	else
		putValue(A_ASG_69_0_0_27_Data_12_16, 0);
	if(thisval&(mask<<17))
		putValue(A_ASG_69_0_0_27_Data_12_17, 1);
	else
		putValue(A_ASG_69_0_0_27_Data_12_17, 0);
	if(thisval&(mask<<18))
		putValue(A_ASG_69_0_0_27_Data_12_18, 1);
	else
		putValue(A_ASG_69_0_0_27_Data_12_18, 0);
	if(thisval&(mask<<19))
		putValue(A_ASG_69_0_0_27_Data_12_19, 1);
	else
		putValue(A_ASG_69_0_0_27_Data_12_19, 0);
	if(thisval&(mask<<20))
		putValue(A_ASG_69_0_0_27_Data_12_20, 1);
	else
		putValue(A_ASG_69_0_0_27_Data_12_20, 0);
	if(thisval&(mask<<21))
		putValue(A_ASG_69_0_0_27_Data_12_21, 1);
	else
		putValue(A_ASG_69_0_0_27_Data_12_21, 0);
	if(thisval&(mask<<22))
		putValue(A_ASG_69_0_0_27_Data_12_22, 1);
	else
		putValue(A_ASG_69_0_0_27_Data_12_22, 0);
	if(thisval&(mask<<23))
		putValue(A_ASG_69_0_0_27_Data_12_23, 1);
	else
		putValue(A_ASG_69_0_0_27_Data_12_23, 0);
	if(thisval&(mask<<24))
		putValue(A_ASG_69_0_0_27_Data_12_24, 1);
	else
		putValue(A_ASG_69_0_0_27_Data_12_24, 0);
	if(thisval&(mask<<25))
		putValue(A_ASG_69_0_0_27_Data_12_25, 1);
	else
		putValue(A_ASG_69_0_0_27_Data_12_25, 0);
	if(thisval&(mask<<26))
		putValue(A_ASG_69_0_0_27_Data_12_26, 1);
	else
		putValue(A_ASG_69_0_0_27_Data_12_26, 0);
	if(thisval&(mask<<27))
		putValue(A_ASG_69_0_0_27_Data_12_27, 1);
	else
		putValue(A_ASG_69_0_0_27_Data_12_27, 0);
	if(thisval&(mask<<28))
		putValue(A_ASG_69_0_0_27_Data_12_28, 1);
	else
		putValue(A_ASG_69_0_0_27_Data_12_28, 0);
	if(thisval&(mask<<29))
		putValue(A_ASG_69_0_0_27_Data_12_29, 1);
	else
		putValue(A_ASG_69_0_0_27_Data_12_29, 0);
    A_ASG_69_0_0_27_ArrayDataList[getValue(A_ASG_69_0_0_27_DataIndex)].Param12 = thisval;
}
on envVar A_ASG_69_0_0_27_Data_13_0
{
	byte bitval;
	//thisval steht hier fuer den bitfield-wert, 
	//aus Generierungsgruenden hier keine einheitliche Bezeichnung moeglich.
	dword thisval; // Display2AdditionalInfo2_1
	bitval= getValue(this);
	thisval = getValue(A_ASG_69_0_0_27_Data_13);
	thisval = thisval&~(1<<0)|(bitval<<0);
	putValue(A_ASG_69_0_0_27_Data_13,thisval);
}

on envVar A_ASG_69_0_0_27_Data_13_1
{
	byte bitval;
	//thisval steht hier fuer den bitfield-wert, 
	//aus Generierungsgruenden hier keine einheitliche Bezeichnung moeglich.
	dword thisval; // Display2AdditionalInfo2_1
	bitval= getValue(this);
	thisval = getValue(A_ASG_69_0_0_27_Data_13);
	thisval = thisval&~(1<<1)|(bitval<<1);
	putValue(A_ASG_69_0_0_27_Data_13,thisval);
}

on envVar A_ASG_69_0_0_27_Data_13_2
{
	byte bitval;
	//thisval steht hier fuer den bitfield-wert, 
	//aus Generierungsgruenden hier keine einheitliche Bezeichnung moeglich.
	dword thisval; // Display2AdditionalInfo2_1
	bitval= getValue(this);
	thisval = getValue(A_ASG_69_0_0_27_Data_13);
	thisval = thisval&~(1<<2)|(bitval<<2);
	putValue(A_ASG_69_0_0_27_Data_13,thisval);
}

on envVar A_ASG_69_0_0_27_Data_13_3
{
	byte bitval;
	//thisval steht hier fuer den bitfield-wert, 
	//aus Generierungsgruenden hier keine einheitliche Bezeichnung moeglich.
	dword thisval; // Display2AdditionalInfo2_1
	bitval= getValue(this);
	thisval = getValue(A_ASG_69_0_0_27_Data_13);
	thisval = thisval&~(1<<3)|(bitval<<3);
	putValue(A_ASG_69_0_0_27_Data_13,thisval);
}

on envVar A_ASG_69_0_0_27_Data_13_4
{
	byte bitval;
	//thisval steht hier fuer den bitfield-wert, 
	//aus Generierungsgruenden hier keine einheitliche Bezeichnung moeglich.
	dword thisval; // Display2AdditionalInfo2_1
	bitval= getValue(this);
	thisval = getValue(A_ASG_69_0_0_27_Data_13);
	thisval = thisval&~(1<<4)|(bitval<<4);
	putValue(A_ASG_69_0_0_27_Data_13,thisval);
}

on envVar A_ASG_69_0_0_27_Data_13_5
{
	byte bitval;
	//thisval steht hier fuer den bitfield-wert, 
	//aus Generierungsgruenden hier keine einheitliche Bezeichnung moeglich.
	dword thisval; // Display2AdditionalInfo2_1
	bitval= getValue(this);
	thisval = getValue(A_ASG_69_0_0_27_Data_13);
	thisval = thisval&~(1<<5)|(bitval<<5);
	putValue(A_ASG_69_0_0_27_Data_13,thisval);
}

on envVar A_ASG_69_0_0_27_Data_13_6
{
	byte bitval;
	//thisval steht hier fuer den bitfield-wert, 
	//aus Generierungsgruenden hier keine einheitliche Bezeichnung moeglich.
	dword thisval; // Display2AdditionalInfo2_1
	bitval= getValue(this);
	thisval = getValue(A_ASG_69_0_0_27_Data_13);
	thisval = thisval&~(1<<6)|(bitval<<6);
	putValue(A_ASG_69_0_0_27_Data_13,thisval);
}

on envVar A_ASG_69_0_0_27_Data_13_7
{
	byte bitval;
	//thisval steht hier fuer den bitfield-wert, 
	//aus Generierungsgruenden hier keine einheitliche Bezeichnung moeglich.
	dword thisval; // Display2AdditionalInfo2_1
	bitval= getValue(this);
	thisval = getValue(A_ASG_69_0_0_27_Data_13);
	thisval = thisval&~(1<<7)|(bitval<<7);
	putValue(A_ASG_69_0_0_27_Data_13,thisval);
}

on envVar A_ASG_69_0_0_27_Data_13_8
{
	byte bitval;
	//thisval steht hier fuer den bitfield-wert, 
	//aus Generierungsgruenden hier keine einheitliche Bezeichnung moeglich.
	dword thisval; // Display2AdditionalInfo2_1
	bitval= getValue(this);
	thisval = getValue(A_ASG_69_0_0_27_Data_13);
	thisval = thisval&~(1<<8)|(bitval<<8);
	putValue(A_ASG_69_0_0_27_Data_13,thisval);
}

on envVar A_ASG_69_0_0_27_Data_13_9
{
	byte bitval;
	//thisval steht hier fuer den bitfield-wert, 
	//aus Generierungsgruenden hier keine einheitliche Bezeichnung moeglich.
	dword thisval; // Display2AdditionalInfo2_1
	bitval= getValue(this);
	thisval = getValue(A_ASG_69_0_0_27_Data_13);
	thisval = thisval&~(1<<9)|(bitval<<9);
	putValue(A_ASG_69_0_0_27_Data_13,thisval);
}

on envVar A_ASG_69_0_0_27_Data_13_10
{
	byte bitval;
	//thisval steht hier fuer den bitfield-wert, 
	//aus Generierungsgruenden hier keine einheitliche Bezeichnung moeglich.
	dword thisval; // Display2AdditionalInfo2_1
	bitval= getValue(this);
	thisval = getValue(A_ASG_69_0_0_27_Data_13);
	thisval = thisval&~(1<<10)|(bitval<<10);
	putValue(A_ASG_69_0_0_27_Data_13,thisval);
}

on envVar A_ASG_69_0_0_27_Data_13_11
{
	byte bitval;
	//thisval steht hier fuer den bitfield-wert, 
	//aus Generierungsgruenden hier keine einheitliche Bezeichnung moeglich.
	dword thisval; // Display2AdditionalInfo2_1
	bitval= getValue(this);
	thisval = getValue(A_ASG_69_0_0_27_Data_13);
	thisval = thisval&~(1<<11)|(bitval<<11);
	putValue(A_ASG_69_0_0_27_Data_13,thisval);
}

on envVar A_ASG_69_0_0_27_Data_13_12
{
	byte bitval;
	//thisval steht hier fuer den bitfield-wert, 
	//aus Generierungsgruenden hier keine einheitliche Bezeichnung moeglich.
	dword thisval; // Display2AdditionalInfo2_1
	bitval= getValue(this);
	thisval = getValue(A_ASG_69_0_0_27_Data_13);
	thisval = thisval&~(1<<12)|(bitval<<12);
	putValue(A_ASG_69_0_0_27_Data_13,thisval);
}

on envVar A_ASG_69_0_0_27_Data_13_13
{
	byte bitval;
	//thisval steht hier fuer den bitfield-wert, 
	//aus Generierungsgruenden hier keine einheitliche Bezeichnung moeglich.
	dword thisval; // Display2AdditionalInfo2_1
	bitval= getValue(this);
	thisval = getValue(A_ASG_69_0_0_27_Data_13);
	thisval = thisval&~(1<<13)|(bitval<<13);
	putValue(A_ASG_69_0_0_27_Data_13,thisval);
}

on envVar A_ASG_69_0_0_27_Data_13_14
{
	byte bitval;
	//thisval steht hier fuer den bitfield-wert, 
	//aus Generierungsgruenden hier keine einheitliche Bezeichnung moeglich.
	dword thisval; // Display2AdditionalInfo2_1
	bitval= getValue(this);
	thisval = getValue(A_ASG_69_0_0_27_Data_13);
	thisval = thisval&~(1<<14)|(bitval<<14);
	putValue(A_ASG_69_0_0_27_Data_13,thisval);
}

on envVar A_ASG_69_0_0_27_Data_13_15
{
	byte bitval;
	//thisval steht hier fuer den bitfield-wert, 
	//aus Generierungsgruenden hier keine einheitliche Bezeichnung moeglich.
	dword thisval; // Display2AdditionalInfo2_1
	bitval= getValue(this);
	thisval = getValue(A_ASG_69_0_0_27_Data_13);
	thisval = thisval&~(1<<15)|(bitval<<15);
	putValue(A_ASG_69_0_0_27_Data_13,thisval);
}

on envVar A_ASG_69_0_0_27_Data_13_16
{
	byte bitval;
	//thisval steht hier fuer den bitfield-wert, 
	//aus Generierungsgruenden hier keine einheitliche Bezeichnung moeglich.
	dword thisval; // Display2AdditionalInfo2_1
	bitval= getValue(this);
	thisval = getValue(A_ASG_69_0_0_27_Data_13);
	thisval = thisval&~(1<<16)|(bitval<<16);
	putValue(A_ASG_69_0_0_27_Data_13,thisval);
}

on envVar A_ASG_69_0_0_27_Data_13_17
{
	byte bitval;
	//thisval steht hier fuer den bitfield-wert, 
	//aus Generierungsgruenden hier keine einheitliche Bezeichnung moeglich.
	dword thisval; // Display2AdditionalInfo2_1
	bitval= getValue(this);
	thisval = getValue(A_ASG_69_0_0_27_Data_13);
	thisval = thisval&~(1<<17)|(bitval<<17);
	putValue(A_ASG_69_0_0_27_Data_13,thisval);
}

on envVar A_ASG_69_0_0_27_Data_13_18
{
	byte bitval;
	//thisval steht hier fuer den bitfield-wert, 
	//aus Generierungsgruenden hier keine einheitliche Bezeichnung moeglich.
	dword thisval; // Display2AdditionalInfo2_1
	bitval= getValue(this);
	thisval = getValue(A_ASG_69_0_0_27_Data_13);
	thisval = thisval&~(1<<18)|(bitval<<18);
	putValue(A_ASG_69_0_0_27_Data_13,thisval);
}

on envVar A_ASG_69_0_0_27_Data_13_19
{
	byte bitval;
	//thisval steht hier fuer den bitfield-wert, 
	//aus Generierungsgruenden hier keine einheitliche Bezeichnung moeglich.
	dword thisval; // Display2AdditionalInfo2_1
	bitval= getValue(this);
	thisval = getValue(A_ASG_69_0_0_27_Data_13);
	thisval = thisval&~(1<<19)|(bitval<<19);
	putValue(A_ASG_69_0_0_27_Data_13,thisval);
}

on envVar A_ASG_69_0_0_27_Data_13_20
{
	byte bitval;
	//thisval steht hier fuer den bitfield-wert, 
	//aus Generierungsgruenden hier keine einheitliche Bezeichnung moeglich.
	dword thisval; // Display2AdditionalInfo2_1
	bitval= getValue(this);
	thisval = getValue(A_ASG_69_0_0_27_Data_13);
	thisval = thisval&~(1<<20)|(bitval<<20);
	putValue(A_ASG_69_0_0_27_Data_13,thisval);
}

on envVar A_ASG_69_0_0_27_Data_13_21
{
	byte bitval;
	//thisval steht hier fuer den bitfield-wert, 
	//aus Generierungsgruenden hier keine einheitliche Bezeichnung moeglich.
	dword thisval; // Display2AdditionalInfo2_1
	bitval= getValue(this);
	thisval = getValue(A_ASG_69_0_0_27_Data_13);
	thisval = thisval&~(1<<21)|(bitval<<21);
	putValue(A_ASG_69_0_0_27_Data_13,thisval);
}

on envVar A_ASG_69_0_0_27_Data_13_22
{
	byte bitval;
	//thisval steht hier fuer den bitfield-wert, 
	//aus Generierungsgruenden hier keine einheitliche Bezeichnung moeglich.
	dword thisval; // Display2AdditionalInfo2_1
	bitval= getValue(this);
	thisval = getValue(A_ASG_69_0_0_27_Data_13);
	thisval = thisval&~(1<<22)|(bitval<<22);
	putValue(A_ASG_69_0_0_27_Data_13,thisval);
}

on envVar A_ASG_69_0_0_27_Data_13_23
{
	byte bitval;
	//thisval steht hier fuer den bitfield-wert, 
	//aus Generierungsgruenden hier keine einheitliche Bezeichnung moeglich.
	dword thisval; // Display2AdditionalInfo2_1
	bitval= getValue(this);
	thisval = getValue(A_ASG_69_0_0_27_Data_13);
	thisval = thisval&~(1<<23)|(bitval<<23);
	putValue(A_ASG_69_0_0_27_Data_13,thisval);
}

on envVar A_ASG_69_0_0_27_Data_13_24
{
	byte bitval;
	//thisval steht hier fuer den bitfield-wert, 
	//aus Generierungsgruenden hier keine einheitliche Bezeichnung moeglich.
	dword thisval; // Display2AdditionalInfo2_1
	bitval= getValue(this);
	thisval = getValue(A_ASG_69_0_0_27_Data_13);
	thisval = thisval&~(1<<24)|(bitval<<24);
	putValue(A_ASG_69_0_0_27_Data_13,thisval);
}

on envVar A_ASG_69_0_0_27_Data_13_25
{
	byte bitval;
	//thisval steht hier fuer den bitfield-wert, 
	//aus Generierungsgruenden hier keine einheitliche Bezeichnung moeglich.
	dword thisval; // Display2AdditionalInfo2_1
	bitval= getValue(this);
	thisval = getValue(A_ASG_69_0_0_27_Data_13);
	thisval = thisval&~(1<<25)|(bitval<<25);
	putValue(A_ASG_69_0_0_27_Data_13,thisval);
}

on envVar A_ASG_69_0_0_27_Data_13_26
{
	byte bitval;
	//thisval steht hier fuer den bitfield-wert, 
	//aus Generierungsgruenden hier keine einheitliche Bezeichnung moeglich.
	dword thisval; // Display2AdditionalInfo2_1
	bitval= getValue(this);
	thisval = getValue(A_ASG_69_0_0_27_Data_13);
	thisval = thisval&~(1<<26)|(bitval<<26);
	putValue(A_ASG_69_0_0_27_Data_13,thisval);
}

on envVar A_ASG_69_0_0_27_Data_13_27
{
	byte bitval;
	//thisval steht hier fuer den bitfield-wert, 
	//aus Generierungsgruenden hier keine einheitliche Bezeichnung moeglich.
	dword thisval; // Display2AdditionalInfo2_1
	bitval= getValue(this);
	thisval = getValue(A_ASG_69_0_0_27_Data_13);
	thisval = thisval&~(1<<27)|(bitval<<27);
	putValue(A_ASG_69_0_0_27_Data_13,thisval);
}

on envVar A_ASG_69_0_0_27_Data_13_28
{
	byte bitval;
	//thisval steht hier fuer den bitfield-wert, 
	//aus Generierungsgruenden hier keine einheitliche Bezeichnung moeglich.
	dword thisval; // Display2AdditionalInfo2_1
	bitval= getValue(this);
	thisval = getValue(A_ASG_69_0_0_27_Data_13);
	thisval = thisval&~(1<<28)|(bitval<<28);
	putValue(A_ASG_69_0_0_27_Data_13,thisval);
}

on envVar A_ASG_69_0_0_27_Data_13_29
{
	byte bitval;
	//thisval steht hier fuer den bitfield-wert, 
	//aus Generierungsgruenden hier keine einheitliche Bezeichnung moeglich.
	dword thisval; // Display2AdditionalInfo2_1
	bitval= getValue(this);
	thisval = getValue(A_ASG_69_0_0_27_Data_13);
	thisval = thisval&~(1<<29)|(bitval<<29);
	putValue(A_ASG_69_0_0_27_Data_13,thisval);
}

on envVar A_ASG_69_0_0_27_Data_13_30
{
	byte bitval;
	//thisval steht hier fuer den bitfield-wert, 
	//aus Generierungsgruenden hier keine einheitliche Bezeichnung moeglich.
	dword thisval; // Display2AdditionalInfo2_1
	bitval= getValue(this);
	thisval = getValue(A_ASG_69_0_0_27_Data_13);
	thisval = thisval&~(1<<30)|(bitval<<30);
	putValue(A_ASG_69_0_0_27_Data_13,thisval);
}

on envVar A_ASG_69_0_0_27_Data_13_31
{
	byte bitval;
	//thisval steht hier fuer den bitfield-wert, 
	//aus Generierungsgruenden hier keine einheitliche Bezeichnung moeglich.
	dword thisval; // Display2AdditionalInfo2_1
	bitval= getValue(this);
	thisval = getValue(A_ASG_69_0_0_27_Data_13);
	thisval = thisval&~(1<<31)|(bitval<<31);
	putValue(A_ASG_69_0_0_27_Data_13,thisval);
}

on envVar A_ASG_69_0_0_27_Data_13
{
	byte superval[665];

	//Update Childvalue (BitField)
	byte mask=0x01;
	int i = 0;
	dword thisval; // Display2AdditionalInfo2_1
	thisval = getValue(this);
	if(thisval&(mask<<0))
		putValue(A_ASG_69_0_0_27_Data_13_0, 1);
	else
		putValue(A_ASG_69_0_0_27_Data_13_0, 0);
	if(thisval&(mask<<1))
		putValue(A_ASG_69_0_0_27_Data_13_1, 1);
	else
		putValue(A_ASG_69_0_0_27_Data_13_1, 0);
	if(thisval&(mask<<2))
		putValue(A_ASG_69_0_0_27_Data_13_2, 1);
	else
		putValue(A_ASG_69_0_0_27_Data_13_2, 0);
	if(thisval&(mask<<3))
		putValue(A_ASG_69_0_0_27_Data_13_3, 1);
	else
		putValue(A_ASG_69_0_0_27_Data_13_3, 0);
	if(thisval&(mask<<4))
		putValue(A_ASG_69_0_0_27_Data_13_4, 1);
	else
		putValue(A_ASG_69_0_0_27_Data_13_4, 0);
	if(thisval&(mask<<5))
		putValue(A_ASG_69_0_0_27_Data_13_5, 1);
	else
		putValue(A_ASG_69_0_0_27_Data_13_5, 0);
	if(thisval&(mask<<6))
		putValue(A_ASG_69_0_0_27_Data_13_6, 1);
	else
		putValue(A_ASG_69_0_0_27_Data_13_6, 0);
	if(thisval&(mask<<7))
		putValue(A_ASG_69_0_0_27_Data_13_7, 1);
	else
		putValue(A_ASG_69_0_0_27_Data_13_7, 0);
	if(thisval&(mask<<8))
		putValue(A_ASG_69_0_0_27_Data_13_8, 1);
	else
		putValue(A_ASG_69_0_0_27_Data_13_8, 0);
	if(thisval&(mask<<9))
		putValue(A_ASG_69_0_0_27_Data_13_9, 1);
	else
		putValue(A_ASG_69_0_0_27_Data_13_9, 0);
	if(thisval&(mask<<10))
		putValue(A_ASG_69_0_0_27_Data_13_10, 1);
	else
		putValue(A_ASG_69_0_0_27_Data_13_10, 0);
	if(thisval&(mask<<11))
		putValue(A_ASG_69_0_0_27_Data_13_11, 1);
	else
		putValue(A_ASG_69_0_0_27_Data_13_11, 0);
	if(thisval&(mask<<12))
		putValue(A_ASG_69_0_0_27_Data_13_12, 1);
	else
		putValue(A_ASG_69_0_0_27_Data_13_12, 0);
	if(thisval&(mask<<13))
		putValue(A_ASG_69_0_0_27_Data_13_13, 1);
	else
		putValue(A_ASG_69_0_0_27_Data_13_13, 0);
	if(thisval&(mask<<14))
		putValue(A_ASG_69_0_0_27_Data_13_14, 1);
	else
		putValue(A_ASG_69_0_0_27_Data_13_14, 0);
	if(thisval&(mask<<15))
		putValue(A_ASG_69_0_0_27_Data_13_15, 1);
	else
		putValue(A_ASG_69_0_0_27_Data_13_15, 0);
	if(thisval&(mask<<16))
		putValue(A_ASG_69_0_0_27_Data_13_16, 1);
	else
		putValue(A_ASG_69_0_0_27_Data_13_16, 0);
	if(thisval&(mask<<17))
		putValue(A_ASG_69_0_0_27_Data_13_17, 1);
	else
		putValue(A_ASG_69_0_0_27_Data_13_17, 0);
	if(thisval&(mask<<18))
		putValue(A_ASG_69_0_0_27_Data_13_18, 1);
	else
		putValue(A_ASG_69_0_0_27_Data_13_18, 0);
	if(thisval&(mask<<19))
		putValue(A_ASG_69_0_0_27_Data_13_19, 1);
	else
		putValue(A_ASG_69_0_0_27_Data_13_19, 0);
	if(thisval&(mask<<20))
		putValue(A_ASG_69_0_0_27_Data_13_20, 1);
	else
		putValue(A_ASG_69_0_0_27_Data_13_20, 0);
	if(thisval&(mask<<21))
		putValue(A_ASG_69_0_0_27_Data_13_21, 1);
	else
		putValue(A_ASG_69_0_0_27_Data_13_21, 0);
	if(thisval&(mask<<22))
		putValue(A_ASG_69_0_0_27_Data_13_22, 1);
	else
		putValue(A_ASG_69_0_0_27_Data_13_22, 0);
	if(thisval&(mask<<23))
		putValue(A_ASG_69_0_0_27_Data_13_23, 1);
	else
		putValue(A_ASG_69_0_0_27_Data_13_23, 0);
	if(thisval&(mask<<24))
		putValue(A_ASG_69_0_0_27_Data_13_24, 1);
	else
		putValue(A_ASG_69_0_0_27_Data_13_24, 0);
	if(thisval&(mask<<25))
		putValue(A_ASG_69_0_0_27_Data_13_25, 1);
	else
		putValue(A_ASG_69_0_0_27_Data_13_25, 0);
	if(thisval&(mask<<26))
		putValue(A_ASG_69_0_0_27_Data_13_26, 1);
	else
		putValue(A_ASG_69_0_0_27_Data_13_26, 0);
	if(thisval&(mask<<27))
		putValue(A_ASG_69_0_0_27_Data_13_27, 1);
	else
		putValue(A_ASG_69_0_0_27_Data_13_27, 0);
	if(thisval&(mask<<28))
		putValue(A_ASG_69_0_0_27_Data_13_28, 1);
	else
		putValue(A_ASG_69_0_0_27_Data_13_28, 0);
	if(thisval&(mask<<29))
		putValue(A_ASG_69_0_0_27_Data_13_29, 1);
	else
		putValue(A_ASG_69_0_0_27_Data_13_29, 0);
	if(thisval&(mask<<30))
		putValue(A_ASG_69_0_0_27_Data_13_30, 1);
	else
		putValue(A_ASG_69_0_0_27_Data_13_30, 0);
	if(thisval&(mask<<31))
		putValue(A_ASG_69_0_0_27_Data_13_31, 1);
	else
		putValue(A_ASG_69_0_0_27_Data_13_31, 0);
    A_ASG_69_0_0_27_ArrayDataList[getValue(A_ASG_69_0_0_27_DataIndex)].Param13 = thisval;
}
on envVar A_ASG_69_0_0_27_Data_14_0
{
	byte bitval;
	//thisval steht hier fuer den bitfield-wert, 
	//aus Generierungsgruenden hier keine einheitliche Bezeichnung moeglich.
	dword thisval; // Display2AdditionalInfo2_2
	bitval= getValue(this);
	thisval = getValue(A_ASG_69_0_0_27_Data_14);
	thisval = thisval&~(1<<0)|(bitval<<0);
	putValue(A_ASG_69_0_0_27_Data_14,thisval);
}

on envVar A_ASG_69_0_0_27_Data_14_1
{
	byte bitval;
	//thisval steht hier fuer den bitfield-wert, 
	//aus Generierungsgruenden hier keine einheitliche Bezeichnung moeglich.
	dword thisval; // Display2AdditionalInfo2_2
	bitval= getValue(this);
	thisval = getValue(A_ASG_69_0_0_27_Data_14);
	thisval = thisval&~(1<<1)|(bitval<<1);
	putValue(A_ASG_69_0_0_27_Data_14,thisval);
}

on envVar A_ASG_69_0_0_27_Data_14_2
{
	byte bitval;
	//thisval steht hier fuer den bitfield-wert, 
	//aus Generierungsgruenden hier keine einheitliche Bezeichnung moeglich.
	dword thisval; // Display2AdditionalInfo2_2
	bitval= getValue(this);
	thisval = getValue(A_ASG_69_0_0_27_Data_14);
	thisval = thisval&~(1<<2)|(bitval<<2);
	putValue(A_ASG_69_0_0_27_Data_14,thisval);
}

on envVar A_ASG_69_0_0_27_Data_14_3
{
	byte bitval;
	//thisval steht hier fuer den bitfield-wert, 
	//aus Generierungsgruenden hier keine einheitliche Bezeichnung moeglich.
	dword thisval; // Display2AdditionalInfo2_2
	bitval= getValue(this);
	thisval = getValue(A_ASG_69_0_0_27_Data_14);
	thisval = thisval&~(1<<3)|(bitval<<3);
	putValue(A_ASG_69_0_0_27_Data_14,thisval);
}

on envVar A_ASG_69_0_0_27_Data_14_4
{
	byte bitval;
	//thisval steht hier fuer den bitfield-wert, 
	//aus Generierungsgruenden hier keine einheitliche Bezeichnung moeglich.
	dword thisval; // Display2AdditionalInfo2_2
	bitval= getValue(this);
	thisval = getValue(A_ASG_69_0_0_27_Data_14);
	thisval = thisval&~(1<<4)|(bitval<<4);
	putValue(A_ASG_69_0_0_27_Data_14,thisval);
}

on envVar A_ASG_69_0_0_27_Data_14_5
{
	byte bitval;
	//thisval steht hier fuer den bitfield-wert, 
	//aus Generierungsgruenden hier keine einheitliche Bezeichnung moeglich.
	dword thisval; // Display2AdditionalInfo2_2
	bitval= getValue(this);
	thisval = getValue(A_ASG_69_0_0_27_Data_14);
	thisval = thisval&~(1<<5)|(bitval<<5);
	putValue(A_ASG_69_0_0_27_Data_14,thisval);
}

on envVar A_ASG_69_0_0_27_Data_14_6
{
	byte bitval;
	//thisval steht hier fuer den bitfield-wert, 
	//aus Generierungsgruenden hier keine einheitliche Bezeichnung moeglich.
	dword thisval; // Display2AdditionalInfo2_2
	bitval= getValue(this);
	thisval = getValue(A_ASG_69_0_0_27_Data_14);
	thisval = thisval&~(1<<6)|(bitval<<6);
	putValue(A_ASG_69_0_0_27_Data_14,thisval);
}

on envVar A_ASG_69_0_0_27_Data_14_7
{
	byte bitval;
	//thisval steht hier fuer den bitfield-wert, 
	//aus Generierungsgruenden hier keine einheitliche Bezeichnung moeglich.
	dword thisval; // Display2AdditionalInfo2_2
	bitval= getValue(this);
	thisval = getValue(A_ASG_69_0_0_27_Data_14);
	thisval = thisval&~(1<<7)|(bitval<<7);
	putValue(A_ASG_69_0_0_27_Data_14,thisval);
}

on envVar A_ASG_69_0_0_27_Data_14_8
{
	byte bitval;
	//thisval steht hier fuer den bitfield-wert, 
	//aus Generierungsgruenden hier keine einheitliche Bezeichnung moeglich.
	dword thisval; // Display2AdditionalInfo2_2
	bitval= getValue(this);
	thisval = getValue(A_ASG_69_0_0_27_Data_14);
	thisval = thisval&~(1<<8)|(bitval<<8);
	putValue(A_ASG_69_0_0_27_Data_14,thisval);
}

on envVar A_ASG_69_0_0_27_Data_14_9
{
	byte bitval;
	//thisval steht hier fuer den bitfield-wert, 
	//aus Generierungsgruenden hier keine einheitliche Bezeichnung moeglich.
	dword thisval; // Display2AdditionalInfo2_2
	bitval= getValue(this);
	thisval = getValue(A_ASG_69_0_0_27_Data_14);
	thisval = thisval&~(1<<9)|(bitval<<9);
	putValue(A_ASG_69_0_0_27_Data_14,thisval);
}

on envVar A_ASG_69_0_0_27_Data_14_10
{
	byte bitval;
	//thisval steht hier fuer den bitfield-wert, 
	//aus Generierungsgruenden hier keine einheitliche Bezeichnung moeglich.
	dword thisval; // Display2AdditionalInfo2_2
	bitval= getValue(this);
	thisval = getValue(A_ASG_69_0_0_27_Data_14);
	thisval = thisval&~(1<<10)|(bitval<<10);
	putValue(A_ASG_69_0_0_27_Data_14,thisval);
}

on envVar A_ASG_69_0_0_27_Data_14_11
{
	byte bitval;
	//thisval steht hier fuer den bitfield-wert, 
	//aus Generierungsgruenden hier keine einheitliche Bezeichnung moeglich.
	dword thisval; // Display2AdditionalInfo2_2
	bitval= getValue(this);
	thisval = getValue(A_ASG_69_0_0_27_Data_14);
	thisval = thisval&~(1<<11)|(bitval<<11);
	putValue(A_ASG_69_0_0_27_Data_14,thisval);
}

on envVar A_ASG_69_0_0_27_Data_14_12
{
	byte bitval;
	//thisval steht hier fuer den bitfield-wert, 
	//aus Generierungsgruenden hier keine einheitliche Bezeichnung moeglich.
	dword thisval; // Display2AdditionalInfo2_2
	bitval= getValue(this);
	thisval = getValue(A_ASG_69_0_0_27_Data_14);
	thisval = thisval&~(1<<12)|(bitval<<12);
	putValue(A_ASG_69_0_0_27_Data_14,thisval);
}

on envVar A_ASG_69_0_0_27_Data_14_13
{
	byte bitval;
	//thisval steht hier fuer den bitfield-wert, 
	//aus Generierungsgruenden hier keine einheitliche Bezeichnung moeglich.
	dword thisval; // Display2AdditionalInfo2_2
	bitval= getValue(this);
	thisval = getValue(A_ASG_69_0_0_27_Data_14);
	thisval = thisval&~(1<<13)|(bitval<<13);
	putValue(A_ASG_69_0_0_27_Data_14,thisval);
}

on envVar A_ASG_69_0_0_27_Data_14_14
{
	byte bitval;
	//thisval steht hier fuer den bitfield-wert, 
	//aus Generierungsgruenden hier keine einheitliche Bezeichnung moeglich.
	dword thisval; // Display2AdditionalInfo2_2
	bitval= getValue(this);
	thisval = getValue(A_ASG_69_0_0_27_Data_14);
	thisval = thisval&~(1<<14)|(bitval<<14);
	putValue(A_ASG_69_0_0_27_Data_14,thisval);
}

on envVar A_ASG_69_0_0_27_Data_14_15
{
	byte bitval;
	//thisval steht hier fuer den bitfield-wert, 
	//aus Generierungsgruenden hier keine einheitliche Bezeichnung moeglich.
	dword thisval; // Display2AdditionalInfo2_2
	bitval= getValue(this);
	thisval = getValue(A_ASG_69_0_0_27_Data_14);
	thisval = thisval&~(1<<15)|(bitval<<15);
	putValue(A_ASG_69_0_0_27_Data_14,thisval);
}

on envVar A_ASG_69_0_0_27_Data_14_16
{
	byte bitval;
	//thisval steht hier fuer den bitfield-wert, 
	//aus Generierungsgruenden hier keine einheitliche Bezeichnung moeglich.
	dword thisval; // Display2AdditionalInfo2_2
	bitval= getValue(this);
	thisval = getValue(A_ASG_69_0_0_27_Data_14);
	thisval = thisval&~(1<<16)|(bitval<<16);
	putValue(A_ASG_69_0_0_27_Data_14,thisval);
}

on envVar A_ASG_69_0_0_27_Data_14_17
{
	byte bitval;
	//thisval steht hier fuer den bitfield-wert, 
	//aus Generierungsgruenden hier keine einheitliche Bezeichnung moeglich.
	dword thisval; // Display2AdditionalInfo2_2
	bitval= getValue(this);
	thisval = getValue(A_ASG_69_0_0_27_Data_14);
	thisval = thisval&~(1<<17)|(bitval<<17);
	putValue(A_ASG_69_0_0_27_Data_14,thisval);
}

on envVar A_ASG_69_0_0_27_Data_14_18
{
	byte bitval;
	//thisval steht hier fuer den bitfield-wert, 
	//aus Generierungsgruenden hier keine einheitliche Bezeichnung moeglich.
	dword thisval; // Display2AdditionalInfo2_2
	bitval= getValue(this);
	thisval = getValue(A_ASG_69_0_0_27_Data_14);
	thisval = thisval&~(1<<18)|(bitval<<18);
	putValue(A_ASG_69_0_0_27_Data_14,thisval);
}

on envVar A_ASG_69_0_0_27_Data_14_19
{
	byte bitval;
	//thisval steht hier fuer den bitfield-wert, 
	//aus Generierungsgruenden hier keine einheitliche Bezeichnung moeglich.
	dword thisval; // Display2AdditionalInfo2_2
	bitval= getValue(this);
	thisval = getValue(A_ASG_69_0_0_27_Data_14);
	thisval = thisval&~(1<<19)|(bitval<<19);
	putValue(A_ASG_69_0_0_27_Data_14,thisval);
}

on envVar A_ASG_69_0_0_27_Data_14_20
{
	byte bitval;
	//thisval steht hier fuer den bitfield-wert, 
	//aus Generierungsgruenden hier keine einheitliche Bezeichnung moeglich.
	dword thisval; // Display2AdditionalInfo2_2
	bitval= getValue(this);
	thisval = getValue(A_ASG_69_0_0_27_Data_14);
	thisval = thisval&~(1<<20)|(bitval<<20);
	putValue(A_ASG_69_0_0_27_Data_14,thisval);
}

on envVar A_ASG_69_0_0_27_Data_14_21
{
	byte bitval;
	//thisval steht hier fuer den bitfield-wert, 
	//aus Generierungsgruenden hier keine einheitliche Bezeichnung moeglich.
	dword thisval; // Display2AdditionalInfo2_2
	bitval= getValue(this);
	thisval = getValue(A_ASG_69_0_0_27_Data_14);
	thisval = thisval&~(1<<21)|(bitval<<21);
	putValue(A_ASG_69_0_0_27_Data_14,thisval);
}

on envVar A_ASG_69_0_0_27_Data_14_22
{
	byte bitval;
	//thisval steht hier fuer den bitfield-wert, 
	//aus Generierungsgruenden hier keine einheitliche Bezeichnung moeglich.
	dword thisval; // Display2AdditionalInfo2_2
	bitval= getValue(this);
	thisval = getValue(A_ASG_69_0_0_27_Data_14);
	thisval = thisval&~(1<<22)|(bitval<<22);
	putValue(A_ASG_69_0_0_27_Data_14,thisval);
}

on envVar A_ASG_69_0_0_27_Data_14_23
{
	byte bitval;
	//thisval steht hier fuer den bitfield-wert, 
	//aus Generierungsgruenden hier keine einheitliche Bezeichnung moeglich.
	dword thisval; // Display2AdditionalInfo2_2
	bitval= getValue(this);
	thisval = getValue(A_ASG_69_0_0_27_Data_14);
	thisval = thisval&~(1<<23)|(bitval<<23);
	putValue(A_ASG_69_0_0_27_Data_14,thisval);
}

on envVar A_ASG_69_0_0_27_Data_14_24
{
	byte bitval;
	//thisval steht hier fuer den bitfield-wert, 
	//aus Generierungsgruenden hier keine einheitliche Bezeichnung moeglich.
	dword thisval; // Display2AdditionalInfo2_2
	bitval= getValue(this);
	thisval = getValue(A_ASG_69_0_0_27_Data_14);
	thisval = thisval&~(1<<24)|(bitval<<24);
	putValue(A_ASG_69_0_0_27_Data_14,thisval);
}

on envVar A_ASG_69_0_0_27_Data_14_25
{
	byte bitval;
	//thisval steht hier fuer den bitfield-wert, 
	//aus Generierungsgruenden hier keine einheitliche Bezeichnung moeglich.
	dword thisval; // Display2AdditionalInfo2_2
	bitval= getValue(this);
	thisval = getValue(A_ASG_69_0_0_27_Data_14);
	thisval = thisval&~(1<<25)|(bitval<<25);
	putValue(A_ASG_69_0_0_27_Data_14,thisval);
}

on envVar A_ASG_69_0_0_27_Data_14_26
{
	byte bitval;
	//thisval steht hier fuer den bitfield-wert, 
	//aus Generierungsgruenden hier keine einheitliche Bezeichnung moeglich.
	dword thisval; // Display2AdditionalInfo2_2
	bitval= getValue(this);
	thisval = getValue(A_ASG_69_0_0_27_Data_14);
	thisval = thisval&~(1<<26)|(bitval<<26);
	putValue(A_ASG_69_0_0_27_Data_14,thisval);
}

on envVar A_ASG_69_0_0_27_Data_14_27
{
	byte bitval;
	//thisval steht hier fuer den bitfield-wert, 
	//aus Generierungsgruenden hier keine einheitliche Bezeichnung moeglich.
	dword thisval; // Display2AdditionalInfo2_2
	bitval= getValue(this);
	thisval = getValue(A_ASG_69_0_0_27_Data_14);
	thisval = thisval&~(1<<27)|(bitval<<27);
	putValue(A_ASG_69_0_0_27_Data_14,thisval);
}

on envVar A_ASG_69_0_0_27_Data_14_28
{
	byte bitval;
	//thisval steht hier fuer den bitfield-wert, 
	//aus Generierungsgruenden hier keine einheitliche Bezeichnung moeglich.
	dword thisval; // Display2AdditionalInfo2_2
	bitval= getValue(this);
	thisval = getValue(A_ASG_69_0_0_27_Data_14);
	thisval = thisval&~(1<<28)|(bitval<<28);
	putValue(A_ASG_69_0_0_27_Data_14,thisval);
}

on envVar A_ASG_69_0_0_27_Data_14_29
{
	byte bitval;
	//thisval steht hier fuer den bitfield-wert, 
	//aus Generierungsgruenden hier keine einheitliche Bezeichnung moeglich.
	dword thisval; // Display2AdditionalInfo2_2
	bitval= getValue(this);
	thisval = getValue(A_ASG_69_0_0_27_Data_14);
	thisval = thisval&~(1<<29)|(bitval<<29);
	putValue(A_ASG_69_0_0_27_Data_14,thisval);
}

on envVar A_ASG_69_0_0_27_Data_14
{
	byte superval[665];

	//Update Childvalue (BitField)
	byte mask=0x01;
	int i = 0;
	dword thisval; // Display2AdditionalInfo2_2
	thisval = getValue(this);
	if(thisval&(mask<<0))
		putValue(A_ASG_69_0_0_27_Data_14_0, 1);
	else
		putValue(A_ASG_69_0_0_27_Data_14_0, 0);
	if(thisval&(mask<<1))
		putValue(A_ASG_69_0_0_27_Data_14_1, 1);
	else
		putValue(A_ASG_69_0_0_27_Data_14_1, 0);
	if(thisval&(mask<<2))
		putValue(A_ASG_69_0_0_27_Data_14_2, 1);
	else
		putValue(A_ASG_69_0_0_27_Data_14_2, 0);
	if(thisval&(mask<<3))
		putValue(A_ASG_69_0_0_27_Data_14_3, 1);
	else
		putValue(A_ASG_69_0_0_27_Data_14_3, 0);
	if(thisval&(mask<<4))
		putValue(A_ASG_69_0_0_27_Data_14_4, 1);
	else
		putValue(A_ASG_69_0_0_27_Data_14_4, 0);
	if(thisval&(mask<<5))
		putValue(A_ASG_69_0_0_27_Data_14_5, 1);
	else
		putValue(A_ASG_69_0_0_27_Data_14_5, 0);
	if(thisval&(mask<<6))
		putValue(A_ASG_69_0_0_27_Data_14_6, 1);
	else
		putValue(A_ASG_69_0_0_27_Data_14_6, 0);
	if(thisval&(mask<<7))
		putValue(A_ASG_69_0_0_27_Data_14_7, 1);
	else
		putValue(A_ASG_69_0_0_27_Data_14_7, 0);
	if(thisval&(mask<<8))
		putValue(A_ASG_69_0_0_27_Data_14_8, 1);
	else
		putValue(A_ASG_69_0_0_27_Data_14_8, 0);
	if(thisval&(mask<<9))
		putValue(A_ASG_69_0_0_27_Data_14_9, 1);
	else
		putValue(A_ASG_69_0_0_27_Data_14_9, 0);
	if(thisval&(mask<<10))
		putValue(A_ASG_69_0_0_27_Data_14_10, 1);
	else
		putValue(A_ASG_69_0_0_27_Data_14_10, 0);
	if(thisval&(mask<<11))
		putValue(A_ASG_69_0_0_27_Data_14_11, 1);
	else
		putValue(A_ASG_69_0_0_27_Data_14_11, 0);
	if(thisval&(mask<<12))
		putValue(A_ASG_69_0_0_27_Data_14_12, 1);
	else
		putValue(A_ASG_69_0_0_27_Data_14_12, 0);
	if(thisval&(mask<<13))
		putValue(A_ASG_69_0_0_27_Data_14_13, 1);
	else
		putValue(A_ASG_69_0_0_27_Data_14_13, 0);
	if(thisval&(mask<<14))
		putValue(A_ASG_69_0_0_27_Data_14_14, 1);
	else
		putValue(A_ASG_69_0_0_27_Data_14_14, 0);
	if(thisval&(mask<<15))
		putValue(A_ASG_69_0_0_27_Data_14_15, 1);
	else
		putValue(A_ASG_69_0_0_27_Data_14_15, 0);
	if(thisval&(mask<<16))
		putValue(A_ASG_69_0_0_27_Data_14_16, 1);
	else
		putValue(A_ASG_69_0_0_27_Data_14_16, 0);
	if(thisval&(mask<<17))
		putValue(A_ASG_69_0_0_27_Data_14_17, 1);
	else
		putValue(A_ASG_69_0_0_27_Data_14_17, 0);
	if(thisval&(mask<<18))
		putValue(A_ASG_69_0_0_27_Data_14_18, 1);
	else
		putValue(A_ASG_69_0_0_27_Data_14_18, 0);
	if(thisval&(mask<<19))
		putValue(A_ASG_69_0_0_27_Data_14_19, 1);
	else
		putValue(A_ASG_69_0_0_27_Data_14_19, 0);
	if(thisval&(mask<<20))
		putValue(A_ASG_69_0_0_27_Data_14_20, 1);
	else
		putValue(A_ASG_69_0_0_27_Data_14_20, 0);
	if(thisval&(mask<<21))
		putValue(A_ASG_69_0_0_27_Data_14_21, 1);
	else
		putValue(A_ASG_69_0_0_27_Data_14_21, 0);
	if(thisval&(mask<<22))
		putValue(A_ASG_69_0_0_27_Data_14_22, 1);
	else
		putValue(A_ASG_69_0_0_27_Data_14_22, 0);
	if(thisval&(mask<<23))
		putValue(A_ASG_69_0_0_27_Data_14_23, 1);
	else
		putValue(A_ASG_69_0_0_27_Data_14_23, 0);
	if(thisval&(mask<<24))
		putValue(A_ASG_69_0_0_27_Data_14_24, 1);
	else
		putValue(A_ASG_69_0_0_27_Data_14_24, 0);
	if(thisval&(mask<<25))
		putValue(A_ASG_69_0_0_27_Data_14_25, 1);
	else
		putValue(A_ASG_69_0_0_27_Data_14_25, 0);
	if(thisval&(mask<<26))
		putValue(A_ASG_69_0_0_27_Data_14_26, 1);
	else
		putValue(A_ASG_69_0_0_27_Data_14_26, 0);
	if(thisval&(mask<<27))
		putValue(A_ASG_69_0_0_27_Data_14_27, 1);
	else
		putValue(A_ASG_69_0_0_27_Data_14_27, 0);
	if(thisval&(mask<<28))
		putValue(A_ASG_69_0_0_27_Data_14_28, 1);
	else
		putValue(A_ASG_69_0_0_27_Data_14_28, 0);
	if(thisval&(mask<<29))
		putValue(A_ASG_69_0_0_27_Data_14_29, 1);
	else
		putValue(A_ASG_69_0_0_27_Data_14_29, 0);
    A_ASG_69_0_0_27_ArrayDataList[getValue(A_ASG_69_0_0_27_DataIndex)].Param14 = thisval;
}
on envVar A_ASG_69_0_0_27_Data_15_0
{
	byte bitval;
	//thisval steht hier fuer den bitfield-wert, 
	//aus Generierungsgruenden hier keine einheitliche Bezeichnung moeglich.
	dword thisval; // Display3MainSelection
	bitval= getValue(this);
	thisval = getValue(A_ASG_69_0_0_27_Data_15);
	thisval = thisval&~(1<<0)|(bitval<<0);
	putValue(A_ASG_69_0_0_27_Data_15,thisval);
}

on envVar A_ASG_69_0_0_27_Data_15_1
{
	byte bitval;
	//thisval steht hier fuer den bitfield-wert, 
	//aus Generierungsgruenden hier keine einheitliche Bezeichnung moeglich.
	dword thisval; // Display3MainSelection
	bitval= getValue(this);
	thisval = getValue(A_ASG_69_0_0_27_Data_15);
	thisval = thisval&~(1<<1)|(bitval<<1);
	putValue(A_ASG_69_0_0_27_Data_15,thisval);
}

on envVar A_ASG_69_0_0_27_Data_15_2
{
	byte bitval;
	//thisval steht hier fuer den bitfield-wert, 
	//aus Generierungsgruenden hier keine einheitliche Bezeichnung moeglich.
	dword thisval; // Display3MainSelection
	bitval= getValue(this);
	thisval = getValue(A_ASG_69_0_0_27_Data_15);
	thisval = thisval&~(1<<2)|(bitval<<2);
	putValue(A_ASG_69_0_0_27_Data_15,thisval);
}

on envVar A_ASG_69_0_0_27_Data_15_3
{
	byte bitval;
	//thisval steht hier fuer den bitfield-wert, 
	//aus Generierungsgruenden hier keine einheitliche Bezeichnung moeglich.
	dword thisval; // Display3MainSelection
	bitval= getValue(this);
	thisval = getValue(A_ASG_69_0_0_27_Data_15);
	thisval = thisval&~(1<<3)|(bitval<<3);
	putValue(A_ASG_69_0_0_27_Data_15,thisval);
}

on envVar A_ASG_69_0_0_27_Data_15_4
{
	byte bitval;
	//thisval steht hier fuer den bitfield-wert, 
	//aus Generierungsgruenden hier keine einheitliche Bezeichnung moeglich.
	dword thisval; // Display3MainSelection
	bitval= getValue(this);
	thisval = getValue(A_ASG_69_0_0_27_Data_15);
	thisval = thisval&~(1<<4)|(bitval<<4);
	putValue(A_ASG_69_0_0_27_Data_15,thisval);
}

on envVar A_ASG_69_0_0_27_Data_15_5
{
	byte bitval;
	//thisval steht hier fuer den bitfield-wert, 
	//aus Generierungsgruenden hier keine einheitliche Bezeichnung moeglich.
	dword thisval; // Display3MainSelection
	bitval= getValue(this);
	thisval = getValue(A_ASG_69_0_0_27_Data_15);
	thisval = thisval&~(1<<5)|(bitval<<5);
	putValue(A_ASG_69_0_0_27_Data_15,thisval);
}

on envVar A_ASG_69_0_0_27_Data_15_6
{
	byte bitval;
	//thisval steht hier fuer den bitfield-wert, 
	//aus Generierungsgruenden hier keine einheitliche Bezeichnung moeglich.
	dword thisval; // Display3MainSelection
	bitval= getValue(this);
	thisval = getValue(A_ASG_69_0_0_27_Data_15);
	thisval = thisval&~(1<<6)|(bitval<<6);
	putValue(A_ASG_69_0_0_27_Data_15,thisval);
}

on envVar A_ASG_69_0_0_27_Data_15_7
{
	byte bitval;
	//thisval steht hier fuer den bitfield-wert, 
	//aus Generierungsgruenden hier keine einheitliche Bezeichnung moeglich.
	dword thisval; // Display3MainSelection
	bitval= getValue(this);
	thisval = getValue(A_ASG_69_0_0_27_Data_15);
	thisval = thisval&~(1<<7)|(bitval<<7);
	putValue(A_ASG_69_0_0_27_Data_15,thisval);
}

on envVar A_ASG_69_0_0_27_Data_15_8
{
	byte bitval;
	//thisval steht hier fuer den bitfield-wert, 
	//aus Generierungsgruenden hier keine einheitliche Bezeichnung moeglich.
	dword thisval; // Display3MainSelection
	bitval= getValue(this);
	thisval = getValue(A_ASG_69_0_0_27_Data_15);
	thisval = thisval&~(1<<8)|(bitval<<8);
	putValue(A_ASG_69_0_0_27_Data_15,thisval);
}

on envVar A_ASG_69_0_0_27_Data_15_9
{
	byte bitval;
	//thisval steht hier fuer den bitfield-wert, 
	//aus Generierungsgruenden hier keine einheitliche Bezeichnung moeglich.
	dword thisval; // Display3MainSelection
	bitval= getValue(this);
	thisval = getValue(A_ASG_69_0_0_27_Data_15);
	thisval = thisval&~(1<<9)|(bitval<<9);
	putValue(A_ASG_69_0_0_27_Data_15,thisval);
}

on envVar A_ASG_69_0_0_27_Data_15_10
{
	byte bitval;
	//thisval steht hier fuer den bitfield-wert, 
	//aus Generierungsgruenden hier keine einheitliche Bezeichnung moeglich.
	dword thisval; // Display3MainSelection
	bitval= getValue(this);
	thisval = getValue(A_ASG_69_0_0_27_Data_15);
	thisval = thisval&~(1<<10)|(bitval<<10);
	putValue(A_ASG_69_0_0_27_Data_15,thisval);
}

on envVar A_ASG_69_0_0_27_Data_15_11
{
	byte bitval;
	//thisval steht hier fuer den bitfield-wert, 
	//aus Generierungsgruenden hier keine einheitliche Bezeichnung moeglich.
	dword thisval; // Display3MainSelection
	bitval= getValue(this);
	thisval = getValue(A_ASG_69_0_0_27_Data_15);
	thisval = thisval&~(1<<11)|(bitval<<11);
	putValue(A_ASG_69_0_0_27_Data_15,thisval);
}

on envVar A_ASG_69_0_0_27_Data_15_12
{
	byte bitval;
	//thisval steht hier fuer den bitfield-wert, 
	//aus Generierungsgruenden hier keine einheitliche Bezeichnung moeglich.
	dword thisval; // Display3MainSelection
	bitval= getValue(this);
	thisval = getValue(A_ASG_69_0_0_27_Data_15);
	thisval = thisval&~(1<<12)|(bitval<<12);
	putValue(A_ASG_69_0_0_27_Data_15,thisval);
}

on envVar A_ASG_69_0_0_27_Data_15_13
{
	byte bitval;
	//thisval steht hier fuer den bitfield-wert, 
	//aus Generierungsgruenden hier keine einheitliche Bezeichnung moeglich.
	dword thisval; // Display3MainSelection
	bitval= getValue(this);
	thisval = getValue(A_ASG_69_0_0_27_Data_15);
	thisval = thisval&~(1<<13)|(bitval<<13);
	putValue(A_ASG_69_0_0_27_Data_15,thisval);
}

on envVar A_ASG_69_0_0_27_Data_15_14
{
	byte bitval;
	//thisval steht hier fuer den bitfield-wert, 
	//aus Generierungsgruenden hier keine einheitliche Bezeichnung moeglich.
	dword thisval; // Display3MainSelection
	bitval= getValue(this);
	thisval = getValue(A_ASG_69_0_0_27_Data_15);
	thisval = thisval&~(1<<14)|(bitval<<14);
	putValue(A_ASG_69_0_0_27_Data_15,thisval);
}

on envVar A_ASG_69_0_0_27_Data_15_15
{
	byte bitval;
	//thisval steht hier fuer den bitfield-wert, 
	//aus Generierungsgruenden hier keine einheitliche Bezeichnung moeglich.
	dword thisval; // Display3MainSelection
	bitval= getValue(this);
	thisval = getValue(A_ASG_69_0_0_27_Data_15);
	thisval = thisval&~(1<<15)|(bitval<<15);
	putValue(A_ASG_69_0_0_27_Data_15,thisval);
}

on envVar A_ASG_69_0_0_27_Data_15_16
{
	byte bitval;
	//thisval steht hier fuer den bitfield-wert, 
	//aus Generierungsgruenden hier keine einheitliche Bezeichnung moeglich.
	dword thisval; // Display3MainSelection
	bitval= getValue(this);
	thisval = getValue(A_ASG_69_0_0_27_Data_15);
	thisval = thisval&~(1<<16)|(bitval<<16);
	putValue(A_ASG_69_0_0_27_Data_15,thisval);
}

on envVar A_ASG_69_0_0_27_Data_15_17
{
	byte bitval;
	//thisval steht hier fuer den bitfield-wert, 
	//aus Generierungsgruenden hier keine einheitliche Bezeichnung moeglich.
	dword thisval; // Display3MainSelection
	bitval= getValue(this);
	thisval = getValue(A_ASG_69_0_0_27_Data_15);
	thisval = thisval&~(1<<17)|(bitval<<17);
	putValue(A_ASG_69_0_0_27_Data_15,thisval);
}

on envVar A_ASG_69_0_0_27_Data_15_18
{
	byte bitval;
	//thisval steht hier fuer den bitfield-wert, 
	//aus Generierungsgruenden hier keine einheitliche Bezeichnung moeglich.
	dword thisval; // Display3MainSelection
	bitval= getValue(this);
	thisval = getValue(A_ASG_69_0_0_27_Data_15);
	thisval = thisval&~(1<<18)|(bitval<<18);
	putValue(A_ASG_69_0_0_27_Data_15,thisval);
}

on envVar A_ASG_69_0_0_27_Data_15_19
{
	byte bitval;
	//thisval steht hier fuer den bitfield-wert, 
	//aus Generierungsgruenden hier keine einheitliche Bezeichnung moeglich.
	dword thisval; // Display3MainSelection
	bitval= getValue(this);
	thisval = getValue(A_ASG_69_0_0_27_Data_15);
	thisval = thisval&~(1<<19)|(bitval<<19);
	putValue(A_ASG_69_0_0_27_Data_15,thisval);
}

on envVar A_ASG_69_0_0_27_Data_15_20
{
	byte bitval;
	//thisval steht hier fuer den bitfield-wert, 
	//aus Generierungsgruenden hier keine einheitliche Bezeichnung moeglich.
	dword thisval; // Display3MainSelection
	bitval= getValue(this);
	thisval = getValue(A_ASG_69_0_0_27_Data_15);
	thisval = thisval&~(1<<20)|(bitval<<20);
	putValue(A_ASG_69_0_0_27_Data_15,thisval);
}

on envVar A_ASG_69_0_0_27_Data_15_21
{
	byte bitval;
	//thisval steht hier fuer den bitfield-wert, 
	//aus Generierungsgruenden hier keine einheitliche Bezeichnung moeglich.
	dword thisval; // Display3MainSelection
	bitval= getValue(this);
	thisval = getValue(A_ASG_69_0_0_27_Data_15);
	thisval = thisval&~(1<<21)|(bitval<<21);
	putValue(A_ASG_69_0_0_27_Data_15,thisval);
}

on envVar A_ASG_69_0_0_27_Data_15_22
{
	byte bitval;
	//thisval steht hier fuer den bitfield-wert, 
	//aus Generierungsgruenden hier keine einheitliche Bezeichnung moeglich.
	dword thisval; // Display3MainSelection
	bitval= getValue(this);
	thisval = getValue(A_ASG_69_0_0_27_Data_15);
	thisval = thisval&~(1<<22)|(bitval<<22);
	putValue(A_ASG_69_0_0_27_Data_15,thisval);
}

on envVar A_ASG_69_0_0_27_Data_15_23
{
	byte bitval;
	//thisval steht hier fuer den bitfield-wert, 
	//aus Generierungsgruenden hier keine einheitliche Bezeichnung moeglich.
	dword thisval; // Display3MainSelection
	bitval= getValue(this);
	thisval = getValue(A_ASG_69_0_0_27_Data_15);
	thisval = thisval&~(1<<23)|(bitval<<23);
	putValue(A_ASG_69_0_0_27_Data_15,thisval);
}

on envVar A_ASG_69_0_0_27_Data_15_24
{
	byte bitval;
	//thisval steht hier fuer den bitfield-wert, 
	//aus Generierungsgruenden hier keine einheitliche Bezeichnung moeglich.
	dword thisval; // Display3MainSelection
	bitval= getValue(this);
	thisval = getValue(A_ASG_69_0_0_27_Data_15);
	thisval = thisval&~(1<<24)|(bitval<<24);
	putValue(A_ASG_69_0_0_27_Data_15,thisval);
}

on envVar A_ASG_69_0_0_27_Data_15_25
{
	byte bitval;
	//thisval steht hier fuer den bitfield-wert, 
	//aus Generierungsgruenden hier keine einheitliche Bezeichnung moeglich.
	dword thisval; // Display3MainSelection
	bitval= getValue(this);
	thisval = getValue(A_ASG_69_0_0_27_Data_15);
	thisval = thisval&~(1<<25)|(bitval<<25);
	putValue(A_ASG_69_0_0_27_Data_15,thisval);
}

on envVar A_ASG_69_0_0_27_Data_15_26
{
	byte bitval;
	//thisval steht hier fuer den bitfield-wert, 
	//aus Generierungsgruenden hier keine einheitliche Bezeichnung moeglich.
	dword thisval; // Display3MainSelection
	bitval= getValue(this);
	thisval = getValue(A_ASG_69_0_0_27_Data_15);
	thisval = thisval&~(1<<26)|(bitval<<26);
	putValue(A_ASG_69_0_0_27_Data_15,thisval);
}

on envVar A_ASG_69_0_0_27_Data_15_27
{
	byte bitval;
	//thisval steht hier fuer den bitfield-wert, 
	//aus Generierungsgruenden hier keine einheitliche Bezeichnung moeglich.
	dword thisval; // Display3MainSelection
	bitval= getValue(this);
	thisval = getValue(A_ASG_69_0_0_27_Data_15);
	thisval = thisval&~(1<<27)|(bitval<<27);
	putValue(A_ASG_69_0_0_27_Data_15,thisval);
}

on envVar A_ASG_69_0_0_27_Data_15
{
	byte superval[665];

	//Update Childvalue (BitField)
	byte mask=0x01;
	int i = 0;
	dword thisval; // Display3MainSelection
	thisval = getValue(this);
	if(thisval&(mask<<0))
		putValue(A_ASG_69_0_0_27_Data_15_0, 1);
	else
		putValue(A_ASG_69_0_0_27_Data_15_0, 0);
	if(thisval&(mask<<1))
		putValue(A_ASG_69_0_0_27_Data_15_1, 1);
	else
		putValue(A_ASG_69_0_0_27_Data_15_1, 0);
	if(thisval&(mask<<2))
		putValue(A_ASG_69_0_0_27_Data_15_2, 1);
	else
		putValue(A_ASG_69_0_0_27_Data_15_2, 0);
	if(thisval&(mask<<3))
		putValue(A_ASG_69_0_0_27_Data_15_3, 1);
	else
		putValue(A_ASG_69_0_0_27_Data_15_3, 0);
	if(thisval&(mask<<4))
		putValue(A_ASG_69_0_0_27_Data_15_4, 1);
	else
		putValue(A_ASG_69_0_0_27_Data_15_4, 0);
	if(thisval&(mask<<5))
		putValue(A_ASG_69_0_0_27_Data_15_5, 1);
	else
		putValue(A_ASG_69_0_0_27_Data_15_5, 0);
	if(thisval&(mask<<6))
		putValue(A_ASG_69_0_0_27_Data_15_6, 1);
	else
		putValue(A_ASG_69_0_0_27_Data_15_6, 0);
	if(thisval&(mask<<7))
		putValue(A_ASG_69_0_0_27_Data_15_7, 1);
	else
		putValue(A_ASG_69_0_0_27_Data_15_7, 0);
	if(thisval&(mask<<8))
		putValue(A_ASG_69_0_0_27_Data_15_8, 1);
	else
		putValue(A_ASG_69_0_0_27_Data_15_8, 0);
	if(thisval&(mask<<9))
		putValue(A_ASG_69_0_0_27_Data_15_9, 1);
	else
		putValue(A_ASG_69_0_0_27_Data_15_9, 0);
	if(thisval&(mask<<10))
		putValue(A_ASG_69_0_0_27_Data_15_10, 1);
	else
		putValue(A_ASG_69_0_0_27_Data_15_10, 0);
	if(thisval&(mask<<11))
		putValue(A_ASG_69_0_0_27_Data_15_11, 1);
	else
		putValue(A_ASG_69_0_0_27_Data_15_11, 0);
	if(thisval&(mask<<12))
		putValue(A_ASG_69_0_0_27_Data_15_12, 1);
	else
		putValue(A_ASG_69_0_0_27_Data_15_12, 0);
	if(thisval&(mask<<13))
		putValue(A_ASG_69_0_0_27_Data_15_13, 1);
	else
		putValue(A_ASG_69_0_0_27_Data_15_13, 0);
	if(thisval&(mask<<14))
		putValue(A_ASG_69_0_0_27_Data_15_14, 1);
	else
		putValue(A_ASG_69_0_0_27_Data_15_14, 0);
	if(thisval&(mask<<15))
		putValue(A_ASG_69_0_0_27_Data_15_15, 1);
	else
		putValue(A_ASG_69_0_0_27_Data_15_15, 0);
	if(thisval&(mask<<16))
		putValue(A_ASG_69_0_0_27_Data_15_16, 1);
	else
		putValue(A_ASG_69_0_0_27_Data_15_16, 0);
	if(thisval&(mask<<17))
		putValue(A_ASG_69_0_0_27_Data_15_17, 1);
	else
		putValue(A_ASG_69_0_0_27_Data_15_17, 0);
	if(thisval&(mask<<18))
		putValue(A_ASG_69_0_0_27_Data_15_18, 1);
	else
		putValue(A_ASG_69_0_0_27_Data_15_18, 0);
	if(thisval&(mask<<19))
		putValue(A_ASG_69_0_0_27_Data_15_19, 1);
	else
		putValue(A_ASG_69_0_0_27_Data_15_19, 0);
	if(thisval&(mask<<20))
		putValue(A_ASG_69_0_0_27_Data_15_20, 1);
	else
		putValue(A_ASG_69_0_0_27_Data_15_20, 0);
	if(thisval&(mask<<21))
		putValue(A_ASG_69_0_0_27_Data_15_21, 1);
	else
		putValue(A_ASG_69_0_0_27_Data_15_21, 0);
	if(thisval&(mask<<22))
		putValue(A_ASG_69_0_0_27_Data_15_22, 1);
	else
		putValue(A_ASG_69_0_0_27_Data_15_22, 0);
	if(thisval&(mask<<23))
		putValue(A_ASG_69_0_0_27_Data_15_23, 1);
	else
		putValue(A_ASG_69_0_0_27_Data_15_23, 0);
	if(thisval&(mask<<24))
		putValue(A_ASG_69_0_0_27_Data_15_24, 1);
	else
		putValue(A_ASG_69_0_0_27_Data_15_24, 0);
	if(thisval&(mask<<25))
		putValue(A_ASG_69_0_0_27_Data_15_25, 1);
	else
		putValue(A_ASG_69_0_0_27_Data_15_25, 0);
	if(thisval&(mask<<26))
		putValue(A_ASG_69_0_0_27_Data_15_26, 1);
	else
		putValue(A_ASG_69_0_0_27_Data_15_26, 0);
	if(thisval&(mask<<27))
		putValue(A_ASG_69_0_0_27_Data_15_27, 1);
	else
		putValue(A_ASG_69_0_0_27_Data_15_27, 0);
    A_ASG_69_0_0_27_ArrayDataList[getValue(A_ASG_69_0_0_27_DataIndex)].Param15 = thisval;
}
on envVar A_ASG_69_0_0_27_Data_16_0
{
	byte bitval;
	//thisval steht hier fuer den bitfield-wert, 
	//aus Generierungsgruenden hier keine einheitliche Bezeichnung moeglich.
	dword thisval; // Display3AdditionalInfo1_1
	bitval= getValue(this);
	thisval = getValue(A_ASG_69_0_0_27_Data_16);
	thisval = thisval&~(1<<0)|(bitval<<0);
	putValue(A_ASG_69_0_0_27_Data_16,thisval);
}

on envVar A_ASG_69_0_0_27_Data_16_1
{
	byte bitval;
	//thisval steht hier fuer den bitfield-wert, 
	//aus Generierungsgruenden hier keine einheitliche Bezeichnung moeglich.
	dword thisval; // Display3AdditionalInfo1_1
	bitval= getValue(this);
	thisval = getValue(A_ASG_69_0_0_27_Data_16);
	thisval = thisval&~(1<<1)|(bitval<<1);
	putValue(A_ASG_69_0_0_27_Data_16,thisval);
}

on envVar A_ASG_69_0_0_27_Data_16_2
{
	byte bitval;
	//thisval steht hier fuer den bitfield-wert, 
	//aus Generierungsgruenden hier keine einheitliche Bezeichnung moeglich.
	dword thisval; // Display3AdditionalInfo1_1
	bitval= getValue(this);
	thisval = getValue(A_ASG_69_0_0_27_Data_16);
	thisval = thisval&~(1<<2)|(bitval<<2);
	putValue(A_ASG_69_0_0_27_Data_16,thisval);
}

on envVar A_ASG_69_0_0_27_Data_16_3
{
	byte bitval;
	//thisval steht hier fuer den bitfield-wert, 
	//aus Generierungsgruenden hier keine einheitliche Bezeichnung moeglich.
	dword thisval; // Display3AdditionalInfo1_1
	bitval= getValue(this);
	thisval = getValue(A_ASG_69_0_0_27_Data_16);
	thisval = thisval&~(1<<3)|(bitval<<3);
	putValue(A_ASG_69_0_0_27_Data_16,thisval);
}

on envVar A_ASG_69_0_0_27_Data_16_4
{
	byte bitval;
	//thisval steht hier fuer den bitfield-wert, 
	//aus Generierungsgruenden hier keine einheitliche Bezeichnung moeglich.
	dword thisval; // Display3AdditionalInfo1_1
	bitval= getValue(this);
	thisval = getValue(A_ASG_69_0_0_27_Data_16);
	thisval = thisval&~(1<<4)|(bitval<<4);
	putValue(A_ASG_69_0_0_27_Data_16,thisval);
}

on envVar A_ASG_69_0_0_27_Data_16_5
{
	byte bitval;
	//thisval steht hier fuer den bitfield-wert, 
	//aus Generierungsgruenden hier keine einheitliche Bezeichnung moeglich.
	dword thisval; // Display3AdditionalInfo1_1
	bitval= getValue(this);
	thisval = getValue(A_ASG_69_0_0_27_Data_16);
	thisval = thisval&~(1<<5)|(bitval<<5);
	putValue(A_ASG_69_0_0_27_Data_16,thisval);
}

on envVar A_ASG_69_0_0_27_Data_16_6
{
	byte bitval;
	//thisval steht hier fuer den bitfield-wert, 
	//aus Generierungsgruenden hier keine einheitliche Bezeichnung moeglich.
	dword thisval; // Display3AdditionalInfo1_1
	bitval= getValue(this);
	thisval = getValue(A_ASG_69_0_0_27_Data_16);
	thisval = thisval&~(1<<6)|(bitval<<6);
	putValue(A_ASG_69_0_0_27_Data_16,thisval);
}

on envVar A_ASG_69_0_0_27_Data_16_7
{
	byte bitval;
	//thisval steht hier fuer den bitfield-wert, 
	//aus Generierungsgruenden hier keine einheitliche Bezeichnung moeglich.
	dword thisval; // Display3AdditionalInfo1_1
	bitval= getValue(this);
	thisval = getValue(A_ASG_69_0_0_27_Data_16);
	thisval = thisval&~(1<<7)|(bitval<<7);
	putValue(A_ASG_69_0_0_27_Data_16,thisval);
}

on envVar A_ASG_69_0_0_27_Data_16_8
{
	byte bitval;
	//thisval steht hier fuer den bitfield-wert, 
	//aus Generierungsgruenden hier keine einheitliche Bezeichnung moeglich.
	dword thisval; // Display3AdditionalInfo1_1
	bitval= getValue(this);
	thisval = getValue(A_ASG_69_0_0_27_Data_16);
	thisval = thisval&~(1<<8)|(bitval<<8);
	putValue(A_ASG_69_0_0_27_Data_16,thisval);
}

on envVar A_ASG_69_0_0_27_Data_16_9
{
	byte bitval;
	//thisval steht hier fuer den bitfield-wert, 
	//aus Generierungsgruenden hier keine einheitliche Bezeichnung moeglich.
	dword thisval; // Display3AdditionalInfo1_1
	bitval= getValue(this);
	thisval = getValue(A_ASG_69_0_0_27_Data_16);
	thisval = thisval&~(1<<9)|(bitval<<9);
	putValue(A_ASG_69_0_0_27_Data_16,thisval);
}

on envVar A_ASG_69_0_0_27_Data_16_10
{
	byte bitval;
	//thisval steht hier fuer den bitfield-wert, 
	//aus Generierungsgruenden hier keine einheitliche Bezeichnung moeglich.
	dword thisval; // Display3AdditionalInfo1_1
	bitval= getValue(this);
	thisval = getValue(A_ASG_69_0_0_27_Data_16);
	thisval = thisval&~(1<<10)|(bitval<<10);
	putValue(A_ASG_69_0_0_27_Data_16,thisval);
}

on envVar A_ASG_69_0_0_27_Data_16_11
{
	byte bitval;
	//thisval steht hier fuer den bitfield-wert, 
	//aus Generierungsgruenden hier keine einheitliche Bezeichnung moeglich.
	dword thisval; // Display3AdditionalInfo1_1
	bitval= getValue(this);
	thisval = getValue(A_ASG_69_0_0_27_Data_16);
	thisval = thisval&~(1<<11)|(bitval<<11);
	putValue(A_ASG_69_0_0_27_Data_16,thisval);
}

on envVar A_ASG_69_0_0_27_Data_16_12
{
	byte bitval;
	//thisval steht hier fuer den bitfield-wert, 
	//aus Generierungsgruenden hier keine einheitliche Bezeichnung moeglich.
	dword thisval; // Display3AdditionalInfo1_1
	bitval= getValue(this);
	thisval = getValue(A_ASG_69_0_0_27_Data_16);
	thisval = thisval&~(1<<12)|(bitval<<12);
	putValue(A_ASG_69_0_0_27_Data_16,thisval);
}

on envVar A_ASG_69_0_0_27_Data_16_13
{
	byte bitval;
	//thisval steht hier fuer den bitfield-wert, 
	//aus Generierungsgruenden hier keine einheitliche Bezeichnung moeglich.
	dword thisval; // Display3AdditionalInfo1_1
	bitval= getValue(this);
	thisval = getValue(A_ASG_69_0_0_27_Data_16);
	thisval = thisval&~(1<<13)|(bitval<<13);
	putValue(A_ASG_69_0_0_27_Data_16,thisval);
}

on envVar A_ASG_69_0_0_27_Data_16_14
{
	byte bitval;
	//thisval steht hier fuer den bitfield-wert, 
	//aus Generierungsgruenden hier keine einheitliche Bezeichnung moeglich.
	dword thisval; // Display3AdditionalInfo1_1
	bitval= getValue(this);
	thisval = getValue(A_ASG_69_0_0_27_Data_16);
	thisval = thisval&~(1<<14)|(bitval<<14);
	putValue(A_ASG_69_0_0_27_Data_16,thisval);
}

on envVar A_ASG_69_0_0_27_Data_16_15
{
	byte bitval;
	//thisval steht hier fuer den bitfield-wert, 
	//aus Generierungsgruenden hier keine einheitliche Bezeichnung moeglich.
	dword thisval; // Display3AdditionalInfo1_1
	bitval= getValue(this);
	thisval = getValue(A_ASG_69_0_0_27_Data_16);
	thisval = thisval&~(1<<15)|(bitval<<15);
	putValue(A_ASG_69_0_0_27_Data_16,thisval);
}

on envVar A_ASG_69_0_0_27_Data_16_16
{
	byte bitval;
	//thisval steht hier fuer den bitfield-wert, 
	//aus Generierungsgruenden hier keine einheitliche Bezeichnung moeglich.
	dword thisval; // Display3AdditionalInfo1_1
	bitval= getValue(this);
	thisval = getValue(A_ASG_69_0_0_27_Data_16);
	thisval = thisval&~(1<<16)|(bitval<<16);
	putValue(A_ASG_69_0_0_27_Data_16,thisval);
}

on envVar A_ASG_69_0_0_27_Data_16_17
{
	byte bitval;
	//thisval steht hier fuer den bitfield-wert, 
	//aus Generierungsgruenden hier keine einheitliche Bezeichnung moeglich.
	dword thisval; // Display3AdditionalInfo1_1
	bitval= getValue(this);
	thisval = getValue(A_ASG_69_0_0_27_Data_16);
	thisval = thisval&~(1<<17)|(bitval<<17);
	putValue(A_ASG_69_0_0_27_Data_16,thisval);
}

on envVar A_ASG_69_0_0_27_Data_16_18
{
	byte bitval;
	//thisval steht hier fuer den bitfield-wert, 
	//aus Generierungsgruenden hier keine einheitliche Bezeichnung moeglich.
	dword thisval; // Display3AdditionalInfo1_1
	bitval= getValue(this);
	thisval = getValue(A_ASG_69_0_0_27_Data_16);
	thisval = thisval&~(1<<18)|(bitval<<18);
	putValue(A_ASG_69_0_0_27_Data_16,thisval);
}

on envVar A_ASG_69_0_0_27_Data_16_19
{
	byte bitval;
	//thisval steht hier fuer den bitfield-wert, 
	//aus Generierungsgruenden hier keine einheitliche Bezeichnung moeglich.
	dword thisval; // Display3AdditionalInfo1_1
	bitval= getValue(this);
	thisval = getValue(A_ASG_69_0_0_27_Data_16);
	thisval = thisval&~(1<<19)|(bitval<<19);
	putValue(A_ASG_69_0_0_27_Data_16,thisval);
}

on envVar A_ASG_69_0_0_27_Data_16_20
{
	byte bitval;
	//thisval steht hier fuer den bitfield-wert, 
	//aus Generierungsgruenden hier keine einheitliche Bezeichnung moeglich.
	dword thisval; // Display3AdditionalInfo1_1
	bitval= getValue(this);
	thisval = getValue(A_ASG_69_0_0_27_Data_16);
	thisval = thisval&~(1<<20)|(bitval<<20);
	putValue(A_ASG_69_0_0_27_Data_16,thisval);
}

on envVar A_ASG_69_0_0_27_Data_16_21
{
	byte bitval;
	//thisval steht hier fuer den bitfield-wert, 
	//aus Generierungsgruenden hier keine einheitliche Bezeichnung moeglich.
	dword thisval; // Display3AdditionalInfo1_1
	bitval= getValue(this);
	thisval = getValue(A_ASG_69_0_0_27_Data_16);
	thisval = thisval&~(1<<21)|(bitval<<21);
	putValue(A_ASG_69_0_0_27_Data_16,thisval);
}

on envVar A_ASG_69_0_0_27_Data_16_22
{
	byte bitval;
	//thisval steht hier fuer den bitfield-wert, 
	//aus Generierungsgruenden hier keine einheitliche Bezeichnung moeglich.
	dword thisval; // Display3AdditionalInfo1_1
	bitval= getValue(this);
	thisval = getValue(A_ASG_69_0_0_27_Data_16);
	thisval = thisval&~(1<<22)|(bitval<<22);
	putValue(A_ASG_69_0_0_27_Data_16,thisval);
}

on envVar A_ASG_69_0_0_27_Data_16_23
{
	byte bitval;
	//thisval steht hier fuer den bitfield-wert, 
	//aus Generierungsgruenden hier keine einheitliche Bezeichnung moeglich.
	dword thisval; // Display3AdditionalInfo1_1
	bitval= getValue(this);
	thisval = getValue(A_ASG_69_0_0_27_Data_16);
	thisval = thisval&~(1<<23)|(bitval<<23);
	putValue(A_ASG_69_0_0_27_Data_16,thisval);
}

on envVar A_ASG_69_0_0_27_Data_16_24
{
	byte bitval;
	//thisval steht hier fuer den bitfield-wert, 
	//aus Generierungsgruenden hier keine einheitliche Bezeichnung moeglich.
	dword thisval; // Display3AdditionalInfo1_1
	bitval= getValue(this);
	thisval = getValue(A_ASG_69_0_0_27_Data_16);
	thisval = thisval&~(1<<24)|(bitval<<24);
	putValue(A_ASG_69_0_0_27_Data_16,thisval);
}

on envVar A_ASG_69_0_0_27_Data_16_25
{
	byte bitval;
	//thisval steht hier fuer den bitfield-wert, 
	//aus Generierungsgruenden hier keine einheitliche Bezeichnung moeglich.
	dword thisval; // Display3AdditionalInfo1_1
	bitval= getValue(this);
	thisval = getValue(A_ASG_69_0_0_27_Data_16);
	thisval = thisval&~(1<<25)|(bitval<<25);
	putValue(A_ASG_69_0_0_27_Data_16,thisval);
}

on envVar A_ASG_69_0_0_27_Data_16_26
{
	byte bitval;
	//thisval steht hier fuer den bitfield-wert, 
	//aus Generierungsgruenden hier keine einheitliche Bezeichnung moeglich.
	dword thisval; // Display3AdditionalInfo1_1
	bitval= getValue(this);
	thisval = getValue(A_ASG_69_0_0_27_Data_16);
	thisval = thisval&~(1<<26)|(bitval<<26);
	putValue(A_ASG_69_0_0_27_Data_16,thisval);
}

on envVar A_ASG_69_0_0_27_Data_16_27
{
	byte bitval;
	//thisval steht hier fuer den bitfield-wert, 
	//aus Generierungsgruenden hier keine einheitliche Bezeichnung moeglich.
	dword thisval; // Display3AdditionalInfo1_1
	bitval= getValue(this);
	thisval = getValue(A_ASG_69_0_0_27_Data_16);
	thisval = thisval&~(1<<27)|(bitval<<27);
	putValue(A_ASG_69_0_0_27_Data_16,thisval);
}

on envVar A_ASG_69_0_0_27_Data_16_28
{
	byte bitval;
	//thisval steht hier fuer den bitfield-wert, 
	//aus Generierungsgruenden hier keine einheitliche Bezeichnung moeglich.
	dword thisval; // Display3AdditionalInfo1_1
	bitval= getValue(this);
	thisval = getValue(A_ASG_69_0_0_27_Data_16);
	thisval = thisval&~(1<<28)|(bitval<<28);
	putValue(A_ASG_69_0_0_27_Data_16,thisval);
}

on envVar A_ASG_69_0_0_27_Data_16_29
{
	byte bitval;
	//thisval steht hier fuer den bitfield-wert, 
	//aus Generierungsgruenden hier keine einheitliche Bezeichnung moeglich.
	dword thisval; // Display3AdditionalInfo1_1
	bitval= getValue(this);
	thisval = getValue(A_ASG_69_0_0_27_Data_16);
	thisval = thisval&~(1<<29)|(bitval<<29);
	putValue(A_ASG_69_0_0_27_Data_16,thisval);
}

on envVar A_ASG_69_0_0_27_Data_16_30
{
	byte bitval;
	//thisval steht hier fuer den bitfield-wert, 
	//aus Generierungsgruenden hier keine einheitliche Bezeichnung moeglich.
	dword thisval; // Display3AdditionalInfo1_1
	bitval= getValue(this);
	thisval = getValue(A_ASG_69_0_0_27_Data_16);
	thisval = thisval&~(1<<30)|(bitval<<30);
	putValue(A_ASG_69_0_0_27_Data_16,thisval);
}

on envVar A_ASG_69_0_0_27_Data_16_31
{
	byte bitval;
	//thisval steht hier fuer den bitfield-wert, 
	//aus Generierungsgruenden hier keine einheitliche Bezeichnung moeglich.
	dword thisval; // Display3AdditionalInfo1_1
	bitval= getValue(this);
	thisval = getValue(A_ASG_69_0_0_27_Data_16);
	thisval = thisval&~(1<<31)|(bitval<<31);
	putValue(A_ASG_69_0_0_27_Data_16,thisval);
}

on envVar A_ASG_69_0_0_27_Data_16
{
	byte superval[665];

	//Update Childvalue (BitField)
	byte mask=0x01;
	int i = 0;
	dword thisval; // Display3AdditionalInfo1_1
	thisval = getValue(this);
	if(thisval&(mask<<0))
		putValue(A_ASG_69_0_0_27_Data_16_0, 1);
	else
		putValue(A_ASG_69_0_0_27_Data_16_0, 0);
	if(thisval&(mask<<1))
		putValue(A_ASG_69_0_0_27_Data_16_1, 1);
	else
		putValue(A_ASG_69_0_0_27_Data_16_1, 0);
	if(thisval&(mask<<2))
		putValue(A_ASG_69_0_0_27_Data_16_2, 1);
	else
		putValue(A_ASG_69_0_0_27_Data_16_2, 0);
	if(thisval&(mask<<3))
		putValue(A_ASG_69_0_0_27_Data_16_3, 1);
	else
		putValue(A_ASG_69_0_0_27_Data_16_3, 0);
	if(thisval&(mask<<4))
		putValue(A_ASG_69_0_0_27_Data_16_4, 1);
	else
		putValue(A_ASG_69_0_0_27_Data_16_4, 0);
	if(thisval&(mask<<5))
		putValue(A_ASG_69_0_0_27_Data_16_5, 1);
	else
		putValue(A_ASG_69_0_0_27_Data_16_5, 0);
	if(thisval&(mask<<6))
		putValue(A_ASG_69_0_0_27_Data_16_6, 1);
	else
		putValue(A_ASG_69_0_0_27_Data_16_6, 0);
	if(thisval&(mask<<7))
		putValue(A_ASG_69_0_0_27_Data_16_7, 1);
	else
		putValue(A_ASG_69_0_0_27_Data_16_7, 0);
	if(thisval&(mask<<8))
		putValue(A_ASG_69_0_0_27_Data_16_8, 1);
	else
		putValue(A_ASG_69_0_0_27_Data_16_8, 0);
	if(thisval&(mask<<9))
		putValue(A_ASG_69_0_0_27_Data_16_9, 1);
	else
		putValue(A_ASG_69_0_0_27_Data_16_9, 0);
	if(thisval&(mask<<10))
		putValue(A_ASG_69_0_0_27_Data_16_10, 1);
	else
		putValue(A_ASG_69_0_0_27_Data_16_10, 0);
	if(thisval&(mask<<11))
		putValue(A_ASG_69_0_0_27_Data_16_11, 1);
	else
		putValue(A_ASG_69_0_0_27_Data_16_11, 0);
	if(thisval&(mask<<12))
		putValue(A_ASG_69_0_0_27_Data_16_12, 1);
	else
		putValue(A_ASG_69_0_0_27_Data_16_12, 0);
	if(thisval&(mask<<13))
		putValue(A_ASG_69_0_0_27_Data_16_13, 1);
	else
		putValue(A_ASG_69_0_0_27_Data_16_13, 0);
	if(thisval&(mask<<14))
		putValue(A_ASG_69_0_0_27_Data_16_14, 1);
	else
		putValue(A_ASG_69_0_0_27_Data_16_14, 0);
	if(thisval&(mask<<15))
		putValue(A_ASG_69_0_0_27_Data_16_15, 1);
	else
		putValue(A_ASG_69_0_0_27_Data_16_15, 0);
	if(thisval&(mask<<16))
		putValue(A_ASG_69_0_0_27_Data_16_16, 1);
	else
		putValue(A_ASG_69_0_0_27_Data_16_16, 0);
	if(thisval&(mask<<17))
		putValue(A_ASG_69_0_0_27_Data_16_17, 1);
	else
		putValue(A_ASG_69_0_0_27_Data_16_17, 0);
	if(thisval&(mask<<18))
		putValue(A_ASG_69_0_0_27_Data_16_18, 1);
	else
		putValue(A_ASG_69_0_0_27_Data_16_18, 0);
	if(thisval&(mask<<19))
		putValue(A_ASG_69_0_0_27_Data_16_19, 1);
	else
		putValue(A_ASG_69_0_0_27_Data_16_19, 0);
	if(thisval&(mask<<20))
		putValue(A_ASG_69_0_0_27_Data_16_20, 1);
	else
		putValue(A_ASG_69_0_0_27_Data_16_20, 0);
	if(thisval&(mask<<21))
		putValue(A_ASG_69_0_0_27_Data_16_21, 1);
	else
		putValue(A_ASG_69_0_0_27_Data_16_21, 0);
	if(thisval&(mask<<22))
		putValue(A_ASG_69_0_0_27_Data_16_22, 1);
	else
		putValue(A_ASG_69_0_0_27_Data_16_22, 0);
	if(thisval&(mask<<23))
		putValue(A_ASG_69_0_0_27_Data_16_23, 1);
	else
		putValue(A_ASG_69_0_0_27_Data_16_23, 0);
	if(thisval&(mask<<24))
		putValue(A_ASG_69_0_0_27_Data_16_24, 1);
	else
		putValue(A_ASG_69_0_0_27_Data_16_24, 0);
	if(thisval&(mask<<25))
		putValue(A_ASG_69_0_0_27_Data_16_25, 1);
	else
		putValue(A_ASG_69_0_0_27_Data_16_25, 0);
	if(thisval&(mask<<26))
		putValue(A_ASG_69_0_0_27_Data_16_26, 1);
	else
		putValue(A_ASG_69_0_0_27_Data_16_26, 0);
	if(thisval&(mask<<27))
		putValue(A_ASG_69_0_0_27_Data_16_27, 1);
	else
		putValue(A_ASG_69_0_0_27_Data_16_27, 0);
	if(thisval&(mask<<28))
		putValue(A_ASG_69_0_0_27_Data_16_28, 1);
	else
		putValue(A_ASG_69_0_0_27_Data_16_28, 0);
	if(thisval&(mask<<29))
		putValue(A_ASG_69_0_0_27_Data_16_29, 1);
	else
		putValue(A_ASG_69_0_0_27_Data_16_29, 0);
	if(thisval&(mask<<30))
		putValue(A_ASG_69_0_0_27_Data_16_30, 1);
	else
		putValue(A_ASG_69_0_0_27_Data_16_30, 0);
	if(thisval&(mask<<31))
		putValue(A_ASG_69_0_0_27_Data_16_31, 1);
	else
		putValue(A_ASG_69_0_0_27_Data_16_31, 0);
    A_ASG_69_0_0_27_ArrayDataList[getValue(A_ASG_69_0_0_27_DataIndex)].Param16 = thisval;
}
on envVar A_ASG_69_0_0_27_Data_17_0
{
	byte bitval;
	//thisval steht hier fuer den bitfield-wert, 
	//aus Generierungsgruenden hier keine einheitliche Bezeichnung moeglich.
	dword thisval; // Display3AdditionalInfo1_2
	bitval= getValue(this);
	thisval = getValue(A_ASG_69_0_0_27_Data_17);
	thisval = thisval&~(1<<0)|(bitval<<0);
	putValue(A_ASG_69_0_0_27_Data_17,thisval);
}

on envVar A_ASG_69_0_0_27_Data_17_1
{
	byte bitval;
	//thisval steht hier fuer den bitfield-wert, 
	//aus Generierungsgruenden hier keine einheitliche Bezeichnung moeglich.
	dword thisval; // Display3AdditionalInfo1_2
	bitval= getValue(this);
	thisval = getValue(A_ASG_69_0_0_27_Data_17);
	thisval = thisval&~(1<<1)|(bitval<<1);
	putValue(A_ASG_69_0_0_27_Data_17,thisval);
}

on envVar A_ASG_69_0_0_27_Data_17_2
{
	byte bitval;
	//thisval steht hier fuer den bitfield-wert, 
	//aus Generierungsgruenden hier keine einheitliche Bezeichnung moeglich.
	dword thisval; // Display3AdditionalInfo1_2
	bitval= getValue(this);
	thisval = getValue(A_ASG_69_0_0_27_Data_17);
	thisval = thisval&~(1<<2)|(bitval<<2);
	putValue(A_ASG_69_0_0_27_Data_17,thisval);
}

on envVar A_ASG_69_0_0_27_Data_17_3
{
	byte bitval;
	//thisval steht hier fuer den bitfield-wert, 
	//aus Generierungsgruenden hier keine einheitliche Bezeichnung moeglich.
	dword thisval; // Display3AdditionalInfo1_2
	bitval= getValue(this);
	thisval = getValue(A_ASG_69_0_0_27_Data_17);
	thisval = thisval&~(1<<3)|(bitval<<3);
	putValue(A_ASG_69_0_0_27_Data_17,thisval);
}

on envVar A_ASG_69_0_0_27_Data_17_4
{
	byte bitval;
	//thisval steht hier fuer den bitfield-wert, 
	//aus Generierungsgruenden hier keine einheitliche Bezeichnung moeglich.
	dword thisval; // Display3AdditionalInfo1_2
	bitval= getValue(this);
	thisval = getValue(A_ASG_69_0_0_27_Data_17);
	thisval = thisval&~(1<<4)|(bitval<<4);
	putValue(A_ASG_69_0_0_27_Data_17,thisval);
}

on envVar A_ASG_69_0_0_27_Data_17_5
{
	byte bitval;
	//thisval steht hier fuer den bitfield-wert, 
	//aus Generierungsgruenden hier keine einheitliche Bezeichnung moeglich.
	dword thisval; // Display3AdditionalInfo1_2
	bitval= getValue(this);
	thisval = getValue(A_ASG_69_0_0_27_Data_17);
	thisval = thisval&~(1<<5)|(bitval<<5);
	putValue(A_ASG_69_0_0_27_Data_17,thisval);
}

on envVar A_ASG_69_0_0_27_Data_17_6
{
	byte bitval;
	//thisval steht hier fuer den bitfield-wert, 
	//aus Generierungsgruenden hier keine einheitliche Bezeichnung moeglich.
	dword thisval; // Display3AdditionalInfo1_2
	bitval= getValue(this);
	thisval = getValue(A_ASG_69_0_0_27_Data_17);
	thisval = thisval&~(1<<6)|(bitval<<6);
	putValue(A_ASG_69_0_0_27_Data_17,thisval);
}

on envVar A_ASG_69_0_0_27_Data_17_7
{
	byte bitval;
	//thisval steht hier fuer den bitfield-wert, 
	//aus Generierungsgruenden hier keine einheitliche Bezeichnung moeglich.
	dword thisval; // Display3AdditionalInfo1_2
	bitval= getValue(this);
	thisval = getValue(A_ASG_69_0_0_27_Data_17);
	thisval = thisval&~(1<<7)|(bitval<<7);
	putValue(A_ASG_69_0_0_27_Data_17,thisval);
}

on envVar A_ASG_69_0_0_27_Data_17_8
{
	byte bitval;
	//thisval steht hier fuer den bitfield-wert, 
	//aus Generierungsgruenden hier keine einheitliche Bezeichnung moeglich.
	dword thisval; // Display3AdditionalInfo1_2
	bitval= getValue(this);
	thisval = getValue(A_ASG_69_0_0_27_Data_17);
	thisval = thisval&~(1<<8)|(bitval<<8);
	putValue(A_ASG_69_0_0_27_Data_17,thisval);
}

on envVar A_ASG_69_0_0_27_Data_17_9
{
	byte bitval;
	//thisval steht hier fuer den bitfield-wert, 
	//aus Generierungsgruenden hier keine einheitliche Bezeichnung moeglich.
	dword thisval; // Display3AdditionalInfo1_2
	bitval= getValue(this);
	thisval = getValue(A_ASG_69_0_0_27_Data_17);
	thisval = thisval&~(1<<9)|(bitval<<9);
	putValue(A_ASG_69_0_0_27_Data_17,thisval);
}

on envVar A_ASG_69_0_0_27_Data_17_10
{
	byte bitval;
	//thisval steht hier fuer den bitfield-wert, 
	//aus Generierungsgruenden hier keine einheitliche Bezeichnung moeglich.
	dword thisval; // Display3AdditionalInfo1_2
	bitval= getValue(this);
	thisval = getValue(A_ASG_69_0_0_27_Data_17);
	thisval = thisval&~(1<<10)|(bitval<<10);
	putValue(A_ASG_69_0_0_27_Data_17,thisval);
}

on envVar A_ASG_69_0_0_27_Data_17_11
{
	byte bitval;
	//thisval steht hier fuer den bitfield-wert, 
	//aus Generierungsgruenden hier keine einheitliche Bezeichnung moeglich.
	dword thisval; // Display3AdditionalInfo1_2
	bitval= getValue(this);
	thisval = getValue(A_ASG_69_0_0_27_Data_17);
	thisval = thisval&~(1<<11)|(bitval<<11);
	putValue(A_ASG_69_0_0_27_Data_17,thisval);
}

on envVar A_ASG_69_0_0_27_Data_17_12
{
	byte bitval;
	//thisval steht hier fuer den bitfield-wert, 
	//aus Generierungsgruenden hier keine einheitliche Bezeichnung moeglich.
	dword thisval; // Display3AdditionalInfo1_2
	bitval= getValue(this);
	thisval = getValue(A_ASG_69_0_0_27_Data_17);
	thisval = thisval&~(1<<12)|(bitval<<12);
	putValue(A_ASG_69_0_0_27_Data_17,thisval);
}

on envVar A_ASG_69_0_0_27_Data_17_13
{
	byte bitval;
	//thisval steht hier fuer den bitfield-wert, 
	//aus Generierungsgruenden hier keine einheitliche Bezeichnung moeglich.
	dword thisval; // Display3AdditionalInfo1_2
	bitval= getValue(this);
	thisval = getValue(A_ASG_69_0_0_27_Data_17);
	thisval = thisval&~(1<<13)|(bitval<<13);
	putValue(A_ASG_69_0_0_27_Data_17,thisval);
}

on envVar A_ASG_69_0_0_27_Data_17_14
{
	byte bitval;
	//thisval steht hier fuer den bitfield-wert, 
	//aus Generierungsgruenden hier keine einheitliche Bezeichnung moeglich.
	dword thisval; // Display3AdditionalInfo1_2
	bitval= getValue(this);
	thisval = getValue(A_ASG_69_0_0_27_Data_17);
	thisval = thisval&~(1<<14)|(bitval<<14);
	putValue(A_ASG_69_0_0_27_Data_17,thisval);
}

on envVar A_ASG_69_0_0_27_Data_17_15
{
	byte bitval;
	//thisval steht hier fuer den bitfield-wert, 
	//aus Generierungsgruenden hier keine einheitliche Bezeichnung moeglich.
	dword thisval; // Display3AdditionalInfo1_2
	bitval= getValue(this);
	thisval = getValue(A_ASG_69_0_0_27_Data_17);
	thisval = thisval&~(1<<15)|(bitval<<15);
	putValue(A_ASG_69_0_0_27_Data_17,thisval);
}

on envVar A_ASG_69_0_0_27_Data_17_16
{
	byte bitval;
	//thisval steht hier fuer den bitfield-wert, 
	//aus Generierungsgruenden hier keine einheitliche Bezeichnung moeglich.
	dword thisval; // Display3AdditionalInfo1_2
	bitval= getValue(this);
	thisval = getValue(A_ASG_69_0_0_27_Data_17);
	thisval = thisval&~(1<<16)|(bitval<<16);
	putValue(A_ASG_69_0_0_27_Data_17,thisval);
}

on envVar A_ASG_69_0_0_27_Data_17_17
{
	byte bitval;
	//thisval steht hier fuer den bitfield-wert, 
	//aus Generierungsgruenden hier keine einheitliche Bezeichnung moeglich.
	dword thisval; // Display3AdditionalInfo1_2
	bitval= getValue(this);
	thisval = getValue(A_ASG_69_0_0_27_Data_17);
	thisval = thisval&~(1<<17)|(bitval<<17);
	putValue(A_ASG_69_0_0_27_Data_17,thisval);
}

on envVar A_ASG_69_0_0_27_Data_17_18
{
	byte bitval;
	//thisval steht hier fuer den bitfield-wert, 
	//aus Generierungsgruenden hier keine einheitliche Bezeichnung moeglich.
	dword thisval; // Display3AdditionalInfo1_2
	bitval= getValue(this);
	thisval = getValue(A_ASG_69_0_0_27_Data_17);
	thisval = thisval&~(1<<18)|(bitval<<18);
	putValue(A_ASG_69_0_0_27_Data_17,thisval);
}

on envVar A_ASG_69_0_0_27_Data_17_19
{
	byte bitval;
	//thisval steht hier fuer den bitfield-wert, 
	//aus Generierungsgruenden hier keine einheitliche Bezeichnung moeglich.
	dword thisval; // Display3AdditionalInfo1_2
	bitval= getValue(this);
	thisval = getValue(A_ASG_69_0_0_27_Data_17);
	thisval = thisval&~(1<<19)|(bitval<<19);
	putValue(A_ASG_69_0_0_27_Data_17,thisval);
}

on envVar A_ASG_69_0_0_27_Data_17_20
{
	byte bitval;
	//thisval steht hier fuer den bitfield-wert, 
	//aus Generierungsgruenden hier keine einheitliche Bezeichnung moeglich.
	dword thisval; // Display3AdditionalInfo1_2
	bitval= getValue(this);
	thisval = getValue(A_ASG_69_0_0_27_Data_17);
	thisval = thisval&~(1<<20)|(bitval<<20);
	putValue(A_ASG_69_0_0_27_Data_17,thisval);
}

on envVar A_ASG_69_0_0_27_Data_17_21
{
	byte bitval;
	//thisval steht hier fuer den bitfield-wert, 
	//aus Generierungsgruenden hier keine einheitliche Bezeichnung moeglich.
	dword thisval; // Display3AdditionalInfo1_2
	bitval= getValue(this);
	thisval = getValue(A_ASG_69_0_0_27_Data_17);
	thisval = thisval&~(1<<21)|(bitval<<21);
	putValue(A_ASG_69_0_0_27_Data_17,thisval);
}

on envVar A_ASG_69_0_0_27_Data_17_22
{
	byte bitval;
	//thisval steht hier fuer den bitfield-wert, 
	//aus Generierungsgruenden hier keine einheitliche Bezeichnung moeglich.
	dword thisval; // Display3AdditionalInfo1_2
	bitval= getValue(this);
	thisval = getValue(A_ASG_69_0_0_27_Data_17);
	thisval = thisval&~(1<<22)|(bitval<<22);
	putValue(A_ASG_69_0_0_27_Data_17,thisval);
}

on envVar A_ASG_69_0_0_27_Data_17_23
{
	byte bitval;
	//thisval steht hier fuer den bitfield-wert, 
	//aus Generierungsgruenden hier keine einheitliche Bezeichnung moeglich.
	dword thisval; // Display3AdditionalInfo1_2
	bitval= getValue(this);
	thisval = getValue(A_ASG_69_0_0_27_Data_17);
	thisval = thisval&~(1<<23)|(bitval<<23);
	putValue(A_ASG_69_0_0_27_Data_17,thisval);
}

on envVar A_ASG_69_0_0_27_Data_17_24
{
	byte bitval;
	//thisval steht hier fuer den bitfield-wert, 
	//aus Generierungsgruenden hier keine einheitliche Bezeichnung moeglich.
	dword thisval; // Display3AdditionalInfo1_2
	bitval= getValue(this);
	thisval = getValue(A_ASG_69_0_0_27_Data_17);
	thisval = thisval&~(1<<24)|(bitval<<24);
	putValue(A_ASG_69_0_0_27_Data_17,thisval);
}

on envVar A_ASG_69_0_0_27_Data_17_25
{
	byte bitval;
	//thisval steht hier fuer den bitfield-wert, 
	//aus Generierungsgruenden hier keine einheitliche Bezeichnung moeglich.
	dword thisval; // Display3AdditionalInfo1_2
	bitval= getValue(this);
	thisval = getValue(A_ASG_69_0_0_27_Data_17);
	thisval = thisval&~(1<<25)|(bitval<<25);
	putValue(A_ASG_69_0_0_27_Data_17,thisval);
}

on envVar A_ASG_69_0_0_27_Data_17_26
{
	byte bitval;
	//thisval steht hier fuer den bitfield-wert, 
	//aus Generierungsgruenden hier keine einheitliche Bezeichnung moeglich.
	dword thisval; // Display3AdditionalInfo1_2
	bitval= getValue(this);
	thisval = getValue(A_ASG_69_0_0_27_Data_17);
	thisval = thisval&~(1<<26)|(bitval<<26);
	putValue(A_ASG_69_0_0_27_Data_17,thisval);
}

on envVar A_ASG_69_0_0_27_Data_17_27
{
	byte bitval;
	//thisval steht hier fuer den bitfield-wert, 
	//aus Generierungsgruenden hier keine einheitliche Bezeichnung moeglich.
	dword thisval; // Display3AdditionalInfo1_2
	bitval= getValue(this);
	thisval = getValue(A_ASG_69_0_0_27_Data_17);
	thisval = thisval&~(1<<27)|(bitval<<27);
	putValue(A_ASG_69_0_0_27_Data_17,thisval);
}

on envVar A_ASG_69_0_0_27_Data_17_28
{
	byte bitval;
	//thisval steht hier fuer den bitfield-wert, 
	//aus Generierungsgruenden hier keine einheitliche Bezeichnung moeglich.
	dword thisval; // Display3AdditionalInfo1_2
	bitval= getValue(this);
	thisval = getValue(A_ASG_69_0_0_27_Data_17);
	thisval = thisval&~(1<<28)|(bitval<<28);
	putValue(A_ASG_69_0_0_27_Data_17,thisval);
}

on envVar A_ASG_69_0_0_27_Data_17_29
{
	byte bitval;
	//thisval steht hier fuer den bitfield-wert, 
	//aus Generierungsgruenden hier keine einheitliche Bezeichnung moeglich.
	dword thisval; // Display3AdditionalInfo1_2
	bitval= getValue(this);
	thisval = getValue(A_ASG_69_0_0_27_Data_17);
	thisval = thisval&~(1<<29)|(bitval<<29);
	putValue(A_ASG_69_0_0_27_Data_17,thisval);
}

on envVar A_ASG_69_0_0_27_Data_17
{
	byte superval[665];

	//Update Childvalue (BitField)
	byte mask=0x01;
	int i = 0;
	dword thisval; // Display3AdditionalInfo1_2
	thisval = getValue(this);
	if(thisval&(mask<<0))
		putValue(A_ASG_69_0_0_27_Data_17_0, 1);
	else
		putValue(A_ASG_69_0_0_27_Data_17_0, 0);
	if(thisval&(mask<<1))
		putValue(A_ASG_69_0_0_27_Data_17_1, 1);
	else
		putValue(A_ASG_69_0_0_27_Data_17_1, 0);
	if(thisval&(mask<<2))
		putValue(A_ASG_69_0_0_27_Data_17_2, 1);
	else
		putValue(A_ASG_69_0_0_27_Data_17_2, 0);
	if(thisval&(mask<<3))
		putValue(A_ASG_69_0_0_27_Data_17_3, 1);
	else
		putValue(A_ASG_69_0_0_27_Data_17_3, 0);
	if(thisval&(mask<<4))
		putValue(A_ASG_69_0_0_27_Data_17_4, 1);
	else
		putValue(A_ASG_69_0_0_27_Data_17_4, 0);
	if(thisval&(mask<<5))
		putValue(A_ASG_69_0_0_27_Data_17_5, 1);
	else
		putValue(A_ASG_69_0_0_27_Data_17_5, 0);
	if(thisval&(mask<<6))
		putValue(A_ASG_69_0_0_27_Data_17_6, 1);
	else
		putValue(A_ASG_69_0_0_27_Data_17_6, 0);
	if(thisval&(mask<<7))
		putValue(A_ASG_69_0_0_27_Data_17_7, 1);
	else
		putValue(A_ASG_69_0_0_27_Data_17_7, 0);
	if(thisval&(mask<<8))
		putValue(A_ASG_69_0_0_27_Data_17_8, 1);
	else
		putValue(A_ASG_69_0_0_27_Data_17_8, 0);
	if(thisval&(mask<<9))
		putValue(A_ASG_69_0_0_27_Data_17_9, 1);
	else
		putValue(A_ASG_69_0_0_27_Data_17_9, 0);
	if(thisval&(mask<<10))
		putValue(A_ASG_69_0_0_27_Data_17_10, 1);
	else
		putValue(A_ASG_69_0_0_27_Data_17_10, 0);
	if(thisval&(mask<<11))
		putValue(A_ASG_69_0_0_27_Data_17_11, 1);
	else
		putValue(A_ASG_69_0_0_27_Data_17_11, 0);
	if(thisval&(mask<<12))
		putValue(A_ASG_69_0_0_27_Data_17_12, 1);
	else
		putValue(A_ASG_69_0_0_27_Data_17_12, 0);
	if(thisval&(mask<<13))
		putValue(A_ASG_69_0_0_27_Data_17_13, 1);
	else
		putValue(A_ASG_69_0_0_27_Data_17_13, 0);
	if(thisval&(mask<<14))
		putValue(A_ASG_69_0_0_27_Data_17_14, 1);
	else
		putValue(A_ASG_69_0_0_27_Data_17_14, 0);
	if(thisval&(mask<<15))
		putValue(A_ASG_69_0_0_27_Data_17_15, 1);
	else
		putValue(A_ASG_69_0_0_27_Data_17_15, 0);
	if(thisval&(mask<<16))
		putValue(A_ASG_69_0_0_27_Data_17_16, 1);
	else
		putValue(A_ASG_69_0_0_27_Data_17_16, 0);
	if(thisval&(mask<<17))
		putValue(A_ASG_69_0_0_27_Data_17_17, 1);
	else
		putValue(A_ASG_69_0_0_27_Data_17_17, 0);
	if(thisval&(mask<<18))
		putValue(A_ASG_69_0_0_27_Data_17_18, 1);
	else
		putValue(A_ASG_69_0_0_27_Data_17_18, 0);
	if(thisval&(mask<<19))
		putValue(A_ASG_69_0_0_27_Data_17_19, 1);
	else
		putValue(A_ASG_69_0_0_27_Data_17_19, 0);
	if(thisval&(mask<<20))
		putValue(A_ASG_69_0_0_27_Data_17_20, 1);
	else
		putValue(A_ASG_69_0_0_27_Data_17_20, 0);
	if(thisval&(mask<<21))
		putValue(A_ASG_69_0_0_27_Data_17_21, 1);
	else
		putValue(A_ASG_69_0_0_27_Data_17_21, 0);
	if(thisval&(mask<<22))
		putValue(A_ASG_69_0_0_27_Data_17_22, 1);
	else
		putValue(A_ASG_69_0_0_27_Data_17_22, 0);
	if(thisval&(mask<<23))
		putValue(A_ASG_69_0_0_27_Data_17_23, 1);
	else
		putValue(A_ASG_69_0_0_27_Data_17_23, 0);
	if(thisval&(mask<<24))
		putValue(A_ASG_69_0_0_27_Data_17_24, 1);
	else
		putValue(A_ASG_69_0_0_27_Data_17_24, 0);
	if(thisval&(mask<<25))
		putValue(A_ASG_69_0_0_27_Data_17_25, 1);
	else
		putValue(A_ASG_69_0_0_27_Data_17_25, 0);
	if(thisval&(mask<<26))
		putValue(A_ASG_69_0_0_27_Data_17_26, 1);
	else
		putValue(A_ASG_69_0_0_27_Data_17_26, 0);
	if(thisval&(mask<<27))
		putValue(A_ASG_69_0_0_27_Data_17_27, 1);
	else
		putValue(A_ASG_69_0_0_27_Data_17_27, 0);
	if(thisval&(mask<<28))
		putValue(A_ASG_69_0_0_27_Data_17_28, 1);
	else
		putValue(A_ASG_69_0_0_27_Data_17_28, 0);
	if(thisval&(mask<<29))
		putValue(A_ASG_69_0_0_27_Data_17_29, 1);
	else
		putValue(A_ASG_69_0_0_27_Data_17_29, 0);
    A_ASG_69_0_0_27_ArrayDataList[getValue(A_ASG_69_0_0_27_DataIndex)].Param17 = thisval;
}
on envVar A_ASG_69_0_0_27_Data_18_0
{
	byte bitval;
	//thisval steht hier fuer den bitfield-wert, 
	//aus Generierungsgruenden hier keine einheitliche Bezeichnung moeglich.
	dword thisval; // Display3AdditionalInfo2_1
	bitval= getValue(this);
	thisval = getValue(A_ASG_69_0_0_27_Data_18);
	thisval = thisval&~(1<<0)|(bitval<<0);
	putValue(A_ASG_69_0_0_27_Data_18,thisval);
}

on envVar A_ASG_69_0_0_27_Data_18_1
{
	byte bitval;
	//thisval steht hier fuer den bitfield-wert, 
	//aus Generierungsgruenden hier keine einheitliche Bezeichnung moeglich.
	dword thisval; // Display3AdditionalInfo2_1
	bitval= getValue(this);
	thisval = getValue(A_ASG_69_0_0_27_Data_18);
	thisval = thisval&~(1<<1)|(bitval<<1);
	putValue(A_ASG_69_0_0_27_Data_18,thisval);
}

on envVar A_ASG_69_0_0_27_Data_18_2
{
	byte bitval;
	//thisval steht hier fuer den bitfield-wert, 
	//aus Generierungsgruenden hier keine einheitliche Bezeichnung moeglich.
	dword thisval; // Display3AdditionalInfo2_1
	bitval= getValue(this);
	thisval = getValue(A_ASG_69_0_0_27_Data_18);
	thisval = thisval&~(1<<2)|(bitval<<2);
	putValue(A_ASG_69_0_0_27_Data_18,thisval);
}

on envVar A_ASG_69_0_0_27_Data_18_3
{
	byte bitval;
	//thisval steht hier fuer den bitfield-wert, 
	//aus Generierungsgruenden hier keine einheitliche Bezeichnung moeglich.
	dword thisval; // Display3AdditionalInfo2_1
	bitval= getValue(this);
	thisval = getValue(A_ASG_69_0_0_27_Data_18);
	thisval = thisval&~(1<<3)|(bitval<<3);
	putValue(A_ASG_69_0_0_27_Data_18,thisval);
}

on envVar A_ASG_69_0_0_27_Data_18_4
{
	byte bitval;
	//thisval steht hier fuer den bitfield-wert, 
	//aus Generierungsgruenden hier keine einheitliche Bezeichnung moeglich.
	dword thisval; // Display3AdditionalInfo2_1
	bitval= getValue(this);
	thisval = getValue(A_ASG_69_0_0_27_Data_18);
	thisval = thisval&~(1<<4)|(bitval<<4);
	putValue(A_ASG_69_0_0_27_Data_18,thisval);
}

on envVar A_ASG_69_0_0_27_Data_18_5
{
	byte bitval;
	//thisval steht hier fuer den bitfield-wert, 
	//aus Generierungsgruenden hier keine einheitliche Bezeichnung moeglich.
	dword thisval; // Display3AdditionalInfo2_1
	bitval= getValue(this);
	thisval = getValue(A_ASG_69_0_0_27_Data_18);
	thisval = thisval&~(1<<5)|(bitval<<5);
	putValue(A_ASG_69_0_0_27_Data_18,thisval);
}

on envVar A_ASG_69_0_0_27_Data_18_6
{
	byte bitval;
	//thisval steht hier fuer den bitfield-wert, 
	//aus Generierungsgruenden hier keine einheitliche Bezeichnung moeglich.
	dword thisval; // Display3AdditionalInfo2_1
	bitval= getValue(this);
	thisval = getValue(A_ASG_69_0_0_27_Data_18);
	thisval = thisval&~(1<<6)|(bitval<<6);
	putValue(A_ASG_69_0_0_27_Data_18,thisval);
}

on envVar A_ASG_69_0_0_27_Data_18_7
{
	byte bitval;
	//thisval steht hier fuer den bitfield-wert, 
	//aus Generierungsgruenden hier keine einheitliche Bezeichnung moeglich.
	dword thisval; // Display3AdditionalInfo2_1
	bitval= getValue(this);
	thisval = getValue(A_ASG_69_0_0_27_Data_18);
	thisval = thisval&~(1<<7)|(bitval<<7);
	putValue(A_ASG_69_0_0_27_Data_18,thisval);
}

on envVar A_ASG_69_0_0_27_Data_18_8
{
	byte bitval;
	//thisval steht hier fuer den bitfield-wert, 
	//aus Generierungsgruenden hier keine einheitliche Bezeichnung moeglich.
	dword thisval; // Display3AdditionalInfo2_1
	bitval= getValue(this);
	thisval = getValue(A_ASG_69_0_0_27_Data_18);
	thisval = thisval&~(1<<8)|(bitval<<8);
	putValue(A_ASG_69_0_0_27_Data_18,thisval);
}

on envVar A_ASG_69_0_0_27_Data_18_9
{
	byte bitval;
	//thisval steht hier fuer den bitfield-wert, 
	//aus Generierungsgruenden hier keine einheitliche Bezeichnung moeglich.
	dword thisval; // Display3AdditionalInfo2_1
	bitval= getValue(this);
	thisval = getValue(A_ASG_69_0_0_27_Data_18);
	thisval = thisval&~(1<<9)|(bitval<<9);
	putValue(A_ASG_69_0_0_27_Data_18,thisval);
}

on envVar A_ASG_69_0_0_27_Data_18_10
{
	byte bitval;
	//thisval steht hier fuer den bitfield-wert, 
	//aus Generierungsgruenden hier keine einheitliche Bezeichnung moeglich.
	dword thisval; // Display3AdditionalInfo2_1
	bitval= getValue(this);
	thisval = getValue(A_ASG_69_0_0_27_Data_18);
	thisval = thisval&~(1<<10)|(bitval<<10);
	putValue(A_ASG_69_0_0_27_Data_18,thisval);
}

on envVar A_ASG_69_0_0_27_Data_18_11
{
	byte bitval;
	//thisval steht hier fuer den bitfield-wert, 
	//aus Generierungsgruenden hier keine einheitliche Bezeichnung moeglich.
	dword thisval; // Display3AdditionalInfo2_1
	bitval= getValue(this);
	thisval = getValue(A_ASG_69_0_0_27_Data_18);
	thisval = thisval&~(1<<11)|(bitval<<11);
	putValue(A_ASG_69_0_0_27_Data_18,thisval);
}

on envVar A_ASG_69_0_0_27_Data_18_12
{
	byte bitval;
	//thisval steht hier fuer den bitfield-wert, 
	//aus Generierungsgruenden hier keine einheitliche Bezeichnung moeglich.
	dword thisval; // Display3AdditionalInfo2_1
	bitval= getValue(this);
	thisval = getValue(A_ASG_69_0_0_27_Data_18);
	thisval = thisval&~(1<<12)|(bitval<<12);
	putValue(A_ASG_69_0_0_27_Data_18,thisval);
}

on envVar A_ASG_69_0_0_27_Data_18_13
{
	byte bitval;
	//thisval steht hier fuer den bitfield-wert, 
	//aus Generierungsgruenden hier keine einheitliche Bezeichnung moeglich.
	dword thisval; // Display3AdditionalInfo2_1
	bitval= getValue(this);
	thisval = getValue(A_ASG_69_0_0_27_Data_18);
	thisval = thisval&~(1<<13)|(bitval<<13);
	putValue(A_ASG_69_0_0_27_Data_18,thisval);
}

on envVar A_ASG_69_0_0_27_Data_18_14
{
	byte bitval;
	//thisval steht hier fuer den bitfield-wert, 
	//aus Generierungsgruenden hier keine einheitliche Bezeichnung moeglich.
	dword thisval; // Display3AdditionalInfo2_1
	bitval= getValue(this);
	thisval = getValue(A_ASG_69_0_0_27_Data_18);
	thisval = thisval&~(1<<14)|(bitval<<14);
	putValue(A_ASG_69_0_0_27_Data_18,thisval);
}

on envVar A_ASG_69_0_0_27_Data_18_15
{
	byte bitval;
	//thisval steht hier fuer den bitfield-wert, 
	//aus Generierungsgruenden hier keine einheitliche Bezeichnung moeglich.
	dword thisval; // Display3AdditionalInfo2_1
	bitval= getValue(this);
	thisval = getValue(A_ASG_69_0_0_27_Data_18);
	thisval = thisval&~(1<<15)|(bitval<<15);
	putValue(A_ASG_69_0_0_27_Data_18,thisval);
}

on envVar A_ASG_69_0_0_27_Data_18_16
{
	byte bitval;
	//thisval steht hier fuer den bitfield-wert, 
	//aus Generierungsgruenden hier keine einheitliche Bezeichnung moeglich.
	dword thisval; // Display3AdditionalInfo2_1
	bitval= getValue(this);
	thisval = getValue(A_ASG_69_0_0_27_Data_18);
	thisval = thisval&~(1<<16)|(bitval<<16);
	putValue(A_ASG_69_0_0_27_Data_18,thisval);
}

on envVar A_ASG_69_0_0_27_Data_18_17
{
	byte bitval;
	//thisval steht hier fuer den bitfield-wert, 
	//aus Generierungsgruenden hier keine einheitliche Bezeichnung moeglich.
	dword thisval; // Display3AdditionalInfo2_1
	bitval= getValue(this);
	thisval = getValue(A_ASG_69_0_0_27_Data_18);
	thisval = thisval&~(1<<17)|(bitval<<17);
	putValue(A_ASG_69_0_0_27_Data_18,thisval);
}

on envVar A_ASG_69_0_0_27_Data_18_18
{
	byte bitval;
	//thisval steht hier fuer den bitfield-wert, 
	//aus Generierungsgruenden hier keine einheitliche Bezeichnung moeglich.
	dword thisval; // Display3AdditionalInfo2_1
	bitval= getValue(this);
	thisval = getValue(A_ASG_69_0_0_27_Data_18);
	thisval = thisval&~(1<<18)|(bitval<<18);
	putValue(A_ASG_69_0_0_27_Data_18,thisval);
}

on envVar A_ASG_69_0_0_27_Data_18_19
{
	byte bitval;
	//thisval steht hier fuer den bitfield-wert, 
	//aus Generierungsgruenden hier keine einheitliche Bezeichnung moeglich.
	dword thisval; // Display3AdditionalInfo2_1
	bitval= getValue(this);
	thisval = getValue(A_ASG_69_0_0_27_Data_18);
	thisval = thisval&~(1<<19)|(bitval<<19);
	putValue(A_ASG_69_0_0_27_Data_18,thisval);
}

on envVar A_ASG_69_0_0_27_Data_18_20
{
	byte bitval;
	//thisval steht hier fuer den bitfield-wert, 
	//aus Generierungsgruenden hier keine einheitliche Bezeichnung moeglich.
	dword thisval; // Display3AdditionalInfo2_1
	bitval= getValue(this);
	thisval = getValue(A_ASG_69_0_0_27_Data_18);
	thisval = thisval&~(1<<20)|(bitval<<20);
	putValue(A_ASG_69_0_0_27_Data_18,thisval);
}

on envVar A_ASG_69_0_0_27_Data_18_21
{
	byte bitval;
	//thisval steht hier fuer den bitfield-wert, 
	//aus Generierungsgruenden hier keine einheitliche Bezeichnung moeglich.
	dword thisval; // Display3AdditionalInfo2_1
	bitval= getValue(this);
	thisval = getValue(A_ASG_69_0_0_27_Data_18);
	thisval = thisval&~(1<<21)|(bitval<<21);
	putValue(A_ASG_69_0_0_27_Data_18,thisval);
}

on envVar A_ASG_69_0_0_27_Data_18_22
{
	byte bitval;
	//thisval steht hier fuer den bitfield-wert, 
	//aus Generierungsgruenden hier keine einheitliche Bezeichnung moeglich.
	dword thisval; // Display3AdditionalInfo2_1
	bitval= getValue(this);
	thisval = getValue(A_ASG_69_0_0_27_Data_18);
	thisval = thisval&~(1<<22)|(bitval<<22);
	putValue(A_ASG_69_0_0_27_Data_18,thisval);
}

on envVar A_ASG_69_0_0_27_Data_18_23
{
	byte bitval;
	//thisval steht hier fuer den bitfield-wert, 
	//aus Generierungsgruenden hier keine einheitliche Bezeichnung moeglich.
	dword thisval; // Display3AdditionalInfo2_1
	bitval= getValue(this);
	thisval = getValue(A_ASG_69_0_0_27_Data_18);
	thisval = thisval&~(1<<23)|(bitval<<23);
	putValue(A_ASG_69_0_0_27_Data_18,thisval);
}

on envVar A_ASG_69_0_0_27_Data_18_24
{
	byte bitval;
	//thisval steht hier fuer den bitfield-wert, 
	//aus Generierungsgruenden hier keine einheitliche Bezeichnung moeglich.
	dword thisval; // Display3AdditionalInfo2_1
	bitval= getValue(this);
	thisval = getValue(A_ASG_69_0_0_27_Data_18);
	thisval = thisval&~(1<<24)|(bitval<<24);
	putValue(A_ASG_69_0_0_27_Data_18,thisval);
}

on envVar A_ASG_69_0_0_27_Data_18_25
{
	byte bitval;
	//thisval steht hier fuer den bitfield-wert, 
	//aus Generierungsgruenden hier keine einheitliche Bezeichnung moeglich.
	dword thisval; // Display3AdditionalInfo2_1
	bitval= getValue(this);
	thisval = getValue(A_ASG_69_0_0_27_Data_18);
	thisval = thisval&~(1<<25)|(bitval<<25);
	putValue(A_ASG_69_0_0_27_Data_18,thisval);
}

on envVar A_ASG_69_0_0_27_Data_18_26
{
	byte bitval;
	//thisval steht hier fuer den bitfield-wert, 
	//aus Generierungsgruenden hier keine einheitliche Bezeichnung moeglich.
	dword thisval; // Display3AdditionalInfo2_1
	bitval= getValue(this);
	thisval = getValue(A_ASG_69_0_0_27_Data_18);
	thisval = thisval&~(1<<26)|(bitval<<26);
	putValue(A_ASG_69_0_0_27_Data_18,thisval);
}

on envVar A_ASG_69_0_0_27_Data_18_27
{
	byte bitval;
	//thisval steht hier fuer den bitfield-wert, 
	//aus Generierungsgruenden hier keine einheitliche Bezeichnung moeglich.
	dword thisval; // Display3AdditionalInfo2_1
	bitval= getValue(this);
	thisval = getValue(A_ASG_69_0_0_27_Data_18);
	thisval = thisval&~(1<<27)|(bitval<<27);
	putValue(A_ASG_69_0_0_27_Data_18,thisval);
}

on envVar A_ASG_69_0_0_27_Data_18_28
{
	byte bitval;
	//thisval steht hier fuer den bitfield-wert, 
	//aus Generierungsgruenden hier keine einheitliche Bezeichnung moeglich.
	dword thisval; // Display3AdditionalInfo2_1
	bitval= getValue(this);
	thisval = getValue(A_ASG_69_0_0_27_Data_18);
	thisval = thisval&~(1<<28)|(bitval<<28);
	putValue(A_ASG_69_0_0_27_Data_18,thisval);
}

on envVar A_ASG_69_0_0_27_Data_18_29
{
	byte bitval;
	//thisval steht hier fuer den bitfield-wert, 
	//aus Generierungsgruenden hier keine einheitliche Bezeichnung moeglich.
	dword thisval; // Display3AdditionalInfo2_1
	bitval= getValue(this);
	thisval = getValue(A_ASG_69_0_0_27_Data_18);
	thisval = thisval&~(1<<29)|(bitval<<29);
	putValue(A_ASG_69_0_0_27_Data_18,thisval);
}

on envVar A_ASG_69_0_0_27_Data_18_30
{
	byte bitval;
	//thisval steht hier fuer den bitfield-wert, 
	//aus Generierungsgruenden hier keine einheitliche Bezeichnung moeglich.
	dword thisval; // Display3AdditionalInfo2_1
	bitval= getValue(this);
	thisval = getValue(A_ASG_69_0_0_27_Data_18);
	thisval = thisval&~(1<<30)|(bitval<<30);
	putValue(A_ASG_69_0_0_27_Data_18,thisval);
}

on envVar A_ASG_69_0_0_27_Data_18_31
{
	byte bitval;
	//thisval steht hier fuer den bitfield-wert, 
	//aus Generierungsgruenden hier keine einheitliche Bezeichnung moeglich.
	dword thisval; // Display3AdditionalInfo2_1
	bitval= getValue(this);
	thisval = getValue(A_ASG_69_0_0_27_Data_18);
	thisval = thisval&~(1<<31)|(bitval<<31);
	putValue(A_ASG_69_0_0_27_Data_18,thisval);
}

on envVar A_ASG_69_0_0_27_Data_18
{
	byte superval[665];

	//Update Childvalue (BitField)
	byte mask=0x01;
	int i = 0;
	dword thisval; // Display3AdditionalInfo2_1
	thisval = getValue(this);
	if(thisval&(mask<<0))
		putValue(A_ASG_69_0_0_27_Data_18_0, 1);
	else
		putValue(A_ASG_69_0_0_27_Data_18_0, 0);
	if(thisval&(mask<<1))
		putValue(A_ASG_69_0_0_27_Data_18_1, 1);
	else
		putValue(A_ASG_69_0_0_27_Data_18_1, 0);
	if(thisval&(mask<<2))
		putValue(A_ASG_69_0_0_27_Data_18_2, 1);
	else
		putValue(A_ASG_69_0_0_27_Data_18_2, 0);
	if(thisval&(mask<<3))
		putValue(A_ASG_69_0_0_27_Data_18_3, 1);
	else
		putValue(A_ASG_69_0_0_27_Data_18_3, 0);
	if(thisval&(mask<<4))
		putValue(A_ASG_69_0_0_27_Data_18_4, 1);
	else
		putValue(A_ASG_69_0_0_27_Data_18_4, 0);
	if(thisval&(mask<<5))
		putValue(A_ASG_69_0_0_27_Data_18_5, 1);
	else
		putValue(A_ASG_69_0_0_27_Data_18_5, 0);
	if(thisval&(mask<<6))
		putValue(A_ASG_69_0_0_27_Data_18_6, 1);
	else
		putValue(A_ASG_69_0_0_27_Data_18_6, 0);
	if(thisval&(mask<<7))
		putValue(A_ASG_69_0_0_27_Data_18_7, 1);
	else
		putValue(A_ASG_69_0_0_27_Data_18_7, 0);
	if(thisval&(mask<<8))
		putValue(A_ASG_69_0_0_27_Data_18_8, 1);
	else
		putValue(A_ASG_69_0_0_27_Data_18_8, 0);
	if(thisval&(mask<<9))
		putValue(A_ASG_69_0_0_27_Data_18_9, 1);
	else
		putValue(A_ASG_69_0_0_27_Data_18_9, 0);
	if(thisval&(mask<<10))
		putValue(A_ASG_69_0_0_27_Data_18_10, 1);
	else
		putValue(A_ASG_69_0_0_27_Data_18_10, 0);
	if(thisval&(mask<<11))
		putValue(A_ASG_69_0_0_27_Data_18_11, 1);
	else
		putValue(A_ASG_69_0_0_27_Data_18_11, 0);
	if(thisval&(mask<<12))
		putValue(A_ASG_69_0_0_27_Data_18_12, 1);
	else
		putValue(A_ASG_69_0_0_27_Data_18_12, 0);
	if(thisval&(mask<<13))
		putValue(A_ASG_69_0_0_27_Data_18_13, 1);
	else
		putValue(A_ASG_69_0_0_27_Data_18_13, 0);
	if(thisval&(mask<<14))
		putValue(A_ASG_69_0_0_27_Data_18_14, 1);
	else
		putValue(A_ASG_69_0_0_27_Data_18_14, 0);
	if(thisval&(mask<<15))
		putValue(A_ASG_69_0_0_27_Data_18_15, 1);
	else
		putValue(A_ASG_69_0_0_27_Data_18_15, 0);
	if(thisval&(mask<<16))
		putValue(A_ASG_69_0_0_27_Data_18_16, 1);
	else
		putValue(A_ASG_69_0_0_27_Data_18_16, 0);
	if(thisval&(mask<<17))
		putValue(A_ASG_69_0_0_27_Data_18_17, 1);
	else
		putValue(A_ASG_69_0_0_27_Data_18_17, 0);
	if(thisval&(mask<<18))
		putValue(A_ASG_69_0_0_27_Data_18_18, 1);
	else
		putValue(A_ASG_69_0_0_27_Data_18_18, 0);
	if(thisval&(mask<<19))
		putValue(A_ASG_69_0_0_27_Data_18_19, 1);
	else
		putValue(A_ASG_69_0_0_27_Data_18_19, 0);
	if(thisval&(mask<<20))
		putValue(A_ASG_69_0_0_27_Data_18_20, 1);
	else
		putValue(A_ASG_69_0_0_27_Data_18_20, 0);
	if(thisval&(mask<<21))
		putValue(A_ASG_69_0_0_27_Data_18_21, 1);
	else
		putValue(A_ASG_69_0_0_27_Data_18_21, 0);
	if(thisval&(mask<<22))
		putValue(A_ASG_69_0_0_27_Data_18_22, 1);
	else
		putValue(A_ASG_69_0_0_27_Data_18_22, 0);
	if(thisval&(mask<<23))
		putValue(A_ASG_69_0_0_27_Data_18_23, 1);
	else
		putValue(A_ASG_69_0_0_27_Data_18_23, 0);
	if(thisval&(mask<<24))
		putValue(A_ASG_69_0_0_27_Data_18_24, 1);
	else
		putValue(A_ASG_69_0_0_27_Data_18_24, 0);
	if(thisval&(mask<<25))
		putValue(A_ASG_69_0_0_27_Data_18_25, 1);
	else
		putValue(A_ASG_69_0_0_27_Data_18_25, 0);
	if(thisval&(mask<<26))
		putValue(A_ASG_69_0_0_27_Data_18_26, 1);
	else
		putValue(A_ASG_69_0_0_27_Data_18_26, 0);
	if(thisval&(mask<<27))
		putValue(A_ASG_69_0_0_27_Data_18_27, 1);
	else
		putValue(A_ASG_69_0_0_27_Data_18_27, 0);
	if(thisval&(mask<<28))
		putValue(A_ASG_69_0_0_27_Data_18_28, 1);
	else
		putValue(A_ASG_69_0_0_27_Data_18_28, 0);
	if(thisval&(mask<<29))
		putValue(A_ASG_69_0_0_27_Data_18_29, 1);
	else
		putValue(A_ASG_69_0_0_27_Data_18_29, 0);
	if(thisval&(mask<<30))
		putValue(A_ASG_69_0_0_27_Data_18_30, 1);
	else
		putValue(A_ASG_69_0_0_27_Data_18_30, 0);
	if(thisval&(mask<<31))
		putValue(A_ASG_69_0_0_27_Data_18_31, 1);
	else
		putValue(A_ASG_69_0_0_27_Data_18_31, 0);
    A_ASG_69_0_0_27_ArrayDataList[getValue(A_ASG_69_0_0_27_DataIndex)].Param18 = thisval;
}
on envVar A_ASG_69_0_0_27_Data_19_0
{
	byte bitval;
	//thisval steht hier fuer den bitfield-wert, 
	//aus Generierungsgruenden hier keine einheitliche Bezeichnung moeglich.
	dword thisval; // Display3AdditionalInfo2_2
	bitval= getValue(this);
	thisval = getValue(A_ASG_69_0_0_27_Data_19);
	thisval = thisval&~(1<<0)|(bitval<<0);
	putValue(A_ASG_69_0_0_27_Data_19,thisval);
}

on envVar A_ASG_69_0_0_27_Data_19_1
{
	byte bitval;
	//thisval steht hier fuer den bitfield-wert, 
	//aus Generierungsgruenden hier keine einheitliche Bezeichnung moeglich.
	dword thisval; // Display3AdditionalInfo2_2
	bitval= getValue(this);
	thisval = getValue(A_ASG_69_0_0_27_Data_19);
	thisval = thisval&~(1<<1)|(bitval<<1);
	putValue(A_ASG_69_0_0_27_Data_19,thisval);
}

on envVar A_ASG_69_0_0_27_Data_19_2
{
	byte bitval;
	//thisval steht hier fuer den bitfield-wert, 
	//aus Generierungsgruenden hier keine einheitliche Bezeichnung moeglich.
	dword thisval; // Display3AdditionalInfo2_2
	bitval= getValue(this);
	thisval = getValue(A_ASG_69_0_0_27_Data_19);
	thisval = thisval&~(1<<2)|(bitval<<2);
	putValue(A_ASG_69_0_0_27_Data_19,thisval);
}

on envVar A_ASG_69_0_0_27_Data_19_3
{
	byte bitval;
	//thisval steht hier fuer den bitfield-wert, 
	//aus Generierungsgruenden hier keine einheitliche Bezeichnung moeglich.
	dword thisval; // Display3AdditionalInfo2_2
	bitval= getValue(this);
	thisval = getValue(A_ASG_69_0_0_27_Data_19);
	thisval = thisval&~(1<<3)|(bitval<<3);
	putValue(A_ASG_69_0_0_27_Data_19,thisval);
}

on envVar A_ASG_69_0_0_27_Data_19_4
{
	byte bitval;
	//thisval steht hier fuer den bitfield-wert, 
	//aus Generierungsgruenden hier keine einheitliche Bezeichnung moeglich.
	dword thisval; // Display3AdditionalInfo2_2
	bitval= getValue(this);
	thisval = getValue(A_ASG_69_0_0_27_Data_19);
	thisval = thisval&~(1<<4)|(bitval<<4);
	putValue(A_ASG_69_0_0_27_Data_19,thisval);
}

on envVar A_ASG_69_0_0_27_Data_19_5
{
	byte bitval;
	//thisval steht hier fuer den bitfield-wert, 
	//aus Generierungsgruenden hier keine einheitliche Bezeichnung moeglich.
	dword thisval; // Display3AdditionalInfo2_2
	bitval= getValue(this);
	thisval = getValue(A_ASG_69_0_0_27_Data_19);
	thisval = thisval&~(1<<5)|(bitval<<5);
	putValue(A_ASG_69_0_0_27_Data_19,thisval);
}

on envVar A_ASG_69_0_0_27_Data_19_6
{
	byte bitval;
	//thisval steht hier fuer den bitfield-wert, 
	//aus Generierungsgruenden hier keine einheitliche Bezeichnung moeglich.
	dword thisval; // Display3AdditionalInfo2_2
	bitval= getValue(this);
	thisval = getValue(A_ASG_69_0_0_27_Data_19);
	thisval = thisval&~(1<<6)|(bitval<<6);
	putValue(A_ASG_69_0_0_27_Data_19,thisval);
}

on envVar A_ASG_69_0_0_27_Data_19_7
{
	byte bitval;
	//thisval steht hier fuer den bitfield-wert, 
	//aus Generierungsgruenden hier keine einheitliche Bezeichnung moeglich.
	dword thisval; // Display3AdditionalInfo2_2
	bitval= getValue(this);
	thisval = getValue(A_ASG_69_0_0_27_Data_19);
	thisval = thisval&~(1<<7)|(bitval<<7);
	putValue(A_ASG_69_0_0_27_Data_19,thisval);
}

on envVar A_ASG_69_0_0_27_Data_19_8
{
	byte bitval;
	//thisval steht hier fuer den bitfield-wert, 
	//aus Generierungsgruenden hier keine einheitliche Bezeichnung moeglich.
	dword thisval; // Display3AdditionalInfo2_2
	bitval= getValue(this);
	thisval = getValue(A_ASG_69_0_0_27_Data_19);
	thisval = thisval&~(1<<8)|(bitval<<8);
	putValue(A_ASG_69_0_0_27_Data_19,thisval);
}

on envVar A_ASG_69_0_0_27_Data_19_9
{
	byte bitval;
	//thisval steht hier fuer den bitfield-wert, 
	//aus Generierungsgruenden hier keine einheitliche Bezeichnung moeglich.
	dword thisval; // Display3AdditionalInfo2_2
	bitval= getValue(this);
	thisval = getValue(A_ASG_69_0_0_27_Data_19);
	thisval = thisval&~(1<<9)|(bitval<<9);
	putValue(A_ASG_69_0_0_27_Data_19,thisval);
}

on envVar A_ASG_69_0_0_27_Data_19_10
{
	byte bitval;
	//thisval steht hier fuer den bitfield-wert, 
	//aus Generierungsgruenden hier keine einheitliche Bezeichnung moeglich.
	dword thisval; // Display3AdditionalInfo2_2
	bitval= getValue(this);
	thisval = getValue(A_ASG_69_0_0_27_Data_19);
	thisval = thisval&~(1<<10)|(bitval<<10);
	putValue(A_ASG_69_0_0_27_Data_19,thisval);
}

on envVar A_ASG_69_0_0_27_Data_19_11
{
	byte bitval;
	//thisval steht hier fuer den bitfield-wert, 
	//aus Generierungsgruenden hier keine einheitliche Bezeichnung moeglich.
	dword thisval; // Display3AdditionalInfo2_2
	bitval= getValue(this);
	thisval = getValue(A_ASG_69_0_0_27_Data_19);
	thisval = thisval&~(1<<11)|(bitval<<11);
	putValue(A_ASG_69_0_0_27_Data_19,thisval);
}

on envVar A_ASG_69_0_0_27_Data_19_12
{
	byte bitval;
	//thisval steht hier fuer den bitfield-wert, 
	//aus Generierungsgruenden hier keine einheitliche Bezeichnung moeglich.
	dword thisval; // Display3AdditionalInfo2_2
	bitval= getValue(this);
	thisval = getValue(A_ASG_69_0_0_27_Data_19);
	thisval = thisval&~(1<<12)|(bitval<<12);
	putValue(A_ASG_69_0_0_27_Data_19,thisval);
}

on envVar A_ASG_69_0_0_27_Data_19_13
{
	byte bitval;
	//thisval steht hier fuer den bitfield-wert, 
	//aus Generierungsgruenden hier keine einheitliche Bezeichnung moeglich.
	dword thisval; // Display3AdditionalInfo2_2
	bitval= getValue(this);
	thisval = getValue(A_ASG_69_0_0_27_Data_19);
	thisval = thisval&~(1<<13)|(bitval<<13);
	putValue(A_ASG_69_0_0_27_Data_19,thisval);
}

on envVar A_ASG_69_0_0_27_Data_19_14
{
	byte bitval;
	//thisval steht hier fuer den bitfield-wert, 
	//aus Generierungsgruenden hier keine einheitliche Bezeichnung moeglich.
	dword thisval; // Display3AdditionalInfo2_2
	bitval= getValue(this);
	thisval = getValue(A_ASG_69_0_0_27_Data_19);
	thisval = thisval&~(1<<14)|(bitval<<14);
	putValue(A_ASG_69_0_0_27_Data_19,thisval);
}

on envVar A_ASG_69_0_0_27_Data_19_15
{
	byte bitval;
	//thisval steht hier fuer den bitfield-wert, 
	//aus Generierungsgruenden hier keine einheitliche Bezeichnung moeglich.
	dword thisval; // Display3AdditionalInfo2_2
	bitval= getValue(this);
	thisval = getValue(A_ASG_69_0_0_27_Data_19);
	thisval = thisval&~(1<<15)|(bitval<<15);
	putValue(A_ASG_69_0_0_27_Data_19,thisval);
}

on envVar A_ASG_69_0_0_27_Data_19_16
{
	byte bitval;
	//thisval steht hier fuer den bitfield-wert, 
	//aus Generierungsgruenden hier keine einheitliche Bezeichnung moeglich.
	dword thisval; // Display3AdditionalInfo2_2
	bitval= getValue(this);
	thisval = getValue(A_ASG_69_0_0_27_Data_19);
	thisval = thisval&~(1<<16)|(bitval<<16);
	putValue(A_ASG_69_0_0_27_Data_19,thisval);
}

on envVar A_ASG_69_0_0_27_Data_19_17
{
	byte bitval;
	//thisval steht hier fuer den bitfield-wert, 
	//aus Generierungsgruenden hier keine einheitliche Bezeichnung moeglich.
	dword thisval; // Display3AdditionalInfo2_2
	bitval= getValue(this);
	thisval = getValue(A_ASG_69_0_0_27_Data_19);
	thisval = thisval&~(1<<17)|(bitval<<17);
	putValue(A_ASG_69_0_0_27_Data_19,thisval);
}

on envVar A_ASG_69_0_0_27_Data_19_18
{
	byte bitval;
	//thisval steht hier fuer den bitfield-wert, 
	//aus Generierungsgruenden hier keine einheitliche Bezeichnung moeglich.
	dword thisval; // Display3AdditionalInfo2_2
	bitval= getValue(this);
	thisval = getValue(A_ASG_69_0_0_27_Data_19);
	thisval = thisval&~(1<<18)|(bitval<<18);
	putValue(A_ASG_69_0_0_27_Data_19,thisval);
}

on envVar A_ASG_69_0_0_27_Data_19_19
{
	byte bitval;
	//thisval steht hier fuer den bitfield-wert, 
	//aus Generierungsgruenden hier keine einheitliche Bezeichnung moeglich.
	dword thisval; // Display3AdditionalInfo2_2
	bitval= getValue(this);
	thisval = getValue(A_ASG_69_0_0_27_Data_19);
	thisval = thisval&~(1<<19)|(bitval<<19);
	putValue(A_ASG_69_0_0_27_Data_19,thisval);
}

on envVar A_ASG_69_0_0_27_Data_19_20
{
	byte bitval;
	//thisval steht hier fuer den bitfield-wert, 
	//aus Generierungsgruenden hier keine einheitliche Bezeichnung moeglich.
	dword thisval; // Display3AdditionalInfo2_2
	bitval= getValue(this);
	thisval = getValue(A_ASG_69_0_0_27_Data_19);
	thisval = thisval&~(1<<20)|(bitval<<20);
	putValue(A_ASG_69_0_0_27_Data_19,thisval);
}

on envVar A_ASG_69_0_0_27_Data_19_21
{
	byte bitval;
	//thisval steht hier fuer den bitfield-wert, 
	//aus Generierungsgruenden hier keine einheitliche Bezeichnung moeglich.
	dword thisval; // Display3AdditionalInfo2_2
	bitval= getValue(this);
	thisval = getValue(A_ASG_69_0_0_27_Data_19);
	thisval = thisval&~(1<<21)|(bitval<<21);
	putValue(A_ASG_69_0_0_27_Data_19,thisval);
}

on envVar A_ASG_69_0_0_27_Data_19_22
{
	byte bitval;
	//thisval steht hier fuer den bitfield-wert, 
	//aus Generierungsgruenden hier keine einheitliche Bezeichnung moeglich.
	dword thisval; // Display3AdditionalInfo2_2
	bitval= getValue(this);
	thisval = getValue(A_ASG_69_0_0_27_Data_19);
	thisval = thisval&~(1<<22)|(bitval<<22);
	putValue(A_ASG_69_0_0_27_Data_19,thisval);
}

on envVar A_ASG_69_0_0_27_Data_19_23
{
	byte bitval;
	//thisval steht hier fuer den bitfield-wert, 
	//aus Generierungsgruenden hier keine einheitliche Bezeichnung moeglich.
	dword thisval; // Display3AdditionalInfo2_2
	bitval= getValue(this);
	thisval = getValue(A_ASG_69_0_0_27_Data_19);
	thisval = thisval&~(1<<23)|(bitval<<23);
	putValue(A_ASG_69_0_0_27_Data_19,thisval);
}

on envVar A_ASG_69_0_0_27_Data_19_24
{
	byte bitval;
	//thisval steht hier fuer den bitfield-wert, 
	//aus Generierungsgruenden hier keine einheitliche Bezeichnung moeglich.
	dword thisval; // Display3AdditionalInfo2_2
	bitval= getValue(this);
	thisval = getValue(A_ASG_69_0_0_27_Data_19);
	thisval = thisval&~(1<<24)|(bitval<<24);
	putValue(A_ASG_69_0_0_27_Data_19,thisval);
}

on envVar A_ASG_69_0_0_27_Data_19_25
{
	byte bitval;
	//thisval steht hier fuer den bitfield-wert, 
	//aus Generierungsgruenden hier keine einheitliche Bezeichnung moeglich.
	dword thisval; // Display3AdditionalInfo2_2
	bitval= getValue(this);
	thisval = getValue(A_ASG_69_0_0_27_Data_19);
	thisval = thisval&~(1<<25)|(bitval<<25);
	putValue(A_ASG_69_0_0_27_Data_19,thisval);
}

on envVar A_ASG_69_0_0_27_Data_19_26
{
	byte bitval;
	//thisval steht hier fuer den bitfield-wert, 
	//aus Generierungsgruenden hier keine einheitliche Bezeichnung moeglich.
	dword thisval; // Display3AdditionalInfo2_2
	bitval= getValue(this);
	thisval = getValue(A_ASG_69_0_0_27_Data_19);
	thisval = thisval&~(1<<26)|(bitval<<26);
	putValue(A_ASG_69_0_0_27_Data_19,thisval);
}

on envVar A_ASG_69_0_0_27_Data_19_27
{
	byte bitval;
	//thisval steht hier fuer den bitfield-wert, 
	//aus Generierungsgruenden hier keine einheitliche Bezeichnung moeglich.
	dword thisval; // Display3AdditionalInfo2_2
	bitval= getValue(this);
	thisval = getValue(A_ASG_69_0_0_27_Data_19);
	thisval = thisval&~(1<<27)|(bitval<<27);
	putValue(A_ASG_69_0_0_27_Data_19,thisval);
}

on envVar A_ASG_69_0_0_27_Data_19_28
{
	byte bitval;
	//thisval steht hier fuer den bitfield-wert, 
	//aus Generierungsgruenden hier keine einheitliche Bezeichnung moeglich.
	dword thisval; // Display3AdditionalInfo2_2
	bitval= getValue(this);
	thisval = getValue(A_ASG_69_0_0_27_Data_19);
	thisval = thisval&~(1<<28)|(bitval<<28);
	putValue(A_ASG_69_0_0_27_Data_19,thisval);
}

on envVar A_ASG_69_0_0_27_Data_19_29
{
	byte bitval;
	//thisval steht hier fuer den bitfield-wert, 
	//aus Generierungsgruenden hier keine einheitliche Bezeichnung moeglich.
	dword thisval; // Display3AdditionalInfo2_2
	bitval= getValue(this);
	thisval = getValue(A_ASG_69_0_0_27_Data_19);
	thisval = thisval&~(1<<29)|(bitval<<29);
	putValue(A_ASG_69_0_0_27_Data_19,thisval);
}

on envVar A_ASG_69_0_0_27_Data_19
{
	byte superval[665];

	//Update Childvalue (BitField)
	byte mask=0x01;
	int i = 0;
	dword thisval; // Display3AdditionalInfo2_2
	thisval = getValue(this);
	if(thisval&(mask<<0))
		putValue(A_ASG_69_0_0_27_Data_19_0, 1);
	else
		putValue(A_ASG_69_0_0_27_Data_19_0, 0);
	if(thisval&(mask<<1))
		putValue(A_ASG_69_0_0_27_Data_19_1, 1);
	else
		putValue(A_ASG_69_0_0_27_Data_19_1, 0);
	if(thisval&(mask<<2))
		putValue(A_ASG_69_0_0_27_Data_19_2, 1);
	else
		putValue(A_ASG_69_0_0_27_Data_19_2, 0);
	if(thisval&(mask<<3))
		putValue(A_ASG_69_0_0_27_Data_19_3, 1);
	else
		putValue(A_ASG_69_0_0_27_Data_19_3, 0);
	if(thisval&(mask<<4))
		putValue(A_ASG_69_0_0_27_Data_19_4, 1);
	else
		putValue(A_ASG_69_0_0_27_Data_19_4, 0);
	if(thisval&(mask<<5))
		putValue(A_ASG_69_0_0_27_Data_19_5, 1);
	else
		putValue(A_ASG_69_0_0_27_Data_19_5, 0);
	if(thisval&(mask<<6))
		putValue(A_ASG_69_0_0_27_Data_19_6, 1);
	else
		putValue(A_ASG_69_0_0_27_Data_19_6, 0);
	if(thisval&(mask<<7))
		putValue(A_ASG_69_0_0_27_Data_19_7, 1);
	else
		putValue(A_ASG_69_0_0_27_Data_19_7, 0);
	if(thisval&(mask<<8))
		putValue(A_ASG_69_0_0_27_Data_19_8, 1);
	else
		putValue(A_ASG_69_0_0_27_Data_19_8, 0);
	if(thisval&(mask<<9))
		putValue(A_ASG_69_0_0_27_Data_19_9, 1);
	else
		putValue(A_ASG_69_0_0_27_Data_19_9, 0);
	if(thisval&(mask<<10))
		putValue(A_ASG_69_0_0_27_Data_19_10, 1);
	else
		putValue(A_ASG_69_0_0_27_Data_19_10, 0);
	if(thisval&(mask<<11))
		putValue(A_ASG_69_0_0_27_Data_19_11, 1);
	else
		putValue(A_ASG_69_0_0_27_Data_19_11, 0);
	if(thisval&(mask<<12))
		putValue(A_ASG_69_0_0_27_Data_19_12, 1);
	else
		putValue(A_ASG_69_0_0_27_Data_19_12, 0);
	if(thisval&(mask<<13))
		putValue(A_ASG_69_0_0_27_Data_19_13, 1);
	else
		putValue(A_ASG_69_0_0_27_Data_19_13, 0);
	if(thisval&(mask<<14))
		putValue(A_ASG_69_0_0_27_Data_19_14, 1);
	else
		putValue(A_ASG_69_0_0_27_Data_19_14, 0);
	if(thisval&(mask<<15))
		putValue(A_ASG_69_0_0_27_Data_19_15, 1);
	else
		putValue(A_ASG_69_0_0_27_Data_19_15, 0);
	if(thisval&(mask<<16))
		putValue(A_ASG_69_0_0_27_Data_19_16, 1);
	else
		putValue(A_ASG_69_0_0_27_Data_19_16, 0);
	if(thisval&(mask<<17))
		putValue(A_ASG_69_0_0_27_Data_19_17, 1);
	else
		putValue(A_ASG_69_0_0_27_Data_19_17, 0);
	if(thisval&(mask<<18))
		putValue(A_ASG_69_0_0_27_Data_19_18, 1);
	else
		putValue(A_ASG_69_0_0_27_Data_19_18, 0);
	if(thisval&(mask<<19))
		putValue(A_ASG_69_0_0_27_Data_19_19, 1);
	else
		putValue(A_ASG_69_0_0_27_Data_19_19, 0);
	if(thisval&(mask<<20))
		putValue(A_ASG_69_0_0_27_Data_19_20, 1);
	else
		putValue(A_ASG_69_0_0_27_Data_19_20, 0);
	if(thisval&(mask<<21))
		putValue(A_ASG_69_0_0_27_Data_19_21, 1);
	else
		putValue(A_ASG_69_0_0_27_Data_19_21, 0);
	if(thisval&(mask<<22))
		putValue(A_ASG_69_0_0_27_Data_19_22, 1);
	else
		putValue(A_ASG_69_0_0_27_Data_19_22, 0);
	if(thisval&(mask<<23))
		putValue(A_ASG_69_0_0_27_Data_19_23, 1);
	else
		putValue(A_ASG_69_0_0_27_Data_19_23, 0);
	if(thisval&(mask<<24))
		putValue(A_ASG_69_0_0_27_Data_19_24, 1);
	else
		putValue(A_ASG_69_0_0_27_Data_19_24, 0);
	if(thisval&(mask<<25))
		putValue(A_ASG_69_0_0_27_Data_19_25, 1);
	else
		putValue(A_ASG_69_0_0_27_Data_19_25, 0);
	if(thisval&(mask<<26))
		putValue(A_ASG_69_0_0_27_Data_19_26, 1);
	else
		putValue(A_ASG_69_0_0_27_Data_19_26, 0);
	if(thisval&(mask<<27))
		putValue(A_ASG_69_0_0_27_Data_19_27, 1);
	else
		putValue(A_ASG_69_0_0_27_Data_19_27, 0);
	if(thisval&(mask<<28))
		putValue(A_ASG_69_0_0_27_Data_19_28, 1);
	else
		putValue(A_ASG_69_0_0_27_Data_19_28, 0);
	if(thisval&(mask<<29))
		putValue(A_ASG_69_0_0_27_Data_19_29, 1);
	else
		putValue(A_ASG_69_0_0_27_Data_19_29, 0);
    A_ASG_69_0_0_27_ArrayDataList[getValue(A_ASG_69_0_0_27_DataIndex)].Param19 = thisval;
}

// Ueberwachung der CheckBox fuer String
on envVar  A_ASG_69_0_0_27_Data_20_cnt
{
	word len;
	byte cnt;
	len = getValue(A_ASG_69_0_0_27_Data_20_len);
	cnt = getValue(this);

    /* Cnt Wert im Array aktualisieren */
	 A_ASG_69_0_0_27_Data_20_CntList[ getValue(A_ASG_69_0_0_27_DataIndex) ] = cnt;

	/* wird nur gerufen, wenn check box deaktiviert mit Length>127*/ 
	if(cnt == 0) 
	{
		if(len > 127 )
		{
			putValue(A_ASG_69_0_0_27_Data_20_len, 127);
		}
	}

}


on envVar A_ASG_69_0_0_27_Data_20_len
{
	long thisval;
	byte cnt;
	thisval = getValue(this);
	cnt = getValue(A_ASG_69_0_0_27_Data_20_cnt);

	/* wenn die Laenge ausserhalb des erlaubten Bereich liegt, wird diese begrenzt */
	if(thisval > 1 || thisval < 0 )
	{
		writelineEx(gBAP_Trace, 0, "Eingegebene Laenge: %d von A_ASG_69_0_0_27_Data_20 ist ungueltig. Die max. erlaubte Laenge ist %d. ", thisval, 1);
		thisval = 1;
	}
	if( thisval >127)
	{
		putValue(A_ASG_69_0_0_27_Data_20_cnt, 1); /* Switch checkbox on */
	}

	A_ASG_69_0_0_27_ArrayDataList[getValue(A_ASG_69_0_0_27_DataIndex)].Param20_Length = thisval;
	A_ASG_69_0_0_27_Data_20_LenList[ getValue(A_ASG_69_0_0_27_DataIndex) ] = thisval;
	putValue(A_ASG_69_0_0_27_Data_20_len, thisval);

}

on envVar A_ASG_69_0_0_27_Data_20
{
	byte superval[665];

	//Update Childvalue (String)
	word i;
	byte thisval[2];
	getValue(this, thisval);
    for(i = 0; i < getValueSize(this); i++)
        A_ASG_69_0_0_27_ArrayDataList[getValue(A_ASG_69_0_0_27_DataIndex)].Param20[i] = thisval[i];
    A_ASG_69_0_0_27_ArrayDataList[getValue(A_ASG_69_0_0_27_DataIndex)].Param20_Length = getValueSize(this);
    A_ASG_69_0_0_27_Data_20_LenList[getValue(A_ASG_69_0_0_27_DataIndex)]= getValueSize(this);
    putValue(A_ASG_69_0_0_27_Data_20_len, getValueSize(this));
}
on envVar A_ASG_69_0_0_27_1_SetGet
{
	byte superval[664];

	//Update Childvalue (Enum)
	byte thisval; // ASG_ID
	thisval = 0x0f & getValue(this);
}
// Ueberwachung der Darstellungsvariable der Range.
on envVar A_ASG_69_0_0_27_2_SetGet_range // DisplayPresets.TAID 
{
	@A_ASG_69_0_0_27_2_SetGet = @A_ASG_69_0_0_27_2_SetGet_range - (0); // slider = range - min
}

on envVar A_ASG_69_0_0_27_2_SetGet
{
	byte superval[664];

	//Update Childvalue (Number)
	byte thisval; // TAID
	float slider_value;

	slider_value = round(@A_ASG_69_0_0_27_2_SetGet, 1.0);
	@A_ASG_69_0_0_27_2_SetGet_range = slider_value + (0); // real value := slider value + range min.
	thisval = (byte)round((slider_value + (0) - (0)) / (1.0), 1); // bus value := (slider value + min - offset) / step.
}
// Ueberwachung der Darstellungsvariable der Range.
on envVar A_ASG_69_0_0_27_Data_1_SetGet_range // DisplayPresets.Pos 
{
	@A_ASG_69_0_0_27_Data_1_SetGet = @A_ASG_69_0_0_27_Data_1_SetGet_range - (0); // slider = range - min
}

on envVar A_ASG_69_0_0_27_Data_1_SetGet
{
	byte superval[664];

	//Update Childvalue (Number)
	byte thisval; // Pos
	float slider_value;

	slider_value = round(@A_ASG_69_0_0_27_Data_1_SetGet, 1.0);
	@A_ASG_69_0_0_27_Data_1_SetGet_range = slider_value + (0); // real value := slider value + range min.
	thisval = (byte)round((slider_value + (0) - (0)) / (1.0), 1); // bus value := (slider value + min - offset) / step.
    A_ASG_69_0_0_27_ArrayDataList[getValue(A_ASG_69_0_0_27_DataIndex_SetGet)].Param1 = thisval;
}
on envVar A_ASG_69_0_0_27_Data_2_SetGet
{
	byte superval[664];

	//Update Childvalue (Enum)
	byte thisval; // State
	thisval = getValue(this);
    A_ASG_69_0_0_27_ArrayDataList[getValue(A_ASG_69_0_0_27_DataIndex_SetGet)].Param2 = thisval;
}
on envVar A_ASG_69_0_0_27_Data_3_SetGet
{
	byte superval[664];

	//Update Childvalue (Enum)
	byte thisval; // DisplayPresetType
	thisval = getValue(this);
    A_ASG_69_0_0_27_ArrayDataList[getValue(A_ASG_69_0_0_27_DataIndex_SetGet)].Param3 = thisval;
}
// Ueberwachung der Darstellungsvariable der Range.
on envVar A_ASG_69_0_0_27_Data_4_SetGet_range // DisplayPresets.DisplayPresetInstance 
{
	@A_ASG_69_0_0_27_Data_4_SetGet = @A_ASG_69_0_0_27_Data_4_SetGet_range - (0); // slider = range - min
}

on envVar A_ASG_69_0_0_27_Data_4_SetGet
{
	byte superval[664];

	//Update Childvalue (Number)
	byte thisval; // DisplayPresetInstance
	float slider_value;

	slider_value = round(@A_ASG_69_0_0_27_Data_4_SetGet, 1.0);
	@A_ASG_69_0_0_27_Data_4_SetGet_range = slider_value + (0); // real value := slider value + range min.
	thisval = (byte)round((slider_value + (0) - (0)) / (1.0), 1); // bus value := (slider value + min - offset) / step.
    A_ASG_69_0_0_27_ArrayDataList[getValue(A_ASG_69_0_0_27_DataIndex_SetGet)].Param4 = thisval;
}
on envVar A_ASG_69_0_0_27_Data_5_SetGet_0
{
	byte bitval;
	//thisval steht hier fuer den bitfield-wert, 
	//aus Generierungsgruenden hier keine einheitliche Bezeichnung moeglich.
	dword thisval; // Display1MainSelection
	bitval= getValue(this);
	thisval = getValue(A_ASG_69_0_0_27_Data_5_SetGet);
	thisval = thisval&~(1<<0)|(bitval<<0);
	putValue(A_ASG_69_0_0_27_Data_5_SetGet,thisval);
}

on envVar A_ASG_69_0_0_27_Data_5_SetGet_1
{
	byte bitval;
	//thisval steht hier fuer den bitfield-wert, 
	//aus Generierungsgruenden hier keine einheitliche Bezeichnung moeglich.
	dword thisval; // Display1MainSelection
	bitval= getValue(this);
	thisval = getValue(A_ASG_69_0_0_27_Data_5_SetGet);
	thisval = thisval&~(1<<1)|(bitval<<1);
	putValue(A_ASG_69_0_0_27_Data_5_SetGet,thisval);
}

on envVar A_ASG_69_0_0_27_Data_5_SetGet_2
{
	byte bitval;
	//thisval steht hier fuer den bitfield-wert, 
	//aus Generierungsgruenden hier keine einheitliche Bezeichnung moeglich.
	dword thisval; // Display1MainSelection
	bitval= getValue(this);
	thisval = getValue(A_ASG_69_0_0_27_Data_5_SetGet);
	thisval = thisval&~(1<<2)|(bitval<<2);
	putValue(A_ASG_69_0_0_27_Data_5_SetGet,thisval);
}

on envVar A_ASG_69_0_0_27_Data_5_SetGet_3
{
	byte bitval;
	//thisval steht hier fuer den bitfield-wert, 
	//aus Generierungsgruenden hier keine einheitliche Bezeichnung moeglich.
	dword thisval; // Display1MainSelection
	bitval= getValue(this);
	thisval = getValue(A_ASG_69_0_0_27_Data_5_SetGet);
	thisval = thisval&~(1<<3)|(bitval<<3);
	putValue(A_ASG_69_0_0_27_Data_5_SetGet,thisval);
}

on envVar A_ASG_69_0_0_27_Data_5_SetGet_4
{
	byte bitval;
	//thisval steht hier fuer den bitfield-wert, 
	//aus Generierungsgruenden hier keine einheitliche Bezeichnung moeglich.
	dword thisval; // Display1MainSelection
	bitval= getValue(this);
	thisval = getValue(A_ASG_69_0_0_27_Data_5_SetGet);
	thisval = thisval&~(1<<4)|(bitval<<4);
	putValue(A_ASG_69_0_0_27_Data_5_SetGet,thisval);
}

on envVar A_ASG_69_0_0_27_Data_5_SetGet_5
{
	byte bitval;
	//thisval steht hier fuer den bitfield-wert, 
	//aus Generierungsgruenden hier keine einheitliche Bezeichnung moeglich.
	dword thisval; // Display1MainSelection
	bitval= getValue(this);
	thisval = getValue(A_ASG_69_0_0_27_Data_5_SetGet);
	thisval = thisval&~(1<<5)|(bitval<<5);
	putValue(A_ASG_69_0_0_27_Data_5_SetGet,thisval);
}

on envVar A_ASG_69_0_0_27_Data_5_SetGet_6
{
	byte bitval;
	//thisval steht hier fuer den bitfield-wert, 
	//aus Generierungsgruenden hier keine einheitliche Bezeichnung moeglich.
	dword thisval; // Display1MainSelection
	bitval= getValue(this);
	thisval = getValue(A_ASG_69_0_0_27_Data_5_SetGet);
	thisval = thisval&~(1<<6)|(bitval<<6);
	putValue(A_ASG_69_0_0_27_Data_5_SetGet,thisval);
}

on envVar A_ASG_69_0_0_27_Data_5_SetGet_7
{
	byte bitval;
	//thisval steht hier fuer den bitfield-wert, 
	//aus Generierungsgruenden hier keine einheitliche Bezeichnung moeglich.
	dword thisval; // Display1MainSelection
	bitval= getValue(this);
	thisval = getValue(A_ASG_69_0_0_27_Data_5_SetGet);
	thisval = thisval&~(1<<7)|(bitval<<7);
	putValue(A_ASG_69_0_0_27_Data_5_SetGet,thisval);
}

on envVar A_ASG_69_0_0_27_Data_5_SetGet_8
{
	byte bitval;
	//thisval steht hier fuer den bitfield-wert, 
	//aus Generierungsgruenden hier keine einheitliche Bezeichnung moeglich.
	dword thisval; // Display1MainSelection
	bitval= getValue(this);
	thisval = getValue(A_ASG_69_0_0_27_Data_5_SetGet);
	thisval = thisval&~(1<<8)|(bitval<<8);
	putValue(A_ASG_69_0_0_27_Data_5_SetGet,thisval);
}

on envVar A_ASG_69_0_0_27_Data_5_SetGet_9
{
	byte bitval;
	//thisval steht hier fuer den bitfield-wert, 
	//aus Generierungsgruenden hier keine einheitliche Bezeichnung moeglich.
	dword thisval; // Display1MainSelection
	bitval= getValue(this);
	thisval = getValue(A_ASG_69_0_0_27_Data_5_SetGet);
	thisval = thisval&~(1<<9)|(bitval<<9);
	putValue(A_ASG_69_0_0_27_Data_5_SetGet,thisval);
}

on envVar A_ASG_69_0_0_27_Data_5_SetGet_10
{
	byte bitval;
	//thisval steht hier fuer den bitfield-wert, 
	//aus Generierungsgruenden hier keine einheitliche Bezeichnung moeglich.
	dword thisval; // Display1MainSelection
	bitval= getValue(this);
	thisval = getValue(A_ASG_69_0_0_27_Data_5_SetGet);
	thisval = thisval&~(1<<10)|(bitval<<10);
	putValue(A_ASG_69_0_0_27_Data_5_SetGet,thisval);
}

on envVar A_ASG_69_0_0_27_Data_5_SetGet_11
{
	byte bitval;
	//thisval steht hier fuer den bitfield-wert, 
	//aus Generierungsgruenden hier keine einheitliche Bezeichnung moeglich.
	dword thisval; // Display1MainSelection
	bitval= getValue(this);
	thisval = getValue(A_ASG_69_0_0_27_Data_5_SetGet);
	thisval = thisval&~(1<<11)|(bitval<<11);
	putValue(A_ASG_69_0_0_27_Data_5_SetGet,thisval);
}

on envVar A_ASG_69_0_0_27_Data_5_SetGet_12
{
	byte bitval;
	//thisval steht hier fuer den bitfield-wert, 
	//aus Generierungsgruenden hier keine einheitliche Bezeichnung moeglich.
	dword thisval; // Display1MainSelection
	bitval= getValue(this);
	thisval = getValue(A_ASG_69_0_0_27_Data_5_SetGet);
	thisval = thisval&~(1<<12)|(bitval<<12);
	putValue(A_ASG_69_0_0_27_Data_5_SetGet,thisval);
}

on envVar A_ASG_69_0_0_27_Data_5_SetGet_13
{
	byte bitval;
	//thisval steht hier fuer den bitfield-wert, 
	//aus Generierungsgruenden hier keine einheitliche Bezeichnung moeglich.
	dword thisval; // Display1MainSelection
	bitval= getValue(this);
	thisval = getValue(A_ASG_69_0_0_27_Data_5_SetGet);
	thisval = thisval&~(1<<13)|(bitval<<13);
	putValue(A_ASG_69_0_0_27_Data_5_SetGet,thisval);
}

on envVar A_ASG_69_0_0_27_Data_5_SetGet_14
{
	byte bitval;
	//thisval steht hier fuer den bitfield-wert, 
	//aus Generierungsgruenden hier keine einheitliche Bezeichnung moeglich.
	dword thisval; // Display1MainSelection
	bitval= getValue(this);
	thisval = getValue(A_ASG_69_0_0_27_Data_5_SetGet);
	thisval = thisval&~(1<<14)|(bitval<<14);
	putValue(A_ASG_69_0_0_27_Data_5_SetGet,thisval);
}

on envVar A_ASG_69_0_0_27_Data_5_SetGet_15
{
	byte bitval;
	//thisval steht hier fuer den bitfield-wert, 
	//aus Generierungsgruenden hier keine einheitliche Bezeichnung moeglich.
	dword thisval; // Display1MainSelection
	bitval= getValue(this);
	thisval = getValue(A_ASG_69_0_0_27_Data_5_SetGet);
	thisval = thisval&~(1<<15)|(bitval<<15);
	putValue(A_ASG_69_0_0_27_Data_5_SetGet,thisval);
}

on envVar A_ASG_69_0_0_27_Data_5_SetGet_16
{
	byte bitval;
	//thisval steht hier fuer den bitfield-wert, 
	//aus Generierungsgruenden hier keine einheitliche Bezeichnung moeglich.
	dword thisval; // Display1MainSelection
	bitval= getValue(this);
	thisval = getValue(A_ASG_69_0_0_27_Data_5_SetGet);
	thisval = thisval&~(1<<16)|(bitval<<16);
	putValue(A_ASG_69_0_0_27_Data_5_SetGet,thisval);
}

on envVar A_ASG_69_0_0_27_Data_5_SetGet_17
{
	byte bitval;
	//thisval steht hier fuer den bitfield-wert, 
	//aus Generierungsgruenden hier keine einheitliche Bezeichnung moeglich.
	dword thisval; // Display1MainSelection
	bitval= getValue(this);
	thisval = getValue(A_ASG_69_0_0_27_Data_5_SetGet);
	thisval = thisval&~(1<<17)|(bitval<<17);
	putValue(A_ASG_69_0_0_27_Data_5_SetGet,thisval);
}

on envVar A_ASG_69_0_0_27_Data_5_SetGet_18
{
	byte bitval;
	//thisval steht hier fuer den bitfield-wert, 
	//aus Generierungsgruenden hier keine einheitliche Bezeichnung moeglich.
	dword thisval; // Display1MainSelection
	bitval= getValue(this);
	thisval = getValue(A_ASG_69_0_0_27_Data_5_SetGet);
	thisval = thisval&~(1<<18)|(bitval<<18);
	putValue(A_ASG_69_0_0_27_Data_5_SetGet,thisval);
}

on envVar A_ASG_69_0_0_27_Data_5_SetGet_19
{
	byte bitval;
	//thisval steht hier fuer den bitfield-wert, 
	//aus Generierungsgruenden hier keine einheitliche Bezeichnung moeglich.
	dword thisval; // Display1MainSelection
	bitval= getValue(this);
	thisval = getValue(A_ASG_69_0_0_27_Data_5_SetGet);
	thisval = thisval&~(1<<19)|(bitval<<19);
	putValue(A_ASG_69_0_0_27_Data_5_SetGet,thisval);
}

on envVar A_ASG_69_0_0_27_Data_5_SetGet_20
{
	byte bitval;
	//thisval steht hier fuer den bitfield-wert, 
	//aus Generierungsgruenden hier keine einheitliche Bezeichnung moeglich.
	dword thisval; // Display1MainSelection
	bitval= getValue(this);
	thisval = getValue(A_ASG_69_0_0_27_Data_5_SetGet);
	thisval = thisval&~(1<<20)|(bitval<<20);
	putValue(A_ASG_69_0_0_27_Data_5_SetGet,thisval);
}

on envVar A_ASG_69_0_0_27_Data_5_SetGet_21
{
	byte bitval;
	//thisval steht hier fuer den bitfield-wert, 
	//aus Generierungsgruenden hier keine einheitliche Bezeichnung moeglich.
	dword thisval; // Display1MainSelection
	bitval= getValue(this);
	thisval = getValue(A_ASG_69_0_0_27_Data_5_SetGet);
	thisval = thisval&~(1<<21)|(bitval<<21);
	putValue(A_ASG_69_0_0_27_Data_5_SetGet,thisval);
}

on envVar A_ASG_69_0_0_27_Data_5_SetGet_22
{
	byte bitval;
	//thisval steht hier fuer den bitfield-wert, 
	//aus Generierungsgruenden hier keine einheitliche Bezeichnung moeglich.
	dword thisval; // Display1MainSelection
	bitval= getValue(this);
	thisval = getValue(A_ASG_69_0_0_27_Data_5_SetGet);
	thisval = thisval&~(1<<22)|(bitval<<22);
	putValue(A_ASG_69_0_0_27_Data_5_SetGet,thisval);
}

on envVar A_ASG_69_0_0_27_Data_5_SetGet_23
{
	byte bitval;
	//thisval steht hier fuer den bitfield-wert, 
	//aus Generierungsgruenden hier keine einheitliche Bezeichnung moeglich.
	dword thisval; // Display1MainSelection
	bitval= getValue(this);
	thisval = getValue(A_ASG_69_0_0_27_Data_5_SetGet);
	thisval = thisval&~(1<<23)|(bitval<<23);
	putValue(A_ASG_69_0_0_27_Data_5_SetGet,thisval);
}

on envVar A_ASG_69_0_0_27_Data_5_SetGet_24
{
	byte bitval;
	//thisval steht hier fuer den bitfield-wert, 
	//aus Generierungsgruenden hier keine einheitliche Bezeichnung moeglich.
	dword thisval; // Display1MainSelection
	bitval= getValue(this);
	thisval = getValue(A_ASG_69_0_0_27_Data_5_SetGet);
	thisval = thisval&~(1<<24)|(bitval<<24);
	putValue(A_ASG_69_0_0_27_Data_5_SetGet,thisval);
}

on envVar A_ASG_69_0_0_27_Data_5_SetGet_25
{
	byte bitval;
	//thisval steht hier fuer den bitfield-wert, 
	//aus Generierungsgruenden hier keine einheitliche Bezeichnung moeglich.
	dword thisval; // Display1MainSelection
	bitval= getValue(this);
	thisval = getValue(A_ASG_69_0_0_27_Data_5_SetGet);
	thisval = thisval&~(1<<25)|(bitval<<25);
	putValue(A_ASG_69_0_0_27_Data_5_SetGet,thisval);
}

on envVar A_ASG_69_0_0_27_Data_5_SetGet_26
{
	byte bitval;
	//thisval steht hier fuer den bitfield-wert, 
	//aus Generierungsgruenden hier keine einheitliche Bezeichnung moeglich.
	dword thisval; // Display1MainSelection
	bitval= getValue(this);
	thisval = getValue(A_ASG_69_0_0_27_Data_5_SetGet);
	thisval = thisval&~(1<<26)|(bitval<<26);
	putValue(A_ASG_69_0_0_27_Data_5_SetGet,thisval);
}

on envVar A_ASG_69_0_0_27_Data_5_SetGet_27
{
	byte bitval;
	//thisval steht hier fuer den bitfield-wert, 
	//aus Generierungsgruenden hier keine einheitliche Bezeichnung moeglich.
	dword thisval; // Display1MainSelection
	bitval= getValue(this);
	thisval = getValue(A_ASG_69_0_0_27_Data_5_SetGet);
	thisval = thisval&~(1<<27)|(bitval<<27);
	putValue(A_ASG_69_0_0_27_Data_5_SetGet,thisval);
}

on envVar A_ASG_69_0_0_27_Data_5_SetGet
{
	byte superval[664];

	//Update Childvalue (BitField)
	byte mask=0x01;
	int i = 0;
	dword thisval; // Display1MainSelection
	thisval = getValue(this);
	if(thisval&(mask<<0))
		putValue(A_ASG_69_0_0_27_Data_5_SetGet_0, 1);
	else
		putValue(A_ASG_69_0_0_27_Data_5_SetGet_0, 0);
	if(thisval&(mask<<1))
		putValue(A_ASG_69_0_0_27_Data_5_SetGet_1, 1);
	else
		putValue(A_ASG_69_0_0_27_Data_5_SetGet_1, 0);
	if(thisval&(mask<<2))
		putValue(A_ASG_69_0_0_27_Data_5_SetGet_2, 1);
	else
		putValue(A_ASG_69_0_0_27_Data_5_SetGet_2, 0);
	if(thisval&(mask<<3))
		putValue(A_ASG_69_0_0_27_Data_5_SetGet_3, 1);
	else
		putValue(A_ASG_69_0_0_27_Data_5_SetGet_3, 0);
	if(thisval&(mask<<4))
		putValue(A_ASG_69_0_0_27_Data_5_SetGet_4, 1);
	else
		putValue(A_ASG_69_0_0_27_Data_5_SetGet_4, 0);
	if(thisval&(mask<<5))
		putValue(A_ASG_69_0_0_27_Data_5_SetGet_5, 1);
	else
		putValue(A_ASG_69_0_0_27_Data_5_SetGet_5, 0);
	if(thisval&(mask<<6))
		putValue(A_ASG_69_0_0_27_Data_5_SetGet_6, 1);
	else
		putValue(A_ASG_69_0_0_27_Data_5_SetGet_6, 0);
	if(thisval&(mask<<7))
		putValue(A_ASG_69_0_0_27_Data_5_SetGet_7, 1);
	else
		putValue(A_ASG_69_0_0_27_Data_5_SetGet_7, 0);
	if(thisval&(mask<<8))
		putValue(A_ASG_69_0_0_27_Data_5_SetGet_8, 1);
	else
		putValue(A_ASG_69_0_0_27_Data_5_SetGet_8, 0);
	if(thisval&(mask<<9))
		putValue(A_ASG_69_0_0_27_Data_5_SetGet_9, 1);
	else
		putValue(A_ASG_69_0_0_27_Data_5_SetGet_9, 0);
	if(thisval&(mask<<10))
		putValue(A_ASG_69_0_0_27_Data_5_SetGet_10, 1);
	else
		putValue(A_ASG_69_0_0_27_Data_5_SetGet_10, 0);
	if(thisval&(mask<<11))
		putValue(A_ASG_69_0_0_27_Data_5_SetGet_11, 1);
	else
		putValue(A_ASG_69_0_0_27_Data_5_SetGet_11, 0);
	if(thisval&(mask<<12))
		putValue(A_ASG_69_0_0_27_Data_5_SetGet_12, 1);
	else
		putValue(A_ASG_69_0_0_27_Data_5_SetGet_12, 0);
	if(thisval&(mask<<13))
		putValue(A_ASG_69_0_0_27_Data_5_SetGet_13, 1);
	else
		putValue(A_ASG_69_0_0_27_Data_5_SetGet_13, 0);
	if(thisval&(mask<<14))
		putValue(A_ASG_69_0_0_27_Data_5_SetGet_14, 1);
	else
		putValue(A_ASG_69_0_0_27_Data_5_SetGet_14, 0);
	if(thisval&(mask<<15))
		putValue(A_ASG_69_0_0_27_Data_5_SetGet_15, 1);
	else
		putValue(A_ASG_69_0_0_27_Data_5_SetGet_15, 0);
	if(thisval&(mask<<16))
		putValue(A_ASG_69_0_0_27_Data_5_SetGet_16, 1);
	else
		putValue(A_ASG_69_0_0_27_Data_5_SetGet_16, 0);
	if(thisval&(mask<<17))
		putValue(A_ASG_69_0_0_27_Data_5_SetGet_17, 1);
	else
		putValue(A_ASG_69_0_0_27_Data_5_SetGet_17, 0);
	if(thisval&(mask<<18))
		putValue(A_ASG_69_0_0_27_Data_5_SetGet_18, 1);
	else
		putValue(A_ASG_69_0_0_27_Data_5_SetGet_18, 0);
	if(thisval&(mask<<19))
		putValue(A_ASG_69_0_0_27_Data_5_SetGet_19, 1);
	else
		putValue(A_ASG_69_0_0_27_Data_5_SetGet_19, 0);
	if(thisval&(mask<<20))
		putValue(A_ASG_69_0_0_27_Data_5_SetGet_20, 1);
	else
		putValue(A_ASG_69_0_0_27_Data_5_SetGet_20, 0);
	if(thisval&(mask<<21))
		putValue(A_ASG_69_0_0_27_Data_5_SetGet_21, 1);
	else
		putValue(A_ASG_69_0_0_27_Data_5_SetGet_21, 0);
	if(thisval&(mask<<22))
		putValue(A_ASG_69_0_0_27_Data_5_SetGet_22, 1);
	else
		putValue(A_ASG_69_0_0_27_Data_5_SetGet_22, 0);
	if(thisval&(mask<<23))
		putValue(A_ASG_69_0_0_27_Data_5_SetGet_23, 1);
	else
		putValue(A_ASG_69_0_0_27_Data_5_SetGet_23, 0);
	if(thisval&(mask<<24))
		putValue(A_ASG_69_0_0_27_Data_5_SetGet_24, 1);
	else
		putValue(A_ASG_69_0_0_27_Data_5_SetGet_24, 0);
	if(thisval&(mask<<25))
		putValue(A_ASG_69_0_0_27_Data_5_SetGet_25, 1);
	else
		putValue(A_ASG_69_0_0_27_Data_5_SetGet_25, 0);
	if(thisval&(mask<<26))
		putValue(A_ASG_69_0_0_27_Data_5_SetGet_26, 1);
	else
		putValue(A_ASG_69_0_0_27_Data_5_SetGet_26, 0);
	if(thisval&(mask<<27))
		putValue(A_ASG_69_0_0_27_Data_5_SetGet_27, 1);
	else
		putValue(A_ASG_69_0_0_27_Data_5_SetGet_27, 0);
    A_ASG_69_0_0_27_ArrayDataList[getValue(A_ASG_69_0_0_27_DataIndex_SetGet)].Param5 = thisval;
}
on envVar A_ASG_69_0_0_27_Data_6_SetGet_0
{
	byte bitval;
	//thisval steht hier fuer den bitfield-wert, 
	//aus Generierungsgruenden hier keine einheitliche Bezeichnung moeglich.
	dword thisval; // Display1AdditionalInfo1_1
	bitval= getValue(this);
	thisval = getValue(A_ASG_69_0_0_27_Data_6_SetGet);
	thisval = thisval&~(1<<0)|(bitval<<0);
	putValue(A_ASG_69_0_0_27_Data_6_SetGet,thisval);
}

on envVar A_ASG_69_0_0_27_Data_6_SetGet_1
{
	byte bitval;
	//thisval steht hier fuer den bitfield-wert, 
	//aus Generierungsgruenden hier keine einheitliche Bezeichnung moeglich.
	dword thisval; // Display1AdditionalInfo1_1
	bitval= getValue(this);
	thisval = getValue(A_ASG_69_0_0_27_Data_6_SetGet);
	thisval = thisval&~(1<<1)|(bitval<<1);
	putValue(A_ASG_69_0_0_27_Data_6_SetGet,thisval);
}

on envVar A_ASG_69_0_0_27_Data_6_SetGet_2
{
	byte bitval;
	//thisval steht hier fuer den bitfield-wert, 
	//aus Generierungsgruenden hier keine einheitliche Bezeichnung moeglich.
	dword thisval; // Display1AdditionalInfo1_1
	bitval= getValue(this);
	thisval = getValue(A_ASG_69_0_0_27_Data_6_SetGet);
	thisval = thisval&~(1<<2)|(bitval<<2);
	putValue(A_ASG_69_0_0_27_Data_6_SetGet,thisval);
}

on envVar A_ASG_69_0_0_27_Data_6_SetGet_3
{
	byte bitval;
	//thisval steht hier fuer den bitfield-wert, 
	//aus Generierungsgruenden hier keine einheitliche Bezeichnung moeglich.
	dword thisval; // Display1AdditionalInfo1_1
	bitval= getValue(this);
	thisval = getValue(A_ASG_69_0_0_27_Data_6_SetGet);
	thisval = thisval&~(1<<3)|(bitval<<3);
	putValue(A_ASG_69_0_0_27_Data_6_SetGet,thisval);
}

on envVar A_ASG_69_0_0_27_Data_6_SetGet_4
{
	byte bitval;
	//thisval steht hier fuer den bitfield-wert, 
	//aus Generierungsgruenden hier keine einheitliche Bezeichnung moeglich.
	dword thisval; // Display1AdditionalInfo1_1
	bitval= getValue(this);
	thisval = getValue(A_ASG_69_0_0_27_Data_6_SetGet);
	thisval = thisval&~(1<<4)|(bitval<<4);
	putValue(A_ASG_69_0_0_27_Data_6_SetGet,thisval);
}

on envVar A_ASG_69_0_0_27_Data_6_SetGet_5
{
	byte bitval;
	//thisval steht hier fuer den bitfield-wert, 
	//aus Generierungsgruenden hier keine einheitliche Bezeichnung moeglich.
	dword thisval; // Display1AdditionalInfo1_1
	bitval= getValue(this);
	thisval = getValue(A_ASG_69_0_0_27_Data_6_SetGet);
	thisval = thisval&~(1<<5)|(bitval<<5);
	putValue(A_ASG_69_0_0_27_Data_6_SetGet,thisval);
}

on envVar A_ASG_69_0_0_27_Data_6_SetGet_6
{
	byte bitval;
	//thisval steht hier fuer den bitfield-wert, 
	//aus Generierungsgruenden hier keine einheitliche Bezeichnung moeglich.
	dword thisval; // Display1AdditionalInfo1_1
	bitval= getValue(this);
	thisval = getValue(A_ASG_69_0_0_27_Data_6_SetGet);
	thisval = thisval&~(1<<6)|(bitval<<6);
	putValue(A_ASG_69_0_0_27_Data_6_SetGet,thisval);
}

on envVar A_ASG_69_0_0_27_Data_6_SetGet_7
{
	byte bitval;
	//thisval steht hier fuer den bitfield-wert, 
	//aus Generierungsgruenden hier keine einheitliche Bezeichnung moeglich.
	dword thisval; // Display1AdditionalInfo1_1
	bitval= getValue(this);
	thisval = getValue(A_ASG_69_0_0_27_Data_6_SetGet);
	thisval = thisval&~(1<<7)|(bitval<<7);
	putValue(A_ASG_69_0_0_27_Data_6_SetGet,thisval);
}

on envVar A_ASG_69_0_0_27_Data_6_SetGet_8
{
	byte bitval;
	//thisval steht hier fuer den bitfield-wert, 
	//aus Generierungsgruenden hier keine einheitliche Bezeichnung moeglich.
	dword thisval; // Display1AdditionalInfo1_1
	bitval= getValue(this);
	thisval = getValue(A_ASG_69_0_0_27_Data_6_SetGet);
	thisval = thisval&~(1<<8)|(bitval<<8);
	putValue(A_ASG_69_0_0_27_Data_6_SetGet,thisval);
}

on envVar A_ASG_69_0_0_27_Data_6_SetGet_9
{
	byte bitval;
	//thisval steht hier fuer den bitfield-wert, 
	//aus Generierungsgruenden hier keine einheitliche Bezeichnung moeglich.
	dword thisval; // Display1AdditionalInfo1_1
	bitval= getValue(this);
	thisval = getValue(A_ASG_69_0_0_27_Data_6_SetGet);
	thisval = thisval&~(1<<9)|(bitval<<9);
	putValue(A_ASG_69_0_0_27_Data_6_SetGet,thisval);
}

on envVar A_ASG_69_0_0_27_Data_6_SetGet_10
{
	byte bitval;
	//thisval steht hier fuer den bitfield-wert, 
	//aus Generierungsgruenden hier keine einheitliche Bezeichnung moeglich.
	dword thisval; // Display1AdditionalInfo1_1
	bitval= getValue(this);
	thisval = getValue(A_ASG_69_0_0_27_Data_6_SetGet);
	thisval = thisval&~(1<<10)|(bitval<<10);
	putValue(A_ASG_69_0_0_27_Data_6_SetGet,thisval);
}

on envVar A_ASG_69_0_0_27_Data_6_SetGet_11
{
	byte bitval;
	//thisval steht hier fuer den bitfield-wert, 
	//aus Generierungsgruenden hier keine einheitliche Bezeichnung moeglich.
	dword thisval; // Display1AdditionalInfo1_1
	bitval= getValue(this);
	thisval = getValue(A_ASG_69_0_0_27_Data_6_SetGet);
	thisval = thisval&~(1<<11)|(bitval<<11);
	putValue(A_ASG_69_0_0_27_Data_6_SetGet,thisval);
}

on envVar A_ASG_69_0_0_27_Data_6_SetGet_12
{
	byte bitval;
	//thisval steht hier fuer den bitfield-wert, 
	//aus Generierungsgruenden hier keine einheitliche Bezeichnung moeglich.
	dword thisval; // Display1AdditionalInfo1_1
	bitval= getValue(this);
	thisval = getValue(A_ASG_69_0_0_27_Data_6_SetGet);
	thisval = thisval&~(1<<12)|(bitval<<12);
	putValue(A_ASG_69_0_0_27_Data_6_SetGet,thisval);
}

on envVar A_ASG_69_0_0_27_Data_6_SetGet_13
{
	byte bitval;
	//thisval steht hier fuer den bitfield-wert, 
	//aus Generierungsgruenden hier keine einheitliche Bezeichnung moeglich.
	dword thisval; // Display1AdditionalInfo1_1
	bitval= getValue(this);
	thisval = getValue(A_ASG_69_0_0_27_Data_6_SetGet);
	thisval = thisval&~(1<<13)|(bitval<<13);
	putValue(A_ASG_69_0_0_27_Data_6_SetGet,thisval);
}

on envVar A_ASG_69_0_0_27_Data_6_SetGet_14
{
	byte bitval;
	//thisval steht hier fuer den bitfield-wert, 
	//aus Generierungsgruenden hier keine einheitliche Bezeichnung moeglich.
	dword thisval; // Display1AdditionalInfo1_1
	bitval= getValue(this);
	thisval = getValue(A_ASG_69_0_0_27_Data_6_SetGet);
	thisval = thisval&~(1<<14)|(bitval<<14);
	putValue(A_ASG_69_0_0_27_Data_6_SetGet,thisval);
}

on envVar A_ASG_69_0_0_27_Data_6_SetGet_15
{
	byte bitval;
	//thisval steht hier fuer den bitfield-wert, 
	//aus Generierungsgruenden hier keine einheitliche Bezeichnung moeglich.
	dword thisval; // Display1AdditionalInfo1_1
	bitval= getValue(this);
	thisval = getValue(A_ASG_69_0_0_27_Data_6_SetGet);
	thisval = thisval&~(1<<15)|(bitval<<15);
	putValue(A_ASG_69_0_0_27_Data_6_SetGet,thisval);
}

on envVar A_ASG_69_0_0_27_Data_6_SetGet_16
{
	byte bitval;
	//thisval steht hier fuer den bitfield-wert, 
	//aus Generierungsgruenden hier keine einheitliche Bezeichnung moeglich.
	dword thisval; // Display1AdditionalInfo1_1
	bitval= getValue(this);
	thisval = getValue(A_ASG_69_0_0_27_Data_6_SetGet);
	thisval = thisval&~(1<<16)|(bitval<<16);
	putValue(A_ASG_69_0_0_27_Data_6_SetGet,thisval);
}

on envVar A_ASG_69_0_0_27_Data_6_SetGet_17
{
	byte bitval;
	//thisval steht hier fuer den bitfield-wert, 
	//aus Generierungsgruenden hier keine einheitliche Bezeichnung moeglich.
	dword thisval; // Display1AdditionalInfo1_1
	bitval= getValue(this);
	thisval = getValue(A_ASG_69_0_0_27_Data_6_SetGet);
	thisval = thisval&~(1<<17)|(bitval<<17);
	putValue(A_ASG_69_0_0_27_Data_6_SetGet,thisval);
}

on envVar A_ASG_69_0_0_27_Data_6_SetGet_18
{
	byte bitval;
	//thisval steht hier fuer den bitfield-wert, 
	//aus Generierungsgruenden hier keine einheitliche Bezeichnung moeglich.
	dword thisval; // Display1AdditionalInfo1_1
	bitval= getValue(this);
	thisval = getValue(A_ASG_69_0_0_27_Data_6_SetGet);
	thisval = thisval&~(1<<18)|(bitval<<18);
	putValue(A_ASG_69_0_0_27_Data_6_SetGet,thisval);
}

on envVar A_ASG_69_0_0_27_Data_6_SetGet_19
{
	byte bitval;
	//thisval steht hier fuer den bitfield-wert, 
	//aus Generierungsgruenden hier keine einheitliche Bezeichnung moeglich.
	dword thisval; // Display1AdditionalInfo1_1
	bitval= getValue(this);
	thisval = getValue(A_ASG_69_0_0_27_Data_6_SetGet);
	thisval = thisval&~(1<<19)|(bitval<<19);
	putValue(A_ASG_69_0_0_27_Data_6_SetGet,thisval);
}

on envVar A_ASG_69_0_0_27_Data_6_SetGet_20
{
	byte bitval;
	//thisval steht hier fuer den bitfield-wert, 
	//aus Generierungsgruenden hier keine einheitliche Bezeichnung moeglich.
	dword thisval; // Display1AdditionalInfo1_1
	bitval= getValue(this);
	thisval = getValue(A_ASG_69_0_0_27_Data_6_SetGet);
	thisval = thisval&~(1<<20)|(bitval<<20);
	putValue(A_ASG_69_0_0_27_Data_6_SetGet,thisval);
}

on envVar A_ASG_69_0_0_27_Data_6_SetGet_21
{
	byte bitval;
	//thisval steht hier fuer den bitfield-wert, 
	//aus Generierungsgruenden hier keine einheitliche Bezeichnung moeglich.
	dword thisval; // Display1AdditionalInfo1_1
	bitval= getValue(this);
	thisval = getValue(A_ASG_69_0_0_27_Data_6_SetGet);
	thisval = thisval&~(1<<21)|(bitval<<21);
	putValue(A_ASG_69_0_0_27_Data_6_SetGet,thisval);
}

on envVar A_ASG_69_0_0_27_Data_6_SetGet_22
{
	byte bitval;
	//thisval steht hier fuer den bitfield-wert, 
	//aus Generierungsgruenden hier keine einheitliche Bezeichnung moeglich.
	dword thisval; // Display1AdditionalInfo1_1
	bitval= getValue(this);
	thisval = getValue(A_ASG_69_0_0_27_Data_6_SetGet);
	thisval = thisval&~(1<<22)|(bitval<<22);
	putValue(A_ASG_69_0_0_27_Data_6_SetGet,thisval);
}

on envVar A_ASG_69_0_0_27_Data_6_SetGet_23
{
	byte bitval;
	//thisval steht hier fuer den bitfield-wert, 
	//aus Generierungsgruenden hier keine einheitliche Bezeichnung moeglich.
	dword thisval; // Display1AdditionalInfo1_1
	bitval= getValue(this);
	thisval = getValue(A_ASG_69_0_0_27_Data_6_SetGet);
	thisval = thisval&~(1<<23)|(bitval<<23);
	putValue(A_ASG_69_0_0_27_Data_6_SetGet,thisval);
}

on envVar A_ASG_69_0_0_27_Data_6_SetGet_24
{
	byte bitval;
	//thisval steht hier fuer den bitfield-wert, 
	//aus Generierungsgruenden hier keine einheitliche Bezeichnung moeglich.
	dword thisval; // Display1AdditionalInfo1_1
	bitval= getValue(this);
	thisval = getValue(A_ASG_69_0_0_27_Data_6_SetGet);
	thisval = thisval&~(1<<24)|(bitval<<24);
	putValue(A_ASG_69_0_0_27_Data_6_SetGet,thisval);
}

on envVar A_ASG_69_0_0_27_Data_6_SetGet_25
{
	byte bitval;
	//thisval steht hier fuer den bitfield-wert, 
	//aus Generierungsgruenden hier keine einheitliche Bezeichnung moeglich.
	dword thisval; // Display1AdditionalInfo1_1
	bitval= getValue(this);
	thisval = getValue(A_ASG_69_0_0_27_Data_6_SetGet);
	thisval = thisval&~(1<<25)|(bitval<<25);
	putValue(A_ASG_69_0_0_27_Data_6_SetGet,thisval);
}

on envVar A_ASG_69_0_0_27_Data_6_SetGet_26
{
	byte bitval;
	//thisval steht hier fuer den bitfield-wert, 
	//aus Generierungsgruenden hier keine einheitliche Bezeichnung moeglich.
	dword thisval; // Display1AdditionalInfo1_1
	bitval= getValue(this);
	thisval = getValue(A_ASG_69_0_0_27_Data_6_SetGet);
	thisval = thisval&~(1<<26)|(bitval<<26);
	putValue(A_ASG_69_0_0_27_Data_6_SetGet,thisval);
}

on envVar A_ASG_69_0_0_27_Data_6_SetGet_27
{
	byte bitval;
	//thisval steht hier fuer den bitfield-wert, 
	//aus Generierungsgruenden hier keine einheitliche Bezeichnung moeglich.
	dword thisval; // Display1AdditionalInfo1_1
	bitval= getValue(this);
	thisval = getValue(A_ASG_69_0_0_27_Data_6_SetGet);
	thisval = thisval&~(1<<27)|(bitval<<27);
	putValue(A_ASG_69_0_0_27_Data_6_SetGet,thisval);
}

on envVar A_ASG_69_0_0_27_Data_6_SetGet_28
{
	byte bitval;
	//thisval steht hier fuer den bitfield-wert, 
	//aus Generierungsgruenden hier keine einheitliche Bezeichnung moeglich.
	dword thisval; // Display1AdditionalInfo1_1
	bitval= getValue(this);
	thisval = getValue(A_ASG_69_0_0_27_Data_6_SetGet);
	thisval = thisval&~(1<<28)|(bitval<<28);
	putValue(A_ASG_69_0_0_27_Data_6_SetGet,thisval);
}

on envVar A_ASG_69_0_0_27_Data_6_SetGet_29
{
	byte bitval;
	//thisval steht hier fuer den bitfield-wert, 
	//aus Generierungsgruenden hier keine einheitliche Bezeichnung moeglich.
	dword thisval; // Display1AdditionalInfo1_1
	bitval= getValue(this);
	thisval = getValue(A_ASG_69_0_0_27_Data_6_SetGet);
	thisval = thisval&~(1<<29)|(bitval<<29);
	putValue(A_ASG_69_0_0_27_Data_6_SetGet,thisval);
}

on envVar A_ASG_69_0_0_27_Data_6_SetGet_30
{
	byte bitval;
	//thisval steht hier fuer den bitfield-wert, 
	//aus Generierungsgruenden hier keine einheitliche Bezeichnung moeglich.
	dword thisval; // Display1AdditionalInfo1_1
	bitval= getValue(this);
	thisval = getValue(A_ASG_69_0_0_27_Data_6_SetGet);
	thisval = thisval&~(1<<30)|(bitval<<30);
	putValue(A_ASG_69_0_0_27_Data_6_SetGet,thisval);
}

on envVar A_ASG_69_0_0_27_Data_6_SetGet_31
{
	byte bitval;
	//thisval steht hier fuer den bitfield-wert, 
	//aus Generierungsgruenden hier keine einheitliche Bezeichnung moeglich.
	dword thisval; // Display1AdditionalInfo1_1
	bitval= getValue(this);
	thisval = getValue(A_ASG_69_0_0_27_Data_6_SetGet);
	thisval = thisval&~(1<<31)|(bitval<<31);
	putValue(A_ASG_69_0_0_27_Data_6_SetGet,thisval);
}

on envVar A_ASG_69_0_0_27_Data_6_SetGet
{
	byte superval[664];

	//Update Childvalue (BitField)
	byte mask=0x01;
	int i = 0;
	dword thisval; // Display1AdditionalInfo1_1
	thisval = getValue(this);
	if(thisval&(mask<<0))
		putValue(A_ASG_69_0_0_27_Data_6_SetGet_0, 1);
	else
		putValue(A_ASG_69_0_0_27_Data_6_SetGet_0, 0);
	if(thisval&(mask<<1))
		putValue(A_ASG_69_0_0_27_Data_6_SetGet_1, 1);
	else
		putValue(A_ASG_69_0_0_27_Data_6_SetGet_1, 0);
	if(thisval&(mask<<2))
		putValue(A_ASG_69_0_0_27_Data_6_SetGet_2, 1);
	else
		putValue(A_ASG_69_0_0_27_Data_6_SetGet_2, 0);
	if(thisval&(mask<<3))
		putValue(A_ASG_69_0_0_27_Data_6_SetGet_3, 1);
	else
		putValue(A_ASG_69_0_0_27_Data_6_SetGet_3, 0);
	if(thisval&(mask<<4))
		putValue(A_ASG_69_0_0_27_Data_6_SetGet_4, 1);
	else
		putValue(A_ASG_69_0_0_27_Data_6_SetGet_4, 0);
	if(thisval&(mask<<5))
		putValue(A_ASG_69_0_0_27_Data_6_SetGet_5, 1);
	else
		putValue(A_ASG_69_0_0_27_Data_6_SetGet_5, 0);
	if(thisval&(mask<<6))
		putValue(A_ASG_69_0_0_27_Data_6_SetGet_6, 1);
	else
		putValue(A_ASG_69_0_0_27_Data_6_SetGet_6, 0);
	if(thisval&(mask<<7))
		putValue(A_ASG_69_0_0_27_Data_6_SetGet_7, 1);
	else
		putValue(A_ASG_69_0_0_27_Data_6_SetGet_7, 0);
	if(thisval&(mask<<8))
		putValue(A_ASG_69_0_0_27_Data_6_SetGet_8, 1);
	else
		putValue(A_ASG_69_0_0_27_Data_6_SetGet_8, 0);
	if(thisval&(mask<<9))
		putValue(A_ASG_69_0_0_27_Data_6_SetGet_9, 1);
	else
		putValue(A_ASG_69_0_0_27_Data_6_SetGet_9, 0);
	if(thisval&(mask<<10))
		putValue(A_ASG_69_0_0_27_Data_6_SetGet_10, 1);
	else
		putValue(A_ASG_69_0_0_27_Data_6_SetGet_10, 0);
	if(thisval&(mask<<11))
		putValue(A_ASG_69_0_0_27_Data_6_SetGet_11, 1);
	else
		putValue(A_ASG_69_0_0_27_Data_6_SetGet_11, 0);
	if(thisval&(mask<<12))
		putValue(A_ASG_69_0_0_27_Data_6_SetGet_12, 1);
	else
		putValue(A_ASG_69_0_0_27_Data_6_SetGet_12, 0);
	if(thisval&(mask<<13))
		putValue(A_ASG_69_0_0_27_Data_6_SetGet_13, 1);
	else
		putValue(A_ASG_69_0_0_27_Data_6_SetGet_13, 0);
	if(thisval&(mask<<14))
		putValue(A_ASG_69_0_0_27_Data_6_SetGet_14, 1);
	else
		putValue(A_ASG_69_0_0_27_Data_6_SetGet_14, 0);
	if(thisval&(mask<<15))
		putValue(A_ASG_69_0_0_27_Data_6_SetGet_15, 1);
	else
		putValue(A_ASG_69_0_0_27_Data_6_SetGet_15, 0);
	if(thisval&(mask<<16))
		putValue(A_ASG_69_0_0_27_Data_6_SetGet_16, 1);
	else
		putValue(A_ASG_69_0_0_27_Data_6_SetGet_16, 0);
	if(thisval&(mask<<17))
		putValue(A_ASG_69_0_0_27_Data_6_SetGet_17, 1);
	else
		putValue(A_ASG_69_0_0_27_Data_6_SetGet_17, 0);
	if(thisval&(mask<<18))
		putValue(A_ASG_69_0_0_27_Data_6_SetGet_18, 1);
	else
		putValue(A_ASG_69_0_0_27_Data_6_SetGet_18, 0);
	if(thisval&(mask<<19))
		putValue(A_ASG_69_0_0_27_Data_6_SetGet_19, 1);
	else
		putValue(A_ASG_69_0_0_27_Data_6_SetGet_19, 0);
	if(thisval&(mask<<20))
		putValue(A_ASG_69_0_0_27_Data_6_SetGet_20, 1);
	else
		putValue(A_ASG_69_0_0_27_Data_6_SetGet_20, 0);
	if(thisval&(mask<<21))
		putValue(A_ASG_69_0_0_27_Data_6_SetGet_21, 1);
	else
		putValue(A_ASG_69_0_0_27_Data_6_SetGet_21, 0);
	if(thisval&(mask<<22))
		putValue(A_ASG_69_0_0_27_Data_6_SetGet_22, 1);
	else
		putValue(A_ASG_69_0_0_27_Data_6_SetGet_22, 0);
	if(thisval&(mask<<23))
		putValue(A_ASG_69_0_0_27_Data_6_SetGet_23, 1);
	else
		putValue(A_ASG_69_0_0_27_Data_6_SetGet_23, 0);
	if(thisval&(mask<<24))
		putValue(A_ASG_69_0_0_27_Data_6_SetGet_24, 1);
	else
		putValue(A_ASG_69_0_0_27_Data_6_SetGet_24, 0);
	if(thisval&(mask<<25))
		putValue(A_ASG_69_0_0_27_Data_6_SetGet_25, 1);
	else
		putValue(A_ASG_69_0_0_27_Data_6_SetGet_25, 0);
	if(thisval&(mask<<26))
		putValue(A_ASG_69_0_0_27_Data_6_SetGet_26, 1);
	else
		putValue(A_ASG_69_0_0_27_Data_6_SetGet_26, 0);
	if(thisval&(mask<<27))
		putValue(A_ASG_69_0_0_27_Data_6_SetGet_27, 1);
	else
		putValue(A_ASG_69_0_0_27_Data_6_SetGet_27, 0);
	if(thisval&(mask<<28))
		putValue(A_ASG_69_0_0_27_Data_6_SetGet_28, 1);
	else
		putValue(A_ASG_69_0_0_27_Data_6_SetGet_28, 0);
	if(thisval&(mask<<29))
		putValue(A_ASG_69_0_0_27_Data_6_SetGet_29, 1);
	else
		putValue(A_ASG_69_0_0_27_Data_6_SetGet_29, 0);
	if(thisval&(mask<<30))
		putValue(A_ASG_69_0_0_27_Data_6_SetGet_30, 1);
	else
		putValue(A_ASG_69_0_0_27_Data_6_SetGet_30, 0);
	if(thisval&(mask<<31))
		putValue(A_ASG_69_0_0_27_Data_6_SetGet_31, 1);
	else
		putValue(A_ASG_69_0_0_27_Data_6_SetGet_31, 0);
    A_ASG_69_0_0_27_ArrayDataList[getValue(A_ASG_69_0_0_27_DataIndex_SetGet)].Param6 = thisval;
}
on envVar A_ASG_69_0_0_27_Data_7_SetGet_0
{
	byte bitval;
	//thisval steht hier fuer den bitfield-wert, 
	//aus Generierungsgruenden hier keine einheitliche Bezeichnung moeglich.
	dword thisval; // Display1AdditionalInfo1_2
	bitval= getValue(this);
	thisval = getValue(A_ASG_69_0_0_27_Data_7_SetGet);
	thisval = thisval&~(1<<0)|(bitval<<0);
	putValue(A_ASG_69_0_0_27_Data_7_SetGet,thisval);
}

on envVar A_ASG_69_0_0_27_Data_7_SetGet_1
{
	byte bitval;
	//thisval steht hier fuer den bitfield-wert, 
	//aus Generierungsgruenden hier keine einheitliche Bezeichnung moeglich.
	dword thisval; // Display1AdditionalInfo1_2
	bitval= getValue(this);
	thisval = getValue(A_ASG_69_0_0_27_Data_7_SetGet);
	thisval = thisval&~(1<<1)|(bitval<<1);
	putValue(A_ASG_69_0_0_27_Data_7_SetGet,thisval);
}

on envVar A_ASG_69_0_0_27_Data_7_SetGet_2
{
	byte bitval;
	//thisval steht hier fuer den bitfield-wert, 
	//aus Generierungsgruenden hier keine einheitliche Bezeichnung moeglich.
	dword thisval; // Display1AdditionalInfo1_2
	bitval= getValue(this);
	thisval = getValue(A_ASG_69_0_0_27_Data_7_SetGet);
	thisval = thisval&~(1<<2)|(bitval<<2);
	putValue(A_ASG_69_0_0_27_Data_7_SetGet,thisval);
}

on envVar A_ASG_69_0_0_27_Data_7_SetGet_3
{
	byte bitval;
	//thisval steht hier fuer den bitfield-wert, 
	//aus Generierungsgruenden hier keine einheitliche Bezeichnung moeglich.
	dword thisval; // Display1AdditionalInfo1_2
	bitval= getValue(this);
	thisval = getValue(A_ASG_69_0_0_27_Data_7_SetGet);
	thisval = thisval&~(1<<3)|(bitval<<3);
	putValue(A_ASG_69_0_0_27_Data_7_SetGet,thisval);
}

on envVar A_ASG_69_0_0_27_Data_7_SetGet_4
{
	byte bitval;
	//thisval steht hier fuer den bitfield-wert, 
	//aus Generierungsgruenden hier keine einheitliche Bezeichnung moeglich.
	dword thisval; // Display1AdditionalInfo1_2
	bitval= getValue(this);
	thisval = getValue(A_ASG_69_0_0_27_Data_7_SetGet);
	thisval = thisval&~(1<<4)|(bitval<<4);
	putValue(A_ASG_69_0_0_27_Data_7_SetGet,thisval);
}

on envVar A_ASG_69_0_0_27_Data_7_SetGet_5
{
	byte bitval;
	//thisval steht hier fuer den bitfield-wert, 
	//aus Generierungsgruenden hier keine einheitliche Bezeichnung moeglich.
	dword thisval; // Display1AdditionalInfo1_2
	bitval= getValue(this);
	thisval = getValue(A_ASG_69_0_0_27_Data_7_SetGet);
	thisval = thisval&~(1<<5)|(bitval<<5);
	putValue(A_ASG_69_0_0_27_Data_7_SetGet,thisval);
}

on envVar A_ASG_69_0_0_27_Data_7_SetGet_6
{
	byte bitval;
	//thisval steht hier fuer den bitfield-wert, 
	//aus Generierungsgruenden hier keine einheitliche Bezeichnung moeglich.
	dword thisval; // Display1AdditionalInfo1_2
	bitval= getValue(this);
	thisval = getValue(A_ASG_69_0_0_27_Data_7_SetGet);
	thisval = thisval&~(1<<6)|(bitval<<6);
	putValue(A_ASG_69_0_0_27_Data_7_SetGet,thisval);
}

on envVar A_ASG_69_0_0_27_Data_7_SetGet_7
{
	byte bitval;
	//thisval steht hier fuer den bitfield-wert, 
	//aus Generierungsgruenden hier keine einheitliche Bezeichnung moeglich.
	dword thisval; // Display1AdditionalInfo1_2
	bitval= getValue(this);
	thisval = getValue(A_ASG_69_0_0_27_Data_7_SetGet);
	thisval = thisval&~(1<<7)|(bitval<<7);
	putValue(A_ASG_69_0_0_27_Data_7_SetGet,thisval);
}

on envVar A_ASG_69_0_0_27_Data_7_SetGet_8
{
	byte bitval;
	//thisval steht hier fuer den bitfield-wert, 
	//aus Generierungsgruenden hier keine einheitliche Bezeichnung moeglich.
	dword thisval; // Display1AdditionalInfo1_2
	bitval= getValue(this);
	thisval = getValue(A_ASG_69_0_0_27_Data_7_SetGet);
	thisval = thisval&~(1<<8)|(bitval<<8);
	putValue(A_ASG_69_0_0_27_Data_7_SetGet,thisval);
}

on envVar A_ASG_69_0_0_27_Data_7_SetGet_9
{
	byte bitval;
	//thisval steht hier fuer den bitfield-wert, 
	//aus Generierungsgruenden hier keine einheitliche Bezeichnung moeglich.
	dword thisval; // Display1AdditionalInfo1_2
	bitval= getValue(this);
	thisval = getValue(A_ASG_69_0_0_27_Data_7_SetGet);
	thisval = thisval&~(1<<9)|(bitval<<9);
	putValue(A_ASG_69_0_0_27_Data_7_SetGet,thisval);
}

on envVar A_ASG_69_0_0_27_Data_7_SetGet_10
{
	byte bitval;
	//thisval steht hier fuer den bitfield-wert, 
	//aus Generierungsgruenden hier keine einheitliche Bezeichnung moeglich.
	dword thisval; // Display1AdditionalInfo1_2
	bitval= getValue(this);
	thisval = getValue(A_ASG_69_0_0_27_Data_7_SetGet);
	thisval = thisval&~(1<<10)|(bitval<<10);
	putValue(A_ASG_69_0_0_27_Data_7_SetGet,thisval);
}

on envVar A_ASG_69_0_0_27_Data_7_SetGet_11
{
	byte bitval;
	//thisval steht hier fuer den bitfield-wert, 
	//aus Generierungsgruenden hier keine einheitliche Bezeichnung moeglich.
	dword thisval; // Display1AdditionalInfo1_2
	bitval= getValue(this);
	thisval = getValue(A_ASG_69_0_0_27_Data_7_SetGet);
	thisval = thisval&~(1<<11)|(bitval<<11);
	putValue(A_ASG_69_0_0_27_Data_7_SetGet,thisval);
}

on envVar A_ASG_69_0_0_27_Data_7_SetGet_12
{
	byte bitval;
	//thisval steht hier fuer den bitfield-wert, 
	//aus Generierungsgruenden hier keine einheitliche Bezeichnung moeglich.
	dword thisval; // Display1AdditionalInfo1_2
	bitval= getValue(this);
	thisval = getValue(A_ASG_69_0_0_27_Data_7_SetGet);
	thisval = thisval&~(1<<12)|(bitval<<12);
	putValue(A_ASG_69_0_0_27_Data_7_SetGet,thisval);
}

on envVar A_ASG_69_0_0_27_Data_7_SetGet_13
{
	byte bitval;
	//thisval steht hier fuer den bitfield-wert, 
	//aus Generierungsgruenden hier keine einheitliche Bezeichnung moeglich.
	dword thisval; // Display1AdditionalInfo1_2
	bitval= getValue(this);
	thisval = getValue(A_ASG_69_0_0_27_Data_7_SetGet);
	thisval = thisval&~(1<<13)|(bitval<<13);
	putValue(A_ASG_69_0_0_27_Data_7_SetGet,thisval);
}

on envVar A_ASG_69_0_0_27_Data_7_SetGet_14
{
	byte bitval;
	//thisval steht hier fuer den bitfield-wert, 
	//aus Generierungsgruenden hier keine einheitliche Bezeichnung moeglich.
	dword thisval; // Display1AdditionalInfo1_2
	bitval= getValue(this);
	thisval = getValue(A_ASG_69_0_0_27_Data_7_SetGet);
	thisval = thisval&~(1<<14)|(bitval<<14);
	putValue(A_ASG_69_0_0_27_Data_7_SetGet,thisval);
}

on envVar A_ASG_69_0_0_27_Data_7_SetGet_15
{
	byte bitval;
	//thisval steht hier fuer den bitfield-wert, 
	//aus Generierungsgruenden hier keine einheitliche Bezeichnung moeglich.
	dword thisval; // Display1AdditionalInfo1_2
	bitval= getValue(this);
	thisval = getValue(A_ASG_69_0_0_27_Data_7_SetGet);
	thisval = thisval&~(1<<15)|(bitval<<15);
	putValue(A_ASG_69_0_0_27_Data_7_SetGet,thisval);
}

on envVar A_ASG_69_0_0_27_Data_7_SetGet_16
{
	byte bitval;
	//thisval steht hier fuer den bitfield-wert, 
	//aus Generierungsgruenden hier keine einheitliche Bezeichnung moeglich.
	dword thisval; // Display1AdditionalInfo1_2
	bitval= getValue(this);
	thisval = getValue(A_ASG_69_0_0_27_Data_7_SetGet);
	thisval = thisval&~(1<<16)|(bitval<<16);
	putValue(A_ASG_69_0_0_27_Data_7_SetGet,thisval);
}

on envVar A_ASG_69_0_0_27_Data_7_SetGet_17
{
	byte bitval;
	//thisval steht hier fuer den bitfield-wert, 
	//aus Generierungsgruenden hier keine einheitliche Bezeichnung moeglich.
	dword thisval; // Display1AdditionalInfo1_2
	bitval= getValue(this);
	thisval = getValue(A_ASG_69_0_0_27_Data_7_SetGet);
	thisval = thisval&~(1<<17)|(bitval<<17);
	putValue(A_ASG_69_0_0_27_Data_7_SetGet,thisval);
}

on envVar A_ASG_69_0_0_27_Data_7_SetGet_18
{
	byte bitval;
	//thisval steht hier fuer den bitfield-wert, 
	//aus Generierungsgruenden hier keine einheitliche Bezeichnung moeglich.
	dword thisval; // Display1AdditionalInfo1_2
	bitval= getValue(this);
	thisval = getValue(A_ASG_69_0_0_27_Data_7_SetGet);
	thisval = thisval&~(1<<18)|(bitval<<18);
	putValue(A_ASG_69_0_0_27_Data_7_SetGet,thisval);
}

on envVar A_ASG_69_0_0_27_Data_7_SetGet_19
{
	byte bitval;
	//thisval steht hier fuer den bitfield-wert, 
	//aus Generierungsgruenden hier keine einheitliche Bezeichnung moeglich.
	dword thisval; // Display1AdditionalInfo1_2
	bitval= getValue(this);
	thisval = getValue(A_ASG_69_0_0_27_Data_7_SetGet);
	thisval = thisval&~(1<<19)|(bitval<<19);
	putValue(A_ASG_69_0_0_27_Data_7_SetGet,thisval);
}

on envVar A_ASG_69_0_0_27_Data_7_SetGet_20
{
	byte bitval;
	//thisval steht hier fuer den bitfield-wert, 
	//aus Generierungsgruenden hier keine einheitliche Bezeichnung moeglich.
	dword thisval; // Display1AdditionalInfo1_2
	bitval= getValue(this);
	thisval = getValue(A_ASG_69_0_0_27_Data_7_SetGet);
	thisval = thisval&~(1<<20)|(bitval<<20);
	putValue(A_ASG_69_0_0_27_Data_7_SetGet,thisval);
}

on envVar A_ASG_69_0_0_27_Data_7_SetGet_21
{
	byte bitval;
	//thisval steht hier fuer den bitfield-wert, 
	//aus Generierungsgruenden hier keine einheitliche Bezeichnung moeglich.
	dword thisval; // Display1AdditionalInfo1_2
	bitval= getValue(this);
	thisval = getValue(A_ASG_69_0_0_27_Data_7_SetGet);
	thisval = thisval&~(1<<21)|(bitval<<21);
	putValue(A_ASG_69_0_0_27_Data_7_SetGet,thisval);
}

on envVar A_ASG_69_0_0_27_Data_7_SetGet_22
{
	byte bitval;
	//thisval steht hier fuer den bitfield-wert, 
	//aus Generierungsgruenden hier keine einheitliche Bezeichnung moeglich.
	dword thisval; // Display1AdditionalInfo1_2
	bitval= getValue(this);
	thisval = getValue(A_ASG_69_0_0_27_Data_7_SetGet);
	thisval = thisval&~(1<<22)|(bitval<<22);
	putValue(A_ASG_69_0_0_27_Data_7_SetGet,thisval);
}

on envVar A_ASG_69_0_0_27_Data_7_SetGet_23
{
	byte bitval;
	//thisval steht hier fuer den bitfield-wert, 
	//aus Generierungsgruenden hier keine einheitliche Bezeichnung moeglich.
	dword thisval; // Display1AdditionalInfo1_2
	bitval= getValue(this);
	thisval = getValue(A_ASG_69_0_0_27_Data_7_SetGet);
	thisval = thisval&~(1<<23)|(bitval<<23);
	putValue(A_ASG_69_0_0_27_Data_7_SetGet,thisval);
}

on envVar A_ASG_69_0_0_27_Data_7_SetGet_24
{
	byte bitval;
	//thisval steht hier fuer den bitfield-wert, 
	//aus Generierungsgruenden hier keine einheitliche Bezeichnung moeglich.
	dword thisval; // Display1AdditionalInfo1_2
	bitval= getValue(this);
	thisval = getValue(A_ASG_69_0_0_27_Data_7_SetGet);
	thisval = thisval&~(1<<24)|(bitval<<24);
	putValue(A_ASG_69_0_0_27_Data_7_SetGet,thisval);
}

on envVar A_ASG_69_0_0_27_Data_7_SetGet_25
{
	byte bitval;
	//thisval steht hier fuer den bitfield-wert, 
	//aus Generierungsgruenden hier keine einheitliche Bezeichnung moeglich.
	dword thisval; // Display1AdditionalInfo1_2
	bitval= getValue(this);
	thisval = getValue(A_ASG_69_0_0_27_Data_7_SetGet);
	thisval = thisval&~(1<<25)|(bitval<<25);
	putValue(A_ASG_69_0_0_27_Data_7_SetGet,thisval);
}

on envVar A_ASG_69_0_0_27_Data_7_SetGet_26
{
	byte bitval;
	//thisval steht hier fuer den bitfield-wert, 
	//aus Generierungsgruenden hier keine einheitliche Bezeichnung moeglich.
	dword thisval; // Display1AdditionalInfo1_2
	bitval= getValue(this);
	thisval = getValue(A_ASG_69_0_0_27_Data_7_SetGet);
	thisval = thisval&~(1<<26)|(bitval<<26);
	putValue(A_ASG_69_0_0_27_Data_7_SetGet,thisval);
}

on envVar A_ASG_69_0_0_27_Data_7_SetGet_27
{
	byte bitval;
	//thisval steht hier fuer den bitfield-wert, 
	//aus Generierungsgruenden hier keine einheitliche Bezeichnung moeglich.
	dword thisval; // Display1AdditionalInfo1_2
	bitval= getValue(this);
	thisval = getValue(A_ASG_69_0_0_27_Data_7_SetGet);
	thisval = thisval&~(1<<27)|(bitval<<27);
	putValue(A_ASG_69_0_0_27_Data_7_SetGet,thisval);
}

on envVar A_ASG_69_0_0_27_Data_7_SetGet_28
{
	byte bitval;
	//thisval steht hier fuer den bitfield-wert, 
	//aus Generierungsgruenden hier keine einheitliche Bezeichnung moeglich.
	dword thisval; // Display1AdditionalInfo1_2
	bitval= getValue(this);
	thisval = getValue(A_ASG_69_0_0_27_Data_7_SetGet);
	thisval = thisval&~(1<<28)|(bitval<<28);
	putValue(A_ASG_69_0_0_27_Data_7_SetGet,thisval);
}

on envVar A_ASG_69_0_0_27_Data_7_SetGet_29
{
	byte bitval;
	//thisval steht hier fuer den bitfield-wert, 
	//aus Generierungsgruenden hier keine einheitliche Bezeichnung moeglich.
	dword thisval; // Display1AdditionalInfo1_2
	bitval= getValue(this);
	thisval = getValue(A_ASG_69_0_0_27_Data_7_SetGet);
	thisval = thisval&~(1<<29)|(bitval<<29);
	putValue(A_ASG_69_0_0_27_Data_7_SetGet,thisval);
}

on envVar A_ASG_69_0_0_27_Data_7_SetGet
{
	byte superval[664];

	//Update Childvalue (BitField)
	byte mask=0x01;
	int i = 0;
	dword thisval; // Display1AdditionalInfo1_2
	thisval = getValue(this);
	if(thisval&(mask<<0))
		putValue(A_ASG_69_0_0_27_Data_7_SetGet_0, 1);
	else
		putValue(A_ASG_69_0_0_27_Data_7_SetGet_0, 0);
	if(thisval&(mask<<1))
		putValue(A_ASG_69_0_0_27_Data_7_SetGet_1, 1);
	else
		putValue(A_ASG_69_0_0_27_Data_7_SetGet_1, 0);
	if(thisval&(mask<<2))
		putValue(A_ASG_69_0_0_27_Data_7_SetGet_2, 1);
	else
		putValue(A_ASG_69_0_0_27_Data_7_SetGet_2, 0);
	if(thisval&(mask<<3))
		putValue(A_ASG_69_0_0_27_Data_7_SetGet_3, 1);
	else
		putValue(A_ASG_69_0_0_27_Data_7_SetGet_3, 0);
	if(thisval&(mask<<4))
		putValue(A_ASG_69_0_0_27_Data_7_SetGet_4, 1);
	else
		putValue(A_ASG_69_0_0_27_Data_7_SetGet_4, 0);
	if(thisval&(mask<<5))
		putValue(A_ASG_69_0_0_27_Data_7_SetGet_5, 1);
	else
		putValue(A_ASG_69_0_0_27_Data_7_SetGet_5, 0);
	if(thisval&(mask<<6))
		putValue(A_ASG_69_0_0_27_Data_7_SetGet_6, 1);
	else
		putValue(A_ASG_69_0_0_27_Data_7_SetGet_6, 0);
	if(thisval&(mask<<7))
		putValue(A_ASG_69_0_0_27_Data_7_SetGet_7, 1);
	else
		putValue(A_ASG_69_0_0_27_Data_7_SetGet_7, 0);
	if(thisval&(mask<<8))
		putValue(A_ASG_69_0_0_27_Data_7_SetGet_8, 1);
	else
		putValue(A_ASG_69_0_0_27_Data_7_SetGet_8, 0);
	if(thisval&(mask<<9))
		putValue(A_ASG_69_0_0_27_Data_7_SetGet_9, 1);
	else
		putValue(A_ASG_69_0_0_27_Data_7_SetGet_9, 0);
	if(thisval&(mask<<10))
		putValue(A_ASG_69_0_0_27_Data_7_SetGet_10, 1);
	else
		putValue(A_ASG_69_0_0_27_Data_7_SetGet_10, 0);
	if(thisval&(mask<<11))
		putValue(A_ASG_69_0_0_27_Data_7_SetGet_11, 1);
	else
		putValue(A_ASG_69_0_0_27_Data_7_SetGet_11, 0);
	if(thisval&(mask<<12))
		putValue(A_ASG_69_0_0_27_Data_7_SetGet_12, 1);
	else
		putValue(A_ASG_69_0_0_27_Data_7_SetGet_12, 0);
	if(thisval&(mask<<13))
		putValue(A_ASG_69_0_0_27_Data_7_SetGet_13, 1);
	else
		putValue(A_ASG_69_0_0_27_Data_7_SetGet_13, 0);
	if(thisval&(mask<<14))
		putValue(A_ASG_69_0_0_27_Data_7_SetGet_14, 1);
	else
		putValue(A_ASG_69_0_0_27_Data_7_SetGet_14, 0);
	if(thisval&(mask<<15))
		putValue(A_ASG_69_0_0_27_Data_7_SetGet_15, 1);
	else
		putValue(A_ASG_69_0_0_27_Data_7_SetGet_15, 0);
	if(thisval&(mask<<16))
		putValue(A_ASG_69_0_0_27_Data_7_SetGet_16, 1);
	else
		putValue(A_ASG_69_0_0_27_Data_7_SetGet_16, 0);
	if(thisval&(mask<<17))
		putValue(A_ASG_69_0_0_27_Data_7_SetGet_17, 1);
	else
		putValue(A_ASG_69_0_0_27_Data_7_SetGet_17, 0);
	if(thisval&(mask<<18))
		putValue(A_ASG_69_0_0_27_Data_7_SetGet_18, 1);
	else
		putValue(A_ASG_69_0_0_27_Data_7_SetGet_18, 0);
	if(thisval&(mask<<19))
		putValue(A_ASG_69_0_0_27_Data_7_SetGet_19, 1);
	else
		putValue(A_ASG_69_0_0_27_Data_7_SetGet_19, 0);
	if(thisval&(mask<<20))
		putValue(A_ASG_69_0_0_27_Data_7_SetGet_20, 1);
	else
		putValue(A_ASG_69_0_0_27_Data_7_SetGet_20, 0);
	if(thisval&(mask<<21))
		putValue(A_ASG_69_0_0_27_Data_7_SetGet_21, 1);
	else
		putValue(A_ASG_69_0_0_27_Data_7_SetGet_21, 0);
	if(thisval&(mask<<22))
		putValue(A_ASG_69_0_0_27_Data_7_SetGet_22, 1);
	else
		putValue(A_ASG_69_0_0_27_Data_7_SetGet_22, 0);
	if(thisval&(mask<<23))
		putValue(A_ASG_69_0_0_27_Data_7_SetGet_23, 1);
	else
		putValue(A_ASG_69_0_0_27_Data_7_SetGet_23, 0);
	if(thisval&(mask<<24))
		putValue(A_ASG_69_0_0_27_Data_7_SetGet_24, 1);
	else
		putValue(A_ASG_69_0_0_27_Data_7_SetGet_24, 0);
	if(thisval&(mask<<25))
		putValue(A_ASG_69_0_0_27_Data_7_SetGet_25, 1);
	else
		putValue(A_ASG_69_0_0_27_Data_7_SetGet_25, 0);
	if(thisval&(mask<<26))
		putValue(A_ASG_69_0_0_27_Data_7_SetGet_26, 1);
	else
		putValue(A_ASG_69_0_0_27_Data_7_SetGet_26, 0);
	if(thisval&(mask<<27))
		putValue(A_ASG_69_0_0_27_Data_7_SetGet_27, 1);
	else
		putValue(A_ASG_69_0_0_27_Data_7_SetGet_27, 0);
	if(thisval&(mask<<28))
		putValue(A_ASG_69_0_0_27_Data_7_SetGet_28, 1);
	else
		putValue(A_ASG_69_0_0_27_Data_7_SetGet_28, 0);
	if(thisval&(mask<<29))
		putValue(A_ASG_69_0_0_27_Data_7_SetGet_29, 1);
	else
		putValue(A_ASG_69_0_0_27_Data_7_SetGet_29, 0);
    A_ASG_69_0_0_27_ArrayDataList[getValue(A_ASG_69_0_0_27_DataIndex_SetGet)].Param7 = thisval;
}
on envVar A_ASG_69_0_0_27_Data_8_SetGet_0
{
	byte bitval;
	//thisval steht hier fuer den bitfield-wert, 
	//aus Generierungsgruenden hier keine einheitliche Bezeichnung moeglich.
	dword thisval; // Display1AdditionalInfo2_1
	bitval= getValue(this);
	thisval = getValue(A_ASG_69_0_0_27_Data_8_SetGet);
	thisval = thisval&~(1<<0)|(bitval<<0);
	putValue(A_ASG_69_0_0_27_Data_8_SetGet,thisval);
}

on envVar A_ASG_69_0_0_27_Data_8_SetGet_1
{
	byte bitval;
	//thisval steht hier fuer den bitfield-wert, 
	//aus Generierungsgruenden hier keine einheitliche Bezeichnung moeglich.
	dword thisval; // Display1AdditionalInfo2_1
	bitval= getValue(this);
	thisval = getValue(A_ASG_69_0_0_27_Data_8_SetGet);
	thisval = thisval&~(1<<1)|(bitval<<1);
	putValue(A_ASG_69_0_0_27_Data_8_SetGet,thisval);
}

on envVar A_ASG_69_0_0_27_Data_8_SetGet_2
{
	byte bitval;
	//thisval steht hier fuer den bitfield-wert, 
	//aus Generierungsgruenden hier keine einheitliche Bezeichnung moeglich.
	dword thisval; // Display1AdditionalInfo2_1
	bitval= getValue(this);
	thisval = getValue(A_ASG_69_0_0_27_Data_8_SetGet);
	thisval = thisval&~(1<<2)|(bitval<<2);
	putValue(A_ASG_69_0_0_27_Data_8_SetGet,thisval);
}

on envVar A_ASG_69_0_0_27_Data_8_SetGet_3
{
	byte bitval;
	//thisval steht hier fuer den bitfield-wert, 
	//aus Generierungsgruenden hier keine einheitliche Bezeichnung moeglich.
	dword thisval; // Display1AdditionalInfo2_1
	bitval= getValue(this);
	thisval = getValue(A_ASG_69_0_0_27_Data_8_SetGet);
	thisval = thisval&~(1<<3)|(bitval<<3);
	putValue(A_ASG_69_0_0_27_Data_8_SetGet,thisval);
}

on envVar A_ASG_69_0_0_27_Data_8_SetGet_4
{
	byte bitval;
	//thisval steht hier fuer den bitfield-wert, 
	//aus Generierungsgruenden hier keine einheitliche Bezeichnung moeglich.
	dword thisval; // Display1AdditionalInfo2_1
	bitval= getValue(this);
	thisval = getValue(A_ASG_69_0_0_27_Data_8_SetGet);
	thisval = thisval&~(1<<4)|(bitval<<4);
	putValue(A_ASG_69_0_0_27_Data_8_SetGet,thisval);
}

on envVar A_ASG_69_0_0_27_Data_8_SetGet_5
{
	byte bitval;
	//thisval steht hier fuer den bitfield-wert, 
	//aus Generierungsgruenden hier keine einheitliche Bezeichnung moeglich.
	dword thisval; // Display1AdditionalInfo2_1
	bitval= getValue(this);
	thisval = getValue(A_ASG_69_0_0_27_Data_8_SetGet);
	thisval = thisval&~(1<<5)|(bitval<<5);
	putValue(A_ASG_69_0_0_27_Data_8_SetGet,thisval);
}

on envVar A_ASG_69_0_0_27_Data_8_SetGet_6
{
	byte bitval;
	//thisval steht hier fuer den bitfield-wert, 
	//aus Generierungsgruenden hier keine einheitliche Bezeichnung moeglich.
	dword thisval; // Display1AdditionalInfo2_1
	bitval= getValue(this);
	thisval = getValue(A_ASG_69_0_0_27_Data_8_SetGet);
	thisval = thisval&~(1<<6)|(bitval<<6);
	putValue(A_ASG_69_0_0_27_Data_8_SetGet,thisval);
}

on envVar A_ASG_69_0_0_27_Data_8_SetGet_7
{
	byte bitval;
	//thisval steht hier fuer den bitfield-wert, 
	//aus Generierungsgruenden hier keine einheitliche Bezeichnung moeglich.
	dword thisval; // Display1AdditionalInfo2_1
	bitval= getValue(this);
	thisval = getValue(A_ASG_69_0_0_27_Data_8_SetGet);
	thisval = thisval&~(1<<7)|(bitval<<7);
	putValue(A_ASG_69_0_0_27_Data_8_SetGet,thisval);
}

on envVar A_ASG_69_0_0_27_Data_8_SetGet_8
{
	byte bitval;
	//thisval steht hier fuer den bitfield-wert, 
	//aus Generierungsgruenden hier keine einheitliche Bezeichnung moeglich.
	dword thisval; // Display1AdditionalInfo2_1
	bitval= getValue(this);
	thisval = getValue(A_ASG_69_0_0_27_Data_8_SetGet);
	thisval = thisval&~(1<<8)|(bitval<<8);
	putValue(A_ASG_69_0_0_27_Data_8_SetGet,thisval);
}

on envVar A_ASG_69_0_0_27_Data_8_SetGet_9
{
	byte bitval;
	//thisval steht hier fuer den bitfield-wert, 
	//aus Generierungsgruenden hier keine einheitliche Bezeichnung moeglich.
	dword thisval; // Display1AdditionalInfo2_1
	bitval= getValue(this);
	thisval = getValue(A_ASG_69_0_0_27_Data_8_SetGet);
	thisval = thisval&~(1<<9)|(bitval<<9);
	putValue(A_ASG_69_0_0_27_Data_8_SetGet,thisval);
}

on envVar A_ASG_69_0_0_27_Data_8_SetGet_10
{
	byte bitval;
	//thisval steht hier fuer den bitfield-wert, 
	//aus Generierungsgruenden hier keine einheitliche Bezeichnung moeglich.
	dword thisval; // Display1AdditionalInfo2_1
	bitval= getValue(this);
	thisval = getValue(A_ASG_69_0_0_27_Data_8_SetGet);
	thisval = thisval&~(1<<10)|(bitval<<10);
	putValue(A_ASG_69_0_0_27_Data_8_SetGet,thisval);
}

on envVar A_ASG_69_0_0_27_Data_8_SetGet_11
{
	byte bitval;
	//thisval steht hier fuer den bitfield-wert, 
	//aus Generierungsgruenden hier keine einheitliche Bezeichnung moeglich.
	dword thisval; // Display1AdditionalInfo2_1
	bitval= getValue(this);
	thisval = getValue(A_ASG_69_0_0_27_Data_8_SetGet);
	thisval = thisval&~(1<<11)|(bitval<<11);
	putValue(A_ASG_69_0_0_27_Data_8_SetGet,thisval);
}

on envVar A_ASG_69_0_0_27_Data_8_SetGet_12
{
	byte bitval;
	//thisval steht hier fuer den bitfield-wert, 
	//aus Generierungsgruenden hier keine einheitliche Bezeichnung moeglich.
	dword thisval; // Display1AdditionalInfo2_1
	bitval= getValue(this);
	thisval = getValue(A_ASG_69_0_0_27_Data_8_SetGet);
	thisval = thisval&~(1<<12)|(bitval<<12);
	putValue(A_ASG_69_0_0_27_Data_8_SetGet,thisval);
}

on envVar A_ASG_69_0_0_27_Data_8_SetGet_13
{
	byte bitval;
	//thisval steht hier fuer den bitfield-wert, 
	//aus Generierungsgruenden hier keine einheitliche Bezeichnung moeglich.
	dword thisval; // Display1AdditionalInfo2_1
	bitval= getValue(this);
	thisval = getValue(A_ASG_69_0_0_27_Data_8_SetGet);
	thisval = thisval&~(1<<13)|(bitval<<13);
	putValue(A_ASG_69_0_0_27_Data_8_SetGet,thisval);
}

on envVar A_ASG_69_0_0_27_Data_8_SetGet_14
{
	byte bitval;
	//thisval steht hier fuer den bitfield-wert, 
	//aus Generierungsgruenden hier keine einheitliche Bezeichnung moeglich.
	dword thisval; // Display1AdditionalInfo2_1
	bitval= getValue(this);
	thisval = getValue(A_ASG_69_0_0_27_Data_8_SetGet);
	thisval = thisval&~(1<<14)|(bitval<<14);
	putValue(A_ASG_69_0_0_27_Data_8_SetGet,thisval);
}

on envVar A_ASG_69_0_0_27_Data_8_SetGet_15
{
	byte bitval;
	//thisval steht hier fuer den bitfield-wert, 
	//aus Generierungsgruenden hier keine einheitliche Bezeichnung moeglich.
	dword thisval; // Display1AdditionalInfo2_1
	bitval= getValue(this);
	thisval = getValue(A_ASG_69_0_0_27_Data_8_SetGet);
	thisval = thisval&~(1<<15)|(bitval<<15);
	putValue(A_ASG_69_0_0_27_Data_8_SetGet,thisval);
}

on envVar A_ASG_69_0_0_27_Data_8_SetGet_16
{
	byte bitval;
	//thisval steht hier fuer den bitfield-wert, 
	//aus Generierungsgruenden hier keine einheitliche Bezeichnung moeglich.
	dword thisval; // Display1AdditionalInfo2_1
	bitval= getValue(this);
	thisval = getValue(A_ASG_69_0_0_27_Data_8_SetGet);
	thisval = thisval&~(1<<16)|(bitval<<16);
	putValue(A_ASG_69_0_0_27_Data_8_SetGet,thisval);
}

on envVar A_ASG_69_0_0_27_Data_8_SetGet_17
{
	byte bitval;
	//thisval steht hier fuer den bitfield-wert, 
	//aus Generierungsgruenden hier keine einheitliche Bezeichnung moeglich.
	dword thisval; // Display1AdditionalInfo2_1
	bitval= getValue(this);
	thisval = getValue(A_ASG_69_0_0_27_Data_8_SetGet);
	thisval = thisval&~(1<<17)|(bitval<<17);
	putValue(A_ASG_69_0_0_27_Data_8_SetGet,thisval);
}

on envVar A_ASG_69_0_0_27_Data_8_SetGet_18
{
	byte bitval;
	//thisval steht hier fuer den bitfield-wert, 
	//aus Generierungsgruenden hier keine einheitliche Bezeichnung moeglich.
	dword thisval; // Display1AdditionalInfo2_1
	bitval= getValue(this);
	thisval = getValue(A_ASG_69_0_0_27_Data_8_SetGet);
	thisval = thisval&~(1<<18)|(bitval<<18);
	putValue(A_ASG_69_0_0_27_Data_8_SetGet,thisval);
}

on envVar A_ASG_69_0_0_27_Data_8_SetGet_19
{
	byte bitval;
	//thisval steht hier fuer den bitfield-wert, 
	//aus Generierungsgruenden hier keine einheitliche Bezeichnung moeglich.
	dword thisval; // Display1AdditionalInfo2_1
	bitval= getValue(this);
	thisval = getValue(A_ASG_69_0_0_27_Data_8_SetGet);
	thisval = thisval&~(1<<19)|(bitval<<19);
	putValue(A_ASG_69_0_0_27_Data_8_SetGet,thisval);
}

on envVar A_ASG_69_0_0_27_Data_8_SetGet_20
{
	byte bitval;
	//thisval steht hier fuer den bitfield-wert, 
	//aus Generierungsgruenden hier keine einheitliche Bezeichnung moeglich.
	dword thisval; // Display1AdditionalInfo2_1
	bitval= getValue(this);
	thisval = getValue(A_ASG_69_0_0_27_Data_8_SetGet);
	thisval = thisval&~(1<<20)|(bitval<<20);
	putValue(A_ASG_69_0_0_27_Data_8_SetGet,thisval);
}

on envVar A_ASG_69_0_0_27_Data_8_SetGet_21
{
	byte bitval;
	//thisval steht hier fuer den bitfield-wert, 
	//aus Generierungsgruenden hier keine einheitliche Bezeichnung moeglich.
	dword thisval; // Display1AdditionalInfo2_1
	bitval= getValue(this);
	thisval = getValue(A_ASG_69_0_0_27_Data_8_SetGet);
	thisval = thisval&~(1<<21)|(bitval<<21);
	putValue(A_ASG_69_0_0_27_Data_8_SetGet,thisval);
}

on envVar A_ASG_69_0_0_27_Data_8_SetGet_22
{
	byte bitval;
	//thisval steht hier fuer den bitfield-wert, 
	//aus Generierungsgruenden hier keine einheitliche Bezeichnung moeglich.
	dword thisval; // Display1AdditionalInfo2_1
	bitval= getValue(this);
	thisval = getValue(A_ASG_69_0_0_27_Data_8_SetGet);
	thisval = thisval&~(1<<22)|(bitval<<22);
	putValue(A_ASG_69_0_0_27_Data_8_SetGet,thisval);
}

on envVar A_ASG_69_0_0_27_Data_8_SetGet_23
{
	byte bitval;
	//thisval steht hier fuer den bitfield-wert, 
	//aus Generierungsgruenden hier keine einheitliche Bezeichnung moeglich.
	dword thisval; // Display1AdditionalInfo2_1
	bitval= getValue(this);
	thisval = getValue(A_ASG_69_0_0_27_Data_8_SetGet);
	thisval = thisval&~(1<<23)|(bitval<<23);
	putValue(A_ASG_69_0_0_27_Data_8_SetGet,thisval);
}

on envVar A_ASG_69_0_0_27_Data_8_SetGet_24
{
	byte bitval;
	//thisval steht hier fuer den bitfield-wert, 
	//aus Generierungsgruenden hier keine einheitliche Bezeichnung moeglich.
	dword thisval; // Display1AdditionalInfo2_1
	bitval= getValue(this);
	thisval = getValue(A_ASG_69_0_0_27_Data_8_SetGet);
	thisval = thisval&~(1<<24)|(bitval<<24);
	putValue(A_ASG_69_0_0_27_Data_8_SetGet,thisval);
}

on envVar A_ASG_69_0_0_27_Data_8_SetGet_25
{
	byte bitval;
	//thisval steht hier fuer den bitfield-wert, 
	//aus Generierungsgruenden hier keine einheitliche Bezeichnung moeglich.
	dword thisval; // Display1AdditionalInfo2_1
	bitval= getValue(this);
	thisval = getValue(A_ASG_69_0_0_27_Data_8_SetGet);
	thisval = thisval&~(1<<25)|(bitval<<25);
	putValue(A_ASG_69_0_0_27_Data_8_SetGet,thisval);
}

on envVar A_ASG_69_0_0_27_Data_8_SetGet_26
{
	byte bitval;
	//thisval steht hier fuer den bitfield-wert, 
	//aus Generierungsgruenden hier keine einheitliche Bezeichnung moeglich.
	dword thisval; // Display1AdditionalInfo2_1
	bitval= getValue(this);
	thisval = getValue(A_ASG_69_0_0_27_Data_8_SetGet);
	thisval = thisval&~(1<<26)|(bitval<<26);
	putValue(A_ASG_69_0_0_27_Data_8_SetGet,thisval);
}

on envVar A_ASG_69_0_0_27_Data_8_SetGet_27
{
	byte bitval;
	//thisval steht hier fuer den bitfield-wert, 
	//aus Generierungsgruenden hier keine einheitliche Bezeichnung moeglich.
	dword thisval; // Display1AdditionalInfo2_1
	bitval= getValue(this);
	thisval = getValue(A_ASG_69_0_0_27_Data_8_SetGet);
	thisval = thisval&~(1<<27)|(bitval<<27);
	putValue(A_ASG_69_0_0_27_Data_8_SetGet,thisval);
}

on envVar A_ASG_69_0_0_27_Data_8_SetGet_28
{
	byte bitval;
	//thisval steht hier fuer den bitfield-wert, 
	//aus Generierungsgruenden hier keine einheitliche Bezeichnung moeglich.
	dword thisval; // Display1AdditionalInfo2_1
	bitval= getValue(this);
	thisval = getValue(A_ASG_69_0_0_27_Data_8_SetGet);
	thisval = thisval&~(1<<28)|(bitval<<28);
	putValue(A_ASG_69_0_0_27_Data_8_SetGet,thisval);
}

on envVar A_ASG_69_0_0_27_Data_8_SetGet_29
{
	byte bitval;
	//thisval steht hier fuer den bitfield-wert, 
	//aus Generierungsgruenden hier keine einheitliche Bezeichnung moeglich.
	dword thisval; // Display1AdditionalInfo2_1
	bitval= getValue(this);
	thisval = getValue(A_ASG_69_0_0_27_Data_8_SetGet);
	thisval = thisval&~(1<<29)|(bitval<<29);
	putValue(A_ASG_69_0_0_27_Data_8_SetGet,thisval);
}

on envVar A_ASG_69_0_0_27_Data_8_SetGet_30
{
	byte bitval;
	//thisval steht hier fuer den bitfield-wert, 
	//aus Generierungsgruenden hier keine einheitliche Bezeichnung moeglich.
	dword thisval; // Display1AdditionalInfo2_1
	bitval= getValue(this);
	thisval = getValue(A_ASG_69_0_0_27_Data_8_SetGet);
	thisval = thisval&~(1<<30)|(bitval<<30);
	putValue(A_ASG_69_0_0_27_Data_8_SetGet,thisval);
}

on envVar A_ASG_69_0_0_27_Data_8_SetGet_31
{
	byte bitval;
	//thisval steht hier fuer den bitfield-wert, 
	//aus Generierungsgruenden hier keine einheitliche Bezeichnung moeglich.
	dword thisval; // Display1AdditionalInfo2_1
	bitval= getValue(this);
	thisval = getValue(A_ASG_69_0_0_27_Data_8_SetGet);
	thisval = thisval&~(1<<31)|(bitval<<31);
	putValue(A_ASG_69_0_0_27_Data_8_SetGet,thisval);
}

on envVar A_ASG_69_0_0_27_Data_8_SetGet
{
	byte superval[664];

	//Update Childvalue (BitField)
	byte mask=0x01;
	int i = 0;
	dword thisval; // Display1AdditionalInfo2_1
	thisval = getValue(this);
	if(thisval&(mask<<0))
		putValue(A_ASG_69_0_0_27_Data_8_SetGet_0, 1);
	else
		putValue(A_ASG_69_0_0_27_Data_8_SetGet_0, 0);
	if(thisval&(mask<<1))
		putValue(A_ASG_69_0_0_27_Data_8_SetGet_1, 1);
	else
		putValue(A_ASG_69_0_0_27_Data_8_SetGet_1, 0);
	if(thisval&(mask<<2))
		putValue(A_ASG_69_0_0_27_Data_8_SetGet_2, 1);
	else
		putValue(A_ASG_69_0_0_27_Data_8_SetGet_2, 0);
	if(thisval&(mask<<3))
		putValue(A_ASG_69_0_0_27_Data_8_SetGet_3, 1);
	else
		putValue(A_ASG_69_0_0_27_Data_8_SetGet_3, 0);
	if(thisval&(mask<<4))
		putValue(A_ASG_69_0_0_27_Data_8_SetGet_4, 1);
	else
		putValue(A_ASG_69_0_0_27_Data_8_SetGet_4, 0);
	if(thisval&(mask<<5))
		putValue(A_ASG_69_0_0_27_Data_8_SetGet_5, 1);
	else
		putValue(A_ASG_69_0_0_27_Data_8_SetGet_5, 0);
	if(thisval&(mask<<6))
		putValue(A_ASG_69_0_0_27_Data_8_SetGet_6, 1);
	else
		putValue(A_ASG_69_0_0_27_Data_8_SetGet_6, 0);
	if(thisval&(mask<<7))
		putValue(A_ASG_69_0_0_27_Data_8_SetGet_7, 1);
	else
		putValue(A_ASG_69_0_0_27_Data_8_SetGet_7, 0);
	if(thisval&(mask<<8))
		putValue(A_ASG_69_0_0_27_Data_8_SetGet_8, 1);
	else
		putValue(A_ASG_69_0_0_27_Data_8_SetGet_8, 0);
	if(thisval&(mask<<9))
		putValue(A_ASG_69_0_0_27_Data_8_SetGet_9, 1);
	else
		putValue(A_ASG_69_0_0_27_Data_8_SetGet_9, 0);
	if(thisval&(mask<<10))
		putValue(A_ASG_69_0_0_27_Data_8_SetGet_10, 1);
	else
		putValue(A_ASG_69_0_0_27_Data_8_SetGet_10, 0);
	if(thisval&(mask<<11))
		putValue(A_ASG_69_0_0_27_Data_8_SetGet_11, 1);
	else
		putValue(A_ASG_69_0_0_27_Data_8_SetGet_11, 0);
	if(thisval&(mask<<12))
		putValue(A_ASG_69_0_0_27_Data_8_SetGet_12, 1);
	else
		putValue(A_ASG_69_0_0_27_Data_8_SetGet_12, 0);
	if(thisval&(mask<<13))
		putValue(A_ASG_69_0_0_27_Data_8_SetGet_13, 1);
	else
		putValue(A_ASG_69_0_0_27_Data_8_SetGet_13, 0);
	if(thisval&(mask<<14))
		putValue(A_ASG_69_0_0_27_Data_8_SetGet_14, 1);
	else
		putValue(A_ASG_69_0_0_27_Data_8_SetGet_14, 0);
	if(thisval&(mask<<15))
		putValue(A_ASG_69_0_0_27_Data_8_SetGet_15, 1);
	else
		putValue(A_ASG_69_0_0_27_Data_8_SetGet_15, 0);
	if(thisval&(mask<<16))
		putValue(A_ASG_69_0_0_27_Data_8_SetGet_16, 1);
	else
		putValue(A_ASG_69_0_0_27_Data_8_SetGet_16, 0);
	if(thisval&(mask<<17))
		putValue(A_ASG_69_0_0_27_Data_8_SetGet_17, 1);
	else
		putValue(A_ASG_69_0_0_27_Data_8_SetGet_17, 0);
	if(thisval&(mask<<18))
		putValue(A_ASG_69_0_0_27_Data_8_SetGet_18, 1);
	else
		putValue(A_ASG_69_0_0_27_Data_8_SetGet_18, 0);
	if(thisval&(mask<<19))
		putValue(A_ASG_69_0_0_27_Data_8_SetGet_19, 1);
	else
		putValue(A_ASG_69_0_0_27_Data_8_SetGet_19, 0);
	if(thisval&(mask<<20))
		putValue(A_ASG_69_0_0_27_Data_8_SetGet_20, 1);
	else
		putValue(A_ASG_69_0_0_27_Data_8_SetGet_20, 0);
	if(thisval&(mask<<21))
		putValue(A_ASG_69_0_0_27_Data_8_SetGet_21, 1);
	else
		putValue(A_ASG_69_0_0_27_Data_8_SetGet_21, 0);
	if(thisval&(mask<<22))
		putValue(A_ASG_69_0_0_27_Data_8_SetGet_22, 1);
	else
		putValue(A_ASG_69_0_0_27_Data_8_SetGet_22, 0);
	if(thisval&(mask<<23))
		putValue(A_ASG_69_0_0_27_Data_8_SetGet_23, 1);
	else
		putValue(A_ASG_69_0_0_27_Data_8_SetGet_23, 0);
	if(thisval&(mask<<24))
		putValue(A_ASG_69_0_0_27_Data_8_SetGet_24, 1);
	else
		putValue(A_ASG_69_0_0_27_Data_8_SetGet_24, 0);
	if(thisval&(mask<<25))
		putValue(A_ASG_69_0_0_27_Data_8_SetGet_25, 1);
	else
		putValue(A_ASG_69_0_0_27_Data_8_SetGet_25, 0);
	if(thisval&(mask<<26))
		putValue(A_ASG_69_0_0_27_Data_8_SetGet_26, 1);
	else
		putValue(A_ASG_69_0_0_27_Data_8_SetGet_26, 0);
	if(thisval&(mask<<27))
		putValue(A_ASG_69_0_0_27_Data_8_SetGet_27, 1);
	else
		putValue(A_ASG_69_0_0_27_Data_8_SetGet_27, 0);
	if(thisval&(mask<<28))
		putValue(A_ASG_69_0_0_27_Data_8_SetGet_28, 1);
	else
		putValue(A_ASG_69_0_0_27_Data_8_SetGet_28, 0);
	if(thisval&(mask<<29))
		putValue(A_ASG_69_0_0_27_Data_8_SetGet_29, 1);
	else
		putValue(A_ASG_69_0_0_27_Data_8_SetGet_29, 0);
	if(thisval&(mask<<30))
		putValue(A_ASG_69_0_0_27_Data_8_SetGet_30, 1);
	else
		putValue(A_ASG_69_0_0_27_Data_8_SetGet_30, 0);
	if(thisval&(mask<<31))
		putValue(A_ASG_69_0_0_27_Data_8_SetGet_31, 1);
	else
		putValue(A_ASG_69_0_0_27_Data_8_SetGet_31, 0);
    A_ASG_69_0_0_27_ArrayDataList[getValue(A_ASG_69_0_0_27_DataIndex_SetGet)].Param8 = thisval;
}
on envVar A_ASG_69_0_0_27_Data_9_SetGet_0
{
	byte bitval;
	//thisval steht hier fuer den bitfield-wert, 
	//aus Generierungsgruenden hier keine einheitliche Bezeichnung moeglich.
	dword thisval; // Display1AdditionalInfo2_2
	bitval= getValue(this);
	thisval = getValue(A_ASG_69_0_0_27_Data_9_SetGet);
	thisval = thisval&~(1<<0)|(bitval<<0);
	putValue(A_ASG_69_0_0_27_Data_9_SetGet,thisval);
}

on envVar A_ASG_69_0_0_27_Data_9_SetGet_1
{
	byte bitval;
	//thisval steht hier fuer den bitfield-wert, 
	//aus Generierungsgruenden hier keine einheitliche Bezeichnung moeglich.
	dword thisval; // Display1AdditionalInfo2_2
	bitval= getValue(this);
	thisval = getValue(A_ASG_69_0_0_27_Data_9_SetGet);
	thisval = thisval&~(1<<1)|(bitval<<1);
	putValue(A_ASG_69_0_0_27_Data_9_SetGet,thisval);
}

on envVar A_ASG_69_0_0_27_Data_9_SetGet_2
{
	byte bitval;
	//thisval steht hier fuer den bitfield-wert, 
	//aus Generierungsgruenden hier keine einheitliche Bezeichnung moeglich.
	dword thisval; // Display1AdditionalInfo2_2
	bitval= getValue(this);
	thisval = getValue(A_ASG_69_0_0_27_Data_9_SetGet);
	thisval = thisval&~(1<<2)|(bitval<<2);
	putValue(A_ASG_69_0_0_27_Data_9_SetGet,thisval);
}

on envVar A_ASG_69_0_0_27_Data_9_SetGet_3
{
	byte bitval;
	//thisval steht hier fuer den bitfield-wert, 
	//aus Generierungsgruenden hier keine einheitliche Bezeichnung moeglich.
	dword thisval; // Display1AdditionalInfo2_2
	bitval= getValue(this);
	thisval = getValue(A_ASG_69_0_0_27_Data_9_SetGet);
	thisval = thisval&~(1<<3)|(bitval<<3);
	putValue(A_ASG_69_0_0_27_Data_9_SetGet,thisval);
}

on envVar A_ASG_69_0_0_27_Data_9_SetGet_4
{
	byte bitval;
	//thisval steht hier fuer den bitfield-wert, 
	//aus Generierungsgruenden hier keine einheitliche Bezeichnung moeglich.
	dword thisval; // Display1AdditionalInfo2_2
	bitval= getValue(this);
	thisval = getValue(A_ASG_69_0_0_27_Data_9_SetGet);
	thisval = thisval&~(1<<4)|(bitval<<4);
	putValue(A_ASG_69_0_0_27_Data_9_SetGet,thisval);
}

on envVar A_ASG_69_0_0_27_Data_9_SetGet_5
{
	byte bitval;
	//thisval steht hier fuer den bitfield-wert, 
	//aus Generierungsgruenden hier keine einheitliche Bezeichnung moeglich.
	dword thisval; // Display1AdditionalInfo2_2
	bitval= getValue(this);
	thisval = getValue(A_ASG_69_0_0_27_Data_9_SetGet);
	thisval = thisval&~(1<<5)|(bitval<<5);
	putValue(A_ASG_69_0_0_27_Data_9_SetGet,thisval);
}

on envVar A_ASG_69_0_0_27_Data_9_SetGet_6
{
	byte bitval;
	//thisval steht hier fuer den bitfield-wert, 
	//aus Generierungsgruenden hier keine einheitliche Bezeichnung moeglich.
	dword thisval; // Display1AdditionalInfo2_2
	bitval= getValue(this);
	thisval = getValue(A_ASG_69_0_0_27_Data_9_SetGet);
	thisval = thisval&~(1<<6)|(bitval<<6);
	putValue(A_ASG_69_0_0_27_Data_9_SetGet,thisval);
}

on envVar A_ASG_69_0_0_27_Data_9_SetGet_7
{
	byte bitval;
	//thisval steht hier fuer den bitfield-wert, 
	//aus Generierungsgruenden hier keine einheitliche Bezeichnung moeglich.
	dword thisval; // Display1AdditionalInfo2_2
	bitval= getValue(this);
	thisval = getValue(A_ASG_69_0_0_27_Data_9_SetGet);
	thisval = thisval&~(1<<7)|(bitval<<7);
	putValue(A_ASG_69_0_0_27_Data_9_SetGet,thisval);
}

on envVar A_ASG_69_0_0_27_Data_9_SetGet_8
{
	byte bitval;
	//thisval steht hier fuer den bitfield-wert, 
	//aus Generierungsgruenden hier keine einheitliche Bezeichnung moeglich.
	dword thisval; // Display1AdditionalInfo2_2
	bitval= getValue(this);
	thisval = getValue(A_ASG_69_0_0_27_Data_9_SetGet);
	thisval = thisval&~(1<<8)|(bitval<<8);
	putValue(A_ASG_69_0_0_27_Data_9_SetGet,thisval);
}

on envVar A_ASG_69_0_0_27_Data_9_SetGet_9
{
	byte bitval;
	//thisval steht hier fuer den bitfield-wert, 
	//aus Generierungsgruenden hier keine einheitliche Bezeichnung moeglich.
	dword thisval; // Display1AdditionalInfo2_2
	bitval= getValue(this);
	thisval = getValue(A_ASG_69_0_0_27_Data_9_SetGet);
	thisval = thisval&~(1<<9)|(bitval<<9);
	putValue(A_ASG_69_0_0_27_Data_9_SetGet,thisval);
}

on envVar A_ASG_69_0_0_27_Data_9_SetGet_10
{
	byte bitval;
	//thisval steht hier fuer den bitfield-wert, 
	//aus Generierungsgruenden hier keine einheitliche Bezeichnung moeglich.
	dword thisval; // Display1AdditionalInfo2_2
	bitval= getValue(this);
	thisval = getValue(A_ASG_69_0_0_27_Data_9_SetGet);
	thisval = thisval&~(1<<10)|(bitval<<10);
	putValue(A_ASG_69_0_0_27_Data_9_SetGet,thisval);
}

on envVar A_ASG_69_0_0_27_Data_9_SetGet_11
{
	byte bitval;
	//thisval steht hier fuer den bitfield-wert, 
	//aus Generierungsgruenden hier keine einheitliche Bezeichnung moeglich.
	dword thisval; // Display1AdditionalInfo2_2
	bitval= getValue(this);
	thisval = getValue(A_ASG_69_0_0_27_Data_9_SetGet);
	thisval = thisval&~(1<<11)|(bitval<<11);
	putValue(A_ASG_69_0_0_27_Data_9_SetGet,thisval);
}

on envVar A_ASG_69_0_0_27_Data_9_SetGet_12
{
	byte bitval;
	//thisval steht hier fuer den bitfield-wert, 
	//aus Generierungsgruenden hier keine einheitliche Bezeichnung moeglich.
	dword thisval; // Display1AdditionalInfo2_2
	bitval= getValue(this);
	thisval = getValue(A_ASG_69_0_0_27_Data_9_SetGet);
	thisval = thisval&~(1<<12)|(bitval<<12);
	putValue(A_ASG_69_0_0_27_Data_9_SetGet,thisval);
}

on envVar A_ASG_69_0_0_27_Data_9_SetGet_13
{
	byte bitval;
	//thisval steht hier fuer den bitfield-wert, 
	//aus Generierungsgruenden hier keine einheitliche Bezeichnung moeglich.
	dword thisval; // Display1AdditionalInfo2_2
	bitval= getValue(this);
	thisval = getValue(A_ASG_69_0_0_27_Data_9_SetGet);
	thisval = thisval&~(1<<13)|(bitval<<13);
	putValue(A_ASG_69_0_0_27_Data_9_SetGet,thisval);
}

on envVar A_ASG_69_0_0_27_Data_9_SetGet_14
{
	byte bitval;
	//thisval steht hier fuer den bitfield-wert, 
	//aus Generierungsgruenden hier keine einheitliche Bezeichnung moeglich.
	dword thisval; // Display1AdditionalInfo2_2
	bitval= getValue(this);
	thisval = getValue(A_ASG_69_0_0_27_Data_9_SetGet);
	thisval = thisval&~(1<<14)|(bitval<<14);
	putValue(A_ASG_69_0_0_27_Data_9_SetGet,thisval);
}

on envVar A_ASG_69_0_0_27_Data_9_SetGet_15
{
	byte bitval;
	//thisval steht hier fuer den bitfield-wert, 
	//aus Generierungsgruenden hier keine einheitliche Bezeichnung moeglich.
	dword thisval; // Display1AdditionalInfo2_2
	bitval= getValue(this);
	thisval = getValue(A_ASG_69_0_0_27_Data_9_SetGet);
	thisval = thisval&~(1<<15)|(bitval<<15);
	putValue(A_ASG_69_0_0_27_Data_9_SetGet,thisval);
}

on envVar A_ASG_69_0_0_27_Data_9_SetGet_16
{
	byte bitval;
	//thisval steht hier fuer den bitfield-wert, 
	//aus Generierungsgruenden hier keine einheitliche Bezeichnung moeglich.
	dword thisval; // Display1AdditionalInfo2_2
	bitval= getValue(this);
	thisval = getValue(A_ASG_69_0_0_27_Data_9_SetGet);
	thisval = thisval&~(1<<16)|(bitval<<16);
	putValue(A_ASG_69_0_0_27_Data_9_SetGet,thisval);
}

on envVar A_ASG_69_0_0_27_Data_9_SetGet_17
{
	byte bitval;
	//thisval steht hier fuer den bitfield-wert, 
	//aus Generierungsgruenden hier keine einheitliche Bezeichnung moeglich.
	dword thisval; // Display1AdditionalInfo2_2
	bitval= getValue(this);
	thisval = getValue(A_ASG_69_0_0_27_Data_9_SetGet);
	thisval = thisval&~(1<<17)|(bitval<<17);
	putValue(A_ASG_69_0_0_27_Data_9_SetGet,thisval);
}

on envVar A_ASG_69_0_0_27_Data_9_SetGet_18
{
	byte bitval;
	//thisval steht hier fuer den bitfield-wert, 
	//aus Generierungsgruenden hier keine einheitliche Bezeichnung moeglich.
	dword thisval; // Display1AdditionalInfo2_2
	bitval= getValue(this);
	thisval = getValue(A_ASG_69_0_0_27_Data_9_SetGet);
	thisval = thisval&~(1<<18)|(bitval<<18);
	putValue(A_ASG_69_0_0_27_Data_9_SetGet,thisval);
}

on envVar A_ASG_69_0_0_27_Data_9_SetGet_19
{
	byte bitval;
	//thisval steht hier fuer den bitfield-wert, 
	//aus Generierungsgruenden hier keine einheitliche Bezeichnung moeglich.
	dword thisval; // Display1AdditionalInfo2_2
	bitval= getValue(this);
	thisval = getValue(A_ASG_69_0_0_27_Data_9_SetGet);
	thisval = thisval&~(1<<19)|(bitval<<19);
	putValue(A_ASG_69_0_0_27_Data_9_SetGet,thisval);
}

on envVar A_ASG_69_0_0_27_Data_9_SetGet_20
{
	byte bitval;
	//thisval steht hier fuer den bitfield-wert, 
	//aus Generierungsgruenden hier keine einheitliche Bezeichnung moeglich.
	dword thisval; // Display1AdditionalInfo2_2
	bitval= getValue(this);
	thisval = getValue(A_ASG_69_0_0_27_Data_9_SetGet);
	thisval = thisval&~(1<<20)|(bitval<<20);
	putValue(A_ASG_69_0_0_27_Data_9_SetGet,thisval);
}

on envVar A_ASG_69_0_0_27_Data_9_SetGet_21
{
	byte bitval;
	//thisval steht hier fuer den bitfield-wert, 
	//aus Generierungsgruenden hier keine einheitliche Bezeichnung moeglich.
	dword thisval; // Display1AdditionalInfo2_2
	bitval= getValue(this);
	thisval = getValue(A_ASG_69_0_0_27_Data_9_SetGet);
	thisval = thisval&~(1<<21)|(bitval<<21);
	putValue(A_ASG_69_0_0_27_Data_9_SetGet,thisval);
}

on envVar A_ASG_69_0_0_27_Data_9_SetGet_22
{
	byte bitval;
	//thisval steht hier fuer den bitfield-wert, 
	//aus Generierungsgruenden hier keine einheitliche Bezeichnung moeglich.
	dword thisval; // Display1AdditionalInfo2_2
	bitval= getValue(this);
	thisval = getValue(A_ASG_69_0_0_27_Data_9_SetGet);
	thisval = thisval&~(1<<22)|(bitval<<22);
	putValue(A_ASG_69_0_0_27_Data_9_SetGet,thisval);
}

on envVar A_ASG_69_0_0_27_Data_9_SetGet_23
{
	byte bitval;
	//thisval steht hier fuer den bitfield-wert, 
	//aus Generierungsgruenden hier keine einheitliche Bezeichnung moeglich.
	dword thisval; // Display1AdditionalInfo2_2
	bitval= getValue(this);
	thisval = getValue(A_ASG_69_0_0_27_Data_9_SetGet);
	thisval = thisval&~(1<<23)|(bitval<<23);
	putValue(A_ASG_69_0_0_27_Data_9_SetGet,thisval);
}

on envVar A_ASG_69_0_0_27_Data_9_SetGet_24
{
	byte bitval;
	//thisval steht hier fuer den bitfield-wert, 
	//aus Generierungsgruenden hier keine einheitliche Bezeichnung moeglich.
	dword thisval; // Display1AdditionalInfo2_2
	bitval= getValue(this);
	thisval = getValue(A_ASG_69_0_0_27_Data_9_SetGet);
	thisval = thisval&~(1<<24)|(bitval<<24);
	putValue(A_ASG_69_0_0_27_Data_9_SetGet,thisval);
}

on envVar A_ASG_69_0_0_27_Data_9_SetGet_25
{
	byte bitval;
	//thisval steht hier fuer den bitfield-wert, 
	//aus Generierungsgruenden hier keine einheitliche Bezeichnung moeglich.
	dword thisval; // Display1AdditionalInfo2_2
	bitval= getValue(this);
	thisval = getValue(A_ASG_69_0_0_27_Data_9_SetGet);
	thisval = thisval&~(1<<25)|(bitval<<25);
	putValue(A_ASG_69_0_0_27_Data_9_SetGet,thisval);
}

on envVar A_ASG_69_0_0_27_Data_9_SetGet_26
{
	byte bitval;
	//thisval steht hier fuer den bitfield-wert, 
	//aus Generierungsgruenden hier keine einheitliche Bezeichnung moeglich.
	dword thisval; // Display1AdditionalInfo2_2
	bitval= getValue(this);
	thisval = getValue(A_ASG_69_0_0_27_Data_9_SetGet);
	thisval = thisval&~(1<<26)|(bitval<<26);
	putValue(A_ASG_69_0_0_27_Data_9_SetGet,thisval);
}

on envVar A_ASG_69_0_0_27_Data_9_SetGet_27
{
	byte bitval;
	//thisval steht hier fuer den bitfield-wert, 
	//aus Generierungsgruenden hier keine einheitliche Bezeichnung moeglich.
	dword thisval; // Display1AdditionalInfo2_2
	bitval= getValue(this);
	thisval = getValue(A_ASG_69_0_0_27_Data_9_SetGet);
	thisval = thisval&~(1<<27)|(bitval<<27);
	putValue(A_ASG_69_0_0_27_Data_9_SetGet,thisval);
}

on envVar A_ASG_69_0_0_27_Data_9_SetGet_28
{
	byte bitval;
	//thisval steht hier fuer den bitfield-wert, 
	//aus Generierungsgruenden hier keine einheitliche Bezeichnung moeglich.
	dword thisval; // Display1AdditionalInfo2_2
	bitval= getValue(this);
	thisval = getValue(A_ASG_69_0_0_27_Data_9_SetGet);
	thisval = thisval&~(1<<28)|(bitval<<28);
	putValue(A_ASG_69_0_0_27_Data_9_SetGet,thisval);
}

on envVar A_ASG_69_0_0_27_Data_9_SetGet_29
{
	byte bitval;
	//thisval steht hier fuer den bitfield-wert, 
	//aus Generierungsgruenden hier keine einheitliche Bezeichnung moeglich.
	dword thisval; // Display1AdditionalInfo2_2
	bitval= getValue(this);
	thisval = getValue(A_ASG_69_0_0_27_Data_9_SetGet);
	thisval = thisval&~(1<<29)|(bitval<<29);
	putValue(A_ASG_69_0_0_27_Data_9_SetGet,thisval);
}

on envVar A_ASG_69_0_0_27_Data_9_SetGet
{
	byte superval[664];

	//Update Childvalue (BitField)
	byte mask=0x01;
	int i = 0;
	dword thisval; // Display1AdditionalInfo2_2
	thisval = getValue(this);
	if(thisval&(mask<<0))
		putValue(A_ASG_69_0_0_27_Data_9_SetGet_0, 1);
	else
		putValue(A_ASG_69_0_0_27_Data_9_SetGet_0, 0);
	if(thisval&(mask<<1))
		putValue(A_ASG_69_0_0_27_Data_9_SetGet_1, 1);
	else
		putValue(A_ASG_69_0_0_27_Data_9_SetGet_1, 0);
	if(thisval&(mask<<2))
		putValue(A_ASG_69_0_0_27_Data_9_SetGet_2, 1);
	else
		putValue(A_ASG_69_0_0_27_Data_9_SetGet_2, 0);
	if(thisval&(mask<<3))
		putValue(A_ASG_69_0_0_27_Data_9_SetGet_3, 1);
	else
		putValue(A_ASG_69_0_0_27_Data_9_SetGet_3, 0);
	if(thisval&(mask<<4))
		putValue(A_ASG_69_0_0_27_Data_9_SetGet_4, 1);
	else
		putValue(A_ASG_69_0_0_27_Data_9_SetGet_4, 0);
	if(thisval&(mask<<5))
		putValue(A_ASG_69_0_0_27_Data_9_SetGet_5, 1);
	else
		putValue(A_ASG_69_0_0_27_Data_9_SetGet_5, 0);
	if(thisval&(mask<<6))
		putValue(A_ASG_69_0_0_27_Data_9_SetGet_6, 1);
	else
		putValue(A_ASG_69_0_0_27_Data_9_SetGet_6, 0);
	if(thisval&(mask<<7))
		putValue(A_ASG_69_0_0_27_Data_9_SetGet_7, 1);
	else
		putValue(A_ASG_69_0_0_27_Data_9_SetGet_7, 0);
	if(thisval&(mask<<8))
		putValue(A_ASG_69_0_0_27_Data_9_SetGet_8, 1);
	else
		putValue(A_ASG_69_0_0_27_Data_9_SetGet_8, 0);
	if(thisval&(mask<<9))
		putValue(A_ASG_69_0_0_27_Data_9_SetGet_9, 1);
	else
		putValue(A_ASG_69_0_0_27_Data_9_SetGet_9, 0);
	if(thisval&(mask<<10))
		putValue(A_ASG_69_0_0_27_Data_9_SetGet_10, 1);
	else
		putValue(A_ASG_69_0_0_27_Data_9_SetGet_10, 0);
	if(thisval&(mask<<11))
		putValue(A_ASG_69_0_0_27_Data_9_SetGet_11, 1);
	else
		putValue(A_ASG_69_0_0_27_Data_9_SetGet_11, 0);
	if(thisval&(mask<<12))
		putValue(A_ASG_69_0_0_27_Data_9_SetGet_12, 1);
	else
		putValue(A_ASG_69_0_0_27_Data_9_SetGet_12, 0);
	if(thisval&(mask<<13))
		putValue(A_ASG_69_0_0_27_Data_9_SetGet_13, 1);
	else
		putValue(A_ASG_69_0_0_27_Data_9_SetGet_13, 0);
	if(thisval&(mask<<14))
		putValue(A_ASG_69_0_0_27_Data_9_SetGet_14, 1);
	else
		putValue(A_ASG_69_0_0_27_Data_9_SetGet_14, 0);
	if(thisval&(mask<<15))
		putValue(A_ASG_69_0_0_27_Data_9_SetGet_15, 1);
	else
		putValue(A_ASG_69_0_0_27_Data_9_SetGet_15, 0);
	if(thisval&(mask<<16))
		putValue(A_ASG_69_0_0_27_Data_9_SetGet_16, 1);
	else
		putValue(A_ASG_69_0_0_27_Data_9_SetGet_16, 0);
	if(thisval&(mask<<17))
		putValue(A_ASG_69_0_0_27_Data_9_SetGet_17, 1);
	else
		putValue(A_ASG_69_0_0_27_Data_9_SetGet_17, 0);
	if(thisval&(mask<<18))
		putValue(A_ASG_69_0_0_27_Data_9_SetGet_18, 1);
	else
		putValue(A_ASG_69_0_0_27_Data_9_SetGet_18, 0);
	if(thisval&(mask<<19))
		putValue(A_ASG_69_0_0_27_Data_9_SetGet_19, 1);
	else
		putValue(A_ASG_69_0_0_27_Data_9_SetGet_19, 0);
	if(thisval&(mask<<20))
		putValue(A_ASG_69_0_0_27_Data_9_SetGet_20, 1);
	else
		putValue(A_ASG_69_0_0_27_Data_9_SetGet_20, 0);
	if(thisval&(mask<<21))
		putValue(A_ASG_69_0_0_27_Data_9_SetGet_21, 1);
	else
		putValue(A_ASG_69_0_0_27_Data_9_SetGet_21, 0);
	if(thisval&(mask<<22))
		putValue(A_ASG_69_0_0_27_Data_9_SetGet_22, 1);
	else
		putValue(A_ASG_69_0_0_27_Data_9_SetGet_22, 0);
	if(thisval&(mask<<23))
		putValue(A_ASG_69_0_0_27_Data_9_SetGet_23, 1);
	else
		putValue(A_ASG_69_0_0_27_Data_9_SetGet_23, 0);
	if(thisval&(mask<<24))
		putValue(A_ASG_69_0_0_27_Data_9_SetGet_24, 1);
	else
		putValue(A_ASG_69_0_0_27_Data_9_SetGet_24, 0);
	if(thisval&(mask<<25))
		putValue(A_ASG_69_0_0_27_Data_9_SetGet_25, 1);
	else
		putValue(A_ASG_69_0_0_27_Data_9_SetGet_25, 0);
	if(thisval&(mask<<26))
		putValue(A_ASG_69_0_0_27_Data_9_SetGet_26, 1);
	else
		putValue(A_ASG_69_0_0_27_Data_9_SetGet_26, 0);
	if(thisval&(mask<<27))
		putValue(A_ASG_69_0_0_27_Data_9_SetGet_27, 1);
	else
		putValue(A_ASG_69_0_0_27_Data_9_SetGet_27, 0);
	if(thisval&(mask<<28))
		putValue(A_ASG_69_0_0_27_Data_9_SetGet_28, 1);
	else
		putValue(A_ASG_69_0_0_27_Data_9_SetGet_28, 0);
	if(thisval&(mask<<29))
		putValue(A_ASG_69_0_0_27_Data_9_SetGet_29, 1);
	else
		putValue(A_ASG_69_0_0_27_Data_9_SetGet_29, 0);
    A_ASG_69_0_0_27_ArrayDataList[getValue(A_ASG_69_0_0_27_DataIndex_SetGet)].Param9 = thisval;
}
on envVar A_ASG_69_0_0_27_Data_10_SetGet_0
{
	byte bitval;
	//thisval steht hier fuer den bitfield-wert, 
	//aus Generierungsgruenden hier keine einheitliche Bezeichnung moeglich.
	dword thisval; // Display2MainSelection
	bitval= getValue(this);
	thisval = getValue(A_ASG_69_0_0_27_Data_10_SetGet);
	thisval = thisval&~(1<<0)|(bitval<<0);
	putValue(A_ASG_69_0_0_27_Data_10_SetGet,thisval);
}

on envVar A_ASG_69_0_0_27_Data_10_SetGet_1
{
	byte bitval;
	//thisval steht hier fuer den bitfield-wert, 
	//aus Generierungsgruenden hier keine einheitliche Bezeichnung moeglich.
	dword thisval; // Display2MainSelection
	bitval= getValue(this);
	thisval = getValue(A_ASG_69_0_0_27_Data_10_SetGet);
	thisval = thisval&~(1<<1)|(bitval<<1);
	putValue(A_ASG_69_0_0_27_Data_10_SetGet,thisval);
}

on envVar A_ASG_69_0_0_27_Data_10_SetGet_2
{
	byte bitval;
	//thisval steht hier fuer den bitfield-wert, 
	//aus Generierungsgruenden hier keine einheitliche Bezeichnung moeglich.
	dword thisval; // Display2MainSelection
	bitval= getValue(this);
	thisval = getValue(A_ASG_69_0_0_27_Data_10_SetGet);
	thisval = thisval&~(1<<2)|(bitval<<2);
	putValue(A_ASG_69_0_0_27_Data_10_SetGet,thisval);
}

on envVar A_ASG_69_0_0_27_Data_10_SetGet_3
{
	byte bitval;
	//thisval steht hier fuer den bitfield-wert, 
	//aus Generierungsgruenden hier keine einheitliche Bezeichnung moeglich.
	dword thisval; // Display2MainSelection
	bitval= getValue(this);
	thisval = getValue(A_ASG_69_0_0_27_Data_10_SetGet);
	thisval = thisval&~(1<<3)|(bitval<<3);
	putValue(A_ASG_69_0_0_27_Data_10_SetGet,thisval);
}

on envVar A_ASG_69_0_0_27_Data_10_SetGet_4
{
	byte bitval;
	//thisval steht hier fuer den bitfield-wert, 
	//aus Generierungsgruenden hier keine einheitliche Bezeichnung moeglich.
	dword thisval; // Display2MainSelection
	bitval= getValue(this);
	thisval = getValue(A_ASG_69_0_0_27_Data_10_SetGet);
	thisval = thisval&~(1<<4)|(bitval<<4);
	putValue(A_ASG_69_0_0_27_Data_10_SetGet,thisval);
}

on envVar A_ASG_69_0_0_27_Data_10_SetGet_5
{
	byte bitval;
	//thisval steht hier fuer den bitfield-wert, 
	//aus Generierungsgruenden hier keine einheitliche Bezeichnung moeglich.
	dword thisval; // Display2MainSelection
	bitval= getValue(this);
	thisval = getValue(A_ASG_69_0_0_27_Data_10_SetGet);
	thisval = thisval&~(1<<5)|(bitval<<5);
	putValue(A_ASG_69_0_0_27_Data_10_SetGet,thisval);
}

on envVar A_ASG_69_0_0_27_Data_10_SetGet_6
{
	byte bitval;
	//thisval steht hier fuer den bitfield-wert, 
	//aus Generierungsgruenden hier keine einheitliche Bezeichnung moeglich.
	dword thisval; // Display2MainSelection
	bitval= getValue(this);
	thisval = getValue(A_ASG_69_0_0_27_Data_10_SetGet);
	thisval = thisval&~(1<<6)|(bitval<<6);
	putValue(A_ASG_69_0_0_27_Data_10_SetGet,thisval);
}

on envVar A_ASG_69_0_0_27_Data_10_SetGet_7
{
	byte bitval;
	//thisval steht hier fuer den bitfield-wert, 
	//aus Generierungsgruenden hier keine einheitliche Bezeichnung moeglich.
	dword thisval; // Display2MainSelection
	bitval= getValue(this);
	thisval = getValue(A_ASG_69_0_0_27_Data_10_SetGet);
	thisval = thisval&~(1<<7)|(bitval<<7);
	putValue(A_ASG_69_0_0_27_Data_10_SetGet,thisval);
}

on envVar A_ASG_69_0_0_27_Data_10_SetGet_8
{
	byte bitval;
	//thisval steht hier fuer den bitfield-wert, 
	//aus Generierungsgruenden hier keine einheitliche Bezeichnung moeglich.
	dword thisval; // Display2MainSelection
	bitval= getValue(this);
	thisval = getValue(A_ASG_69_0_0_27_Data_10_SetGet);
	thisval = thisval&~(1<<8)|(bitval<<8);
	putValue(A_ASG_69_0_0_27_Data_10_SetGet,thisval);
}

on envVar A_ASG_69_0_0_27_Data_10_SetGet_9
{
	byte bitval;
	//thisval steht hier fuer den bitfield-wert, 
	//aus Generierungsgruenden hier keine einheitliche Bezeichnung moeglich.
	dword thisval; // Display2MainSelection
	bitval= getValue(this);
	thisval = getValue(A_ASG_69_0_0_27_Data_10_SetGet);
	thisval = thisval&~(1<<9)|(bitval<<9);
	putValue(A_ASG_69_0_0_27_Data_10_SetGet,thisval);
}

on envVar A_ASG_69_0_0_27_Data_10_SetGet_10
{
	byte bitval;
	//thisval steht hier fuer den bitfield-wert, 
	//aus Generierungsgruenden hier keine einheitliche Bezeichnung moeglich.
	dword thisval; // Display2MainSelection
	bitval= getValue(this);
	thisval = getValue(A_ASG_69_0_0_27_Data_10_SetGet);
	thisval = thisval&~(1<<10)|(bitval<<10);
	putValue(A_ASG_69_0_0_27_Data_10_SetGet,thisval);
}

on envVar A_ASG_69_0_0_27_Data_10_SetGet_11
{
	byte bitval;
	//thisval steht hier fuer den bitfield-wert, 
	//aus Generierungsgruenden hier keine einheitliche Bezeichnung moeglich.
	dword thisval; // Display2MainSelection
	bitval= getValue(this);
	thisval = getValue(A_ASG_69_0_0_27_Data_10_SetGet);
	thisval = thisval&~(1<<11)|(bitval<<11);
	putValue(A_ASG_69_0_0_27_Data_10_SetGet,thisval);
}

on envVar A_ASG_69_0_0_27_Data_10_SetGet_12
{
	byte bitval;
	//thisval steht hier fuer den bitfield-wert, 
	//aus Generierungsgruenden hier keine einheitliche Bezeichnung moeglich.
	dword thisval; // Display2MainSelection
	bitval= getValue(this);
	thisval = getValue(A_ASG_69_0_0_27_Data_10_SetGet);
	thisval = thisval&~(1<<12)|(bitval<<12);
	putValue(A_ASG_69_0_0_27_Data_10_SetGet,thisval);
}

on envVar A_ASG_69_0_0_27_Data_10_SetGet_13
{
	byte bitval;
	//thisval steht hier fuer den bitfield-wert, 
	//aus Generierungsgruenden hier keine einheitliche Bezeichnung moeglich.
	dword thisval; // Display2MainSelection
	bitval= getValue(this);
	thisval = getValue(A_ASG_69_0_0_27_Data_10_SetGet);
	thisval = thisval&~(1<<13)|(bitval<<13);
	putValue(A_ASG_69_0_0_27_Data_10_SetGet,thisval);
}

on envVar A_ASG_69_0_0_27_Data_10_SetGet_14
{
	byte bitval;
	//thisval steht hier fuer den bitfield-wert, 
	//aus Generierungsgruenden hier keine einheitliche Bezeichnung moeglich.
	dword thisval; // Display2MainSelection
	bitval= getValue(this);
	thisval = getValue(A_ASG_69_0_0_27_Data_10_SetGet);
	thisval = thisval&~(1<<14)|(bitval<<14);
	putValue(A_ASG_69_0_0_27_Data_10_SetGet,thisval);
}

on envVar A_ASG_69_0_0_27_Data_10_SetGet_15
{
	byte bitval;
	//thisval steht hier fuer den bitfield-wert, 
	//aus Generierungsgruenden hier keine einheitliche Bezeichnung moeglich.
	dword thisval; // Display2MainSelection
	bitval= getValue(this);
	thisval = getValue(A_ASG_69_0_0_27_Data_10_SetGet);
	thisval = thisval&~(1<<15)|(bitval<<15);
	putValue(A_ASG_69_0_0_27_Data_10_SetGet,thisval);
}

on envVar A_ASG_69_0_0_27_Data_10_SetGet_16
{
	byte bitval;
	//thisval steht hier fuer den bitfield-wert, 
	//aus Generierungsgruenden hier keine einheitliche Bezeichnung moeglich.
	dword thisval; // Display2MainSelection
	bitval= getValue(this);
	thisval = getValue(A_ASG_69_0_0_27_Data_10_SetGet);
	thisval = thisval&~(1<<16)|(bitval<<16);
	putValue(A_ASG_69_0_0_27_Data_10_SetGet,thisval);
}

on envVar A_ASG_69_0_0_27_Data_10_SetGet_17
{
	byte bitval;
	//thisval steht hier fuer den bitfield-wert, 
	//aus Generierungsgruenden hier keine einheitliche Bezeichnung moeglich.
	dword thisval; // Display2MainSelection
	bitval= getValue(this);
	thisval = getValue(A_ASG_69_0_0_27_Data_10_SetGet);
	thisval = thisval&~(1<<17)|(bitval<<17);
	putValue(A_ASG_69_0_0_27_Data_10_SetGet,thisval);
}

on envVar A_ASG_69_0_0_27_Data_10_SetGet_18
{
	byte bitval;
	//thisval steht hier fuer den bitfield-wert, 
	//aus Generierungsgruenden hier keine einheitliche Bezeichnung moeglich.
	dword thisval; // Display2MainSelection
	bitval= getValue(this);
	thisval = getValue(A_ASG_69_0_0_27_Data_10_SetGet);
	thisval = thisval&~(1<<18)|(bitval<<18);
	putValue(A_ASG_69_0_0_27_Data_10_SetGet,thisval);
}

on envVar A_ASG_69_0_0_27_Data_10_SetGet_19
{
	byte bitval;
	//thisval steht hier fuer den bitfield-wert, 
	//aus Generierungsgruenden hier keine einheitliche Bezeichnung moeglich.
	dword thisval; // Display2MainSelection
	bitval= getValue(this);
	thisval = getValue(A_ASG_69_0_0_27_Data_10_SetGet);
	thisval = thisval&~(1<<19)|(bitval<<19);
	putValue(A_ASG_69_0_0_27_Data_10_SetGet,thisval);
}

on envVar A_ASG_69_0_0_27_Data_10_SetGet_20
{
	byte bitval;
	//thisval steht hier fuer den bitfield-wert, 
	//aus Generierungsgruenden hier keine einheitliche Bezeichnung moeglich.
	dword thisval; // Display2MainSelection
	bitval= getValue(this);
	thisval = getValue(A_ASG_69_0_0_27_Data_10_SetGet);
	thisval = thisval&~(1<<20)|(bitval<<20);
	putValue(A_ASG_69_0_0_27_Data_10_SetGet,thisval);
}

on envVar A_ASG_69_0_0_27_Data_10_SetGet_21
{
	byte bitval;
	//thisval steht hier fuer den bitfield-wert, 
	//aus Generierungsgruenden hier keine einheitliche Bezeichnung moeglich.
	dword thisval; // Display2MainSelection
	bitval= getValue(this);
	thisval = getValue(A_ASG_69_0_0_27_Data_10_SetGet);
	thisval = thisval&~(1<<21)|(bitval<<21);
	putValue(A_ASG_69_0_0_27_Data_10_SetGet,thisval);
}

on envVar A_ASG_69_0_0_27_Data_10_SetGet_22
{
	byte bitval;
	//thisval steht hier fuer den bitfield-wert, 
	//aus Generierungsgruenden hier keine einheitliche Bezeichnung moeglich.
	dword thisval; // Display2MainSelection
	bitval= getValue(this);
	thisval = getValue(A_ASG_69_0_0_27_Data_10_SetGet);
	thisval = thisval&~(1<<22)|(bitval<<22);
	putValue(A_ASG_69_0_0_27_Data_10_SetGet,thisval);
}

on envVar A_ASG_69_0_0_27_Data_10_SetGet_23
{
	byte bitval;
	//thisval steht hier fuer den bitfield-wert, 
	//aus Generierungsgruenden hier keine einheitliche Bezeichnung moeglich.
	dword thisval; // Display2MainSelection
	bitval= getValue(this);
	thisval = getValue(A_ASG_69_0_0_27_Data_10_SetGet);
	thisval = thisval&~(1<<23)|(bitval<<23);
	putValue(A_ASG_69_0_0_27_Data_10_SetGet,thisval);
}

on envVar A_ASG_69_0_0_27_Data_10_SetGet_24
{
	byte bitval;
	//thisval steht hier fuer den bitfield-wert, 
	//aus Generierungsgruenden hier keine einheitliche Bezeichnung moeglich.
	dword thisval; // Display2MainSelection
	bitval= getValue(this);
	thisval = getValue(A_ASG_69_0_0_27_Data_10_SetGet);
	thisval = thisval&~(1<<24)|(bitval<<24);
	putValue(A_ASG_69_0_0_27_Data_10_SetGet,thisval);
}

on envVar A_ASG_69_0_0_27_Data_10_SetGet_25
{
	byte bitval;
	//thisval steht hier fuer den bitfield-wert, 
	//aus Generierungsgruenden hier keine einheitliche Bezeichnung moeglich.
	dword thisval; // Display2MainSelection
	bitval= getValue(this);
	thisval = getValue(A_ASG_69_0_0_27_Data_10_SetGet);
	thisval = thisval&~(1<<25)|(bitval<<25);
	putValue(A_ASG_69_0_0_27_Data_10_SetGet,thisval);
}

on envVar A_ASG_69_0_0_27_Data_10_SetGet_26
{
	byte bitval;
	//thisval steht hier fuer den bitfield-wert, 
	//aus Generierungsgruenden hier keine einheitliche Bezeichnung moeglich.
	dword thisval; // Display2MainSelection
	bitval= getValue(this);
	thisval = getValue(A_ASG_69_0_0_27_Data_10_SetGet);
	thisval = thisval&~(1<<26)|(bitval<<26);
	putValue(A_ASG_69_0_0_27_Data_10_SetGet,thisval);
}

on envVar A_ASG_69_0_0_27_Data_10_SetGet_27
{
	byte bitval;
	//thisval steht hier fuer den bitfield-wert, 
	//aus Generierungsgruenden hier keine einheitliche Bezeichnung moeglich.
	dword thisval; // Display2MainSelection
	bitval= getValue(this);
	thisval = getValue(A_ASG_69_0_0_27_Data_10_SetGet);
	thisval = thisval&~(1<<27)|(bitval<<27);
	putValue(A_ASG_69_0_0_27_Data_10_SetGet,thisval);
}

on envVar A_ASG_69_0_0_27_Data_10_SetGet
{
	byte superval[664];

	//Update Childvalue (BitField)
	byte mask=0x01;
	int i = 0;
	dword thisval; // Display2MainSelection
	thisval = getValue(this);
	if(thisval&(mask<<0))
		putValue(A_ASG_69_0_0_27_Data_10_SetGet_0, 1);
	else
		putValue(A_ASG_69_0_0_27_Data_10_SetGet_0, 0);
	if(thisval&(mask<<1))
		putValue(A_ASG_69_0_0_27_Data_10_SetGet_1, 1);
	else
		putValue(A_ASG_69_0_0_27_Data_10_SetGet_1, 0);
	if(thisval&(mask<<2))
		putValue(A_ASG_69_0_0_27_Data_10_SetGet_2, 1);
	else
		putValue(A_ASG_69_0_0_27_Data_10_SetGet_2, 0);
	if(thisval&(mask<<3))
		putValue(A_ASG_69_0_0_27_Data_10_SetGet_3, 1);
	else
		putValue(A_ASG_69_0_0_27_Data_10_SetGet_3, 0);
	if(thisval&(mask<<4))
		putValue(A_ASG_69_0_0_27_Data_10_SetGet_4, 1);
	else
		putValue(A_ASG_69_0_0_27_Data_10_SetGet_4, 0);
	if(thisval&(mask<<5))
		putValue(A_ASG_69_0_0_27_Data_10_SetGet_5, 1);
	else
		putValue(A_ASG_69_0_0_27_Data_10_SetGet_5, 0);
	if(thisval&(mask<<6))
		putValue(A_ASG_69_0_0_27_Data_10_SetGet_6, 1);
	else
		putValue(A_ASG_69_0_0_27_Data_10_SetGet_6, 0);
	if(thisval&(mask<<7))
		putValue(A_ASG_69_0_0_27_Data_10_SetGet_7, 1);
	else
		putValue(A_ASG_69_0_0_27_Data_10_SetGet_7, 0);
	if(thisval&(mask<<8))
		putValue(A_ASG_69_0_0_27_Data_10_SetGet_8, 1);
	else
		putValue(A_ASG_69_0_0_27_Data_10_SetGet_8, 0);
	if(thisval&(mask<<9))
		putValue(A_ASG_69_0_0_27_Data_10_SetGet_9, 1);
	else
		putValue(A_ASG_69_0_0_27_Data_10_SetGet_9, 0);
	if(thisval&(mask<<10))
		putValue(A_ASG_69_0_0_27_Data_10_SetGet_10, 1);
	else
		putValue(A_ASG_69_0_0_27_Data_10_SetGet_10, 0);
	if(thisval&(mask<<11))
		putValue(A_ASG_69_0_0_27_Data_10_SetGet_11, 1);
	else
		putValue(A_ASG_69_0_0_27_Data_10_SetGet_11, 0);
	if(thisval&(mask<<12))
		putValue(A_ASG_69_0_0_27_Data_10_SetGet_12, 1);
	else
		putValue(A_ASG_69_0_0_27_Data_10_SetGet_12, 0);
	if(thisval&(mask<<13))
		putValue(A_ASG_69_0_0_27_Data_10_SetGet_13, 1);
	else
		putValue(A_ASG_69_0_0_27_Data_10_SetGet_13, 0);
	if(thisval&(mask<<14))
		putValue(A_ASG_69_0_0_27_Data_10_SetGet_14, 1);
	else
		putValue(A_ASG_69_0_0_27_Data_10_SetGet_14, 0);
	if(thisval&(mask<<15))
		putValue(A_ASG_69_0_0_27_Data_10_SetGet_15, 1);
	else
		putValue(A_ASG_69_0_0_27_Data_10_SetGet_15, 0);
	if(thisval&(mask<<16))
		putValue(A_ASG_69_0_0_27_Data_10_SetGet_16, 1);
	else
		putValue(A_ASG_69_0_0_27_Data_10_SetGet_16, 0);
	if(thisval&(mask<<17))
		putValue(A_ASG_69_0_0_27_Data_10_SetGet_17, 1);
	else
		putValue(A_ASG_69_0_0_27_Data_10_SetGet_17, 0);
	if(thisval&(mask<<18))
		putValue(A_ASG_69_0_0_27_Data_10_SetGet_18, 1);
	else
		putValue(A_ASG_69_0_0_27_Data_10_SetGet_18, 0);
	if(thisval&(mask<<19))
		putValue(A_ASG_69_0_0_27_Data_10_SetGet_19, 1);
	else
		putValue(A_ASG_69_0_0_27_Data_10_SetGet_19, 0);
	if(thisval&(mask<<20))
		putValue(A_ASG_69_0_0_27_Data_10_SetGet_20, 1);
	else
		putValue(A_ASG_69_0_0_27_Data_10_SetGet_20, 0);
	if(thisval&(mask<<21))
		putValue(A_ASG_69_0_0_27_Data_10_SetGet_21, 1);
	else
		putValue(A_ASG_69_0_0_27_Data_10_SetGet_21, 0);
	if(thisval&(mask<<22))
		putValue(A_ASG_69_0_0_27_Data_10_SetGet_22, 1);
	else
		putValue(A_ASG_69_0_0_27_Data_10_SetGet_22, 0);
	if(thisval&(mask<<23))
		putValue(A_ASG_69_0_0_27_Data_10_SetGet_23, 1);
	else
		putValue(A_ASG_69_0_0_27_Data_10_SetGet_23, 0);
	if(thisval&(mask<<24))
		putValue(A_ASG_69_0_0_27_Data_10_SetGet_24, 1);
	else
		putValue(A_ASG_69_0_0_27_Data_10_SetGet_24, 0);
	if(thisval&(mask<<25))
		putValue(A_ASG_69_0_0_27_Data_10_SetGet_25, 1);
	else
		putValue(A_ASG_69_0_0_27_Data_10_SetGet_25, 0);
	if(thisval&(mask<<26))
		putValue(A_ASG_69_0_0_27_Data_10_SetGet_26, 1);
	else
		putValue(A_ASG_69_0_0_27_Data_10_SetGet_26, 0);
	if(thisval&(mask<<27))
		putValue(A_ASG_69_0_0_27_Data_10_SetGet_27, 1);
	else
		putValue(A_ASG_69_0_0_27_Data_10_SetGet_27, 0);
    A_ASG_69_0_0_27_ArrayDataList[getValue(A_ASG_69_0_0_27_DataIndex_SetGet)].Param10 = thisval;
}
on envVar A_ASG_69_0_0_27_Data_11_SetGet_0
{
	byte bitval;
	//thisval steht hier fuer den bitfield-wert, 
	//aus Generierungsgruenden hier keine einheitliche Bezeichnung moeglich.
	dword thisval; // Display2AdditionalInfo1_1
	bitval= getValue(this);
	thisval = getValue(A_ASG_69_0_0_27_Data_11_SetGet);
	thisval = thisval&~(1<<0)|(bitval<<0);
	putValue(A_ASG_69_0_0_27_Data_11_SetGet,thisval);
}

on envVar A_ASG_69_0_0_27_Data_11_SetGet_1
{
	byte bitval;
	//thisval steht hier fuer den bitfield-wert, 
	//aus Generierungsgruenden hier keine einheitliche Bezeichnung moeglich.
	dword thisval; // Display2AdditionalInfo1_1
	bitval= getValue(this);
	thisval = getValue(A_ASG_69_0_0_27_Data_11_SetGet);
	thisval = thisval&~(1<<1)|(bitval<<1);
	putValue(A_ASG_69_0_0_27_Data_11_SetGet,thisval);
}

on envVar A_ASG_69_0_0_27_Data_11_SetGet_2
{
	byte bitval;
	//thisval steht hier fuer den bitfield-wert, 
	//aus Generierungsgruenden hier keine einheitliche Bezeichnung moeglich.
	dword thisval; // Display2AdditionalInfo1_1
	bitval= getValue(this);
	thisval = getValue(A_ASG_69_0_0_27_Data_11_SetGet);
	thisval = thisval&~(1<<2)|(bitval<<2);
	putValue(A_ASG_69_0_0_27_Data_11_SetGet,thisval);
}

on envVar A_ASG_69_0_0_27_Data_11_SetGet_3
{
	byte bitval;
	//thisval steht hier fuer den bitfield-wert, 
	//aus Generierungsgruenden hier keine einheitliche Bezeichnung moeglich.
	dword thisval; // Display2AdditionalInfo1_1
	bitval= getValue(this);
	thisval = getValue(A_ASG_69_0_0_27_Data_11_SetGet);
	thisval = thisval&~(1<<3)|(bitval<<3);
	putValue(A_ASG_69_0_0_27_Data_11_SetGet,thisval);
}

on envVar A_ASG_69_0_0_27_Data_11_SetGet_4
{
	byte bitval;
	//thisval steht hier fuer den bitfield-wert, 
	//aus Generierungsgruenden hier keine einheitliche Bezeichnung moeglich.
	dword thisval; // Display2AdditionalInfo1_1
	bitval= getValue(this);
	thisval = getValue(A_ASG_69_0_0_27_Data_11_SetGet);
	thisval = thisval&~(1<<4)|(bitval<<4);
	putValue(A_ASG_69_0_0_27_Data_11_SetGet,thisval);
}

on envVar A_ASG_69_0_0_27_Data_11_SetGet_5
{
	byte bitval;
	//thisval steht hier fuer den bitfield-wert, 
	//aus Generierungsgruenden hier keine einheitliche Bezeichnung moeglich.
	dword thisval; // Display2AdditionalInfo1_1
	bitval= getValue(this);
	thisval = getValue(A_ASG_69_0_0_27_Data_11_SetGet);
	thisval = thisval&~(1<<5)|(bitval<<5);
	putValue(A_ASG_69_0_0_27_Data_11_SetGet,thisval);
}

on envVar A_ASG_69_0_0_27_Data_11_SetGet_6
{
	byte bitval;
	//thisval steht hier fuer den bitfield-wert, 
	//aus Generierungsgruenden hier keine einheitliche Bezeichnung moeglich.
	dword thisval; // Display2AdditionalInfo1_1
	bitval= getValue(this);
	thisval = getValue(A_ASG_69_0_0_27_Data_11_SetGet);
	thisval = thisval&~(1<<6)|(bitval<<6);
	putValue(A_ASG_69_0_0_27_Data_11_SetGet,thisval);
}

on envVar A_ASG_69_0_0_27_Data_11_SetGet_7
{
	byte bitval;
	//thisval steht hier fuer den bitfield-wert, 
	//aus Generierungsgruenden hier keine einheitliche Bezeichnung moeglich.
	dword thisval; // Display2AdditionalInfo1_1
	bitval= getValue(this);
	thisval = getValue(A_ASG_69_0_0_27_Data_11_SetGet);
	thisval = thisval&~(1<<7)|(bitval<<7);
	putValue(A_ASG_69_0_0_27_Data_11_SetGet,thisval);
}

on envVar A_ASG_69_0_0_27_Data_11_SetGet_8
{
	byte bitval;
	//thisval steht hier fuer den bitfield-wert, 
	//aus Generierungsgruenden hier keine einheitliche Bezeichnung moeglich.
	dword thisval; // Display2AdditionalInfo1_1
	bitval= getValue(this);
	thisval = getValue(A_ASG_69_0_0_27_Data_11_SetGet);
	thisval = thisval&~(1<<8)|(bitval<<8);
	putValue(A_ASG_69_0_0_27_Data_11_SetGet,thisval);
}

on envVar A_ASG_69_0_0_27_Data_11_SetGet_9
{
	byte bitval;
	//thisval steht hier fuer den bitfield-wert, 
	//aus Generierungsgruenden hier keine einheitliche Bezeichnung moeglich.
	dword thisval; // Display2AdditionalInfo1_1
	bitval= getValue(this);
	thisval = getValue(A_ASG_69_0_0_27_Data_11_SetGet);
	thisval = thisval&~(1<<9)|(bitval<<9);
	putValue(A_ASG_69_0_0_27_Data_11_SetGet,thisval);
}

on envVar A_ASG_69_0_0_27_Data_11_SetGet_10
{
	byte bitval;
	//thisval steht hier fuer den bitfield-wert, 
	//aus Generierungsgruenden hier keine einheitliche Bezeichnung moeglich.
	dword thisval; // Display2AdditionalInfo1_1
	bitval= getValue(this);
	thisval = getValue(A_ASG_69_0_0_27_Data_11_SetGet);
	thisval = thisval&~(1<<10)|(bitval<<10);
	putValue(A_ASG_69_0_0_27_Data_11_SetGet,thisval);
}

on envVar A_ASG_69_0_0_27_Data_11_SetGet_11
{
	byte bitval;
	//thisval steht hier fuer den bitfield-wert, 
	//aus Generierungsgruenden hier keine einheitliche Bezeichnung moeglich.
	dword thisval; // Display2AdditionalInfo1_1
	bitval= getValue(this);
	thisval = getValue(A_ASG_69_0_0_27_Data_11_SetGet);
	thisval = thisval&~(1<<11)|(bitval<<11);
	putValue(A_ASG_69_0_0_27_Data_11_SetGet,thisval);
}

on envVar A_ASG_69_0_0_27_Data_11_SetGet_12
{
	byte bitval;
	//thisval steht hier fuer den bitfield-wert, 
	//aus Generierungsgruenden hier keine einheitliche Bezeichnung moeglich.
	dword thisval; // Display2AdditionalInfo1_1
	bitval= getValue(this);
	thisval = getValue(A_ASG_69_0_0_27_Data_11_SetGet);
	thisval = thisval&~(1<<12)|(bitval<<12);
	putValue(A_ASG_69_0_0_27_Data_11_SetGet,thisval);
}

on envVar A_ASG_69_0_0_27_Data_11_SetGet_13
{
	byte bitval;
	//thisval steht hier fuer den bitfield-wert, 
	//aus Generierungsgruenden hier keine einheitliche Bezeichnung moeglich.
	dword thisval; // Display2AdditionalInfo1_1
	bitval= getValue(this);
	thisval = getValue(A_ASG_69_0_0_27_Data_11_SetGet);
	thisval = thisval&~(1<<13)|(bitval<<13);
	putValue(A_ASG_69_0_0_27_Data_11_SetGet,thisval);
}

on envVar A_ASG_69_0_0_27_Data_11_SetGet_14
{
	byte bitval;
	//thisval steht hier fuer den bitfield-wert, 
	//aus Generierungsgruenden hier keine einheitliche Bezeichnung moeglich.
	dword thisval; // Display2AdditionalInfo1_1
	bitval= getValue(this);
	thisval = getValue(A_ASG_69_0_0_27_Data_11_SetGet);
	thisval = thisval&~(1<<14)|(bitval<<14);
	putValue(A_ASG_69_0_0_27_Data_11_SetGet,thisval);
}

on envVar A_ASG_69_0_0_27_Data_11_SetGet_15
{
	byte bitval;
	//thisval steht hier fuer den bitfield-wert, 
	//aus Generierungsgruenden hier keine einheitliche Bezeichnung moeglich.
	dword thisval; // Display2AdditionalInfo1_1
	bitval= getValue(this);
	thisval = getValue(A_ASG_69_0_0_27_Data_11_SetGet);
	thisval = thisval&~(1<<15)|(bitval<<15);
	putValue(A_ASG_69_0_0_27_Data_11_SetGet,thisval);
}

on envVar A_ASG_69_0_0_27_Data_11_SetGet_16
{
	byte bitval;
	//thisval steht hier fuer den bitfield-wert, 
	//aus Generierungsgruenden hier keine einheitliche Bezeichnung moeglich.
	dword thisval; // Display2AdditionalInfo1_1
	bitval= getValue(this);
	thisval = getValue(A_ASG_69_0_0_27_Data_11_SetGet);
	thisval = thisval&~(1<<16)|(bitval<<16);
	putValue(A_ASG_69_0_0_27_Data_11_SetGet,thisval);
}

on envVar A_ASG_69_0_0_27_Data_11_SetGet_17
{
	byte bitval;
	//thisval steht hier fuer den bitfield-wert, 
	//aus Generierungsgruenden hier keine einheitliche Bezeichnung moeglich.
	dword thisval; // Display2AdditionalInfo1_1
	bitval= getValue(this);
	thisval = getValue(A_ASG_69_0_0_27_Data_11_SetGet);
	thisval = thisval&~(1<<17)|(bitval<<17);
	putValue(A_ASG_69_0_0_27_Data_11_SetGet,thisval);
}

on envVar A_ASG_69_0_0_27_Data_11_SetGet_18
{
	byte bitval;
	//thisval steht hier fuer den bitfield-wert, 
	//aus Generierungsgruenden hier keine einheitliche Bezeichnung moeglich.
	dword thisval; // Display2AdditionalInfo1_1
	bitval= getValue(this);
	thisval = getValue(A_ASG_69_0_0_27_Data_11_SetGet);
	thisval = thisval&~(1<<18)|(bitval<<18);
	putValue(A_ASG_69_0_0_27_Data_11_SetGet,thisval);
}

on envVar A_ASG_69_0_0_27_Data_11_SetGet_19
{
	byte bitval;
	//thisval steht hier fuer den bitfield-wert, 
	//aus Generierungsgruenden hier keine einheitliche Bezeichnung moeglich.
	dword thisval; // Display2AdditionalInfo1_1
	bitval= getValue(this);
	thisval = getValue(A_ASG_69_0_0_27_Data_11_SetGet);
	thisval = thisval&~(1<<19)|(bitval<<19);
	putValue(A_ASG_69_0_0_27_Data_11_SetGet,thisval);
}

on envVar A_ASG_69_0_0_27_Data_11_SetGet_20
{
	byte bitval;
	//thisval steht hier fuer den bitfield-wert, 
	//aus Generierungsgruenden hier keine einheitliche Bezeichnung moeglich.
	dword thisval; // Display2AdditionalInfo1_1
	bitval= getValue(this);
	thisval = getValue(A_ASG_69_0_0_27_Data_11_SetGet);
	thisval = thisval&~(1<<20)|(bitval<<20);
	putValue(A_ASG_69_0_0_27_Data_11_SetGet,thisval);
}

on envVar A_ASG_69_0_0_27_Data_11_SetGet_21
{
	byte bitval;
	//thisval steht hier fuer den bitfield-wert, 
	//aus Generierungsgruenden hier keine einheitliche Bezeichnung moeglich.
	dword thisval; // Display2AdditionalInfo1_1
	bitval= getValue(this);
	thisval = getValue(A_ASG_69_0_0_27_Data_11_SetGet);
	thisval = thisval&~(1<<21)|(bitval<<21);
	putValue(A_ASG_69_0_0_27_Data_11_SetGet,thisval);
}

on envVar A_ASG_69_0_0_27_Data_11_SetGet_22
{
	byte bitval;
	//thisval steht hier fuer den bitfield-wert, 
	//aus Generierungsgruenden hier keine einheitliche Bezeichnung moeglich.
	dword thisval; // Display2AdditionalInfo1_1
	bitval= getValue(this);
	thisval = getValue(A_ASG_69_0_0_27_Data_11_SetGet);
	thisval = thisval&~(1<<22)|(bitval<<22);
	putValue(A_ASG_69_0_0_27_Data_11_SetGet,thisval);
}

on envVar A_ASG_69_0_0_27_Data_11_SetGet_23
{
	byte bitval;
	//thisval steht hier fuer den bitfield-wert, 
	//aus Generierungsgruenden hier keine einheitliche Bezeichnung moeglich.
	dword thisval; // Display2AdditionalInfo1_1
	bitval= getValue(this);
	thisval = getValue(A_ASG_69_0_0_27_Data_11_SetGet);
	thisval = thisval&~(1<<23)|(bitval<<23);
	putValue(A_ASG_69_0_0_27_Data_11_SetGet,thisval);
}

on envVar A_ASG_69_0_0_27_Data_11_SetGet_24
{
	byte bitval;
	//thisval steht hier fuer den bitfield-wert, 
	//aus Generierungsgruenden hier keine einheitliche Bezeichnung moeglich.
	dword thisval; // Display2AdditionalInfo1_1
	bitval= getValue(this);
	thisval = getValue(A_ASG_69_0_0_27_Data_11_SetGet);
	thisval = thisval&~(1<<24)|(bitval<<24);
	putValue(A_ASG_69_0_0_27_Data_11_SetGet,thisval);
}

on envVar A_ASG_69_0_0_27_Data_11_SetGet_25
{
	byte bitval;
	//thisval steht hier fuer den bitfield-wert, 
	//aus Generierungsgruenden hier keine einheitliche Bezeichnung moeglich.
	dword thisval; // Display2AdditionalInfo1_1
	bitval= getValue(this);
	thisval = getValue(A_ASG_69_0_0_27_Data_11_SetGet);
	thisval = thisval&~(1<<25)|(bitval<<25);
	putValue(A_ASG_69_0_0_27_Data_11_SetGet,thisval);
}

on envVar A_ASG_69_0_0_27_Data_11_SetGet_26
{
	byte bitval;
	//thisval steht hier fuer den bitfield-wert, 
	//aus Generierungsgruenden hier keine einheitliche Bezeichnung moeglich.
	dword thisval; // Display2AdditionalInfo1_1
	bitval= getValue(this);
	thisval = getValue(A_ASG_69_0_0_27_Data_11_SetGet);
	thisval = thisval&~(1<<26)|(bitval<<26);
	putValue(A_ASG_69_0_0_27_Data_11_SetGet,thisval);
}

on envVar A_ASG_69_0_0_27_Data_11_SetGet_27
{
	byte bitval;
	//thisval steht hier fuer den bitfield-wert, 
	//aus Generierungsgruenden hier keine einheitliche Bezeichnung moeglich.
	dword thisval; // Display2AdditionalInfo1_1
	bitval= getValue(this);
	thisval = getValue(A_ASG_69_0_0_27_Data_11_SetGet);
	thisval = thisval&~(1<<27)|(bitval<<27);
	putValue(A_ASG_69_0_0_27_Data_11_SetGet,thisval);
}

on envVar A_ASG_69_0_0_27_Data_11_SetGet_28
{
	byte bitval;
	//thisval steht hier fuer den bitfield-wert, 
	//aus Generierungsgruenden hier keine einheitliche Bezeichnung moeglich.
	dword thisval; // Display2AdditionalInfo1_1
	bitval= getValue(this);
	thisval = getValue(A_ASG_69_0_0_27_Data_11_SetGet);
	thisval = thisval&~(1<<28)|(bitval<<28);
	putValue(A_ASG_69_0_0_27_Data_11_SetGet,thisval);
}

on envVar A_ASG_69_0_0_27_Data_11_SetGet_29
{
	byte bitval;
	//thisval steht hier fuer den bitfield-wert, 
	//aus Generierungsgruenden hier keine einheitliche Bezeichnung moeglich.
	dword thisval; // Display2AdditionalInfo1_1
	bitval= getValue(this);
	thisval = getValue(A_ASG_69_0_0_27_Data_11_SetGet);
	thisval = thisval&~(1<<29)|(bitval<<29);
	putValue(A_ASG_69_0_0_27_Data_11_SetGet,thisval);
}

on envVar A_ASG_69_0_0_27_Data_11_SetGet_30
{
	byte bitval;
	//thisval steht hier fuer den bitfield-wert, 
	//aus Generierungsgruenden hier keine einheitliche Bezeichnung moeglich.
	dword thisval; // Display2AdditionalInfo1_1
	bitval= getValue(this);
	thisval = getValue(A_ASG_69_0_0_27_Data_11_SetGet);
	thisval = thisval&~(1<<30)|(bitval<<30);
	putValue(A_ASG_69_0_0_27_Data_11_SetGet,thisval);
}

on envVar A_ASG_69_0_0_27_Data_11_SetGet_31
{
	byte bitval;
	//thisval steht hier fuer den bitfield-wert, 
	//aus Generierungsgruenden hier keine einheitliche Bezeichnung moeglich.
	dword thisval; // Display2AdditionalInfo1_1
	bitval= getValue(this);
	thisval = getValue(A_ASG_69_0_0_27_Data_11_SetGet);
	thisval = thisval&~(1<<31)|(bitval<<31);
	putValue(A_ASG_69_0_0_27_Data_11_SetGet,thisval);
}

on envVar A_ASG_69_0_0_27_Data_11_SetGet
{
	byte superval[664];

	//Update Childvalue (BitField)
	byte mask=0x01;
	int i = 0;
	dword thisval; // Display2AdditionalInfo1_1
	thisval = getValue(this);
	if(thisval&(mask<<0))
		putValue(A_ASG_69_0_0_27_Data_11_SetGet_0, 1);
	else
		putValue(A_ASG_69_0_0_27_Data_11_SetGet_0, 0);
	if(thisval&(mask<<1))
		putValue(A_ASG_69_0_0_27_Data_11_SetGet_1, 1);
	else
		putValue(A_ASG_69_0_0_27_Data_11_SetGet_1, 0);
	if(thisval&(mask<<2))
		putValue(A_ASG_69_0_0_27_Data_11_SetGet_2, 1);
	else
		putValue(A_ASG_69_0_0_27_Data_11_SetGet_2, 0);
	if(thisval&(mask<<3))
		putValue(A_ASG_69_0_0_27_Data_11_SetGet_3, 1);
	else
		putValue(A_ASG_69_0_0_27_Data_11_SetGet_3, 0);
	if(thisval&(mask<<4))
		putValue(A_ASG_69_0_0_27_Data_11_SetGet_4, 1);
	else
		putValue(A_ASG_69_0_0_27_Data_11_SetGet_4, 0);
	if(thisval&(mask<<5))
		putValue(A_ASG_69_0_0_27_Data_11_SetGet_5, 1);
	else
		putValue(A_ASG_69_0_0_27_Data_11_SetGet_5, 0);
	if(thisval&(mask<<6))
		putValue(A_ASG_69_0_0_27_Data_11_SetGet_6, 1);
	else
		putValue(A_ASG_69_0_0_27_Data_11_SetGet_6, 0);
	if(thisval&(mask<<7))
		putValue(A_ASG_69_0_0_27_Data_11_SetGet_7, 1);
	else
		putValue(A_ASG_69_0_0_27_Data_11_SetGet_7, 0);
	if(thisval&(mask<<8))
		putValue(A_ASG_69_0_0_27_Data_11_SetGet_8, 1);
	else
		putValue(A_ASG_69_0_0_27_Data_11_SetGet_8, 0);
	if(thisval&(mask<<9))
		putValue(A_ASG_69_0_0_27_Data_11_SetGet_9, 1);
	else
		putValue(A_ASG_69_0_0_27_Data_11_SetGet_9, 0);
	if(thisval&(mask<<10))
		putValue(A_ASG_69_0_0_27_Data_11_SetGet_10, 1);
	else
		putValue(A_ASG_69_0_0_27_Data_11_SetGet_10, 0);
	if(thisval&(mask<<11))
		putValue(A_ASG_69_0_0_27_Data_11_SetGet_11, 1);
	else
		putValue(A_ASG_69_0_0_27_Data_11_SetGet_11, 0);
	if(thisval&(mask<<12))
		putValue(A_ASG_69_0_0_27_Data_11_SetGet_12, 1);
	else
		putValue(A_ASG_69_0_0_27_Data_11_SetGet_12, 0);
	if(thisval&(mask<<13))
		putValue(A_ASG_69_0_0_27_Data_11_SetGet_13, 1);
	else
		putValue(A_ASG_69_0_0_27_Data_11_SetGet_13, 0);
	if(thisval&(mask<<14))
		putValue(A_ASG_69_0_0_27_Data_11_SetGet_14, 1);
	else
		putValue(A_ASG_69_0_0_27_Data_11_SetGet_14, 0);
	if(thisval&(mask<<15))
		putValue(A_ASG_69_0_0_27_Data_11_SetGet_15, 1);
	else
		putValue(A_ASG_69_0_0_27_Data_11_SetGet_15, 0);
	if(thisval&(mask<<16))
		putValue(A_ASG_69_0_0_27_Data_11_SetGet_16, 1);
	else
		putValue(A_ASG_69_0_0_27_Data_11_SetGet_16, 0);
	if(thisval&(mask<<17))
		putValue(A_ASG_69_0_0_27_Data_11_SetGet_17, 1);
	else
		putValue(A_ASG_69_0_0_27_Data_11_SetGet_17, 0);
	if(thisval&(mask<<18))
		putValue(A_ASG_69_0_0_27_Data_11_SetGet_18, 1);
	else
		putValue(A_ASG_69_0_0_27_Data_11_SetGet_18, 0);
	if(thisval&(mask<<19))
		putValue(A_ASG_69_0_0_27_Data_11_SetGet_19, 1);
	else
		putValue(A_ASG_69_0_0_27_Data_11_SetGet_19, 0);
	if(thisval&(mask<<20))
		putValue(A_ASG_69_0_0_27_Data_11_SetGet_20, 1);
	else
		putValue(A_ASG_69_0_0_27_Data_11_SetGet_20, 0);
	if(thisval&(mask<<21))
		putValue(A_ASG_69_0_0_27_Data_11_SetGet_21, 1);
	else
		putValue(A_ASG_69_0_0_27_Data_11_SetGet_21, 0);
	if(thisval&(mask<<22))
		putValue(A_ASG_69_0_0_27_Data_11_SetGet_22, 1);
	else
		putValue(A_ASG_69_0_0_27_Data_11_SetGet_22, 0);
	if(thisval&(mask<<23))
		putValue(A_ASG_69_0_0_27_Data_11_SetGet_23, 1);
	else
		putValue(A_ASG_69_0_0_27_Data_11_SetGet_23, 0);
	if(thisval&(mask<<24))
		putValue(A_ASG_69_0_0_27_Data_11_SetGet_24, 1);
	else
		putValue(A_ASG_69_0_0_27_Data_11_SetGet_24, 0);
	if(thisval&(mask<<25))
		putValue(A_ASG_69_0_0_27_Data_11_SetGet_25, 1);
	else
		putValue(A_ASG_69_0_0_27_Data_11_SetGet_25, 0);
	if(thisval&(mask<<26))
		putValue(A_ASG_69_0_0_27_Data_11_SetGet_26, 1);
	else
		putValue(A_ASG_69_0_0_27_Data_11_SetGet_26, 0);
	if(thisval&(mask<<27))
		putValue(A_ASG_69_0_0_27_Data_11_SetGet_27, 1);
	else
		putValue(A_ASG_69_0_0_27_Data_11_SetGet_27, 0);
	if(thisval&(mask<<28))
		putValue(A_ASG_69_0_0_27_Data_11_SetGet_28, 1);
	else
		putValue(A_ASG_69_0_0_27_Data_11_SetGet_28, 0);
	if(thisval&(mask<<29))
		putValue(A_ASG_69_0_0_27_Data_11_SetGet_29, 1);
	else
		putValue(A_ASG_69_0_0_27_Data_11_SetGet_29, 0);
	if(thisval&(mask<<30))
		putValue(A_ASG_69_0_0_27_Data_11_SetGet_30, 1);
	else
		putValue(A_ASG_69_0_0_27_Data_11_SetGet_30, 0);
	if(thisval&(mask<<31))
		putValue(A_ASG_69_0_0_27_Data_11_SetGet_31, 1);
	else
		putValue(A_ASG_69_0_0_27_Data_11_SetGet_31, 0);
    A_ASG_69_0_0_27_ArrayDataList[getValue(A_ASG_69_0_0_27_DataIndex_SetGet)].Param11 = thisval;
}
on envVar A_ASG_69_0_0_27_Data_12_SetGet_0
{
	byte bitval;
	//thisval steht hier fuer den bitfield-wert, 
	//aus Generierungsgruenden hier keine einheitliche Bezeichnung moeglich.
	dword thisval; // Display2AdditionalInfo1_2
	bitval= getValue(this);
	thisval = getValue(A_ASG_69_0_0_27_Data_12_SetGet);
	thisval = thisval&~(1<<0)|(bitval<<0);
	putValue(A_ASG_69_0_0_27_Data_12_SetGet,thisval);
}

on envVar A_ASG_69_0_0_27_Data_12_SetGet_1
{
	byte bitval;
	//thisval steht hier fuer den bitfield-wert, 
	//aus Generierungsgruenden hier keine einheitliche Bezeichnung moeglich.
	dword thisval; // Display2AdditionalInfo1_2
	bitval= getValue(this);
	thisval = getValue(A_ASG_69_0_0_27_Data_12_SetGet);
	thisval = thisval&~(1<<1)|(bitval<<1);
	putValue(A_ASG_69_0_0_27_Data_12_SetGet,thisval);
}

on envVar A_ASG_69_0_0_27_Data_12_SetGet_2
{
	byte bitval;
	//thisval steht hier fuer den bitfield-wert, 
	//aus Generierungsgruenden hier keine einheitliche Bezeichnung moeglich.
	dword thisval; // Display2AdditionalInfo1_2
	bitval= getValue(this);
	thisval = getValue(A_ASG_69_0_0_27_Data_12_SetGet);
	thisval = thisval&~(1<<2)|(bitval<<2);
	putValue(A_ASG_69_0_0_27_Data_12_SetGet,thisval);
}

on envVar A_ASG_69_0_0_27_Data_12_SetGet_3
{
	byte bitval;
	//thisval steht hier fuer den bitfield-wert, 
	//aus Generierungsgruenden hier keine einheitliche Bezeichnung moeglich.
	dword thisval; // Display2AdditionalInfo1_2
	bitval= getValue(this);
	thisval = getValue(A_ASG_69_0_0_27_Data_12_SetGet);
	thisval = thisval&~(1<<3)|(bitval<<3);
	putValue(A_ASG_69_0_0_27_Data_12_SetGet,thisval);
}

on envVar A_ASG_69_0_0_27_Data_12_SetGet_4
{
	byte bitval;
	//thisval steht hier fuer den bitfield-wert, 
	//aus Generierungsgruenden hier keine einheitliche Bezeichnung moeglich.
	dword thisval; // Display2AdditionalInfo1_2
	bitval= getValue(this);
	thisval = getValue(A_ASG_69_0_0_27_Data_12_SetGet);
	thisval = thisval&~(1<<4)|(bitval<<4);
	putValue(A_ASG_69_0_0_27_Data_12_SetGet,thisval);
}

on envVar A_ASG_69_0_0_27_Data_12_SetGet_5
{
	byte bitval;
	//thisval steht hier fuer den bitfield-wert, 
	//aus Generierungsgruenden hier keine einheitliche Bezeichnung moeglich.
	dword thisval; // Display2AdditionalInfo1_2
	bitval= getValue(this);
	thisval = getValue(A_ASG_69_0_0_27_Data_12_SetGet);
	thisval = thisval&~(1<<5)|(bitval<<5);
	putValue(A_ASG_69_0_0_27_Data_12_SetGet,thisval);
}

on envVar A_ASG_69_0_0_27_Data_12_SetGet_6
{
	byte bitval;
	//thisval steht hier fuer den bitfield-wert, 
	//aus Generierungsgruenden hier keine einheitliche Bezeichnung moeglich.
	dword thisval; // Display2AdditionalInfo1_2
	bitval= getValue(this);
	thisval = getValue(A_ASG_69_0_0_27_Data_12_SetGet);
	thisval = thisval&~(1<<6)|(bitval<<6);
	putValue(A_ASG_69_0_0_27_Data_12_SetGet,thisval);
}

on envVar A_ASG_69_0_0_27_Data_12_SetGet_7
{
	byte bitval;
	//thisval steht hier fuer den bitfield-wert, 
	//aus Generierungsgruenden hier keine einheitliche Bezeichnung moeglich.
	dword thisval; // Display2AdditionalInfo1_2
	bitval= getValue(this);
	thisval = getValue(A_ASG_69_0_0_27_Data_12_SetGet);
	thisval = thisval&~(1<<7)|(bitval<<7);
	putValue(A_ASG_69_0_0_27_Data_12_SetGet,thisval);
}

on envVar A_ASG_69_0_0_27_Data_12_SetGet_8
{
	byte bitval;
	//thisval steht hier fuer den bitfield-wert, 
	//aus Generierungsgruenden hier keine einheitliche Bezeichnung moeglich.
	dword thisval; // Display2AdditionalInfo1_2
	bitval= getValue(this);
	thisval = getValue(A_ASG_69_0_0_27_Data_12_SetGet);
	thisval = thisval&~(1<<8)|(bitval<<8);
	putValue(A_ASG_69_0_0_27_Data_12_SetGet,thisval);
}

on envVar A_ASG_69_0_0_27_Data_12_SetGet_9
{
	byte bitval;
	//thisval steht hier fuer den bitfield-wert, 
	//aus Generierungsgruenden hier keine einheitliche Bezeichnung moeglich.
	dword thisval; // Display2AdditionalInfo1_2
	bitval= getValue(this);
	thisval = getValue(A_ASG_69_0_0_27_Data_12_SetGet);
	thisval = thisval&~(1<<9)|(bitval<<9);
	putValue(A_ASG_69_0_0_27_Data_12_SetGet,thisval);
}

on envVar A_ASG_69_0_0_27_Data_12_SetGet_10
{
	byte bitval;
	//thisval steht hier fuer den bitfield-wert, 
	//aus Generierungsgruenden hier keine einheitliche Bezeichnung moeglich.
	dword thisval; // Display2AdditionalInfo1_2
	bitval= getValue(this);
	thisval = getValue(A_ASG_69_0_0_27_Data_12_SetGet);
	thisval = thisval&~(1<<10)|(bitval<<10);
	putValue(A_ASG_69_0_0_27_Data_12_SetGet,thisval);
}

on envVar A_ASG_69_0_0_27_Data_12_SetGet_11
{
	byte bitval;
	//thisval steht hier fuer den bitfield-wert, 
	//aus Generierungsgruenden hier keine einheitliche Bezeichnung moeglich.
	dword thisval; // Display2AdditionalInfo1_2
	bitval= getValue(this);
	thisval = getValue(A_ASG_69_0_0_27_Data_12_SetGet);
	thisval = thisval&~(1<<11)|(bitval<<11);
	putValue(A_ASG_69_0_0_27_Data_12_SetGet,thisval);
}

on envVar A_ASG_69_0_0_27_Data_12_SetGet_12
{
	byte bitval;
	//thisval steht hier fuer den bitfield-wert, 
	//aus Generierungsgruenden hier keine einheitliche Bezeichnung moeglich.
	dword thisval; // Display2AdditionalInfo1_2
	bitval= getValue(this);
	thisval = getValue(A_ASG_69_0_0_27_Data_12_SetGet);
	thisval = thisval&~(1<<12)|(bitval<<12);
	putValue(A_ASG_69_0_0_27_Data_12_SetGet,thisval);
}

on envVar A_ASG_69_0_0_27_Data_12_SetGet_13
{
	byte bitval;
	//thisval steht hier fuer den bitfield-wert, 
	//aus Generierungsgruenden hier keine einheitliche Bezeichnung moeglich.
	dword thisval; // Display2AdditionalInfo1_2
	bitval= getValue(this);
	thisval = getValue(A_ASG_69_0_0_27_Data_12_SetGet);
	thisval = thisval&~(1<<13)|(bitval<<13);
	putValue(A_ASG_69_0_0_27_Data_12_SetGet,thisval);
}

on envVar A_ASG_69_0_0_27_Data_12_SetGet_14
{
	byte bitval;
	//thisval steht hier fuer den bitfield-wert, 
	//aus Generierungsgruenden hier keine einheitliche Bezeichnung moeglich.
	dword thisval; // Display2AdditionalInfo1_2
	bitval= getValue(this);
	thisval = getValue(A_ASG_69_0_0_27_Data_12_SetGet);
	thisval = thisval&~(1<<14)|(bitval<<14);
	putValue(A_ASG_69_0_0_27_Data_12_SetGet,thisval);
}

on envVar A_ASG_69_0_0_27_Data_12_SetGet_15
{
	byte bitval;
	//thisval steht hier fuer den bitfield-wert, 
	//aus Generierungsgruenden hier keine einheitliche Bezeichnung moeglich.
	dword thisval; // Display2AdditionalInfo1_2
	bitval= getValue(this);
	thisval = getValue(A_ASG_69_0_0_27_Data_12_SetGet);
	thisval = thisval&~(1<<15)|(bitval<<15);
	putValue(A_ASG_69_0_0_27_Data_12_SetGet,thisval);
}

on envVar A_ASG_69_0_0_27_Data_12_SetGet_16
{
	byte bitval;
	//thisval steht hier fuer den bitfield-wert, 
	//aus Generierungsgruenden hier keine einheitliche Bezeichnung moeglich.
	dword thisval; // Display2AdditionalInfo1_2
	bitval= getValue(this);
	thisval = getValue(A_ASG_69_0_0_27_Data_12_SetGet);
	thisval = thisval&~(1<<16)|(bitval<<16);
	putValue(A_ASG_69_0_0_27_Data_12_SetGet,thisval);
}

on envVar A_ASG_69_0_0_27_Data_12_SetGet_17
{
	byte bitval;
	//thisval steht hier fuer den bitfield-wert, 
	//aus Generierungsgruenden hier keine einheitliche Bezeichnung moeglich.
	dword thisval; // Display2AdditionalInfo1_2
	bitval= getValue(this);
	thisval = getValue(A_ASG_69_0_0_27_Data_12_SetGet);
	thisval = thisval&~(1<<17)|(bitval<<17);
	putValue(A_ASG_69_0_0_27_Data_12_SetGet,thisval);
}

on envVar A_ASG_69_0_0_27_Data_12_SetGet_18
{
	byte bitval;
	//thisval steht hier fuer den bitfield-wert, 
	//aus Generierungsgruenden hier keine einheitliche Bezeichnung moeglich.
	dword thisval; // Display2AdditionalInfo1_2
	bitval= getValue(this);
	thisval = getValue(A_ASG_69_0_0_27_Data_12_SetGet);
	thisval = thisval&~(1<<18)|(bitval<<18);
	putValue(A_ASG_69_0_0_27_Data_12_SetGet,thisval);
}

on envVar A_ASG_69_0_0_27_Data_12_SetGet_19
{
	byte bitval;
	//thisval steht hier fuer den bitfield-wert, 
	//aus Generierungsgruenden hier keine einheitliche Bezeichnung moeglich.
	dword thisval; // Display2AdditionalInfo1_2
	bitval= getValue(this);
	thisval = getValue(A_ASG_69_0_0_27_Data_12_SetGet);
	thisval = thisval&~(1<<19)|(bitval<<19);
	putValue(A_ASG_69_0_0_27_Data_12_SetGet,thisval);
}

on envVar A_ASG_69_0_0_27_Data_12_SetGet_20
{
	byte bitval;
	//thisval steht hier fuer den bitfield-wert, 
	//aus Generierungsgruenden hier keine einheitliche Bezeichnung moeglich.
	dword thisval; // Display2AdditionalInfo1_2
	bitval= getValue(this);
	thisval = getValue(A_ASG_69_0_0_27_Data_12_SetGet);
	thisval = thisval&~(1<<20)|(bitval<<20);
	putValue(A_ASG_69_0_0_27_Data_12_SetGet,thisval);
}

on envVar A_ASG_69_0_0_27_Data_12_SetGet_21
{
	byte bitval;
	//thisval steht hier fuer den bitfield-wert, 
	//aus Generierungsgruenden hier keine einheitliche Bezeichnung moeglich.
	dword thisval; // Display2AdditionalInfo1_2
	bitval= getValue(this);
	thisval = getValue(A_ASG_69_0_0_27_Data_12_SetGet);
	thisval = thisval&~(1<<21)|(bitval<<21);
	putValue(A_ASG_69_0_0_27_Data_12_SetGet,thisval);
}

on envVar A_ASG_69_0_0_27_Data_12_SetGet_22
{
	byte bitval;
	//thisval steht hier fuer den bitfield-wert, 
	//aus Generierungsgruenden hier keine einheitliche Bezeichnung moeglich.
	dword thisval; // Display2AdditionalInfo1_2
	bitval= getValue(this);
	thisval = getValue(A_ASG_69_0_0_27_Data_12_SetGet);
	thisval = thisval&~(1<<22)|(bitval<<22);
	putValue(A_ASG_69_0_0_27_Data_12_SetGet,thisval);
}

on envVar A_ASG_69_0_0_27_Data_12_SetGet_23
{
	byte bitval;
	//thisval steht hier fuer den bitfield-wert, 
	//aus Generierungsgruenden hier keine einheitliche Bezeichnung moeglich.
	dword thisval; // Display2AdditionalInfo1_2
	bitval= getValue(this);
	thisval = getValue(A_ASG_69_0_0_27_Data_12_SetGet);
	thisval = thisval&~(1<<23)|(bitval<<23);
	putValue(A_ASG_69_0_0_27_Data_12_SetGet,thisval);
}

on envVar A_ASG_69_0_0_27_Data_12_SetGet_24
{
	byte bitval;
	//thisval steht hier fuer den bitfield-wert, 
	//aus Generierungsgruenden hier keine einheitliche Bezeichnung moeglich.
	dword thisval; // Display2AdditionalInfo1_2
	bitval= getValue(this);
	thisval = getValue(A_ASG_69_0_0_27_Data_12_SetGet);
	thisval = thisval&~(1<<24)|(bitval<<24);
	putValue(A_ASG_69_0_0_27_Data_12_SetGet,thisval);
}

on envVar A_ASG_69_0_0_27_Data_12_SetGet_25
{
	byte bitval;
	//thisval steht hier fuer den bitfield-wert, 
	//aus Generierungsgruenden hier keine einheitliche Bezeichnung moeglich.
	dword thisval; // Display2AdditionalInfo1_2
	bitval= getValue(this);
	thisval = getValue(A_ASG_69_0_0_27_Data_12_SetGet);
	thisval = thisval&~(1<<25)|(bitval<<25);
	putValue(A_ASG_69_0_0_27_Data_12_SetGet,thisval);
}

on envVar A_ASG_69_0_0_27_Data_12_SetGet_26
{
	byte bitval;
	//thisval steht hier fuer den bitfield-wert, 
	//aus Generierungsgruenden hier keine einheitliche Bezeichnung moeglich.
	dword thisval; // Display2AdditionalInfo1_2
	bitval= getValue(this);
	thisval = getValue(A_ASG_69_0_0_27_Data_12_SetGet);
	thisval = thisval&~(1<<26)|(bitval<<26);
	putValue(A_ASG_69_0_0_27_Data_12_SetGet,thisval);
}

on envVar A_ASG_69_0_0_27_Data_12_SetGet_27
{
	byte bitval;
	//thisval steht hier fuer den bitfield-wert, 
	//aus Generierungsgruenden hier keine einheitliche Bezeichnung moeglich.
	dword thisval; // Display2AdditionalInfo1_2
	bitval= getValue(this);
	thisval = getValue(A_ASG_69_0_0_27_Data_12_SetGet);
	thisval = thisval&~(1<<27)|(bitval<<27);
	putValue(A_ASG_69_0_0_27_Data_12_SetGet,thisval);
}

on envVar A_ASG_69_0_0_27_Data_12_SetGet_28
{
	byte bitval;
	//thisval steht hier fuer den bitfield-wert, 
	//aus Generierungsgruenden hier keine einheitliche Bezeichnung moeglich.
	dword thisval; // Display2AdditionalInfo1_2
	bitval= getValue(this);
	thisval = getValue(A_ASG_69_0_0_27_Data_12_SetGet);
	thisval = thisval&~(1<<28)|(bitval<<28);
	putValue(A_ASG_69_0_0_27_Data_12_SetGet,thisval);
}

on envVar A_ASG_69_0_0_27_Data_12_SetGet_29
{
	byte bitval;
	//thisval steht hier fuer den bitfield-wert, 
	//aus Generierungsgruenden hier keine einheitliche Bezeichnung moeglich.
	dword thisval; // Display2AdditionalInfo1_2
	bitval= getValue(this);
	thisval = getValue(A_ASG_69_0_0_27_Data_12_SetGet);
	thisval = thisval&~(1<<29)|(bitval<<29);
	putValue(A_ASG_69_0_0_27_Data_12_SetGet,thisval);
}

on envVar A_ASG_69_0_0_27_Data_12_SetGet
{
	byte superval[664];

	//Update Childvalue (BitField)
	byte mask=0x01;
	int i = 0;
	dword thisval; // Display2AdditionalInfo1_2
	thisval = getValue(this);
	if(thisval&(mask<<0))
		putValue(A_ASG_69_0_0_27_Data_12_SetGet_0, 1);
	else
		putValue(A_ASG_69_0_0_27_Data_12_SetGet_0, 0);
	if(thisval&(mask<<1))
		putValue(A_ASG_69_0_0_27_Data_12_SetGet_1, 1);
	else
		putValue(A_ASG_69_0_0_27_Data_12_SetGet_1, 0);
	if(thisval&(mask<<2))
		putValue(A_ASG_69_0_0_27_Data_12_SetGet_2, 1);
	else
		putValue(A_ASG_69_0_0_27_Data_12_SetGet_2, 0);
	if(thisval&(mask<<3))
		putValue(A_ASG_69_0_0_27_Data_12_SetGet_3, 1);
	else
		putValue(A_ASG_69_0_0_27_Data_12_SetGet_3, 0);
	if(thisval&(mask<<4))
		putValue(A_ASG_69_0_0_27_Data_12_SetGet_4, 1);
	else
		putValue(A_ASG_69_0_0_27_Data_12_SetGet_4, 0);
	if(thisval&(mask<<5))
		putValue(A_ASG_69_0_0_27_Data_12_SetGet_5, 1);
	else
		putValue(A_ASG_69_0_0_27_Data_12_SetGet_5, 0);
	if(thisval&(mask<<6))
		putValue(A_ASG_69_0_0_27_Data_12_SetGet_6, 1);
	else
		putValue(A_ASG_69_0_0_27_Data_12_SetGet_6, 0);
	if(thisval&(mask<<7))
		putValue(A_ASG_69_0_0_27_Data_12_SetGet_7, 1);
	else
		putValue(A_ASG_69_0_0_27_Data_12_SetGet_7, 0);
	if(thisval&(mask<<8))
		putValue(A_ASG_69_0_0_27_Data_12_SetGet_8, 1);
	else
		putValue(A_ASG_69_0_0_27_Data_12_SetGet_8, 0);
	if(thisval&(mask<<9))
		putValue(A_ASG_69_0_0_27_Data_12_SetGet_9, 1);
	else
		putValue(A_ASG_69_0_0_27_Data_12_SetGet_9, 0);
	if(thisval&(mask<<10))
		putValue(A_ASG_69_0_0_27_Data_12_SetGet_10, 1);
	else
		putValue(A_ASG_69_0_0_27_Data_12_SetGet_10, 0);
	if(thisval&(mask<<11))
		putValue(A_ASG_69_0_0_27_Data_12_SetGet_11, 1);
	else
		putValue(A_ASG_69_0_0_27_Data_12_SetGet_11, 0);
	if(thisval&(mask<<12))
		putValue(A_ASG_69_0_0_27_Data_12_SetGet_12, 1);
	else
		putValue(A_ASG_69_0_0_27_Data_12_SetGet_12, 0);
	if(thisval&(mask<<13))
		putValue(A_ASG_69_0_0_27_Data_12_SetGet_13, 1);
	else
		putValue(A_ASG_69_0_0_27_Data_12_SetGet_13, 0);
	if(thisval&(mask<<14))
		putValue(A_ASG_69_0_0_27_Data_12_SetGet_14, 1);
	else
		putValue(A_ASG_69_0_0_27_Data_12_SetGet_14, 0);
	if(thisval&(mask<<15))
		putValue(A_ASG_69_0_0_27_Data_12_SetGet_15, 1);
	else
		putValue(A_ASG_69_0_0_27_Data_12_SetGet_15, 0);
	if(thisval&(mask<<16))
		putValue(A_ASG_69_0_0_27_Data_12_SetGet_16, 1);
	else
		putValue(A_ASG_69_0_0_27_Data_12_SetGet_16, 0);
	if(thisval&(mask<<17))
		putValue(A_ASG_69_0_0_27_Data_12_SetGet_17, 1);
	else
		putValue(A_ASG_69_0_0_27_Data_12_SetGet_17, 0);
	if(thisval&(mask<<18))
		putValue(A_ASG_69_0_0_27_Data_12_SetGet_18, 1);
	else
		putValue(A_ASG_69_0_0_27_Data_12_SetGet_18, 0);
	if(thisval&(mask<<19))
		putValue(A_ASG_69_0_0_27_Data_12_SetGet_19, 1);
	else
		putValue(A_ASG_69_0_0_27_Data_12_SetGet_19, 0);
	if(thisval&(mask<<20))
		putValue(A_ASG_69_0_0_27_Data_12_SetGet_20, 1);
	else
		putValue(A_ASG_69_0_0_27_Data_12_SetGet_20, 0);
	if(thisval&(mask<<21))
		putValue(A_ASG_69_0_0_27_Data_12_SetGet_21, 1);
	else
		putValue(A_ASG_69_0_0_27_Data_12_SetGet_21, 0);
	if(thisval&(mask<<22))
		putValue(A_ASG_69_0_0_27_Data_12_SetGet_22, 1);
	else
		putValue(A_ASG_69_0_0_27_Data_12_SetGet_22, 0);
	if(thisval&(mask<<23))
		putValue(A_ASG_69_0_0_27_Data_12_SetGet_23, 1);
	else
		putValue(A_ASG_69_0_0_27_Data_12_SetGet_23, 0);
	if(thisval&(mask<<24))
		putValue(A_ASG_69_0_0_27_Data_12_SetGet_24, 1);
	else
		putValue(A_ASG_69_0_0_27_Data_12_SetGet_24, 0);
	if(thisval&(mask<<25))
		putValue(A_ASG_69_0_0_27_Data_12_SetGet_25, 1);
	else
		putValue(A_ASG_69_0_0_27_Data_12_SetGet_25, 0);
	if(thisval&(mask<<26))
		putValue(A_ASG_69_0_0_27_Data_12_SetGet_26, 1);
	else
		putValue(A_ASG_69_0_0_27_Data_12_SetGet_26, 0);
	if(thisval&(mask<<27))
		putValue(A_ASG_69_0_0_27_Data_12_SetGet_27, 1);
	else
		putValue(A_ASG_69_0_0_27_Data_12_SetGet_27, 0);
	if(thisval&(mask<<28))
		putValue(A_ASG_69_0_0_27_Data_12_SetGet_28, 1);
	else
		putValue(A_ASG_69_0_0_27_Data_12_SetGet_28, 0);
	if(thisval&(mask<<29))
		putValue(A_ASG_69_0_0_27_Data_12_SetGet_29, 1);
	else
		putValue(A_ASG_69_0_0_27_Data_12_SetGet_29, 0);
    A_ASG_69_0_0_27_ArrayDataList[getValue(A_ASG_69_0_0_27_DataIndex_SetGet)].Param12 = thisval;
}
on envVar A_ASG_69_0_0_27_Data_13_SetGet_0
{
	byte bitval;
	//thisval steht hier fuer den bitfield-wert, 
	//aus Generierungsgruenden hier keine einheitliche Bezeichnung moeglich.
	dword thisval; // Display2AdditionalInfo2_1
	bitval= getValue(this);
	thisval = getValue(A_ASG_69_0_0_27_Data_13_SetGet);
	thisval = thisval&~(1<<0)|(bitval<<0);
	putValue(A_ASG_69_0_0_27_Data_13_SetGet,thisval);
}

on envVar A_ASG_69_0_0_27_Data_13_SetGet_1
{
	byte bitval;
	//thisval steht hier fuer den bitfield-wert, 
	//aus Generierungsgruenden hier keine einheitliche Bezeichnung moeglich.
	dword thisval; // Display2AdditionalInfo2_1
	bitval= getValue(this);
	thisval = getValue(A_ASG_69_0_0_27_Data_13_SetGet);
	thisval = thisval&~(1<<1)|(bitval<<1);
	putValue(A_ASG_69_0_0_27_Data_13_SetGet,thisval);
}

on envVar A_ASG_69_0_0_27_Data_13_SetGet_2
{
	byte bitval;
	//thisval steht hier fuer den bitfield-wert, 
	//aus Generierungsgruenden hier keine einheitliche Bezeichnung moeglich.
	dword thisval; // Display2AdditionalInfo2_1
	bitval= getValue(this);
	thisval = getValue(A_ASG_69_0_0_27_Data_13_SetGet);
	thisval = thisval&~(1<<2)|(bitval<<2);
	putValue(A_ASG_69_0_0_27_Data_13_SetGet,thisval);
}

on envVar A_ASG_69_0_0_27_Data_13_SetGet_3
{
	byte bitval;
	//thisval steht hier fuer den bitfield-wert, 
	//aus Generierungsgruenden hier keine einheitliche Bezeichnung moeglich.
	dword thisval; // Display2AdditionalInfo2_1
	bitval= getValue(this);
	thisval = getValue(A_ASG_69_0_0_27_Data_13_SetGet);
	thisval = thisval&~(1<<3)|(bitval<<3);
	putValue(A_ASG_69_0_0_27_Data_13_SetGet,thisval);
}

on envVar A_ASG_69_0_0_27_Data_13_SetGet_4
{
	byte bitval;
	//thisval steht hier fuer den bitfield-wert, 
	//aus Generierungsgruenden hier keine einheitliche Bezeichnung moeglich.
	dword thisval; // Display2AdditionalInfo2_1
	bitval= getValue(this);
	thisval = getValue(A_ASG_69_0_0_27_Data_13_SetGet);
	thisval = thisval&~(1<<4)|(bitval<<4);
	putValue(A_ASG_69_0_0_27_Data_13_SetGet,thisval);
}

on envVar A_ASG_69_0_0_27_Data_13_SetGet_5
{
	byte bitval;
	//thisval steht hier fuer den bitfield-wert, 
	//aus Generierungsgruenden hier keine einheitliche Bezeichnung moeglich.
	dword thisval; // Display2AdditionalInfo2_1
	bitval= getValue(this);
	thisval = getValue(A_ASG_69_0_0_27_Data_13_SetGet);
	thisval = thisval&~(1<<5)|(bitval<<5);
	putValue(A_ASG_69_0_0_27_Data_13_SetGet,thisval);
}

on envVar A_ASG_69_0_0_27_Data_13_SetGet_6
{
	byte bitval;
	//thisval steht hier fuer den bitfield-wert, 
	//aus Generierungsgruenden hier keine einheitliche Bezeichnung moeglich.
	dword thisval; // Display2AdditionalInfo2_1
	bitval= getValue(this);
	thisval = getValue(A_ASG_69_0_0_27_Data_13_SetGet);
	thisval = thisval&~(1<<6)|(bitval<<6);
	putValue(A_ASG_69_0_0_27_Data_13_SetGet,thisval);
}

on envVar A_ASG_69_0_0_27_Data_13_SetGet_7
{
	byte bitval;
	//thisval steht hier fuer den bitfield-wert, 
	//aus Generierungsgruenden hier keine einheitliche Bezeichnung moeglich.
	dword thisval; // Display2AdditionalInfo2_1
	bitval= getValue(this);
	thisval = getValue(A_ASG_69_0_0_27_Data_13_SetGet);
	thisval = thisval&~(1<<7)|(bitval<<7);
	putValue(A_ASG_69_0_0_27_Data_13_SetGet,thisval);
}

on envVar A_ASG_69_0_0_27_Data_13_SetGet_8
{
	byte bitval;
	//thisval steht hier fuer den bitfield-wert, 
	//aus Generierungsgruenden hier keine einheitliche Bezeichnung moeglich.
	dword thisval; // Display2AdditionalInfo2_1
	bitval= getValue(this);
	thisval = getValue(A_ASG_69_0_0_27_Data_13_SetGet);
	thisval = thisval&~(1<<8)|(bitval<<8);
	putValue(A_ASG_69_0_0_27_Data_13_SetGet,thisval);
}

on envVar A_ASG_69_0_0_27_Data_13_SetGet_9
{
	byte bitval;
	//thisval steht hier fuer den bitfield-wert, 
	//aus Generierungsgruenden hier keine einheitliche Bezeichnung moeglich.
	dword thisval; // Display2AdditionalInfo2_1
	bitval= getValue(this);
	thisval = getValue(A_ASG_69_0_0_27_Data_13_SetGet);
	thisval = thisval&~(1<<9)|(bitval<<9);
	putValue(A_ASG_69_0_0_27_Data_13_SetGet,thisval);
}

on envVar A_ASG_69_0_0_27_Data_13_SetGet_10
{
	byte bitval;
	//thisval steht hier fuer den bitfield-wert, 
	//aus Generierungsgruenden hier keine einheitliche Bezeichnung moeglich.
	dword thisval; // Display2AdditionalInfo2_1
	bitval= getValue(this);
	thisval = getValue(A_ASG_69_0_0_27_Data_13_SetGet);
	thisval = thisval&~(1<<10)|(bitval<<10);
	putValue(A_ASG_69_0_0_27_Data_13_SetGet,thisval);
}

on envVar A_ASG_69_0_0_27_Data_13_SetGet_11
{
	byte bitval;
	//thisval steht hier fuer den bitfield-wert, 
	//aus Generierungsgruenden hier keine einheitliche Bezeichnung moeglich.
	dword thisval; // Display2AdditionalInfo2_1
	bitval= getValue(this);
	thisval = getValue(A_ASG_69_0_0_27_Data_13_SetGet);
	thisval = thisval&~(1<<11)|(bitval<<11);
	putValue(A_ASG_69_0_0_27_Data_13_SetGet,thisval);
}

on envVar A_ASG_69_0_0_27_Data_13_SetGet_12
{
	byte bitval;
	//thisval steht hier fuer den bitfield-wert, 
	//aus Generierungsgruenden hier keine einheitliche Bezeichnung moeglich.
	dword thisval; // Display2AdditionalInfo2_1
	bitval= getValue(this);
	thisval = getValue(A_ASG_69_0_0_27_Data_13_SetGet);
	thisval = thisval&~(1<<12)|(bitval<<12);
	putValue(A_ASG_69_0_0_27_Data_13_SetGet,thisval);
}

on envVar A_ASG_69_0_0_27_Data_13_SetGet_13
{
	byte bitval;
	//thisval steht hier fuer den bitfield-wert, 
	//aus Generierungsgruenden hier keine einheitliche Bezeichnung moeglich.
	dword thisval; // Display2AdditionalInfo2_1
	bitval= getValue(this);
	thisval = getValue(A_ASG_69_0_0_27_Data_13_SetGet);
	thisval = thisval&~(1<<13)|(bitval<<13);
	putValue(A_ASG_69_0_0_27_Data_13_SetGet,thisval);
}

on envVar A_ASG_69_0_0_27_Data_13_SetGet_14
{
	byte bitval;
	//thisval steht hier fuer den bitfield-wert, 
	//aus Generierungsgruenden hier keine einheitliche Bezeichnung moeglich.
	dword thisval; // Display2AdditionalInfo2_1
	bitval= getValue(this);
	thisval = getValue(A_ASG_69_0_0_27_Data_13_SetGet);
	thisval = thisval&~(1<<14)|(bitval<<14);
	putValue(A_ASG_69_0_0_27_Data_13_SetGet,thisval);
}

on envVar A_ASG_69_0_0_27_Data_13_SetGet_15
{
	byte bitval;
	//thisval steht hier fuer den bitfield-wert, 
	//aus Generierungsgruenden hier keine einheitliche Bezeichnung moeglich.
	dword thisval; // Display2AdditionalInfo2_1
	bitval= getValue(this);
	thisval = getValue(A_ASG_69_0_0_27_Data_13_SetGet);
	thisval = thisval&~(1<<15)|(bitval<<15);
	putValue(A_ASG_69_0_0_27_Data_13_SetGet,thisval);
}

on envVar A_ASG_69_0_0_27_Data_13_SetGet_16
{
	byte bitval;
	//thisval steht hier fuer den bitfield-wert, 
	//aus Generierungsgruenden hier keine einheitliche Bezeichnung moeglich.
	dword thisval; // Display2AdditionalInfo2_1
	bitval= getValue(this);
	thisval = getValue(A_ASG_69_0_0_27_Data_13_SetGet);
	thisval = thisval&~(1<<16)|(bitval<<16);
	putValue(A_ASG_69_0_0_27_Data_13_SetGet,thisval);
}

on envVar A_ASG_69_0_0_27_Data_13_SetGet_17
{
	byte bitval;
	//thisval steht hier fuer den bitfield-wert, 
	//aus Generierungsgruenden hier keine einheitliche Bezeichnung moeglich.
	dword thisval; // Display2AdditionalInfo2_1
	bitval= getValue(this);
	thisval = getValue(A_ASG_69_0_0_27_Data_13_SetGet);
	thisval = thisval&~(1<<17)|(bitval<<17);
	putValue(A_ASG_69_0_0_27_Data_13_SetGet,thisval);
}

on envVar A_ASG_69_0_0_27_Data_13_SetGet_18
{
	byte bitval;
	//thisval steht hier fuer den bitfield-wert, 
	//aus Generierungsgruenden hier keine einheitliche Bezeichnung moeglich.
	dword thisval; // Display2AdditionalInfo2_1
	bitval= getValue(this);
	thisval = getValue(A_ASG_69_0_0_27_Data_13_SetGet);
	thisval = thisval&~(1<<18)|(bitval<<18);
	putValue(A_ASG_69_0_0_27_Data_13_SetGet,thisval);
}

on envVar A_ASG_69_0_0_27_Data_13_SetGet_19
{
	byte bitval;
	//thisval steht hier fuer den bitfield-wert, 
	//aus Generierungsgruenden hier keine einheitliche Bezeichnung moeglich.
	dword thisval; // Display2AdditionalInfo2_1
	bitval= getValue(this);
	thisval = getValue(A_ASG_69_0_0_27_Data_13_SetGet);
	thisval = thisval&~(1<<19)|(bitval<<19);
	putValue(A_ASG_69_0_0_27_Data_13_SetGet,thisval);
}

on envVar A_ASG_69_0_0_27_Data_13_SetGet_20
{
	byte bitval;
	//thisval steht hier fuer den bitfield-wert, 
	//aus Generierungsgruenden hier keine einheitliche Bezeichnung moeglich.
	dword thisval; // Display2AdditionalInfo2_1
	bitval= getValue(this);
	thisval = getValue(A_ASG_69_0_0_27_Data_13_SetGet);
	thisval = thisval&~(1<<20)|(bitval<<20);
	putValue(A_ASG_69_0_0_27_Data_13_SetGet,thisval);
}

on envVar A_ASG_69_0_0_27_Data_13_SetGet_21
{
	byte bitval;
	//thisval steht hier fuer den bitfield-wert, 
	//aus Generierungsgruenden hier keine einheitliche Bezeichnung moeglich.
	dword thisval; // Display2AdditionalInfo2_1
	bitval= getValue(this);
	thisval = getValue(A_ASG_69_0_0_27_Data_13_SetGet);
	thisval = thisval&~(1<<21)|(bitval<<21);
	putValue(A_ASG_69_0_0_27_Data_13_SetGet,thisval);
}

on envVar A_ASG_69_0_0_27_Data_13_SetGet_22
{
	byte bitval;
	//thisval steht hier fuer den bitfield-wert, 
	//aus Generierungsgruenden hier keine einheitliche Bezeichnung moeglich.
	dword thisval; // Display2AdditionalInfo2_1
	bitval= getValue(this);
	thisval = getValue(A_ASG_69_0_0_27_Data_13_SetGet);
	thisval = thisval&~(1<<22)|(bitval<<22);
	putValue(A_ASG_69_0_0_27_Data_13_SetGet,thisval);
}

on envVar A_ASG_69_0_0_27_Data_13_SetGet_23
{
	byte bitval;
	//thisval steht hier fuer den bitfield-wert, 
	//aus Generierungsgruenden hier keine einheitliche Bezeichnung moeglich.
	dword thisval; // Display2AdditionalInfo2_1
	bitval= getValue(this);
	thisval = getValue(A_ASG_69_0_0_27_Data_13_SetGet);
	thisval = thisval&~(1<<23)|(bitval<<23);
	putValue(A_ASG_69_0_0_27_Data_13_SetGet,thisval);
}

on envVar A_ASG_69_0_0_27_Data_13_SetGet_24
{
	byte bitval;
	//thisval steht hier fuer den bitfield-wert, 
	//aus Generierungsgruenden hier keine einheitliche Bezeichnung moeglich.
	dword thisval; // Display2AdditionalInfo2_1
	bitval= getValue(this);
	thisval = getValue(A_ASG_69_0_0_27_Data_13_SetGet);
	thisval = thisval&~(1<<24)|(bitval<<24);
	putValue(A_ASG_69_0_0_27_Data_13_SetGet,thisval);
}

on envVar A_ASG_69_0_0_27_Data_13_SetGet_25
{
	byte bitval;
	//thisval steht hier fuer den bitfield-wert, 
	//aus Generierungsgruenden hier keine einheitliche Bezeichnung moeglich.
	dword thisval; // Display2AdditionalInfo2_1
	bitval= getValue(this);
	thisval = getValue(A_ASG_69_0_0_27_Data_13_SetGet);
	thisval = thisval&~(1<<25)|(bitval<<25);
	putValue(A_ASG_69_0_0_27_Data_13_SetGet,thisval);
}

on envVar A_ASG_69_0_0_27_Data_13_SetGet_26
{
	byte bitval;
	//thisval steht hier fuer den bitfield-wert, 
	//aus Generierungsgruenden hier keine einheitliche Bezeichnung moeglich.
	dword thisval; // Display2AdditionalInfo2_1
	bitval= getValue(this);
	thisval = getValue(A_ASG_69_0_0_27_Data_13_SetGet);
	thisval = thisval&~(1<<26)|(bitval<<26);
	putValue(A_ASG_69_0_0_27_Data_13_SetGet,thisval);
}

on envVar A_ASG_69_0_0_27_Data_13_SetGet_27
{
	byte bitval;
	//thisval steht hier fuer den bitfield-wert, 
	//aus Generierungsgruenden hier keine einheitliche Bezeichnung moeglich.
	dword thisval; // Display2AdditionalInfo2_1
	bitval= getValue(this);
	thisval = getValue(A_ASG_69_0_0_27_Data_13_SetGet);
	thisval = thisval&~(1<<27)|(bitval<<27);
	putValue(A_ASG_69_0_0_27_Data_13_SetGet,thisval);
}

on envVar A_ASG_69_0_0_27_Data_13_SetGet_28
{
	byte bitval;
	//thisval steht hier fuer den bitfield-wert, 
	//aus Generierungsgruenden hier keine einheitliche Bezeichnung moeglich.
	dword thisval; // Display2AdditionalInfo2_1
	bitval= getValue(this);
	thisval = getValue(A_ASG_69_0_0_27_Data_13_SetGet);
	thisval = thisval&~(1<<28)|(bitval<<28);
	putValue(A_ASG_69_0_0_27_Data_13_SetGet,thisval);
}

on envVar A_ASG_69_0_0_27_Data_13_SetGet_29
{
	byte bitval;
	//thisval steht hier fuer den bitfield-wert, 
	//aus Generierungsgruenden hier keine einheitliche Bezeichnung moeglich.
	dword thisval; // Display2AdditionalInfo2_1
	bitval= getValue(this);
	thisval = getValue(A_ASG_69_0_0_27_Data_13_SetGet);
	thisval = thisval&~(1<<29)|(bitval<<29);
	putValue(A_ASG_69_0_0_27_Data_13_SetGet,thisval);
}

on envVar A_ASG_69_0_0_27_Data_13_SetGet_30
{
	byte bitval;
	//thisval steht hier fuer den bitfield-wert, 
	//aus Generierungsgruenden hier keine einheitliche Bezeichnung moeglich.
	dword thisval; // Display2AdditionalInfo2_1
	bitval= getValue(this);
	thisval = getValue(A_ASG_69_0_0_27_Data_13_SetGet);
	thisval = thisval&~(1<<30)|(bitval<<30);
	putValue(A_ASG_69_0_0_27_Data_13_SetGet,thisval);
}

on envVar A_ASG_69_0_0_27_Data_13_SetGet_31
{
	byte bitval;
	//thisval steht hier fuer den bitfield-wert, 
	//aus Generierungsgruenden hier keine einheitliche Bezeichnung moeglich.
	dword thisval; // Display2AdditionalInfo2_1
	bitval= getValue(this);
	thisval = getValue(A_ASG_69_0_0_27_Data_13_SetGet);
	thisval = thisval&~(1<<31)|(bitval<<31);
	putValue(A_ASG_69_0_0_27_Data_13_SetGet,thisval);
}

on envVar A_ASG_69_0_0_27_Data_13_SetGet
{
	byte superval[664];

	//Update Childvalue (BitField)
	byte mask=0x01;
	int i = 0;
	dword thisval; // Display2AdditionalInfo2_1
	thisval = getValue(this);
	if(thisval&(mask<<0))
		putValue(A_ASG_69_0_0_27_Data_13_SetGet_0, 1);
	else
		putValue(A_ASG_69_0_0_27_Data_13_SetGet_0, 0);
	if(thisval&(mask<<1))
		putValue(A_ASG_69_0_0_27_Data_13_SetGet_1, 1);
	else
		putValue(A_ASG_69_0_0_27_Data_13_SetGet_1, 0);
	if(thisval&(mask<<2))
		putValue(A_ASG_69_0_0_27_Data_13_SetGet_2, 1);
	else
		putValue(A_ASG_69_0_0_27_Data_13_SetGet_2, 0);
	if(thisval&(mask<<3))
		putValue(A_ASG_69_0_0_27_Data_13_SetGet_3, 1);
	else
		putValue(A_ASG_69_0_0_27_Data_13_SetGet_3, 0);
	if(thisval&(mask<<4))
		putValue(A_ASG_69_0_0_27_Data_13_SetGet_4, 1);
	else
		putValue(A_ASG_69_0_0_27_Data_13_SetGet_4, 0);
	if(thisval&(mask<<5))
		putValue(A_ASG_69_0_0_27_Data_13_SetGet_5, 1);
	else
		putValue(A_ASG_69_0_0_27_Data_13_SetGet_5, 0);
	if(thisval&(mask<<6))
		putValue(A_ASG_69_0_0_27_Data_13_SetGet_6, 1);
	else
		putValue(A_ASG_69_0_0_27_Data_13_SetGet_6, 0);
	if(thisval&(mask<<7))
		putValue(A_ASG_69_0_0_27_Data_13_SetGet_7, 1);
	else
		putValue(A_ASG_69_0_0_27_Data_13_SetGet_7, 0);
	if(thisval&(mask<<8))
		putValue(A_ASG_69_0_0_27_Data_13_SetGet_8, 1);
	else
		putValue(A_ASG_69_0_0_27_Data_13_SetGet_8, 0);
	if(thisval&(mask<<9))
		putValue(A_ASG_69_0_0_27_Data_13_SetGet_9, 1);
	else
		putValue(A_ASG_69_0_0_27_Data_13_SetGet_9, 0);
	if(thisval&(mask<<10))
		putValue(A_ASG_69_0_0_27_Data_13_SetGet_10, 1);
	else
		putValue(A_ASG_69_0_0_27_Data_13_SetGet_10, 0);
	if(thisval&(mask<<11))
		putValue(A_ASG_69_0_0_27_Data_13_SetGet_11, 1);
	else
		putValue(A_ASG_69_0_0_27_Data_13_SetGet_11, 0);
	if(thisval&(mask<<12))
		putValue(A_ASG_69_0_0_27_Data_13_SetGet_12, 1);
	else
		putValue(A_ASG_69_0_0_27_Data_13_SetGet_12, 0);
	if(thisval&(mask<<13))
		putValue(A_ASG_69_0_0_27_Data_13_SetGet_13, 1);
	else
		putValue(A_ASG_69_0_0_27_Data_13_SetGet_13, 0);
	if(thisval&(mask<<14))
		putValue(A_ASG_69_0_0_27_Data_13_SetGet_14, 1);
	else
		putValue(A_ASG_69_0_0_27_Data_13_SetGet_14, 0);
	if(thisval&(mask<<15))
		putValue(A_ASG_69_0_0_27_Data_13_SetGet_15, 1);
	else
		putValue(A_ASG_69_0_0_27_Data_13_SetGet_15, 0);
	if(thisval&(mask<<16))
		putValue(A_ASG_69_0_0_27_Data_13_SetGet_16, 1);
	else
		putValue(A_ASG_69_0_0_27_Data_13_SetGet_16, 0);
	if(thisval&(mask<<17))
		putValue(A_ASG_69_0_0_27_Data_13_SetGet_17, 1);
	else
		putValue(A_ASG_69_0_0_27_Data_13_SetGet_17, 0);
	if(thisval&(mask<<18))
		putValue(A_ASG_69_0_0_27_Data_13_SetGet_18, 1);
	else
		putValue(A_ASG_69_0_0_27_Data_13_SetGet_18, 0);
	if(thisval&(mask<<19))
		putValue(A_ASG_69_0_0_27_Data_13_SetGet_19, 1);
	else
		putValue(A_ASG_69_0_0_27_Data_13_SetGet_19, 0);
	if(thisval&(mask<<20))
		putValue(A_ASG_69_0_0_27_Data_13_SetGet_20, 1);
	else
		putValue(A_ASG_69_0_0_27_Data_13_SetGet_20, 0);
	if(thisval&(mask<<21))
		putValue(A_ASG_69_0_0_27_Data_13_SetGet_21, 1);
	else
		putValue(A_ASG_69_0_0_27_Data_13_SetGet_21, 0);
	if(thisval&(mask<<22))
		putValue(A_ASG_69_0_0_27_Data_13_SetGet_22, 1);
	else
		putValue(A_ASG_69_0_0_27_Data_13_SetGet_22, 0);
	if(thisval&(mask<<23))
		putValue(A_ASG_69_0_0_27_Data_13_SetGet_23, 1);
	else
		putValue(A_ASG_69_0_0_27_Data_13_SetGet_23, 0);
	if(thisval&(mask<<24))
		putValue(A_ASG_69_0_0_27_Data_13_SetGet_24, 1);
	else
		putValue(A_ASG_69_0_0_27_Data_13_SetGet_24, 0);
	if(thisval&(mask<<25))
		putValue(A_ASG_69_0_0_27_Data_13_SetGet_25, 1);
	else
		putValue(A_ASG_69_0_0_27_Data_13_SetGet_25, 0);
	if(thisval&(mask<<26))
		putValue(A_ASG_69_0_0_27_Data_13_SetGet_26, 1);
	else
		putValue(A_ASG_69_0_0_27_Data_13_SetGet_26, 0);
	if(thisval&(mask<<27))
		putValue(A_ASG_69_0_0_27_Data_13_SetGet_27, 1);
	else
		putValue(A_ASG_69_0_0_27_Data_13_SetGet_27, 0);
	if(thisval&(mask<<28))
		putValue(A_ASG_69_0_0_27_Data_13_SetGet_28, 1);
	else
		putValue(A_ASG_69_0_0_27_Data_13_SetGet_28, 0);
	if(thisval&(mask<<29))
		putValue(A_ASG_69_0_0_27_Data_13_SetGet_29, 1);
	else
		putValue(A_ASG_69_0_0_27_Data_13_SetGet_29, 0);
	if(thisval&(mask<<30))
		putValue(A_ASG_69_0_0_27_Data_13_SetGet_30, 1);
	else
		putValue(A_ASG_69_0_0_27_Data_13_SetGet_30, 0);
	if(thisval&(mask<<31))
		putValue(A_ASG_69_0_0_27_Data_13_SetGet_31, 1);
	else
		putValue(A_ASG_69_0_0_27_Data_13_SetGet_31, 0);
    A_ASG_69_0_0_27_ArrayDataList[getValue(A_ASG_69_0_0_27_DataIndex_SetGet)].Param13 = thisval;
}
on envVar A_ASG_69_0_0_27_Data_14_SetGet_0
{
	byte bitval;
	//thisval steht hier fuer den bitfield-wert, 
	//aus Generierungsgruenden hier keine einheitliche Bezeichnung moeglich.
	dword thisval; // Display2AdditionalInfo2_2
	bitval= getValue(this);
	thisval = getValue(A_ASG_69_0_0_27_Data_14_SetGet);
	thisval = thisval&~(1<<0)|(bitval<<0);
	putValue(A_ASG_69_0_0_27_Data_14_SetGet,thisval);
}

on envVar A_ASG_69_0_0_27_Data_14_SetGet_1
{
	byte bitval;
	//thisval steht hier fuer den bitfield-wert, 
	//aus Generierungsgruenden hier keine einheitliche Bezeichnung moeglich.
	dword thisval; // Display2AdditionalInfo2_2
	bitval= getValue(this);
	thisval = getValue(A_ASG_69_0_0_27_Data_14_SetGet);
	thisval = thisval&~(1<<1)|(bitval<<1);
	putValue(A_ASG_69_0_0_27_Data_14_SetGet,thisval);
}

on envVar A_ASG_69_0_0_27_Data_14_SetGet_2
{
	byte bitval;
	//thisval steht hier fuer den bitfield-wert, 
	//aus Generierungsgruenden hier keine einheitliche Bezeichnung moeglich.
	dword thisval; // Display2AdditionalInfo2_2
	bitval= getValue(this);
	thisval = getValue(A_ASG_69_0_0_27_Data_14_SetGet);
	thisval = thisval&~(1<<2)|(bitval<<2);
	putValue(A_ASG_69_0_0_27_Data_14_SetGet,thisval);
}

on envVar A_ASG_69_0_0_27_Data_14_SetGet_3
{
	byte bitval;
	//thisval steht hier fuer den bitfield-wert, 
	//aus Generierungsgruenden hier keine einheitliche Bezeichnung moeglich.
	dword thisval; // Display2AdditionalInfo2_2
	bitval= getValue(this);
	thisval = getValue(A_ASG_69_0_0_27_Data_14_SetGet);
	thisval = thisval&~(1<<3)|(bitval<<3);
	putValue(A_ASG_69_0_0_27_Data_14_SetGet,thisval);
}

on envVar A_ASG_69_0_0_27_Data_14_SetGet_4
{
	byte bitval;
	//thisval steht hier fuer den bitfield-wert, 
	//aus Generierungsgruenden hier keine einheitliche Bezeichnung moeglich.
	dword thisval; // Display2AdditionalInfo2_2
	bitval= getValue(this);
	thisval = getValue(A_ASG_69_0_0_27_Data_14_SetGet);
	thisval = thisval&~(1<<4)|(bitval<<4);
	putValue(A_ASG_69_0_0_27_Data_14_SetGet,thisval);
}

on envVar A_ASG_69_0_0_27_Data_14_SetGet_5
{
	byte bitval;
	//thisval steht hier fuer den bitfield-wert, 
	//aus Generierungsgruenden hier keine einheitliche Bezeichnung moeglich.
	dword thisval; // Display2AdditionalInfo2_2
	bitval= getValue(this);
	thisval = getValue(A_ASG_69_0_0_27_Data_14_SetGet);
	thisval = thisval&~(1<<5)|(bitval<<5);
	putValue(A_ASG_69_0_0_27_Data_14_SetGet,thisval);
}

on envVar A_ASG_69_0_0_27_Data_14_SetGet_6
{
	byte bitval;
	//thisval steht hier fuer den bitfield-wert, 
	//aus Generierungsgruenden hier keine einheitliche Bezeichnung moeglich.
	dword thisval; // Display2AdditionalInfo2_2
	bitval= getValue(this);
	thisval = getValue(A_ASG_69_0_0_27_Data_14_SetGet);
	thisval = thisval&~(1<<6)|(bitval<<6);
	putValue(A_ASG_69_0_0_27_Data_14_SetGet,thisval);
}

on envVar A_ASG_69_0_0_27_Data_14_SetGet_7
{
	byte bitval;
	//thisval steht hier fuer den bitfield-wert, 
	//aus Generierungsgruenden hier keine einheitliche Bezeichnung moeglich.
	dword thisval; // Display2AdditionalInfo2_2
	bitval= getValue(this);
	thisval = getValue(A_ASG_69_0_0_27_Data_14_SetGet);
	thisval = thisval&~(1<<7)|(bitval<<7);
	putValue(A_ASG_69_0_0_27_Data_14_SetGet,thisval);
}

on envVar A_ASG_69_0_0_27_Data_14_SetGet_8
{
	byte bitval;
	//thisval steht hier fuer den bitfield-wert, 
	//aus Generierungsgruenden hier keine einheitliche Bezeichnung moeglich.
	dword thisval; // Display2AdditionalInfo2_2
	bitval= getValue(this);
	thisval = getValue(A_ASG_69_0_0_27_Data_14_SetGet);
	thisval = thisval&~(1<<8)|(bitval<<8);
	putValue(A_ASG_69_0_0_27_Data_14_SetGet,thisval);
}

on envVar A_ASG_69_0_0_27_Data_14_SetGet_9
{
	byte bitval;
	//thisval steht hier fuer den bitfield-wert, 
	//aus Generierungsgruenden hier keine einheitliche Bezeichnung moeglich.
	dword thisval; // Display2AdditionalInfo2_2
	bitval= getValue(this);
	thisval = getValue(A_ASG_69_0_0_27_Data_14_SetGet);
	thisval = thisval&~(1<<9)|(bitval<<9);
	putValue(A_ASG_69_0_0_27_Data_14_SetGet,thisval);
}

on envVar A_ASG_69_0_0_27_Data_14_SetGet_10
{
	byte bitval;
	//thisval steht hier fuer den bitfield-wert, 
	//aus Generierungsgruenden hier keine einheitliche Bezeichnung moeglich.
	dword thisval; // Display2AdditionalInfo2_2
	bitval= getValue(this);
	thisval = getValue(A_ASG_69_0_0_27_Data_14_SetGet);
	thisval = thisval&~(1<<10)|(bitval<<10);
	putValue(A_ASG_69_0_0_27_Data_14_SetGet,thisval);
}

on envVar A_ASG_69_0_0_27_Data_14_SetGet_11
{
	byte bitval;
	//thisval steht hier fuer den bitfield-wert, 
	//aus Generierungsgruenden hier keine einheitliche Bezeichnung moeglich.
	dword thisval; // Display2AdditionalInfo2_2
	bitval= getValue(this);
	thisval = getValue(A_ASG_69_0_0_27_Data_14_SetGet);
	thisval = thisval&~(1<<11)|(bitval<<11);
	putValue(A_ASG_69_0_0_27_Data_14_SetGet,thisval);
}

on envVar A_ASG_69_0_0_27_Data_14_SetGet_12
{
	byte bitval;
	//thisval steht hier fuer den bitfield-wert, 
	//aus Generierungsgruenden hier keine einheitliche Bezeichnung moeglich.
	dword thisval; // Display2AdditionalInfo2_2
	bitval= getValue(this);
	thisval = getValue(A_ASG_69_0_0_27_Data_14_SetGet);
	thisval = thisval&~(1<<12)|(bitval<<12);
	putValue(A_ASG_69_0_0_27_Data_14_SetGet,thisval);
}

on envVar A_ASG_69_0_0_27_Data_14_SetGet_13
{
	byte bitval;
	//thisval steht hier fuer den bitfield-wert, 
	//aus Generierungsgruenden hier keine einheitliche Bezeichnung moeglich.
	dword thisval; // Display2AdditionalInfo2_2
	bitval= getValue(this);
	thisval = getValue(A_ASG_69_0_0_27_Data_14_SetGet);
	thisval = thisval&~(1<<13)|(bitval<<13);
	putValue(A_ASG_69_0_0_27_Data_14_SetGet,thisval);
}

on envVar A_ASG_69_0_0_27_Data_14_SetGet_14
{
	byte bitval;
	//thisval steht hier fuer den bitfield-wert, 
	//aus Generierungsgruenden hier keine einheitliche Bezeichnung moeglich.
	dword thisval; // Display2AdditionalInfo2_2
	bitval= getValue(this);
	thisval = getValue(A_ASG_69_0_0_27_Data_14_SetGet);
	thisval = thisval&~(1<<14)|(bitval<<14);
	putValue(A_ASG_69_0_0_27_Data_14_SetGet,thisval);
}

on envVar A_ASG_69_0_0_27_Data_14_SetGet_15
{
	byte bitval;
	//thisval steht hier fuer den bitfield-wert, 
	//aus Generierungsgruenden hier keine einheitliche Bezeichnung moeglich.
	dword thisval; // Display2AdditionalInfo2_2
	bitval= getValue(this);
	thisval = getValue(A_ASG_69_0_0_27_Data_14_SetGet);
	thisval = thisval&~(1<<15)|(bitval<<15);
	putValue(A_ASG_69_0_0_27_Data_14_SetGet,thisval);
}

on envVar A_ASG_69_0_0_27_Data_14_SetGet_16
{
	byte bitval;
	//thisval steht hier fuer den bitfield-wert, 
	//aus Generierungsgruenden hier keine einheitliche Bezeichnung moeglich.
	dword thisval; // Display2AdditionalInfo2_2
	bitval= getValue(this);
	thisval = getValue(A_ASG_69_0_0_27_Data_14_SetGet);
	thisval = thisval&~(1<<16)|(bitval<<16);
	putValue(A_ASG_69_0_0_27_Data_14_SetGet,thisval);
}

on envVar A_ASG_69_0_0_27_Data_14_SetGet_17
{
	byte bitval;
	//thisval steht hier fuer den bitfield-wert, 
	//aus Generierungsgruenden hier keine einheitliche Bezeichnung moeglich.
	dword thisval; // Display2AdditionalInfo2_2
	bitval= getValue(this);
	thisval = getValue(A_ASG_69_0_0_27_Data_14_SetGet);
	thisval = thisval&~(1<<17)|(bitval<<17);
	putValue(A_ASG_69_0_0_27_Data_14_SetGet,thisval);
}

on envVar A_ASG_69_0_0_27_Data_14_SetGet_18
{
	byte bitval;
	//thisval steht hier fuer den bitfield-wert, 
	//aus Generierungsgruenden hier keine einheitliche Bezeichnung moeglich.
	dword thisval; // Display2AdditionalInfo2_2
	bitval= getValue(this);
	thisval = getValue(A_ASG_69_0_0_27_Data_14_SetGet);
	thisval = thisval&~(1<<18)|(bitval<<18);
	putValue(A_ASG_69_0_0_27_Data_14_SetGet,thisval);
}

on envVar A_ASG_69_0_0_27_Data_14_SetGet_19
{
	byte bitval;
	//thisval steht hier fuer den bitfield-wert, 
	//aus Generierungsgruenden hier keine einheitliche Bezeichnung moeglich.
	dword thisval; // Display2AdditionalInfo2_2
	bitval= getValue(this);
	thisval = getValue(A_ASG_69_0_0_27_Data_14_SetGet);
	thisval = thisval&~(1<<19)|(bitval<<19);
	putValue(A_ASG_69_0_0_27_Data_14_SetGet,thisval);
}

on envVar A_ASG_69_0_0_27_Data_14_SetGet_20
{
	byte bitval;
	//thisval steht hier fuer den bitfield-wert, 
	//aus Generierungsgruenden hier keine einheitliche Bezeichnung moeglich.
	dword thisval; // Display2AdditionalInfo2_2
	bitval= getValue(this);
	thisval = getValue(A_ASG_69_0_0_27_Data_14_SetGet);
	thisval = thisval&~(1<<20)|(bitval<<20);
	putValue(A_ASG_69_0_0_27_Data_14_SetGet,thisval);
}

on envVar A_ASG_69_0_0_27_Data_14_SetGet_21
{
	byte bitval;
	//thisval steht hier fuer den bitfield-wert, 
	//aus Generierungsgruenden hier keine einheitliche Bezeichnung moeglich.
	dword thisval; // Display2AdditionalInfo2_2
	bitval= getValue(this);
	thisval = getValue(A_ASG_69_0_0_27_Data_14_SetGet);
	thisval = thisval&~(1<<21)|(bitval<<21);
	putValue(A_ASG_69_0_0_27_Data_14_SetGet,thisval);
}

on envVar A_ASG_69_0_0_27_Data_14_SetGet_22
{
	byte bitval;
	//thisval steht hier fuer den bitfield-wert, 
	//aus Generierungsgruenden hier keine einheitliche Bezeichnung moeglich.
	dword thisval; // Display2AdditionalInfo2_2
	bitval= getValue(this);
	thisval = getValue(A_ASG_69_0_0_27_Data_14_SetGet);
	thisval = thisval&~(1<<22)|(bitval<<22);
	putValue(A_ASG_69_0_0_27_Data_14_SetGet,thisval);
}

on envVar A_ASG_69_0_0_27_Data_14_SetGet_23
{
	byte bitval;
	//thisval steht hier fuer den bitfield-wert, 
	//aus Generierungsgruenden hier keine einheitliche Bezeichnung moeglich.
	dword thisval; // Display2AdditionalInfo2_2
	bitval= getValue(this);
	thisval = getValue(A_ASG_69_0_0_27_Data_14_SetGet);
	thisval = thisval&~(1<<23)|(bitval<<23);
	putValue(A_ASG_69_0_0_27_Data_14_SetGet,thisval);
}

on envVar A_ASG_69_0_0_27_Data_14_SetGet_24
{
	byte bitval;
	//thisval steht hier fuer den bitfield-wert, 
	//aus Generierungsgruenden hier keine einheitliche Bezeichnung moeglich.
	dword thisval; // Display2AdditionalInfo2_2
	bitval= getValue(this);
	thisval = getValue(A_ASG_69_0_0_27_Data_14_SetGet);
	thisval = thisval&~(1<<24)|(bitval<<24);
	putValue(A_ASG_69_0_0_27_Data_14_SetGet,thisval);
}

on envVar A_ASG_69_0_0_27_Data_14_SetGet_25
{
	byte bitval;
	//thisval steht hier fuer den bitfield-wert, 
	//aus Generierungsgruenden hier keine einheitliche Bezeichnung moeglich.
	dword thisval; // Display2AdditionalInfo2_2
	bitval= getValue(this);
	thisval = getValue(A_ASG_69_0_0_27_Data_14_SetGet);
	thisval = thisval&~(1<<25)|(bitval<<25);
	putValue(A_ASG_69_0_0_27_Data_14_SetGet,thisval);
}

on envVar A_ASG_69_0_0_27_Data_14_SetGet_26
{
	byte bitval;
	//thisval steht hier fuer den bitfield-wert, 
	//aus Generierungsgruenden hier keine einheitliche Bezeichnung moeglich.
	dword thisval; // Display2AdditionalInfo2_2
	bitval= getValue(this);
	thisval = getValue(A_ASG_69_0_0_27_Data_14_SetGet);
	thisval = thisval&~(1<<26)|(bitval<<26);
	putValue(A_ASG_69_0_0_27_Data_14_SetGet,thisval);
}

on envVar A_ASG_69_0_0_27_Data_14_SetGet_27
{
	byte bitval;
	//thisval steht hier fuer den bitfield-wert, 
	//aus Generierungsgruenden hier keine einheitliche Bezeichnung moeglich.
	dword thisval; // Display2AdditionalInfo2_2
	bitval= getValue(this);
	thisval = getValue(A_ASG_69_0_0_27_Data_14_SetGet);
	thisval = thisval&~(1<<27)|(bitval<<27);
	putValue(A_ASG_69_0_0_27_Data_14_SetGet,thisval);
}

on envVar A_ASG_69_0_0_27_Data_14_SetGet_28
{
	byte bitval;
	//thisval steht hier fuer den bitfield-wert, 
	//aus Generierungsgruenden hier keine einheitliche Bezeichnung moeglich.
	dword thisval; // Display2AdditionalInfo2_2
	bitval= getValue(this);
	thisval = getValue(A_ASG_69_0_0_27_Data_14_SetGet);
	thisval = thisval&~(1<<28)|(bitval<<28);
	putValue(A_ASG_69_0_0_27_Data_14_SetGet,thisval);
}

on envVar A_ASG_69_0_0_27_Data_14_SetGet_29
{
	byte bitval;
	//thisval steht hier fuer den bitfield-wert, 
	//aus Generierungsgruenden hier keine einheitliche Bezeichnung moeglich.
	dword thisval; // Display2AdditionalInfo2_2
	bitval= getValue(this);
	thisval = getValue(A_ASG_69_0_0_27_Data_14_SetGet);
	thisval = thisval&~(1<<29)|(bitval<<29);
	putValue(A_ASG_69_0_0_27_Data_14_SetGet,thisval);
}

on envVar A_ASG_69_0_0_27_Data_14_SetGet
{
	byte superval[664];

	//Update Childvalue (BitField)
	byte mask=0x01;
	int i = 0;
	dword thisval; // Display2AdditionalInfo2_2
	thisval = getValue(this);
	if(thisval&(mask<<0))
		putValue(A_ASG_69_0_0_27_Data_14_SetGet_0, 1);
	else
		putValue(A_ASG_69_0_0_27_Data_14_SetGet_0, 0);
	if(thisval&(mask<<1))
		putValue(A_ASG_69_0_0_27_Data_14_SetGet_1, 1);
	else
		putValue(A_ASG_69_0_0_27_Data_14_SetGet_1, 0);
	if(thisval&(mask<<2))
		putValue(A_ASG_69_0_0_27_Data_14_SetGet_2, 1);
	else
		putValue(A_ASG_69_0_0_27_Data_14_SetGet_2, 0);
	if(thisval&(mask<<3))
		putValue(A_ASG_69_0_0_27_Data_14_SetGet_3, 1);
	else
		putValue(A_ASG_69_0_0_27_Data_14_SetGet_3, 0);
	if(thisval&(mask<<4))
		putValue(A_ASG_69_0_0_27_Data_14_SetGet_4, 1);
	else
		putValue(A_ASG_69_0_0_27_Data_14_SetGet_4, 0);
	if(thisval&(mask<<5))
		putValue(A_ASG_69_0_0_27_Data_14_SetGet_5, 1);
	else
		putValue(A_ASG_69_0_0_27_Data_14_SetGet_5, 0);
	if(thisval&(mask<<6))
		putValue(A_ASG_69_0_0_27_Data_14_SetGet_6, 1);
	else
		putValue(A_ASG_69_0_0_27_Data_14_SetGet_6, 0);
	if(thisval&(mask<<7))
		putValue(A_ASG_69_0_0_27_Data_14_SetGet_7, 1);
	else
		putValue(A_ASG_69_0_0_27_Data_14_SetGet_7, 0);
	if(thisval&(mask<<8))
		putValue(A_ASG_69_0_0_27_Data_14_SetGet_8, 1);
	else
		putValue(A_ASG_69_0_0_27_Data_14_SetGet_8, 0);
	if(thisval&(mask<<9))
		putValue(A_ASG_69_0_0_27_Data_14_SetGet_9, 1);
	else
		putValue(A_ASG_69_0_0_27_Data_14_SetGet_9, 0);
	if(thisval&(mask<<10))
		putValue(A_ASG_69_0_0_27_Data_14_SetGet_10, 1);
	else
		putValue(A_ASG_69_0_0_27_Data_14_SetGet_10, 0);
	if(thisval&(mask<<11))
		putValue(A_ASG_69_0_0_27_Data_14_SetGet_11, 1);
	else
		putValue(A_ASG_69_0_0_27_Data_14_SetGet_11, 0);
	if(thisval&(mask<<12))
		putValue(A_ASG_69_0_0_27_Data_14_SetGet_12, 1);
	else
		putValue(A_ASG_69_0_0_27_Data_14_SetGet_12, 0);
	if(thisval&(mask<<13))
		putValue(A_ASG_69_0_0_27_Data_14_SetGet_13, 1);
	else
		putValue(A_ASG_69_0_0_27_Data_14_SetGet_13, 0);
	if(thisval&(mask<<14))
		putValue(A_ASG_69_0_0_27_Data_14_SetGet_14, 1);
	else
		putValue(A_ASG_69_0_0_27_Data_14_SetGet_14, 0);
	if(thisval&(mask<<15))
		putValue(A_ASG_69_0_0_27_Data_14_SetGet_15, 1);
	else
		putValue(A_ASG_69_0_0_27_Data_14_SetGet_15, 0);
	if(thisval&(mask<<16))
		putValue(A_ASG_69_0_0_27_Data_14_SetGet_16, 1);
	else
		putValue(A_ASG_69_0_0_27_Data_14_SetGet_16, 0);
	if(thisval&(mask<<17))
		putValue(A_ASG_69_0_0_27_Data_14_SetGet_17, 1);
	else
		putValue(A_ASG_69_0_0_27_Data_14_SetGet_17, 0);
	if(thisval&(mask<<18))
		putValue(A_ASG_69_0_0_27_Data_14_SetGet_18, 1);
	else
		putValue(A_ASG_69_0_0_27_Data_14_SetGet_18, 0);
	if(thisval&(mask<<19))
		putValue(A_ASG_69_0_0_27_Data_14_SetGet_19, 1);
	else
		putValue(A_ASG_69_0_0_27_Data_14_SetGet_19, 0);
	if(thisval&(mask<<20))
		putValue(A_ASG_69_0_0_27_Data_14_SetGet_20, 1);
	else
		putValue(A_ASG_69_0_0_27_Data_14_SetGet_20, 0);
	if(thisval&(mask<<21))
		putValue(A_ASG_69_0_0_27_Data_14_SetGet_21, 1);
	else
		putValue(A_ASG_69_0_0_27_Data_14_SetGet_21, 0);
	if(thisval&(mask<<22))
		putValue(A_ASG_69_0_0_27_Data_14_SetGet_22, 1);
	else
		putValue(A_ASG_69_0_0_27_Data_14_SetGet_22, 0);
	if(thisval&(mask<<23))
		putValue(A_ASG_69_0_0_27_Data_14_SetGet_23, 1);
	else
		putValue(A_ASG_69_0_0_27_Data_14_SetGet_23, 0);
	if(thisval&(mask<<24))
		putValue(A_ASG_69_0_0_27_Data_14_SetGet_24, 1);
	else
		putValue(A_ASG_69_0_0_27_Data_14_SetGet_24, 0);
	if(thisval&(mask<<25))
		putValue(A_ASG_69_0_0_27_Data_14_SetGet_25, 1);
	else
		putValue(A_ASG_69_0_0_27_Data_14_SetGet_25, 0);
	if(thisval&(mask<<26))
		putValue(A_ASG_69_0_0_27_Data_14_SetGet_26, 1);
	else
		putValue(A_ASG_69_0_0_27_Data_14_SetGet_26, 0);
	if(thisval&(mask<<27))
		putValue(A_ASG_69_0_0_27_Data_14_SetGet_27, 1);
	else
		putValue(A_ASG_69_0_0_27_Data_14_SetGet_27, 0);
	if(thisval&(mask<<28))
		putValue(A_ASG_69_0_0_27_Data_14_SetGet_28, 1);
	else
		putValue(A_ASG_69_0_0_27_Data_14_SetGet_28, 0);
	if(thisval&(mask<<29))
		putValue(A_ASG_69_0_0_27_Data_14_SetGet_29, 1);
	else
		putValue(A_ASG_69_0_0_27_Data_14_SetGet_29, 0);
    A_ASG_69_0_0_27_ArrayDataList[getValue(A_ASG_69_0_0_27_DataIndex_SetGet)].Param14 = thisval;
}
on envVar A_ASG_69_0_0_27_Data_15_SetGet_0
{
	byte bitval;
	//thisval steht hier fuer den bitfield-wert, 
	//aus Generierungsgruenden hier keine einheitliche Bezeichnung moeglich.
	dword thisval; // Display3MainSelection
	bitval= getValue(this);
	thisval = getValue(A_ASG_69_0_0_27_Data_15_SetGet);
	thisval = thisval&~(1<<0)|(bitval<<0);
	putValue(A_ASG_69_0_0_27_Data_15_SetGet,thisval);
}

on envVar A_ASG_69_0_0_27_Data_15_SetGet_1
{
	byte bitval;
	//thisval steht hier fuer den bitfield-wert, 
	//aus Generierungsgruenden hier keine einheitliche Bezeichnung moeglich.
	dword thisval; // Display3MainSelection
	bitval= getValue(this);
	thisval = getValue(A_ASG_69_0_0_27_Data_15_SetGet);
	thisval = thisval&~(1<<1)|(bitval<<1);
	putValue(A_ASG_69_0_0_27_Data_15_SetGet,thisval);
}

on envVar A_ASG_69_0_0_27_Data_15_SetGet_2
{
	byte bitval;
	//thisval steht hier fuer den bitfield-wert, 
	//aus Generierungsgruenden hier keine einheitliche Bezeichnung moeglich.
	dword thisval; // Display3MainSelection
	bitval= getValue(this);
	thisval = getValue(A_ASG_69_0_0_27_Data_15_SetGet);
	thisval = thisval&~(1<<2)|(bitval<<2);
	putValue(A_ASG_69_0_0_27_Data_15_SetGet,thisval);
}

on envVar A_ASG_69_0_0_27_Data_15_SetGet_3
{
	byte bitval;
	//thisval steht hier fuer den bitfield-wert, 
	//aus Generierungsgruenden hier keine einheitliche Bezeichnung moeglich.
	dword thisval; // Display3MainSelection
	bitval= getValue(this);
	thisval = getValue(A_ASG_69_0_0_27_Data_15_SetGet);
	thisval = thisval&~(1<<3)|(bitval<<3);
	putValue(A_ASG_69_0_0_27_Data_15_SetGet,thisval);
}

on envVar A_ASG_69_0_0_27_Data_15_SetGet_4
{
	byte bitval;
	//thisval steht hier fuer den bitfield-wert, 
	//aus Generierungsgruenden hier keine einheitliche Bezeichnung moeglich.
	dword thisval; // Display3MainSelection
	bitval= getValue(this);
	thisval = getValue(A_ASG_69_0_0_27_Data_15_SetGet);
	thisval = thisval&~(1<<4)|(bitval<<4);
	putValue(A_ASG_69_0_0_27_Data_15_SetGet,thisval);
}

on envVar A_ASG_69_0_0_27_Data_15_SetGet_5
{
	byte bitval;
	//thisval steht hier fuer den bitfield-wert, 
	//aus Generierungsgruenden hier keine einheitliche Bezeichnung moeglich.
	dword thisval; // Display3MainSelection
	bitval= getValue(this);
	thisval = getValue(A_ASG_69_0_0_27_Data_15_SetGet);
	thisval = thisval&~(1<<5)|(bitval<<5);
	putValue(A_ASG_69_0_0_27_Data_15_SetGet,thisval);
}

on envVar A_ASG_69_0_0_27_Data_15_SetGet_6
{
	byte bitval;
	//thisval steht hier fuer den bitfield-wert, 
	//aus Generierungsgruenden hier keine einheitliche Bezeichnung moeglich.
	dword thisval; // Display3MainSelection
	bitval= getValue(this);
	thisval = getValue(A_ASG_69_0_0_27_Data_15_SetGet);
	thisval = thisval&~(1<<6)|(bitval<<6);
	putValue(A_ASG_69_0_0_27_Data_15_SetGet,thisval);
}

on envVar A_ASG_69_0_0_27_Data_15_SetGet_7
{
	byte bitval;
	//thisval steht hier fuer den bitfield-wert, 
	//aus Generierungsgruenden hier keine einheitliche Bezeichnung moeglich.
	dword thisval; // Display3MainSelection
	bitval= getValue(this);
	thisval = getValue(A_ASG_69_0_0_27_Data_15_SetGet);
	thisval = thisval&~(1<<7)|(bitval<<7);
	putValue(A_ASG_69_0_0_27_Data_15_SetGet,thisval);
}

on envVar A_ASG_69_0_0_27_Data_15_SetGet_8
{
	byte bitval;
	//thisval steht hier fuer den bitfield-wert, 
	//aus Generierungsgruenden hier keine einheitliche Bezeichnung moeglich.
	dword thisval; // Display3MainSelection
	bitval= getValue(this);
	thisval = getValue(A_ASG_69_0_0_27_Data_15_SetGet);
	thisval = thisval&~(1<<8)|(bitval<<8);
	putValue(A_ASG_69_0_0_27_Data_15_SetGet,thisval);
}

on envVar A_ASG_69_0_0_27_Data_15_SetGet_9
{
	byte bitval;
	//thisval steht hier fuer den bitfield-wert, 
	//aus Generierungsgruenden hier keine einheitliche Bezeichnung moeglich.
	dword thisval; // Display3MainSelection
	bitval= getValue(this);
	thisval = getValue(A_ASG_69_0_0_27_Data_15_SetGet);
	thisval = thisval&~(1<<9)|(bitval<<9);
	putValue(A_ASG_69_0_0_27_Data_15_SetGet,thisval);
}

on envVar A_ASG_69_0_0_27_Data_15_SetGet_10
{
	byte bitval;
	//thisval steht hier fuer den bitfield-wert, 
	//aus Generierungsgruenden hier keine einheitliche Bezeichnung moeglich.
	dword thisval; // Display3MainSelection
	bitval= getValue(this);
	thisval = getValue(A_ASG_69_0_0_27_Data_15_SetGet);
	thisval = thisval&~(1<<10)|(bitval<<10);
	putValue(A_ASG_69_0_0_27_Data_15_SetGet,thisval);
}

on envVar A_ASG_69_0_0_27_Data_15_SetGet_11
{
	byte bitval;
	//thisval steht hier fuer den bitfield-wert, 
	//aus Generierungsgruenden hier keine einheitliche Bezeichnung moeglich.
	dword thisval; // Display3MainSelection
	bitval= getValue(this);
	thisval = getValue(A_ASG_69_0_0_27_Data_15_SetGet);
	thisval = thisval&~(1<<11)|(bitval<<11);
	putValue(A_ASG_69_0_0_27_Data_15_SetGet,thisval);
}

on envVar A_ASG_69_0_0_27_Data_15_SetGet_12
{
	byte bitval;
	//thisval steht hier fuer den bitfield-wert, 
	//aus Generierungsgruenden hier keine einheitliche Bezeichnung moeglich.
	dword thisval; // Display3MainSelection
	bitval= getValue(this);
	thisval = getValue(A_ASG_69_0_0_27_Data_15_SetGet);
	thisval = thisval&~(1<<12)|(bitval<<12);
	putValue(A_ASG_69_0_0_27_Data_15_SetGet,thisval);
}

on envVar A_ASG_69_0_0_27_Data_15_SetGet_13
{
	byte bitval;
	//thisval steht hier fuer den bitfield-wert, 
	//aus Generierungsgruenden hier keine einheitliche Bezeichnung moeglich.
	dword thisval; // Display3MainSelection
	bitval= getValue(this);
	thisval = getValue(A_ASG_69_0_0_27_Data_15_SetGet);
	thisval = thisval&~(1<<13)|(bitval<<13);
	putValue(A_ASG_69_0_0_27_Data_15_SetGet,thisval);
}

on envVar A_ASG_69_0_0_27_Data_15_SetGet_14
{
	byte bitval;
	//thisval steht hier fuer den bitfield-wert, 
	//aus Generierungsgruenden hier keine einheitliche Bezeichnung moeglich.
	dword thisval; // Display3MainSelection
	bitval= getValue(this);
	thisval = getValue(A_ASG_69_0_0_27_Data_15_SetGet);
	thisval = thisval&~(1<<14)|(bitval<<14);
	putValue(A_ASG_69_0_0_27_Data_15_SetGet,thisval);
}

on envVar A_ASG_69_0_0_27_Data_15_SetGet_15
{
	byte bitval;
	//thisval steht hier fuer den bitfield-wert, 
	//aus Generierungsgruenden hier keine einheitliche Bezeichnung moeglich.
	dword thisval; // Display3MainSelection
	bitval= getValue(this);
	thisval = getValue(A_ASG_69_0_0_27_Data_15_SetGet);
	thisval = thisval&~(1<<15)|(bitval<<15);
	putValue(A_ASG_69_0_0_27_Data_15_SetGet,thisval);
}

on envVar A_ASG_69_0_0_27_Data_15_SetGet_16
{
	byte bitval;
	//thisval steht hier fuer den bitfield-wert, 
	//aus Generierungsgruenden hier keine einheitliche Bezeichnung moeglich.
	dword thisval; // Display3MainSelection
	bitval= getValue(this);
	thisval = getValue(A_ASG_69_0_0_27_Data_15_SetGet);
	thisval = thisval&~(1<<16)|(bitval<<16);
	putValue(A_ASG_69_0_0_27_Data_15_SetGet,thisval);
}

on envVar A_ASG_69_0_0_27_Data_15_SetGet_17
{
	byte bitval;
	//thisval steht hier fuer den bitfield-wert, 
	//aus Generierungsgruenden hier keine einheitliche Bezeichnung moeglich.
	dword thisval; // Display3MainSelection
	bitval= getValue(this);
	thisval = getValue(A_ASG_69_0_0_27_Data_15_SetGet);
	thisval = thisval&~(1<<17)|(bitval<<17);
	putValue(A_ASG_69_0_0_27_Data_15_SetGet,thisval);
}

on envVar A_ASG_69_0_0_27_Data_15_SetGet_18
{
	byte bitval;
	//thisval steht hier fuer den bitfield-wert, 
	//aus Generierungsgruenden hier keine einheitliche Bezeichnung moeglich.
	dword thisval; // Display3MainSelection
	bitval= getValue(this);
	thisval = getValue(A_ASG_69_0_0_27_Data_15_SetGet);
	thisval = thisval&~(1<<18)|(bitval<<18);
	putValue(A_ASG_69_0_0_27_Data_15_SetGet,thisval);
}

on envVar A_ASG_69_0_0_27_Data_15_SetGet_19
{
	byte bitval;
	//thisval steht hier fuer den bitfield-wert, 
	//aus Generierungsgruenden hier keine einheitliche Bezeichnung moeglich.
	dword thisval; // Display3MainSelection
	bitval= getValue(this);
	thisval = getValue(A_ASG_69_0_0_27_Data_15_SetGet);
	thisval = thisval&~(1<<19)|(bitval<<19);
	putValue(A_ASG_69_0_0_27_Data_15_SetGet,thisval);
}

on envVar A_ASG_69_0_0_27_Data_15_SetGet_20
{
	byte bitval;
	//thisval steht hier fuer den bitfield-wert, 
	//aus Generierungsgruenden hier keine einheitliche Bezeichnung moeglich.
	dword thisval; // Display3MainSelection
	bitval= getValue(this);
	thisval = getValue(A_ASG_69_0_0_27_Data_15_SetGet);
	thisval = thisval&~(1<<20)|(bitval<<20);
	putValue(A_ASG_69_0_0_27_Data_15_SetGet,thisval);
}

on envVar A_ASG_69_0_0_27_Data_15_SetGet_21
{
	byte bitval;
	//thisval steht hier fuer den bitfield-wert, 
	//aus Generierungsgruenden hier keine einheitliche Bezeichnung moeglich.
	dword thisval; // Display3MainSelection
	bitval= getValue(this);
	thisval = getValue(A_ASG_69_0_0_27_Data_15_SetGet);
	thisval = thisval&~(1<<21)|(bitval<<21);
	putValue(A_ASG_69_0_0_27_Data_15_SetGet,thisval);
}

on envVar A_ASG_69_0_0_27_Data_15_SetGet_22
{
	byte bitval;
	//thisval steht hier fuer den bitfield-wert, 
	//aus Generierungsgruenden hier keine einheitliche Bezeichnung moeglich.
	dword thisval; // Display3MainSelection
	bitval= getValue(this);
	thisval = getValue(A_ASG_69_0_0_27_Data_15_SetGet);
	thisval = thisval&~(1<<22)|(bitval<<22);
	putValue(A_ASG_69_0_0_27_Data_15_SetGet,thisval);
}

on envVar A_ASG_69_0_0_27_Data_15_SetGet_23
{
	byte bitval;
	//thisval steht hier fuer den bitfield-wert, 
	//aus Generierungsgruenden hier keine einheitliche Bezeichnung moeglich.
	dword thisval; // Display3MainSelection
	bitval= getValue(this);
	thisval = getValue(A_ASG_69_0_0_27_Data_15_SetGet);
	thisval = thisval&~(1<<23)|(bitval<<23);
	putValue(A_ASG_69_0_0_27_Data_15_SetGet,thisval);
}

on envVar A_ASG_69_0_0_27_Data_15_SetGet_24
{
	byte bitval;
	//thisval steht hier fuer den bitfield-wert, 
	//aus Generierungsgruenden hier keine einheitliche Bezeichnung moeglich.
	dword thisval; // Display3MainSelection
	bitval= getValue(this);
	thisval = getValue(A_ASG_69_0_0_27_Data_15_SetGet);
	thisval = thisval&~(1<<24)|(bitval<<24);
	putValue(A_ASG_69_0_0_27_Data_15_SetGet,thisval);
}

on envVar A_ASG_69_0_0_27_Data_15_SetGet_25
{
	byte bitval;
	//thisval steht hier fuer den bitfield-wert, 
	//aus Generierungsgruenden hier keine einheitliche Bezeichnung moeglich.
	dword thisval; // Display3MainSelection
	bitval= getValue(this);
	thisval = getValue(A_ASG_69_0_0_27_Data_15_SetGet);
	thisval = thisval&~(1<<25)|(bitval<<25);
	putValue(A_ASG_69_0_0_27_Data_15_SetGet,thisval);
}

on envVar A_ASG_69_0_0_27_Data_15_SetGet_26
{
	byte bitval;
	//thisval steht hier fuer den bitfield-wert, 
	//aus Generierungsgruenden hier keine einheitliche Bezeichnung moeglich.
	dword thisval; // Display3MainSelection
	bitval= getValue(this);
	thisval = getValue(A_ASG_69_0_0_27_Data_15_SetGet);
	thisval = thisval&~(1<<26)|(bitval<<26);
	putValue(A_ASG_69_0_0_27_Data_15_SetGet,thisval);
}

on envVar A_ASG_69_0_0_27_Data_15_SetGet_27
{
	byte bitval;
	//thisval steht hier fuer den bitfield-wert, 
	//aus Generierungsgruenden hier keine einheitliche Bezeichnung moeglich.
	dword thisval; // Display3MainSelection
	bitval= getValue(this);
	thisval = getValue(A_ASG_69_0_0_27_Data_15_SetGet);
	thisval = thisval&~(1<<27)|(bitval<<27);
	putValue(A_ASG_69_0_0_27_Data_15_SetGet,thisval);
}

on envVar A_ASG_69_0_0_27_Data_15_SetGet
{
	byte superval[664];

	//Update Childvalue (BitField)
	byte mask=0x01;
	int i = 0;
	dword thisval; // Display3MainSelection
	thisval = getValue(this);
	if(thisval&(mask<<0))
		putValue(A_ASG_69_0_0_27_Data_15_SetGet_0, 1);
	else
		putValue(A_ASG_69_0_0_27_Data_15_SetGet_0, 0);
	if(thisval&(mask<<1))
		putValue(A_ASG_69_0_0_27_Data_15_SetGet_1, 1);
	else
		putValue(A_ASG_69_0_0_27_Data_15_SetGet_1, 0);
	if(thisval&(mask<<2))
		putValue(A_ASG_69_0_0_27_Data_15_SetGet_2, 1);
	else
		putValue(A_ASG_69_0_0_27_Data_15_SetGet_2, 0);
	if(thisval&(mask<<3))
		putValue(A_ASG_69_0_0_27_Data_15_SetGet_3, 1);
	else
		putValue(A_ASG_69_0_0_27_Data_15_SetGet_3, 0);
	if(thisval&(mask<<4))
		putValue(A_ASG_69_0_0_27_Data_15_SetGet_4, 1);
	else
		putValue(A_ASG_69_0_0_27_Data_15_SetGet_4, 0);
	if(thisval&(mask<<5))
		putValue(A_ASG_69_0_0_27_Data_15_SetGet_5, 1);
	else
		putValue(A_ASG_69_0_0_27_Data_15_SetGet_5, 0);
	if(thisval&(mask<<6))
		putValue(A_ASG_69_0_0_27_Data_15_SetGet_6, 1);
	else
		putValue(A_ASG_69_0_0_27_Data_15_SetGet_6, 0);
	if(thisval&(mask<<7))
		putValue(A_ASG_69_0_0_27_Data_15_SetGet_7, 1);
	else
		putValue(A_ASG_69_0_0_27_Data_15_SetGet_7, 0);
	if(thisval&(mask<<8))
		putValue(A_ASG_69_0_0_27_Data_15_SetGet_8, 1);
	else
		putValue(A_ASG_69_0_0_27_Data_15_SetGet_8, 0);
	if(thisval&(mask<<9))
		putValue(A_ASG_69_0_0_27_Data_15_SetGet_9, 1);
	else
		putValue(A_ASG_69_0_0_27_Data_15_SetGet_9, 0);
	if(thisval&(mask<<10))
		putValue(A_ASG_69_0_0_27_Data_15_SetGet_10, 1);
	else
		putValue(A_ASG_69_0_0_27_Data_15_SetGet_10, 0);
	if(thisval&(mask<<11))
		putValue(A_ASG_69_0_0_27_Data_15_SetGet_11, 1);
	else
		putValue(A_ASG_69_0_0_27_Data_15_SetGet_11, 0);
	if(thisval&(mask<<12))
		putValue(A_ASG_69_0_0_27_Data_15_SetGet_12, 1);
	else
		putValue(A_ASG_69_0_0_27_Data_15_SetGet_12, 0);
	if(thisval&(mask<<13))
		putValue(A_ASG_69_0_0_27_Data_15_SetGet_13, 1);
	else
		putValue(A_ASG_69_0_0_27_Data_15_SetGet_13, 0);
	if(thisval&(mask<<14))
		putValue(A_ASG_69_0_0_27_Data_15_SetGet_14, 1);
	else
		putValue(A_ASG_69_0_0_27_Data_15_SetGet_14, 0);
	if(thisval&(mask<<15))
		putValue(A_ASG_69_0_0_27_Data_15_SetGet_15, 1);
	else
		putValue(A_ASG_69_0_0_27_Data_15_SetGet_15, 0);
	if(thisval&(mask<<16))
		putValue(A_ASG_69_0_0_27_Data_15_SetGet_16, 1);
	else
		putValue(A_ASG_69_0_0_27_Data_15_SetGet_16, 0);
	if(thisval&(mask<<17))
		putValue(A_ASG_69_0_0_27_Data_15_SetGet_17, 1);
	else
		putValue(A_ASG_69_0_0_27_Data_15_SetGet_17, 0);
	if(thisval&(mask<<18))
		putValue(A_ASG_69_0_0_27_Data_15_SetGet_18, 1);
	else
		putValue(A_ASG_69_0_0_27_Data_15_SetGet_18, 0);
	if(thisval&(mask<<19))
		putValue(A_ASG_69_0_0_27_Data_15_SetGet_19, 1);
	else
		putValue(A_ASG_69_0_0_27_Data_15_SetGet_19, 0);
	if(thisval&(mask<<20))
		putValue(A_ASG_69_0_0_27_Data_15_SetGet_20, 1);
	else
		putValue(A_ASG_69_0_0_27_Data_15_SetGet_20, 0);
	if(thisval&(mask<<21))
		putValue(A_ASG_69_0_0_27_Data_15_SetGet_21, 1);
	else
		putValue(A_ASG_69_0_0_27_Data_15_SetGet_21, 0);
	if(thisval&(mask<<22))
		putValue(A_ASG_69_0_0_27_Data_15_SetGet_22, 1);
	else
		putValue(A_ASG_69_0_0_27_Data_15_SetGet_22, 0);
	if(thisval&(mask<<23))
		putValue(A_ASG_69_0_0_27_Data_15_SetGet_23, 1);
	else
		putValue(A_ASG_69_0_0_27_Data_15_SetGet_23, 0);
	if(thisval&(mask<<24))
		putValue(A_ASG_69_0_0_27_Data_15_SetGet_24, 1);
	else
		putValue(A_ASG_69_0_0_27_Data_15_SetGet_24, 0);
	if(thisval&(mask<<25))
		putValue(A_ASG_69_0_0_27_Data_15_SetGet_25, 1);
	else
		putValue(A_ASG_69_0_0_27_Data_15_SetGet_25, 0);
	if(thisval&(mask<<26))
		putValue(A_ASG_69_0_0_27_Data_15_SetGet_26, 1);
	else
		putValue(A_ASG_69_0_0_27_Data_15_SetGet_26, 0);
	if(thisval&(mask<<27))
		putValue(A_ASG_69_0_0_27_Data_15_SetGet_27, 1);
	else
		putValue(A_ASG_69_0_0_27_Data_15_SetGet_27, 0);
    A_ASG_69_0_0_27_ArrayDataList[getValue(A_ASG_69_0_0_27_DataIndex_SetGet)].Param15 = thisval;
}
on envVar A_ASG_69_0_0_27_Data_16_SetGet_0
{
	byte bitval;
	//thisval steht hier fuer den bitfield-wert, 
	//aus Generierungsgruenden hier keine einheitliche Bezeichnung moeglich.
	dword thisval; // Display3AdditionalInfo1_1
	bitval= getValue(this);
	thisval = getValue(A_ASG_69_0_0_27_Data_16_SetGet);
	thisval = thisval&~(1<<0)|(bitval<<0);
	putValue(A_ASG_69_0_0_27_Data_16_SetGet,thisval);
}

on envVar A_ASG_69_0_0_27_Data_16_SetGet_1
{
	byte bitval;
	//thisval steht hier fuer den bitfield-wert, 
	//aus Generierungsgruenden hier keine einheitliche Bezeichnung moeglich.
	dword thisval; // Display3AdditionalInfo1_1
	bitval= getValue(this);
	thisval = getValue(A_ASG_69_0_0_27_Data_16_SetGet);
	thisval = thisval&~(1<<1)|(bitval<<1);
	putValue(A_ASG_69_0_0_27_Data_16_SetGet,thisval);
}

on envVar A_ASG_69_0_0_27_Data_16_SetGet_2
{
	byte bitval;
	//thisval steht hier fuer den bitfield-wert, 
	//aus Generierungsgruenden hier keine einheitliche Bezeichnung moeglich.
	dword thisval; // Display3AdditionalInfo1_1
	bitval= getValue(this);
	thisval = getValue(A_ASG_69_0_0_27_Data_16_SetGet);
	thisval = thisval&~(1<<2)|(bitval<<2);
	putValue(A_ASG_69_0_0_27_Data_16_SetGet,thisval);
}

on envVar A_ASG_69_0_0_27_Data_16_SetGet_3
{
	byte bitval;
	//thisval steht hier fuer den bitfield-wert, 
	//aus Generierungsgruenden hier keine einheitliche Bezeichnung moeglich.
	dword thisval; // Display3AdditionalInfo1_1
	bitval= getValue(this);
	thisval = getValue(A_ASG_69_0_0_27_Data_16_SetGet);
	thisval = thisval&~(1<<3)|(bitval<<3);
	putValue(A_ASG_69_0_0_27_Data_16_SetGet,thisval);
}

on envVar A_ASG_69_0_0_27_Data_16_SetGet_4
{
	byte bitval;
	//thisval steht hier fuer den bitfield-wert, 
	//aus Generierungsgruenden hier keine einheitliche Bezeichnung moeglich.
	dword thisval; // Display3AdditionalInfo1_1
	bitval= getValue(this);
	thisval = getValue(A_ASG_69_0_0_27_Data_16_SetGet);
	thisval = thisval&~(1<<4)|(bitval<<4);
	putValue(A_ASG_69_0_0_27_Data_16_SetGet,thisval);
}

on envVar A_ASG_69_0_0_27_Data_16_SetGet_5
{
	byte bitval;
	//thisval steht hier fuer den bitfield-wert, 
	//aus Generierungsgruenden hier keine einheitliche Bezeichnung moeglich.
	dword thisval; // Display3AdditionalInfo1_1
	bitval= getValue(this);
	thisval = getValue(A_ASG_69_0_0_27_Data_16_SetGet);
	thisval = thisval&~(1<<5)|(bitval<<5);
	putValue(A_ASG_69_0_0_27_Data_16_SetGet,thisval);
}

on envVar A_ASG_69_0_0_27_Data_16_SetGet_6
{
	byte bitval;
	//thisval steht hier fuer den bitfield-wert, 
	//aus Generierungsgruenden hier keine einheitliche Bezeichnung moeglich.
	dword thisval; // Display3AdditionalInfo1_1
	bitval= getValue(this);
	thisval = getValue(A_ASG_69_0_0_27_Data_16_SetGet);
	thisval = thisval&~(1<<6)|(bitval<<6);
	putValue(A_ASG_69_0_0_27_Data_16_SetGet,thisval);
}

on envVar A_ASG_69_0_0_27_Data_16_SetGet_7
{
	byte bitval;
	//thisval steht hier fuer den bitfield-wert, 
	//aus Generierungsgruenden hier keine einheitliche Bezeichnung moeglich.
	dword thisval; // Display3AdditionalInfo1_1
	bitval= getValue(this);
	thisval = getValue(A_ASG_69_0_0_27_Data_16_SetGet);
	thisval = thisval&~(1<<7)|(bitval<<7);
	putValue(A_ASG_69_0_0_27_Data_16_SetGet,thisval);
}

on envVar A_ASG_69_0_0_27_Data_16_SetGet_8
{
	byte bitval;
	//thisval steht hier fuer den bitfield-wert, 
	//aus Generierungsgruenden hier keine einheitliche Bezeichnung moeglich.
	dword thisval; // Display3AdditionalInfo1_1
	bitval= getValue(this);
	thisval = getValue(A_ASG_69_0_0_27_Data_16_SetGet);
	thisval = thisval&~(1<<8)|(bitval<<8);
	putValue(A_ASG_69_0_0_27_Data_16_SetGet,thisval);
}

on envVar A_ASG_69_0_0_27_Data_16_SetGet_9
{
	byte bitval;
	//thisval steht hier fuer den bitfield-wert, 
	//aus Generierungsgruenden hier keine einheitliche Bezeichnung moeglich.
	dword thisval; // Display3AdditionalInfo1_1
	bitval= getValue(this);
	thisval = getValue(A_ASG_69_0_0_27_Data_16_SetGet);
	thisval = thisval&~(1<<9)|(bitval<<9);
	putValue(A_ASG_69_0_0_27_Data_16_SetGet,thisval);
}

on envVar A_ASG_69_0_0_27_Data_16_SetGet_10
{
	byte bitval;
	//thisval steht hier fuer den bitfield-wert, 
	//aus Generierungsgruenden hier keine einheitliche Bezeichnung moeglich.
	dword thisval; // Display3AdditionalInfo1_1
	bitval= getValue(this);
	thisval = getValue(A_ASG_69_0_0_27_Data_16_SetGet);
	thisval = thisval&~(1<<10)|(bitval<<10);
	putValue(A_ASG_69_0_0_27_Data_16_SetGet,thisval);
}

on envVar A_ASG_69_0_0_27_Data_16_SetGet_11
{
	byte bitval;
	//thisval steht hier fuer den bitfield-wert, 
	//aus Generierungsgruenden hier keine einheitliche Bezeichnung moeglich.
	dword thisval; // Display3AdditionalInfo1_1
	bitval= getValue(this);
	thisval = getValue(A_ASG_69_0_0_27_Data_16_SetGet);
	thisval = thisval&~(1<<11)|(bitval<<11);
	putValue(A_ASG_69_0_0_27_Data_16_SetGet,thisval);
}

on envVar A_ASG_69_0_0_27_Data_16_SetGet_12
{
	byte bitval;
	//thisval steht hier fuer den bitfield-wert, 
	//aus Generierungsgruenden hier keine einheitliche Bezeichnung moeglich.
	dword thisval; // Display3AdditionalInfo1_1
	bitval= getValue(this);
	thisval = getValue(A_ASG_69_0_0_27_Data_16_SetGet);
	thisval = thisval&~(1<<12)|(bitval<<12);
	putValue(A_ASG_69_0_0_27_Data_16_SetGet,thisval);
}

on envVar A_ASG_69_0_0_27_Data_16_SetGet_13
{
	byte bitval;
	//thisval steht hier fuer den bitfield-wert, 
	//aus Generierungsgruenden hier keine einheitliche Bezeichnung moeglich.
	dword thisval; // Display3AdditionalInfo1_1
	bitval= getValue(this);
	thisval = getValue(A_ASG_69_0_0_27_Data_16_SetGet);
	thisval = thisval&~(1<<13)|(bitval<<13);
	putValue(A_ASG_69_0_0_27_Data_16_SetGet,thisval);
}

on envVar A_ASG_69_0_0_27_Data_16_SetGet_14
{
	byte bitval;
	//thisval steht hier fuer den bitfield-wert, 
	//aus Generierungsgruenden hier keine einheitliche Bezeichnung moeglich.
	dword thisval; // Display3AdditionalInfo1_1
	bitval= getValue(this);
	thisval = getValue(A_ASG_69_0_0_27_Data_16_SetGet);
	thisval = thisval&~(1<<14)|(bitval<<14);
	putValue(A_ASG_69_0_0_27_Data_16_SetGet,thisval);
}

on envVar A_ASG_69_0_0_27_Data_16_SetGet_15
{
	byte bitval;
	//thisval steht hier fuer den bitfield-wert, 
	//aus Generierungsgruenden hier keine einheitliche Bezeichnung moeglich.
	dword thisval; // Display3AdditionalInfo1_1
	bitval= getValue(this);
	thisval = getValue(A_ASG_69_0_0_27_Data_16_SetGet);
	thisval = thisval&~(1<<15)|(bitval<<15);
	putValue(A_ASG_69_0_0_27_Data_16_SetGet,thisval);
}

on envVar A_ASG_69_0_0_27_Data_16_SetGet_16
{
	byte bitval;
	//thisval steht hier fuer den bitfield-wert, 
	//aus Generierungsgruenden hier keine einheitliche Bezeichnung moeglich.
	dword thisval; // Display3AdditionalInfo1_1
	bitval= getValue(this);
	thisval = getValue(A_ASG_69_0_0_27_Data_16_SetGet);
	thisval = thisval&~(1<<16)|(bitval<<16);
	putValue(A_ASG_69_0_0_27_Data_16_SetGet,thisval);
}

on envVar A_ASG_69_0_0_27_Data_16_SetGet_17
{
	byte bitval;
	//thisval steht hier fuer den bitfield-wert, 
	//aus Generierungsgruenden hier keine einheitliche Bezeichnung moeglich.
	dword thisval; // Display3AdditionalInfo1_1
	bitval= getValue(this);
	thisval = getValue(A_ASG_69_0_0_27_Data_16_SetGet);
	thisval = thisval&~(1<<17)|(bitval<<17);
	putValue(A_ASG_69_0_0_27_Data_16_SetGet,thisval);
}

on envVar A_ASG_69_0_0_27_Data_16_SetGet_18
{
	byte bitval;
	//thisval steht hier fuer den bitfield-wert, 
	//aus Generierungsgruenden hier keine einheitliche Bezeichnung moeglich.
	dword thisval; // Display3AdditionalInfo1_1
	bitval= getValue(this);
	thisval = getValue(A_ASG_69_0_0_27_Data_16_SetGet);
	thisval = thisval&~(1<<18)|(bitval<<18);
	putValue(A_ASG_69_0_0_27_Data_16_SetGet,thisval);
}

on envVar A_ASG_69_0_0_27_Data_16_SetGet_19
{
	byte bitval;
	//thisval steht hier fuer den bitfield-wert, 
	//aus Generierungsgruenden hier keine einheitliche Bezeichnung moeglich.
	dword thisval; // Display3AdditionalInfo1_1
	bitval= getValue(this);
	thisval = getValue(A_ASG_69_0_0_27_Data_16_SetGet);
	thisval = thisval&~(1<<19)|(bitval<<19);
	putValue(A_ASG_69_0_0_27_Data_16_SetGet,thisval);
}

on envVar A_ASG_69_0_0_27_Data_16_SetGet_20
{
	byte bitval;
	//thisval steht hier fuer den bitfield-wert, 
	//aus Generierungsgruenden hier keine einheitliche Bezeichnung moeglich.
	dword thisval; // Display3AdditionalInfo1_1
	bitval= getValue(this);
	thisval = getValue(A_ASG_69_0_0_27_Data_16_SetGet);
	thisval = thisval&~(1<<20)|(bitval<<20);
	putValue(A_ASG_69_0_0_27_Data_16_SetGet,thisval);
}

on envVar A_ASG_69_0_0_27_Data_16_SetGet_21
{
	byte bitval;
	//thisval steht hier fuer den bitfield-wert, 
	//aus Generierungsgruenden hier keine einheitliche Bezeichnung moeglich.
	dword thisval; // Display3AdditionalInfo1_1
	bitval= getValue(this);
	thisval = getValue(A_ASG_69_0_0_27_Data_16_SetGet);
	thisval = thisval&~(1<<21)|(bitval<<21);
	putValue(A_ASG_69_0_0_27_Data_16_SetGet,thisval);
}

on envVar A_ASG_69_0_0_27_Data_16_SetGet_22
{
	byte bitval;
	//thisval steht hier fuer den bitfield-wert, 
	//aus Generierungsgruenden hier keine einheitliche Bezeichnung moeglich.
	dword thisval; // Display3AdditionalInfo1_1
	bitval= getValue(this);
	thisval = getValue(A_ASG_69_0_0_27_Data_16_SetGet);
	thisval = thisval&~(1<<22)|(bitval<<22);
	putValue(A_ASG_69_0_0_27_Data_16_SetGet,thisval);
}

on envVar A_ASG_69_0_0_27_Data_16_SetGet_23
{
	byte bitval;
	//thisval steht hier fuer den bitfield-wert, 
	//aus Generierungsgruenden hier keine einheitliche Bezeichnung moeglich.
	dword thisval; // Display3AdditionalInfo1_1
	bitval= getValue(this);
	thisval = getValue(A_ASG_69_0_0_27_Data_16_SetGet);
	thisval = thisval&~(1<<23)|(bitval<<23);
	putValue(A_ASG_69_0_0_27_Data_16_SetGet,thisval);
}

on envVar A_ASG_69_0_0_27_Data_16_SetGet_24
{
	byte bitval;
	//thisval steht hier fuer den bitfield-wert, 
	//aus Generierungsgruenden hier keine einheitliche Bezeichnung moeglich.
	dword thisval; // Display3AdditionalInfo1_1
	bitval= getValue(this);
	thisval = getValue(A_ASG_69_0_0_27_Data_16_SetGet);
	thisval = thisval&~(1<<24)|(bitval<<24);
	putValue(A_ASG_69_0_0_27_Data_16_SetGet,thisval);
}

on envVar A_ASG_69_0_0_27_Data_16_SetGet_25
{
	byte bitval;
	//thisval steht hier fuer den bitfield-wert, 
	//aus Generierungsgruenden hier keine einheitliche Bezeichnung moeglich.
	dword thisval; // Display3AdditionalInfo1_1
	bitval= getValue(this);
	thisval = getValue(A_ASG_69_0_0_27_Data_16_SetGet);
	thisval = thisval&~(1<<25)|(bitval<<25);
	putValue(A_ASG_69_0_0_27_Data_16_SetGet,thisval);
}

on envVar A_ASG_69_0_0_27_Data_16_SetGet_26
{
	byte bitval;
	//thisval steht hier fuer den bitfield-wert, 
	//aus Generierungsgruenden hier keine einheitliche Bezeichnung moeglich.
	dword thisval; // Display3AdditionalInfo1_1
	bitval= getValue(this);
	thisval = getValue(A_ASG_69_0_0_27_Data_16_SetGet);
	thisval = thisval&~(1<<26)|(bitval<<26);
	putValue(A_ASG_69_0_0_27_Data_16_SetGet,thisval);
}

on envVar A_ASG_69_0_0_27_Data_16_SetGet_27
{
	byte bitval;
	//thisval steht hier fuer den bitfield-wert, 
	//aus Generierungsgruenden hier keine einheitliche Bezeichnung moeglich.
	dword thisval; // Display3AdditionalInfo1_1
	bitval= getValue(this);
	thisval = getValue(A_ASG_69_0_0_27_Data_16_SetGet);
	thisval = thisval&~(1<<27)|(bitval<<27);
	putValue(A_ASG_69_0_0_27_Data_16_SetGet,thisval);
}

on envVar A_ASG_69_0_0_27_Data_16_SetGet_28
{
	byte bitval;
	//thisval steht hier fuer den bitfield-wert, 
	//aus Generierungsgruenden hier keine einheitliche Bezeichnung moeglich.
	dword thisval; // Display3AdditionalInfo1_1
	bitval= getValue(this);
	thisval = getValue(A_ASG_69_0_0_27_Data_16_SetGet);
	thisval = thisval&~(1<<28)|(bitval<<28);
	putValue(A_ASG_69_0_0_27_Data_16_SetGet,thisval);
}

on envVar A_ASG_69_0_0_27_Data_16_SetGet_29
{
	byte bitval;
	//thisval steht hier fuer den bitfield-wert, 
	//aus Generierungsgruenden hier keine einheitliche Bezeichnung moeglich.
	dword thisval; // Display3AdditionalInfo1_1
	bitval= getValue(this);
	thisval = getValue(A_ASG_69_0_0_27_Data_16_SetGet);
	thisval = thisval&~(1<<29)|(bitval<<29);
	putValue(A_ASG_69_0_0_27_Data_16_SetGet,thisval);
}

on envVar A_ASG_69_0_0_27_Data_16_SetGet_30
{
	byte bitval;
	//thisval steht hier fuer den bitfield-wert, 
	//aus Generierungsgruenden hier keine einheitliche Bezeichnung moeglich.
	dword thisval; // Display3AdditionalInfo1_1
	bitval= getValue(this);
	thisval = getValue(A_ASG_69_0_0_27_Data_16_SetGet);
	thisval = thisval&~(1<<30)|(bitval<<30);
	putValue(A_ASG_69_0_0_27_Data_16_SetGet,thisval);
}

on envVar A_ASG_69_0_0_27_Data_16_SetGet_31
{
	byte bitval;
	//thisval steht hier fuer den bitfield-wert, 
	//aus Generierungsgruenden hier keine einheitliche Bezeichnung moeglich.
	dword thisval; // Display3AdditionalInfo1_1
	bitval= getValue(this);
	thisval = getValue(A_ASG_69_0_0_27_Data_16_SetGet);
	thisval = thisval&~(1<<31)|(bitval<<31);
	putValue(A_ASG_69_0_0_27_Data_16_SetGet,thisval);
}

on envVar A_ASG_69_0_0_27_Data_16_SetGet
{
	byte superval[664];

	//Update Childvalue (BitField)
	byte mask=0x01;
	int i = 0;
	dword thisval; // Display3AdditionalInfo1_1
	thisval = getValue(this);
	if(thisval&(mask<<0))
		putValue(A_ASG_69_0_0_27_Data_16_SetGet_0, 1);
	else
		putValue(A_ASG_69_0_0_27_Data_16_SetGet_0, 0);
	if(thisval&(mask<<1))
		putValue(A_ASG_69_0_0_27_Data_16_SetGet_1, 1);
	else
		putValue(A_ASG_69_0_0_27_Data_16_SetGet_1, 0);
	if(thisval&(mask<<2))
		putValue(A_ASG_69_0_0_27_Data_16_SetGet_2, 1);
	else
		putValue(A_ASG_69_0_0_27_Data_16_SetGet_2, 0);
	if(thisval&(mask<<3))
		putValue(A_ASG_69_0_0_27_Data_16_SetGet_3, 1);
	else
		putValue(A_ASG_69_0_0_27_Data_16_SetGet_3, 0);
	if(thisval&(mask<<4))
		putValue(A_ASG_69_0_0_27_Data_16_SetGet_4, 1);
	else
		putValue(A_ASG_69_0_0_27_Data_16_SetGet_4, 0);
	if(thisval&(mask<<5))
		putValue(A_ASG_69_0_0_27_Data_16_SetGet_5, 1);
	else
		putValue(A_ASG_69_0_0_27_Data_16_SetGet_5, 0);
	if(thisval&(mask<<6))
		putValue(A_ASG_69_0_0_27_Data_16_SetGet_6, 1);
	else
		putValue(A_ASG_69_0_0_27_Data_16_SetGet_6, 0);
	if(thisval&(mask<<7))
		putValue(A_ASG_69_0_0_27_Data_16_SetGet_7, 1);
	else
		putValue(A_ASG_69_0_0_27_Data_16_SetGet_7, 0);
	if(thisval&(mask<<8))
		putValue(A_ASG_69_0_0_27_Data_16_SetGet_8, 1);
	else
		putValue(A_ASG_69_0_0_27_Data_16_SetGet_8, 0);
	if(thisval&(mask<<9))
		putValue(A_ASG_69_0_0_27_Data_16_SetGet_9, 1);
	else
		putValue(A_ASG_69_0_0_27_Data_16_SetGet_9, 0);
	if(thisval&(mask<<10))
		putValue(A_ASG_69_0_0_27_Data_16_SetGet_10, 1);
	else
		putValue(A_ASG_69_0_0_27_Data_16_SetGet_10, 0);
	if(thisval&(mask<<11))
		putValue(A_ASG_69_0_0_27_Data_16_SetGet_11, 1);
	else
		putValue(A_ASG_69_0_0_27_Data_16_SetGet_11, 0);
	if(thisval&(mask<<12))
		putValue(A_ASG_69_0_0_27_Data_16_SetGet_12, 1);
	else
		putValue(A_ASG_69_0_0_27_Data_16_SetGet_12, 0);
	if(thisval&(mask<<13))
		putValue(A_ASG_69_0_0_27_Data_16_SetGet_13, 1);
	else
		putValue(A_ASG_69_0_0_27_Data_16_SetGet_13, 0);
	if(thisval&(mask<<14))
		putValue(A_ASG_69_0_0_27_Data_16_SetGet_14, 1);
	else
		putValue(A_ASG_69_0_0_27_Data_16_SetGet_14, 0);
	if(thisval&(mask<<15))
		putValue(A_ASG_69_0_0_27_Data_16_SetGet_15, 1);
	else
		putValue(A_ASG_69_0_0_27_Data_16_SetGet_15, 0);
	if(thisval&(mask<<16))
		putValue(A_ASG_69_0_0_27_Data_16_SetGet_16, 1);
	else
		putValue(A_ASG_69_0_0_27_Data_16_SetGet_16, 0);
	if(thisval&(mask<<17))
		putValue(A_ASG_69_0_0_27_Data_16_SetGet_17, 1);
	else
		putValue(A_ASG_69_0_0_27_Data_16_SetGet_17, 0);
	if(thisval&(mask<<18))
		putValue(A_ASG_69_0_0_27_Data_16_SetGet_18, 1);
	else
		putValue(A_ASG_69_0_0_27_Data_16_SetGet_18, 0);
	if(thisval&(mask<<19))
		putValue(A_ASG_69_0_0_27_Data_16_SetGet_19, 1);
	else
		putValue(A_ASG_69_0_0_27_Data_16_SetGet_19, 0);
	if(thisval&(mask<<20))
		putValue(A_ASG_69_0_0_27_Data_16_SetGet_20, 1);
	else
		putValue(A_ASG_69_0_0_27_Data_16_SetGet_20, 0);
	if(thisval&(mask<<21))
		putValue(A_ASG_69_0_0_27_Data_16_SetGet_21, 1);
	else
		putValue(A_ASG_69_0_0_27_Data_16_SetGet_21, 0);
	if(thisval&(mask<<22))
		putValue(A_ASG_69_0_0_27_Data_16_SetGet_22, 1);
	else
		putValue(A_ASG_69_0_0_27_Data_16_SetGet_22, 0);
	if(thisval&(mask<<23))
		putValue(A_ASG_69_0_0_27_Data_16_SetGet_23, 1);
	else
		putValue(A_ASG_69_0_0_27_Data_16_SetGet_23, 0);
	if(thisval&(mask<<24))
		putValue(A_ASG_69_0_0_27_Data_16_SetGet_24, 1);
	else
		putValue(A_ASG_69_0_0_27_Data_16_SetGet_24, 0);
	if(thisval&(mask<<25))
		putValue(A_ASG_69_0_0_27_Data_16_SetGet_25, 1);
	else
		putValue(A_ASG_69_0_0_27_Data_16_SetGet_25, 0);
	if(thisval&(mask<<26))
		putValue(A_ASG_69_0_0_27_Data_16_SetGet_26, 1);
	else
		putValue(A_ASG_69_0_0_27_Data_16_SetGet_26, 0);
	if(thisval&(mask<<27))
		putValue(A_ASG_69_0_0_27_Data_16_SetGet_27, 1);
	else
		putValue(A_ASG_69_0_0_27_Data_16_SetGet_27, 0);
	if(thisval&(mask<<28))
		putValue(A_ASG_69_0_0_27_Data_16_SetGet_28, 1);
	else
		putValue(A_ASG_69_0_0_27_Data_16_SetGet_28, 0);
	if(thisval&(mask<<29))
		putValue(A_ASG_69_0_0_27_Data_16_SetGet_29, 1);
	else
		putValue(A_ASG_69_0_0_27_Data_16_SetGet_29, 0);
	if(thisval&(mask<<30))
		putValue(A_ASG_69_0_0_27_Data_16_SetGet_30, 1);
	else
		putValue(A_ASG_69_0_0_27_Data_16_SetGet_30, 0);
	if(thisval&(mask<<31))
		putValue(A_ASG_69_0_0_27_Data_16_SetGet_31, 1);
	else
		putValue(A_ASG_69_0_0_27_Data_16_SetGet_31, 0);
    A_ASG_69_0_0_27_ArrayDataList[getValue(A_ASG_69_0_0_27_DataIndex_SetGet)].Param16 = thisval;
}
on envVar A_ASG_69_0_0_27_Data_17_SetGet_0
{
	byte bitval;
	//thisval steht hier fuer den bitfield-wert, 
	//aus Generierungsgruenden hier keine einheitliche Bezeichnung moeglich.
	dword thisval; // Display3AdditionalInfo1_2
	bitval= getValue(this);
	thisval = getValue(A_ASG_69_0_0_27_Data_17_SetGet);
	thisval = thisval&~(1<<0)|(bitval<<0);
	putValue(A_ASG_69_0_0_27_Data_17_SetGet,thisval);
}

on envVar A_ASG_69_0_0_27_Data_17_SetGet_1
{
	byte bitval;
	//thisval steht hier fuer den bitfield-wert, 
	//aus Generierungsgruenden hier keine einheitliche Bezeichnung moeglich.
	dword thisval; // Display3AdditionalInfo1_2
	bitval= getValue(this);
	thisval = getValue(A_ASG_69_0_0_27_Data_17_SetGet);
	thisval = thisval&~(1<<1)|(bitval<<1);
	putValue(A_ASG_69_0_0_27_Data_17_SetGet,thisval);
}

on envVar A_ASG_69_0_0_27_Data_17_SetGet_2
{
	byte bitval;
	//thisval steht hier fuer den bitfield-wert, 
	//aus Generierungsgruenden hier keine einheitliche Bezeichnung moeglich.
	dword thisval; // Display3AdditionalInfo1_2
	bitval= getValue(this);
	thisval = getValue(A_ASG_69_0_0_27_Data_17_SetGet);
	thisval = thisval&~(1<<2)|(bitval<<2);
	putValue(A_ASG_69_0_0_27_Data_17_SetGet,thisval);
}

on envVar A_ASG_69_0_0_27_Data_17_SetGet_3
{
	byte bitval;
	//thisval steht hier fuer den bitfield-wert, 
	//aus Generierungsgruenden hier keine einheitliche Bezeichnung moeglich.
	dword thisval; // Display3AdditionalInfo1_2
	bitval= getValue(this);
	thisval = getValue(A_ASG_69_0_0_27_Data_17_SetGet);
	thisval = thisval&~(1<<3)|(bitval<<3);
	putValue(A_ASG_69_0_0_27_Data_17_SetGet,thisval);
}

on envVar A_ASG_69_0_0_27_Data_17_SetGet_4
{
	byte bitval;
	//thisval steht hier fuer den bitfield-wert, 
	//aus Generierungsgruenden hier keine einheitliche Bezeichnung moeglich.
	dword thisval; // Display3AdditionalInfo1_2
	bitval= getValue(this);
	thisval = getValue(A_ASG_69_0_0_27_Data_17_SetGet);
	thisval = thisval&~(1<<4)|(bitval<<4);
	putValue(A_ASG_69_0_0_27_Data_17_SetGet,thisval);
}

on envVar A_ASG_69_0_0_27_Data_17_SetGet_5
{
	byte bitval;
	//thisval steht hier fuer den bitfield-wert, 
	//aus Generierungsgruenden hier keine einheitliche Bezeichnung moeglich.
	dword thisval; // Display3AdditionalInfo1_2
	bitval= getValue(this);
	thisval = getValue(A_ASG_69_0_0_27_Data_17_SetGet);
	thisval = thisval&~(1<<5)|(bitval<<5);
	putValue(A_ASG_69_0_0_27_Data_17_SetGet,thisval);
}

on envVar A_ASG_69_0_0_27_Data_17_SetGet_6
{
	byte bitval;
	//thisval steht hier fuer den bitfield-wert, 
	//aus Generierungsgruenden hier keine einheitliche Bezeichnung moeglich.
	dword thisval; // Display3AdditionalInfo1_2
	bitval= getValue(this);
	thisval = getValue(A_ASG_69_0_0_27_Data_17_SetGet);
	thisval = thisval&~(1<<6)|(bitval<<6);
	putValue(A_ASG_69_0_0_27_Data_17_SetGet,thisval);
}

on envVar A_ASG_69_0_0_27_Data_17_SetGet_7
{
	byte bitval;
	//thisval steht hier fuer den bitfield-wert, 
	//aus Generierungsgruenden hier keine einheitliche Bezeichnung moeglich.
	dword thisval; // Display3AdditionalInfo1_2
	bitval= getValue(this);
	thisval = getValue(A_ASG_69_0_0_27_Data_17_SetGet);
	thisval = thisval&~(1<<7)|(bitval<<7);
	putValue(A_ASG_69_0_0_27_Data_17_SetGet,thisval);
}

on envVar A_ASG_69_0_0_27_Data_17_SetGet_8
{
	byte bitval;
	//thisval steht hier fuer den bitfield-wert, 
	//aus Generierungsgruenden hier keine einheitliche Bezeichnung moeglich.
	dword thisval; // Display3AdditionalInfo1_2
	bitval= getValue(this);
	thisval = getValue(A_ASG_69_0_0_27_Data_17_SetGet);
	thisval = thisval&~(1<<8)|(bitval<<8);
	putValue(A_ASG_69_0_0_27_Data_17_SetGet,thisval);
}

on envVar A_ASG_69_0_0_27_Data_17_SetGet_9
{
	byte bitval;
	//thisval steht hier fuer den bitfield-wert, 
	//aus Generierungsgruenden hier keine einheitliche Bezeichnung moeglich.
	dword thisval; // Display3AdditionalInfo1_2
	bitval= getValue(this);
	thisval = getValue(A_ASG_69_0_0_27_Data_17_SetGet);
	thisval = thisval&~(1<<9)|(bitval<<9);
	putValue(A_ASG_69_0_0_27_Data_17_SetGet,thisval);
}

on envVar A_ASG_69_0_0_27_Data_17_SetGet_10
{
	byte bitval;
	//thisval steht hier fuer den bitfield-wert, 
	//aus Generierungsgruenden hier keine einheitliche Bezeichnung moeglich.
	dword thisval; // Display3AdditionalInfo1_2
	bitval= getValue(this);
	thisval = getValue(A_ASG_69_0_0_27_Data_17_SetGet);
	thisval = thisval&~(1<<10)|(bitval<<10);
	putValue(A_ASG_69_0_0_27_Data_17_SetGet,thisval);
}

on envVar A_ASG_69_0_0_27_Data_17_SetGet_11
{
	byte bitval;
	//thisval steht hier fuer den bitfield-wert, 
	//aus Generierungsgruenden hier keine einheitliche Bezeichnung moeglich.
	dword thisval; // Display3AdditionalInfo1_2
	bitval= getValue(this);
	thisval = getValue(A_ASG_69_0_0_27_Data_17_SetGet);
	thisval = thisval&~(1<<11)|(bitval<<11);
	putValue(A_ASG_69_0_0_27_Data_17_SetGet,thisval);
}

on envVar A_ASG_69_0_0_27_Data_17_SetGet_12
{
	byte bitval;
	//thisval steht hier fuer den bitfield-wert, 
	//aus Generierungsgruenden hier keine einheitliche Bezeichnung moeglich.
	dword thisval; // Display3AdditionalInfo1_2
	bitval= getValue(this);
	thisval = getValue(A_ASG_69_0_0_27_Data_17_SetGet);
	thisval = thisval&~(1<<12)|(bitval<<12);
	putValue(A_ASG_69_0_0_27_Data_17_SetGet,thisval);
}

on envVar A_ASG_69_0_0_27_Data_17_SetGet_13
{
	byte bitval;
	//thisval steht hier fuer den bitfield-wert, 
	//aus Generierungsgruenden hier keine einheitliche Bezeichnung moeglich.
	dword thisval; // Display3AdditionalInfo1_2
	bitval= getValue(this);
	thisval = getValue(A_ASG_69_0_0_27_Data_17_SetGet);
	thisval = thisval&~(1<<13)|(bitval<<13);
	putValue(A_ASG_69_0_0_27_Data_17_SetGet,thisval);
}

on envVar A_ASG_69_0_0_27_Data_17_SetGet_14
{
	byte bitval;
	//thisval steht hier fuer den bitfield-wert, 
	//aus Generierungsgruenden hier keine einheitliche Bezeichnung moeglich.
	dword thisval; // Display3AdditionalInfo1_2
	bitval= getValue(this);
	thisval = getValue(A_ASG_69_0_0_27_Data_17_SetGet);
	thisval = thisval&~(1<<14)|(bitval<<14);
	putValue(A_ASG_69_0_0_27_Data_17_SetGet,thisval);
}

on envVar A_ASG_69_0_0_27_Data_17_SetGet_15
{
	byte bitval;
	//thisval steht hier fuer den bitfield-wert, 
	//aus Generierungsgruenden hier keine einheitliche Bezeichnung moeglich.
	dword thisval; // Display3AdditionalInfo1_2
	bitval= getValue(this);
	thisval = getValue(A_ASG_69_0_0_27_Data_17_SetGet);
	thisval = thisval&~(1<<15)|(bitval<<15);
	putValue(A_ASG_69_0_0_27_Data_17_SetGet,thisval);
}

on envVar A_ASG_69_0_0_27_Data_17_SetGet_16
{
	byte bitval;
	//thisval steht hier fuer den bitfield-wert, 
	//aus Generierungsgruenden hier keine einheitliche Bezeichnung moeglich.
	dword thisval; // Display3AdditionalInfo1_2
	bitval= getValue(this);
	thisval = getValue(A_ASG_69_0_0_27_Data_17_SetGet);
	thisval = thisval&~(1<<16)|(bitval<<16);
	putValue(A_ASG_69_0_0_27_Data_17_SetGet,thisval);
}

on envVar A_ASG_69_0_0_27_Data_17_SetGet_17
{
	byte bitval;
	//thisval steht hier fuer den bitfield-wert, 
	//aus Generierungsgruenden hier keine einheitliche Bezeichnung moeglich.
	dword thisval; // Display3AdditionalInfo1_2
	bitval= getValue(this);
	thisval = getValue(A_ASG_69_0_0_27_Data_17_SetGet);
	thisval = thisval&~(1<<17)|(bitval<<17);
	putValue(A_ASG_69_0_0_27_Data_17_SetGet,thisval);
}

on envVar A_ASG_69_0_0_27_Data_17_SetGet_18
{
	byte bitval;
	//thisval steht hier fuer den bitfield-wert, 
	//aus Generierungsgruenden hier keine einheitliche Bezeichnung moeglich.
	dword thisval; // Display3AdditionalInfo1_2
	bitval= getValue(this);
	thisval = getValue(A_ASG_69_0_0_27_Data_17_SetGet);
	thisval = thisval&~(1<<18)|(bitval<<18);
	putValue(A_ASG_69_0_0_27_Data_17_SetGet,thisval);
}

on envVar A_ASG_69_0_0_27_Data_17_SetGet_19
{
	byte bitval;
	//thisval steht hier fuer den bitfield-wert, 
	//aus Generierungsgruenden hier keine einheitliche Bezeichnung moeglich.
	dword thisval; // Display3AdditionalInfo1_2
	bitval= getValue(this);
	thisval = getValue(A_ASG_69_0_0_27_Data_17_SetGet);
	thisval = thisval&~(1<<19)|(bitval<<19);
	putValue(A_ASG_69_0_0_27_Data_17_SetGet,thisval);
}

on envVar A_ASG_69_0_0_27_Data_17_SetGet_20
{
	byte bitval;
	//thisval steht hier fuer den bitfield-wert, 
	//aus Generierungsgruenden hier keine einheitliche Bezeichnung moeglich.
	dword thisval; // Display3AdditionalInfo1_2
	bitval= getValue(this);
	thisval = getValue(A_ASG_69_0_0_27_Data_17_SetGet);
	thisval = thisval&~(1<<20)|(bitval<<20);
	putValue(A_ASG_69_0_0_27_Data_17_SetGet,thisval);
}

on envVar A_ASG_69_0_0_27_Data_17_SetGet_21
{
	byte bitval;
	//thisval steht hier fuer den bitfield-wert, 
	//aus Generierungsgruenden hier keine einheitliche Bezeichnung moeglich.
	dword thisval; // Display3AdditionalInfo1_2
	bitval= getValue(this);
	thisval = getValue(A_ASG_69_0_0_27_Data_17_SetGet);
	thisval = thisval&~(1<<21)|(bitval<<21);
	putValue(A_ASG_69_0_0_27_Data_17_SetGet,thisval);
}

on envVar A_ASG_69_0_0_27_Data_17_SetGet_22
{
	byte bitval;
	//thisval steht hier fuer den bitfield-wert, 
	//aus Generierungsgruenden hier keine einheitliche Bezeichnung moeglich.
	dword thisval; // Display3AdditionalInfo1_2
	bitval= getValue(this);
	thisval = getValue(A_ASG_69_0_0_27_Data_17_SetGet);
	thisval = thisval&~(1<<22)|(bitval<<22);
	putValue(A_ASG_69_0_0_27_Data_17_SetGet,thisval);
}

on envVar A_ASG_69_0_0_27_Data_17_SetGet_23
{
	byte bitval;
	//thisval steht hier fuer den bitfield-wert, 
	//aus Generierungsgruenden hier keine einheitliche Bezeichnung moeglich.
	dword thisval; // Display3AdditionalInfo1_2
	bitval= getValue(this);
	thisval = getValue(A_ASG_69_0_0_27_Data_17_SetGet);
	thisval = thisval&~(1<<23)|(bitval<<23);
	putValue(A_ASG_69_0_0_27_Data_17_SetGet,thisval);
}

on envVar A_ASG_69_0_0_27_Data_17_SetGet_24
{
	byte bitval;
	//thisval steht hier fuer den bitfield-wert, 
	//aus Generierungsgruenden hier keine einheitliche Bezeichnung moeglich.
	dword thisval; // Display3AdditionalInfo1_2
	bitval= getValue(this);
	thisval = getValue(A_ASG_69_0_0_27_Data_17_SetGet);
	thisval = thisval&~(1<<24)|(bitval<<24);
	putValue(A_ASG_69_0_0_27_Data_17_SetGet,thisval);
}

on envVar A_ASG_69_0_0_27_Data_17_SetGet_25
{
	byte bitval;
	//thisval steht hier fuer den bitfield-wert, 
	//aus Generierungsgruenden hier keine einheitliche Bezeichnung moeglich.
	dword thisval; // Display3AdditionalInfo1_2
	bitval= getValue(this);
	thisval = getValue(A_ASG_69_0_0_27_Data_17_SetGet);
	thisval = thisval&~(1<<25)|(bitval<<25);
	putValue(A_ASG_69_0_0_27_Data_17_SetGet,thisval);
}

on envVar A_ASG_69_0_0_27_Data_17_SetGet_26
{
	byte bitval;
	//thisval steht hier fuer den bitfield-wert, 
	//aus Generierungsgruenden hier keine einheitliche Bezeichnung moeglich.
	dword thisval; // Display3AdditionalInfo1_2
	bitval= getValue(this);
	thisval = getValue(A_ASG_69_0_0_27_Data_17_SetGet);
	thisval = thisval&~(1<<26)|(bitval<<26);
	putValue(A_ASG_69_0_0_27_Data_17_SetGet,thisval);
}

on envVar A_ASG_69_0_0_27_Data_17_SetGet_27
{
	byte bitval;
	//thisval steht hier fuer den bitfield-wert, 
	//aus Generierungsgruenden hier keine einheitliche Bezeichnung moeglich.
	dword thisval; // Display3AdditionalInfo1_2
	bitval= getValue(this);
	thisval = getValue(A_ASG_69_0_0_27_Data_17_SetGet);
	thisval = thisval&~(1<<27)|(bitval<<27);
	putValue(A_ASG_69_0_0_27_Data_17_SetGet,thisval);
}

on envVar A_ASG_69_0_0_27_Data_17_SetGet_28
{
	byte bitval;
	//thisval steht hier fuer den bitfield-wert, 
	//aus Generierungsgruenden hier keine einheitliche Bezeichnung moeglich.
	dword thisval; // Display3AdditionalInfo1_2
	bitval= getValue(this);
	thisval = getValue(A_ASG_69_0_0_27_Data_17_SetGet);
	thisval = thisval&~(1<<28)|(bitval<<28);
	putValue(A_ASG_69_0_0_27_Data_17_SetGet,thisval);
}

on envVar A_ASG_69_0_0_27_Data_17_SetGet_29
{
	byte bitval;
	//thisval steht hier fuer den bitfield-wert, 
	//aus Generierungsgruenden hier keine einheitliche Bezeichnung moeglich.
	dword thisval; // Display3AdditionalInfo1_2
	bitval= getValue(this);
	thisval = getValue(A_ASG_69_0_0_27_Data_17_SetGet);
	thisval = thisval&~(1<<29)|(bitval<<29);
	putValue(A_ASG_69_0_0_27_Data_17_SetGet,thisval);
}

on envVar A_ASG_69_0_0_27_Data_17_SetGet
{
	byte superval[664];

	//Update Childvalue (BitField)
	byte mask=0x01;
	int i = 0;
	dword thisval; // Display3AdditionalInfo1_2
	thisval = getValue(this);
	if(thisval&(mask<<0))
		putValue(A_ASG_69_0_0_27_Data_17_SetGet_0, 1);
	else
		putValue(A_ASG_69_0_0_27_Data_17_SetGet_0, 0);
	if(thisval&(mask<<1))
		putValue(A_ASG_69_0_0_27_Data_17_SetGet_1, 1);
	else
		putValue(A_ASG_69_0_0_27_Data_17_SetGet_1, 0);
	if(thisval&(mask<<2))
		putValue(A_ASG_69_0_0_27_Data_17_SetGet_2, 1);
	else
		putValue(A_ASG_69_0_0_27_Data_17_SetGet_2, 0);
	if(thisval&(mask<<3))
		putValue(A_ASG_69_0_0_27_Data_17_SetGet_3, 1);
	else
		putValue(A_ASG_69_0_0_27_Data_17_SetGet_3, 0);
	if(thisval&(mask<<4))
		putValue(A_ASG_69_0_0_27_Data_17_SetGet_4, 1);
	else
		putValue(A_ASG_69_0_0_27_Data_17_SetGet_4, 0);
	if(thisval&(mask<<5))
		putValue(A_ASG_69_0_0_27_Data_17_SetGet_5, 1);
	else
		putValue(A_ASG_69_0_0_27_Data_17_SetGet_5, 0);
	if(thisval&(mask<<6))
		putValue(A_ASG_69_0_0_27_Data_17_SetGet_6, 1);
	else
		putValue(A_ASG_69_0_0_27_Data_17_SetGet_6, 0);
	if(thisval&(mask<<7))
		putValue(A_ASG_69_0_0_27_Data_17_SetGet_7, 1);
	else
		putValue(A_ASG_69_0_0_27_Data_17_SetGet_7, 0);
	if(thisval&(mask<<8))
		putValue(A_ASG_69_0_0_27_Data_17_SetGet_8, 1);
	else
		putValue(A_ASG_69_0_0_27_Data_17_SetGet_8, 0);
	if(thisval&(mask<<9))
		putValue(A_ASG_69_0_0_27_Data_17_SetGet_9, 1);
	else
		putValue(A_ASG_69_0_0_27_Data_17_SetGet_9, 0);
	if(thisval&(mask<<10))
		putValue(A_ASG_69_0_0_27_Data_17_SetGet_10, 1);
	else
		putValue(A_ASG_69_0_0_27_Data_17_SetGet_10, 0);
	if(thisval&(mask<<11))
		putValue(A_ASG_69_0_0_27_Data_17_SetGet_11, 1);
	else
		putValue(A_ASG_69_0_0_27_Data_17_SetGet_11, 0);
	if(thisval&(mask<<12))
		putValue(A_ASG_69_0_0_27_Data_17_SetGet_12, 1);
	else
		putValue(A_ASG_69_0_0_27_Data_17_SetGet_12, 0);
	if(thisval&(mask<<13))
		putValue(A_ASG_69_0_0_27_Data_17_SetGet_13, 1);
	else
		putValue(A_ASG_69_0_0_27_Data_17_SetGet_13, 0);
	if(thisval&(mask<<14))
		putValue(A_ASG_69_0_0_27_Data_17_SetGet_14, 1);
	else
		putValue(A_ASG_69_0_0_27_Data_17_SetGet_14, 0);
	if(thisval&(mask<<15))
		putValue(A_ASG_69_0_0_27_Data_17_SetGet_15, 1);
	else
		putValue(A_ASG_69_0_0_27_Data_17_SetGet_15, 0);
	if(thisval&(mask<<16))
		putValue(A_ASG_69_0_0_27_Data_17_SetGet_16, 1);
	else
		putValue(A_ASG_69_0_0_27_Data_17_SetGet_16, 0);
	if(thisval&(mask<<17))
		putValue(A_ASG_69_0_0_27_Data_17_SetGet_17, 1);
	else
		putValue(A_ASG_69_0_0_27_Data_17_SetGet_17, 0);
	if(thisval&(mask<<18))
		putValue(A_ASG_69_0_0_27_Data_17_SetGet_18, 1);
	else
		putValue(A_ASG_69_0_0_27_Data_17_SetGet_18, 0);
	if(thisval&(mask<<19))
		putValue(A_ASG_69_0_0_27_Data_17_SetGet_19, 1);
	else
		putValue(A_ASG_69_0_0_27_Data_17_SetGet_19, 0);
	if(thisval&(mask<<20))
		putValue(A_ASG_69_0_0_27_Data_17_SetGet_20, 1);
	else
		putValue(A_ASG_69_0_0_27_Data_17_SetGet_20, 0);
	if(thisval&(mask<<21))
		putValue(A_ASG_69_0_0_27_Data_17_SetGet_21, 1);
	else
		putValue(A_ASG_69_0_0_27_Data_17_SetGet_21, 0);
	if(thisval&(mask<<22))
		putValue(A_ASG_69_0_0_27_Data_17_SetGet_22, 1);
	else
		putValue(A_ASG_69_0_0_27_Data_17_SetGet_22, 0);
	if(thisval&(mask<<23))
		putValue(A_ASG_69_0_0_27_Data_17_SetGet_23, 1);
	else
		putValue(A_ASG_69_0_0_27_Data_17_SetGet_23, 0);
	if(thisval&(mask<<24))
		putValue(A_ASG_69_0_0_27_Data_17_SetGet_24, 1);
	else
		putValue(A_ASG_69_0_0_27_Data_17_SetGet_24, 0);
	if(thisval&(mask<<25))
		putValue(A_ASG_69_0_0_27_Data_17_SetGet_25, 1);
	else
		putValue(A_ASG_69_0_0_27_Data_17_SetGet_25, 0);
	if(thisval&(mask<<26))
		putValue(A_ASG_69_0_0_27_Data_17_SetGet_26, 1);
	else
		putValue(A_ASG_69_0_0_27_Data_17_SetGet_26, 0);
	if(thisval&(mask<<27))
		putValue(A_ASG_69_0_0_27_Data_17_SetGet_27, 1);
	else
		putValue(A_ASG_69_0_0_27_Data_17_SetGet_27, 0);
	if(thisval&(mask<<28))
		putValue(A_ASG_69_0_0_27_Data_17_SetGet_28, 1);
	else
		putValue(A_ASG_69_0_0_27_Data_17_SetGet_28, 0);
	if(thisval&(mask<<29))
		putValue(A_ASG_69_0_0_27_Data_17_SetGet_29, 1);
	else
		putValue(A_ASG_69_0_0_27_Data_17_SetGet_29, 0);
    A_ASG_69_0_0_27_ArrayDataList[getValue(A_ASG_69_0_0_27_DataIndex_SetGet)].Param17 = thisval;
}
on envVar A_ASG_69_0_0_27_Data_18_SetGet_0
{
	byte bitval;
	//thisval steht hier fuer den bitfield-wert, 
	//aus Generierungsgruenden hier keine einheitliche Bezeichnung moeglich.
	dword thisval; // Display3AdditionalInfo2_1
	bitval= getValue(this);
	thisval = getValue(A_ASG_69_0_0_27_Data_18_SetGet);
	thisval = thisval&~(1<<0)|(bitval<<0);
	putValue(A_ASG_69_0_0_27_Data_18_SetGet,thisval);
}

on envVar A_ASG_69_0_0_27_Data_18_SetGet_1
{
	byte bitval;
	//thisval steht hier fuer den bitfield-wert, 
	//aus Generierungsgruenden hier keine einheitliche Bezeichnung moeglich.
	dword thisval; // Display3AdditionalInfo2_1
	bitval= getValue(this);
	thisval = getValue(A_ASG_69_0_0_27_Data_18_SetGet);
	thisval = thisval&~(1<<1)|(bitval<<1);
	putValue(A_ASG_69_0_0_27_Data_18_SetGet,thisval);
}

on envVar A_ASG_69_0_0_27_Data_18_SetGet_2
{
	byte bitval;
	//thisval steht hier fuer den bitfield-wert, 
	//aus Generierungsgruenden hier keine einheitliche Bezeichnung moeglich.
	dword thisval; // Display3AdditionalInfo2_1
	bitval= getValue(this);
	thisval = getValue(A_ASG_69_0_0_27_Data_18_SetGet);
	thisval = thisval&~(1<<2)|(bitval<<2);
	putValue(A_ASG_69_0_0_27_Data_18_SetGet,thisval);
}

on envVar A_ASG_69_0_0_27_Data_18_SetGet_3
{
	byte bitval;
	//thisval steht hier fuer den bitfield-wert, 
	//aus Generierungsgruenden hier keine einheitliche Bezeichnung moeglich.
	dword thisval; // Display3AdditionalInfo2_1
	bitval= getValue(this);
	thisval = getValue(A_ASG_69_0_0_27_Data_18_SetGet);
	thisval = thisval&~(1<<3)|(bitval<<3);
	putValue(A_ASG_69_0_0_27_Data_18_SetGet,thisval);
}

on envVar A_ASG_69_0_0_27_Data_18_SetGet_4
{
	byte bitval;
	//thisval steht hier fuer den bitfield-wert, 
	//aus Generierungsgruenden hier keine einheitliche Bezeichnung moeglich.
	dword thisval; // Display3AdditionalInfo2_1
	bitval= getValue(this);
	thisval = getValue(A_ASG_69_0_0_27_Data_18_SetGet);
	thisval = thisval&~(1<<4)|(bitval<<4);
	putValue(A_ASG_69_0_0_27_Data_18_SetGet,thisval);
}

on envVar A_ASG_69_0_0_27_Data_18_SetGet_5
{
	byte bitval;
	//thisval steht hier fuer den bitfield-wert, 
	//aus Generierungsgruenden hier keine einheitliche Bezeichnung moeglich.
	dword thisval; // Display3AdditionalInfo2_1
	bitval= getValue(this);
	thisval = getValue(A_ASG_69_0_0_27_Data_18_SetGet);
	thisval = thisval&~(1<<5)|(bitval<<5);
	putValue(A_ASG_69_0_0_27_Data_18_SetGet,thisval);
}

on envVar A_ASG_69_0_0_27_Data_18_SetGet_6
{
	byte bitval;
	//thisval steht hier fuer den bitfield-wert, 
	//aus Generierungsgruenden hier keine einheitliche Bezeichnung moeglich.
	dword thisval; // Display3AdditionalInfo2_1
	bitval= getValue(this);
	thisval = getValue(A_ASG_69_0_0_27_Data_18_SetGet);
	thisval = thisval&~(1<<6)|(bitval<<6);
	putValue(A_ASG_69_0_0_27_Data_18_SetGet,thisval);
}

on envVar A_ASG_69_0_0_27_Data_18_SetGet_7
{
	byte bitval;
	//thisval steht hier fuer den bitfield-wert, 
	//aus Generierungsgruenden hier keine einheitliche Bezeichnung moeglich.
	dword thisval; // Display3AdditionalInfo2_1
	bitval= getValue(this);
	thisval = getValue(A_ASG_69_0_0_27_Data_18_SetGet);
	thisval = thisval&~(1<<7)|(bitval<<7);
	putValue(A_ASG_69_0_0_27_Data_18_SetGet,thisval);
}

on envVar A_ASG_69_0_0_27_Data_18_SetGet_8
{
	byte bitval;
	//thisval steht hier fuer den bitfield-wert, 
	//aus Generierungsgruenden hier keine einheitliche Bezeichnung moeglich.
	dword thisval; // Display3AdditionalInfo2_1
	bitval= getValue(this);
	thisval = getValue(A_ASG_69_0_0_27_Data_18_SetGet);
	thisval = thisval&~(1<<8)|(bitval<<8);
	putValue(A_ASG_69_0_0_27_Data_18_SetGet,thisval);
}

on envVar A_ASG_69_0_0_27_Data_18_SetGet_9
{
	byte bitval;
	//thisval steht hier fuer den bitfield-wert, 
	//aus Generierungsgruenden hier keine einheitliche Bezeichnung moeglich.
	dword thisval; // Display3AdditionalInfo2_1
	bitval= getValue(this);
	thisval = getValue(A_ASG_69_0_0_27_Data_18_SetGet);
	thisval = thisval&~(1<<9)|(bitval<<9);
	putValue(A_ASG_69_0_0_27_Data_18_SetGet,thisval);
}

on envVar A_ASG_69_0_0_27_Data_18_SetGet_10
{
	byte bitval;
	//thisval steht hier fuer den bitfield-wert, 
	//aus Generierungsgruenden hier keine einheitliche Bezeichnung moeglich.
	dword thisval; // Display3AdditionalInfo2_1
	bitval= getValue(this);
	thisval = getValue(A_ASG_69_0_0_27_Data_18_SetGet);
	thisval = thisval&~(1<<10)|(bitval<<10);
	putValue(A_ASG_69_0_0_27_Data_18_SetGet,thisval);
}

on envVar A_ASG_69_0_0_27_Data_18_SetGet_11
{
	byte bitval;
	//thisval steht hier fuer den bitfield-wert, 
	//aus Generierungsgruenden hier keine einheitliche Bezeichnung moeglich.
	dword thisval; // Display3AdditionalInfo2_1
	bitval= getValue(this);
	thisval = getValue(A_ASG_69_0_0_27_Data_18_SetGet);
	thisval = thisval&~(1<<11)|(bitval<<11);
	putValue(A_ASG_69_0_0_27_Data_18_SetGet,thisval);
}

on envVar A_ASG_69_0_0_27_Data_18_SetGet_12
{
	byte bitval;
	//thisval steht hier fuer den bitfield-wert, 
	//aus Generierungsgruenden hier keine einheitliche Bezeichnung moeglich.
	dword thisval; // Display3AdditionalInfo2_1
	bitval= getValue(this);
	thisval = getValue(A_ASG_69_0_0_27_Data_18_SetGet);
	thisval = thisval&~(1<<12)|(bitval<<12);
	putValue(A_ASG_69_0_0_27_Data_18_SetGet,thisval);
}

on envVar A_ASG_69_0_0_27_Data_18_SetGet_13
{
	byte bitval;
	//thisval steht hier fuer den bitfield-wert, 
	//aus Generierungsgruenden hier keine einheitliche Bezeichnung moeglich.
	dword thisval; // Display3AdditionalInfo2_1
	bitval= getValue(this);
	thisval = getValue(A_ASG_69_0_0_27_Data_18_SetGet);
	thisval = thisval&~(1<<13)|(bitval<<13);
	putValue(A_ASG_69_0_0_27_Data_18_SetGet,thisval);
}

on envVar A_ASG_69_0_0_27_Data_18_SetGet_14
{
	byte bitval;
	//thisval steht hier fuer den bitfield-wert, 
	//aus Generierungsgruenden hier keine einheitliche Bezeichnung moeglich.
	dword thisval; // Display3AdditionalInfo2_1
	bitval= getValue(this);
	thisval = getValue(A_ASG_69_0_0_27_Data_18_SetGet);
	thisval = thisval&~(1<<14)|(bitval<<14);
	putValue(A_ASG_69_0_0_27_Data_18_SetGet,thisval);
}

on envVar A_ASG_69_0_0_27_Data_18_SetGet_15
{
	byte bitval;
	//thisval steht hier fuer den bitfield-wert, 
	//aus Generierungsgruenden hier keine einheitliche Bezeichnung moeglich.
	dword thisval; // Display3AdditionalInfo2_1
	bitval= getValue(this);
	thisval = getValue(A_ASG_69_0_0_27_Data_18_SetGet);
	thisval = thisval&~(1<<15)|(bitval<<15);
	putValue(A_ASG_69_0_0_27_Data_18_SetGet,thisval);
}

on envVar A_ASG_69_0_0_27_Data_18_SetGet_16
{
	byte bitval;
	//thisval steht hier fuer den bitfield-wert, 
	//aus Generierungsgruenden hier keine einheitliche Bezeichnung moeglich.
	dword thisval; // Display3AdditionalInfo2_1
	bitval= getValue(this);
	thisval = getValue(A_ASG_69_0_0_27_Data_18_SetGet);
	thisval = thisval&~(1<<16)|(bitval<<16);
	putValue(A_ASG_69_0_0_27_Data_18_SetGet,thisval);
}

on envVar A_ASG_69_0_0_27_Data_18_SetGet_17
{
	byte bitval;
	//thisval steht hier fuer den bitfield-wert, 
	//aus Generierungsgruenden hier keine einheitliche Bezeichnung moeglich.
	dword thisval; // Display3AdditionalInfo2_1
	bitval= getValue(this);
	thisval = getValue(A_ASG_69_0_0_27_Data_18_SetGet);
	thisval = thisval&~(1<<17)|(bitval<<17);
	putValue(A_ASG_69_0_0_27_Data_18_SetGet,thisval);
}

on envVar A_ASG_69_0_0_27_Data_18_SetGet_18
{
	byte bitval;
	//thisval steht hier fuer den bitfield-wert, 
	//aus Generierungsgruenden hier keine einheitliche Bezeichnung moeglich.
	dword thisval; // Display3AdditionalInfo2_1
	bitval= getValue(this);
	thisval = getValue(A_ASG_69_0_0_27_Data_18_SetGet);
	thisval = thisval&~(1<<18)|(bitval<<18);
	putValue(A_ASG_69_0_0_27_Data_18_SetGet,thisval);
}

on envVar A_ASG_69_0_0_27_Data_18_SetGet_19
{
	byte bitval;
	//thisval steht hier fuer den bitfield-wert, 
	//aus Generierungsgruenden hier keine einheitliche Bezeichnung moeglich.
	dword thisval; // Display3AdditionalInfo2_1
	bitval= getValue(this);
	thisval = getValue(A_ASG_69_0_0_27_Data_18_SetGet);
	thisval = thisval&~(1<<19)|(bitval<<19);
	putValue(A_ASG_69_0_0_27_Data_18_SetGet,thisval);
}

on envVar A_ASG_69_0_0_27_Data_18_SetGet_20
{
	byte bitval;
	//thisval steht hier fuer den bitfield-wert, 
	//aus Generierungsgruenden hier keine einheitliche Bezeichnung moeglich.
	dword thisval; // Display3AdditionalInfo2_1
	bitval= getValue(this);
	thisval = getValue(A_ASG_69_0_0_27_Data_18_SetGet);
	thisval = thisval&~(1<<20)|(bitval<<20);
	putValue(A_ASG_69_0_0_27_Data_18_SetGet,thisval);
}

on envVar A_ASG_69_0_0_27_Data_18_SetGet_21
{
	byte bitval;
	//thisval steht hier fuer den bitfield-wert, 
	//aus Generierungsgruenden hier keine einheitliche Bezeichnung moeglich.
	dword thisval; // Display3AdditionalInfo2_1
	bitval= getValue(this);
	thisval = getValue(A_ASG_69_0_0_27_Data_18_SetGet);
	thisval = thisval&~(1<<21)|(bitval<<21);
	putValue(A_ASG_69_0_0_27_Data_18_SetGet,thisval);
}

on envVar A_ASG_69_0_0_27_Data_18_SetGet_22
{
	byte bitval;
	//thisval steht hier fuer den bitfield-wert, 
	//aus Generierungsgruenden hier keine einheitliche Bezeichnung moeglich.
	dword thisval; // Display3AdditionalInfo2_1
	bitval= getValue(this);
	thisval = getValue(A_ASG_69_0_0_27_Data_18_SetGet);
	thisval = thisval&~(1<<22)|(bitval<<22);
	putValue(A_ASG_69_0_0_27_Data_18_SetGet,thisval);
}

on envVar A_ASG_69_0_0_27_Data_18_SetGet_23
{
	byte bitval;
	//thisval steht hier fuer den bitfield-wert, 
	//aus Generierungsgruenden hier keine einheitliche Bezeichnung moeglich.
	dword thisval; // Display3AdditionalInfo2_1
	bitval= getValue(this);
	thisval = getValue(A_ASG_69_0_0_27_Data_18_SetGet);
	thisval = thisval&~(1<<23)|(bitval<<23);
	putValue(A_ASG_69_0_0_27_Data_18_SetGet,thisval);
}

on envVar A_ASG_69_0_0_27_Data_18_SetGet_24
{
	byte bitval;
	//thisval steht hier fuer den bitfield-wert, 
	//aus Generierungsgruenden hier keine einheitliche Bezeichnung moeglich.
	dword thisval; // Display3AdditionalInfo2_1
	bitval= getValue(this);
	thisval = getValue(A_ASG_69_0_0_27_Data_18_SetGet);
	thisval = thisval&~(1<<24)|(bitval<<24);
	putValue(A_ASG_69_0_0_27_Data_18_SetGet,thisval);
}

on envVar A_ASG_69_0_0_27_Data_18_SetGet_25
{
	byte bitval;
	//thisval steht hier fuer den bitfield-wert, 
	//aus Generierungsgruenden hier keine einheitliche Bezeichnung moeglich.
	dword thisval; // Display3AdditionalInfo2_1
	bitval= getValue(this);
	thisval = getValue(A_ASG_69_0_0_27_Data_18_SetGet);
	thisval = thisval&~(1<<25)|(bitval<<25);
	putValue(A_ASG_69_0_0_27_Data_18_SetGet,thisval);
}

on envVar A_ASG_69_0_0_27_Data_18_SetGet_26
{
	byte bitval;
	//thisval steht hier fuer den bitfield-wert, 
	//aus Generierungsgruenden hier keine einheitliche Bezeichnung moeglich.
	dword thisval; // Display3AdditionalInfo2_1
	bitval= getValue(this);
	thisval = getValue(A_ASG_69_0_0_27_Data_18_SetGet);
	thisval = thisval&~(1<<26)|(bitval<<26);
	putValue(A_ASG_69_0_0_27_Data_18_SetGet,thisval);
}

on envVar A_ASG_69_0_0_27_Data_18_SetGet_27
{
	byte bitval;
	//thisval steht hier fuer den bitfield-wert, 
	//aus Generierungsgruenden hier keine einheitliche Bezeichnung moeglich.
	dword thisval; // Display3AdditionalInfo2_1
	bitval= getValue(this);
	thisval = getValue(A_ASG_69_0_0_27_Data_18_SetGet);
	thisval = thisval&~(1<<27)|(bitval<<27);
	putValue(A_ASG_69_0_0_27_Data_18_SetGet,thisval);
}

on envVar A_ASG_69_0_0_27_Data_18_SetGet_28
{
	byte bitval;
	//thisval steht hier fuer den bitfield-wert, 
	//aus Generierungsgruenden hier keine einheitliche Bezeichnung moeglich.
	dword thisval; // Display3AdditionalInfo2_1
	bitval= getValue(this);
	thisval = getValue(A_ASG_69_0_0_27_Data_18_SetGet);
	thisval = thisval&~(1<<28)|(bitval<<28);
	putValue(A_ASG_69_0_0_27_Data_18_SetGet,thisval);
}

on envVar A_ASG_69_0_0_27_Data_18_SetGet_29
{
	byte bitval;
	//thisval steht hier fuer den bitfield-wert, 
	//aus Generierungsgruenden hier keine einheitliche Bezeichnung moeglich.
	dword thisval; // Display3AdditionalInfo2_1
	bitval= getValue(this);
	thisval = getValue(A_ASG_69_0_0_27_Data_18_SetGet);
	thisval = thisval&~(1<<29)|(bitval<<29);
	putValue(A_ASG_69_0_0_27_Data_18_SetGet,thisval);
}

on envVar A_ASG_69_0_0_27_Data_18_SetGet_30
{
	byte bitval;
	//thisval steht hier fuer den bitfield-wert, 
	//aus Generierungsgruenden hier keine einheitliche Bezeichnung moeglich.
	dword thisval; // Display3AdditionalInfo2_1
	bitval= getValue(this);
	thisval = getValue(A_ASG_69_0_0_27_Data_18_SetGet);
	thisval = thisval&~(1<<30)|(bitval<<30);
	putValue(A_ASG_69_0_0_27_Data_18_SetGet,thisval);
}

on envVar A_ASG_69_0_0_27_Data_18_SetGet_31
{
	byte bitval;
	//thisval steht hier fuer den bitfield-wert, 
	//aus Generierungsgruenden hier keine einheitliche Bezeichnung moeglich.
	dword thisval; // Display3AdditionalInfo2_1
	bitval= getValue(this);
	thisval = getValue(A_ASG_69_0_0_27_Data_18_SetGet);
	thisval = thisval&~(1<<31)|(bitval<<31);
	putValue(A_ASG_69_0_0_27_Data_18_SetGet,thisval);
}

on envVar A_ASG_69_0_0_27_Data_18_SetGet
{
	byte superval[664];

	//Update Childvalue (BitField)
	byte mask=0x01;
	int i = 0;
	dword thisval; // Display3AdditionalInfo2_1
	thisval = getValue(this);
	if(thisval&(mask<<0))
		putValue(A_ASG_69_0_0_27_Data_18_SetGet_0, 1);
	else
		putValue(A_ASG_69_0_0_27_Data_18_SetGet_0, 0);
	if(thisval&(mask<<1))
		putValue(A_ASG_69_0_0_27_Data_18_SetGet_1, 1);
	else
		putValue(A_ASG_69_0_0_27_Data_18_SetGet_1, 0);
	if(thisval&(mask<<2))
		putValue(A_ASG_69_0_0_27_Data_18_SetGet_2, 1);
	else
		putValue(A_ASG_69_0_0_27_Data_18_SetGet_2, 0);
	if(thisval&(mask<<3))
		putValue(A_ASG_69_0_0_27_Data_18_SetGet_3, 1);
	else
		putValue(A_ASG_69_0_0_27_Data_18_SetGet_3, 0);
	if(thisval&(mask<<4))
		putValue(A_ASG_69_0_0_27_Data_18_SetGet_4, 1);
	else
		putValue(A_ASG_69_0_0_27_Data_18_SetGet_4, 0);
	if(thisval&(mask<<5))
		putValue(A_ASG_69_0_0_27_Data_18_SetGet_5, 1);
	else
		putValue(A_ASG_69_0_0_27_Data_18_SetGet_5, 0);
	if(thisval&(mask<<6))
		putValue(A_ASG_69_0_0_27_Data_18_SetGet_6, 1);
	else
		putValue(A_ASG_69_0_0_27_Data_18_SetGet_6, 0);
	if(thisval&(mask<<7))
		putValue(A_ASG_69_0_0_27_Data_18_SetGet_7, 1);
	else
		putValue(A_ASG_69_0_0_27_Data_18_SetGet_7, 0);
	if(thisval&(mask<<8))
		putValue(A_ASG_69_0_0_27_Data_18_SetGet_8, 1);
	else
		putValue(A_ASG_69_0_0_27_Data_18_SetGet_8, 0);
	if(thisval&(mask<<9))
		putValue(A_ASG_69_0_0_27_Data_18_SetGet_9, 1);
	else
		putValue(A_ASG_69_0_0_27_Data_18_SetGet_9, 0);
	if(thisval&(mask<<10))
		putValue(A_ASG_69_0_0_27_Data_18_SetGet_10, 1);
	else
		putValue(A_ASG_69_0_0_27_Data_18_SetGet_10, 0);
	if(thisval&(mask<<11))
		putValue(A_ASG_69_0_0_27_Data_18_SetGet_11, 1);
	else
		putValue(A_ASG_69_0_0_27_Data_18_SetGet_11, 0);
	if(thisval&(mask<<12))
		putValue(A_ASG_69_0_0_27_Data_18_SetGet_12, 1);
	else
		putValue(A_ASG_69_0_0_27_Data_18_SetGet_12, 0);
	if(thisval&(mask<<13))
		putValue(A_ASG_69_0_0_27_Data_18_SetGet_13, 1);
	else
		putValue(A_ASG_69_0_0_27_Data_18_SetGet_13, 0);
	if(thisval&(mask<<14))
		putValue(A_ASG_69_0_0_27_Data_18_SetGet_14, 1);
	else
		putValue(A_ASG_69_0_0_27_Data_18_SetGet_14, 0);
	if(thisval&(mask<<15))
		putValue(A_ASG_69_0_0_27_Data_18_SetGet_15, 1);
	else
		putValue(A_ASG_69_0_0_27_Data_18_SetGet_15, 0);
	if(thisval&(mask<<16))
		putValue(A_ASG_69_0_0_27_Data_18_SetGet_16, 1);
	else
		putValue(A_ASG_69_0_0_27_Data_18_SetGet_16, 0);
	if(thisval&(mask<<17))
		putValue(A_ASG_69_0_0_27_Data_18_SetGet_17, 1);
	else
		putValue(A_ASG_69_0_0_27_Data_18_SetGet_17, 0);
	if(thisval&(mask<<18))
		putValue(A_ASG_69_0_0_27_Data_18_SetGet_18, 1);
	else
		putValue(A_ASG_69_0_0_27_Data_18_SetGet_18, 0);
	if(thisval&(mask<<19))
		putValue(A_ASG_69_0_0_27_Data_18_SetGet_19, 1);
	else
		putValue(A_ASG_69_0_0_27_Data_18_SetGet_19, 0);
	if(thisval&(mask<<20))
		putValue(A_ASG_69_0_0_27_Data_18_SetGet_20, 1);
	else
		putValue(A_ASG_69_0_0_27_Data_18_SetGet_20, 0);
	if(thisval&(mask<<21))
		putValue(A_ASG_69_0_0_27_Data_18_SetGet_21, 1);
	else
		putValue(A_ASG_69_0_0_27_Data_18_SetGet_21, 0);
	if(thisval&(mask<<22))
		putValue(A_ASG_69_0_0_27_Data_18_SetGet_22, 1);
	else
		putValue(A_ASG_69_0_0_27_Data_18_SetGet_22, 0);
	if(thisval&(mask<<23))
		putValue(A_ASG_69_0_0_27_Data_18_SetGet_23, 1);
	else
		putValue(A_ASG_69_0_0_27_Data_18_SetGet_23, 0);
	if(thisval&(mask<<24))
		putValue(A_ASG_69_0_0_27_Data_18_SetGet_24, 1);
	else
		putValue(A_ASG_69_0_0_27_Data_18_SetGet_24, 0);
	if(thisval&(mask<<25))
		putValue(A_ASG_69_0_0_27_Data_18_SetGet_25, 1);
	else
		putValue(A_ASG_69_0_0_27_Data_18_SetGet_25, 0);
	if(thisval&(mask<<26))
		putValue(A_ASG_69_0_0_27_Data_18_SetGet_26, 1);
	else
		putValue(A_ASG_69_0_0_27_Data_18_SetGet_26, 0);
	if(thisval&(mask<<27))
		putValue(A_ASG_69_0_0_27_Data_18_SetGet_27, 1);
	else
		putValue(A_ASG_69_0_0_27_Data_18_SetGet_27, 0);
	if(thisval&(mask<<28))
		putValue(A_ASG_69_0_0_27_Data_18_SetGet_28, 1);
	else
		putValue(A_ASG_69_0_0_27_Data_18_SetGet_28, 0);
	if(thisval&(mask<<29))
		putValue(A_ASG_69_0_0_27_Data_18_SetGet_29, 1);
	else
		putValue(A_ASG_69_0_0_27_Data_18_SetGet_29, 0);
	if(thisval&(mask<<30))
		putValue(A_ASG_69_0_0_27_Data_18_SetGet_30, 1);
	else
		putValue(A_ASG_69_0_0_27_Data_18_SetGet_30, 0);
	if(thisval&(mask<<31))
		putValue(A_ASG_69_0_0_27_Data_18_SetGet_31, 1);
	else
		putValue(A_ASG_69_0_0_27_Data_18_SetGet_31, 0);
    A_ASG_69_0_0_27_ArrayDataList[getValue(A_ASG_69_0_0_27_DataIndex_SetGet)].Param18 = thisval;
}
on envVar A_ASG_69_0_0_27_Data_19_SetGet_0
{
	byte bitval;
	//thisval steht hier fuer den bitfield-wert, 
	//aus Generierungsgruenden hier keine einheitliche Bezeichnung moeglich.
	dword thisval; // Display3AdditionalInfo2_2
	bitval= getValue(this);
	thisval = getValue(A_ASG_69_0_0_27_Data_19_SetGet);
	thisval = thisval&~(1<<0)|(bitval<<0);
	putValue(A_ASG_69_0_0_27_Data_19_SetGet,thisval);
}

on envVar A_ASG_69_0_0_27_Data_19_SetGet_1
{
	byte bitval;
	//thisval steht hier fuer den bitfield-wert, 
	//aus Generierungsgruenden hier keine einheitliche Bezeichnung moeglich.
	dword thisval; // Display3AdditionalInfo2_2
	bitval= getValue(this);
	thisval = getValue(A_ASG_69_0_0_27_Data_19_SetGet);
	thisval = thisval&~(1<<1)|(bitval<<1);
	putValue(A_ASG_69_0_0_27_Data_19_SetGet,thisval);
}

on envVar A_ASG_69_0_0_27_Data_19_SetGet_2
{
	byte bitval;
	//thisval steht hier fuer den bitfield-wert, 
	//aus Generierungsgruenden hier keine einheitliche Bezeichnung moeglich.
	dword thisval; // Display3AdditionalInfo2_2
	bitval= getValue(this);
	thisval = getValue(A_ASG_69_0_0_27_Data_19_SetGet);
	thisval = thisval&~(1<<2)|(bitval<<2);
	putValue(A_ASG_69_0_0_27_Data_19_SetGet,thisval);
}

on envVar A_ASG_69_0_0_27_Data_19_SetGet_3
{
	byte bitval;
	//thisval steht hier fuer den bitfield-wert, 
	//aus Generierungsgruenden hier keine einheitliche Bezeichnung moeglich.
	dword thisval; // Display3AdditionalInfo2_2
	bitval= getValue(this);
	thisval = getValue(A_ASG_69_0_0_27_Data_19_SetGet);
	thisval = thisval&~(1<<3)|(bitval<<3);
	putValue(A_ASG_69_0_0_27_Data_19_SetGet,thisval);
}

on envVar A_ASG_69_0_0_27_Data_19_SetGet_4
{
	byte bitval;
	//thisval steht hier fuer den bitfield-wert, 
	//aus Generierungsgruenden hier keine einheitliche Bezeichnung moeglich.
	dword thisval; // Display3AdditionalInfo2_2
	bitval= getValue(this);
	thisval = getValue(A_ASG_69_0_0_27_Data_19_SetGet);
	thisval = thisval&~(1<<4)|(bitval<<4);
	putValue(A_ASG_69_0_0_27_Data_19_SetGet,thisval);
}

on envVar A_ASG_69_0_0_27_Data_19_SetGet_5
{
	byte bitval;
	//thisval steht hier fuer den bitfield-wert, 
	//aus Generierungsgruenden hier keine einheitliche Bezeichnung moeglich.
	dword thisval; // Display3AdditionalInfo2_2
	bitval= getValue(this);
	thisval = getValue(A_ASG_69_0_0_27_Data_19_SetGet);
	thisval = thisval&~(1<<5)|(bitval<<5);
	putValue(A_ASG_69_0_0_27_Data_19_SetGet,thisval);
}

on envVar A_ASG_69_0_0_27_Data_19_SetGet_6
{
	byte bitval;
	//thisval steht hier fuer den bitfield-wert, 
	//aus Generierungsgruenden hier keine einheitliche Bezeichnung moeglich.
	dword thisval; // Display3AdditionalInfo2_2
	bitval= getValue(this);
	thisval = getValue(A_ASG_69_0_0_27_Data_19_SetGet);
	thisval = thisval&~(1<<6)|(bitval<<6);
	putValue(A_ASG_69_0_0_27_Data_19_SetGet,thisval);
}

on envVar A_ASG_69_0_0_27_Data_19_SetGet_7
{
	byte bitval;
	//thisval steht hier fuer den bitfield-wert, 
	//aus Generierungsgruenden hier keine einheitliche Bezeichnung moeglich.
	dword thisval; // Display3AdditionalInfo2_2
	bitval= getValue(this);
	thisval = getValue(A_ASG_69_0_0_27_Data_19_SetGet);
	thisval = thisval&~(1<<7)|(bitval<<7);
	putValue(A_ASG_69_0_0_27_Data_19_SetGet,thisval);
}

on envVar A_ASG_69_0_0_27_Data_19_SetGet_8
{
	byte bitval;
	//thisval steht hier fuer den bitfield-wert, 
	//aus Generierungsgruenden hier keine einheitliche Bezeichnung moeglich.
	dword thisval; // Display3AdditionalInfo2_2
	bitval= getValue(this);
	thisval = getValue(A_ASG_69_0_0_27_Data_19_SetGet);
	thisval = thisval&~(1<<8)|(bitval<<8);
	putValue(A_ASG_69_0_0_27_Data_19_SetGet,thisval);
}

on envVar A_ASG_69_0_0_27_Data_19_SetGet_9
{
	byte bitval;
	//thisval steht hier fuer den bitfield-wert, 
	//aus Generierungsgruenden hier keine einheitliche Bezeichnung moeglich.
	dword thisval; // Display3AdditionalInfo2_2
	bitval= getValue(this);
	thisval = getValue(A_ASG_69_0_0_27_Data_19_SetGet);
	thisval = thisval&~(1<<9)|(bitval<<9);
	putValue(A_ASG_69_0_0_27_Data_19_SetGet,thisval);
}

on envVar A_ASG_69_0_0_27_Data_19_SetGet_10
{
	byte bitval;
	//thisval steht hier fuer den bitfield-wert, 
	//aus Generierungsgruenden hier keine einheitliche Bezeichnung moeglich.
	dword thisval; // Display3AdditionalInfo2_2
	bitval= getValue(this);
	thisval = getValue(A_ASG_69_0_0_27_Data_19_SetGet);
	thisval = thisval&~(1<<10)|(bitval<<10);
	putValue(A_ASG_69_0_0_27_Data_19_SetGet,thisval);
}

on envVar A_ASG_69_0_0_27_Data_19_SetGet_11
{
	byte bitval;
	//thisval steht hier fuer den bitfield-wert, 
	//aus Generierungsgruenden hier keine einheitliche Bezeichnung moeglich.
	dword thisval; // Display3AdditionalInfo2_2
	bitval= getValue(this);
	thisval = getValue(A_ASG_69_0_0_27_Data_19_SetGet);
	thisval = thisval&~(1<<11)|(bitval<<11);
	putValue(A_ASG_69_0_0_27_Data_19_SetGet,thisval);
}

on envVar A_ASG_69_0_0_27_Data_19_SetGet_12
{
	byte bitval;
	//thisval steht hier fuer den bitfield-wert, 
	//aus Generierungsgruenden hier keine einheitliche Bezeichnung moeglich.
	dword thisval; // Display3AdditionalInfo2_2
	bitval= getValue(this);
	thisval = getValue(A_ASG_69_0_0_27_Data_19_SetGet);
	thisval = thisval&~(1<<12)|(bitval<<12);
	putValue(A_ASG_69_0_0_27_Data_19_SetGet,thisval);
}

on envVar A_ASG_69_0_0_27_Data_19_SetGet_13
{
	byte bitval;
	//thisval steht hier fuer den bitfield-wert, 
	//aus Generierungsgruenden hier keine einheitliche Bezeichnung moeglich.
	dword thisval; // Display3AdditionalInfo2_2
	bitval= getValue(this);
	thisval = getValue(A_ASG_69_0_0_27_Data_19_SetGet);
	thisval = thisval&~(1<<13)|(bitval<<13);
	putValue(A_ASG_69_0_0_27_Data_19_SetGet,thisval);
}

on envVar A_ASG_69_0_0_27_Data_19_SetGet_14
{
	byte bitval;
	//thisval steht hier fuer den bitfield-wert, 
	//aus Generierungsgruenden hier keine einheitliche Bezeichnung moeglich.
	dword thisval; // Display3AdditionalInfo2_2
	bitval= getValue(this);
	thisval = getValue(A_ASG_69_0_0_27_Data_19_SetGet);
	thisval = thisval&~(1<<14)|(bitval<<14);
	putValue(A_ASG_69_0_0_27_Data_19_SetGet,thisval);
}

on envVar A_ASG_69_0_0_27_Data_19_SetGet_15
{
	byte bitval;
	//thisval steht hier fuer den bitfield-wert, 
	//aus Generierungsgruenden hier keine einheitliche Bezeichnung moeglich.
	dword thisval; // Display3AdditionalInfo2_2
	bitval= getValue(this);
	thisval = getValue(A_ASG_69_0_0_27_Data_19_SetGet);
	thisval = thisval&~(1<<15)|(bitval<<15);
	putValue(A_ASG_69_0_0_27_Data_19_SetGet,thisval);
}

on envVar A_ASG_69_0_0_27_Data_19_SetGet_16
{
	byte bitval;
	//thisval steht hier fuer den bitfield-wert, 
	//aus Generierungsgruenden hier keine einheitliche Bezeichnung moeglich.
	dword thisval; // Display3AdditionalInfo2_2
	bitval= getValue(this);
	thisval = getValue(A_ASG_69_0_0_27_Data_19_SetGet);
	thisval = thisval&~(1<<16)|(bitval<<16);
	putValue(A_ASG_69_0_0_27_Data_19_SetGet,thisval);
}

on envVar A_ASG_69_0_0_27_Data_19_SetGet_17
{
	byte bitval;
	//thisval steht hier fuer den bitfield-wert, 
	//aus Generierungsgruenden hier keine einheitliche Bezeichnung moeglich.
	dword thisval; // Display3AdditionalInfo2_2
	bitval= getValue(this);
	thisval = getValue(A_ASG_69_0_0_27_Data_19_SetGet);
	thisval = thisval&~(1<<17)|(bitval<<17);
	putValue(A_ASG_69_0_0_27_Data_19_SetGet,thisval);
}

on envVar A_ASG_69_0_0_27_Data_19_SetGet_18
{
	byte bitval;
	//thisval steht hier fuer den bitfield-wert, 
	//aus Generierungsgruenden hier keine einheitliche Bezeichnung moeglich.
	dword thisval; // Display3AdditionalInfo2_2
	bitval= getValue(this);
	thisval = getValue(A_ASG_69_0_0_27_Data_19_SetGet);
	thisval = thisval&~(1<<18)|(bitval<<18);
	putValue(A_ASG_69_0_0_27_Data_19_SetGet,thisval);
}

on envVar A_ASG_69_0_0_27_Data_19_SetGet_19
{
	byte bitval;
	//thisval steht hier fuer den bitfield-wert, 
	//aus Generierungsgruenden hier keine einheitliche Bezeichnung moeglich.
	dword thisval; // Display3AdditionalInfo2_2
	bitval= getValue(this);
	thisval = getValue(A_ASG_69_0_0_27_Data_19_SetGet);
	thisval = thisval&~(1<<19)|(bitval<<19);
	putValue(A_ASG_69_0_0_27_Data_19_SetGet,thisval);
}

on envVar A_ASG_69_0_0_27_Data_19_SetGet_20
{
	byte bitval;
	//thisval steht hier fuer den bitfield-wert, 
	//aus Generierungsgruenden hier keine einheitliche Bezeichnung moeglich.
	dword thisval; // Display3AdditionalInfo2_2
	bitval= getValue(this);
	thisval = getValue(A_ASG_69_0_0_27_Data_19_SetGet);
	thisval = thisval&~(1<<20)|(bitval<<20);
	putValue(A_ASG_69_0_0_27_Data_19_SetGet,thisval);
}

on envVar A_ASG_69_0_0_27_Data_19_SetGet_21
{
	byte bitval;
	//thisval steht hier fuer den bitfield-wert, 
	//aus Generierungsgruenden hier keine einheitliche Bezeichnung moeglich.
	dword thisval; // Display3AdditionalInfo2_2
	bitval= getValue(this);
	thisval = getValue(A_ASG_69_0_0_27_Data_19_SetGet);
	thisval = thisval&~(1<<21)|(bitval<<21);
	putValue(A_ASG_69_0_0_27_Data_19_SetGet,thisval);
}

on envVar A_ASG_69_0_0_27_Data_19_SetGet_22
{
	byte bitval;
	//thisval steht hier fuer den bitfield-wert, 
	//aus Generierungsgruenden hier keine einheitliche Bezeichnung moeglich.
	dword thisval; // Display3AdditionalInfo2_2
	bitval= getValue(this);
	thisval = getValue(A_ASG_69_0_0_27_Data_19_SetGet);
	thisval = thisval&~(1<<22)|(bitval<<22);
	putValue(A_ASG_69_0_0_27_Data_19_SetGet,thisval);
}

on envVar A_ASG_69_0_0_27_Data_19_SetGet_23
{
	byte bitval;
	//thisval steht hier fuer den bitfield-wert, 
	//aus Generierungsgruenden hier keine einheitliche Bezeichnung moeglich.
	dword thisval; // Display3AdditionalInfo2_2
	bitval= getValue(this);
	thisval = getValue(A_ASG_69_0_0_27_Data_19_SetGet);
	thisval = thisval&~(1<<23)|(bitval<<23);
	putValue(A_ASG_69_0_0_27_Data_19_SetGet,thisval);
}

on envVar A_ASG_69_0_0_27_Data_19_SetGet_24
{
	byte bitval;
	//thisval steht hier fuer den bitfield-wert, 
	//aus Generierungsgruenden hier keine einheitliche Bezeichnung moeglich.
	dword thisval; // Display3AdditionalInfo2_2
	bitval= getValue(this);
	thisval = getValue(A_ASG_69_0_0_27_Data_19_SetGet);
	thisval = thisval&~(1<<24)|(bitval<<24);
	putValue(A_ASG_69_0_0_27_Data_19_SetGet,thisval);
}

on envVar A_ASG_69_0_0_27_Data_19_SetGet_25
{
	byte bitval;
	//thisval steht hier fuer den bitfield-wert, 
	//aus Generierungsgruenden hier keine einheitliche Bezeichnung moeglich.
	dword thisval; // Display3AdditionalInfo2_2
	bitval= getValue(this);
	thisval = getValue(A_ASG_69_0_0_27_Data_19_SetGet);
	thisval = thisval&~(1<<25)|(bitval<<25);
	putValue(A_ASG_69_0_0_27_Data_19_SetGet,thisval);
}

on envVar A_ASG_69_0_0_27_Data_19_SetGet_26
{
	byte bitval;
	//thisval steht hier fuer den bitfield-wert, 
	//aus Generierungsgruenden hier keine einheitliche Bezeichnung moeglich.
	dword thisval; // Display3AdditionalInfo2_2
	bitval= getValue(this);
	thisval = getValue(A_ASG_69_0_0_27_Data_19_SetGet);
	thisval = thisval&~(1<<26)|(bitval<<26);
	putValue(A_ASG_69_0_0_27_Data_19_SetGet,thisval);
}

on envVar A_ASG_69_0_0_27_Data_19_SetGet_27
{
	byte bitval;
	//thisval steht hier fuer den bitfield-wert, 
	//aus Generierungsgruenden hier keine einheitliche Bezeichnung moeglich.
	dword thisval; // Display3AdditionalInfo2_2
	bitval= getValue(this);
	thisval = getValue(A_ASG_69_0_0_27_Data_19_SetGet);
	thisval = thisval&~(1<<27)|(bitval<<27);
	putValue(A_ASG_69_0_0_27_Data_19_SetGet,thisval);
}

on envVar A_ASG_69_0_0_27_Data_19_SetGet_28
{
	byte bitval;
	//thisval steht hier fuer den bitfield-wert, 
	//aus Generierungsgruenden hier keine einheitliche Bezeichnung moeglich.
	dword thisval; // Display3AdditionalInfo2_2
	bitval= getValue(this);
	thisval = getValue(A_ASG_69_0_0_27_Data_19_SetGet);
	thisval = thisval&~(1<<28)|(bitval<<28);
	putValue(A_ASG_69_0_0_27_Data_19_SetGet,thisval);
}

on envVar A_ASG_69_0_0_27_Data_19_SetGet_29
{
	byte bitval;
	//thisval steht hier fuer den bitfield-wert, 
	//aus Generierungsgruenden hier keine einheitliche Bezeichnung moeglich.
	dword thisval; // Display3AdditionalInfo2_2
	bitval= getValue(this);
	thisval = getValue(A_ASG_69_0_0_27_Data_19_SetGet);
	thisval = thisval&~(1<<29)|(bitval<<29);
	putValue(A_ASG_69_0_0_27_Data_19_SetGet,thisval);
}

on envVar A_ASG_69_0_0_27_Data_19_SetGet
{
	byte superval[664];

	//Update Childvalue (BitField)
	byte mask=0x01;
	int i = 0;
	dword thisval; // Display3AdditionalInfo2_2
	thisval = getValue(this);
	if(thisval&(mask<<0))
		putValue(A_ASG_69_0_0_27_Data_19_SetGet_0, 1);
	else
		putValue(A_ASG_69_0_0_27_Data_19_SetGet_0, 0);
	if(thisval&(mask<<1))
		putValue(A_ASG_69_0_0_27_Data_19_SetGet_1, 1);
	else
		putValue(A_ASG_69_0_0_27_Data_19_SetGet_1, 0);
	if(thisval&(mask<<2))
		putValue(A_ASG_69_0_0_27_Data_19_SetGet_2, 1);
	else
		putValue(A_ASG_69_0_0_27_Data_19_SetGet_2, 0);
	if(thisval&(mask<<3))
		putValue(A_ASG_69_0_0_27_Data_19_SetGet_3, 1);
	else
		putValue(A_ASG_69_0_0_27_Data_19_SetGet_3, 0);
	if(thisval&(mask<<4))
		putValue(A_ASG_69_0_0_27_Data_19_SetGet_4, 1);
	else
		putValue(A_ASG_69_0_0_27_Data_19_SetGet_4, 0);
	if(thisval&(mask<<5))
		putValue(A_ASG_69_0_0_27_Data_19_SetGet_5, 1);
	else
		putValue(A_ASG_69_0_0_27_Data_19_SetGet_5, 0);
	if(thisval&(mask<<6))
		putValue(A_ASG_69_0_0_27_Data_19_SetGet_6, 1);
	else
		putValue(A_ASG_69_0_0_27_Data_19_SetGet_6, 0);
	if(thisval&(mask<<7))
		putValue(A_ASG_69_0_0_27_Data_19_SetGet_7, 1);
	else
		putValue(A_ASG_69_0_0_27_Data_19_SetGet_7, 0);
	if(thisval&(mask<<8))
		putValue(A_ASG_69_0_0_27_Data_19_SetGet_8, 1);
	else
		putValue(A_ASG_69_0_0_27_Data_19_SetGet_8, 0);
	if(thisval&(mask<<9))
		putValue(A_ASG_69_0_0_27_Data_19_SetGet_9, 1);
	else
		putValue(A_ASG_69_0_0_27_Data_19_SetGet_9, 0);
	if(thisval&(mask<<10))
		putValue(A_ASG_69_0_0_27_Data_19_SetGet_10, 1);
	else
		putValue(A_ASG_69_0_0_27_Data_19_SetGet_10, 0);
	if(thisval&(mask<<11))
		putValue(A_ASG_69_0_0_27_Data_19_SetGet_11, 1);
	else
		putValue(A_ASG_69_0_0_27_Data_19_SetGet_11, 0);
	if(thisval&(mask<<12))
		putValue(A_ASG_69_0_0_27_Data_19_SetGet_12, 1);
	else
		putValue(A_ASG_69_0_0_27_Data_19_SetGet_12, 0);
	if(thisval&(mask<<13))
		putValue(A_ASG_69_0_0_27_Data_19_SetGet_13, 1);
	else
		putValue(A_ASG_69_0_0_27_Data_19_SetGet_13, 0);
	if(thisval&(mask<<14))
		putValue(A_ASG_69_0_0_27_Data_19_SetGet_14, 1);
	else
		putValue(A_ASG_69_0_0_27_Data_19_SetGet_14, 0);
	if(thisval&(mask<<15))
		putValue(A_ASG_69_0_0_27_Data_19_SetGet_15, 1);
	else
		putValue(A_ASG_69_0_0_27_Data_19_SetGet_15, 0);
	if(thisval&(mask<<16))
		putValue(A_ASG_69_0_0_27_Data_19_SetGet_16, 1);
	else
		putValue(A_ASG_69_0_0_27_Data_19_SetGet_16, 0);
	if(thisval&(mask<<17))
		putValue(A_ASG_69_0_0_27_Data_19_SetGet_17, 1);
	else
		putValue(A_ASG_69_0_0_27_Data_19_SetGet_17, 0);
	if(thisval&(mask<<18))
		putValue(A_ASG_69_0_0_27_Data_19_SetGet_18, 1);
	else
		putValue(A_ASG_69_0_0_27_Data_19_SetGet_18, 0);
	if(thisval&(mask<<19))
		putValue(A_ASG_69_0_0_27_Data_19_SetGet_19, 1);
	else
		putValue(A_ASG_69_0_0_27_Data_19_SetGet_19, 0);
	if(thisval&(mask<<20))
		putValue(A_ASG_69_0_0_27_Data_19_SetGet_20, 1);
	else
		putValue(A_ASG_69_0_0_27_Data_19_SetGet_20, 0);
	if(thisval&(mask<<21))
		putValue(A_ASG_69_0_0_27_Data_19_SetGet_21, 1);
	else
		putValue(A_ASG_69_0_0_27_Data_19_SetGet_21, 0);
	if(thisval&(mask<<22))
		putValue(A_ASG_69_0_0_27_Data_19_SetGet_22, 1);
	else
		putValue(A_ASG_69_0_0_27_Data_19_SetGet_22, 0);
	if(thisval&(mask<<23))
		putValue(A_ASG_69_0_0_27_Data_19_SetGet_23, 1);
	else
		putValue(A_ASG_69_0_0_27_Data_19_SetGet_23, 0);
	if(thisval&(mask<<24))
		putValue(A_ASG_69_0_0_27_Data_19_SetGet_24, 1);
	else
		putValue(A_ASG_69_0_0_27_Data_19_SetGet_24, 0);
	if(thisval&(mask<<25))
		putValue(A_ASG_69_0_0_27_Data_19_SetGet_25, 1);
	else
		putValue(A_ASG_69_0_0_27_Data_19_SetGet_25, 0);
	if(thisval&(mask<<26))
		putValue(A_ASG_69_0_0_27_Data_19_SetGet_26, 1);
	else
		putValue(A_ASG_69_0_0_27_Data_19_SetGet_26, 0);
	if(thisval&(mask<<27))
		putValue(A_ASG_69_0_0_27_Data_19_SetGet_27, 1);
	else
		putValue(A_ASG_69_0_0_27_Data_19_SetGet_27, 0);
	if(thisval&(mask<<28))
		putValue(A_ASG_69_0_0_27_Data_19_SetGet_28, 1);
	else
		putValue(A_ASG_69_0_0_27_Data_19_SetGet_28, 0);
	if(thisval&(mask<<29))
		putValue(A_ASG_69_0_0_27_Data_19_SetGet_29, 1);
	else
		putValue(A_ASG_69_0_0_27_Data_19_SetGet_29, 0);
    A_ASG_69_0_0_27_ArrayDataList[getValue(A_ASG_69_0_0_27_DataIndex_SetGet)].Param19 = thisval;
}

// Ueberwachung der CheckBox fuer String
on envVar  A_ASG_69_0_0_27_Data_20_SetGet_cnt
{
	word len;
	byte cnt;
	len = getValue(A_ASG_69_0_0_27_Data_20_SetGet_len);
	cnt = getValue(this);

    /* Cnt Wert im Array aktualisieren */
	 A_ASG_69_0_0_27_Data_20_SetGet_CntList[ getValue(A_ASG_69_0_0_27_DataIndex_SetGet) ] = cnt;

	/* wird nur gerufen, wenn check box deaktiviert mit Length>127*/ 
	if(cnt == 0) 
	{
		if(len > 127 )
		{
			putValue(A_ASG_69_0_0_27_Data_20_SetGet_len, 127);
		}
	}

}


on envVar A_ASG_69_0_0_27_Data_20_SetGet_len
{
	long thisval;
	byte cnt;
	thisval = getValue(this);
	cnt = getValue(A_ASG_69_0_0_27_Data_20_SetGet_cnt);

	/* wenn die Laenge ausserhalb des erlaubten Bereich liegt, wird diese begrenzt */
	if(thisval > 1 || thisval < 0 )
	{
		writelineEx(gBAP_Trace, 0, "Eingegebene Laenge: %d von A_ASG_69_0_0_27_Data_20_SetGet ist ungueltig. Die max. erlaubte Laenge ist %d. ", thisval, 1);
		thisval = 1;
	}
	if( thisval >127)
	{
		putValue(A_ASG_69_0_0_27_Data_20_SetGet_cnt, 1); /* Switch checkbox on */
	}

	A_ASG_69_0_0_27_ArrayDataList[getValue(A_ASG_69_0_0_27_DataIndex_SetGet)].Param20_Length = thisval;
	A_ASG_69_0_0_27_Data_20_SetGet_LenList[ getValue(A_ASG_69_0_0_27_DataIndex_SetGet) ] = thisval;
	putValue(A_ASG_69_0_0_27_Data_20_SetGet_len, thisval);

}

on envVar A_ASG_69_0_0_27_Data_20_SetGet
{
	byte superval[664];

	//Update Childvalue (String)
	word i;
	byte thisval[2];
	getValue(this, thisval);
    for(i = 0; i < getValueSize(this); i++)
        A_ASG_69_0_0_27_ArrayDataList[getValue(A_ASG_69_0_0_27_DataIndex_SetGet)].Param20[i] = thisval[i];
    A_ASG_69_0_0_27_ArrayDataList[getValue(A_ASG_69_0_0_27_DataIndex_SetGet)].Param20_Length = getValueSize(this);
    A_ASG_69_0_0_27_Data_20_SetGet_LenList[getValue(A_ASG_69_0_0_27_DataIndex_SetGet)]= getValueSize(this);
    putValue(A_ASG_69_0_0_27_Data_20_SetGet_len, getValueSize(this));
}
on envVar P_ASG_69_0_0_28Get_BTN
{
 if (P_ASG_69_0_0_28Get_BTN_already_pressed == 0)
  {
       putValue(P_ASG_69_0_0_28_ErrCode,0);
       SetControlBackColor(panel_name,"errField_P_ASG_69_0_0_28",MakeRGB(255,255,255));
       P_ASG_69_0_0_28Get_BTN_already_pressed = 1;
 }
 else
 {
       Request_Void(LSGID, P_ASG_69_0_0_28_ID, DataGet_REQ); 
       P_ASG_69_0_0_28Get_BTN_already_pressed = 0;
 }
}
on envVar P_ASG_69_0_0_28SetGet_BTN
{
	byte BAPTemp[4];
    if (P_ASG_69_0_0_28SetGet_BTN_already_pressed == 0)
    {
       putValue(P_ASG_69_0_0_28_ErrCode,0);
       SetControlBackColor(panel_name,"errField_P_ASG_69_0_0_28",MakeRGB(255,255,255));
       P_ASG_69_0_0_28SetGet_BTN_already_pressed = 1;
    }
    else
    {
       getValue(P_ASG_69_0_0_28, BAPTemp);
       Request_ByteSequence(LSGID, P_ASG_69_0_0_28_ID, DataSetGet_REQ, BAPTemp, getValueSize(P_ASG_69_0_0_28));
       P_ASG_69_0_0_28SetGet_BTN_already_pressed = 0;
    }
}
on envVar P_ASG_69_0_0_28 // bus value of DisplayDependency (28).
{
	// opcodes: Error-Status
	byte param1; // Setup
	byte param2; // Extension1
	byte param3; // Extension2
	byte param4; // ModificationReason
	byte param5; // ModificationState
	// DATATYPE_BYTESEQUENCE / DATATYPE_FIXEDBYTESEQUENCE
	int i;
	byte superval[4];
	int currentPos;
	currentPos = 0;
	for( i = 0; i < 4; i++ ) {
		superval[i] = 0;
	}
	getValue(P_ASG_69_0_0_28, superval);
	///////// Start param1 - UINT8 /////////
	param1 = superval[currentPos++];
	putValue(P_ASG_69_0_0_28_1, param1);
	///////// Start param2 - UINT8 /////////
	param2 = superval[currentPos++];
	putValue(P_ASG_69_0_0_28_2, round((param2 * 1.0) - (0) + (0), 1.0));
	///////// Start param3 - UINT8 /////////
	param3 = superval[currentPos++];
	putValue(P_ASG_69_0_0_28_3, round((param3 * 1.0) - (0) + (0), 1.0));
	///////// Start param4 - NIBBLE /////////
	param4 = (superval[currentPos] & 0xf0)>>4;
	putValue(P_ASG_69_0_0_28_4, param4);
	///////// Start param5 - NIBBLE /////////
	param5 = superval[currentPos++] & 0x0f;
	putValue(P_ASG_69_0_0_28_5, param5);
}

on envVar P_ASG_69_0_0_28_1_0
{
	byte bitval;
	//thisval steht hier fuer den bitfield-wert, 
	//aus Generierungsgruenden hier keine einheitliche Bezeichnung moeglich.
	byte thisval; // Setup
	bitval= getValue(this);
	thisval = getValue(P_ASG_69_0_0_28_1);
	thisval = thisval&~(1<<0)|(bitval<<0);
	putValue(P_ASG_69_0_0_28_1,thisval);
}

on envVar P_ASG_69_0_0_28_1 // DisplayDependency.Setup
{
	byte superval[4];

	//Update Childvalue (BitField)
	byte mask=0x01;
	int i = 0;
	byte thisval; // Setup
	thisval = getValue(this);
	if(thisval&(mask<<0))
		putValue(P_ASG_69_0_0_28_1_0, 1);
	else
		putValue(P_ASG_69_0_0_28_1_0, 0);

    // Update superval
	getValue(P_ASG_69_0_0_28, superval);
	superval[0]=thisval;
	putValue(P_ASG_69_0_0_28,superval);
}

// Ueberwachung der Darstellungsvariable der Range.
on envVar P_ASG_69_0_0_28_2_range // DisplayDependency.Extension1 
{
	@P_ASG_69_0_0_28_2 = @P_ASG_69_0_0_28_2_range - (0); // slider = range - min
}

on envVar P_ASG_69_0_0_28_2 // DisplayDependency.Extension1
{
	byte superval[4];

	//Update Childvalue (Number)
	byte thisval; // Extension1
	float slider_value;

	slider_value = 0; // Konstanter Parameter.
	@P_ASG_69_0_0_28_2_range = slider_value + (0); // real value := slider value + range min.
	thisval = (byte)round((slider_value + (0) - (0)) / (1.0), 1); // bus value := (slider value + min - offset) / step.

    // Update superval
	getValue(P_ASG_69_0_0_28, superval);
	superval[1]=thisval;
	putValue(P_ASG_69_0_0_28,superval);
}

// Ueberwachung der Darstellungsvariable der Range.
on envVar P_ASG_69_0_0_28_3_range // DisplayDependency.Extension2 
{
	@P_ASG_69_0_0_28_3 = @P_ASG_69_0_0_28_3_range - (0); // slider = range - min
}

on envVar P_ASG_69_0_0_28_3 // DisplayDependency.Extension2
{
	byte superval[4];

	//Update Childvalue (Number)
	byte thisval; // Extension2
	float slider_value;

	slider_value = 0; // Konstanter Parameter.
	@P_ASG_69_0_0_28_3_range = slider_value + (0); // real value := slider value + range min.
	thisval = (byte)round((slider_value + (0) - (0)) / (1.0), 1); // bus value := (slider value + min - offset) / step.

    // Update superval
	getValue(P_ASG_69_0_0_28, superval);
	superval[2]=thisval;
	putValue(P_ASG_69_0_0_28,superval);
}

on envVar P_ASG_69_0_0_28_4 // DisplayDependency.ModificationReason
{
	byte superval[4];

	//Update Childvalue (Enum)
	byte thisval; // ModificationReason
	thisval = 0x0f & getValue(this);

    // Update superval
	getValue(P_ASG_69_0_0_28, superval);
	superval[3]= superval[3]&0x0f;
	superval[3]= superval[3]|(thisval<<4);
	putValue(P_ASG_69_0_0_28,superval);
}

on envVar P_ASG_69_0_0_28_5_0
{
	byte bitval;
	//thisval steht hier fuer den bitfield-wert, 
	//aus Generierungsgruenden hier keine einheitliche Bezeichnung moeglich.
	byte thisval; // ModificationState
	bitval= getValue(this);
	thisval = getValue(P_ASG_69_0_0_28_5);
	thisval = thisval&~(1<<0)|(bitval<<0);
	putValue(P_ASG_69_0_0_28_5,thisval);
}

on envVar P_ASG_69_0_0_28_5 // DisplayDependency.ModificationState
{
	byte superval[4];

	//Update Childvalue (BitField)
	byte mask=0x01;
	int i = 0;
	byte thisval; // ModificationState
	thisval = getValue(this);
	if(thisval&(mask<<0))
		putValue(P_ASG_69_0_0_28_5_0, 1);
	else
		putValue(P_ASG_69_0_0_28_5_0, 0);

    // Update superval
	getValue(P_ASG_69_0_0_28, superval);
	superval[3]= superval[3]&0xf0;
	superval[3]= superval[3]|thisval;
	putValue(P_ASG_69_0_0_28,superval);
}

on envVar P_ASG_69_0_0_29Get_BTN
{
 if (P_ASG_69_0_0_29Get_BTN_already_pressed == 0)
  {
       putValue(P_ASG_69_0_0_29_ErrCode,0);
       SetControlBackColor(panel_name,"errField_P_ASG_69_0_0_29",MakeRGB(255,255,255));
       P_ASG_69_0_0_29Get_BTN_already_pressed = 1;
 }
 else
 {
       Request_Void(LSGID, P_ASG_69_0_0_29_ID, DataGet_REQ); 
       P_ASG_69_0_0_29Get_BTN_already_pressed = 0;
 }
}
on envVar P_ASG_69_0_0_29SetGet_BTN
{
	byte BAPTemp[2];
    if (P_ASG_69_0_0_29SetGet_BTN_already_pressed == 0)
    {
       putValue(P_ASG_69_0_0_29_ErrCode,0);
       SetControlBackColor(panel_name,"errField_P_ASG_69_0_0_29",MakeRGB(255,255,255));
       P_ASG_69_0_0_29SetGet_BTN_already_pressed = 1;
    }
    else
    {
       getValue(P_ASG_69_0_0_29, BAPTemp);
       Request_ByteSequence(LSGID, P_ASG_69_0_0_29_ID, DataSetGet_REQ, BAPTemp, getValueSize(P_ASG_69_0_0_29));
       P_ASG_69_0_0_29SetGet_BTN_already_pressed = 0;
    }
}
on envVar P_ASG_69_0_0_29 // bus value of ActiveDisplayPreset (29).
{
	// opcodes: Error-Status
	byte param1; // PresetID
	byte param2; // ModificationReason
	byte param3; // ModificationState
	// DATATYPE_BYTESEQUENCE / DATATYPE_FIXEDBYTESEQUENCE
	int i;
	byte superval[2];
	int currentPos;
	currentPos = 0;
	for( i = 0; i < 2; i++ ) {
		superval[i] = 0;
	}
	getValue(P_ASG_69_0_0_29, superval);
	///////// Start param1 - UINT8 /////////
	param1 = superval[currentPos++];
	putValue(P_ASG_69_0_0_29_1, round((param1 * 1.0) - (0) + (0), 1.0));
	///////// Start param2 - NIBBLE /////////
	param2 = (superval[currentPos] & 0xf0)>>4;
	putValue(P_ASG_69_0_0_29_2, param2);
	///////// Start param3 - NIBBLE /////////
	param3 = superval[currentPos++] & 0x0f;
	putValue(P_ASG_69_0_0_29_3, param3);
}

// Ueberwachung der Darstellungsvariable der Range.
on envVar P_ASG_69_0_0_29_1_range // ActiveDisplayPreset.PresetID 
{
	@P_ASG_69_0_0_29_1 = @P_ASG_69_0_0_29_1_range - (0); // slider = range - min
}

on envVar P_ASG_69_0_0_29_1 // ActiveDisplayPreset.PresetID
{
	byte superval[2];

	//Update Childvalue (Number)
	byte thisval; // PresetID
	float slider_value;

	slider_value = round(@P_ASG_69_0_0_29_1, 1.0);
	@P_ASG_69_0_0_29_1_range = slider_value + (0); // real value := slider value + range min.
	thisval = (byte)round((slider_value + (0) - (0)) / (1.0), 1); // bus value := (slider value + min - offset) / step.

    // Update superval
	getValue(P_ASG_69_0_0_29, superval);
	superval[0]=thisval;
	putValue(P_ASG_69_0_0_29,superval);
}

on envVar P_ASG_69_0_0_29_2 // ActiveDisplayPreset.ModificationReason
{
	byte superval[2];

	//Update Childvalue (Enum)
	byte thisval; // ModificationReason
	thisval = 0x0f & getValue(this);

    // Update superval
	getValue(P_ASG_69_0_0_29, superval);
	superval[1]= superval[1]&0x0f;
	superval[1]= superval[1]|(thisval<<4);
	putValue(P_ASG_69_0_0_29,superval);
}

on envVar P_ASG_69_0_0_29_3_0
{
	byte bitval;
	//thisval steht hier fuer den bitfield-wert, 
	//aus Generierungsgruenden hier keine einheitliche Bezeichnung moeglich.
	byte thisval; // ModificationState
	bitval= getValue(this);
	thisval = getValue(P_ASG_69_0_0_29_3);
	thisval = thisval&~(1<<0)|(bitval<<0);
	putValue(P_ASG_69_0_0_29_3,thisval);
}

on envVar P_ASG_69_0_0_29_3 // ActiveDisplayPreset.ModificationState
{
	byte superval[2];

	//Update Childvalue (BitField)
	byte mask=0x01;
	int i = 0;
	byte thisval; // ModificationState
	thisval = getValue(this);
	if(thisval&(mask<<0))
		putValue(P_ASG_69_0_0_29_3_0, 1);
	else
		putValue(P_ASG_69_0_0_29_3_0, 0);

    // Update superval
	getValue(P_ASG_69_0_0_29, superval);
	superval[1]= superval[1]&0xf0;
	superval[1]= superval[1]|thisval;
	putValue(P_ASG_69_0_0_29,superval);
}

on envVar P_ASG_69_0_0_30Get_BTN
{
 if (P_ASG_69_0_0_30Get_BTN_already_pressed == 0)
  {
       putValue(P_ASG_69_0_0_30_ErrCode,0);
       SetControlBackColor(panel_name,"errField_P_ASG_69_0_0_30",MakeRGB(255,255,255));
       P_ASG_69_0_0_30Get_BTN_already_pressed = 1;
 }
 else
 {
       Request_Void(LSGID, P_ASG_69_0_0_30_ID, DataGet_REQ); 
       P_ASG_69_0_0_30Get_BTN_already_pressed = 0;
 }
}
on envVar P_ASG_69_0_0_30SetGet_BTN
{
	byte BAPTemp[4];
    if (P_ASG_69_0_0_30SetGet_BTN_already_pressed == 0)
    {
       putValue(P_ASG_69_0_0_30_ErrCode,0);
       SetControlBackColor(panel_name,"errField_P_ASG_69_0_0_30",MakeRGB(255,255,255));
       P_ASG_69_0_0_30SetGet_BTN_already_pressed = 1;
    }
    else
    {
       getValue(P_ASG_69_0_0_30, BAPTemp);
       Request_ByteSequence(LSGID, P_ASG_69_0_0_30_ID, DataSetGet_REQ, BAPTemp, getValueSize(P_ASG_69_0_0_30));
       P_ASG_69_0_0_30SetGet_BTN_already_pressed = 0;
    }
}
on envVar P_ASG_69_0_0_30 // bus value of DisplayViewConfiguration (30).
{
	// opcodes: Error-Status
	byte param1; // ActiveDisplayView
	byte param2; // Extension1
	byte param3; // Extension2
	byte param4; // ModificationReason
	byte param5; // ModificationState
	// DATATYPE_BYTESEQUENCE / DATATYPE_FIXEDBYTESEQUENCE
	int i;
	byte superval[4];
	int currentPos;
	currentPos = 0;
	for( i = 0; i < 4; i++ ) {
		superval[i] = 0;
	}
	getValue(P_ASG_69_0_0_30, superval);
	///////// Start param1 - UINT8 /////////
	param1 = superval[currentPos++];
	putValue(P_ASG_69_0_0_30_1, param1);
	///////// Start param2 - UINT8 /////////
	param2 = superval[currentPos++];
	putValue(P_ASG_69_0_0_30_2, round((param2 * 1.0) - (0) + (0), 1.0));
	///////// Start param3 - UINT8 /////////
	param3 = superval[currentPos++];
	putValue(P_ASG_69_0_0_30_3, round((param3 * 1.0) - (0) + (0), 1.0));
	///////// Start param4 - NIBBLE /////////
	param4 = (superval[currentPos] & 0xf0)>>4;
	putValue(P_ASG_69_0_0_30_4, param4);
	///////// Start param5 - NIBBLE /////////
	param5 = superval[currentPos++] & 0x0f;
	putValue(P_ASG_69_0_0_30_5, param5);
}

on envVar P_ASG_69_0_0_30_1 // DisplayViewConfiguration.ActiveDisplayView
{
	byte superval[4];

	//Update Childvalue (Enum)
	byte thisval; // ActiveDisplayView
	thisval = getValue(this);

    // Update superval
	getValue(P_ASG_69_0_0_30, superval);
	superval[0]=thisval;
	putValue(P_ASG_69_0_0_30,superval);
}

// Ueberwachung der Darstellungsvariable der Range.
on envVar P_ASG_69_0_0_30_2_range // DisplayViewConfiguration.Extension1 
{
	@P_ASG_69_0_0_30_2 = @P_ASG_69_0_0_30_2_range - (0); // slider = range - min
}

on envVar P_ASG_69_0_0_30_2 // DisplayViewConfiguration.Extension1
{
	byte superval[4];

	//Update Childvalue (Number)
	byte thisval; // Extension1
	float slider_value;

	slider_value = 0; // Konstanter Parameter.
	@P_ASG_69_0_0_30_2_range = slider_value + (0); // real value := slider value + range min.
	thisval = (byte)round((slider_value + (0) - (0)) / (1.0), 1); // bus value := (slider value + min - offset) / step.

    // Update superval
	getValue(P_ASG_69_0_0_30, superval);
	superval[1]=thisval;
	putValue(P_ASG_69_0_0_30,superval);
}

// Ueberwachung der Darstellungsvariable der Range.
on envVar P_ASG_69_0_0_30_3_range // DisplayViewConfiguration.Extension2 
{
	@P_ASG_69_0_0_30_3 = @P_ASG_69_0_0_30_3_range - (0); // slider = range - min
}

on envVar P_ASG_69_0_0_30_3 // DisplayViewConfiguration.Extension2
{
	byte superval[4];

	//Update Childvalue (Number)
	byte thisval; // Extension2
	float slider_value;

	slider_value = 0; // Konstanter Parameter.
	@P_ASG_69_0_0_30_3_range = slider_value + (0); // real value := slider value + range min.
	thisval = (byte)round((slider_value + (0) - (0)) / (1.0), 1); // bus value := (slider value + min - offset) / step.

    // Update superval
	getValue(P_ASG_69_0_0_30, superval);
	superval[2]=thisval;
	putValue(P_ASG_69_0_0_30,superval);
}

on envVar P_ASG_69_0_0_30_4 // DisplayViewConfiguration.ModificationReason
{
	byte superval[4];

	//Update Childvalue (Enum)
	byte thisval; // ModificationReason
	thisval = 0x0f & getValue(this);

    // Update superval
	getValue(P_ASG_69_0_0_30, superval);
	superval[3]= superval[3]&0x0f;
	superval[3]= superval[3]|(thisval<<4);
	putValue(P_ASG_69_0_0_30,superval);
}

on envVar P_ASG_69_0_0_30_5_0
{
	byte bitval;
	//thisval steht hier fuer den bitfield-wert, 
	//aus Generierungsgruenden hier keine einheitliche Bezeichnung moeglich.
	byte thisval; // ModificationState
	bitval= getValue(this);
	thisval = getValue(P_ASG_69_0_0_30_5);
	thisval = thisval&~(1<<0)|(bitval<<0);
	putValue(P_ASG_69_0_0_30_5,thisval);
}

on envVar P_ASG_69_0_0_30_5 // DisplayViewConfiguration.ModificationState
{
	byte superval[4];

	//Update Childvalue (BitField)
	byte mask=0x01;
	int i = 0;
	byte thisval; // ModificationState
	thisval = getValue(this);
	if(thisval&(mask<<0))
		putValue(P_ASG_69_0_0_30_5_0, 1);
	else
		putValue(P_ASG_69_0_0_30_5_0, 0);

    // Update superval
	getValue(P_ASG_69_0_0_30, superval);
	superval[3]= superval[3]&0xf0;
	superval[3]= superval[3]|thisval;
	putValue(P_ASG_69_0_0_30,superval);
}

on envVar P_ASG_69_0_0_31Get_BTN
{
 if (P_ASG_69_0_0_31Get_BTN_already_pressed == 0)
  {
       putValue(P_ASG_69_0_0_31_ErrCode,0);
       SetControlBackColor(panel_name,"errField_P_ASG_69_0_0_31",MakeRGB(255,255,255));
       P_ASG_69_0_0_31Get_BTN_already_pressed = 1;
 }
 else
 {
       Request_Void(LSGID, P_ASG_69_0_0_31_ID, DataGet_REQ); 
       P_ASG_69_0_0_31Get_BTN_already_pressed = 0;
 }
}
on envVar P_ASG_69_0_0_31SetGet_BTN
{
	byte BAPTemp[6];
    if (P_ASG_69_0_0_31SetGet_BTN_already_pressed == 0)
    {
       putValue(P_ASG_69_0_0_31_ErrCode,0);
       SetControlBackColor(panel_name,"errField_P_ASG_69_0_0_31",MakeRGB(255,255,255));
       P_ASG_69_0_0_31SetGet_BTN_already_pressed = 1;
    }
    else
    {
       getValue(P_ASG_69_0_0_31, BAPTemp);
       Request_ByteSequence(LSGID, P_ASG_69_0_0_31_ID, DataSetGet_REQ, BAPTemp, getValueSize(P_ASG_69_0_0_31));
       P_ASG_69_0_0_31SetGet_BTN_already_pressed = 0;
    }
}
on envVar P_ASG_69_0_0_31 // bus value of LED_Configuration (31).
{
	// opcodes: Error-Status
	byte param1; // State
	byte param2; // ModificationReason
	byte param3; // ModificationState
	byte param4; // Extension1
	byte param5; // Extension2
	byte param6; // Extension3
	byte param7; // Extension4
	// DATATYPE_BYTESEQUENCE / DATATYPE_FIXEDBYTESEQUENCE
	int i;
	byte superval[6];
	int currentPos;
	currentPos = 0;
	for( i = 0; i < 6; i++ ) {
		superval[i] = 0;
	}
	getValue(P_ASG_69_0_0_31, superval);
	///////// Start param1 - UINT8 /////////
	param1 = superval[currentPos++];
	putValue(P_ASG_69_0_0_31_1, param1);
	///////// Start param2 - NIBBLE /////////
	param2 = (superval[currentPos] & 0xf0)>>4;
	putValue(P_ASG_69_0_0_31_2, param2);
	///////// Start param3 - NIBBLE /////////
	param3 = superval[currentPos++] & 0x0f;
	putValue(P_ASG_69_0_0_31_3, param3);
	///////// Start param4 - UINT8 /////////
	param4 = superval[currentPos++];
	putValue(P_ASG_69_0_0_31_4, round((param4 * 1.0) - (0) + (0), 1.0));
	///////// Start param5 - UINT8 /////////
	param5 = superval[currentPos++];
	putValue(P_ASG_69_0_0_31_5, round((param5 * 1.0) - (0) + (0), 1.0));
	///////// Start param6 - UINT8 /////////
	param6 = superval[currentPos++];
	putValue(P_ASG_69_0_0_31_6, round((param6 * 1.0) - (0) + (0), 1.0));
	///////// Start param7 - UINT8 /////////
	param7 = superval[currentPos++];
	putValue(P_ASG_69_0_0_31_7, round((param7 * 1.0) - (0) + (0), 1.0));
}

on envVar P_ASG_69_0_0_31_1_0
{
	byte bitval;
	//thisval steht hier fuer den bitfield-wert, 
	//aus Generierungsgruenden hier keine einheitliche Bezeichnung moeglich.
	byte thisval; // State
	bitval= getValue(this);
	thisval = getValue(P_ASG_69_0_0_31_1);
	thisval = thisval&~(1<<0)|(bitval<<0);
	putValue(P_ASG_69_0_0_31_1,thisval);
}

on envVar P_ASG_69_0_0_31_1 // LED_Configuration.State
{
	byte superval[6];

	//Update Childvalue (BitField)
	byte mask=0x01;
	int i = 0;
	byte thisval; // State
	thisval = getValue(this);
	if(thisval&(mask<<0))
		putValue(P_ASG_69_0_0_31_1_0, 1);
	else
		putValue(P_ASG_69_0_0_31_1_0, 0);

    // Update superval
	getValue(P_ASG_69_0_0_31, superval);
	superval[0]=thisval;
	putValue(P_ASG_69_0_0_31,superval);
}

on envVar P_ASG_69_0_0_31_2 // LED_Configuration.ModificationReason
{
	byte superval[6];

	//Update Childvalue (Enum)
	byte thisval; // ModificationReason
	thisval = 0x0f & getValue(this);

    // Update superval
	getValue(P_ASG_69_0_0_31, superval);
	superval[1]= superval[1]&0x0f;
	superval[1]= superval[1]|(thisval<<4);
	putValue(P_ASG_69_0_0_31,superval);
}

on envVar P_ASG_69_0_0_31_3_0
{
	byte bitval;
	//thisval steht hier fuer den bitfield-wert, 
	//aus Generierungsgruenden hier keine einheitliche Bezeichnung moeglich.
	byte thisval; // ModificationState
	bitval= getValue(this);
	thisval = getValue(P_ASG_69_0_0_31_3);
	thisval = thisval&~(1<<0)|(bitval<<0);
	putValue(P_ASG_69_0_0_31_3,thisval);
}

on envVar P_ASG_69_0_0_31_3 // LED_Configuration.ModificationState
{
	byte superval[6];

	//Update Childvalue (BitField)
	byte mask=0x01;
	int i = 0;
	byte thisval; // ModificationState
	thisval = getValue(this);
	if(thisval&(mask<<0))
		putValue(P_ASG_69_0_0_31_3_0, 1);
	else
		putValue(P_ASG_69_0_0_31_3_0, 0);

    // Update superval
	getValue(P_ASG_69_0_0_31, superval);
	superval[1]= superval[1]&0xf0;
	superval[1]= superval[1]|thisval;
	putValue(P_ASG_69_0_0_31,superval);
}

// Ueberwachung der Darstellungsvariable der Range.
on envVar P_ASG_69_0_0_31_4_range // LED_Configuration.Extension1 
{
	@P_ASG_69_0_0_31_4 = @P_ASG_69_0_0_31_4_range - (0); // slider = range - min
}

on envVar P_ASG_69_0_0_31_4 // LED_Configuration.Extension1
{
	byte superval[6];

	//Update Childvalue (Number)
	byte thisval; // Extension1
	float slider_value;

	slider_value = 0; // Konstanter Parameter.
	@P_ASG_69_0_0_31_4_range = slider_value + (0); // real value := slider value + range min.
	thisval = (byte)round((slider_value + (0) - (0)) / (1.0), 1); // bus value := (slider value + min - offset) / step.

    // Update superval
	getValue(P_ASG_69_0_0_31, superval);
	superval[2]=thisval;
	putValue(P_ASG_69_0_0_31,superval);
}

// Ueberwachung der Darstellungsvariable der Range.
on envVar P_ASG_69_0_0_31_5_range // LED_Configuration.Extension2 
{
	@P_ASG_69_0_0_31_5 = @P_ASG_69_0_0_31_5_range - (0); // slider = range - min
}

on envVar P_ASG_69_0_0_31_5 // LED_Configuration.Extension2
{
	byte superval[6];

	//Update Childvalue (Number)
	byte thisval; // Extension2
	float slider_value;

	slider_value = 0; // Konstanter Parameter.
	@P_ASG_69_0_0_31_5_range = slider_value + (0); // real value := slider value + range min.
	thisval = (byte)round((slider_value + (0) - (0)) / (1.0), 1); // bus value := (slider value + min - offset) / step.

    // Update superval
	getValue(P_ASG_69_0_0_31, superval);
	superval[3]=thisval;
	putValue(P_ASG_69_0_0_31,superval);
}

// Ueberwachung der Darstellungsvariable der Range.
on envVar P_ASG_69_0_0_31_6_range // LED_Configuration.Extension3 
{
	@P_ASG_69_0_0_31_6 = @P_ASG_69_0_0_31_6_range - (0); // slider = range - min
}

on envVar P_ASG_69_0_0_31_6 // LED_Configuration.Extension3
{
	byte superval[6];

	//Update Childvalue (Number)
	byte thisval; // Extension3
	float slider_value;

	slider_value = 0; // Konstanter Parameter.
	@P_ASG_69_0_0_31_6_range = slider_value + (0); // real value := slider value + range min.
	thisval = (byte)round((slider_value + (0) - (0)) / (1.0), 1); // bus value := (slider value + min - offset) / step.

    // Update superval
	getValue(P_ASG_69_0_0_31, superval);
	superval[4]=thisval;
	putValue(P_ASG_69_0_0_31,superval);
}

// Ueberwachung der Darstellungsvariable der Range.
on envVar P_ASG_69_0_0_31_7_range // LED_Configuration.Extension4 
{
	@P_ASG_69_0_0_31_7 = @P_ASG_69_0_0_31_7_range - (0); // slider = range - min
}

on envVar P_ASG_69_0_0_31_7 // LED_Configuration.Extension4
{
	byte superval[6];

	//Update Childvalue (Number)
	byte thisval; // Extension4
	float slider_value;

	slider_value = 0; // Konstanter Parameter.
	@P_ASG_69_0_0_31_7_range = slider_value + (0); // real value := slider value + range min.
	thisval = (byte)round((slider_value + (0) - (0)) / (1.0), 1); // bus value := (slider value + min - offset) / step.

    // Update superval
	getValue(P_ASG_69_0_0_31, superval);
	superval[5]=thisval;
	putValue(P_ASG_69_0_0_31,superval);
}

on envVar P_ASG_69_0_0_32Get_BTN
{
 if (P_ASG_69_0_0_32Get_BTN_already_pressed == 0)
  {
       putValue(P_ASG_69_0_0_32_ErrCode,0);
       SetControlBackColor(panel_name,"errField_P_ASG_69_0_0_32",MakeRGB(255,255,255));
       P_ASG_69_0_0_32Get_BTN_already_pressed = 1;
 }
 else
 {
       Request_Void(LSGID, P_ASG_69_0_0_32_ID, DataGet_REQ); 
       P_ASG_69_0_0_32Get_BTN_already_pressed = 0;
 }
}
on envVar P_ASG_69_0_0_32SetGet_BTN
{
	byte BAPTemp[3];
    if (P_ASG_69_0_0_32SetGet_BTN_already_pressed == 0)
    {
       putValue(P_ASG_69_0_0_32_ErrCode,0);
       SetControlBackColor(panel_name,"errField_P_ASG_69_0_0_32",MakeRGB(255,255,255));
       P_ASG_69_0_0_32SetGet_BTN_already_pressed = 1;
    }
    else
    {
       getValue(P_ASG_69_0_0_32, BAPTemp);
       Request_ByteSequence(LSGID, P_ASG_69_0_0_32_ID, DataSetGet_REQ, BAPTemp, getValueSize(P_ASG_69_0_0_32));
       P_ASG_69_0_0_32SetGet_BTN_already_pressed = 0;
    }
}
on envVar P_ASG_69_0_0_32 // bus value of PopupSelection (32).
{
	// opcodes: Error-Status
	byte param1; // PopupSelection
	byte param2; // Extension1
	byte param3; // ModificationReason
	byte param4; // ModificationState
	// DATATYPE_BYTESEQUENCE / DATATYPE_FIXEDBYTESEQUENCE
	int i;
	byte superval[3];
	int currentPos;
	currentPos = 0;
	for( i = 0; i < 3; i++ ) {
		superval[i] = 0;
	}
	getValue(P_ASG_69_0_0_32, superval);
	///////// Start param1 - UINT8 /////////
	param1 = superval[currentPos++];
	putValue(P_ASG_69_0_0_32_1, param1);
	///////// Start param2 - UINT8 /////////
	param2 = superval[currentPos++];
	putValue(P_ASG_69_0_0_32_2, round((param2 * 1.0) - (0) + (0), 1.0));
	///////// Start param3 - NIBBLE /////////
	param3 = (superval[currentPos] & 0xf0)>>4;
	putValue(P_ASG_69_0_0_32_3, param3);
	///////// Start param4 - NIBBLE /////////
	param4 = superval[currentPos++] & 0x0f;
	putValue(P_ASG_69_0_0_32_4, param4);
}

on envVar P_ASG_69_0_0_32_1_0
{
	byte bitval;
	//thisval steht hier fuer den bitfield-wert, 
	//aus Generierungsgruenden hier keine einheitliche Bezeichnung moeglich.
	byte thisval; // PopupSelection
	bitval= getValue(this);
	thisval = getValue(P_ASG_69_0_0_32_1);
	thisval = thisval&~(1<<0)|(bitval<<0);
	putValue(P_ASG_69_0_0_32_1,thisval);
}

on envVar P_ASG_69_0_0_32_1_1
{
	byte bitval;
	//thisval steht hier fuer den bitfield-wert, 
	//aus Generierungsgruenden hier keine einheitliche Bezeichnung moeglich.
	byte thisval; // PopupSelection
	bitval= getValue(this);
	thisval = getValue(P_ASG_69_0_0_32_1);
	thisval = thisval&~(1<<1)|(bitval<<1);
	putValue(P_ASG_69_0_0_32_1,thisval);
}

on envVar P_ASG_69_0_0_32_1_2
{
	byte bitval;
	//thisval steht hier fuer den bitfield-wert, 
	//aus Generierungsgruenden hier keine einheitliche Bezeichnung moeglich.
	byte thisval; // PopupSelection
	bitval= getValue(this);
	thisval = getValue(P_ASG_69_0_0_32_1);
	thisval = thisval&~(1<<2)|(bitval<<2);
	putValue(P_ASG_69_0_0_32_1,thisval);
}

on envVar P_ASG_69_0_0_32_1_3
{
	byte bitval;
	//thisval steht hier fuer den bitfield-wert, 
	//aus Generierungsgruenden hier keine einheitliche Bezeichnung moeglich.
	byte thisval; // PopupSelection
	bitval= getValue(this);
	thisval = getValue(P_ASG_69_0_0_32_1);
	thisval = thisval&~(1<<3)|(bitval<<3);
	putValue(P_ASG_69_0_0_32_1,thisval);
}

on envVar P_ASG_69_0_0_32_1_4
{
	byte bitval;
	//thisval steht hier fuer den bitfield-wert, 
	//aus Generierungsgruenden hier keine einheitliche Bezeichnung moeglich.
	byte thisval; // PopupSelection
	bitval= getValue(this);
	thisval = getValue(P_ASG_69_0_0_32_1);
	thisval = thisval&~(1<<4)|(bitval<<4);
	putValue(P_ASG_69_0_0_32_1,thisval);
}

on envVar P_ASG_69_0_0_32_1 // PopupSelection.PopupSelection
{
	byte superval[3];

	//Update Childvalue (BitField)
	byte mask=0x01;
	int i = 0;
	byte thisval; // PopupSelection
	thisval = getValue(this);
	if(thisval&(mask<<0))
		putValue(P_ASG_69_0_0_32_1_0, 1);
	else
		putValue(P_ASG_69_0_0_32_1_0, 0);
	if(thisval&(mask<<1))
		putValue(P_ASG_69_0_0_32_1_1, 1);
	else
		putValue(P_ASG_69_0_0_32_1_1, 0);
	if(thisval&(mask<<2))
		putValue(P_ASG_69_0_0_32_1_2, 1);
	else
		putValue(P_ASG_69_0_0_32_1_2, 0);
	if(thisval&(mask<<3))
		putValue(P_ASG_69_0_0_32_1_3, 1);
	else
		putValue(P_ASG_69_0_0_32_1_3, 0);
	if(thisval&(mask<<4))
		putValue(P_ASG_69_0_0_32_1_4, 1);
	else
		putValue(P_ASG_69_0_0_32_1_4, 0);

    // Update superval
	getValue(P_ASG_69_0_0_32, superval);
	superval[0]=thisval;
	putValue(P_ASG_69_0_0_32,superval);
}

// Ueberwachung der Darstellungsvariable der Range.
on envVar P_ASG_69_0_0_32_2_range // PopupSelection.Extension1 
{
	@P_ASG_69_0_0_32_2 = @P_ASG_69_0_0_32_2_range - (0); // slider = range - min
}

on envVar P_ASG_69_0_0_32_2 // PopupSelection.Extension1
{
	byte superval[3];

	//Update Childvalue (Number)
	byte thisval; // Extension1
	float slider_value;

	slider_value = 0; // Konstanter Parameter.
	@P_ASG_69_0_0_32_2_range = slider_value + (0); // real value := slider value + range min.
	thisval = (byte)round((slider_value + (0) - (0)) / (1.0), 1); // bus value := (slider value + min - offset) / step.

    // Update superval
	getValue(P_ASG_69_0_0_32, superval);
	superval[1]=thisval;
	putValue(P_ASG_69_0_0_32,superval);
}

on envVar P_ASG_69_0_0_32_3 // PopupSelection.ModificationReason
{
	byte superval[3];

	//Update Childvalue (Enum)
	byte thisval; // ModificationReason
	thisval = 0x0f & getValue(this);

    // Update superval
	getValue(P_ASG_69_0_0_32, superval);
	superval[2]= superval[2]&0x0f;
	superval[2]= superval[2]|(thisval<<4);
	putValue(P_ASG_69_0_0_32,superval);
}

on envVar P_ASG_69_0_0_32_4_0
{
	byte bitval;
	//thisval steht hier fuer den bitfield-wert, 
	//aus Generierungsgruenden hier keine einheitliche Bezeichnung moeglich.
	byte thisval; // ModificationState
	bitval= getValue(this);
	thisval = getValue(P_ASG_69_0_0_32_4);
	thisval = thisval&~(1<<0)|(bitval<<0);
	putValue(P_ASG_69_0_0_32_4,thisval);
}

on envVar P_ASG_69_0_0_32_4 // PopupSelection.ModificationState
{
	byte superval[3];

	//Update Childvalue (BitField)
	byte mask=0x01;
	int i = 0;
	byte thisval; // ModificationState
	thisval = getValue(this);
	if(thisval&(mask<<0))
		putValue(P_ASG_69_0_0_32_4_0, 1);
	else
		putValue(P_ASG_69_0_0_32_4_0, 0);

    // Update superval
	getValue(P_ASG_69_0_0_32, superval);
	superval[2]= superval[2]&0xf0;
	superval[2]= superval[2]|thisval;
	putValue(P_ASG_69_0_0_32,superval);
}

on envVar P_ASG_69_0_0_33Get_BTN
{
 if (P_ASG_69_0_0_33Get_BTN_already_pressed == 0)
  {
       putValue(P_ASG_69_0_0_33_ErrCode,0);
       SetControlBackColor(panel_name,"errField_P_ASG_69_0_0_33",MakeRGB(255,255,255));
       P_ASG_69_0_0_33Get_BTN_already_pressed = 1;
 }
 else
 {
       Request_Void(LSGID, P_ASG_69_0_0_33_ID, DataGet_REQ); 
       P_ASG_69_0_0_33Get_BTN_already_pressed = 0;
 }
}
on envVar P_ASG_69_0_0_33SetGet_BTN
{
	byte BAPTemp[2];
    if (P_ASG_69_0_0_33SetGet_BTN_already_pressed == 0)
    {
       putValue(P_ASG_69_0_0_33_ErrCode,0);
       SetControlBackColor(panel_name,"errField_P_ASG_69_0_0_33",MakeRGB(255,255,255));
       P_ASG_69_0_0_33SetGet_BTN_already_pressed = 1;
    }
    else
    {
       getValue(P_ASG_69_0_0_33, BAPTemp);
       Request_ByteSequence(LSGID, P_ASG_69_0_0_33_ID, DataSetGet_REQ, BAPTemp, getValueSize(P_ASG_69_0_0_33));
       P_ASG_69_0_0_33SetGet_BTN_already_pressed = 0;
    }
}
on envVar P_ASG_69_0_0_33 // bus value of AutoSkinSwitch (33).
{
	// opcodes: Error-Status
	byte param1; // Setup
	byte param2; // ModificationReason
	byte param3; // ModificationState
	// DATATYPE_BYTESEQUENCE / DATATYPE_FIXEDBYTESEQUENCE
	int i;
	byte superval[2];
	int currentPos;
	currentPos = 0;
	for( i = 0; i < 2; i++ ) {
		superval[i] = 0;
	}
	getValue(P_ASG_69_0_0_33, superval);
	///////// Start param1 - UINT8 /////////
	param1 = superval[currentPos++];
	putValue(P_ASG_69_0_0_33_1, param1);
	///////// Start param2 - NIBBLE /////////
	param2 = (superval[currentPos] & 0xf0)>>4;
	putValue(P_ASG_69_0_0_33_2, param2);
	///////// Start param3 - NIBBLE /////////
	param3 = superval[currentPos++] & 0x0f;
	putValue(P_ASG_69_0_0_33_3, param3);
}

on envVar P_ASG_69_0_0_33_1_0
{
	byte bitval;
	//thisval steht hier fuer den bitfield-wert, 
	//aus Generierungsgruenden hier keine einheitliche Bezeichnung moeglich.
	byte thisval; // Setup
	bitval= getValue(this);
	thisval = getValue(P_ASG_69_0_0_33_1);
	thisval = thisval&~(1<<0)|(bitval<<0);
	putValue(P_ASG_69_0_0_33_1,thisval);
}

on envVar P_ASG_69_0_0_33_1 // AutoSkinSwitch.Setup
{
	byte superval[2];

	//Update Childvalue (BitField)
	byte mask=0x01;
	int i = 0;
	byte thisval; // Setup
	thisval = getValue(this);
	if(thisval&(mask<<0))
		putValue(P_ASG_69_0_0_33_1_0, 1);
	else
		putValue(P_ASG_69_0_0_33_1_0, 0);

    // Update superval
	getValue(P_ASG_69_0_0_33, superval);
	superval[0]=thisval;
	putValue(P_ASG_69_0_0_33,superval);
}

on envVar P_ASG_69_0_0_33_2 // AutoSkinSwitch.ModificationReason
{
	byte superval[2];

	//Update Childvalue (Enum)
	byte thisval; // ModificationReason
	thisval = 0x0f & getValue(this);

    // Update superval
	getValue(P_ASG_69_0_0_33, superval);
	superval[1]= superval[1]&0x0f;
	superval[1]= superval[1]|(thisval<<4);
	putValue(P_ASG_69_0_0_33,superval);
}

on envVar P_ASG_69_0_0_33_3_0
{
	byte bitval;
	//thisval steht hier fuer den bitfield-wert, 
	//aus Generierungsgruenden hier keine einheitliche Bezeichnung moeglich.
	byte thisval; // ModificationState
	bitval= getValue(this);
	thisval = getValue(P_ASG_69_0_0_33_3);
	thisval = thisval&~(1<<0)|(bitval<<0);
	putValue(P_ASG_69_0_0_33_3,thisval);
}

on envVar P_ASG_69_0_0_33_3 // AutoSkinSwitch.ModificationState
{
	byte superval[2];

	//Update Childvalue (BitField)
	byte mask=0x01;
	int i = 0;
	byte thisval; // ModificationState
	thisval = getValue(this);
	if(thisval&(mask<<0))
		putValue(P_ASG_69_0_0_33_3_0, 1);
	else
		putValue(P_ASG_69_0_0_33_3_0, 0);

    // Update superval
	getValue(P_ASG_69_0_0_33, superval);
	superval[1]= superval[1]&0xf0;
	superval[1]= superval[1]|thisval;
	putValue(P_ASG_69_0_0_33,superval);
}

on envVar A_ASG_69_0_0_34Get_BTN
{
  byte data[119]; 
  byte stringValue[119];
  byte head[5];
  int i;
  int headLength;
  long tempValue;
  word currentPos;
  word startVal;
  word elementsVal;
  byte nibbleSetted;
  if (A_ASG_69_0_0_34Get_BTN_already_pressed == 0)
  {
     putValue(A_ASG_69_0_0_34_ErrCode,0);
     SetControlBackColor(panel_name,"errField_A_ASG_69_0_0_34",MakeRGB(255,255,255));
     A_ASG_69_0_0_34Get_BTN_already_pressed = 1;
  }
  else
  {
        currentPos = 0;
        //Einzelparameter: Operation
        tempValue = getValue(A_ASG_69_0_0_34_1_SetGet);
        //voriger Parameter war ein first nibble, bei 1 Byte Werten Position incr
        if(nibbleSetted == 1) currentPos++;
        nibbleSetted = 0;
        data[currentPos++] = tempValue;
        //Einzelparameter: Type
        tempValue = getValue(A_ASG_69_0_0_34_2_SetGet);
        //voriger Parameter war ein first nibble, bei 1 Byte Werten Position incr
        if(nibbleSetted == 1) currentPos++;
        nibbleSetted = 0;
        data[currentPos++] = tempValue;
        //Einzelparameter: Slot
        tempValue = getValue(A_ASG_69_0_0_34_3_SetGet);
        //voriger Parameter war ein first nibble, bei 1 Byte Werten Position incr
        if(nibbleSetted == 1) currentPos++;
        nibbleSetted = 0;
        data[currentPos++] = tempValue;
        //Einzelparameter: ASG_ID
        tempValue = getValue(A_ASG_69_0_0_34_4_SetGet);
    if(nibbleSetted == 1)
    {
        //voriger Parameter war ein Nibble, => second nibble, Pos incr und Flag zuruecksetzen
        data[currentPos] = (tempValue &0x0F) | (data[currentPos] &0xF0);
        currentPos++;
        nibbleSetted = 0;
    }
    else
    {
        //first nibble, kein increment, Flag setzen
        data[currentPos] = (tempValue<<4) &0xF0;
        nibbleSetted = 1;
    }
        //Einzelparameter: TAID
        tempValue = getValue(A_ASG_69_0_0_34_5_SetGet);
    if(nibbleSetted == 1)
    {
        //voriger Parameter war ein Nibble, => second nibble, Pos incr und Flag zuruecksetzen
        data[currentPos] = (tempValue &0x0F) | (data[currentPos] &0xF0);
        currentPos++;
        nibbleSetted = 0;
    }
    else
    {
        //first nibble, kein increment, Flag setzen
        data[currentPos] = (tempValue<<4) &0xF0;
        nibbleSetted = 1;
    }
        //head Parameter
        headLength = getValueSize(A_ASG_69_0_0_34_SetGet);
        getValue(A_ASG_69_0_0_34_SetGet,head);
        for(i=0; i< headLength; i++)
        {
            data[currentPos++] = head[i];
        }

     Request_ByteSequence(LSGID, A_ASG_69_0_0_34_ID, DataGet_REQ, data, currentPos);
     if(getValue(A_ASG_69_0_0_34_IntTlgEn)) //getValue(IT))
     {
       intertelegram_err(A_ASG_69_0_0_34_ID);
     }
     if(getValue(A_ASG_69_0_0_34_SegmEn))   //getvalue(SG)
     {
         sequence_err(A_ASG_69_0_0_34_ID,getValueSize(A_ASG_69_0_0_34_SetGet));
     }
     A_ASG_69_0_0_34Get_BTN_already_pressed = 0;
  }
}
A_ASG_69_0_0_34_SetGet_GenerateSetGet()
{
    byte head[5];
    //Record Address in Byte 0 Bit 0-3 kopieren - MAX Wert = 0x0F
    if(getValue(A_ASG_69_0_0_34_SetGet_RecAdr) > 0x0F)
        putValue(A_ASG_69_0_0_34_SetGet_RecAdr , 0x0F);
    head[0] = (head[0] & 0xF0) | getValue(A_ASG_69_0_0_34_SetGet_RecAdr);
    //Shift Bit in Byte 0 Bit 4 kopieren
    if( getValue(A_ASG_69_0_0_34_SetGet_Shift) > 0) head[0] = head[0] | 0x10;
    else head[0] = head[0] & 0xEF;
    // Direction Bit in Byte 0 Bit 5 kopieren
    if( getValue(A_ASG_69_0_0_34_SetGet_Direction) > 0) head[0] = head[0] | 0x20;
    else head[0] = head[0] & 0xDF;
    // reserverd:  Byte 0 Bit 6
    if( getValue(A_ASG_69_0_0_34_SetGet_IndexSize) > 0)
    {
        // 5 Byte Header
        head[0] = head[0] | 0x80;
        head[1] =  getValue(A_ASG_69_0_0_34_SetGet_Start) & 0xFF;
        head[2] = (getValue(A_ASG_69_0_0_34_SetGet_Start) >> 8 ) & 0xFF;
        head[3] =  getValue(A_ASG_69_0_0_34_SetGet_Elements) & 0xFF;
        head[4] = (getValue(A_ASG_69_0_0_34_SetGet_Elements)  >> 8 ) & 0xFF;
        //ToDo: DATA - derzeit einfach laenge = 5
        putValue(A_ASG_69_0_0_34_SetGet, head, 5); 
    }
    else 
    {
        // 3 Byte Header
        head[0] = head[0] & 0x7F;
        head[1] = getValue(A_ASG_69_0_0_34_SetGet_Start) & 0xFF;
        head[2] = getValue(A_ASG_69_0_0_34_SetGet_Elements) & 0xFF;
        //ToDo: DATA - derzeit einfach laenge = 3
        putValue(A_ASG_69_0_0_34_SetGet, head, 3); 
    }
}

on envVar A_ASG_69_0_0_34_SetGet_RecAdr
{
    A_ASG_69_0_0_34_SetGet_GenerateSetGet();
}

on envVar A_ASG_69_0_0_34_SetGet_Shift
{
    A_ASG_69_0_0_34_SetGet_GenerateSetGet();
}

on envVar A_ASG_69_0_0_34_SetGet_Direction
{
    A_ASG_69_0_0_34_SetGet_GenerateSetGet();
}

on envVar A_ASG_69_0_0_34_SetGet_Start
{
    A_ASG_69_0_0_34_SetGet_GenerateSetGet();
}

on envVar A_ASG_69_0_0_34_SetGet_Elements
{
    A_ASG_69_0_0_34_SetGet_GenerateSetGet();
}

on envVar A_ASG_69_0_0_34_SetGet_IndexSize
{
    A_ASG_69_0_0_34_SetGet_GenerateSetGet();
}
on envVar A_ASG_69_0_0_34SetGet_BTN
{
  byte data[119]; 
  byte stringValue[119];
  byte head[5];
  int i;
  int j = 0;
  long StringLength = 0;
  int headLength;
  long tempValue;
  word currentPos;
  word startVal;
  word elementsVal;
  byte nibbleSetted;
  if (A_ASG_69_0_0_34SetGet_BTN_already_pressed == 0)
  {
     putValue(A_ASG_69_0_0_34_ErrCode,0);
     SetControlBackColor(panel_name,"errField_A_ASG_69_0_0_34",MakeRGB(255,255,255));
     A_ASG_69_0_0_34SetGet_BTN_already_pressed = 1;
  }
  else
  {
        currentPos = 0;
        //Einzelparameter: Operation
        tempValue = getValue(A_ASG_69_0_0_34_1_SetGet);
        //voriger Parameter war ein first nibble, bei 1 Byte Werten Position incr
        if(nibbleSetted == 1) currentPos++;
        nibbleSetted = 0;
        data[currentPos++] = tempValue;
        //Einzelparameter: Type
        tempValue = getValue(A_ASG_69_0_0_34_2_SetGet);
        //voriger Parameter war ein first nibble, bei 1 Byte Werten Position incr
        if(nibbleSetted == 1) currentPos++;
        nibbleSetted = 0;
        data[currentPos++] = tempValue;
        //Einzelparameter: Slot
        tempValue = getValue(A_ASG_69_0_0_34_3_SetGet);
        //voriger Parameter war ein first nibble, bei 1 Byte Werten Position incr
        if(nibbleSetted == 1) currentPos++;
        nibbleSetted = 0;
        data[currentPos++] = tempValue;
        //Einzelparameter: ASG_ID
        tempValue = getValue(A_ASG_69_0_0_34_4_SetGet);
    if(nibbleSetted == 1)
    {
        //voriger Parameter war ein Nibble, => second nibble, Pos incr und Flag zuruecksetzen
        data[currentPos] = (tempValue &0x0F) | (data[currentPos] &0xF0);
        currentPos++;
        nibbleSetted = 0;
    }
    else
    {
        //first nibble, kein increment, Flag setzen
        data[currentPos] = (tempValue<<4) &0xF0;
        nibbleSetted = 1;
    }
        //Einzelparameter: TAID
        tempValue = getValue(A_ASG_69_0_0_34_5_SetGet);
    if(nibbleSetted == 1)
    {
        //voriger Parameter war ein Nibble, => second nibble, Pos incr und Flag zuruecksetzen
        data[currentPos] = (tempValue &0x0F) | (data[currentPos] &0xF0);
        currentPos++;
        nibbleSetted = 0;
    }
    else
    {
        //first nibble, kein increment, Flag setzen
        data[currentPos] = (tempValue<<4) &0xF0;
        nibbleSetted = 1;
    }
        //head Parameter
        headLength = getValueSize(A_ASG_69_0_0_34_SetGet);
        getValue(A_ASG_69_0_0_34_SetGet,head);
        for(i=0; i< headLength; i++)
        {
            data[currentPos++] = head[i];
        }
    //data Parameter
     startVal = getValue(A_ASG_69_0_0_34_SetGet_Start);
     elementsVal = getValue(A_ASG_69_0_0_34_SetGet_Elements);
     nibbleSetted = 0;
    if( (head[0]&0x20) == 0)
    {
     if( (head[0] & 0x10) > 0)
     {
        startVal++;
     }
     for( i = startVal ; i < startVal + elementsVal ; i++)
     {
       if( i < 0 || i >= A_ASG_69_0_0_34_ArrayDataList_Length )
       {
         write("Array index ausserhalb der Grenzen, Fct: 34");
         break;
       }
      if(nibbleSetted == 1) currentPos++;
      nibbleSetted = 0;
     if( (head[0]&0x40) == 0){ /* Transmit_Pos = 0, keine Positionsdaten */ }
     else
     {
        if( (head[0]&0x80) == 0)
        {
           //IndexSize = 0, Pos als 1 Byte Wert
           //Kein POS definiert
        }
        else
        {
           //IndexSize = 1, Pos als 2 Byte Wert
           //Kein POS definiert
        }
     }
      // Check if the current value of RecAdr enables the variable Parameter_ID:
      if( 0 || 1 == getValue( A_ASG_69_0_0_34_SetGet_RecAdr ) || 2 == getValue( A_ASG_69_0_0_34_SetGet_RecAdr ) || 3 == getValue( A_ASG_69_0_0_34_SetGet_RecAdr ) )
      {
        //Sollte vor einem 4 Byte Wert 1 Nibble kommen, muss der index um 1 incrementiert werden!
        if( nibbleSetted==1) currentPos++;
        nibbleSetted = 0;
        data[currentPos++] = (A_ASG_69_0_0_34_ArrayDataList[i].Param1      ) & 0xFF;
        data[currentPos++] = (A_ASG_69_0_0_34_ArrayDataList[i].Param1 >>  8) & 0xFF;
        data[currentPos++] = (A_ASG_69_0_0_34_ArrayDataList[i].Param1 >> 16) & 0xFF;
        data[currentPos++] = (A_ASG_69_0_0_34_ArrayDataList[i].Param1 >> 24) & 0xFF;
       }
      // Check if the current value of RecAdr enables the variable DataDescription:
      if( 0 || 1 == getValue( A_ASG_69_0_0_34_SetGet_RecAdr ) || 2 == getValue( A_ASG_69_0_0_34_SetGet_RecAdr ) || 3 == getValue( A_ASG_69_0_0_34_SetGet_RecAdr ) )
      {
        //Sollte vor einem 1 Byte Wert 1 Nibble kommen, muss der index um 1 incrementiert werden!
        if( nibbleSetted==1) currentPos++;
        nibbleSetted = 0;
        data[currentPos++] = (A_ASG_69_0_0_34_ArrayDataList[i].Param2 ) & 0xFF;
       }
      // Check if the current value of RecAdr enables the variable DataTag:
      if( 0 || 2 == getValue( A_ASG_69_0_0_34_SetGet_RecAdr ) || 3 == getValue( A_ASG_69_0_0_34_SetGet_RecAdr ) )
      {
        //Sollte vor einem 1 Byte Wert 1 Nibble kommen, muss der index um 1 incrementiert werden!
        if( nibbleSetted==1) currentPos++;
        nibbleSetted = 0;
        data[currentPos++] = (A_ASG_69_0_0_34_ArrayDataList[i].Param3 ) & 0xFF;
       }
      // Check if the current value of RecAdr enables the variable DataLength:
      if( 0 || 3 == getValue( A_ASG_69_0_0_34_SetGet_RecAdr ) )
      {
        //Sollte vor einem 4 Byte Wert 1 Nibble kommen, muss der index um 1 incrementiert werden!
        if( nibbleSetted==1) currentPos++;
        nibbleSetted = 0;
        data[currentPos++] = (A_ASG_69_0_0_34_ArrayDataList[i].Param4      ) & 0xFF;
        data[currentPos++] = (A_ASG_69_0_0_34_ArrayDataList[i].Param4 >>  8) & 0xFF;
        data[currentPos++] = (A_ASG_69_0_0_34_ArrayDataList[i].Param4 >> 16) & 0xFF;
        data[currentPos++] = (A_ASG_69_0_0_34_ArrayDataList[i].Param4 >> 24) & 0xFF;
       }
      // Check if the current value of RecAdr enables the variable Data:
      if( 0 || 3 == getValue( A_ASG_69_0_0_34_SetGet_RecAdr ) )
      {
        //Sollte vor einem String Wert 1 Nibble kommen, muss der index um 1 incrementiert werden!
        if( nibbleSetted==1) currentPos++;
        nibbleSetted = 0;
        StringLength =A_ASG_69_0_0_34_ArrayDataList[i].Param5_Length;
		/* Pruefung ob die Laenge-Checkbox aktiv ist */
		if (1 == A_ASG_69_0_0_34_Data_5_CntList[i] && 0)
		{
			if(StringLength >= 0 && StringLength <= 32767 /*&& StringLength <= 1-2*/)
			{
				data[currentPos++] = ( (StringLength >> 8) & 0x7F ) | 0x80; //2Byte Flag (Bit 8) setzen + HighByte (erste 7 bit)
				data[currentPos++] = StringLength &0xFF;
			}
			else
			{
				writelineEx(gBAP_Trace, 0, "Eingegebene Laenge: %d von A_ASG_69_0_0_34_Data_5 mit Record Nr. %d ist ungueltig. Die max. erlaubte Laenge ist %d.", StringLength, i, 1-2);
				return;
			}
		}
		else if(0 == A_ASG_69_0_0_34_Data_5_CntList[i] && 0) /*check box deaktiviert*/
		{
			//if(StringLength >= 0 && StringLength <= 127 && StringLength <= 1-1)
			if (StringLength <= 1)
			{
				data[currentPos++] = StringLength & 0x7F; //Bit 8 = 0
			}
			else
			{
				writelineEx(gBAP_Trace, 0, "Eingegebene Laenge: %d von A_ASG_69_0_0_34_Data_5 mit Record Nr. %d ist ungueltig. Die max. erlaubte Laenge ist %d. ", StringLength, i, 1-1);
				return;
			}
		}
        for(j=0; j < StringLength ; j++)
        {
            data[currentPos++] = A_ASG_69_0_0_34_ArrayDataList[i].Param5[j];
        }
       }
    //sollte der letzte Parameter ein first nibble gewesen sein, muss noch 1 increment durchgefuehrt werden
    if( nibbleSetted==1) currentPos++;
    nibbleSetted = 0;
     }
    }
    else
    {
     if( (head[0] & 0x10) > 0)
     {
        if(startVal != 0) startVal--;
        else
        {
           startVal = A_ASG_69_0_0_34_ArrayDataList_Length -1;
        }
     }
     for( i = startVal ; i > startVal - elementsVal ; i--)
     {
       if( i < 0 || i >= A_ASG_69_0_0_34_ArrayDataList_Length )
       {
         write("Array index ausserhalb der Grenzen, Fct: 34");
         break;
       }
      if(nibbleSetted == 1) currentPos++;
      nibbleSetted = 0;
     if( (head[0]&0x40) == 0){ /* Transmit_Pos = 0, keine Positionsdaten */ }
     else
     {
        if( (head[0]&0x80) == 0)
        {
           //IndexSize = 0, Pos als 1 Byte Wert
           //Kein POS definiert
        }
        else
        {
           //IndexSize = 1, Pos als 2 Byte Wert
           //Kein POS definiert
        }
     }
      // Check if the current value of RecAdr enables the variable Parameter_ID:
      if( 0 || 1 == getValue( A_ASG_69_0_0_34_SetGet_RecAdr ) || 2 == getValue( A_ASG_69_0_0_34_SetGet_RecAdr ) || 3 == getValue( A_ASG_69_0_0_34_SetGet_RecAdr ) )
      {
        //Sollte vor einem 4 Byte Wert 1 Nibble kommen, muss der index um 1 incrementiert werden!
        if( nibbleSetted==1) currentPos++;
        nibbleSetted = 0;
        data[currentPos++] = (A_ASG_69_0_0_34_ArrayDataList[i].Param1      ) & 0xFF;
        data[currentPos++] = (A_ASG_69_0_0_34_ArrayDataList[i].Param1 >>  8) & 0xFF;
        data[currentPos++] = (A_ASG_69_0_0_34_ArrayDataList[i].Param1 >> 16) & 0xFF;
        data[currentPos++] = (A_ASG_69_0_0_34_ArrayDataList[i].Param1 >> 24) & 0xFF;
       }
      // Check if the current value of RecAdr enables the variable DataDescription:
      if( 0 || 1 == getValue( A_ASG_69_0_0_34_SetGet_RecAdr ) || 2 == getValue( A_ASG_69_0_0_34_SetGet_RecAdr ) || 3 == getValue( A_ASG_69_0_0_34_SetGet_RecAdr ) )
      {
        //Sollte vor einem 1 Byte Wert 1 Nibble kommen, muss der index um 1 incrementiert werden!
        if( nibbleSetted==1) currentPos++;
        nibbleSetted = 0;
        data[currentPos++] = (A_ASG_69_0_0_34_ArrayDataList[i].Param2 ) & 0xFF;
       }
      // Check if the current value of RecAdr enables the variable DataTag:
      if( 0 || 2 == getValue( A_ASG_69_0_0_34_SetGet_RecAdr ) || 3 == getValue( A_ASG_69_0_0_34_SetGet_RecAdr ) )
      {
        //Sollte vor einem 1 Byte Wert 1 Nibble kommen, muss der index um 1 incrementiert werden!
        if( nibbleSetted==1) currentPos++;
        nibbleSetted = 0;
        data[currentPos++] = (A_ASG_69_0_0_34_ArrayDataList[i].Param3 ) & 0xFF;
       }
      // Check if the current value of RecAdr enables the variable DataLength:
      if( 0 || 3 == getValue( A_ASG_69_0_0_34_SetGet_RecAdr ) )
      {
        //Sollte vor einem 4 Byte Wert 1 Nibble kommen, muss der index um 1 incrementiert werden!
        if( nibbleSetted==1) currentPos++;
        nibbleSetted = 0;
        data[currentPos++] = (A_ASG_69_0_0_34_ArrayDataList[i].Param4      ) & 0xFF;
        data[currentPos++] = (A_ASG_69_0_0_34_ArrayDataList[i].Param4 >>  8) & 0xFF;
        data[currentPos++] = (A_ASG_69_0_0_34_ArrayDataList[i].Param4 >> 16) & 0xFF;
        data[currentPos++] = (A_ASG_69_0_0_34_ArrayDataList[i].Param4 >> 24) & 0xFF;
       }
      // Check if the current value of RecAdr enables the variable Data:
      if( 0 || 3 == getValue( A_ASG_69_0_0_34_SetGet_RecAdr ) )
      {
        //Sollte vor einem String Wert 1 Nibble kommen, muss der index um 1 incrementiert werden!
        if( nibbleSetted==1) currentPos++;
        nibbleSetted = 0;
        StringLength =A_ASG_69_0_0_34_ArrayDataList[i].Param5_Length;
		/* Pruefung ob die Laenge-Checkbox aktiv ist */
		if (1 == A_ASG_69_0_0_34_Data_5_CntList[i] && 0)
		{
			if(StringLength >= 0 && StringLength <= 32767 /*&& StringLength <= 1-2*/)
			{
				data[currentPos++] = ( (StringLength >> 8) & 0x7F ) | 0x80; //2Byte Flag (Bit 8) setzen + HighByte (erste 7 bit)
				data[currentPos++] = StringLength &0xFF;
			}
			else
			{
				writelineEx(gBAP_Trace, 0, "Eingegebene Laenge: %d von A_ASG_69_0_0_34_Data_5 mit Record Nr. %d ist ungueltig. Die max. erlaubte Laenge ist %d.", StringLength, i, 1-2);
				return;
			}
		}
		else if(0 == A_ASG_69_0_0_34_Data_5_CntList[i] && 0) /*check box deaktiviert*/
		{
			if(StringLength >= 0 && StringLength <= 127 /*&& StringLength <= 1-1*/)
			{
				data[currentPos++] = StringLength & 0x7F; //Bit 8 = 0
			}
			else
			{
				writelineEx(gBAP_Trace, 0, "Eingegebene Laenge: %d von A_ASG_69_0_0_34_Data_5 mit Record Nr. %d ist ungueltig. Die max. erlaubte Laenge ist %d. ", StringLength, i, 1-1);
				return;
			}
		}
        for(j=0; j < StringLength ; j++)
        {
            data[currentPos++] = A_ASG_69_0_0_34_ArrayDataList[i].Param5[j];
        }
       }
    //sollte der letzte Parameter ein first nibble gewesen sein, muss noch 1 increment durchgefuehrt werden
    if( nibbleSetted==1) currentPos++;
    nibbleSetted = 0;
     }
    }

     Request_ByteSequence(LSGID, A_ASG_69_0_0_34_ID, DataSetGet_REQ, data, currentPos);
     if(getValue(A_ASG_69_0_0_34_IntTlgEn)) //getValue(IT))
     {
           intertelegram_err(A_ASG_69_0_0_34_ID);
     }
     if(getValue(A_ASG_69_0_0_34_SegmEn))   //getvalue(SG)
     {
             sequence_err(A_ASG_69_0_0_34_ID,getValueSize(A_ASG_69_0_0_34_SetGet));
     }
     A_ASG_69_0_0_34SetGet_BTN_already_pressed = 0;
  }
}
on envVar A_ASG_69_0_0_34
{
    byte temp[119];
    byte head[5];
    getValue(A_ASG_69_0_0_34, head);
    putValue(A_ASG_69_0_0_34_RecAdr, 0x0F & head[0]); //Record Address = Bit 0-3 von Byte 0
    if ( (0x10 & head[0]) >0)
        putValue(A_ASG_69_0_0_34_Shift, 1); //Shift = Bit 4 von Byte 0
    else
        putValue(A_ASG_69_0_0_34_Shift, 0); //Shift = Bit 4 von Byte 0
    if ( (0x20 & head[0]) >0)
        putValue(A_ASG_69_0_0_34_Direction, 1); //Direction = Bit 5 von Byte 0
    else
        putValue(A_ASG_69_0_0_34_Direction, 0); //Direction = Bit 5 von Byte 0
    if ( (0x40 & head[0]) >0)
        putValue(A_ASG_69_0_0_34_TransPos, 1); //Transmission Pos = Bit 6 von Byte 0
    else
        putValue(A_ASG_69_0_0_34_TransPos, 0); //Transmission Pos = Bit 6 von Byte 0
    if ( (0x80 & head[0]) >0)
        putValue(A_ASG_69_0_0_34_IndexSize, 1); //IndexSize = Bit 7 von Byte 0
    else
        putValue(A_ASG_69_0_0_34_IndexSize, 0); //IndexSize = Bit 7 von Byte 0
    if(getValue(A_ASG_69_0_0_34_IndexSize))
    {
        putValue(A_ASG_69_0_0_34_Start, ((head[2]<<8)| head[1]) ); //Start Wert, 2 Byte lang
        putValue(A_ASG_69_0_0_34_Elements, ((head[4]<<8)| head[3]) ); //Elements Wert, 2 Byte lang
    }
    else
    {
        putValue(A_ASG_69_0_0_34_Start, head[1]); //Start Wert, 1 Byte lang
        putValue(A_ASG_69_0_0_34_Elements, head[2]); //Start Wert, 1 Byte lang
    }
}
on envVar A_ASG_69_0_0_34_Changed
{
    byte temp[122];
    getValue(A_ASG_69_0_0_34_Changed, temp);
    putValue(A_ASG_69_0_0_34_Changed_RecAdr, 0x0F & temp[0]); //Record Address = Bit 0-3 von Byte 0
    if ( (0x10 & temp[0]) >0)
        putValue(A_ASG_69_0_0_34_Changed_Shift, 1); //Shift = Bit 4 von Byte 0
    else
        putValue(A_ASG_69_0_0_34_Changed_Shift, 0); //Shift = Bit 4 von Byte 0
    if ( (0x20 & temp[0]) >0)
        putValue(A_ASG_69_0_0_34_Changed_Direction, 1); //Direction = Bit 5 von Byte 0
    else
        putValue(A_ASG_69_0_0_34_Changed_Direction, 0); //Direction = Bit 5 von Byte 0
    if ( (0x40 & temp[0]) >0)
        putValue(A_ASG_69_0_0_34_Changed_TransPos, 1); //Transmission Pos = Bit 6 von Byte 0
    else
        putValue(A_ASG_69_0_0_34_Changed_TransPos, 0); //Transmission Pos = Bit 6 von Byte 0
    if ( (0x80 & temp[0]) >0)
        putValue(A_ASG_69_0_0_34_Changed_IndexSize, 1); //IndexSize = Bit 7 von Byte 0
    else
        putValue(A_ASG_69_0_0_34_Changed_IndexSize, 0); //IndexSize = Bit 7 von Byte 0
    if(getValue(A_ASG_69_0_0_34_Changed_IndexSize))
    {
        putValue(A_ASG_69_0_0_34_Changed_Start, ((temp[2]<<8)| temp[1]) ); //Start Wert, 2 Byte lang
        putValue(A_ASG_69_0_0_34_Changed_Elements, ((temp[4]<<8)| temp[3]) ); //Elements Wert, 2 Byte lang
    }
    else
    {
        putValue(A_ASG_69_0_0_34_Changed_Start, temp[1]); //Start Wert, 1 Byte lang
        putValue(A_ASG_69_0_0_34_Changed_Elements, temp[2]); //Start Wert, 1 Byte lang
    }
}
on envVar A_ASG_69_0_0_34_SetGet
{
    byte temp[119];
    getValue(A_ASG_69_0_0_34_SetGet, temp);
    putValue(A_ASG_69_0_0_34_SetGet_RecAdr, 0x0F & temp[0]); //Record Address = Bit 0-3 von Byte 0
    if ( (0x10 & temp[0]) >0)
        putValue(A_ASG_69_0_0_34_SetGet_Shift, 1); //Shift = Bit 4 von Byte 0
    else
        putValue(A_ASG_69_0_0_34_SetGet_Shift, 0); //Shift = Bit 4 von Byte 0
    if ( (0x20 & temp[0]) >0)
        putValue(A_ASG_69_0_0_34_SetGet_Direction, 1); //Direction = Bit 5 von Byte 0
    else
        putValue(A_ASG_69_0_0_34_SetGet_Direction, 0); //Direction = Bit 5 von Byte 0
    // Bit 6 von Byte 0 = reserved
    if ( (0x80 & temp[0]) >0)
        putValue(A_ASG_69_0_0_34_SetGet_IndexSize, 1); //IndexSize = Bit 7 von Byte 0
    else
        putValue(A_ASG_69_0_0_34_SetGet_IndexSize, 0); //IndexSize = Bit 7 von Byte 0
    if(getValue(A_ASG_69_0_0_34_SetGet_IndexSize))
    {
        putValue(A_ASG_69_0_0_34_SetGet_Start, ((temp[2]<<8)| temp[1]) ); //Start Wert, 2 Byte lang
        putValue(A_ASG_69_0_0_34_SetGet_Elements, ((temp[4]<<8)| temp[3]) ); //Elements Wert, 2 Byte lang
    }
    else
    {
        putValue(A_ASG_69_0_0_34_SetGet_Start, temp[1]); //Start Wert, 1 Byte lang
        putValue(A_ASG_69_0_0_34_SetGet_Elements, temp[2]); //Start Wert, 1 Byte lang
    }
}
A_ASG_69_0_0_34_LoadArray()
{
	/********* Statische Deklarationen ***********/
	dword CSVfileHandle;
	dword filePos;
	dword paramPos;
	dword Num_of_csv_byte;
	dword element;
	dword current_CSV_line;
	byte buffer_byte[0xFFFF];
	dword i;
	dword j;
	char CSV_filename[255];

	/********* Param Puffer Deklarationen ***********/
	char temp1[25];
	char temp2[25];
	char temp3[25];
	char temp4[25];

	/********* Initialisierungen ***********/
	CSVfileHandle = 0;
	filePos = 0;
	paramPos = 0;
	Num_of_csv_byte = 0;
	element = 1;
	current_CSV_line = 0;
	for(i = 0; i < A_ASG_69_0_0_34_ArrayDataList_Length; i++)
	{ /* Initialisierung von den Ziel-Strukturen */
		A_ASG_69_0_0_34_ArrayDataList[i].Param1 = 0;
		A_ASG_69_0_0_34_ArrayDataList[i].Param2 = 0;
		A_ASG_69_0_0_34_ArrayDataList[i].Param3 = 0;
		A_ASG_69_0_0_34_ArrayDataList[i].Param4 = 0;
		for(j=0; j<1; j++)
			A_ASG_69_0_0_34_ArrayDataList[i].Param5[j] = 0;
		A_ASG_69_0_0_34_ArrayDataList[i].Param5_Length = 0;
		A_ASG_69_0_0_34_Data_5_LenList[i] = 0;
	}

	/********* Laden der CSV-Datei ***********/
	getValue(A_ASG_69_0_0_34_fileSelector, CSV_filename);
	CSVfileHandle = openFileRead(CSV_filename, 1); //open *.csv (binary-mode ->get the ASCII/UTF-8 code)

	if (CSVfileHandle!=0) //*.csv file access successful
	{
		writelineEx(gBAP_Trace, 0,"Dateizugriff auf '%s' erfolgreich", CSV_filename);    //output result
		//get data from *.csv and store the total number of byte in *.csv-file
		Num_of_csv_byte = fileGetBinaryBlock (buffer_byte, elcount(buffer_byte), CSVfileHandle);

		for (filePos = 0; filePos < Num_of_csv_byte; filePos++) //copy data into "LastDestList"
		{
			if (buffer_byte[filePos] != 0x3B) //read data if no ";" is detected
			{
				//nextline in *.csv (next "record element" in LastDestList) -> "LF" and "CR" detected -> copy (transform string -> long) data from help values in global values
				if(buffer_byte[filePos] == 0x0D && buffer_byte[filePos+1] == 0x0A)
				{
					if(current_CSV_line > 0 && current_CSV_line < 11) //ignore first line in *.csv file
					{
						A_ASG_69_0_0_34_ArrayDataList[current_CSV_line-1].Param1 = atol(temp1); //Parameter_ID
						A_ASG_69_0_0_34_ArrayDataList[current_CSV_line-1].Param2 = atol(temp2); //DataDescription
						A_ASG_69_0_0_34_ArrayDataList[current_CSV_line-1].Param3 = atol(temp3); //DataTag
						A_ASG_69_0_0_34_ArrayDataList[current_CSV_line-1].Param4 = atol(temp4); //DataLength
						for(i = 0; i < 25; i++)
						{ /* Temp-Puffer Initialisierung zur Vermeidung von Nebeneffekte */
							temp1[i]=0;
							temp2[i]=0;
							temp3[i]=0;
							temp4[i]=0;
						}
					}
					current_CSV_line++; //next line in *.csv file
					element = 1; //start at 'POS' (first record element of "array data")
					paramPos = 0; //reset value
				}
 				//copy data from "buffer_byte" (data from *.csv file) in help values and "name" until end of line is not detected
				else if(current_CSV_line > 0 && current_CSV_line < 11)
				{
					//writelineEx(gBAP_Trace, 0, "Element %x  Index %x", element, j);
					switch (element)
					{
						case 1: //Parameter_ID
								if( paramPos >= elCount(temp1) ){
									writelineEx(gBAP_Trace, 0, "Param%x in Zeile %d in der Input CSV Datei, enthaelt mehr Zeichen als erlaubt. Bearbeitung abgebrochen!", element, current_CSV_line);
									return; //False
								}else{
									temp1[paramPos] = buffer_byte[filePos];
									paramPos++;
								}
							break;
						case 2: //DataDescription
								if( paramPos >= elCount(temp2) ){
									writelineEx(gBAP_Trace, 0, "Param%x in Zeile %d in der Input CSV Datei, enthaelt mehr Zeichen als erlaubt. Bearbeitung abgebrochen!", element, current_CSV_line);
									return; //False
								}else{
									temp2[paramPos] = buffer_byte[filePos];
									paramPos++;
								}
							break;
						case 3: //DataTag
								if( paramPos >= elCount(temp3) ){
									writelineEx(gBAP_Trace, 0, "Param%x in Zeile %d in der Input CSV Datei, enthaelt mehr Zeichen als erlaubt. Bearbeitung abgebrochen!", element, current_CSV_line);
									return; //False
								}else{
									temp3[paramPos] = buffer_byte[filePos];
									paramPos++;
								}
							break;
						case 4: //DataLength
								if( paramPos >= elCount(temp4) ){
									writelineEx(gBAP_Trace, 0, "Param%x in Zeile %d in der Input CSV Datei, enthaelt mehr Zeichen als erlaubt. Bearbeitung abgebrochen!", element, current_CSV_line);
									return; //False
								}else{
									temp4[paramPos] = buffer_byte[filePos];
									paramPos++;
								}
							break;
						case 5: //Data
								if(paramPos < 0)
								{
									A_ASG_69_0_0_34_ArrayDataList[current_CSV_line-1].Param5[paramPos] = buffer_byte[filePos];
									A_ASG_69_0_0_34_ArrayDataList[current_CSV_line-1].Param5_Length = paramPos +1;
								}
								paramPos++;
						break;
						default:
						break;
					}
				}
			}
			else  // ";" is detected ->next record element of "array data"
			{
				//writelineEx(gBAP_Trace, 0, "naechstes Element %d Bytes",element);
				element++;
				paramPos=0; //reset value
			}
		}

		if(fileClose (CSVfileHandle) !=0) //close *.csv file
			writelineEx(gBAP_Trace, 0,"Datei '%s' geschlossen", CSV_filename); //output result
		else
			writelineEx(gBAP_Trace, 0,"Fehler beim Schliessen der Datei '%s'", CSV_filename);//output result
	}
	else //*.csv file access not successful
	{
		writelineEx(gBAP_Trace, 0,"Fehler beim Dateizugriff auf '%s'",CSV_filename); //output result
	}
}

on envVar A_ASG_69_0_0_34_loadArray_Btn
{
	char filePath[255];
	if (A_ASG_69_0_0_34_generateData_Btn_already_pressed == 0)
	{
		A_ASG_69_0_0_34_generateData_Btn_already_pressed = 1;
	}
	else
	{
		A_ASG_69_0_0_34_generateData_Btn_already_pressed = 0;
		getValue(A_ASG_69_0_0_34_fileSelector, filePath);
		if(0 == strlen(filePath))
		{
			writelineEx(gBAP_Trace, 0, "Invalid file path!");
		}
		else
		{
			A_ASG_69_0_0_34_LoadArray();
			writelineEx(gBAP_Trace, 0, "Load array from CSV file: %s", filePath);
		}
	}
	putValue(A_ASG_69_0_0_34_Data_1, A_ASG_69_0_0_34_ArrayDataList[ getValue( A_ASG_69_0_0_34_DataIndex) ].Param1);
	putValue(A_ASG_69_0_0_34_Data_2, A_ASG_69_0_0_34_ArrayDataList[ getValue( A_ASG_69_0_0_34_DataIndex) ].Param2);
	putValue(A_ASG_69_0_0_34_Data_3, A_ASG_69_0_0_34_ArrayDataList[ getValue( A_ASG_69_0_0_34_DataIndex) ].Param3);
	putValue(A_ASG_69_0_0_34_Data_4, A_ASG_69_0_0_34_ArrayDataList[ getValue( A_ASG_69_0_0_34_DataIndex) ].Param4);
	putValue(A_ASG_69_0_0_34_Data_5, A_ASG_69_0_0_34_ArrayDataList[ getValue( A_ASG_69_0_0_34_DataIndex) ].Param5, A_ASG_69_0_0_34_ArrayDataList[getValue(A_ASG_69_0_0_34_DataIndex)].Param5_Length);
}


on envVar A_ASG_69_0_0_34_generateData_Btn
{
	word i;
	dword elementsArray[6] = {4, 1, 1, 4, 1, 2};
	byte elementsTypeArray[6] = {0, 0, 0, 0, 0xE, 0xF};
	dword elementsMaxSizeArray[6] = {4294967295LL, 255, 0xFF, 1, 0, 0};
	byte tempArray[130];
	if (A_ASG_69_0_0_34_generateData_Btn_already_pressed == 0)
	{
		A_ASG_69_0_0_34_generateData_Btn_already_pressed = 1;
	}
	else
	{
		initStruct(tempArray, elementsArray, elementsTypeArray, elementsMaxSizeArray, 34, 10 );
		for(i = 0; i < 10; i++)
		{
			memcpy(A_ASG_69_0_0_34_ArrayDataList[i], tempArray, (i * 13) );
			if(A_ASG_69_0_0_34_ArrayDataList[i].Param5_Length > 127 )
				A_ASG_69_0_0_34_Data_5_CntList[i] = 1;
		}
		A_ASG_69_0_0_34_generateData_Btn_already_pressed = 0;
	}
	putValue(A_ASG_69_0_0_34_Data_1, A_ASG_69_0_0_34_ArrayDataList[ getValue( A_ASG_69_0_0_34_DataIndex) ].Param1);
	putValue(A_ASG_69_0_0_34_Data_2, A_ASG_69_0_0_34_ArrayDataList[ getValue( A_ASG_69_0_0_34_DataIndex) ].Param2);
	putValue(A_ASG_69_0_0_34_Data_3, A_ASG_69_0_0_34_ArrayDataList[ getValue( A_ASG_69_0_0_34_DataIndex) ].Param3);
	putValue(A_ASG_69_0_0_34_Data_4, A_ASG_69_0_0_34_ArrayDataList[ getValue( A_ASG_69_0_0_34_DataIndex) ].Param4);
	putValue(A_ASG_69_0_0_34_Data_5, A_ASG_69_0_0_34_ArrayDataList[ getValue( A_ASG_69_0_0_34_DataIndex) ].Param5, A_ASG_69_0_0_34_ArrayDataList[getValue(A_ASG_69_0_0_34_DataIndex)].Param5_Length);
}
// HME generateCaplOnEnv (3131)
on envVar A_ASG_69_0_0_34_DataIndex
{
    long index;
    long maxIndex = 10-1;
    index = getValue(this);
    if(index >= maxIndex) index = maxIndex;
    else if(index < 0) index = 0;
    putValue(this, index);
    putValue(A_ASG_69_0_0_34_Data_1, A_ASG_69_0_0_34_ArrayDataList[index].Param1);
    putValue(A_ASG_69_0_0_34_Data_2, A_ASG_69_0_0_34_ArrayDataList[index].Param2);
    putValue(A_ASG_69_0_0_34_Data_3, A_ASG_69_0_0_34_ArrayDataList[index].Param3);
    putValue(A_ASG_69_0_0_34_Data_4, A_ASG_69_0_0_34_ArrayDataList[index].Param4);
    putValue(A_ASG_69_0_0_34_Data_5_len, A_ASG_69_0_0_34_Data_5_LenList[index]);
    putValue(A_ASG_69_0_0_34_Data_5_cnt, A_ASG_69_0_0_34_Data_5_CntList[index]);
    putValue(A_ASG_69_0_0_34_Data_5, A_ASG_69_0_0_34_ArrayDataList[index].Param5, A_ASG_69_0_0_34_ArrayDataList[index].Param5_Length);

}
on envVar A_ASG_69_0_0_34_DataIndex_Incr
{
    long index;
    if(A_ASG_69_0_0_34_DataIndex_Incr_already_pressed == 0)
    {
        A_ASG_69_0_0_34_DataIndex_Incr_already_pressed = 1;
    }
    else
    {
        index = getValue(A_ASG_69_0_0_34_DataIndex);
        index++;
        putValue(A_ASG_69_0_0_34_DataIndex, index);
        A_ASG_69_0_0_34_DataIndex_Incr_already_pressed = 0;
    }
}
on envVar A_ASG_69_0_0_34_DataIndex_Decr
{
    long index;
    if(A_ASG_69_0_0_34_DataIndex_Decr_already_pressed == 0)
    {
        A_ASG_69_0_0_34_DataIndex_Decr_already_pressed = 1;
    }
    else
    {
        index = getValue(A_ASG_69_0_0_34_DataIndex);
        index--;
        putValue(A_ASG_69_0_0_34_DataIndex, index);
        A_ASG_69_0_0_34_DataIndex_Decr_already_pressed = 0;
    }
}
// HME generateCaplOnEnv (3160)
on envVar A_ASG_69_0_0_34_DataIndex_SetGet
{
    long index;
    long maxIndex = 10-1;
    index = getValue(this);
    if(index >= maxIndex) index = maxIndex;
    else if(index < 0) index = 0;
    putValue(this, index);
    putValue(A_ASG_69_0_0_34_Data_1_SetGet, A_ASG_69_0_0_34_ArrayDataList[index].Param1);
    putValue(A_ASG_69_0_0_34_Data_2_SetGet, A_ASG_69_0_0_34_ArrayDataList[index].Param2);
    putValue(A_ASG_69_0_0_34_Data_3_SetGet, A_ASG_69_0_0_34_ArrayDataList[index].Param3);
    putValue(A_ASG_69_0_0_34_Data_4_SetGet, A_ASG_69_0_0_34_ArrayDataList[index].Param4);
    putValue(A_ASG_69_0_0_34_Data_5_SetGet_len, A_ASG_69_0_0_34_Data_5_SetGet_LenList[index]);
    putValue(A_ASG_69_0_0_34_Data_5_SetGet_cnt, A_ASG_69_0_0_34_Data_5_SetGet_CntList[index]);
    putValue(A_ASG_69_0_0_34_Data_5_SetGet, A_ASG_69_0_0_34_ArrayDataList[index].Param5, A_ASG_69_0_0_34_ArrayDataList[index].Param5_Length);

}
on envVar A_ASG_69_0_0_34_DataIndex_SetGet_Incr
{
    long index;
    if(A_ASG_69_0_0_34_DataIndex_SetGet_Incr_already_pressed == 0)
    {
        A_ASG_69_0_0_34_DataIndex_SetGet_Incr_already_pressed = 1;
    }
    else
    {
        index = getValue(A_ASG_69_0_0_34_DataIndex_SetGet);
        index++;
        putValue(A_ASG_69_0_0_34_DataIndex_SetGet, index);
        A_ASG_69_0_0_34_DataIndex_SetGet_Incr_already_pressed = 0;
    }
}
on envVar A_ASG_69_0_0_34_DataIndex_SetGet_Decr
{
    long index;
    if(A_ASG_69_0_0_34_DataIndex_SetGet_Decr_already_pressed == 0)
    {
        A_ASG_69_0_0_34_DataIndex_SetGet_Decr_already_pressed = 1;
    }
    else
    {
        index = getValue(A_ASG_69_0_0_34_DataIndex_SetGet);
        index--;
        putValue(A_ASG_69_0_0_34_DataIndex_SetGet, index);
        A_ASG_69_0_0_34_DataIndex_SetGet_Decr_already_pressed = 0;
    }
}
// Man darf gleichzeitig nur Checkbox fuer SegmError oder IntertelegramError aktiviert werden
on envVar A_ASG_69_0_0_34_IntTlgEn
{
       if(getValue(this)) 
       {
           putValue(A_ASG_69_0_0_34_SegmEn,0);
           intertelegram_err(A_ASG_69_0_0_34_ID);
       }
       else
       {
           intertelegram_err_off(A_ASG_69_0_0_34_ID);
       }
}
// Man darf gleichzeitig nur Checkbox fuer SegmError oder IntertelegramError aktiviert werden
on envVar A_ASG_69_0_0_34_SegmEn
{
       if(getValue(this)) 
       {
           putValue(A_ASG_69_0_0_34_IntTlgEn,0);
           sequence_err(A_ASG_69_0_0_34_ID,getValueSize(A_ASG_69_0_0_34_SegmEn));
       }
       else
       {
              sequence_err_off(A_ASG_69_0_0_34_ID);
       }
}

// [XL] Ueberwachung der CheckBox fuer AT
on envVar A_ASG_69_0_0_34_AT
{
	if(getValue(this))
	{
		EnableControl(panel_name,"panel_A_ASG_69_0_0_34_Status",0);
	}
	else
	{
   	EnableControl(panel_name,"panel_A_ASG_69_0_0_34_Status",1);
 	}
}

A_ASG_69_0_0_34_DataInd()
{
    int currentPos;
    byte head[5];
    byte stringTempValue[122];
    int i;
    int j;
    int startVal;
    int elementsVal;
    byte recordAddressVal;
    byte transmitPosVal;
    long tempValue;
    long index;
    byte nibbleSetted;
    currentPos = 0;
    nibbleSetted = 0;
    //Einzelparameter: Operation
    //voriger Parameter war ein first nibble, bei 1 Byte Werten Position incr
    if(nibbleSetted == 1) currentPos++;
    nibbleSetted = 0;
    tempValue = gBAP_Indication_data[currentPos++];
    putValue(A_ASG_69_0_0_34_1, tempValue);
    //Einzelparameter: Type
    //voriger Parameter war ein first nibble, bei 1 Byte Werten Position incr
    if(nibbleSetted == 1) currentPos++;
    nibbleSetted = 0;
    tempValue = gBAP_Indication_data[currentPos++];
    putValue(A_ASG_69_0_0_34_2, tempValue);
    //Einzelparameter: Slot
    //voriger Parameter war ein first nibble, bei 1 Byte Werten Position incr
    if(nibbleSetted == 1) currentPos++;
    nibbleSetted = 0;
    tempValue = gBAP_Indication_data[currentPos++];
    putValue(A_ASG_69_0_0_34_3, tempValue);
    //Einzelparameter: State
    //voriger Parameter war ein first nibble, bei 1 Byte Werten Position incr
    if(nibbleSetted == 1) currentPos++;
    nibbleSetted = 0;
    tempValue = gBAP_Indication_data[currentPos++];
    putValue(A_ASG_69_0_0_34_4, tempValue);
    //Einzelparameter: ASG_ID
    if(nibbleSetted == 1)
    {
        //voriger Parameter war ein Nibble, => second nibble, Pos incr und Flag zuruecksetzen
        tempValue = (gBAP_Indication_data[currentPos++] &0xF);
        nibbleSetted = 0;
    }
    else
    {
        //first nibble, kein increment, Flag setzen
        tempValue = ((gBAP_Indication_data[currentPos]>>4) &0xF);
        nibbleSetted = 1;
    }
    putValue(A_ASG_69_0_0_34_5, tempValue);
    //Einzelparameter: TAID
    if(nibbleSetted == 1)
    {
        //voriger Parameter war ein Nibble, => second nibble, Pos incr und Flag zuruecksetzen
        tempValue = (gBAP_Indication_data[currentPos++] &0xF);
        nibbleSetted = 0;
    }
    else
    {
        //first nibble, kein increment, Flag setzen
        tempValue = ((gBAP_Indication_data[currentPos]>>4) &0xF);
        nibbleSetted = 1;
    }
    putValue(A_ASG_69_0_0_34_6, tempValue);
    //Einzelparameter: TotalNumListElements
    //voriger Parameter war ein first nibble, bei 2 Byte Werten Position incr
    if(nibbleSetted == 1) currentPos++;
    nibbleSetted = 0;
    tempValue =  (gBAP_Indication_data[currentPos++] & 0xFF);
    tempValue += (gBAP_Indication_data[currentPos++] & 0xFF) << 8;
    putValue(A_ASG_69_0_0_34_7, tempValue);
    //head Parameter
    if(gBAP_Indication_header[4] >= (3+currentPos))
    {
        if( (gBAP_Indication_data[currentPos] & 0x80) > 0)
            if(gBAP_Indication_header[4] >= (5+currentPos))
            {
                for(i = 0; i < 5; i++) head[i] = gBAP_Indication_data[currentPos++];
                putValue(A_ASG_69_0_0_34, head, 5);
                startVal = (head[2]<<8) | head[1];
                elementsVal = (head[4]<<8) | head[3];
            }
            else write("received Data Error");
        else
        {
            for(i = 0; i < 3; i++) head[i] = gBAP_Indication_data[currentPos++];
            putValue(A_ASG_69_0_0_34, head, 3);
                startVal = head[1];
                elementsVal = head[2];
        }
        recordAddressVal = head[0] & 0x0F;
        transmitPosVal = head[0] & 0x40;
    }
    //data Parameter
     nibbleSetted = 0;
    if( (head[0] & 0x20) == 0) { // array header: increasing indices (Direction = 0).
      if( (head[0] & 0x10) > 0) { // array header: first element is one after specified start element (Shift = 1, Direction = 0).
        startVal++;
      }
      for ( i = startVal ; i < startVal + elementsVal ; i++) {
        if ( i < 0 || i >= A_ASG_69_0_0_34_ArrayDataList_Length ) {
          write("Array index ausserhalb der Grenzen, Fct: 34");
          break;
        }
        if(nibbleSetted == 1) currentPos++;
        nibbleSetted = 0;
     if( (head[0]&0x40) == 0){ /* Transmit_Pos = 0, keine Positionsdaten */ }
     else
     {
        if( (head[0]&0x80) == 0)
        {
           //IndexSize = 0, Pos als 1 Byte Wert
           //Kein POS definiert
        }
        else
        {
           //IndexSize = 1, Pos als 2 Byte Wert
           //Kein POS definiert
        }
     }
      // 0 - es kann vorkommen, dass das if leer ist dies wuerde zum Fehler fuehren. => automatische generierung der 0
      if( 0 || 1 == recordAddressVal || 2 == recordAddressVal || 3 == recordAddressVal )
      {
        //Sollte vor einem 4 Byte Wert 1 Nibble kommen, muss der index um 1 incrementiert werden!
        if( nibbleSetted==1) currentPos++;
        nibbleSetted = 0;
        A_ASG_69_0_0_34_ArrayDataList[i].Param1 = (gBAP_Indication_data[currentPos++] & 0xFF) + ((gBAP_Indication_data[currentPos++] & 0xFF) <<8) + ((gBAP_Indication_data[currentPos++] & 0xFF) <<16) + ((gBAP_Indication_data[currentPos++] & 0xFF) <<24);
      }
      // 0 - es kann vorkommen, dass das if leer ist dies wuerde zum Fehler fuehren. => automatische generierung der 0
      if( 0 || 1 == recordAddressVal || 2 == recordAddressVal || 3 == recordAddressVal )
      {
        //Sollte vor einem 1 Byte Wert 1 Nibble kommen, muss der index um 1 incrementiert werden!
        if( nibbleSetted==1) currentPos++;
        nibbleSetted = 0;
        A_ASG_69_0_0_34_ArrayDataList[i].Param2 = (gBAP_Indication_data[currentPos++] & 0xFF);
      }
      // 0 - es kann vorkommen, dass das if leer ist dies wuerde zum Fehler fuehren. => automatische generierung der 0
      if( 0 || 2 == recordAddressVal || 3 == recordAddressVal )
      {
        //Sollte vor einem 1 Byte Wert 1 Nibble kommen, muss der index um 1 incrementiert werden!
        if( nibbleSetted==1) currentPos++;
        nibbleSetted = 0;
        A_ASG_69_0_0_34_ArrayDataList[i].Param3 = (gBAP_Indication_data[currentPos++] & 0xFF);
      }
      // 0 - es kann vorkommen, dass das if leer ist dies wuerde zum Fehler fuehren. => automatische generierung der 0
      if( 0 || 3 == recordAddressVal )
      {
        //Sollte vor einem 4 Byte Wert 1 Nibble kommen, muss der index um 1 incrementiert werden!
        if( nibbleSetted==1) currentPos++;
        nibbleSetted = 0;
        A_ASG_69_0_0_34_ArrayDataList[i].Param4 = (gBAP_Indication_data[currentPos++] & 0xFF) + ((gBAP_Indication_data[currentPos++] & 0xFF) <<8) + ((gBAP_Indication_data[currentPos++] & 0xFF) <<16) + ((gBAP_Indication_data[currentPos++] & 0xFF) <<24);
      }
      // 0 - es kann vorkommen, dass das if leer ist dies wuerde zum Fehler fuehren. => automatische generierung der 0
      if( ( 0 || 3 == recordAddressVal ) && (A_ASG_69_0_0_34_ArrayDataList[i].Param4 != 0) )
      {
        //Sollte vor einem String Wert 1 Nibble kommen, muss der index um 1 incrementiert werden!
        /*if( nibbleSetted==1) currentPos++;
        nibbleSetted = 0;
        if((gBAP_Indication_data[currentPos] & 0x80) >= 1)
        {
        	 A_ASG_69_0_0_34_Data_5_CntList[i] = 1;
            A_ASG_69_0_0_34_ArrayDataList[i].Param5_Length = ( (gBAP_Indication_data[currentPos++] & 0x7F) << 8) + (gBAP_Indication_data[currentPos++] & 0xFF);
        }
        else
        {
        	 A_ASG_69_0_0_34_Data_5_CntList[i] = 0;
            A_ASG_69_0_0_34_ArrayDataList[i].Param5_Length = gBAP_Indication_data[currentPos++] & 0x7F;
        }
		write("lenth  = %d", A_ASG_69_0_0_34_ArrayDataList[i].Param5_Length);
        for(j = 0; j < A_ASG_69_0_0_34_ArrayDataList[i].Param5_Length; j++)
        {
            A_ASG_69_0_0_34_ArrayDataList[i].Param5[j] = gBAP_Indication_data[currentPos++];
			write("ata  = %d", A_ASG_69_0_0_34_ArrayDataList[i].Param5[j]);
        }*/
		//Sollte vor einem String Wert 1 Nibble kommen, muss der index um 1 incrementiert werden!
        if( nibbleSetted==1) currentPos++;
        nibbleSetted = 0;
        if((gBAP_Indication_data[currentPos] & 0x80) >= 1) // CG Anpassung fuer PSO
        {
        	 A_ASG_69_0_0_34_Data_5_CntList[i] = 1;//1;
            A_ASG_69_0_0_34_ArrayDataList[i].Param5_Length = 1;//( (gBAP_Indication_data[currentPos++] & 0x7F) << 8) + (gBAP_Indication_data[currentPos++] & 0xFF);
        }
        else
        {
        	 A_ASG_69_0_0_34_Data_5_CntList[i] = 1;
            A_ASG_69_0_0_34_ArrayDataList[i].Param5_Length = 1;//gBAP_Indication_data[currentPos++] & 0x7F;
        }
        for(j = 0; j < A_ASG_69_0_0_34_ArrayDataList[i].Param5_Length; j++)
        {
            A_ASG_69_0_0_34_ArrayDataList[i].Param5[j] = gBAP_Indication_data[currentPos++];
        }
      }
      } // for
    } else { // array header: decreasing indices (Direction = 1).
      if( (head[0] & 0x10) > 0) { // array header: first element is one before specified start element (Shift = 1, Direction = 1).
        if(startVal != 0) {          startVal--;
        } else {
          startVal = A_ASG_69_0_0_34_ArrayDataList_Length -1;
        }
      }
      for ( i = startVal ; i > startVal - elementsVal ; i--) {
        if ( i < 0 || i >= A_ASG_69_0_0_34_ArrayDataList_Length ) {
          write("Array index ausserhalb der Grenzen, Fct: 34");
          break;
        }
        if(nibbleSetted == 1) currentPos++;
        nibbleSetted = 0;
     if( (head[0]&0x40) == 0){ /* Transmit_Pos = 0, keine Positionsdaten */ }
     else
     {
        if( (head[0]&0x80) == 0)
        {
           //IndexSize = 0, Pos als 1 Byte Wert
           //Kein POS definiert
        }
        else
        {
           //IndexSize = 1, Pos als 2 Byte Wert
           //Kein POS definiert
        }
     }
      // 0 - es kann vorkommen, dass das if leer ist dies wuerde zum Fehler fuehren. => automatische generierung der 0
      if( 0 || 1 == recordAddressVal || 2 == recordAddressVal || 3 == recordAddressVal )
      {
        //Sollte vor einem 4 Byte Wert 1 Nibble kommen, muss der index um 1 incrementiert werden!
        if( nibbleSetted==1) currentPos++;
        nibbleSetted = 0;
        A_ASG_69_0_0_34_ArrayDataList[i].Param1 = (gBAP_Indication_data[currentPos++] & 0xFF) + ((gBAP_Indication_data[currentPos++] & 0xFF) <<8) + ((gBAP_Indication_data[currentPos++] & 0xFF) <<16) + ((gBAP_Indication_data[currentPos++] & 0xFF) <<24);
      }
      // 0 - es kann vorkommen, dass das if leer ist dies wuerde zum Fehler fuehren. => automatische generierung der 0
      if( 0 || 1 == recordAddressVal || 2 == recordAddressVal || 3 == recordAddressVal )
      {
        //Sollte vor einem 1 Byte Wert 1 Nibble kommen, muss der index um 1 incrementiert werden!
        if( nibbleSetted==1) currentPos++;
        nibbleSetted = 0;
        A_ASG_69_0_0_34_ArrayDataList[i].Param2 = (gBAP_Indication_data[currentPos++] & 0xFF);
      }
      // 0 - es kann vorkommen, dass das if leer ist dies wuerde zum Fehler fuehren. => automatische generierung der 0
      if( 0 || 2 == recordAddressVal || 3 == recordAddressVal )
      {
        //Sollte vor einem 1 Byte Wert 1 Nibble kommen, muss der index um 1 incrementiert werden!
        if( nibbleSetted==1) currentPos++;
        nibbleSetted = 0;
        A_ASG_69_0_0_34_ArrayDataList[i].Param3 = (gBAP_Indication_data[currentPos++] & 0xFF);
      }
      // 0 - es kann vorkommen, dass das if leer ist dies wuerde zum Fehler fuehren. => automatische generierung der 0
      if( 0 || 3 == recordAddressVal )
      {
        //Sollte vor einem 4 Byte Wert 1 Nibble kommen, muss der index um 1 incrementiert werden!
        if( nibbleSetted==1) currentPos++;
        nibbleSetted = 0;
        A_ASG_69_0_0_34_ArrayDataList[i].Param4 = (gBAP_Indication_data[currentPos++] & 0xFF) + ((gBAP_Indication_data[currentPos++] & 0xFF) <<8) + ((gBAP_Indication_data[currentPos++] & 0xFF) <<16) + ((gBAP_Indication_data[currentPos++] & 0xFF) <<24);
      }
      // 0 - es kann vorkommen, dass das if leer ist dies wuerde zum Fehler fuehren. => automatische generierung der 0
      if( (0 || 3 == recordAddressVal) && (A_ASG_69_0_0_34_ArrayDataList[i].Param4 != 0) )
      {
        //Sollte vor einem String Wert 1 Nibble kommen, muss der index um 1 incrementiert werden!
        /*if( nibbleSetted==1) currentPos++;
        nibbleSetted = 0;
        if((gBAP_Indication_data[currentPos] & 0x80) >= 1)
        {
        	 A_ASG_69_0_0_34_Data_5_CntList[i] = 1;
            A_ASG_69_0_0_34_ArrayDataList[i].Param5_Length = ( (gBAP_Indication_data[currentPos++] & 0x7F) << 8) + (gBAP_Indication_data[currentPos++] & 0xFF);
        }
        else
        {
        	 A_ASG_69_0_0_34_Data_5_CntList[i] = 0;
            A_ASG_69_0_0_34_ArrayDataList[i].Param5_Length = gBAP_Indication_data[currentPos++] & 0x7F;
        }
        for(j = 0; j < A_ASG_69_0_0_34_ArrayDataList[i].Param5_Length; j++)
        {
            A_ASG_69_0_0_34_ArrayDataList[i].Param5[j] = gBAP_Indication_data[currentPos++];
        }*/
		//Sollte vor einem String Wert 1 Nibble kommen, muss der index um 1 incrementiert werden!
        if( nibbleSetted==1) currentPos++;
        nibbleSetted = 0;
        if((gBAP_Indication_data[currentPos] & 0x80) >= 1) // CG Anpassung fuer PSO
        {
        	 A_ASG_69_0_0_34_Data_5_CntList[i] = 0;//1;
            A_ASG_69_0_0_34_ArrayDataList[i].Param5_Length = 1; //( (gBAP_Indication_data[currentPos++] & 0x7F) << 8) + (gBAP_Indication_data[currentPos++] & 0xFF);
        }
        else
        {
        	 A_ASG_69_0_0_34_Data_5_CntList[i] = 0;//1;
            A_ASG_69_0_0_34_ArrayDataList[i].Param5_Length = 1; //gBAP_Indication_data[currentPos++] & 0x7F;
        }
        for(j = 0; j < A_ASG_69_0_0_34_ArrayDataList[i].Param5_Length; j++)
        {
            A_ASG_69_0_0_34_ArrayDataList[i].Param5[j] = gBAP_Indication_data[currentPos++];
        }
      }
      } // for
    }
    nibbleSetted = 0;
index = getValue(A_ASG_69_0_0_34_DataIndex);
    putValue(A_ASG_69_0_0_34_Data_1, A_ASG_69_0_0_34_ArrayDataList[index].Param1);
    putValue(A_ASG_69_0_0_34_Data_2, A_ASG_69_0_0_34_ArrayDataList[index].Param2);
    putValue(A_ASG_69_0_0_34_Data_3, A_ASG_69_0_0_34_ArrayDataList[index].Param3);
    putValue(A_ASG_69_0_0_34_Data_4, A_ASG_69_0_0_34_ArrayDataList[index].Param4);
    putValue(A_ASG_69_0_0_34_Data_5_len, A_ASG_69_0_0_34_Data_5_LenList[index]);
    putValue(A_ASG_69_0_0_34_Data_5_cnt, A_ASG_69_0_0_34_Data_5_CntList[index]);
    putValue(A_ASG_69_0_0_34_Data_5, A_ASG_69_0_0_34_ArrayDataList[index].Param5, A_ASG_69_0_0_34_ArrayDataList[index].Param5_Length);
}

A_ASG_69_0_0_34_ChangedInd()
{
    int currentPos;
    byte head[5];
    byte stringTempValue[122];
    int i;
    int j;
    int startVal;
    int elementsVal;
    byte recordAddressVal;
    byte transmitPosVal;
    long tempValue;
    long index;
    byte nibbleSetted;
    currentPos = 0;
    nibbleSetted = 0;
    //Einzelparameter: Operation
    //voriger Parameter war ein first nibble, bei 1 Byte Werten Position incr
    if(nibbleSetted == 1) currentPos++;
    nibbleSetted = 0;
    tempValue = gBAP_Indication_data[currentPos++];
    putValue(A_ASG_69_0_0_34_1_Changed, tempValue);
    //Einzelparameter: Type
    //voriger Parameter war ein first nibble, bei 1 Byte Werten Position incr
    if(nibbleSetted == 1) currentPos++;
    nibbleSetted = 0;
    tempValue = gBAP_Indication_data[currentPos++];
    putValue(A_ASG_69_0_0_34_2_Changed, tempValue);
    //Einzelparameter: Slot
    //voriger Parameter war ein first nibble, bei 1 Byte Werten Position incr
    if(nibbleSetted == 1) currentPos++;
    nibbleSetted = 0;
    tempValue = gBAP_Indication_data[currentPos++];
    putValue(A_ASG_69_0_0_34_3_Changed, tempValue);
    //head Parameter
    if(gBAP_Indication_header[4] >= (3+currentPos))
    {
        if( (gBAP_Indication_data[currentPos] & 0x80) > 0)
            if(gBAP_Indication_header[4] >= (5+currentPos))
            {
                for(i = 0; i < 5; i++) head[i] = gBAP_Indication_data[currentPos++];
                putValue(A_ASG_69_0_0_34_Changed, head, 5);
                startVal = (head[2]<<8) | head[1];
                elementsVal = (head[4]<<8) | head[3];
            }
            else write("received Data Error");
        else
        {
            for(i = 0; i < 3; i++) head[i] = gBAP_Indication_data[currentPos++];
            putValue(A_ASG_69_0_0_34_Changed, head, 3);
                startVal = head[1];
                elementsVal = head[2];
        }
        recordAddressVal = head[0] & 0x0F;
        transmitPosVal = head[0] & 0x40;
    }
}




on envVar A_ASG_69_0_0_34_1
{
	byte superval[122];

	//Update Childvalue (Enum)
	byte thisval; // Operation
	thisval = getValue(this);
}
on envVar A_ASG_69_0_0_34_2
{
	byte superval[122];

	//Update Childvalue (Enum)
	byte thisval; // Type
	thisval = getValue(this);
}
// Ueberwachung der Darstellungsvariable der Range.
on envVar A_ASG_69_0_0_34_3_range // PSO_ImExport.Slot 
{
	@A_ASG_69_0_0_34_3 = @A_ASG_69_0_0_34_3_range - (0); // slider = range - min
}

on envVar A_ASG_69_0_0_34_3
{
	byte superval[122];

	//Update Childvalue (Number)
	byte thisval; // Slot
	float slider_value;

	slider_value = round(@A_ASG_69_0_0_34_3, 1.0);
	@A_ASG_69_0_0_34_3_range = slider_value + (0); // real value := slider value + range min.
	thisval = (byte)round((slider_value + (0) - (0)) / (1.0), 1); // bus value := (slider value + min - offset) / step.
}
on envVar A_ASG_69_0_0_34_4_0
{
	byte bitval;
	//thisval steht hier fuer den bitfield-wert, 
	//aus Generierungsgruenden hier keine einheitliche Bezeichnung moeglich.
	byte thisval; // State
	bitval= getValue(this);
	thisval = getValue(A_ASG_69_0_0_34_4);
	thisval = thisval&~(1<<0)|(bitval<<0);
	putValue(A_ASG_69_0_0_34_4,thisval);
}

on envVar A_ASG_69_0_0_34_4_1
{
	byte bitval;
	//thisval steht hier fuer den bitfield-wert, 
	//aus Generierungsgruenden hier keine einheitliche Bezeichnung moeglich.
	byte thisval; // State
	bitval= getValue(this);
	thisval = getValue(A_ASG_69_0_0_34_4);
	thisval = thisval&~(1<<1)|(bitval<<1);
	putValue(A_ASG_69_0_0_34_4,thisval);
}

on envVar A_ASG_69_0_0_34_4_2
{
	byte bitval;
	//thisval steht hier fuer den bitfield-wert, 
	//aus Generierungsgruenden hier keine einheitliche Bezeichnung moeglich.
	byte thisval; // State
	bitval= getValue(this);
	thisval = getValue(A_ASG_69_0_0_34_4);
	thisval = thisval&~(1<<2)|(bitval<<2);
	putValue(A_ASG_69_0_0_34_4,thisval);
}

on envVar A_ASG_69_0_0_34_4
{
	byte superval[122];

	//Update Childvalue (BitField)
	byte mask=0x01;
	int i = 0;
	byte thisval; // State
	thisval = getValue(this);
	if(thisval&(mask<<0))
		putValue(A_ASG_69_0_0_34_4_0, 1);
	else
		putValue(A_ASG_69_0_0_34_4_0, 0);
	if(thisval&(mask<<1))
		putValue(A_ASG_69_0_0_34_4_1, 1);
	else
		putValue(A_ASG_69_0_0_34_4_1, 0);
	if(thisval&(mask<<2))
		putValue(A_ASG_69_0_0_34_4_2, 1);
	else
		putValue(A_ASG_69_0_0_34_4_2, 0);
}
on envVar A_ASG_69_0_0_34_5
{
	byte superval[122];

	//Update Childvalue (Enum)
	byte thisval; // ASG_ID
	thisval = 0x0f & getValue(this);
}
// Ueberwachung der Darstellungsvariable der Range.
on envVar A_ASG_69_0_0_34_6_range // PSO_ImExport.TAID 
{
	@A_ASG_69_0_0_34_6 = @A_ASG_69_0_0_34_6_range - (0); // slider = range - min
}

on envVar A_ASG_69_0_0_34_6
{
	byte superval[122];

	//Update Childvalue (Number)
	byte thisval; // TAID
	float slider_value;

	slider_value = round(@A_ASG_69_0_0_34_6, 1.0);
	@A_ASG_69_0_0_34_6_range = slider_value + (0); // real value := slider value + range min.
	thisval = (byte)round((slider_value + (0) - (0)) / (1.0), 1); // bus value := (slider value + min - offset) / step.
}
// Ueberwachung der Darstellungsvariable der Range.
on envVar A_ASG_69_0_0_34_7_range // PSO_ImExport.TotalNumListElements 
{
	@A_ASG_69_0_0_34_7 = @A_ASG_69_0_0_34_7_range - (0); // slider = range - min
}

on envVar A_ASG_69_0_0_34_7
{
	byte superval[122];

	//Update Childvalue (Number)
	word thisval; // TotalNumListElements
	float slider_value;

	slider_value = round(@A_ASG_69_0_0_34_7, 1.0);
	@A_ASG_69_0_0_34_7_range = slider_value + (0); // real value := slider value + range min.
	thisval = (word)round((slider_value + (0) - (0)) / (1.0), 1); // bus value := (slider value + min - offset) / step.
}
// Ueberwachung der Darstellungsvariable der Range.
on envVar A_ASG_69_0_0_34_Data_1_range // PSO_ImExport.Parameter_ID 
{
	@A_ASG_69_0_0_34_Data_1 = @A_ASG_69_0_0_34_Data_1_range - (0); // slider = range - min
}

on envVar A_ASG_69_0_0_34_Data_1
{
	byte superval[122];

	//Update Childvalue (Number)
	dword thisval; // Parameter_ID
	float slider_value;

	slider_value = round(@A_ASG_69_0_0_34_Data_1, 1.0);
	@A_ASG_69_0_0_34_Data_1_range = slider_value + (0); // real value := slider value + range min.
	thisval = (dword)round((slider_value + (0) - (0)) / (1.0), 1); // bus value := (slider value + min - offset) / step.
    A_ASG_69_0_0_34_ArrayDataList[getValue(A_ASG_69_0_0_34_DataIndex)].Param1 = thisval;
}
// Ueberwachung der Darstellungsvariable der Range.
on envVar A_ASG_69_0_0_34_Data_2_range // PSO_ImExport.DataDescription 
{
	@A_ASG_69_0_0_34_Data_2 = @A_ASG_69_0_0_34_Data_2_range - (0); // slider = range - min
}

on envVar A_ASG_69_0_0_34_Data_2
{
	byte superval[122];

	//Update Childvalue (Number)
	byte thisval; // DataDescription
	float slider_value;

	slider_value = round(@A_ASG_69_0_0_34_Data_2, 1.0);
	@A_ASG_69_0_0_34_Data_2_range = slider_value + (0); // real value := slider value + range min.
	thisval = (byte)round((slider_value + (0) - (0)) / (1.0), 1); // bus value := (slider value + min - offset) / step.
    A_ASG_69_0_0_34_ArrayDataList[getValue(A_ASG_69_0_0_34_DataIndex)].Param2 = thisval;
}
on envVar A_ASG_69_0_0_34_Data_3_0
{
	byte bitval;
	//thisval steht hier fuer den bitfield-wert, 
	//aus Generierungsgruenden hier keine einheitliche Bezeichnung moeglich.
	byte thisval; // DataTag
	bitval= getValue(this);
	thisval = getValue(A_ASG_69_0_0_34_Data_3);
	thisval = thisval&~(1<<0)|(bitval<<0);
	putValue(A_ASG_69_0_0_34_Data_3,thisval);
}

on envVar A_ASG_69_0_0_34_Data_3_4
{
	byte bitval;
	//thisval steht hier fuer den bitfield-wert, 
	//aus Generierungsgruenden hier keine einheitliche Bezeichnung moeglich.
	byte thisval; // DataTag
	bitval= getValue(this);
	thisval = getValue(A_ASG_69_0_0_34_Data_3);
	thisval = thisval&~(1<<4)|(bitval<<4);
	putValue(A_ASG_69_0_0_34_Data_3,thisval);
}

on envVar A_ASG_69_0_0_34_Data_3_5
{
	byte bitval;
	//thisval steht hier fuer den bitfield-wert, 
	//aus Generierungsgruenden hier keine einheitliche Bezeichnung moeglich.
	byte thisval; // DataTag
	bitval= getValue(this);
	thisval = getValue(A_ASG_69_0_0_34_Data_3);
	thisval = thisval&~(1<<5)|(bitval<<5);
	putValue(A_ASG_69_0_0_34_Data_3,thisval);
}

on envVar A_ASG_69_0_0_34_Data_3_6
{
	byte bitval;
	//thisval steht hier fuer den bitfield-wert, 
	//aus Generierungsgruenden hier keine einheitliche Bezeichnung moeglich.
	byte thisval; // DataTag
	bitval= getValue(this);
	thisval = getValue(A_ASG_69_0_0_34_Data_3);
	thisval = thisval&~(1<<6)|(bitval<<6);
	putValue(A_ASG_69_0_0_34_Data_3,thisval);
}

on envVar A_ASG_69_0_0_34_Data_3_7
{
	byte bitval;
	//thisval steht hier fuer den bitfield-wert, 
	//aus Generierungsgruenden hier keine einheitliche Bezeichnung moeglich.
	byte thisval; // DataTag
	bitval= getValue(this);
	thisval = getValue(A_ASG_69_0_0_34_Data_3);
	thisval = thisval&~(1<<7)|(bitval<<7);
	putValue(A_ASG_69_0_0_34_Data_3,thisval);
}

on envVar A_ASG_69_0_0_34_Data_3
{
	byte superval[122];

	//Update Childvalue (BitField)
	byte mask=0x01;
	int i = 0;
	byte thisval; // DataTag
	thisval = getValue(this);
	if(thisval&(mask<<0))
		putValue(A_ASG_69_0_0_34_Data_3_0, 1);
	else
		putValue(A_ASG_69_0_0_34_Data_3_0, 0);
	if(thisval&(mask<<4))
		putValue(A_ASG_69_0_0_34_Data_3_4, 1);
	else
		putValue(A_ASG_69_0_0_34_Data_3_4, 0);
	if(thisval&(mask<<5))
		putValue(A_ASG_69_0_0_34_Data_3_5, 1);
	else
		putValue(A_ASG_69_0_0_34_Data_3_5, 0);
	if(thisval&(mask<<6))
		putValue(A_ASG_69_0_0_34_Data_3_6, 1);
	else
		putValue(A_ASG_69_0_0_34_Data_3_6, 0);
	if(thisval&(mask<<7))
		putValue(A_ASG_69_0_0_34_Data_3_7, 1);
	else
		putValue(A_ASG_69_0_0_34_Data_3_7, 0);
    A_ASG_69_0_0_34_ArrayDataList[getValue(A_ASG_69_0_0_34_DataIndex)].Param3 = thisval;
}
// Ueberwachung der Darstellungsvariable der Range.
on envVar A_ASG_69_0_0_34_Data_4_range // PSO_ImExport.DataLength 
{
	@A_ASG_69_0_0_34_Data_4 = @A_ASG_69_0_0_34_Data_4_range - (0); // slider = range - min
}

on envVar A_ASG_69_0_0_34_Data_4
{
	byte superval[122];

	//Update Childvalue (Number)
	dword thisval; // DataLength
	float slider_value;

	slider_value = round(@A_ASG_69_0_0_34_Data_4, 1.0);
	@A_ASG_69_0_0_34_Data_4_range = slider_value + (0); // real value := slider value + range min.
	thisval = (dword)round((slider_value + (0) - (0)) / (1.0), 1); // bus value := (slider value + min - offset) / step.
    A_ASG_69_0_0_34_ArrayDataList[getValue(A_ASG_69_0_0_34_DataIndex)].Param4 = thisval;
}

// Ueberwachung der CheckBox fuer String
on envVar  A_ASG_69_0_0_34_Data_5_cnt
{
	word len;
	byte cnt;
	len = getValue(A_ASG_69_0_0_34_Data_5_len);
	cnt = getValue(this);

    /* Cnt Wert im Array aktualisieren */
	 A_ASG_69_0_0_34_Data_5_CntList[ getValue(A_ASG_69_0_0_34_DataIndex) ] = cnt;

	/* wird nur gerufen, wenn check box deaktiviert mit Length>127*/ 
	if(cnt == 0) 
	{
		if(len > 127 )
		{
			putValue(A_ASG_69_0_0_34_Data_5_len, 127);
		}
	}

}


on envVar A_ASG_69_0_0_34_Data_5_len
{
	long thisval;
	byte cnt;
	thisval = getValue(this);
	cnt = getValue(A_ASG_69_0_0_34_Data_5_cnt);

	/* wenn die Laenge ausserhalb des erlaubten Bereich liegt, wird diese begrenzt */
	if(thisval > 1)//if(thisval > 0 || thisval < 2 )
	{
		writelineEx(gBAP_Trace, 0, "Eingegebene Laenge: %d von A_ASG_69_0_0_34_Data_5 ist ungueltig. Die max. erlaubte Laenge ist %d. ", thisval, 1);
		thisval = 1;//2;
	}
	if( thisval >127)
	{
		putValue(A_ASG_69_0_0_34_Data_5_cnt, 1); /* Switch checkbox on */
	}

	A_ASG_69_0_0_34_ArrayDataList[getValue(A_ASG_69_0_0_34_DataIndex)].Param5_Length = thisval;
	A_ASG_69_0_0_34_Data_5_LenList[ getValue(A_ASG_69_0_0_34_DataIndex) ] = thisval;
	putValue(A_ASG_69_0_0_34_Data_5_len, thisval);

}

on envVar A_ASG_69_0_0_34_Data_5
{
	byte superval[122];

	//Update Childvalue (String)
	word i;
	byte thisval[118];
	getValue(this, thisval);
    for(i = 0; i < getValueSize(this); i++)
        A_ASG_69_0_0_34_ArrayDataList[getValue(A_ASG_69_0_0_34_DataIndex)].Param5[i] = thisval[i];
    A_ASG_69_0_0_34_ArrayDataList[getValue(A_ASG_69_0_0_34_DataIndex)].Param5_Length = getValueSize(this);
    A_ASG_69_0_0_34_Data_5_LenList[getValue(A_ASG_69_0_0_34_DataIndex)]= getValueSize(this);
    putValue(A_ASG_69_0_0_34_Data_5_len, getValueSize(this));
}
on envVar A_ASG_69_0_0_34_1_Changed
{
	byte superval[122];

	//Update Childvalue (Enum)
	byte thisval; // Operation
	thisval = getValue(this);
}
on envVar A_ASG_69_0_0_34_2_Changed
{
	byte superval[122];

	//Update Childvalue (Enum)
	byte thisval; // Type
	thisval = getValue(this);
}
// Ueberwachung der Darstellungsvariable der Range.
on envVar A_ASG_69_0_0_34_3_Changed_range // PSO_ImExport.Slot 
{
	@A_ASG_69_0_0_34_3_Changed = @A_ASG_69_0_0_34_3_Changed_range - (0); // slider = range - min
}

on envVar A_ASG_69_0_0_34_3_Changed
{
	byte superval[122];

	//Update Childvalue (Number)
	byte thisval; // Slot
	float slider_value;

	slider_value = round(@A_ASG_69_0_0_34_3_Changed, 1.0);
	@A_ASG_69_0_0_34_3_Changed_range = slider_value + (0); // real value := slider value + range min.
	thisval = (byte)round((slider_value + (0) - (0)) / (1.0), 1); // bus value := (slider value + min - offset) / step.
}
on envVar A_ASG_69_0_0_34_1_SetGet
{
	byte superval[119];

	//Update Childvalue (Enum)
	byte thisval; // Operation
	thisval = getValue(this);
}
on envVar A_ASG_69_0_0_34_2_SetGet
{
	byte superval[119];

	//Update Childvalue (Enum)
	byte thisval; // Type
	thisval = getValue(this);
}
// Ueberwachung der Darstellungsvariable der Range.
on envVar A_ASG_69_0_0_34_3_SetGet_range // PSO_ImExport.Slot 
{
	@A_ASG_69_0_0_34_3_SetGet = @A_ASG_69_0_0_34_3_SetGet_range - (0); // slider = range - min
}

on envVar A_ASG_69_0_0_34_3_SetGet
{
	byte superval[119];

	//Update Childvalue (Number)
	byte thisval; // Slot
	float slider_value;

	slider_value = round(@A_ASG_69_0_0_34_3_SetGet, 1.0);
	@A_ASG_69_0_0_34_3_SetGet_range = slider_value + (0); // real value := slider value + range min.
	thisval = (byte)round((slider_value + (0) - (0)) / (1.0), 1); // bus value := (slider value + min - offset) / step.
}
on envVar A_ASG_69_0_0_34_4_SetGet
{
	byte superval[119];

	//Update Childvalue (Enum)
	byte thisval; // ASG_ID
	thisval = 0x0f & getValue(this);
}
// Ueberwachung der Darstellungsvariable der Range.
on envVar A_ASG_69_0_0_34_5_SetGet_range // PSO_ImExport.TAID 
{
	@A_ASG_69_0_0_34_5_SetGet = @A_ASG_69_0_0_34_5_SetGet_range - (0); // slider = range - min
}

on envVar A_ASG_69_0_0_34_5_SetGet
{
	byte superval[119];

	//Update Childvalue (Number)
	byte thisval; // TAID
	float slider_value;

	slider_value = round(@A_ASG_69_0_0_34_5_SetGet, 1.0);
	@A_ASG_69_0_0_34_5_SetGet_range = slider_value + (0); // real value := slider value + range min.
	thisval = (byte)round((slider_value + (0) - (0)) / (1.0), 1); // bus value := (slider value + min - offset) / step.
}
// Ueberwachung der Darstellungsvariable der Range.
on envVar A_ASG_69_0_0_34_Data_1_SetGet_range // PSO_ImExport.Parameter_ID 
{
	@A_ASG_69_0_0_34_Data_1_SetGet = @A_ASG_69_0_0_34_Data_1_SetGet_range - (0); // slider = range - min
}

on envVar A_ASG_69_0_0_34_Data_1_SetGet
{
	byte superval[119];

	//Update Childvalue (Number)
	dword thisval; // Parameter_ID
	float slider_value;

	slider_value = round(@A_ASG_69_0_0_34_Data_1_SetGet, 1.0);
	@A_ASG_69_0_0_34_Data_1_SetGet_range = slider_value + (0); // real value := slider value + range min.
	thisval = (dword)round((slider_value + (0) - (0)) / (1.0), 1); // bus value := (slider value + min - offset) / step.
    A_ASG_69_0_0_34_ArrayDataList[getValue(A_ASG_69_0_0_34_DataIndex_SetGet)].Param1 = thisval;
}
// Ueberwachung der Darstellungsvariable der Range.
on envVar A_ASG_69_0_0_34_Data_2_SetGet_range // PSO_ImExport.DataDescription 
{
	@A_ASG_69_0_0_34_Data_2_SetGet = @A_ASG_69_0_0_34_Data_2_SetGet_range - (0); // slider = range - min
}

on envVar A_ASG_69_0_0_34_Data_2_SetGet
{
	byte superval[119];

	//Update Childvalue (Number)
	byte thisval; // DataDescription
	float slider_value;

	slider_value = round(@A_ASG_69_0_0_34_Data_2_SetGet, 1.0);
	@A_ASG_69_0_0_34_Data_2_SetGet_range = slider_value + (0); // real value := slider value + range min.
	thisval = (byte)round((slider_value + (0) - (0)) / (1.0), 1); // bus value := (slider value + min - offset) / step.
    A_ASG_69_0_0_34_ArrayDataList[getValue(A_ASG_69_0_0_34_DataIndex_SetGet)].Param2 = thisval;
}
on envVar A_ASG_69_0_0_34_Data_3_SetGet_0
{
	byte bitval;
	//thisval steht hier fuer den bitfield-wert, 
	//aus Generierungsgruenden hier keine einheitliche Bezeichnung moeglich.
	byte thisval; // DataTag
	bitval= getValue(this);
	thisval = getValue(A_ASG_69_0_0_34_Data_3_SetGet);
	thisval = thisval&~(1<<0)|(bitval<<0);
	putValue(A_ASG_69_0_0_34_Data_3_SetGet,thisval);
}

on envVar A_ASG_69_0_0_34_Data_3_SetGet_4
{
	byte bitval;
	//thisval steht hier fuer den bitfield-wert, 
	//aus Generierungsgruenden hier keine einheitliche Bezeichnung moeglich.
	byte thisval; // DataTag
	bitval= getValue(this);
	thisval = getValue(A_ASG_69_0_0_34_Data_3_SetGet);
	thisval = thisval&~(1<<4)|(bitval<<4);
	putValue(A_ASG_69_0_0_34_Data_3_SetGet,thisval);
}

on envVar A_ASG_69_0_0_34_Data_3_SetGet_5
{
	byte bitval;
	//thisval steht hier fuer den bitfield-wert, 
	//aus Generierungsgruenden hier keine einheitliche Bezeichnung moeglich.
	byte thisval; // DataTag
	bitval= getValue(this);
	thisval = getValue(A_ASG_69_0_0_34_Data_3_SetGet);
	thisval = thisval&~(1<<5)|(bitval<<5);
	putValue(A_ASG_69_0_0_34_Data_3_SetGet,thisval);
}

on envVar A_ASG_69_0_0_34_Data_3_SetGet_6
{
	byte bitval;
	//thisval steht hier fuer den bitfield-wert, 
	//aus Generierungsgruenden hier keine einheitliche Bezeichnung moeglich.
	byte thisval; // DataTag
	bitval= getValue(this);
	thisval = getValue(A_ASG_69_0_0_34_Data_3_SetGet);
	thisval = thisval&~(1<<6)|(bitval<<6);
	putValue(A_ASG_69_0_0_34_Data_3_SetGet,thisval);
}

on envVar A_ASG_69_0_0_34_Data_3_SetGet_7
{
	byte bitval;
	//thisval steht hier fuer den bitfield-wert, 
	//aus Generierungsgruenden hier keine einheitliche Bezeichnung moeglich.
	byte thisval; // DataTag
	bitval= getValue(this);
	thisval = getValue(A_ASG_69_0_0_34_Data_3_SetGet);
	thisval = thisval&~(1<<7)|(bitval<<7);
	putValue(A_ASG_69_0_0_34_Data_3_SetGet,thisval);
}

on envVar A_ASG_69_0_0_34_Data_3_SetGet
{
	byte superval[119];

	//Update Childvalue (BitField)
	byte mask=0x01;
	int i = 0;
	byte thisval; // DataTag
	thisval = getValue(this);
	if(thisval&(mask<<0))
		putValue(A_ASG_69_0_0_34_Data_3_SetGet_0, 1);
	else
		putValue(A_ASG_69_0_0_34_Data_3_SetGet_0, 0);
	if(thisval&(mask<<4))
		putValue(A_ASG_69_0_0_34_Data_3_SetGet_4, 1);
	else
		putValue(A_ASG_69_0_0_34_Data_3_SetGet_4, 0);
	if(thisval&(mask<<5))
		putValue(A_ASG_69_0_0_34_Data_3_SetGet_5, 1);
	else
		putValue(A_ASG_69_0_0_34_Data_3_SetGet_5, 0);
	if(thisval&(mask<<6))
		putValue(A_ASG_69_0_0_34_Data_3_SetGet_6, 1);
	else
		putValue(A_ASG_69_0_0_34_Data_3_SetGet_6, 0);
	if(thisval&(mask<<7))
		putValue(A_ASG_69_0_0_34_Data_3_SetGet_7, 1);
	else
		putValue(A_ASG_69_0_0_34_Data_3_SetGet_7, 0);
    A_ASG_69_0_0_34_ArrayDataList[getValue(A_ASG_69_0_0_34_DataIndex_SetGet)].Param3 = thisval;
}
// Ueberwachung der Darstellungsvariable der Range.
on envVar A_ASG_69_0_0_34_Data_4_SetGet_range // PSO_ImExport.DataLength 
{
	@A_ASG_69_0_0_34_Data_4_SetGet = @A_ASG_69_0_0_34_Data_4_SetGet_range - (0); // slider = range - min
}

on envVar A_ASG_69_0_0_34_Data_4_SetGet
{
	byte superval[119];

	//Update Childvalue (Number)
	dword thisval; // DataLength
	float slider_value;

	slider_value = round(@A_ASG_69_0_0_34_Data_4_SetGet, 1.0);
	@A_ASG_69_0_0_34_Data_4_SetGet_range = slider_value + (0); // real value := slider value + range min.
	thisval = (dword)round((slider_value + (0) - (0)) / (1.0), 1); // bus value := (slider value + min - offset) / step.
    A_ASG_69_0_0_34_ArrayDataList[getValue(A_ASG_69_0_0_34_DataIndex_SetGet)].Param4 = thisval;
}

// Ueberwachung der CheckBox fuer String
on envVar  A_ASG_69_0_0_34_Data_5_SetGet_cnt
{
	word len;
	byte cnt;
	len = getValue(A_ASG_69_0_0_34_Data_5_SetGet_len);
	cnt = getValue(this);

    /* Cnt Wert im Array aktualisieren */
	 A_ASG_69_0_0_34_Data_5_SetGet_CntList[ getValue(A_ASG_69_0_0_34_DataIndex_SetGet) ] = cnt;

	/* wird nur gerufen, wenn check box deaktiviert mit Length>127*/ 
	if(cnt == 0) 
	{
		if(len > 127 )
		{
			putValue(A_ASG_69_0_0_34_Data_5_SetGet_len, 127);
		}
	}

}


on envVar A_ASG_69_0_0_34_Data_5_SetGet_len
{
	long thisval;
	byte cnt;
	thisval = getValue(this);
	cnt = getValue(A_ASG_69_0_0_34_Data_5_SetGet_cnt);

	/* wenn die Laenge ausserhalb des erlaubten Bereich liegt, wird diese begrenzt */
	if(thisval > 1)
	{
		writelineEx(gBAP_Trace, 0, "Eingegebene Laenge: %d von A_ASG_69_0_0_34_Data_5_SetGet ist ungueltig. Die max. erlaubte Laenge ist %d. ", thisval, 1);
		thisval = 1;//2;
	}
	if( thisval >127)
	{
		putValue(A_ASG_69_0_0_34_Data_5_SetGet_cnt, 1); /* Switch checkbox on */
	}

	A_ASG_69_0_0_34_ArrayDataList[getValue(A_ASG_69_0_0_34_DataIndex_SetGet)].Param5_Length = thisval;
	A_ASG_69_0_0_34_Data_5_SetGet_LenList[ getValue(A_ASG_69_0_0_34_DataIndex_SetGet) ] = thisval;
	putValue(A_ASG_69_0_0_34_Data_5_SetGet_len, thisval);

}

on envVar A_ASG_69_0_0_34_Data_5_SetGet
{
	byte superval[119];

	//Update Childvalue (String)
	word i;
	byte thisval[1];
	getValue(this, thisval);
    for(i = 0; i < getValueSize(this); i++)
        A_ASG_69_0_0_34_ArrayDataList[getValue(A_ASG_69_0_0_34_DataIndex_SetGet)].Param5[i] = thisval[i];
    A_ASG_69_0_0_34_ArrayDataList[getValue(A_ASG_69_0_0_34_DataIndex_SetGet)].Param5_Length = getValueSize(this);
    A_ASG_69_0_0_34_Data_5_SetGet_LenList[getValue(A_ASG_69_0_0_34_DataIndex_SetGet)]= getValueSize(this);
    putValue(A_ASG_69_0_0_34_Data_5_SetGet_len, getValueSize(this));
}


/**
*
* Template-Funktion zum automatischen befuellen der Array-Daten, die in einer Arrayfunktion genutzt werden.
* Die Funktion wird durch den von BAPSimGen generierten Code aufgerufen.
*
* Parameter:
* - structArray: Muss mindestens nMax * Arraygroesse Bytes Platz haben, wird vom BAPSimGen automatisch generiert
* - structElementsSizeArray: Enthaelt die Groesseangabe jedes Array-Elements. Die Arraygroesse entspricht der Elementanzahl im Array.
*       Byte & Nibble = 1; Word = 2; usw. Bei Strings wird die maximale Stringlaenge angegeben.
* - structElementsTypeArray: Gibt den Datentyp eines Array-Elements zurueck. Die Arraygroesse entspricht der Elmentanzahl im Array.
*                               0x0 = Zahlenwert, also ein Slider, Enum, Bitfield,...
*                               0xE = String (darauf folgt immer eine 2, mit der Angabe der benutzen Bytes im String)
*                               0xF = Laenge der Nutzdaten des Strings, nur return Wert
* - fctID: Kann zur Fallunterscheidung der Funktions-IDs verwendet werden.
* - nMax: Array-Index
*
* Die Funktion kann im Switch-Case beliebig erweitert werden. Der Switch-Case wertet den Parameter fctID aus.
*           
*                    
**/
initStruct(byte structArray[], dword structElementsSizeArray[], byte structElementsTypeArray[], dword structElementsMaxSizeArray[], word fctID, word nMax )
{
    byte rand8;
    word rand16;
    word randSize;
    word index;           //indexNr die an die String Parameter angehaengt wird.
    dword destArraySize;   //groesse von structArray
    dword destStructSize;  //groesse eines "Structs" also destArraySize / Anzahl Elemente (nMax))
    dword rand32;    
    dword i;
    dword pos;    //aktuelle Position im structArray
    dword elpos;  //aktuelle Position in den structElementsXXXArray's
    
    destArraySize = elCount(structArray);
    destStructSize = destArraySize / nMax;    

    Switch(fctID){

        //Idee ist, die Arrays je nach Funcion-ID speziell initalisieren zu koennen.
        //hierbei koennten die Daten z.B. aus einer Datei eingelesen werden,
        //oder auch ueber spezielle init Funktionen mit festen Werten initialisiert werden.
        //Der Default-Fall befuellt das Array mit Random-Werten und Strings mit einem vordefinierten Wort (hier test,)

        default :
        {
            pos = 0; 
            for(i = 1; i <= nMax; i++)
            {
                //walk through the array
                
                elpos = 0;
                while(pos < (destStructSize * i) )
                {   
                    //check Element type
                    if( structElementsTypeArray[elpos] == 0x0)          
                    { //Params like int, word, etc.
                        //check element length
                        Switch(structElementsSizeArray[elpos])
                        {
                            case(1) : //byte / nibble
                                rand8 = random(structElementsMaxSizeArray[elpos]);
                                structArray[pos] = rand8;
                                pos++;
                                break;

                            case(2) : //word / int
                                rand16 = random(structElementsMaxSizeArray[elpos]);
                                int2byte(structArray, pos, rand16);
                                pos += 2;
                                break;

                            case (4) : //dword / long
                                rand32 = random(structElementsMaxSizeArray[elpos]);
                                long2byte(structArray, pos, rand32);
                                pos += 4;
                                break;                        
                         }
                    }
                    else if(structElementsTypeArray[elpos] == 0xE)          
                    { //String Params like byte[]
                        randSize = random(structElementsSizeArray[elpos]);
                        if(randSize < 2) randSize = 2; 
                        index = i-1;
                        setRandomString(structArray ,pos ,structElementsSizeArray[elpos], randSize, index);
                        pos += structElementsSizeArray[elpos];
                    }
                    else if(structElementsTypeArray[elpos] == 0xF)          
                    {
                        int2byte(structArray, pos, randSize);
                        pos += 2;
                        //write("Pos: %d Strlth: %d Type: %d ",pos-1,randSize,structElementsTypeArray[elpos]);
                    
                    }
                    elpos++;
                }
            }   
        break;
        }            
    }
}

long2Byte(byte in[], dword pos, dword value)
{
    if( (elCount(in)-pos) < 4)
        write("Array out ouf bounds - too small!");
    in[pos] = value;
    in[++pos] = (value >> 8);
    in[++pos] = (value >> 16);
    in[++pos] = (value >> 24);
}

int2byte (byte in[],dword pos,word value)
{
    if( (elCount(in)-pos) < 2 )
        write("Array out of bounds - too small!");
    in[pos] = value;
    in[++pos] = (value >> 8);        
}

setRandomString (byte in[], dword pos, word strSize, word randSize, word count)
{
    word endPos, endString, j;
    byte testString[4]={'t','e','s','t'};
    
    endPos = pos + strSize;
    endString = pos + randSize;
    j=0;
    
    int2ascii(in, pos, count);
    pos += 2;
    
    for(pos; pos < endPos ;pos ++)
    {
        if(j > 3 )
            j = 0;
        if(pos < endString)
            in[pos] = testString[j++];
        else
            in[pos] = 0x0;
    }
}

int2ascii (byte in[], dword pos, word value)
{
    //Konvertiert nur die erste und zweite Dezimalstelle, also Zahlen zw. 0 und 99.
    
    //auf 2 Stellen kuerzen
    value = value%100;
    //10er schreiben
    in[pos] = (value/10) + 48;    //  0x30 hex = 48 dez = ascii null
    //1er schreiben
    in[pos+1] = (value%10) + 48;  //  0x30 hex = 48 dez = ascii null
}

