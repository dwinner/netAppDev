/*@!Encoding:1252*/
includes
{
    #include "RBS_IncDec.cin"
}

variables
{
}

/* ------- generated code for Rest Bus Simulation ------- */

on EnvVar eLog_Kombi_Req_DataDec
{
    if( getValue( this ))  putValue( eLog_Kombi_Req_DataS, getValue( eLog_Kombi_Req_DataS ) - 1 );
}

on EnvVar eLog_Kombi_Req_DataInc
{
    if( getValue( this ))  putValue( eLog_Kombi_Req_DataS, getValue( eLog_Kombi_Req_DataS ) + 1 );
}

on EnvVar eLog_Kombi_Req_DataDef
{
    putValue( eLog_Kombi_Req_DataS, 0 );
}

on EnvVar eLog_Datalogger_Req_DataKombi_MD
{
    if( getValue( this ))  putValue( eLog_Datalogger_Req_DataKombi_MQ, getValue( eLog_Datalogger_Req_DataKombi_MQ ) - 1 );
}

on EnvVar eLog_Datalogger_Req_DataKombi_MI
{
    if( getValue( this ))  putValue( eLog_Datalogger_Req_DataKombi_MQ, getValue( eLog_Datalogger_Req_DataKombi_MQ ) + 1 );
}

on EnvVar e00Log_Datalogger_Req_DataKombi_
{
    putValue( eLog_Datalogger_Req_DataKombi_MQ, 0 );
}

on EnvVar eMO_Kuehlerluefter_1Dec
{
    if( getValue( this ))  putValue( eMO_Kuehlerluefter_1S, getValue( eMO_Kuehlerluefter_1S ) - 1 );
}

on EnvVar eMO_Kuehlerluefter_1Inc
{
    if( getValue( this ))  putValue( eMO_Kuehlerluefter_1S, getValue( eMO_Kuehlerluefter_1S ) + 1 );
}

on EnvVar eMO_Kuehlerluefter_1Def
{
    putValue( eMO_Kuehlerluefter_1S, 126 );
}

on EnvVar eMO_Kuehlerluefter_2Dec
{
    if( getValue( this ))  putValue( eMO_Kuehlerluefter_2S, getValue( eMO_Kuehlerluefter_2S ) - 1 );
}

on EnvVar eMO_Kuehlerluefter_2Inc
{
    if( getValue( this ))  putValue( eMO_Kuehlerluefter_2S, getValue( eMO_Kuehlerluefter_2S ) + 1 );
}

on EnvVar eMO_Kuehlerluefter_2Def
{
    putValue( eMO_Kuehlerluefter_2S, 126 );
}

on EnvVar eMO_HYB_Status_HV_LadungDec
{
    if( getValue( this ))  putValue( eMO_HYB_Status_HV_LadungS, getValue( eMO_HYB_Status_HV_LadungS ) - 1 );
}

on EnvVar eMO_HYB_Status_HV_LadungInc
{
    if( getValue( this ))  putValue( eMO_HYB_Status_HV_LadungS, getValue( eMO_HYB_Status_HV_LadungS ) + 1 );
}

on EnvVar eMO_HYB_Status_HV_LadungDef
{
    putValue( eMO_HYB_Status_HV_LadungS, 0 );
}

on EnvVar eWIV_OelstandDec
{
    if( getValue( this ))  putValue( eWIV_OelstandS, getValue( eWIV_OelstandS ) - 12.5 );
}

on EnvVar eWIV_OelstandInc
{
    if( getValue( this ))  putValue( eWIV_OelstandS, getValue( eWIV_OelstandS ) + 12.5 );
}

on EnvVar eWIV_OelstandDef
{
    putValue( eWIV_OelstandS, 0 );
}

on EnvVar eMO_Zustand_HWPDec
{
    if( getValue( this ))  putValue( eMO_Zustand_HWPS, getValue( eMO_Zustand_HWPS ) - 1 );
}

on EnvVar eMO_Zustand_HWPInc
{
    if( getValue( this ))  putValue( eMO_Zustand_HWPS, getValue( eMO_Zustand_HWPS ) + 1 );
}

on EnvVar eMO_Zustand_HWPDef
{
    putValue( eMO_Zustand_HWPS, 1 );
}

on EnvVar eMO_Text_MotorstartDec
{
    if( getValue( this ))  putValue( eMO_Text_MotorstartS, getValue( eMO_Text_MotorstartS ) - 1 );
}

on EnvVar eMO_Text_MotorstartInc
{
    if( getValue( this ))  putValue( eMO_Text_MotorstartS, getValue( eMO_Text_MotorstartS ) + 1 );
}

on EnvVar eMO_Text_MotorstartDef
{
    putValue( eMO_Text_MotorstartS, 0 );
}

on EnvVar eWIV_OelmengeDec
{
    if( getValue( this ))  putValue( eWIV_OelmengeS, getValue( eWIV_OelmengeS ) - 125 );
}

on EnvVar eWIV_OelmengeInc
{
    if( getValue( this ))  putValue( eWIV_OelmengeS, getValue( eWIV_OelmengeS ) + 125 );
}

on EnvVar eWIV_OelmengeDef
{
    putValue( eWIV_OelmengeS, 0 );
}

 on EnvVar eACC_Status_GRA_ModusDec
{
    if( getValue( this ))  putValue( eACC_Status_GRA_ModusS, getValue( eACC_Status_GRA_ModusS ) - 1);
}

on EnvVar eACC_Status_GRA_ModusInc
{
    if( getValue( this ))  putValue( eACC_Status_GRA_ModusS, getValue( eACC_Status_GRA_ModusS ) +1);
}

on EnvVar eACC_Status_GRA_ModusDef
{
    putValue( eACC_Status_GRA_ModusS, 0);
}

//GVJ-4663
on EnvVar eACC_FoD_StatusDec
{
    if( getValue( this ))  putValue( eACC_FoD_StatusS, getValue( eACC_FoD_StatusS ) - 1 );
}

on EnvVar eACC_FoD_StatusInc
{
    if( getValue( this ))  putValue( eACC_FoD_StatusS, getValue( eACC_FoD_StatusS ) + 1 );
}

on EnvVar eACC_FoD_StatusDef
{
    putValue( eACC_FoD_StatusS, 0 );
}

//GVJ-4663
on EnvVar eAB_Gurtwarn_Reihe4_FADec
{
    if( getValue( this ))  putValue( eAB_Gurtwarn_Reihe4_FAS, getValue( eAB_Gurtwarn_Reihe4_FAS ) - 1 );
}

on EnvVar eAB_Gurtwarn_Reihe4_FAInc
{
    if( getValue( this ))  putValue( eAB_Gurtwarn_Reihe4_FAS, getValue( eAB_Gurtwarn_Reihe4_FAS ) + 1 );
}

on EnvVar eAB_Gurtwarn_Reihe4_FADef
{
    putValue( eAB_Gurtwarn_Reihe4_FAS, 0 );
}

//GVJ-4663
on EnvVar eAB_Gurtwarn_Reihe4_BFDec
{
    if( getValue( this ))  putValue( eAB_Gurtwarn_Reihe4_BFS, getValue( eAB_Gurtwarn_Reihe4_BFS ) - 1 );
}

on EnvVar eAB_Gurtwarn_Reihe4_BFInc
{
    if( getValue( this ))  putValue( eAB_Gurtwarn_Reihe4_BFS, getValue( eAB_Gurtwarn_Reihe4_BFS ) + 1 );
}

on EnvVar eAB_Gurtwarn_Reihe4_BFDef
{
    putValue( eAB_Gurtwarn_Reihe4_BFS, 0 );
}

//GVJ-4663
on EnvVar eAB_Gurtwarn_Reihe4_MIDec
{
    if( getValue( this ))  putValue( eAB_Gurtwarn_Reihe4_MIS, getValue( eAB_Gurtwarn_Reihe4_MIS ) - 1 );
}

on EnvVar eAB_Gurtwarn_Reihe4_MIInc
{
    if( getValue( this ))  putValue( eAB_Gurtwarn_Reihe4_MIS, getValue( eAB_Gurtwarn_Reihe4_MIS ) + 1 );
}

on EnvVar eAB_Gurtwarn_Reihe4_MIDef
{
    putValue( eAB_Gurtwarn_Reihe4_MIS, 0 );
}

//GVJ-4663
on EnvVar eAWV_AW_TexteDec
{
    if( getValue( this ))  putValue( eAWV_AW_TexteS, getValue( eAWV_AW_TexteS ) - 1 );
}

on EnvVar eAWV_AW_TexteInc
{
    if( getValue( this ))  putValue( eAWV_AW_TexteS, getValue( eAWV_AW_TexteS ) + 1 );
}

on EnvVar eAWV_AW_TexteDef
{
    putValue( eAWV_AW_TexteS, 0 );
}

//GVJ-4663
on EnvVar eAWV_AW_Texte_ZusatzanzeigeDec
{
    if( getValue( this ))  putValue( eAWV_AW_Texte_ZusatzanzeigeS, getValue( eAWV_AW_Texte_ZusatzanzeigeS ) - 1 );
}

on EnvVar eAWV_AW_Texte_ZusatzanzeigeInc
{
    if( getValue( this ))  putValue( eAWV_AW_Texte_ZusatzanzeigeS, getValue( eAWV_AW_Texte_ZusatzanzeigeS ) + 1 );
}

on EnvVar eAWV_AW_Texte_ZusatzanzeigeDef
{
    putValue( eAWV_AW_Texte_ZusatzanzeigeS, 0 );
}

//GVJ-4663
on EnvVar eBCM_Anf_AAW_MoLaWaDec
{
    if( getValue( this ))  putValue( eBCM_Anf_AAW_MoLaWaS, getValue( eBCM_Anf_AAW_MoLaWaS ) - 1 );
}

on EnvVar eBCM_Anf_AAW_MoLaWaInc
{
    if( getValue( this ))  putValue( eBCM_Anf_AAW_MoLaWaS, getValue( eBCM_Anf_AAW_MoLaWaS ) + 1 );
}

on EnvVar eBCM_Anf_AAW_MoLaWaDef
{
    putValue( eBCM_Anf_AAW_MoLaWaS, 0 );
}

//GVJ-4663
on EnvVar eHVLM_Restladezeit_HV_Bat_02Dec
{
    if( getValue( this ))  putValue( eHVLM_Restladezeit_HV_Bat_02S, getValue( eHVLM_Restladezeit_HV_Bat_02S ) - 5 );
}

on EnvVar eHVLM_Restladezeit_HV_Bat_02Inc
{
    if( getValue( this ))  putValue( eHVLM_Restladezeit_HV_Bat_02S, getValue( eHVLM_Restladezeit_HV_Bat_02S ) + 5 );
}

on EnvVar eHVLM_Restladezeit_HV_Bat_02Def
{
    putValue( eHVLM_Restladezeit_HV_Bat_02S, 2550 );
}

on EnvVar eHVLM_AnzeigetexteDec
{
    if( getValue( this ))  putValue( eHVLM_AnzeigetexteS, getValue( eHVLM_AnzeigetexteS ) - 1 );
}

on EnvVar eHVLM_AnzeigetexteInc
{
    if( getValue( this ))  putValue( eHVLM_AnzeigetexteS, getValue( eHVLM_AnzeigetexteS ) + 1 );
}

on EnvVar eHVLM_AnzeigetexteDef
{
    putValue( eHVLM_AnzeigetexteS, 0 );
}

on EnvVar eHVLM_Bat_laden_aktivDec
{
    if( getValue( this ))  putValue( eHVLM_Bat_laden_aktivS, getValue( eHVLM_Bat_laden_aktivS ) - 1 );
}

on EnvVar eHVLM_Bat_laden_aktivInc
{
    if( getValue( this ))  putValue( eHVLM_Bat_laden_aktivS, getValue( eHVLM_Bat_laden_aktivS ) + 1 );
}

on EnvVar eHVLM_Bat_laden_aktivDef
{
    putValue( eHVLM_Bat_laden_aktivS, 0 );
}

//GVJ-4663
on EnvVar eTSK_Status_vMax_FahrerInfoDec
{
    if( getValue( this ))  putValue( eTSK_Status_vMax_FahrerInfoS, getValue( eTSK_Status_vMax_FahrerInfoS ) - 1 );
}

on EnvVar eTSK_Status_vMax_FahrerInfoInc
{
    if( getValue( this ))  putValue( eTSK_Status_vMax_FahrerInfoS, getValue( eTSK_Status_vMax_FahrerInfoS ) + 1);
}

on EnvVar eTSK_Status_vMax_FahrerInfoDef
{
    putValue( eTSK_Status_vMax_FahrerInfoS, 0 );
}

//GVJ-4663
on EnvVar eTSK_vMax_FahrerInfoDec
{
    if( getValue( this ))  putValue( eTSK_vMax_FahrerInfoS, getValue( eTSK_vMax_FahrerInfoS ) - 1 );
}

on EnvVar eTSK_vMax_FahrerInfoInc
{
    if( getValue( this ))  putValue( eTSK_vMax_FahrerInfoS, getValue( eTSK_vMax_FahrerInfoS ) + 1);
}

on EnvVar eTSK_vMax_FahrerInfoDef
{
    putValue( eTSK_vMax_FahrerInfoS, 15 );
}

on EnvVar eWFS_Schluessel_SollDec
{
    if( getValue( this ))  putValue( eWFS_Schluessel_SollS, getValue( eWFS_Schluessel_SollS ) - 1 );
}

on EnvVar eWFS_Schluessel_SollInc
{
    if( getValue( this ))  putValue( eWFS_Schluessel_SollS, getValue( eWFS_Schluessel_SollS ) + 1);
}

on EnvVar eWFS_Schluessel_SollDef
{
    putValue( eWFS_Schluessel_SollS, 0 );
}

//GVJ-4663
on EnvVar eWFS_Schluessel_IstDec
{
    if( getValue( this ))  putValue( eWFS_Schluessel_IstS, getValue( eWFS_Schluessel_IstS ) - 1 );
}

on EnvVar eWFS_Schluessel_IstInc
{
    if( getValue( this ))  putValue( eWFS_Schluessel_IstS, getValue( eWFS_Schluessel_IstS ) + 1);
}

on EnvVar eWFS_Schluessel_IstDef
{
    putValue( eWFS_Schluessel_IstS, 0 );
}

on EnvVar eWFS_LZDec
{
    if( getValue( this ))  putValue( eWFS_LZS, getValue( eWFS_LZS ) - 1);
}

on EnvVar eWFS_LZInc
{
    if( getValue( this ))  putValue( eWFS_LZS, getValue( eWFS_LZS ) + 1);
}

on EnvVar eWFS_LZDef
{
    putValue( eWFS_LZS, 0 );
}

//GVJ-4663
on EnvVar eBCM_anf_VLWDec
{
    if( getValue( this ))  putValue( eBCM_anf_VLWS, getValue( eBCM_anf_VLWS ) - 1);
}

on EnvVar eBCM_anf_VLWInc
{
    if( getValue( this ))  putValue( eBCM_anf_VLWS, getValue( eBCM_anf_VLWS ) + 1);
}

on EnvVar eBCM_anf_VLWDef
{
    putValue( eBCM_anf_VLWS, 0 );
}

//GVJ-4663
on EnvVar eBCM_LTM_PopUp_StatusDec
{
    if( getValue( this ))  putValue( eBCM_LTM_PopUp_StatusS, getValue( eBCM_LTM_PopUp_StatusS ) - 1);
}

on EnvVar eBCM_LTM_PopUp_StatusInc
{
    if( getValue( this ))  putValue( eBCM_LTM_PopUp_StatusS, getValue( eBCM_LTM_PopUp_StatusS ) + 1);
}

on EnvVar eBCM_LTM_PopUp_StatusDef
{
    putValue( eBCM_LTM_PopUp_StatusS, 0 );
}

//GVJ-4663
on EnvVar eBCM_LTM_PopUp_AnfDec
{
    if( getValue( this ))  putValue( eBCM_LTM_PopUp_AnfS, getValue( eBCM_LTM_PopUp_AnfS ) - 1);
}

on EnvVar eBCM_LTM_PopUp_AnfInc
{
    if( getValue( this ))  putValue( eBCM_LTM_PopUp_AnfS, getValue( eBCM_LTM_PopUp_AnfS ) + 1);
}

on EnvVar eBCM_LTM_PopUp_AnfDef
{
    putValue( eBCM_LTM_PopUp_AnfS, 0 );
}

//GVJ-4663
on EnvVar eBCM_LTM_PopUp_InhaltDec
{
    if( getValue( this ))  putValue( eBCM_LTM_PopUp_InhaltS, getValue( eBCM_LTM_PopUp_InhaltS ) - 1);
}

on EnvVar eBCM_LTM_PopUp_InhaltInc
{
    if( getValue( this ))  putValue( eBCM_LTM_PopUp_InhaltS, getValue( eBCM_LTM_PopUp_InhaltS ) + 1);
}

on EnvVar eBCM_LTM_PopUp_InhaltDef
{
    putValue( eBCM_LTM_PopUp_InhaltS, 0 );
}

//GVJ-4663
on EnvVar eNVEM_BordnetzdiagnoseDec
{
    if( getValue( this ))  putValue( eNVEM_BordnetzdiagnoseS, getValue( eNVEM_BordnetzdiagnoseS ) - 1);
}

on EnvVar eNVEM_BordnetzdiagnoseInc
{
    if( getValue( this ))  putValue( eNVEM_BordnetzdiagnoseS, getValue( eNVEM_BordnetzdiagnoseS ) + 1);
}

on EnvVar eNVEM_BordnetzdiagnoseDef
{
    putValue( eNVEM_BordnetzdiagnoseS, 0 );
}

//GVJ-4663
on EnvVar eFoD_Anz_FunktionsabschaltungDec
{
    if( getValue( this ))  putValue( eFoD_Anz_FunktionsabschaltungS, getValue( eFoD_Anz_FunktionsabschaltungS ) - 1);
}

on EnvVar eFoD_Anz_FunktionsabschaltungInc
{
    if( getValue( this ))  putValue( eFoD_Anz_FunktionsabschaltungS, getValue( eFoD_Anz_FunktionsabschaltungS ) + 1);
}

on EnvVar eFoD_Anz_FunktionsabschaltungDef
{
    putValue( eFoD_Anz_FunktionsabschaltungS, 0 );
}

on EnvVar eGE_SumpftemperaturDec
{
    if( getValue( this ))  putValue( eGE_SumpftemperaturS, getValue( eGE_SumpftemperaturS ) - 1);
}

on EnvVar eGE_SumpftemperaturInc
{
    if( getValue( this ))  putValue( eGE_SumpftemperaturS, getValue( eGE_SumpftemperaturS ) + 1);
}

on EnvVar eGE_SumpftemperaturDef
{
    putValue( eGE_SumpftemperaturS, -58 );
}

on EnvVar eGNSS_Ortung_2D_Geschw_ue_GrundDec
{
    if( getValue( this ))  putValue( eGNSS_Ortung_2D_Geschw_ue_GrundS, getValue( eGNSS_Ortung_2D_Geschw_ue_GrundS ) - 0.25);
}

on EnvVar eGNSS_Ortung_2D_Geschw_ue_GrundInc
{
    if( getValue( this ))  putValue( eGNSS_Ortung_2D_Geschw_ue_GrundS, getValue( eGNSS_Ortung_2D_Geschw_ue_GrundS ) + 0.25);
}

on EnvVar eGNSS_Ortung_2D_Geschw_ue_GrundDef
{
    putValue( eGNSS_Ortung_2D_Geschw_ue_GrundS, 127.5 );
}

on EnvVar eGNSS_Ortung_Guete_GeschwindigkDec
{
    if( getValue( this ))  putValue( eGNSS_Ortung_Guete_GeschwindigkS, getValue( eGNSS_Ortung_Guete_GeschwindigkS ) - 0.05);
}

on EnvVar eGNSS_Ortung_Guete_GeschwindigkInc
{
    if( getValue( this ))  putValue( eGNSS_Ortung_Guete_GeschwindigkS, getValue( eGNSS_Ortung_Guete_GeschwindigkS ) + 0.05);
}

on EnvVar eGNSS_Ortung_Guete_GeschwindigkDef
{
    putValue( eGNSS_Ortung_Guete_GeschwindigkS, 3.1 );
}

on EnvVar eHUD_FAS_Anzeige_KombiDec
{
    if( getValue( this ))  putValue( eHUD_FAS_Anzeige_KombiS, getValue( eHUD_FAS_Anzeige_KombiS ) - 1);
}

on EnvVar eHUD_FAS_Anzeige_KombiInc
{
    if( getValue( this ))  putValue( eHUD_FAS_Anzeige_KombiS, getValue( eHUD_FAS_Anzeige_KombiS ) + 1);
}

on EnvVar eHUD_FAS_Anzeige_KombiDef
{
    putValue( eHUD_FAS_Anzeige_KombiS, 0 );
}

on EnvVar eHUD_KDK_Anzeige_KombiDec
{
    if( getValue( this ))  putValue( eHUD_KDK_Anzeige_KombiS, getValue( eHUD_KDK_Anzeige_KombiS ) - 1);
}

on EnvVar eHUD_KDK_Anzeige_KombiInc
{
    if( getValue( this ))  putValue( eHUD_KDK_Anzeige_KombiS, getValue( eHUD_KDK_Anzeige_KombiS ) + 1);
}

on EnvVar eHUD_KDK_Anzeige_KombiDef
{
    putValue( eHUD_KDK_Anzeige_KombiS, 0 );
}

//GVJ-4663
on EnvVar eHUD_PEA_Anzeige_KombiDec
{
    if( getValue( this ))  putValue( eHUD_PEA_Anzeige_KombiS, getValue( eHUD_PEA_Anzeige_KombiS ) - 1);
}

on EnvVar eHUD_PEA_Anzeige_KombiInc
{
    if( getValue( this ))  putValue( eHUD_PEA_Anzeige_KombiS, getValue( eHUD_PEA_Anzeige_KombiS ) + 1);
}

on EnvVar eHUD_PEA_Anzeige_KombiDef
{
    putValue( eHUD_PEA_Anzeige_KombiS, 0 );
}

on EnvVar eHUD_VZE_AIO_Anzeige_KombiDec
{
    if( getValue( this ))  putValue( eHUD_VZE_AIO_Anzeige_KombiS, getValue( eHUD_VZE_AIO_Anzeige_KombiS ) - 1);
}

on EnvVar eHUD_VZE_AIO_Anzeige_KombiInc
{
    if( getValue( this ))  putValue( eHUD_VZE_AIO_Anzeige_KombiS, getValue( eHUD_VZE_AIO_Anzeige_KombiS ) + 1);
}

on EnvVar eHUD_VZE_AIO_Anzeige_KombiDef
{
    putValue( eHUD_VZE_AIO_Anzeige_KombiS, 0 );
}

on EnvVar eHVK_Gesamtst_SpgfreiheitDec
{
    if( getValue( this ))  putValue( eHVK_Gesamtst_SpgfreiheitS, getValue( eHVK_Gesamtst_SpgfreiheitS ) - 1);
}

on EnvVar eHVK_Gesamtst_SpgfreiheitInc
{
    if( getValue( this ))  putValue( eHVK_Gesamtst_SpgfreiheitS, getValue( eHVK_Gesamtst_SpgfreiheitS ) + 1);
}

on EnvVar eHVK_Gesamtst_SpgfreiheitDef
{
    putValue( eHVK_Gesamtst_SpgfreiheitS, 0 );
}

on EnvVar eLoGeWa_C2C_Event_RichtungDec
{
    if( getValue( this ))  putValue( eLoGeWa_C2C_Event_RichtungS, getValue( eLoGeWa_C2C_Event_RichtungS ) - 1);
}

on EnvVar eLoGeWa_C2C_Event_RichtungInc
{
    if( getValue( this ))  putValue( eLoGeWa_C2C_Event_RichtungS, getValue( eLoGeWa_C2C_Event_RichtungS ) + 1);
}

on EnvVar eLoGeWa_C2C_Event_RichtungDef
{
    putValue( eLoGeWa_C2C_Event_RichtungS, 0 );
}

//GVJ-4663
on EnvVar eLoGeWa_C2C_Event_EinheitDec
{
    if( getValue( this ))  putValue( eLoGeWa_C2C_Event_EinheitS, getValue( eLoGeWa_C2C_Event_EinheitS ) - 1);
}

on EnvVar eLoGeWa_C2C_Event_EinheitInc
{
    if( getValue( this ))  putValue( eLoGeWa_C2C_Event_EinheitS, getValue( eLoGeWa_C2C_Event_EinheitS ) + 1);
}

on EnvVar eLoGeWa_C2C_Event_EinheitDef
{
    putValue( eLoGeWa_C2C_Event_EinheitS, 0 );
}

//GVJ-4663
on EnvVar eLoGeWa_C2C_Event_StatusDec
{
    if( getValue( this ))  putValue( eLoGeWa_C2C_Event_StatusS, getValue( eLoGeWa_C2C_Event_StatusS ) - 1);
}

on EnvVar eLoGeWa_C2C_Event_StatusInc
{
    if( getValue( this ))  putValue( eLoGeWa_C2C_Event_StatusS, getValue( eLoGeWa_C2C_Event_StatusS ) + 1);
}

on EnvVar eLoGeWa_C2C_Event_StatusDef
{
    putValue( eLoGeWa_C2C_Event_StatusS, 0 );
}

on EnvVar eLoGeWa_C2C_Event_WarnungDec
{
    if( getValue( this ))  putValue( eLoGeWa_C2C_Event_WarnungS, getValue( eLoGeWa_C2C_Event_WarnungS ) - 1);
}

on EnvVar eLoGeWa_C2C_Event_WarnungInc
{
    if( getValue( this ))  putValue( eLoGeWa_C2C_Event_WarnungS, getValue( eLoGeWa_C2C_Event_WarnungS ) + 1);
}

on EnvVar eLoGeWa_C2C_Event_WarnungDef
{
    putValue( eLoGeWa_C2C_Event_WarnungS, 0 );
}

on EnvVar eLoGeWa_C2C_Event_EntfernungDec
{
    if( getValue( this ))  putValue( eLoGeWa_C2C_Event_EntfernungS, getValue( eLoGeWa_C2C_Event_EntfernungS ) - 0.1);
}

on EnvVar eLoGeWa_C2C_Event_EntfernungInc
{
    if( getValue( this ))  putValue( eLoGeWa_C2C_Event_EntfernungS, getValue( eLoGeWa_C2C_Event_EntfernungS ) + 0.1);
}

on EnvVar eLoGeWa_C2C_Event_EntfernungDef
{
    putValue( eLoGeWa_C2C_Event_EntfernungS, 6553.5 );
}

//GVJ-4663
on EnvVar eMVK_MV_Netz_WarnungenDec
{
    if( getValue( this ))  putValue( eMVK_MV_Netz_WarnungenS, getValue( eMVK_MV_Netz_WarnungenS ) - 1);
}

on EnvVar eMVK_MV_Netz_WarnungenInc
{
    if( getValue( this ))  putValue( eMVK_MV_Netz_WarnungenS, getValue( eMVK_MV_Netz_WarnungenS ) + 1);
}

on EnvVar eMVK_MV_Netz_WarnungenDef
{
    putValue( eMVK_MV_Netz_WarnungenS, 0 );
}

on EnvVar ePH_VerschmutzungsmeldungDec
{
    if( getValue( this ))  putValue( ePH_VerschmutzungsmeldungS, getValue( ePH_VerschmutzungsmeldungS ) - 1);
}

on EnvVar ePH_VerschmutzungsmeldungInc
{
    if( getValue( this ))  putValue( ePH_VerschmutzungsmeldungS, getValue( ePH_VerschmutzungsmeldungS ) + 1);
}

on EnvVar ePH_VerschmutzungsmeldungDef
{
    putValue( ePH_VerschmutzungsmeldungS, 0 );
}

//GVJ-4663
on EnvVar ePH_WAH_MeldungDec
{
    if( getValue( this ))  putValue( ePH_WAH_MeldungS, getValue( ePH_WAH_MeldungS ) - 1);
}

on EnvVar ePH_WAH_MeldungInc
{
    if( getValue( this ))  putValue( ePH_WAH_MeldungS, getValue( ePH_WAH_MeldungS ) + 1);
}

on EnvVar ePH_WAH_MeldungDef
{
    putValue( ePH_WAH_MeldungS, 0 );
}

//GVJ-4663
on EnvVar eMMI_StartupAnimationDec
{
    if( getValue( this ))  putValue( eMMI_StartupAnimationS, getValue( eMMI_StartupAnimationS ) - 1);
}

on EnvVar eMMI_StartupAnimationInc
{
    if( getValue( this ))  putValue( eMMI_StartupAnimationS, getValue( eMMI_StartupAnimationS ) + 1);
}

on EnvVar eMMI_StartupAnimationDef
{
    putValue( eMMI_StartupAnimationS, 0 );
}

on EnvVar eACC_Wunschgeschw_02Dec
{
    if( getValue( this ))  putValue( eACC_Wunschgeschw_02S, getValue( eACC_Wunschgeschw_02S ) - 0.32 );
}

on EnvVar eACC_Wunschgeschw_02Inc
{
    if( getValue( this ))  putValue( eACC_Wunschgeschw_02S, getValue( eACC_Wunschgeschw_02S ) + 0.32 );
}

on EnvVar eACC_Wunschgeschw_02Def
{
    putValue( eACC_Wunschgeschw_02S, 327.36 );
}

on EnvVar eACC_Status_Prim_AnzDec
{
    if( getValue( this ))  putValue( eACC_Status_Prim_AnzS, getValue( eACC_Status_Prim_AnzS ) - 1 );
}

on EnvVar eACC_Status_Prim_AnzInc
{
    if( getValue( this ))  putValue( eACC_Status_Prim_AnzS, getValue( eACC_Status_Prim_AnzS ) + 1 );
}

on EnvVar eACC_Status_Prim_AnzDef
{
    putValue( eACC_Status_Prim_AnzS, 0 );
}

on EnvVar eACC_Akustik_02Dec
{
    if( getValue( this ))  putValue( eACC_Akustik_02S, getValue( eACC_Akustik_02S ) - 1 );
}

on EnvVar eACC_Akustik_02Inc
{
    if( getValue( this ))  putValue( eACC_Akustik_02S, getValue( eACC_Akustik_02S ) + 1 );
}

on EnvVar eACC_Akustik_02Def
{
    putValue( eACC_Akustik_02S, 0 );
}

on EnvVar eACC_Gesetzte_ZeitlueckeDec
{
    if( getValue( this ))  putValue( eACC_Gesetzte_ZeitlueckeS, getValue( eACC_Gesetzte_ZeitlueckeS ) - 1 );
}

on EnvVar eACC_Gesetzte_ZeitlueckeInc
{
    if( getValue( this ))  putValue( eACC_Gesetzte_ZeitlueckeS, getValue( eACC_Gesetzte_ZeitlueckeS ) + 1 );
}

on EnvVar eACC_Gesetzte_ZeitlueckeDef
{
    putValue( eACC_Gesetzte_ZeitlueckeS, 0 );
}

on EnvVar eACC_Display_PrioDec
{
    if( getValue( this ))  putValue( eACC_Display_PrioS, getValue( eACC_Display_PrioS ) - 1 );
}

on EnvVar eACC_Display_PrioInc
{
    if( getValue( this ))  putValue( eACC_Display_PrioS, getValue( eACC_Display_PrioS ) + 1 );
}

on EnvVar eACC_Display_PrioDef
{
    putValue( eACC_Display_PrioS, 0 );
}

on EnvVar eACC_Relevantes_ObjektDec
{
    if( getValue( this ))  putValue( eACC_Relevantes_ObjektS, getValue( eACC_Relevantes_ObjektS ) - 1 );
}

on EnvVar eACC_Relevantes_ObjektInc
{
    if( getValue( this ))  putValue( eACC_Relevantes_ObjektS, getValue( eACC_Relevantes_ObjektS ) + 1 );
}

on EnvVar eACC_Relevantes_ObjektDef
{
    putValue( eACC_Relevantes_ObjektS, 0 );
}

on EnvVar eACC_Texte_PrimaeranzDec
{
    if( getValue( this ))  putValue( eACC_Texte_PrimaeranzS, getValue( eACC_Texte_PrimaeranzS ) - 1 );
}

on EnvVar eACC_Texte_PrimaeranzInc
{
    if( getValue( this ))  putValue( eACC_Texte_PrimaeranzS, getValue( eACC_Texte_PrimaeranzS ) + 1 );
}

on EnvVar eACC_Texte_PrimaeranzDef
{
    putValue( eACC_Texte_PrimaeranzS, 0 );
}

on EnvVar eACC_Status_AnzeigeDec
{
    if( getValue( this ))  putValue( eACC_Status_AnzeigeS, getValue( eACC_Status_AnzeigeS ) - 1 );
}

on EnvVar eACC_Status_AnzeigeInc
{
    if( getValue( this ))  putValue( eACC_Status_AnzeigeS, getValue( eACC_Status_AnzeigeS ) + 1 );
}

on EnvVar eACC_Status_AnzeigeDef
{
    putValue( eACC_Status_AnzeigeS, 0 );
}

on EnvVar eACC_Texte_ZusatzanzDec
{
    if( getValue( this ))  putValue( eACC_Texte_ZusatzanzS, getValue( eACC_Texte_ZusatzanzS ) - 1 );
}

on EnvVar eACC_Texte_ZusatzanzInc
{
    if( getValue( this ))  putValue( eACC_Texte_ZusatzanzS, getValue( eACC_Texte_ZusatzanzS ) + 1 );
}

on EnvVar eACC_Texte_ZusatzanzDef
{
    putValue( eACC_Texte_ZusatzanzS, 0 );
}

on EnvVar eACC_Status_ZusatzanzDec
{
    if( getValue( this ))  putValue( eACC_Status_ZusatzanzS, getValue( eACC_Status_ZusatzanzS ) - 1 );
}

on EnvVar eACC_Status_ZusatzanzInc
{
    if( getValue( this ))  putValue( eACC_Status_ZusatzanzS, getValue( eACC_Status_ZusatzanzS ) + 1 );
}

on EnvVar eACC_Status_ZusatzanzDef
{
    putValue( eACC_Status_ZusatzanzS, 0 );
}

on EnvVar eACC_TexteDec
{
    if( getValue( this ))  putValue( eACC_TexteS, getValue( eACC_TexteS ) - 1 );
}

on EnvVar eACC_TexteInc
{
    if( getValue( this ))  putValue( eACC_TexteS, getValue( eACC_TexteS ) + 1 );
}

on EnvVar eACC_TexteDef
{
    putValue( eACC_TexteS, 0 );
}

on EnvVar eACC_Texte_braking_guardDec
{
    if( getValue( this ))  putValue( eACC_Texte_braking_guardS, getValue( eACC_Texte_braking_guardS ) - 1 );
}

on EnvVar eACC_Texte_braking_guardInc
{
    if( getValue( this ))  putValue( eACC_Texte_braking_guardS, getValue( eACC_Texte_braking_guardS ) + 1 );
}

on EnvVar eACC_Texte_braking_guardDef
{
    putValue( eACC_Texte_braking_guardS, 0 );
}

on EnvVar eACC_Geschw_ZielfahrzeugDec
{
    if( getValue( this ))  putValue( eACC_Geschw_ZielfahrzeugS, getValue( eACC_Geschw_ZielfahrzeugS ) - 0.32 );
}

on EnvVar eACC_Geschw_ZielfahrzeugInc
{
    if( getValue( this ))  putValue( eACC_Geschw_ZielfahrzeugS, getValue( eACC_Geschw_ZielfahrzeugS ) + 0.32 );
}

on EnvVar eACC_Geschw_ZielfahrzeugDef
{
    putValue( eACC_Geschw_ZielfahrzeugS, 0 );
}

on EnvVar eACC_Charisma_FahrPrDec
{
    if( getValue( this ))  putValue( eACC_Charisma_FahrPrS, getValue( eACC_Charisma_FahrPrS ) - 1 );
}

on EnvVar eACC_Charisma_FahrPrInc
{
    if( getValue( this ))  putValue( eACC_Charisma_FahrPrS, getValue( eACC_Charisma_FahrPrS ) + 1 );
}

on EnvVar eACC_Charisma_FahrPrDef
{
    putValue( eACC_Charisma_FahrPrS, 0 );
}

on EnvVar eACC_Charisma_StatusDec
{
    if( getValue( this ))  putValue( eACC_Charisma_StatusS, getValue( eACC_Charisma_StatusS ) - 1 );
}

on EnvVar eACC_Charisma_StatusInc
{
    if( getValue( this ))  putValue( eACC_Charisma_StatusS, getValue( eACC_Charisma_StatusS ) + 1 );
}

on EnvVar eACC_Charisma_StatusDef
{
    putValue( eACC_Charisma_StatusS, 0 );
}

on EnvVar eAB_RGS_AnstDec
{
    if( getValue( this ))  putValue( eAB_RGS_AnstS, getValue( eAB_RGS_AnstS ) - 1 );
}

on EnvVar eAB_RGS_AnstInc
{
    if( getValue( this ))  putValue( eAB_RGS_AnstS, getValue( eAB_RGS_AnstS ) + 1 );
}

on EnvVar eAB_RGS_AnstDef
{
    putValue( eAB_RGS_AnstS, 8 );
}

on EnvVar eAB_Crash_IntDec
{
    if( getValue( this ))  putValue( eAB_Crash_IntS, getValue( eAB_Crash_IntS ) - 1 );
}

on EnvVar eAB_Crash_IntInc
{
    if( getValue( this ))  putValue( eAB_Crash_IntS, getValue( eAB_Crash_IntS ) + 1 );
}

on EnvVar eAB_Crash_IntDef
{
    putValue( eAB_Crash_IntS, 0 );
}

on EnvVar eAB_Erh_Auf_VBDec
{
    if( getValue( this ))  putValue( eAB_Erh_Auf_VBS, getValue( eAB_Erh_Auf_VBS ) - 1 );
}

on EnvVar eAB_Erh_Auf_VBInc
{
    if( getValue( this ))  putValue( eAB_Erh_Auf_VBS, getValue( eAB_Erh_Auf_VBS ) + 1 );
}

on EnvVar eAB_Erh_Auf_VBDef
{
    putValue( eAB_Erh_Auf_VBS, 0 );
}

on EnvVar eAB_Anzeige_FussgDec
{
    if( getValue( this ))  putValue( eAB_Anzeige_FussgS, getValue( eAB_Anzeige_FussgS ) - 1 );
}

on EnvVar eAB_Anzeige_FussgInc
{
    if( getValue( this ))  putValue( eAB_Anzeige_FussgS, getValue( eAB_Anzeige_FussgS ) + 1 );
}

on EnvVar eAB_Anzeige_FussgDef
{
    putValue( eAB_Anzeige_FussgS, 0 );
}

on EnvVar eAB_Texte_AKSDec
{
    if( getValue( this ))  putValue( eAB_Texte_AKSS, getValue( eAB_Texte_AKSS ) - 1 );
}

on EnvVar eAB_Texte_AKSInc
{
    if( getValue( this ))  putValue( eAB_Texte_AKSS, getValue( eAB_Texte_AKSS ) + 1 );
}

on EnvVar eAB_Texte_AKSDef
{
    putValue( eAB_Texte_AKSS, 0 );
}

on EnvVar eAB_Belegung_VBDec
{
    if( getValue( this ))  putValue( eAB_Belegung_VBS, getValue( eAB_Belegung_VBS ) - 1 );
}

on EnvVar eAB_Belegung_VBInc
{
    if( getValue( this ))  putValue( eAB_Belegung_VBS, getValue( eAB_Belegung_VBS ) + 1 );
}

on EnvVar eAB_Belegung_VBDef
{
    putValue( eAB_Belegung_VBS, 0 );
}

on EnvVar eAB_Gurtschloss_FADec
{
    if( getValue( this ))  putValue( eAB_Gurtschloss_FAS, getValue( eAB_Gurtschloss_FAS ) - 1 );
}

on EnvVar eAB_Gurtschloss_FAInc
{
    if( getValue( this ))  putValue( eAB_Gurtschloss_FAS, getValue( eAB_Gurtschloss_FAS ) + 1 );
}

on EnvVar eAB_Gurtschloss_FADef
{
    putValue( eAB_Gurtschloss_FAS, 1 );
}

on EnvVar eAB_Gurtschloss_BFDec
{
    if( getValue( this ))  putValue( eAB_Gurtschloss_BFS, getValue( eAB_Gurtschloss_BFS ) - 1 );
}

on EnvVar eAB_Gurtschloss_BFInc
{
    if( getValue( this ))  putValue( eAB_Gurtschloss_BFS, getValue( eAB_Gurtschloss_BFS ) + 1 );
}

on EnvVar eAB_Gurtschloss_BFDef
{
    putValue( eAB_Gurtschloss_BFS, 1 );
}

on EnvVar eAB_Gurtschloss_Reihe2_FADec
{
    if( getValue( this ))  putValue( eAB_Gurtschloss_Reihe2_FAS, getValue( eAB_Gurtschloss_Reihe2_FAS ) - 1 );
}

on EnvVar eAB_Gurtschloss_Reihe2_FAInc
{
    if( getValue( this ))  putValue( eAB_Gurtschloss_Reihe2_FAS, getValue( eAB_Gurtschloss_Reihe2_FAS ) + 1 );
}

on EnvVar eAB_Gurtschloss_Reihe2_FADef
{
    putValue( eAB_Gurtschloss_Reihe2_FAS, 1 );
}

on EnvVar eAB_Gurtschloss_Reihe2_MIDec
{
    if( getValue( this ))  putValue( eAB_Gurtschloss_Reihe2_MIS, getValue( eAB_Gurtschloss_Reihe2_MIS ) - 1 );
}

on EnvVar eAB_Gurtschloss_Reihe2_MIInc
{
    if( getValue( this ))  putValue( eAB_Gurtschloss_Reihe2_MIS, getValue( eAB_Gurtschloss_Reihe2_MIS ) + 1 );
}

on EnvVar eAB_Gurtschloss_Reihe2_MIDef
{
    putValue( eAB_Gurtschloss_Reihe2_MIS, 1 );
}

on EnvVar eAB_Gurtschloss_Reihe2_BFDec
{
    if( getValue( this ))  putValue( eAB_Gurtschloss_Reihe2_BFS, getValue( eAB_Gurtschloss_Reihe2_BFS ) - 1 );
}

on EnvVar eAB_Gurtschloss_Reihe2_BFInc
{
    if( getValue( this ))  putValue( eAB_Gurtschloss_Reihe2_BFS, getValue( eAB_Gurtschloss_Reihe2_BFS ) + 1 );
}

on EnvVar eAB_Gurtschloss_Reihe2_BFDef
{
    putValue( eAB_Gurtschloss_Reihe2_BFS, 1 );
}

on EnvVar eAB_Gurtschloss_Reihe3_FADec
{
    if( getValue( this ))  putValue( eAB_Gurtschloss_Reihe3_FAS, getValue( eAB_Gurtschloss_Reihe3_FAS ) - 1 );
}

on EnvVar eAB_Gurtschloss_Reihe3_FAInc
{
    if( getValue( this ))  putValue( eAB_Gurtschloss_Reihe3_FAS, getValue( eAB_Gurtschloss_Reihe3_FAS ) + 1 );
}

on EnvVar eAB_Gurtschloss_Reihe3_FADef
{
    putValue( eAB_Gurtschloss_Reihe3_FAS, 1 );
}

on EnvVar eAB_Gurtschloss_Reihe3_MIDec
{
    if( getValue( this ))  putValue( eAB_Gurtschloss_Reihe3_MIS, getValue( eAB_Gurtschloss_Reihe3_MIS ) - 1 );
}

on EnvVar eAB_Gurtschloss_Reihe3_MIInc
{
    if( getValue( this ))  putValue( eAB_Gurtschloss_Reihe3_MIS, getValue( eAB_Gurtschloss_Reihe3_MIS ) + 1 );
}

on EnvVar eAB_Gurtschloss_Reihe3_MIDef
{
    putValue( eAB_Gurtschloss_Reihe3_MIS, 1 );
}

on EnvVar eAB_Gurtschloss_Reihe3_BFDec
{
    if( getValue( this ))  putValue( eAB_Gurtschloss_Reihe3_BFS, getValue( eAB_Gurtschloss_Reihe3_BFS ) - 1 );
}

on EnvVar eAB_Gurtschloss_Reihe3_BFInc
{
    if( getValue( this ))  putValue( eAB_Gurtschloss_Reihe3_BFS, getValue( eAB_Gurtschloss_Reihe3_BFS ) + 1 );
}

on EnvVar eAB_Gurtschloss_Reihe3_BFDef
{
    putValue( eAB_Gurtschloss_Reihe3_BFS, 1 );
}

on EnvVar eAB_Sitzpos_Sens_FADec
{
    if( getValue( this ))  putValue( eAB_Sitzpos_Sens_FAS, getValue( eAB_Sitzpos_Sens_FAS ) - 1 );
}

on EnvVar eAB_Sitzpos_Sens_FAInc
{
    if( getValue( this ))  putValue( eAB_Sitzpos_Sens_FAS, getValue( eAB_Sitzpos_Sens_FAS ) + 1 );
}

on EnvVar eAB_Sitzpos_Sens_FADef
{
    putValue( eAB_Sitzpos_Sens_FAS, 0 );
}

on EnvVar eAB_Sitzpos_Sens_BFDec
{
    if( getValue( this ))  putValue( eAB_Sitzpos_Sens_BFS, getValue( eAB_Sitzpos_Sens_BFS ) - 1 );
}

on EnvVar eAB_Sitzpos_Sens_BFInc
{
    if( getValue( this ))  putValue( eAB_Sitzpos_Sens_BFS, getValue( eAB_Sitzpos_Sens_BFS ) + 1 );
}

on EnvVar eAB_Sitzpos_Sens_BFDef
{
    putValue( eAB_Sitzpos_Sens_BFS, 0 );
}

on EnvVar eAAG_AVS_Fehler_02Dec
{
    if( getValue( this ))  putValue( eAAG_AVS_Fehler_02S, getValue( eAAG_AVS_Fehler_02S ) - 1 );
}

on EnvVar eAAG_AVS_Fehler_02Inc
{
    if( getValue( this ))  putValue( eAAG_AVS_Fehler_02S, getValue( eAAG_AVS_Fehler_02S ) + 1 );
}

on EnvVar eAAG_AVS_Fehler_02Def
{
    putValue( eAAG_AVS_Fehler_02S, 0 );
}

on EnvVar eAAG_AVS_StatiDec
{
    if( getValue( this ))  putValue( eAAG_AVS_StatiS, getValue( eAAG_AVS_StatiS ) - 1 );
}

on EnvVar eAAG_AVS_StatiInc
{
    if( getValue( this ))  putValue( eAAG_AVS_StatiS, getValue( eAAG_AVS_StatiS ) + 1 );
}

on EnvVar eAAG_AVS_StatiDef
{
    putValue( eAAG_AVS_StatiS, 0 );
}

on EnvVar eBCM1_Lichtwarn_TexteDec
{
    if( getValue( this ))  putValue( eBCM1_Lichtwarn_TexteS, getValue( eBCM1_Lichtwarn_TexteS ) - 1 );
}

on EnvVar eBCM1_Lichtwarn_TexteInc
{
    if( getValue( this ))  putValue( eBCM1_Lichtwarn_TexteS, getValue( eBCM1_Lichtwarn_TexteS ) + 1 );
}

on EnvVar eBCM1_Lichtwarn_TexteDef
{
    putValue( eBCM1_Lichtwarn_TexteS, 0 );
}

on EnvVar eKY_IDGeber_1_StatusDec
{
    if( getValue( this ))  putValue( eKY_IDGeber_1_StatusS, getValue( eKY_IDGeber_1_StatusS ) - 1 );
}

on EnvVar eKY_IDGeber_1_StatusInc
{
    if( getValue( this ))  putValue( eKY_IDGeber_1_StatusS, getValue( eKY_IDGeber_1_StatusS ) + 1 );
}

on EnvVar eKY_IDGeber_1_StatusDef
{
    putValue( eKY_IDGeber_1_StatusS, 0 );
}

on EnvVar eKY_IDGeber_2_StatusDec
{
    if( getValue( this ))  putValue( eKY_IDGeber_2_StatusS, getValue( eKY_IDGeber_2_StatusS ) - 1 );
}

on EnvVar eKY_IDGeber_2_StatusInc
{
    if( getValue( this ))  putValue( eKY_IDGeber_2_StatusS, getValue( eKY_IDGeber_2_StatusS ) + 1 );
}

on EnvVar eKY_IDGeber_2_StatusDef
{
    putValue( eKY_IDGeber_2_StatusS, 0 );
}

on EnvVar eKY_IDGeber_3_StatusDec
{
    if( getValue( this ))  putValue( eKY_IDGeber_3_StatusS, getValue( eKY_IDGeber_3_StatusS ) - 1 );
}

on EnvVar eKY_IDGeber_3_StatusInc
{
    if( getValue( this ))  putValue( eKY_IDGeber_3_StatusS, getValue( eKY_IDGeber_3_StatusS ) + 1 );
}

on EnvVar eKY_IDGeber_3_StatusDef
{
    putValue( eKY_IDGeber_3_StatusS, 0 );
}

on EnvVar eKY_IDGeber_4_StatusDec
{
    if( getValue( this ))  putValue( eKY_IDGeber_4_StatusS, getValue( eKY_IDGeber_4_StatusS ) - 1 );
}

on EnvVar eKY_IDGeber_4_StatusInc
{
    if( getValue( this ))  putValue( eKY_IDGeber_4_StatusS, getValue( eKY_IDGeber_4_StatusS ) + 1 );
}

on EnvVar eKY_IDGeber_4_StatusDef
{
    putValue( eKY_IDGeber_4_StatusS, 0 );
}

on EnvVar eKY_IDGeber_1_BatDec
{
    if( getValue( this ))  putValue( eKY_IDGeber_1_BatS, getValue( eKY_IDGeber_1_BatS ) - 1 );
}

on EnvVar eKY_IDGeber_1_BatInc
{
    if( getValue( this ))  putValue( eKY_IDGeber_1_BatS, getValue( eKY_IDGeber_1_BatS ) + 1 );
}

on EnvVar eKY_IDGeber_1_BatDef
{
    putValue( eKY_IDGeber_1_BatS, 0 );
}

on EnvVar eKY_IDGeber_2_BatDec
{
    if( getValue( this ))  putValue( eKY_IDGeber_2_BatS, getValue( eKY_IDGeber_2_BatS ) - 1 );
}

on EnvVar eKY_IDGeber_2_BatInc
{
    if( getValue( this ))  putValue( eKY_IDGeber_2_BatS, getValue( eKY_IDGeber_2_BatS ) + 1 );
}

on EnvVar eKY_IDGeber_2_BatDef
{
    putValue( eKY_IDGeber_2_BatS, 0 );
}

on EnvVar eKY_IDGeber_3_BatDec
{
    if( getValue( this ))  putValue( eKY_IDGeber_3_BatS, getValue( eKY_IDGeber_3_BatS ) - 1 );
}

on EnvVar eKY_IDGeber_3_BatInc
{
    if( getValue( this ))  putValue( eKY_IDGeber_3_BatS, getValue( eKY_IDGeber_3_BatS ) + 1 );
}

on EnvVar eKY_IDGeber_3_BatDef
{
    putValue( eKY_IDGeber_3_BatS, 0 );
}

on EnvVar eKY_IDGeber_4_BatDec
{
    if( getValue( this ))  putValue( eKY_IDGeber_4_BatS, getValue( eKY_IDGeber_4_BatS ) - 1 );
}

on EnvVar eKY_IDGeber_4_BatInc
{
    if( getValue( this ))  putValue( eKY_IDGeber_4_BatS, getValue( eKY_IDGeber_4_BatS ) + 1 );
}

on EnvVar eKY_IDGeber_4_BatDef
{
    putValue( eKY_IDGeber_4_BatS, 0 );
}

on EnvVar eKY_RSSI_WertDec
{
    if( getValue( this ))  putValue( eKY_RSSI_WertS, getValue( eKY_RSSI_WertS ) - 1 );
}

on EnvVar eKY_RSSI_WertInc
{
    if( getValue( this ))  putValue( eKY_RSSI_WertS, getValue( eKY_RSSI_WertS ) + 1 );
}

on EnvVar eKY_RSSI_WertDef
{
    putValue( eKY_RSSI_WertS, 0 );
}

on EnvVar eKY_Nr_IDGeber_AutofktDec
{
    if( getValue( this ))  putValue( eKY_Nr_IDGeber_AutofktS, getValue( eKY_Nr_IDGeber_AutofktS ) - 1 );
}

on EnvVar eKY_Nr_IDGeber_AutofktInc
{
    if( getValue( this ))  putValue( eKY_Nr_IDGeber_AutofktS, getValue( eKY_Nr_IDGeber_AutofktS ) + 1 );
}

on EnvVar eKY_Nr_IDGeber_AutofktDef
{
    putValue( eKY_Nr_IDGeber_AutofktS, 0 );
}

on EnvVar eKY_BedienstelleDec
{
    if( getValue( this ))  putValue( eKY_BedienstelleS, getValue( eKY_BedienstelleS ) - 1 );
}

on EnvVar eKY_BedienstelleInc
{
    if( getValue( this ))  putValue( eKY_BedienstelleS, getValue( eKY_BedienstelleS ) + 1 );
}

on EnvVar eKY_BedienstelleDef
{
    putValue( eKY_BedienstelleS, 0 );
}

on EnvVar eKY_ZV_CMDDec
{
    if( getValue( this ))  putValue( eKY_ZV_CMDS, getValue( eKY_ZV_CMDS ) - 1 );
}

on EnvVar eKY_ZV_CMDInc
{
    if( getValue( this ))  putValue( eKY_ZV_CMDS, getValue( eKY_ZV_CMDS ) + 1 );
}

on EnvVar eKY_ZV_CMDDef
{
    putValue( eKY_ZV_CMDS, 0 );
}

on EnvVar eKY_SchluesselnrDec
{
    if( getValue( this ))  putValue( eKY_SchluesselnrS, getValue( eKY_SchluesselnrS ) - 1 );
}

on EnvVar eKY_SchluesselnrInc
{
    if( getValue( this ))  putValue( eKY_SchluesselnrS, getValue( eKY_SchluesselnrS ) + 1 );
}

on EnvVar eKY_SchluesselnrDef
{
    putValue( eKY_SchluesselnrS, 0 );
}

on EnvVar eKY_WFS_KeyDataDec
{
    if( getValue( this ))  putValue( eKY_WFS_KeyDataS, getValue( eKY_WFS_KeyDataS ) - 1 );
}

on EnvVar eKY_WFS_KeyDataInc
{
    if( getValue( this ))  putValue( eKY_WFS_KeyDataS, getValue( eKY_WFS_KeyDataS ) + 1 );
}

on EnvVar eKY_WFS_KeyDataDef
{
    putValue( eKY_WFS_KeyDataS, 0 );
}

on EnvVar eBEM_02_AbschaltstufenDec
{
    if( getValue( this ))  putValue( eBEM_02_AbschaltstufenS, getValue( eBEM_02_AbschaltstufenS ) - 1 );
}

on EnvVar eBEM_02_AbschaltstufenInc
{
    if( getValue( this ))  putValue( eBEM_02_AbschaltstufenS, getValue( eBEM_02_AbschaltstufenS ) + 1 );
}

on EnvVar eBEM_02_AbschaltstufenDef
{
    putValue( eBEM_02_AbschaltstufenS, 0 );
}

on EnvVar eBEM_STH_ZielzeitDec
{
    if( getValue( this ))  putValue( eBEM_STH_ZielzeitS, getValue( eBEM_STH_ZielzeitS ) - 5 );
}

on EnvVar eBEM_STH_ZielzeitInc
{
    if( getValue( this ))  putValue( eBEM_STH_ZielzeitS, getValue( eBEM_STH_ZielzeitS ) + 5 );
}

on EnvVar eBEM_STH_ZielzeitDef
{
    putValue( eBEM_STH_ZielzeitS, 70 );
}

on EnvVar eBEM_HL_KontingentierungDec
{
    if( getValue( this ))  putValue( eBEM_HL_KontingentierungS, getValue( eBEM_HL_KontingentierungS ) - 50 );
}

on EnvVar eBEM_HL_KontingentierungInc
{
    if( getValue( this ))  putValue( eBEM_HL_KontingentierungS, getValue( eBEM_HL_KontingentierungS ) + 50 );
}

on EnvVar eBEM_HL_KontingentierungDef
{
    putValue( eBEM_HL_KontingentierungS, -1000 );
}

on EnvVar eBEM_GeneratordiagnoseDec
{
    if( getValue( this ))  putValue( eBEM_GeneratordiagnoseS, getValue( eBEM_GeneratordiagnoseS ) - 1 );
}

on EnvVar eBEM_GeneratordiagnoseInc
{
    if( getValue( this ))  putValue( eBEM_GeneratordiagnoseS, getValue( eBEM_GeneratordiagnoseS ) + 1 );
}

on EnvVar eBEM_GeneratordiagnoseDef
{
    putValue( eBEM_GeneratordiagnoseS, 0 );
}

on EnvVar eBEM_Red_InnengeblaeseDec
{
    if( getValue( this ))  putValue( eBEM_Red_InnengeblaeseS, getValue( eBEM_Red_InnengeblaeseS ) - 1 );
}

on EnvVar eBEM_Red_InnengeblaeseInc
{
    if( getValue( this ))  putValue( eBEM_Red_InnengeblaeseS, getValue( eBEM_Red_InnengeblaeseS ) + 1 );
}

on EnvVar eBEM_Red_InnengeblaeseDef
{
    putValue( eBEM_Red_InnengeblaeseS, 0 );
}

on EnvVar eBEM_HL_Regelung_StatusDec
{
    if( getValue( this ))  putValue( eBEM_HL_Regelung_StatusS, getValue( eBEM_HL_Regelung_StatusS ) - 1 );
}

on EnvVar eBEM_HL_Regelung_StatusInc
{
    if( getValue( this ))  putValue( eBEM_HL_Regelung_StatusS, getValue( eBEM_HL_Regelung_StatusS ) + 1 );
}

on EnvVar eBEM_HL_Regelung_StatusDef
{
    putValue( eBEM_HL_Regelung_StatusS, 0 );
}

on EnvVar eBEM_LadezustandDec
{
    if( getValue( this ))  putValue( eBEM_LadezustandS, getValue( eBEM_LadezustandS ) - 10 );
}

on EnvVar eBEM_LadezustandInc
{
    if( getValue( this ))  putValue( eBEM_LadezustandS, getValue( eBEM_LadezustandS ) + 10 );
}

on EnvVar eBEM_LadezustandDef
{
    putValue( eBEM_LadezustandS, 140 );
}

on EnvVar eBEM_BatteriediagnoseDec
{
    if( getValue( this ))  putValue( eBEM_BatteriediagnoseS, getValue( eBEM_BatteriediagnoseS ) - 1 );
}

on EnvVar eBEM_BatteriediagnoseInc
{
    if( getValue( this ))  putValue( eBEM_BatteriediagnoseS, getValue( eBEM_BatteriediagnoseS ) + 1 );
}

on EnvVar eBEM_BatteriediagnoseDef
{
    putValue( eBEM_BatteriediagnoseS, 0 );
}

on EnvVar eBEM_DFMDec
{
    if( getValue( this ))  putValue( eBEM_DFMS, getValue( eBEM_DFMS ) - 3.225 );
}

on EnvVar eBEM_DFMInc
{
    if( getValue( this ))  putValue( eBEM_DFMS, getValue( eBEM_DFMS ) + 3.225 );
}

on EnvVar eBEM_DFMDef
{
    putValue( eBEM_DFMS, 0.025 );
}

on EnvVar eBEM_UBDMDec
{
    if( getValue( this ))  putValue( eBEM_UBDMS, getValue( eBEM_UBDMS ) - 0.05 );
}

on EnvVar eBEM_UBDMInc
{
    if( getValue( this ))  putValue( eBEM_UBDMS, getValue( eBEM_UBDMS ) + 0.05 );
}

on EnvVar eBEM_UBDMDef
{
    putValue( eBEM_UBDMS, 5 );
}

on EnvVar eBEM_UGenSollDec
{
    if( getValue( this ))  putValue( eBEM_UGenSollS, getValue( eBEM_UGenSollS ) - 0.1 );
}

on EnvVar eBEM_UGenSollInc
{
    if( getValue( this ))  putValue( eBEM_UGenSollS, getValue( eBEM_UGenSollS ) + 0.1 );
}

on EnvVar eBEM_UGenSollDef
{
    putValue( eBEM_UGenSollS, 10.6 );
}

on EnvVar eBM_NBA_StatusDec
{
    if( getValue( this ))  putValue( eBM_NBA_StatusS, getValue( eBM_NBA_StatusS ) - 1 );
}

on EnvVar eBM_NBA_StatusInc
{
    if( getValue( this ))  putValue( eBM_NBA_StatusS, getValue( eBM_NBA_StatusS ) + 1 );
}

on EnvVar eBM_NBA_StatusDef
{
    putValue( eBM_NBA_StatusS, 0 );
}

on EnvVar eCHA_Eco_Charisma_LEDDec
{
    if( getValue( this ))  putValue( eCHA_Eco_Charisma_LEDS, getValue( eCHA_Eco_Charisma_LEDS ) - 1 );
}

on EnvVar eCHA_Eco_Charisma_LEDInc
{
    if( getValue( this ))  putValue( eCHA_Eco_Charisma_LEDS, getValue( eCHA_Eco_Charisma_LEDS ) + 1 );
}

on EnvVar eCHA_Eco_Charisma_LEDDef
{
    putValue( eCHA_Eco_Charisma_LEDS, 0 );
}

on EnvVar eCHA_Ziel_FahrPr_AMBDec
{
    if( getValue( this ))  putValue( eCHA_Ziel_FahrPr_AMBS, getValue( eCHA_Ziel_FahrPr_AMBS ) - 1 );
}

on EnvVar eCHA_Ziel_FahrPr_AMBInc
{
    if( getValue( this ))  putValue( eCHA_Ziel_FahrPr_AMBS, getValue( eCHA_Ziel_FahrPr_AMBS ) + 1 );
}

on EnvVar eCHA_Ziel_FahrPr_AMBDef
{
    putValue( eCHA_Ziel_FahrPr_AMBS, 0 );
}

on EnvVar eCHA_Ziel_FahrPr_IVBDec
{
    if( getValue( this ))  putValue( eCHA_Ziel_FahrPr_IVBS, getValue( eCHA_Ziel_FahrPr_IVBS ) - 1 );
}

on EnvVar eCHA_Ziel_FahrPr_IVBInc
{
    if( getValue( this ))  putValue( eCHA_Ziel_FahrPr_IVBS, getValue( eCHA_Ziel_FahrPr_IVBS ) + 1 );
}

on EnvVar eCHA_Ziel_FahrPr_IVBDef
{
    putValue( eCHA_Ziel_FahrPr_IVBS, 0 );
}

on EnvVar eCHA_Kombi_TexteDec
{
    if( getValue( this ))  putValue( eCHA_Kombi_TexteS, getValue( eCHA_Kombi_TexteS ) - 1 );
}

on EnvVar eCHA_Kombi_TexteInc
{
    if( getValue( this ))  putValue( eCHA_Kombi_TexteS, getValue( eCHA_Kombi_TexteS ) + 1 );
}

on EnvVar eCHA_Kombi_TexteDef
{
    putValue( eCHA_Kombi_TexteS, 0 );
}

on EnvVar eCHA_Ziel_FahrPr_KLDec
{
    if( getValue( this ))  putValue( eCHA_Ziel_FahrPr_KLS, getValue( eCHA_Ziel_FahrPr_KLS ) - 1 );
}

on EnvVar eCHA_Ziel_FahrPr_KLInc
{
    if( getValue( this ))  putValue( eCHA_Ziel_FahrPr_KLS, getValue( eCHA_Ziel_FahrPr_KLS ) + 1 );
}

on EnvVar eCHA_Ziel_FahrPr_KLDef
{
    putValue( eCHA_Ziel_FahrPr_KLS, 0 );
}

on EnvVar eCHA_Ziel_FahrPr_NAV_RouteDec
{
    if( getValue( this ))  putValue( eCHA_Ziel_FahrPr_NAV_RouteS, getValue( eCHA_Ziel_FahrPr_NAV_RouteS ) - 1 );
}

on EnvVar eCHA_Ziel_FahrPr_NAV_RouteInc
{
    if( getValue( this ))  putValue( eCHA_Ziel_FahrPr_NAV_RouteS, getValue( eCHA_Ziel_FahrPr_NAV_RouteS ) + 1 );
}

on EnvVar eCHA_Ziel_FahrPr_NAV_RouteDef
{
    putValue( eCHA_Ziel_FahrPr_NAV_RouteS, 0 );
}

on EnvVar eCHA_Ziel_FahrPr_NAV_SegelDec
{
    if( getValue( this ))  putValue( eCHA_Ziel_FahrPr_NAV_SegelS, getValue( eCHA_Ziel_FahrPr_NAV_SegelS ) - 1 );
}

on EnvVar eCHA_Ziel_FahrPr_NAV_SegelInc
{
    if( getValue( this ))  putValue( eCHA_Ziel_FahrPr_NAV_SegelS, getValue( eCHA_Ziel_FahrPr_NAV_SegelS ) + 1 );
}

on EnvVar eCHA_Ziel_FahrPr_NAV_SegelDef
{
    putValue( eCHA_Ziel_FahrPr_NAV_SegelS, 0 );
}

on EnvVar eCHA_Ziel_FahrPr_03_01Dec
{
    if( getValue( this ))  putValue( eCHA_Ziel_FahrPr_03_01S, getValue( eCHA_Ziel_FahrPr_03_01S ) - 1 );
}

on EnvVar eCHA_Ziel_FahrPr_03_01Inc
{
    if( getValue( this ))  putValue( eCHA_Ziel_FahrPr_03_01S, getValue( eCHA_Ziel_FahrPr_03_01S ) + 1 );
}

on EnvVar eCHA_Ziel_FahrPr_03_01Def
{
    putValue( eCHA_Ziel_FahrPr_03_01S, 0 );
}

on EnvVar eCHA_Ziel_FahrPr_03_02Dec
{
    if( getValue( this ))  putValue( eCHA_Ziel_FahrPr_03_02S, getValue( eCHA_Ziel_FahrPr_03_02S ) - 1 );
}

on EnvVar eCHA_Ziel_FahrPr_03_02Inc
{
    if( getValue( this ))  putValue( eCHA_Ziel_FahrPr_03_02S, getValue( eCHA_Ziel_FahrPr_03_02S ) + 1 );
}

on EnvVar eCHA_Ziel_FahrPr_03_02Def
{
    putValue( eCHA_Ziel_FahrPr_03_02S, 0 );
}

on EnvVar eDR_SystemstatusDec
{
    if( getValue( this ))  putValue( eDR_SystemstatusS, getValue( eDR_SystemstatusS ) - 1 );
}

on EnvVar eDR_SystemstatusInc
{
    if( getValue( this ))  putValue( eDR_SystemstatusS, getValue( eDR_SystemstatusS ) + 1 );
}

on EnvVar eDR_SystemstatusDef
{
    putValue( eDR_SystemstatusS, 0 );
}

on EnvVar eLF_TexteDec
{
    if( getValue( this ))  putValue( eLF_TexteS, getValue( eLF_TexteS ) - 1 );
}

on EnvVar eLF_TexteInc
{
    if( getValue( this ))  putValue( eLF_TexteS, getValue( eLF_TexteS ) + 1 );
}

on EnvVar eLF_TexteDef
{
    putValue( eLF_TexteS, 0 );
}

on EnvVar eDR_Gelbe_WarnlampeDec
{
    if( getValue( this ))  putValue( eDR_Gelbe_WarnlampeS, getValue( eDR_Gelbe_WarnlampeS ) - 1 );
}

on EnvVar eDR_Gelbe_WarnlampeInc
{
    if( getValue( this ))  putValue( eDR_Gelbe_WarnlampeS, getValue( eDR_Gelbe_WarnlampeS ) + 1 );
}

on EnvVar eDR_Gelbe_WarnlampeDef
{
    putValue( eDR_Gelbe_WarnlampeS, 0 );
}

on EnvVar eDR_Daempferreg_TexteDec
{
    if( getValue( this ))  putValue( eDR_Daempferreg_TexteS, getValue( eDR_Daempferreg_TexteS ) - 1 );
}

on EnvVar eDR_Daempferreg_TexteInc
{
    if( getValue( this ))  putValue( eDR_Daempferreg_TexteS, getValue( eDR_Daempferreg_TexteS ) + 1 );
}

on EnvVar eDR_Daempferreg_TexteDef
{
    putValue( eDR_Daempferreg_TexteS, 0 );
}

on EnvVar eDGN_VerlernzaehlerDec
{
    if( getValue( this ))  putValue( eDGN_VerlernzaehlerS, getValue( eDGN_VerlernzaehlerS ) - 1 );
}

on EnvVar eDGN_VerlernzaehlerInc
{
    if( getValue( this ))  putValue( eDGN_VerlernzaehlerS, getValue( eDGN_VerlernzaehlerS ) + 1 );
}

on EnvVar eDGN_VerlernzaehlerDef
{
    putValue( eDGN_VerlernzaehlerS, 0 );
}

on EnvVar eKBI_Kilometerstand_1Dec
{
    if( getValue( this ))  putValue( eKBI_Kilometerstand_1S, getValue( eKBI_Kilometerstand_1S ) - 1 );
}

on EnvVar eKBI_Kilometerstand_1Inc
{
    if( getValue( this ))  putValue( eKBI_Kilometerstand_1S, getValue( eKBI_Kilometerstand_1S ) + 1 );
}

on EnvVar eKBI_Kilometerstand_1Def
{
    putValue( eKBI_Kilometerstand_1S, 1048574 );
}

on EnvVar eUH_Jahr_1Dec
{
    if( getValue( this ))  putValue( eUH_Jahr_1S, getValue( eUH_Jahr_1S ) - 1 );
}

on EnvVar eUH_Jahr_1Inc
{
    if( getValue( this ))  putValue( eUH_Jahr_1S, getValue( eUH_Jahr_1S ) + 1 );
}

on EnvVar eUH_Jahr_1Def
{
    putValue( eUH_Jahr_1S, 2000 );
}

on EnvVar eUH_Monat_1Dec
{
    if( getValue( this ))  putValue( eUH_Monat_1S, getValue( eUH_Monat_1S ) - 1 );
}

on EnvVar eUH_Monat_1Inc
{
    if( getValue( this ))  putValue( eUH_Monat_1S, getValue( eUH_Monat_1S ) + 1 );
}

on EnvVar eUH_Monat_1Def
{
    putValue( eUH_Monat_1S, 1 );
}

on EnvVar eUH_Tag_1Dec
{
    if( getValue( this ))  putValue( eUH_Tag_1S, getValue( eUH_Tag_1S ) - 1 );
}

on EnvVar eUH_Tag_1Inc
{
    if( getValue( this ))  putValue( eUH_Tag_1S, getValue( eUH_Tag_1S ) + 1 );
}

on EnvVar eUH_Tag_1Def
{
    putValue( eUH_Tag_1S, 0 );
}

on EnvVar eUH_Stunde_1Dec
{
    if( getValue( this ))  putValue( eUH_Stunde_1S, getValue( eUH_Stunde_1S ) - 1 );
}

on EnvVar eUH_Stunde_1Inc
{
    if( getValue( this ))  putValue( eUH_Stunde_1S, getValue( eUH_Stunde_1S ) + 1 );
}

on EnvVar eUH_Stunde_1Def
{
    putValue( eUH_Stunde_1S, 0 );
}

on EnvVar eUH_Minute_1Dec
{
    if( getValue( this ))  putValue( eUH_Minute_1S, getValue( eUH_Minute_1S ) - 1 );
}

on EnvVar eUH_Minute_1Inc
{
    if( getValue( this ))  putValue( eUH_Minute_1S, getValue( eUH_Minute_1S ) + 1 );
}

on EnvVar eUH_Minute_1Def
{
    putValue( eUH_Minute_1S, 0 );
}

on EnvVar eUH_Sekunde_1Dec
{
    if( getValue( this ))  putValue( eUH_Sekunde_1S, getValue( eUH_Sekunde_1S ) - 1 );
}

on EnvVar eUH_Sekunde_1Inc
{
    if( getValue( this ))  putValue( eUH_Sekunde_1S, getValue( eUH_Sekunde_1S ) + 1 );
}

on EnvVar eUH_Sekunde_1Def
{
    putValue( eUH_Sekunde_1S, 0 );
}

on EnvVar eDI_KL_58xdDec
{
    if( getValue( this ))  putValue( eDI_KL_58xdS, getValue( eDI_KL_58xdS ) - 1 );
}

on EnvVar eDI_KL_58xdInc
{
    if( getValue( this ))  putValue( eDI_KL_58xdS, getValue( eDI_KL_58xdS ) + 1 );
}

on EnvVar eDI_KL_58xdDef
{
    putValue( eDI_KL_58xdS, 254 );
}

on EnvVar eDI_KL_58xsDec
{
    if( getValue( this ))  putValue( eDI_KL_58xsS, getValue( eDI_KL_58xsS ) - 1 );
}

on EnvVar eDI_KL_58xsInc
{
    if( getValue( this ))  putValue( eDI_KL_58xsS, getValue( eDI_KL_58xsS ) + 1 );
}

on EnvVar eDI_KL_58xsDef
{
    putValue( eDI_KL_58xsS, 126 );
}

on EnvVar eDI_KL_58xtDec
{
    if( getValue( this ))  putValue( eDI_KL_58xtS, getValue( eDI_KL_58xtS ) - 1 );
}

on EnvVar eDI_KL_58xtInc
{
    if( getValue( this ))  putValue( eDI_KL_58xtS, getValue( eDI_KL_58xtS ) + 1 );
}

on EnvVar eDI_KL_58xtDef
{
    putValue( eDI_KL_58xtS, 126 );
}

on EnvVar eDI_FotosensorDec
{
    if( getValue( this ))  putValue( eDI_FotosensorS, getValue( eDI_FotosensorS ) - 1 );
}

on EnvVar eDI_FotosensorInc
{
    if( getValue( this ))  putValue( eDI_FotosensorS, getValue( eDI_FotosensorS ) + 1 );
}

on EnvVar eDI_FotosensorDef
{
    putValue( eDI_FotosensorS, 0 );
}

on EnvVar eELV_WFS_RNDDec
{
    if( getValue( this ))  putValue( eELV_WFS_RNDS, getValue( eELV_WFS_RNDS ) - 1 );
}

on EnvVar eELV_WFS_RNDInc
{
    if( getValue( this ))  putValue( eELV_WFS_RNDS, getValue( eELV_WFS_RNDS ) + 1 );
}

on EnvVar eELV_WFS_RNDDef
{
    putValue( eELV_WFS_RNDS, 0 );
}

on EnvVar eELV_WFS_CRCDec
{
    if( getValue( this ))  putValue( eELV_WFS_CRCS, getValue( eELV_WFS_CRCS ) - 1 );
}

on EnvVar eELV_WFS_CRCInc
{
    if( getValue( this ))  putValue( eELV_WFS_CRCS, getValue( eELV_WFS_CRCS ) + 1 );
}

on EnvVar eELV_WFS_CRCDef
{
    putValue( eELV_WFS_CRCS, 0 );
}

on EnvVar eEPB_TexteDec
{
    if( getValue( this ))  putValue( eEPB_TexteS, getValue( eEPB_TexteS ) - 1 );
}

on EnvVar eEPB_TexteInc
{
    if( getValue( this ))  putValue( eEPB_TexteS, getValue( eEPB_TexteS ) + 1 );
}

on EnvVar eEPB_TexteDef
{
    putValue( eEPB_TexteS, 0 );
}

on EnvVar eESP_QuerbeschleunigungDec
{
    if( getValue( this ))  putValue( eESP_QuerbeschleunigungS, getValue( eESP_QuerbeschleunigungS ) - 0.01 );
}

on EnvVar eESP_QuerbeschleunigungInc
{
    if( getValue( this ))  putValue( eESP_QuerbeschleunigungS, getValue( eESP_QuerbeschleunigungS ) + 0.01 );
}

on EnvVar eESP_QuerbeschleunigungDef
{
    putValue( eESP_QuerbeschleunigungS, 0 );
}

on EnvVar eESP_LaengsbeschlDec
{
    if( getValue( this ))  putValue( eESP_LaengsbeschlS, getValue( eESP_LaengsbeschlS ) - 0.03125 );
}

on EnvVar eESP_LaengsbeschlInc
{
    if( getValue( this ))  putValue( eESP_LaengsbeschlS, getValue( eESP_LaengsbeschlS ) + 0.03125 );
}

on EnvVar eESP_LaengsbeschlDef
{
    putValue( eESP_LaengsbeschlS, 0 );
}

on EnvVar eESP_GierrateDec
{
    if( getValue( this ))  putValue( eESP_GierrateS, getValue( eESP_GierrateS ) - 0.01 );
}

on EnvVar eESP_GierrateInc
{
    if( getValue( this ))  putValue( eESP_GierrateS, getValue( eESP_GierrateS ) + 0.01 );
}

on EnvVar eESP_GierrateDef
{
    putValue( eESP_GierrateS, 0 );
}

on EnvVar eESP_PLA_AbbruchDec
{
    if( getValue( this ))  putValue( eESP_PLA_AbbruchS, getValue( eESP_PLA_AbbruchS ) - 1 );
}

on EnvVar eESP_PLA_AbbruchInc
{
    if( getValue( this ))  putValue( eESP_PLA_AbbruchS, getValue( eESP_PLA_AbbruchS ) + 1 );
}

on EnvVar eESP_PLA_AbbruchDef
{
    putValue( eESP_PLA_AbbruchS, 0 );
}

on EnvVar eESP_Status_ESP_PLADec
{
    if( getValue( this ))  putValue( eESP_Status_ESP_PLAS, getValue( eESP_Status_ESP_PLAS ) - 1 );
}

on EnvVar eESP_Status_ESP_PLAInc
{
    if( getValue( this ))  putValue( eESP_Status_ESP_PLAS, getValue( eESP_Status_ESP_PLAS ) + 1 );
}

on EnvVar eESP_Status_ESP_PLADef
{
    putValue( eESP_Status_ESP_PLAS, 0 );
}

on EnvVar eBR_SystemartDec
{
    if( getValue( this ))  putValue( eBR_SystemartS, getValue( eBR_SystemartS ) - 1 );
}

on EnvVar eBR_SystemartInc
{
    if( getValue( this ))  putValue( eBR_SystemartS, getValue( eBR_SystemartS ) + 1 );
}

on EnvVar eBR_SystemartDef
{
    putValue( eBR_SystemartS, 0 );
}

on EnvVar eESP_ZaehnezahlDec
{
    if( getValue( this ))  putValue( eESP_ZaehnezahlS, getValue( eESP_ZaehnezahlS ) - 1 );
}

on EnvVar eESP_ZaehnezahlInc
{
    if( getValue( this ))  putValue( eESP_ZaehnezahlS, getValue( eESP_ZaehnezahlS ) + 1 );
}

on EnvVar eESP_ZaehnezahlDef
{
    putValue( eESP_ZaehnezahlS, 0 );
}

on EnvVar eESP_24_BZDec
{
    if( getValue( this ))  putValue( eESP_24_BZS, getValue( eESP_24_BZS ) - 1 );
}

on EnvVar eESP_24_BZInc
{
    if( getValue( this ))  putValue( eESP_24_BZS, getValue( eESP_24_BZS ) + 1 );
}

on EnvVar eESP_24_BZDef
{
    putValue( eESP_24_BZS, 0 );
}

on EnvVar eESP_21_BZDec
{
    if( getValue( this ))  putValue( eESP_21_BZS, getValue( eESP_21_BZS ) - 1 );
}

on EnvVar eESP_21_BZInc
{
    if( getValue( this ))  putValue( eESP_21_BZS, getValue( eESP_21_BZS ) + 1 );
}

on EnvVar eESP_21_BZDef
{
    putValue( eESP_21_BZS, 0 );
}

on EnvVar eTSG_FT_02_BZDec
{
    if( getValue( this ))  putValue( eTSG_FT_02_BZS, getValue( eTSG_FT_02_BZS ) - 1 );
}

on EnvVar eTSG_FT_02_BZInc
{
    if( getValue( this ))  putValue( eTSG_FT_02_BZS, getValue( eTSG_FT_02_BZS ) + 1 );
}

on EnvVar eTSG_FT_02_BZDef
{
    putValue( eTSG_FT_02_BZS, 0 );
}

on EnvVar eBK_Lampe_02Dec
{
    if( getValue( this ))  putValue( eBK_Lampe_02S, getValue( eBK_Lampe_02S ) - 1 );
}

on EnvVar eBK_Lampe_02Inc
{
    if( getValue( this ))  putValue( eBK_Lampe_02S, getValue( eBK_Lampe_02S ) + 1 );
}

on EnvVar eBK_Lampe_02Def
{
    putValue( eBK_Lampe_02S, 1 );
}

on EnvVar eESP_m_RaddrehzDec
{
    if( getValue( this ))  putValue( eESP_m_RaddrehzS, getValue( eESP_m_RaddrehzS ) - 0.002 );
}

on EnvVar eESP_m_RaddrehzInc
{
    if( getValue( this ))  putValue( eESP_m_RaddrehzS, getValue( eESP_m_RaddrehzS ) + 0.002 );
}

on EnvVar eESP_m_RaddrehzDef
{
    putValue( eESP_m_RaddrehzS, 65.532 );
}

on EnvVar eESP_Textanzeigen_03Dec
{
    if( getValue( this ))  putValue( eESP_Textanzeigen_03S, getValue( eESP_Textanzeigen_03S ) - 1 );
}

on EnvVar eESP_Textanzeigen_03Inc
{
    if( getValue( this ))  putValue( eESP_Textanzeigen_03S, getValue( eESP_Textanzeigen_03S ) + 1 );
}

on EnvVar eESP_Textanzeigen_03Def
{
    putValue( eESP_Textanzeigen_03S, 0 );
}

on EnvVar eESP_MeldungenDec
{
    if( getValue( this ))  putValue( eESP_MeldungenS, getValue( eESP_MeldungenS ) - 1 );
}

on EnvVar eESP_MeldungenInc
{
    if( getValue( this ))  putValue( eESP_MeldungenS, getValue( eESP_MeldungenS ) + 1 );
}

on EnvVar eESP_MeldungenDef
{
    putValue( eESP_MeldungenS, 0 );
}

on EnvVar eESP_Wegimp_VADec
{
    if( getValue( this ))  putValue( eESP_Wegimp_VAS, getValue( eESP_Wegimp_VAS ) - 1 );
}

on EnvVar eESP_Wegimp_VAInc
{
    if( getValue( this ))  putValue( eESP_Wegimp_VAS, getValue( eESP_Wegimp_VAS ) + 1 );
}

on EnvVar eESP_Wegimp_VADef
{
    putValue( eESP_Wegimp_VAS, 0 );
}

on EnvVar eMKE_TexteDec
{
    if( getValue( this ))  putValue( eMKE_TexteS, getValue( eMKE_TexteS ) - 1 );
}

on EnvVar eMKE_TexteInc
{
    if( getValue( this ))  putValue( eMKE_TexteS, getValue( eMKE_TexteS ) + 1 );
}

on EnvVar eMKE_TexteDef
{
    putValue( eMKE_TexteS, 0 );
}

on EnvVar eMO_Drehzahl_01Dec
{
    if( getValue( this ))  putValue( eMO_Drehzahl_01S, getValue( eMO_Drehzahl_01S ) - 0.25 );
}

on EnvVar eMO_Drehzahl_01Inc
{
    if( getValue( this ))  putValue( eMO_Drehzahl_01S, getValue( eMO_Drehzahl_01S ) + 0.25 );
}

on EnvVar eMO_Drehzahl_01Def
{
    putValue( eMO_Drehzahl_01S, 0 );
}

on EnvVar eGE_FahrstufeDec
{
    if( getValue( this ))  putValue( eGE_FahrstufeS, getValue( eGE_FahrstufeS ) - 1 );
}

on EnvVar eGE_FahrstufeInc
{
    if( getValue( this ))  putValue( eGE_FahrstufeS, getValue( eGE_FahrstufeS ) + 1 );
}

on EnvVar eGE_FahrstufeDef
{
    putValue( eGE_FahrstufeS, 1 );
}

on EnvVar eGE_ZielgangDec
{
    if( getValue( this ))  putValue( eGE_ZielgangS, getValue( eGE_ZielgangS ) - 1 );
}

on EnvVar eGE_ZielgangInc
{
    if( getValue( this ))  putValue( eGE_ZielgangS, getValue( eGE_ZielgangS ) + 1 );
}

on EnvVar eGE_ZielgangDef
{
    putValue( eGE_ZielgangS, 0 );
}

on EnvVar eWFS_GSG_RNDDec
{
    if( getValue( this ))  putValue( eWFS_GSG_RNDS, getValue( eWFS_GSG_RNDS ) - 1 );
}

on EnvVar eWFS_GSG_RNDInc
{
    if( getValue( this ))  putValue( eWFS_GSG_RNDS, getValue( eWFS_GSG_RNDS ) + 1 );
}

on EnvVar eWFS_GSG_RNDDef
{
    putValue( eWFS_GSG_RNDS, 0 );
}

on EnvVar eWFS_GSG_CRCDec
{
    if( getValue( this ))  putValue( eWFS_GSG_CRCS, getValue( eWFS_GSG_CRCS ) - 1 );
}

on EnvVar eWFS_GSG_CRCInc
{
    if( getValue( this ))  putValue( eWFS_GSG_CRCS, getValue( eWFS_GSG_CRCS ) + 1 );
}

on EnvVar eWFS_GSG_CRCDef
{
    putValue( eWFS_GSG_CRCS, 0 );
}

on EnvVar eISO_ALL_01_Req_DataDec
{
    if( getValue( this ))  putValue( eISO_ALL_01_Req_DataS, getValue( eISO_ALL_01_Req_DataS ) - 1 );
}

on EnvVar eISO_ALL_01_Req_DataInc
{
    if( getValue( this ))  putValue( eISO_ALL_01_Req_DataS, getValue( eISO_ALL_01_Req_DataS ) + 1 );
}

on EnvVar eISO_ALL_01_Req_DataDef
{
    putValue( eISO_ALL_01_Req_DataS, 0 );
}

on EnvVar eISO_ALL_01_Req_Data_2Dec
{
    if( getValue( this ))  putValue( eISO_ALL_01_Req_Data_2S, getValue( eISO_ALL_01_Req_Data_2S ) - 1 );
}

on EnvVar eISO_ALL_01_Req_Data_2Inc
{
    if( getValue( this ))  putValue( eISO_ALL_01_Req_Data_2S, getValue( eISO_ALL_01_Req_Data_2S ) + 1 );
}

on EnvVar eISO_ALL_01_Req_Data_2Def
{
    putValue( eISO_ALL_01_Req_Data_2S, 0 );
}

on EnvVar eISO_Kombi_Req_DataDec
{
    if( getValue( this ))  putValue( eISO_Kombi_Req_DataS, getValue( eISO_Kombi_Req_DataS ) - 1 );
}

on EnvVar eISO_Kombi_Req_DataInc
{
    if( getValue( this ))  putValue( eISO_Kombi_Req_DataS, getValue( eISO_Kombi_Req_DataS ) + 1 );
}

on EnvVar eISO_Kombi_Req_DataDef
{
    putValue( eISO_Kombi_Req_DataS, 0 );
}

on EnvVar eKY_MeldungenDec
{
    if( getValue( this ))  putValue( eKY_MeldungenS, getValue( eKY_MeldungenS ) - 1 );
}

on EnvVar eKY_MeldungenInc
{
    if( getValue( this ))  putValue( eKY_MeldungenS, getValue( eKY_MeldungenS ) + 1 );
}

on EnvVar eKY_MeldungenDef
{
    putValue( eKY_MeldungenS, 0 );
}

on EnvVar eKY_StartStopp_InfoDec
{
    if( getValue( this ))  putValue( eKY_StartStopp_InfoS, getValue( eKY_StartStopp_InfoS ) - 1 );
}

on EnvVar eKY_StartStopp_InfoInc
{
    if( getValue( this ))  putValue( eKY_StartStopp_InfoS, getValue( eKY_StartStopp_InfoS ) + 1 );
}

on EnvVar eKY_StartStopp_InfoDef
{
    putValue( eKY_StartStopp_InfoS, 0 );
}

on EnvVar eBCM1_Aussen_Temp_ungefDec
{
    if( getValue( this ))  putValue( eBCM1_Aussen_Temp_ungefS, getValue( eBCM1_Aussen_Temp_ungefS ) - 0.5 );
}

on EnvVar eBCM1_Aussen_Temp_ungefInc
{
    if( getValue( this ))  putValue( eBCM1_Aussen_Temp_ungefS, getValue( eBCM1_Aussen_Temp_ungefS ) + 0.5 );
}

on EnvVar eBCM1_Aussen_Temp_ungefDef
{
    putValue( eBCM1_Aussen_Temp_ungefS, 77 );
}

on EnvVar eBCM1_OBD_FStatus_ATempDec
{
    if( getValue( this ))  putValue( eBCM1_OBD_FStatus_ATempS, getValue( eBCM1_OBD_FStatus_ATempS ) - 1 );
}

on EnvVar eBCM1_OBD_FStatus_ATempInc
{
    if( getValue( this ))  putValue( eBCM1_OBD_FStatus_ATempS, getValue( eBCM1_OBD_FStatus_ATempS ) + 1 );
}

on EnvVar eBCM1_OBD_FStatus_ATempDef
{
    putValue( eBCM1_OBD_FStatus_ATempS, 0 );
}

on EnvVar eKS_Kombi_Req_DataDec
{
    if( getValue( this ))  putValue( eKS_Kombi_Req_DataS, getValue( eKS_Kombi_Req_DataS ) - 1 );
}

on EnvVar eKS_Kombi_Req_DataInc
{
    if( getValue( this ))  putValue( eKS_Kombi_Req_DataS, getValue( eKS_Kombi_Req_DataS ) + 1 );
}

on EnvVar eKS_Kombi_Req_DataDef
{
    putValue( eKS_Kombi_Req_DataS, 0 );
}

on EnvVar eLDW_GongDec
{
    if( getValue( this ))  putValue( eLDW_GongS, getValue( eLDW_GongS ) - 1 );
}

on EnvVar eLDW_GongInc
{
    if( getValue( this ))  putValue( eLDW_GongS, getValue( eLDW_GongS ) + 1 );
}

on EnvVar eLDW_GongDef
{
    putValue( eLDW_GongS, 0 );
}

on EnvVar eLDW_TexteDec
{
    if( getValue( this ))  putValue( eLDW_TexteS, getValue( eLDW_TexteS ) - 1 );
}

on EnvVar eLDW_TexteInc
{
    if( getValue( this ))  putValue( eLDW_TexteS, getValue( eLDW_TexteS ) + 1 );
}

on EnvVar eLDW_TexteDef
{
    putValue( eLDW_TexteS, 0 );
}

/*on EnvVar eLDW_LernmodusDec
{
    if( getValue( this ))  putValue( eLDW_LernmodusS, getValue( eLDW_LernmodusS ) - 1 );
}*/

/*on EnvVar eLDW_LernmodusInc
{
    if( getValue( this ))  putValue( eLDW_LernmodusS, getValue( eLDW_LernmodusS ) + 1 );
}*/

/*on EnvVar eLDW_LernmodusDef
{
    putValue( eLDW_LernmodusS, 0 );
}*/

/*on EnvVar eLDW_Anlaufsp_VLRDec
{
    if( getValue( this ))  putValue( eLDW_Anlaufsp_VLRS, getValue( eLDW_Anlaufsp_VLRS ) - 1 );
}*/

/*on EnvVar eLDW_Anlaufsp_VLRInc
/{
    if( getValue( this ))  putValue( eLDW_Anlaufsp_VLRS, getValue( eLDW_Anlaufsp_VLRS ) + 1 );
}*/

/*on EnvVar eLDW_Anlaufsp_VLRDef
{
    putValue( eLDW_Anlaufsp_VLRS, 0 );
}*/

/*on EnvVar eLDW_Vib_Amp_VLRDec
{
    if( getValue( this ))  putValue( eLDW_Vib_Amp_VLRS, getValue( eLDW_Vib_Amp_VLRS ) - 1 );
}*/

/*on EnvVar eLDW_Vib_Amp_VLRInc
{
    if( getValue( this ))  putValue( eLDW_Vib_Amp_VLRS, getValue( eLDW_Vib_Amp_VLRS ) + 1 );
}*/

/*on EnvVar eLDW_Vib_Amp_VLRDef
{
    putValue( eLDW_Vib_Amp_VLRS, 0 );
}*/

/*on EnvVar eLDW_Anlaufzeit_VLRDec
{
    if( getValue( this ))  putValue( eLDW_Anlaufzeit_VLRS, getValue( eLDW_Anlaufzeit_VLRS ) - 1 );
}*/

/*on EnvVar eLDW_Anlaufzeit_VLRInc
{
    if( getValue( this ))  putValue( eLDW_Anlaufzeit_VLRS, getValue( eLDW_Anlaufzeit_VLRS ) + 1 );
}*/

/*on EnvVar eLDW_Anlaufzeit_VLRDef
{
    putValue( eLDW_Anlaufzeit_VLRS, 0 );
}*/

on EnvVar eLDW_Lernmodus_seitenabhaengigDec
{
    if( getValue( this ))  putValue( eLDW_Lernmodus_seitenabhaengigS, getValue( eLDW_Lernmodus_seitenabhaengigS ) - 1 );
}

on EnvVar eLDW_Lernmodus_seitenabhaengigInc
{
    if( getValue( this ))  putValue( eLDW_Lernmodus_seitenabhaengigS, getValue( eLDW_Lernmodus_seitenabhaengigS ) + 1 );
}

on EnvVar e00LDW_Lernmodus_seitenabhaengig
{
    putValue( eLDW_Lernmodus_seitenabhaengigS, 0 );
}

on EnvVar eLDW_DLCDec
{
    if( getValue( this ))  putValue( eLDW_DLCS, getValue( eLDW_DLCS ) - 0.01 );
}

on EnvVar eLDW_DLCInc
{
    if( getValue( this ))  putValue( eLDW_DLCS, getValue( eLDW_DLCS ) + 0.01 );
}

on EnvVar eLDW_DLCDef
{
    putValue( eLDW_DLCS, 1.25 );
}

on EnvVar eLDW_TLCDec
{
    if( getValue( this ))  putValue( eLDW_TLCS, getValue( eLDW_TLCS ) - 0.1 );
}

on EnvVar eLDW_TLCInc
{
    if( getValue( this ))  putValue( eLDW_TLCS, getValue( eLDW_TLCS ) + 0.1 );
}

on EnvVar eLDW_TLCDef
{
    putValue( eLDW_TLCS, 3.1 );
}

on EnvVar eEPS_01_BZDec
{
    if( getValue( this ))  putValue( eEPS_01_BZS, getValue( eEPS_01_BZS ) - 1 );
}

on EnvVar eEPS_01_BZInc
{
    if( getValue( this ))  putValue( eEPS_01_BZS, getValue( eEPS_01_BZS ) + 1 );
}

on EnvVar eEPS_01_BZDef
{
    putValue( eEPS_01_BZS, 0 );
}

on EnvVar eEPS_WarnungenDec
{
    if( getValue( this ))  putValue( eEPS_WarnungenS, getValue( eEPS_WarnungenS ) - 1 );
}

on EnvVar eEPS_WarnungenInc
{
    if( getValue( this ))  putValue( eEPS_WarnungenS, getValue( eEPS_WarnungenS ) + 1 );
}

on EnvVar eEPS_WarnungenDef
{
    putValue( eEPS_WarnungenS, 0 );
}

on EnvVar eEPS_PLA_AbbruchDec
{
    if( getValue( this ))  putValue( eEPS_PLA_AbbruchS, getValue( eEPS_PLA_AbbruchS ) - 1 );
}

on EnvVar eEPS_PLA_AbbruchInc
{
    if( getValue( this ))  putValue( eEPS_PLA_AbbruchS, getValue( eEPS_PLA_AbbruchS ) + 1 );
}

on EnvVar eEPS_PLA_AbbruchDef
{
    putValue( eEPS_PLA_AbbruchS, 0 );
}

on EnvVar eEPS_PLA_FehlerDec
{
    if( getValue( this ))  putValue( eEPS_PLA_FehlerS, getValue( eEPS_PLA_FehlerS ) - 1 );
}

on EnvVar eEPS_PLA_FehlerInc
{
    if( getValue( this ))  putValue( eEPS_PLA_FehlerS, getValue( eEPS_PLA_FehlerS ) + 1 );
}

on EnvVar eEPS_PLA_FehlerDef
{
    putValue( eEPS_PLA_FehlerS, 0 );
}

on EnvVar eEPS_PLA_StatusDec
{
    if( getValue( this ))  putValue( eEPS_PLA_StatusS, getValue( eEPS_PLA_StatusS ) - 1 );
}

on EnvVar eEPS_PLA_StatusInc
{
    if( getValue( this ))  putValue( eEPS_PLA_StatusS, getValue( eEPS_PLA_StatusS ) + 1 );
}

on EnvVar eEPS_PLA_StatusDef
{
    putValue( eEPS_PLA_StatusS, 0 );
}

on EnvVar eEPS_Charisma_FahrPrDec
{
    if( getValue( this ))  putValue( eEPS_Charisma_FahrPrS, getValue( eEPS_Charisma_FahrPrS ) - 1 );
}

on EnvVar eEPS_Charisma_FahrPrInc
{
    if( getValue( this ))  putValue( eEPS_Charisma_FahrPrS, getValue( eEPS_Charisma_FahrPrS ) + 1 );
}

on EnvVar eEPS_Charisma_FahrPrDef
{
    putValue( eEPS_Charisma_FahrPrS, 0 );
}

on EnvVar eEPS_Charisma_StatusDec
{
    if( getValue( this ))  putValue( eEPS_Charisma_StatusS, getValue( eEPS_Charisma_StatusS ) - 1 );
}

on EnvVar eEPS_Charisma_StatusInc
{
    if( getValue( this ))  putValue( eEPS_Charisma_StatusS, getValue( eEPS_Charisma_StatusS ) + 1 );
}

on EnvVar eEPS_Charisma_StatusDef
{
    putValue( eEPS_Charisma_StatusS, 0 );
}

on EnvVar eEPS_LenkerpositionDec
{
    if( getValue( this ))  putValue( eEPS_LenkerpositionS, getValue( eEPS_LenkerpositionS ) - 1 );
}

on EnvVar eEPS_LenkerpositionInc
{
    if( getValue( this ))  putValue( eEPS_LenkerpositionS, getValue( eEPS_LenkerpositionS ) + 1 );
}

on EnvVar eEPS_LenkerpositionDef
{
    putValue( eEPS_LenkerpositionS, 0 );
}

on EnvVar eLicht_hinten_01_BZDec
{
    if( getValue( this ))  putValue( eLicht_hinten_01_BZS, getValue( eLicht_hinten_01_BZS ) - 1 );
}

on EnvVar eLicht_hinten_01_BZInc
{
    if( getValue( this ))  putValue( eLicht_hinten_01_BZS, getValue( eLicht_hinten_01_BZS ) + 1 );
}

on EnvVar eLicht_hinten_01_BZDef
{
    putValue( eLicht_hinten_01_BZS, 0 );
}

on EnvVar eLWR_AFS_01_BZDec
{
    if( getValue( this ))  putValue( eLWR_AFS_01_BZS, getValue( eLWR_AFS_01_BZS ) - 1 );
}

on EnvVar eLWR_AFS_01_BZInc
{
    if( getValue( this ))  putValue( eLWR_AFS_01_BZS, getValue( eLWR_AFS_01_BZS ) + 1 );
}

on EnvVar eLWR_AFS_01_BZDef
{
    putValue( eLWR_AFS_01_BZS, 0 );
}

on EnvVar eAFS_Charisma_FahrPrDec
{
    if( getValue( this ))  putValue( eAFS_Charisma_FahrPrS, getValue( eAFS_Charisma_FahrPrS ) - 1 );
}

on EnvVar eAFS_Charisma_FahrPrInc
{
    if( getValue( this ))  putValue( eAFS_Charisma_FahrPrS, getValue( eAFS_Charisma_FahrPrS ) + 1 );
}

on EnvVar eAFS_Charisma_FahrPrDef
{
    putValue( eAFS_Charisma_FahrPrS, 0 );
}

on EnvVar eAFS_Charisma_StatusDec
{
    if( getValue( this ))  putValue( eAFS_Charisma_StatusS, getValue( eAFS_Charisma_StatusS ) - 1 );
}

on EnvVar eAFS_Charisma_StatusInc
{
    if( getValue( this ))  putValue( eAFS_Charisma_StatusS, getValue( eAFS_Charisma_StatusS ) + 1 );
}

on EnvVar eAFS_Charisma_StatusDef
{
    putValue( eAFS_Charisma_StatusS, 0 );
}

on EnvVar eAFS_Charisma_UmschaltungDec
{
    if( getValue( this ))  putValue( eAFS_Charisma_UmschaltungS, getValue( eAFS_Charisma_UmschaltungS ) - 1 );
}

on EnvVar eAFS_Charisma_UmschaltungInc
{
    if( getValue( this ))  putValue( eAFS_Charisma_UmschaltungS, getValue( eAFS_Charisma_UmschaltungS ) + 1 );
}

on EnvVar eAFS_Charisma_UmschaltungDef
{
    putValue( eAFS_Charisma_UmschaltungS, 0 );
}

on EnvVar eLWR_Reisemodus_TexteDec
{
    if( getValue( this ))  putValue( eLWR_Reisemodus_TexteS, getValue( eLWR_Reisemodus_TexteS ) - 1 );
}

on EnvVar eLWR_Reisemodus_TexteInc
{
    if( getValue( this ))  putValue( eLWR_Reisemodus_TexteS, getValue( eLWR_Reisemodus_TexteS ) + 1 );
}

on EnvVar eLWR_Reisemodus_TexteDef
{
    putValue( eLWR_Reisemodus_TexteS, 0 );
}

on EnvVar eLWR_Pos_SchrittmotorDec
{
    if( getValue( this ))  putValue( eLWR_Pos_SchrittmotorS, getValue( eLWR_Pos_SchrittmotorS ) - 0.4 );
}

on EnvVar eLWR_Pos_SchrittmotorInc
{
    if( getValue( this ))  putValue( eLWR_Pos_SchrittmotorS, getValue( eLWR_Pos_SchrittmotorS ) + 0.4 );
}

on EnvVar eLWR_Pos_SchrittmotorDef
{
    putValue( eLWR_Pos_SchrittmotorS, 101.6 );
}

on EnvVar eLWR_Hoehenwert_VLDec
{
    if( getValue( this ))  putValue( eLWR_Hoehenwert_VLS, getValue( eLWR_Hoehenwert_VLS ) - 1 );
}

on EnvVar eLWR_Hoehenwert_VLInc
{
    if( getValue( this ))  putValue( eLWR_Hoehenwert_VLS, getValue( eLWR_Hoehenwert_VLS ) + 1 );
}

on EnvVar eLWR_Hoehenwert_VLDef
{
    putValue( eLWR_Hoehenwert_VLS, 127 );
}

on EnvVar eLWR_Hoehenwert_HLDec
{
    if( getValue( this ))  putValue( eLWR_Hoehenwert_HLS, getValue( eLWR_Hoehenwert_HLS ) - 1 );
}

on EnvVar eLWR_Hoehenwert_HLInc
{
    if( getValue( this ))  putValue( eLWR_Hoehenwert_HLS, getValue( eLWR_Hoehenwert_HLS ) + 1 );
}

on EnvVar eLWR_Hoehenwert_HLDef
{
    putValue( eLWR_Hoehenwert_HLS, 127 );
}

on EnvVar eBFS_MMB_storageDec
{
    if( getValue( this ))  putValue( eBFS_MMB_storageS, getValue( eBFS_MMB_storageS ) - 1 );
}

on EnvVar eBFS_MMB_storageInc
{
    if( getValue( this ))  putValue( eBFS_MMB_storageS, getValue( eBFS_MMB_storageS ) + 1 );
}

on EnvVar eBFS_MMB_storageDef
{
    putValue( eBFS_MMB_storageS, 0 );
}

on EnvVar eBFS_SIH_StatusDec
{
    if( getValue( this ))  putValue( eBFS_SIH_StatusS, getValue( eBFS_SIH_StatusS ) - 1 );
}

on EnvVar eBFS_SIH_StatusInc
{
    if( getValue( this ))  putValue( eBFS_SIH_StatusS, getValue( eBFS_SIH_StatusS ) + 1 );
}

on EnvVar eBFS_SIH_StatusDef
{
    putValue( eBFS_SIH_StatusS, 0 );
}

on EnvVar eBFS_SLR_ReglerstatusDec
{
    if( getValue( this ))  putValue( eBFS_SLR_ReglerstatusS, getValue( eBFS_SLR_ReglerstatusS ) - 1 );
}

on EnvVar eBFS_SLR_ReglerstatusInc
{
    if( getValue( this ))  putValue( eBFS_SLR_ReglerstatusS, getValue( eBFS_SLR_ReglerstatusS ) + 1 );
}

on EnvVar eBFS_SLR_ReglerstatusDef
{
    putValue( eBFS_SLR_ReglerstatusS, 0 );
}

on EnvVar eFS_MMB_storageDec
{
    if( getValue( this ))  putValue( eFS_MMB_storageS, getValue( eFS_MMB_storageS ) - 1 );
}

on EnvVar eFS_MMB_storageInc
{
    if( getValue( this ))  putValue( eFS_MMB_storageS, getValue( eFS_MMB_storageS ) + 1 );
}

on EnvVar eFS_MMB_storageDef
{
    putValue( eFS_MMB_storageS, 0 );
}

on EnvVar eFS_SIH_StatusDec
{
    if( getValue( this ))  putValue( eFS_SIH_StatusS, getValue( eFS_SIH_StatusS ) - 1 );
}

on EnvVar eFS_SIH_StatusInc
{
    if( getValue( this ))  putValue( eFS_SIH_StatusS, getValue( eFS_SIH_StatusS ) + 1 );
}

on EnvVar eFS_SIH_StatusDef
{
    putValue( eFS_SIH_StatusS, 0 );
}

on EnvVar eFS_SLR_ReglerstatusDec
{
    if( getValue( this ))  putValue( eFS_SLR_ReglerstatusS, getValue( eFS_SLR_ReglerstatusS ) - 1 );
}

on EnvVar eFS_SLR_ReglerstatusInc
{
    if( getValue( this ))  putValue( eFS_SLR_ReglerstatusS, getValue( eFS_SLR_ReglerstatusS ) + 1 );
}

on EnvVar eFS_SLR_ReglerstatusDef
{
    putValue( eFS_SLR_ReglerstatusS, 0 );
}

on EnvVar eMFG_01_BZDec
{
    if( getValue( this ))  putValue( eMFG_01_BZS, getValue( eMFG_01_BZS ) - 1 );
}

on EnvVar eMFG_01_BZInc
{
    if( getValue( this ))  putValue( eMFG_01_BZS, getValue( eMFG_01_BZS ) + 1 );
}

on EnvVar eMFG_01_BZDef
{
    putValue( eMFG_01_BZS, 0 );
}

on EnvVar eMF_VarianteDec
{
    if( getValue( this ))  putValue( eMF_VarianteS, getValue( eMF_VarianteS ) - 1 );
}

on EnvVar eMF_VarianteInc
{
    if( getValue( this ))  putValue( eMF_VarianteS, getValue( eMF_VarianteS ) + 1 );
}

on EnvVar eMF_VarianteDef
{
    putValue( eMF_VarianteS, 0 );
}

on EnvVar eMF_StartStopp_InfoDec
{
    if( getValue( this ))  putValue( eMF_StartStopp_InfoS, getValue( eMF_StartStopp_InfoS ) - 1 );
}

on EnvVar eMF_StartStopp_InfoInc
{
    if( getValue( this ))  putValue( eMF_StartStopp_InfoS, getValue( eMF_StartStopp_InfoS ) + 1 );
}

on EnvVar eMF_StartStopp_InfoDef
{
    putValue( eMF_StartStopp_InfoS, 0 );
}

on EnvVar eMFL_Tastencode_1Dec
{
    if( getValue( this ))  putValue( eMFL_Tastencode_1S, getValue( eMFL_Tastencode_1S ) - 1 );
}

on EnvVar eMFL_Tastencode_1Inc
{
    if( getValue( this ))  putValue( eMFL_Tastencode_1S, getValue( eMFL_Tastencode_1S ) + 1 );
}

on EnvVar eMFL_Tastencode_1Def
{
    putValue( eMFL_Tastencode_1S, 0 );
}

on EnvVar eMFL_Tastencode_2Dec
{
    if( getValue( this ))  putValue( eMFL_Tastencode_2S, getValue( eMFL_Tastencode_2S ) - 1 );
}

on EnvVar eMFL_Tastencode_2Inc
{
    if( getValue( this ))  putValue( eMFL_Tastencode_2S, getValue( eMFL_Tastencode_2S ) + 1 );
}

on EnvVar eMFL_Tastencode_2Def
{
    putValue( eMFL_Tastencode_2S, 0 );
}

on EnvVar eMFL_Eventcode_1Dec
{
    if( getValue( this ))  putValue( eMFL_Eventcode_1S, getValue( eMFL_Eventcode_1S ) - 1 );
}

on EnvVar eMFL_Eventcode_1Inc
{
    if( getValue( this ))  putValue( eMFL_Eventcode_1S, getValue( eMFL_Eventcode_1S ) + 1 );
}

on EnvVar eMFL_Eventcode_1Def
{
    putValue( eMFL_Eventcode_1S, 0 );
}

on EnvVar eMFL_Eventcode_2Dec
{
    if( getValue( this ))  putValue( eMFL_Eventcode_2S, getValue( eMFL_Eventcode_2S ) - 1 );
}

on EnvVar eMFL_Eventcode_2Inc
{
    if( getValue( this ))  putValue( eMFL_Eventcode_2S, getValue( eMFL_Eventcode_2S ) + 1 );
}

on EnvVar eMFL_Eventcode_2Def
{
    putValue( eMFL_Eventcode_2S, 0 );
}

on EnvVar eMFL_MarkeDec
{
    if( getValue( this ))  putValue( eMFL_MarkeS, getValue( eMFL_MarkeS ) - 1 );
}

on EnvVar eMFL_MarkeInc
{
    if( getValue( this ))  putValue( eMFL_MarkeS, getValue( eMFL_MarkeS ) + 1 );
}

on EnvVar eMFL_MarkeDef
{
    putValue( eMFL_MarkeS, 0 );
}

on EnvVar eMFL_VarianteDec
{
    if( getValue( this ))  putValue( eMFL_VarianteS, getValue( eMFL_VarianteS ) - 1 );
}

on EnvVar eMFL_VarianteInc
{
    if( getValue( this ))  putValue( eMFL_VarianteS, getValue( eMFL_VarianteS ) + 1 );
}

on EnvVar eMFL_VarianteDef
{
    putValue( eMFL_VarianteS, 0 );
}

on EnvVar eMO_IstgangDec
{
    if( getValue( this ))  putValue( eMO_IstgangS, getValue( eMO_IstgangS ) - 1 );
}

on EnvVar eMO_IstgangInc
{
    if( getValue( this ))  putValue( eMO_IstgangS, getValue( eMO_IstgangS ) + 1 );
}

on EnvVar eMO_IstgangDef
{
    putValue( eMO_IstgangS, 0 );
}

on EnvVar eMO_SollgangDec
{
    if( getValue( this ))  putValue( eMO_SollgangS, getValue( eMO_SollgangS ) - 1 );
}

on EnvVar eMO_SollgangInc
{
    if( getValue( this ))  putValue( eMO_SollgangS, getValue( eMO_SollgangS ) + 1 );
}

on EnvVar eMO_SollgangDef
{
    putValue( eMO_SollgangS, 0 );
}

on EnvVar eMO_OeldruckDec
{
    if( getValue( this ))  putValue( eMO_OeldruckS, getValue( eMO_OeldruckS ) - 0.04 );
}

on EnvVar eMO_OeldruckInc
{
    if( getValue( this ))  putValue( eMO_OeldruckS, getValue( eMO_OeldruckS ) + 0.04 );
}

on EnvVar eMO_OeldruckDef
{
    putValue( eMO_OeldruckS, 10.16 );
}

on EnvVar eMO_AnzeigedrehzDec
{
    if( getValue( this ))  putValue( eMO_AnzeigedrehzS, getValue( eMO_AnzeigedrehzS ) - 3 );
}

on EnvVar eMO_AnzeigedrehzInc
{
    if( getValue( this ))  putValue( eMO_AnzeigedrehzS, getValue( eMO_AnzeigedrehzS ) + 3 );
}

on EnvVar eMO_AnzeigedrehzDef
{
    putValue( eMO_AnzeigedrehzS, 0 );
}

on EnvVar eMO_LadedruckDec
{
    if( getValue( this ))  putValue( eMO_LadedruckS, getValue( eMO_LadedruckS ) - 0.01 );
}

on EnvVar eMO_LadedruckInc
{
    if( getValue( this ))  putValue( eMO_LadedruckS, getValue( eMO_LadedruckS ) + 0.01 );
}

on EnvVar eMO_LadedruckDef
{
    putValue( eMO_LadedruckS, 0 );
}

on EnvVar eMO_KVSDec
{
    if( getValue( this ))  putValue( eMO_KVSS, getValue( eMO_KVSS ) - 1 );
}

on EnvVar eMO_KVSInc
{
    if( getValue( this ))  putValue( eMO_KVSS, getValue( eMO_KVSS ) + 1 );
}

on EnvVar eMO_KVSDef
{
    putValue( eMO_KVSS, 0 );
}

on EnvVar eMO_Absperrventil_oeffnenDec
{
    if( getValue( this ))  putValue( eMO_Absperrventil_oeffnenS, getValue( eMO_Absperrventil_oeffnenS ) - 1 );
}

on EnvVar eMO_Absperrventil_oeffnenInc
{
    if( getValue( this ))  putValue( eMO_Absperrventil_oeffnenS, getValue( eMO_Absperrventil_oeffnenS ) + 1 );
}

on EnvVar eMO_Absperrventil_oeffnenDef
{
    putValue( eMO_Absperrventil_oeffnenS, 0 );
}

on EnvVar eMO_Ansaugluft_TempDec
{
    if( getValue( this ))  putValue( eMO_Ansaugluft_TempS, getValue( eMO_Ansaugluft_TempS ) - 0.75 );
}

on EnvVar eMO_Ansaugluft_TempInc
{
    if( getValue( this ))  putValue( eMO_Ansaugluft_TempS, getValue( eMO_Ansaugluft_TempS ) + 0.75 );
}

on EnvVar eMO_Ansaugluft_TempDef
{
    putValue( eMO_Ansaugluft_TempS, 142.5 );
}

on EnvVar eMO_Oel_TempDec
{
    if( getValue( this ))  putValue( eMO_Oel_TempS, getValue( eMO_Oel_TempS ) - 1 );
}

on EnvVar eMO_Oel_TempInc
{
    if( getValue( this ))  putValue( eMO_Oel_TempS, getValue( eMO_Oel_TempS ) + 1 );
}

on EnvVar eMO_Oel_TempDef
{
    putValue( eMO_Oel_TempS, 194 );
}

on EnvVar eMO_Kuehlmittel_TempDec
{
    if( getValue( this ))  putValue( eMO_Kuehlmittel_TempS, getValue( eMO_Kuehlmittel_TempS ) - 0.75 );
}

on EnvVar eMO_Kuehlmittel_TempInc
{
    if( getValue( this ))  putValue( eMO_Kuehlmittel_TempS, getValue( eMO_Kuehlmittel_TempS ) + 0.75 );
}

on EnvVar eMO_Kuehlmittel_TempDef
{
    putValue( eMO_Kuehlmittel_TempS, 142.5 );
}

on EnvVar eMO_HoeheninfoDec
{
    if( getValue( this ))  putValue( eMO_HoeheninfoS, getValue( eMO_HoeheninfoS ) - 0.00781 );
}

on EnvVar eMO_HoeheninfoInc
{
    if( getValue( this ))  putValue( eMO_HoeheninfoS, getValue( eMO_HoeheninfoS ) + 0.00781 );
}

on EnvVar eMO_HoeheninfoDef
{
    putValue( eMO_HoeheninfoS, 0 );
}

on EnvVar eMO_VersionsinfoDec
{
    if( getValue( this ))  putValue( eMO_VersionsinfoS, getValue( eMO_VersionsinfoS ) - 1 );
}

on EnvVar eMO_VersionsinfoInc
{
    if( getValue( this ))  putValue( eMO_VersionsinfoS, getValue( eMO_VersionsinfoS ) + 1 );
}

on EnvVar eMO_VersionsinfoDef
{
    putValue( eMO_VersionsinfoS, 0 );
}

on EnvVar eMO_Mom_Traegheit_02Dec
{
    if( getValue( this ))  putValue( eMO_Mom_Traegheit_02S, getValue( eMO_Mom_Traegheit_02S ) - 0.01 );
}

on EnvVar eMO_Mom_Traegheit_02Inc
{
    if( getValue( this ))  putValue( eMO_Mom_Traegheit_02S, getValue( eMO_Mom_Traegheit_02S ) + 0.01 );
}

on EnvVar eMO_Mom_Traegheit_02Def
{
    putValue( eMO_Mom_Traegheit_02S, 0 );
}

on EnvVar eMO_HeizungspumpenansteuerungDec
{
    if( getValue( this ))  putValue( eMO_HeizungspumpenansteuerungS, getValue( eMO_HeizungspumpenansteuerungS ) - 10 );
}

on EnvVar eMO_HeizungspumpenansteuerungInc
{
    if( getValue( this ))  putValue( eMO_HeizungspumpenansteuerungS, getValue( eMO_HeizungspumpenansteuerungS ) + 10 );
}

on EnvVar eMO_HeizungspumpenansteuerungDef
{
    putValue( eMO_HeizungspumpenansteuerungS, 140 );
}

on EnvVar eMO_Nachlaufzeit_HeizungspumpeDe
{
    if( getValue( this ))  putValue( eMO_Nachlaufzeit_HeizungspumpeS, getValue( eMO_Nachlaufzeit_HeizungspumpeS ) - 15 );
}

on EnvVar eMO_Nachlaufzeit_HeizungspumpeIn
{
    if( getValue( this ))  putValue( eMO_Nachlaufzeit_HeizungspumpeS, getValue( eMO_Nachlaufzeit_HeizungspumpeS ) + 15 );
}

on EnvVar e00MO_Nachlaufzeit_Heizungspumpe
{
    putValue( eMO_Nachlaufzeit_HeizungspumpeS, 0 );
}

on EnvVar eMO_ITM_Kuehlmittel_TempDec
{
    if( getValue( this ))  putValue( eMO_ITM_Kuehlmittel_TempS, getValue( eMO_ITM_Kuehlmittel_TempS ) - 0.75 );
}

on EnvVar eMO_ITM_Kuehlmittel_TempInc
{
    if( getValue( this ))  putValue( eMO_ITM_Kuehlmittel_TempS, getValue( eMO_ITM_Kuehlmittel_TempS ) + 0.75 );
}

on EnvVar eMO_ITM_Kuehlmittel_TempDef
{
    putValue( eMO_ITM_Kuehlmittel_TempS, -47.25 );
}

on EnvVar eSCR_ReichweiteDec
{
    if( getValue( this ))  putValue( eSCR_ReichweiteS, getValue( eSCR_ReichweiteS ) - 1 );
}

on EnvVar eSCR_ReichweiteInc
{
    if( getValue( this ))  putValue( eSCR_ReichweiteS, getValue( eSCR_ReichweiteS ) + 1 );
}

on EnvVar eSCR_ReichweiteDef
{
    putValue( eSCR_ReichweiteS, 32676 );
}

on EnvVar eSCR_TextDec
{
    if( getValue( this ))  putValue( eSCR_TextS, getValue( eSCR_TextS ) - 1 );
}

on EnvVar eSCR_TextInc
{
    if( getValue( this ))  putValue( eSCR_TextS, getValue( eSCR_TextS ) + 1 );
}

on EnvVar eSCR_TextDef
{
    putValue( eSCR_TextS, 0 );
}

on EnvVar eMO_E85_SensorDec
{
    if( getValue( this ))  putValue( eMO_E85_SensorS, getValue( eMO_E85_SensorS ) - 10 );
}

on EnvVar eMO_E85_SensorInc
{
    if( getValue( this ))  putValue( eMO_E85_SensorS, getValue( eMO_E85_SensorS ) + 10 );
}

on EnvVar eMO_E85_SensorDef
{
    putValue( eMO_E85_SensorS, 140 );
}

on EnvVar eSCR_Anz_MotorstartsDec
{
    if( getValue( this ))  putValue( eSCR_Anz_MotorstartsS, getValue( eSCR_Anz_MotorstartsS ) - 1 );
}

on EnvVar eSCR_Anz_MotorstartsInc
{
    if( getValue( this ))  putValue( eSCR_Anz_MotorstartsS, getValue( eSCR_Anz_MotorstartsS ) + 1 );
}

on EnvVar eSCR_Anz_MotorstartsDef
{
    putValue( eSCR_Anz_MotorstartsS, 15 );
}

on EnvVar eSCR_AkustikDec
{
    if( getValue( this ))  putValue( eSCR_AkustikS, getValue( eSCR_AkustikS ) - 1 );
}

on EnvVar eSCR_AkustikInc
{
    if( getValue( this ))  putValue( eSCR_AkustikS, getValue( eSCR_AkustikS ) + 1 );
}

on EnvVar eSCR_AkustikDef
{
    putValue( eSCR_AkustikS, 0 );
}

on EnvVar eSCR_Inducement_StrategieDec
{
    if( getValue( this ))  putValue( eSCR_Inducement_StrategieS, getValue( eSCR_Inducement_StrategieS ) - 1 );
}

on EnvVar eSCR_Inducement_StrategieInc
{
    if( getValue( this ))  putValue( eSCR_Inducement_StrategieS, getValue( eSCR_Inducement_StrategieS ) + 1 );
}

on EnvVar eSCR_Inducement_StrategieDef
{
    putValue( eSCR_Inducement_StrategieS, 0 );
}

on EnvVar eMO_CO2_FaktorDec
{
    if( getValue( this ))  putValue( eMO_CO2_FaktorS, getValue( eMO_CO2_FaktorS ) - 1 );
}

on EnvVar eMO_CO2_FaktorInc
{
    if( getValue( this ))  putValue( eMO_CO2_FaktorS, getValue( eMO_CO2_FaktorS ) + 1 );
}

on EnvVar eMO_CO2_FaktorDef
{
    putValue( eMO_CO2_FaktorS, 0 );
}

on EnvVar eMO_MKB_MUXDec
{
    if( getValue( this ))  putValue( eMO_MKB_MUXS, getValue( eMO_MKB_MUXS ) - 1 );
}

on EnvVar eMO_MKB_MUXInc
{
    if( getValue( this ))  putValue( eMO_MKB_MUXS, getValue( eMO_MKB_MUXS ) + 1 );
}

on EnvVar eMO_MKB_MUXDef
{
    putValue( eMO_MKB_MUXS, 0 );
}

on EnvVar eMO_MKB_01Dec
{
    if( getValue( this ))  putValue( eMO_MKB_01S, getValue( eMO_MKB_01S ) - 1 );
}

on EnvVar eMO_MKB_01Inc
{
    if( getValue( this ))  putValue( eMO_MKB_01S, getValue( eMO_MKB_01S ) + 1 );
}

on EnvVar eMO_MKB_01Def
{
    putValue( eMO_MKB_01S, 0 );
}

on EnvVar eMO_MKB_02Dec
{
    if( getValue( this ))  putValue( eMO_MKB_02S, getValue( eMO_MKB_02S ) - 1 );
}

on EnvVar eMO_MKB_02Inc
{
    if( getValue( this ))  putValue( eMO_MKB_02S, getValue( eMO_MKB_02S ) + 1 );
}

on EnvVar eMO_MKB_02Def
{
    putValue( eMO_MKB_02S, 0 );
}

on EnvVar eMO_MKB_03Dec
{
    if( getValue( this ))  putValue( eMO_MKB_03S, getValue( eMO_MKB_03S ) - 1 );
}

on EnvVar eMO_MKB_03Inc
{
    if( getValue( this ))  putValue( eMO_MKB_03S, getValue( eMO_MKB_03S ) + 1 );
}

on EnvVar eMO_MKB_03Def
{
    putValue( eMO_MKB_03S, 0 );
}

on EnvVar eMO_MKB_04Dec
{
    if( getValue( this ))  putValue( eMO_MKB_04S, getValue( eMO_MKB_04S ) - 1 );
}

on EnvVar eMO_MKB_04Inc
{
    if( getValue( this ))  putValue( eMO_MKB_04S, getValue( eMO_MKB_04S ) + 1 );
}

on EnvVar eMO_MKB_04Def
{
    putValue( eMO_MKB_04S, 0 );
}

on EnvVar eMO_StartStopp_StatusDec
{
    if( getValue( this ))  putValue( eMO_StartStopp_StatusS, getValue( eMO_StartStopp_StatusS ) - 1 );
}

on EnvVar eMO_StartStopp_StatusInc
{
    if( getValue( this ))  putValue( eMO_StartStopp_StatusS, getValue( eMO_StartStopp_StatusS ) + 1 );
}

on EnvVar eMO_StartStopp_StatusDef
{
    putValue( eMO_StartStopp_StatusS, 0 );
}

on EnvVar eMO_Freig_RekuDec
{
    if( getValue( this ))  putValue( eMO_Freig_RekuS, getValue( eMO_Freig_RekuS ) - 1 );
}

on EnvVar eMO_Freig_RekuInc
{
    if( getValue( this ))  putValue( eMO_Freig_RekuS, getValue( eMO_Freig_RekuS ) + 1 );
}

on EnvVar eMO_Freig_RekuDef
{
    putValue( eMO_Freig_RekuS, 0 );
}

on EnvVar eMO_GangpositionDec
{
    if( getValue( this ))  putValue( eMO_GangpositionS, getValue( eMO_GangpositionS ) - 1 );
}

on EnvVar eMO_GangpositionInc
{
    if( getValue( this ))  putValue( eMO_GangpositionS, getValue( eMO_GangpositionS ) + 1 );
}

on EnvVar eMO_GangpositionDef
{
    putValue( eMO_GangpositionS, 14 );
}

on EnvVar eMO_StartStopp_FahrerwunschDec
{
    if( getValue( this ))  putValue( eMO_StartStopp_FahrerwunschS, getValue( eMO_StartStopp_FahrerwunschS ) - 1 );
}

on EnvVar eMO_StartStopp_FahrerwunschInc
{
    if( getValue( this ))  putValue( eMO_StartStopp_FahrerwunschS, getValue( eMO_StartStopp_FahrerwunschS ) + 1 );
}

on EnvVar eMO_StartStopp_FahrerwunschDef
{
    putValue( eMO_StartStopp_FahrerwunschS, 0 );
}

on EnvVar eMO_Klima_EingrDec
{
    if( getValue( this ))  putValue( eMO_Klima_EingrS, getValue( eMO_Klima_EingrS ) - 1 );
}

on EnvVar eMO_Klima_EingrInc
{
    if( getValue( this ))  putValue( eMO_Klima_EingrS, getValue( eMO_Klima_EingrS ) + 1 );
}

on EnvVar eMO_Klima_EingrDef
{
    putValue( eMO_Klima_EingrS, 0 );
}

on EnvVar eMO_EKlKomLeiRedDec
{
    if( getValue( this ))  putValue( eMO_EKlKomLeiRedS, getValue( eMO_EKlKomLeiRedS ) - 1 );
}

on EnvVar eMO_EKlKomLeiRedInc
{
    if( getValue( this ))  putValue( eMO_EKlKomLeiRedS, getValue( eMO_EKlKomLeiRedS ) + 1 );
}

on EnvVar eMO_EKlKomLeiRedDef
{
    putValue( eMO_EKlKomLeiRedS, 0 );
}

on EnvVar eMO_obere_DrehzahlgrenzeDec
{
    if( getValue( this ))  putValue( eMO_obere_DrehzahlgrenzeS, getValue( eMO_obere_DrehzahlgrenzeS ) - 50 );
}

on EnvVar eMO_obere_DrehzahlgrenzeInc
{
    if( getValue( this ))  putValue( eMO_obere_DrehzahlgrenzeS, getValue( eMO_obere_DrehzahlgrenzeS ) + 50 );
}

on EnvVar eMO_obere_DrehzahlgrenzeDef
{
    putValue( eMO_obere_DrehzahlgrenzeS, 0 );
}

on EnvVar eMotor_Code_01_BZDec
{
    if( getValue( this ))  putValue( eMotor_Code_01_BZS, getValue( eMotor_Code_01_BZS ) - 1 );
}

on EnvVar eMotor_Code_01_BZInc
{
    if( getValue( this ))  putValue( eMotor_Code_01_BZS, getValue( eMotor_Code_01_BZS ) + 1 );
}

on EnvVar eMotor_Code_01_BZDef
{
    putValue( eMotor_Code_01_BZS, 0 );
}

on EnvVar eMO_Faktor_Momente_02Dec
{
    if( getValue( this ))  putValue( eMO_Faktor_Momente_02S, getValue( eMO_Faktor_Momente_02S ) - 1 );
}

on EnvVar eMO_Faktor_Momente_02Inc
{
    if( getValue( this ))  putValue( eMO_Faktor_Momente_02S, getValue( eMO_Faktor_Momente_02S ) + 1 );
}

on EnvVar eMO_Faktor_Momente_02Def
{
    putValue( eMO_Faktor_Momente_02S, 0 );
}

on EnvVar eMO_HybridfahrzeugDec
{
    if( getValue( this ))  putValue( eMO_HybridfahrzeugS, getValue( eMO_HybridfahrzeugS ) - 1 );
}

on EnvVar eMO_HybridfahrzeugInc
{
    if( getValue( this ))  putValue( eMO_HybridfahrzeugS, getValue( eMO_HybridfahrzeugS ) + 1 );
}

on EnvVar eMO_HybridfahrzeugDef
{
    putValue( eMO_HybridfahrzeugS, 0 );
}

on EnvVar eMO_CodeDec
{
    if( getValue( this ))  putValue( eMO_CodeS, getValue( eMO_CodeS ) - 1 );
}

on EnvVar eMO_CodeInc
{
    if( getValue( this ))  putValue( eMO_CodeS, getValue( eMO_CodeS ) + 1 );
}

on EnvVar eMO_CodeDef
{
    putValue( eMO_CodeS, 0 );
}

on EnvVar eMO_Getriebe_CodeDec
{
    if( getValue( this ))  putValue( eMO_Getriebe_CodeS, getValue( eMO_Getriebe_CodeS ) - 1 );
}

on EnvVar eMO_Getriebe_CodeInc
{
    if( getValue( this ))  putValue( eMO_Getriebe_CodeS, getValue( eMO_Getriebe_CodeS ) + 1 );
}

on EnvVar eMO_Getriebe_CodeDef
{
    putValue( eMO_Getriebe_CodeS, 0 );
}

on EnvVar eMO_Anzahl_ZylDec
{
    if( getValue( this ))  putValue( eMO_Anzahl_ZylS, getValue( eMO_Anzahl_ZylS ) - 1 );
}

on EnvVar eMO_Anzahl_ZylInc
{
    if( getValue( this ))  putValue( eMO_Anzahl_ZylS, getValue( eMO_Anzahl_ZylS ) + 1 );
}

on EnvVar eMO_Anzahl_ZylDef
{
    putValue( eMO_Anzahl_ZylS, 0 );
}

on EnvVar eMO_KraftstoffartDec
{
    if( getValue( this ))  putValue( eMO_KraftstoffartS, getValue( eMO_KraftstoffartS ) - 1 );
}

on EnvVar eMO_KraftstoffartInc
{
    if( getValue( this ))  putValue( eMO_KraftstoffartS, getValue( eMO_KraftstoffartS ) + 1 );
}

on EnvVar eMO_KraftstoffartDef
{
    putValue( eMO_KraftstoffartS, 0 );
}

on EnvVar eMO_HubraumDec
{
    if( getValue( this ))  putValue( eMO_HubraumS, getValue( eMO_HubraumS ) - 0.1 );
}

on EnvVar eMO_HubraumInc
{
    if( getValue( this ))  putValue( eMO_HubraumS, getValue( eMO_HubraumS ) + 0.1 );
}

on EnvVar eMO_HubraumDef
{
    putValue( eMO_HubraumS, 0 );
}

on EnvVar eMO_LeistungDec
{
    if( getValue( this ))  putValue( eMO_LeistungS, getValue( eMO_LeistungS ) - 1 );
}

on EnvVar eMO_LeistungInc
{
    if( getValue( this ))  putValue( eMO_LeistungS, getValue( eMO_LeistungS ) + 1 );
}

on EnvVar eMO_LeistungDef
{
    putValue( eMO_LeistungS, 0 );
}

on EnvVar eTSK_CodierungDec
{
    if( getValue( this ))  putValue( eTSK_CodierungS, getValue( eTSK_CodierungS ) - 1 );
}

on EnvVar eTSK_CodierungInc
{
    if( getValue( this ))  putValue( eTSK_CodierungS, getValue( eTSK_CodierungS ) + 1 );
}

on EnvVar eTSK_CodierungDef
{
    putValue( eTSK_CodierungS, 7 );
}

on EnvVar eWFS_MSG1_RNDDec
{
    if( getValue( this ))  putValue( eWFS_MSG1_RNDS, getValue( eWFS_MSG1_RNDS ) - 1 );
}

on EnvVar eWFS_MSG1_RNDInc
{
    if( getValue( this ))  putValue( eWFS_MSG1_RNDS, getValue( eWFS_MSG1_RNDS ) + 1 );
}

on EnvVar eWFS_MSG1_RNDDef
{
    putValue( eWFS_MSG1_RNDS, 0 );
}

on EnvVar eWFS_MSG1_CRCDec
{
    if( getValue( this ))  putValue( eWFS_MSG1_CRCS, getValue( eWFS_MSG1_CRCS ) - 1 );
}

on EnvVar eWFS_MSG1_CRCInc
{
    if( getValue( this ))  putValue( eWFS_MSG1_CRCS, getValue( eWFS_MSG1_CRCS ) + 1 );
}

on EnvVar eWFS_MSG1_CRCDef
{
    putValue( eWFS_MSG1_CRCS, 0 );
}

on EnvVar eWFS_MSG2_RNDDec
{
    if( getValue( this ))  putValue( eWFS_MSG2_RNDS, getValue( eWFS_MSG2_RNDS ) - 1 );
}

on EnvVar eWFS_MSG2_RNDInc
{
    if( getValue( this ))  putValue( eWFS_MSG2_RNDS, getValue( eWFS_MSG2_RNDS ) + 1 );
}

on EnvVar eWFS_MSG2_RNDDef
{
    putValue( eWFS_MSG2_RNDS, 0 );
}

on EnvVar eWFS_MSG2_CRCDec
{
    if( getValue( this ))  putValue( eWFS_MSG2_CRCS, getValue( eWFS_MSG2_CRCS ) - 1 );
}

on EnvVar eWFS_MSG2_CRCInc
{
    if( getValue( this ))  putValue( eWFS_MSG2_CRCS, getValue( eWFS_MSG2_CRCS ) + 1 );
}

on EnvVar eWFS_MSG2_CRCDef
{
    putValue( eWFS_MSG2_CRCS, 0 );
}

on EnvVar eWFS_MSG3_RNDDec
{
    if( getValue( this ))  putValue( eWFS_MSG3_RNDS, getValue( eWFS_MSG3_RNDS ) - 1 );
}

on EnvVar eWFS_MSG3_RNDInc
{
    if( getValue( this ))  putValue( eWFS_MSG3_RNDS, getValue( eWFS_MSG3_RNDS ) + 1 );
}

on EnvVar eWFS_MSG3_RNDDef
{
    putValue( eWFS_MSG3_RNDS, 0 );
}

on EnvVar eWFS_MSG3_CRCDec
{
    if( getValue( this ))  putValue( eWFS_MSG3_CRCS, getValue( eWFS_MSG3_CRCS ) - 1 );
}

on EnvVar eWFS_MSG3_CRCInc
{
    if( getValue( this ))  putValue( eWFS_MSG3_CRCS, getValue( eWFS_MSG3_CRCS ) + 1 );
}

on EnvVar eWFS_MSG3_CRCDef
{
    putValue( eWFS_MSG3_CRCS, 0 );
}

on EnvVar eWFS_MSG4_RNDDec
{
    if( getValue( this ))  putValue( eWFS_MSG4_RNDS, getValue( eWFS_MSG4_RNDS ) - 1 );
}

on EnvVar eWFS_MSG4_RNDInc
{
    if( getValue( this ))  putValue( eWFS_MSG4_RNDS, getValue( eWFS_MSG4_RNDS ) + 1 );
}

on EnvVar eWFS_MSG4_RNDDef
{
    putValue( eWFS_MSG4_RNDS, 0 );
}

on EnvVar eWFS_MSG4_CRCDec
{
    if( getValue( this ))  putValue( eWFS_MSG4_CRCS, getValue( eWFS_MSG4_CRCS ) - 1 );
}

on EnvVar eWFS_MSG4_CRCInc
{
    if( getValue( this ))  putValue( eWFS_MSG4_CRCS, getValue( eWFS_MSG4_CRCS ) + 1 );
}

on EnvVar eWFS_MSG4_CRCDef
{
    putValue( eWFS_MSG4_CRCS, 0 );
}

on EnvVar eNM_Gateway_SNIDec
{
    if( getValue( this ))  putValue( eNM_Gateway_SNIS, getValue( eNM_Gateway_SNIS ) - 1 );
}

on EnvVar eNM_Gateway_SNIInc
{
    if( getValue( this ))  putValue( eNM_Gateway_SNIS, getValue( eNM_Gateway_SNIS ) + 1 );
}

on EnvVar eNM_Gateway_SNIDef
{
    putValue( eNM_Gateway_SNIS, 16 );
}

on EnvVar eNM_Gateway_NM_StateDec
{
    if( getValue( this ))  putValue( eNM_Gateway_NM_StateS, getValue( eNM_Gateway_NM_StateS ) - 1 );
}

on EnvVar eNM_Gateway_NM_StateInc
{
    if( getValue( this ))  putValue( eNM_Gateway_NM_StateS, getValue( eNM_Gateway_NM_StateS ) + 1 );
}

on EnvVar eNM_Gateway_NM_StateDef
{
    putValue( eNM_Gateway_NM_StateS, 0 );
}

on EnvVar eNM_Gateway_WakeupDec
{
    if( getValue( this ))  putValue( eNM_Gateway_WakeupS, getValue( eNM_Gateway_WakeupS ) - 1 );
}

on EnvVar eNM_Gateway_WakeupInc
{
    if( getValue( this ))  putValue( eNM_Gateway_WakeupS, getValue( eNM_Gateway_WakeupS ) + 1 );
}

on EnvVar eNM_Gateway_WakeupDef
{
    putValue( eNM_Gateway_WakeupS, 0 );
}

on EnvVar ePLS_TexteDec
{
    if( getValue( this ))  putValue( ePLS_TexteS, getValue( ePLS_TexteS ) - 1 );
}

on EnvVar ePLS_TexteInc
{
    if( getValue( this ))  putValue( ePLS_TexteS, getValue( ePLS_TexteS ) + 1 );
}

on EnvVar ePLS_TexteDef
{
    putValue( ePLS_TexteS, 0 );
}

on EnvVar ePLS_Schwellpfeil_relDec
{
    if( getValue( this ))  putValue( ePLS_Schwellpfeil_relS, getValue( ePLS_Schwellpfeil_relS ) - 1 );
}

on EnvVar ePLS_Schwellpfeil_relInc
{
    if( getValue( this ))  putValue( ePLS_Schwellpfeil_relS, getValue( ePLS_Schwellpfeil_relS ) + 1 );
}

on EnvVar ePLS_Schwellpfeil_relDef
{
    putValue( ePLS_Schwellpfeil_relS, 0 );
}

on EnvVar ePLS_Schwellpfeil_absDec
{
    if( getValue( this ))  putValue( ePLS_Schwellpfeil_absS, getValue( ePLS_Schwellpfeil_absS ) - 1 );
}

on EnvVar ePLS_Schwellpfeil_absInc
{
    if( getValue( this ))  putValue( ePLS_Schwellpfeil_absS, getValue( ePLS_Schwellpfeil_absS ) + 1 );
}

on EnvVar ePLS_Schwellpfeil_absDef
{
    putValue( ePLS_Schwellpfeil_absS, 0 );
}

on EnvVar eRDK_Diff_Druck_VLDec
{
    if( getValue( this ))  putValue( eRDK_Diff_Druck_VLS, getValue( eRDK_Diff_Druck_VLS ) - 0.1 );
}

on EnvVar eRDK_Diff_Druck_VLInc
{
    if( getValue( this ))  putValue( eRDK_Diff_Druck_VLS, getValue( eRDK_Diff_Druck_VLS ) + 0.1 );
}

on EnvVar eRDK_Diff_Druck_VLDef
{
    putValue( eRDK_Diff_Druck_VLS, -6.3 );
}

on EnvVar eRDK_Diff_Druck_VRDec
{
    if( getValue( this ))  putValue( eRDK_Diff_Druck_VRS, getValue( eRDK_Diff_Druck_VRS ) - 0.1 );
}

on EnvVar eRDK_Diff_Druck_VRInc
{
    if( getValue( this ))  putValue( eRDK_Diff_Druck_VRS, getValue( eRDK_Diff_Druck_VRS ) + 0.1 );
}

on EnvVar eRDK_Diff_Druck_VRDef
{
    putValue( eRDK_Diff_Druck_VRS, -6.3 );
}

on EnvVar eRDK_Diff_Druck_HLDec
{
    if( getValue( this ))  putValue( eRDK_Diff_Druck_HLS, getValue( eRDK_Diff_Druck_HLS ) - 0.1 );
}

on EnvVar eRDK_Diff_Druck_HLInc
{
    if( getValue( this ))  putValue( eRDK_Diff_Druck_HLS, getValue( eRDK_Diff_Druck_HLS ) + 0.1 );
}

on EnvVar eRDK_Diff_Druck_HLDef
{
    putValue( eRDK_Diff_Druck_HLS, -6.3 );
}

on EnvVar eRDK_Diff_Druck_HRDec
{
    if( getValue( this ))  putValue( eRDK_Diff_Druck_HRS, getValue( eRDK_Diff_Druck_HRS ) - 0.1 );
}

on EnvVar eRDK_Diff_Druck_HRInc
{
    if( getValue( this ))  putValue( eRDK_Diff_Druck_HRS, getValue( eRDK_Diff_Druck_HRS ) + 0.1 );
}

on EnvVar eRDK_Diff_Druck_HRDef
{
    putValue( eRDK_Diff_Druck_HRS, -6.3 );
}

on EnvVar eRKA_WarnungenDec
{
    if( getValue( this ))  putValue( eRKA_WarnungenS, getValue( eRKA_WarnungenS ) - 1 );
}

on EnvVar eRKA_WarnungenInc
{
    if( getValue( this ))  putValue( eRKA_WarnungenS, getValue( eRKA_WarnungenS ) + 1 );
}

on EnvVar eRKA_WarnungenDef
{
    putValue( eRKA_WarnungenS, 0 );
}

on EnvVar eRKA_Warnungen_02Dec
{
    if( getValue( this ))  putValue( eRKA_Warnungen_02S, getValue( eRKA_Warnungen_02S ) - 1 );
}

on EnvVar eRKA_Warnungen_02Inc
{
    if( getValue( this ))  putValue( eRKA_Warnungen_02S, getValue( eRKA_Warnungen_02S ) + 1 );
}

on EnvVar eRKA_Warnungen_02Def
{
    putValue( eRKA_Warnungen_02S, 0 );
}

on EnvVar eLS_Helligkeit_IRDec
{
    if( getValue( this ))  putValue( eLS_Helligkeit_IRS, getValue( eLS_Helligkeit_IRS ) - 400 );
}

on EnvVar eLS_Helligkeit_IRInc
{
    if( getValue( this ))  putValue( eLS_Helligkeit_IRS, getValue( eLS_Helligkeit_IRS ) + 400 );
}

on EnvVar eLS_Helligkeit_IRDef
{
    putValue( eLS_Helligkeit_IRS, 101600 );
}

on EnvVar eLS_Helligkeit_FWDec
{
    if( getValue( this ))  putValue( eLS_Helligkeit_FWS, getValue( eLS_Helligkeit_FWS ) - 6 );
}

on EnvVar eLS_Helligkeit_FWInc
{
    if( getValue( this ))  putValue( eLS_Helligkeit_FWS, getValue( eLS_Helligkeit_FWS ) + 6 );
}

on EnvVar eLS_Helligkeit_FWDef
{
    putValue( eLS_Helligkeit_FWS, 6132 );
}

on EnvVar eRS_RegenmengeDec
{
    if( getValue( this ))  putValue( eRS_RegenmengeS, getValue( eRS_RegenmengeS ) - 10 );
}

on EnvVar eRS_RegenmengeInc
{
    if( getValue( this ))  putValue( eRS_RegenmengeS, getValue( eRS_RegenmengeS ) + 10 );
}

on EnvVar eRS_RegenmengeDef
{
    putValue( eRS_RegenmengeS, 140 );
}

on EnvVar eRS_WischergeschwindigkeitDec
{
    if( getValue( this ))  putValue( eRS_WischergeschwindigkeitS, getValue( eRS_WischergeschwindigkeitS ) - 1 );
}

on EnvVar eRS_WischergeschwindigkeitInc
{
    if( getValue( this ))  putValue( eRS_WischergeschwindigkeitS, getValue( eRS_WischergeschwindigkeitS ) + 1 );
}

on EnvVar eRS_WischergeschwindigkeitDef
{
    putValue( eRS_WischergeschwindigkeitS, 0 );
}

on EnvVar eWH_IntervallstufenDec
{
    if( getValue( this ))  putValue( eWH_IntervallstufenS, getValue( eWH_IntervallstufenS ) - 1 );
}

on EnvVar eWH_IntervallstufenInc
{
    if( getValue( this ))  putValue( eWH_IntervallstufenS, getValue( eWH_IntervallstufenS ) + 1 );
}

on EnvVar eWH_IntervallstufenDef
{
    putValue( eWH_IntervallstufenS, 0 );
}

on EnvVar eLRH_on_offDec
{
    if( getValue( this ))  putValue( eLRH_on_offS, getValue( eLRH_on_offS ) - 1 );
}

on EnvVar eLRH_on_offInc
{
    if( getValue( this ))  putValue( eLRH_on_offS, getValue( eLRH_on_offS ) + 1 );
}

on EnvVar eLRH_on_offDef
{
    putValue( eLRH_on_offS, 0 );
}

on EnvVar eLSS_TastencodeDec
{
    if( getValue( this ))  putValue( eLSS_TastencodeS, getValue( eLSS_TastencodeS ) - 1 );
}

on EnvVar eLSS_TastencodeInc
{
    if( getValue( this ))  putValue( eLSS_TastencodeS, getValue( eLSS_TastencodeS ) + 1 );
}

on EnvVar eLSS_TastencodeDef
{
    putValue( eLSS_TastencodeS, 0 );
}

on EnvVar eSTS_TypencodierungDec
{
    if( getValue( this ))  putValue( eSTS_TypencodierungS, getValue( eSTS_TypencodierungS ) - 1 );
}

on EnvVar eSTS_TypencodierungInc
{
    if( getValue( this ))  putValue( eSTS_TypencodierungS, getValue( eSTS_TypencodierungS ) + 1 );
}

on EnvVar eSTS_TypencodierungDef
{
    putValue( eSTS_TypencodierungS, 0 );
}

on EnvVar eSTS_TexteDec
{
    if( getValue( this ))  putValue( eSTS_TexteS, getValue( eSTS_TexteS ) - 1 );
}

on EnvVar eSTS_TexteInc
{
    if( getValue( this ))  putValue( eSTS_TexteS, getValue( eSTS_TexteS ) + 1 );
}

on EnvVar eSTS_TexteDef
{
    putValue( eSTS_TexteS, 14 );
}

on EnvVar eSWA_Status_BZDec
{
    if( getValue( this ))  putValue( eSWA_Status_BZS, getValue( eSWA_Status_BZS ) - 1 );
}

on EnvVar eSWA_Status_BZInc
{
    if( getValue( this ))  putValue( eSWA_Status_BZS, getValue( eSWA_Status_BZS ) + 1 );
}

on EnvVar eSWA_Status_BZDef
{
    putValue( eSWA_Status_BZS, 0 );
}

on EnvVar eSWA_AnzeigenDec
{
    if( getValue( this ))  putValue( eSWA_AnzeigenS, getValue( eSWA_AnzeigenS ) - 1 );
}

on EnvVar eSWA_AnzeigenInc
{
    if( getValue( this ))  putValue( eSWA_AnzeigenS, getValue( eSWA_AnzeigenS ) + 1 );
}

on EnvVar eSWA_AnzeigenDef
{
    putValue( eSWA_AnzeigenS, 0 );
}

on EnvVar eSWA_GischtzaehlerDec
{
    if( getValue( this ))  putValue( eSWA_GischtzaehlerS, getValue( eSWA_GischtzaehlerS ) - 1 );
}

on EnvVar eSWA_GischtzaehlerInc
{
    if( getValue( this ))  putValue( eSWA_GischtzaehlerS, getValue( eSWA_GischtzaehlerS ) + 1 );
}

on EnvVar eSWA_GischtzaehlerDef
{
    putValue( eSWA_GischtzaehlerS, 0 );
}

on EnvVar eSI_Sammel_SG_FehlerDec
{
    if( getValue( this ))  putValue( eSI_Sammel_SG_FehlerS, getValue( eSI_Sammel_SG_FehlerS ) - 1 );
}

on EnvVar eSI_Sammel_SG_FehlerInc
{
    if( getValue( this ))  putValue( eSI_Sammel_SG_FehlerS, getValue( eSI_Sammel_SG_FehlerS ) + 1 );
}

on EnvVar eSI_Sammel_SG_FehlerDef
{
    putValue( eSI_Sammel_SG_FehlerS, 63 );
}

/*
on EnvVar eSI_P_Mode_gueltigDec
{
    if( getValue( this ))  putValue( eSI_P_Mode_gueltigS, getValue( eSI_P_Mode_gueltigS ) - 1 );
}

on EnvVar eSI_P_Mode_gueltigInc
{
    if( getValue( this ))  putValue( eSI_P_Mode_gueltigS, getValue( eSI_P_Mode_gueltigS ) + 1 );
}

on EnvVar eSI_P_Mode_gueltigDef
{
    putValue( eSI_P_Mode_gueltigS, 0 );
}
*/
on EnvVar eTCO_Driver1_DSDec
{
    if( getValue( this ))  putValue( eTCO_Driver1_DSS, getValue( eTCO_Driver1_DSS ) - 1 );
}

on EnvVar eTCO_Driver1_DSInc
{
    if( getValue( this ))  putValue( eTCO_Driver1_DSS, getValue( eTCO_Driver1_DSS ) + 1 );
}

on EnvVar eTCO_Driver1_DSDef
{
    putValue( eTCO_Driver1_DSS, 0 );
}

on EnvVar eTCO_Driver2_DSDec
{
    if( getValue( this ))  putValue( eTCO_Driver2_DSS, getValue( eTCO_Driver2_DSS ) - 1 );
}

on EnvVar eTCO_Driver2_DSInc
{
    if( getValue( this ))  putValue( eTCO_Driver2_DSS, getValue( eTCO_Driver2_DSS ) + 1 );
}

on EnvVar eTCO_Driver2_DSDef
{
    putValue( eTCO_Driver2_DSS, 0 );
}

on EnvVar eTCO_FahrerkennDec
{
    if( getValue( this ))  putValue( eTCO_FahrerkennS, getValue( eTCO_FahrerkennS ) - 1 );
}

on EnvVar eTCO_FahrerkennInc
{
    if( getValue( this ))  putValue( eTCO_FahrerkennS, getValue( eTCO_FahrerkennS ) + 1 );
}

on EnvVar eTCO_FahrerkennDef
{
    putValue( eTCO_FahrerkennS, 0 );
}

on EnvVar eTCO_Driver1_StDec
{
    if( getValue( this ))  putValue( eTCO_Driver1_StS, getValue( eTCO_Driver1_StS ) - 1 );
}

on EnvVar eTCO_Driver1_StInc
{
    if( getValue( this ))  putValue( eTCO_Driver1_StS, getValue( eTCO_Driver1_StS ) + 1 );
}

on EnvVar eTCO_Driver1_StDef
{
    putValue( eTCO_Driver1_StS, 0 );
}

on EnvVar eTCO_Driver2_StDec
{
    if( getValue( this ))  putValue( eTCO_Driver2_StS, getValue( eTCO_Driver2_StS ) - 1 );
}

on EnvVar eTCO_Driver2_StInc
{
    if( getValue( this ))  putValue( eTCO_Driver2_StS, getValue( eTCO_Driver2_StS ) + 1 );
}

on EnvVar eTCO_Driver2_StDef
{
    putValue( eTCO_Driver2_StS, 0 );
}

on EnvVar eTCO_System_EvDec
{
    if( getValue( this ))  putValue( eTCO_System_EvS, getValue( eTCO_System_EvS ) - 1 );
}

on EnvVar eTCO_System_EvInc
{
    if( getValue( this ))  putValue( eTCO_System_EvS, getValue( eTCO_System_EvS ) + 1 );
}

on EnvVar eTCO_System_EvDef
{
    putValue( eTCO_System_EvS, 0 );
}

on EnvVar eTCO_Handle_InfDec
{
    if( getValue( this ))  putValue( eTCO_Handle_InfS, getValue( eTCO_Handle_InfS ) - 1 );
}

on EnvVar eTCO_Handle_InfInc
{
    if( getValue( this ))  putValue( eTCO_Handle_InfS, getValue( eTCO_Handle_InfS ) + 1 );
}

on EnvVar eTCO_Handle_InfDef
{
    putValue( eTCO_Handle_InfS, 0 );
}

on EnvVar eTCO_Sys_PerfDec
{
    if( getValue( this ))  putValue( eTCO_Sys_PerfS, getValue( eTCO_Sys_PerfS ) - 1 );
}

on EnvVar eTCO_Sys_PerfInc
{
    if( getValue( this ))  putValue( eTCO_Sys_PerfS, getValue( eTCO_Sys_PerfS ) + 1 );
}

on EnvVar eTCO_Sys_PerfDef
{
    putValue( eTCO_Sys_PerfS, 0 );
}

on EnvVar eTCO_Dir_IndDec
{
    if( getValue( this ))  putValue( eTCO_Dir_IndS, getValue( eTCO_Dir_IndS ) - 1 );
}

on EnvVar eTCO_Dir_IndInc
{
    if( getValue( this ))  putValue( eTCO_Dir_IndS, getValue( eTCO_Dir_IndS ) + 1 );
}

on EnvVar eTCO_Dir_IndDef
{
    putValue( eTCO_Dir_IndS, 0 );
}

on EnvVar eTCO_Outp_SpeedDec
{
    if( getValue( this ))  putValue( eTCO_Outp_SpeedS, getValue( eTCO_Outp_SpeedS ) - 0.125 );
}

on EnvVar eTCO_Outp_SpeedInc
{
    if( getValue( this ))  putValue( eTCO_Outp_SpeedS, getValue( eTCO_Outp_SpeedS ) + 0.125 );
}

on EnvVar eTCO_Outp_SpeedDef
{
    putValue( eTCO_Outp_SpeedS, 0 );
}

on EnvVar eTCO_Vehicle_SpeedDec
{
    if( getValue( this ))  putValue( eTCO_Vehicle_SpeedS, getValue( eTCO_Vehicle_SpeedS ) - 0.00390625 );
}

on EnvVar eTCO_Vehicle_SpeedInc
{
    if( getValue( this ))  putValue( eTCO_Vehicle_SpeedS, getValue( eTCO_Vehicle_SpeedS ) + 0.00390625 );
}

on EnvVar eTCO_Vehicle_SpeedDef
{
    putValue( eTCO_Vehicle_SpeedS, 0 );
}

on EnvVar eTD_SekundenDec
{
    if( getValue( this ))  putValue( eTD_SekundenS, getValue( eTD_SekundenS ) - 0.25 );
}

on EnvVar eTD_SekundenInc
{
    if( getValue( this ))  putValue( eTD_SekundenS, getValue( eTD_SekundenS ) + 0.25 );
}

on EnvVar eTD_SekundenDef
{
    putValue( eTD_SekundenS, 0 );
}

on EnvVar eTD_MinutenDec
{
    if( getValue( this ))  putValue( eTD_MinutenS, getValue( eTD_MinutenS ) - 1 );
}

on EnvVar eTD_MinutenInc
{
    if( getValue( this ))  putValue( eTD_MinutenS, getValue( eTD_MinutenS ) + 1 );
}

on EnvVar eTD_MinutenDef
{
    putValue( eTD_MinutenS, 0 );
}

on EnvVar eTD_StundenDec
{
    if( getValue( this ))  putValue( eTD_StundenS, getValue( eTD_StundenS ) - 1 );
}

on EnvVar eTD_StundenInc
{
    if( getValue( this ))  putValue( eTD_StundenS, getValue( eTD_StundenS ) + 1 );
}

on EnvVar eTD_StundenDef
{
    putValue( eTD_StundenS, 0 );
}

on EnvVar eTD_MonatDec
{
    if( getValue( this ))  putValue( eTD_MonatS, getValue( eTD_MonatS ) - 1 );
}

on EnvVar eTD_MonatInc
{
    if( getValue( this ))  putValue( eTD_MonatS, getValue( eTD_MonatS ) + 1 );
}

on EnvVar eTD_MonatDef
{
    putValue( eTD_MonatS, 0 );
}

on EnvVar eTD_TagDec
{
    if( getValue( this ))  putValue( eTD_TagS, getValue( eTD_TagS ) - 0.25 );
}

on EnvVar eTD_TagInc
{
    if( getValue( this ))  putValue( eTD_TagS, getValue( eTD_TagS ) + 0.25 );
}

on EnvVar eTD_TagDef
{
    putValue( eTD_TagS, 0 );
}

on EnvVar eTD_JahrDec
{
    if( getValue( this ))  putValue( eTD_JahrS, getValue( eTD_JahrS ) - 1 );
}

on EnvVar eTD_JahrInc
{
    if( getValue( this ))  putValue( eTD_JahrS, getValue( eTD_JahrS ) + 1 );
}

on EnvVar eTD_JahrDef
{
    putValue( eTD_JahrS, 1985 );
}

on EnvVar eTD_Lok_Minute_offsDec
{
    if( getValue( this ))  putValue( eTD_Lok_Minute_offsS, getValue( eTD_Lok_Minute_offsS ) - 1 );
}

on EnvVar eTD_Lok_Minute_offsInc
{
    if( getValue( this ))  putValue( eTD_Lok_Minute_offsS, getValue( eTD_Lok_Minute_offsS ) + 1 );
}

on EnvVar eTD_Lok_Minute_offsDef
{
    putValue( eTD_Lok_Minute_offsS, -125 );
}

on EnvVar eTD_Lok_Hour_offsDec
{
    if( getValue( this ))  putValue( eTD_Lok_Hour_offsS, getValue( eTD_Lok_Hour_offsS ) - 1 );
}

on EnvVar eTD_Lok_Hour_offsInc
{
    if( getValue( this ))  putValue( eTD_Lok_Hour_offsS, getValue( eTD_Lok_Hour_offsS ) + 1 );
}

on EnvVar eTD_Lok_Hour_offsDef
{
    putValue( eTD_Lok_Hour_offsS, -125 );
}

on EnvVar eTSK_WunschgeschwDec
{
    if( getValue( this ))  putValue( eTSK_WunschgeschwS, getValue( eTSK_WunschgeschwS ) - 0.32 );
}

on EnvVar eTSK_WunschgeschwInc
{
    if( getValue( this ))  putValue( eTSK_WunschgeschwS, getValue( eTSK_WunschgeschwS ) + 0.32 );
}

on EnvVar eTSK_WunschgeschwDef
{
    putValue( eTSK_WunschgeschwS, 0 );
}

on EnvVar eTSK_Texte_PrimaeranzDec
{
    if( getValue( this ))  putValue( eTSK_Texte_PrimaeranzS, getValue( eTSK_Texte_PrimaeranzS ) - 1 );
}

on EnvVar eTSK_Texte_PrimaeranzInc
{
    if( getValue( this ))  putValue( eTSK_Texte_PrimaeranzS, getValue( eTSK_Texte_PrimaeranzS ) + 1 );
}

on EnvVar eTSK_Texte_PrimaeranzDef
{
    putValue( eTSK_Texte_PrimaeranzS, 0 );
}

on EnvVar eTSK_Status_AnzeigeDec
{
    if( getValue( this ))  putValue( eTSK_Status_AnzeigeS, getValue( eTSK_Status_AnzeigeS ) - 1 );
}

on EnvVar eTSK_Status_AnzeigeInc
{
    if( getValue( this ))  putValue( eTSK_Status_AnzeigeS, getValue( eTSK_Status_AnzeigeS ) + 1 );
}

on EnvVar eTSK_Status_AnzeigeDef
{
    putValue( eTSK_Status_AnzeigeS, 1 );
}

on EnvVar eVDI_V_distDec
{
    if( getValue( this ))  putValue( eVDI_V_distS, getValue( eVDI_V_distS ) - 0.005 );
}

on EnvVar eVDI_V_distInc
{
    if( getValue( this ))  putValue( eVDI_V_distS, getValue( eVDI_V_distS ) + 0.005 );
}

on EnvVar eVDI_V_distDef
{
    putValue( eVDI_V_distS, 0 );
}

on EnvVar eVDI_T_distDec
{
    if( getValue( this ))  putValue( eVDI_T_distS, getValue( eVDI_T_distS ) - 0.005 );
}

on EnvVar eVDI_T_distInc
{
    if( getValue( this ))  putValue( eVDI_T_distS, getValue( eVDI_T_distS ) + 0.005 );
}

on EnvVar eVDI_T_distDef
{
    putValue( eVDI_T_distS, 0 );
}

on EnvVar eWBA_Fahrstufe_02Dec
{
    if( getValue( this ))  putValue( eWBA_Fahrstufe_02S, getValue( eWBA_Fahrstufe_02S ) - 1 );
}

on EnvVar eWBA_Fahrstufe_02Inc
{
    if( getValue( this ))  putValue( eWBA_Fahrstufe_02S, getValue( eWBA_Fahrstufe_02S ) + 1 );
}

on EnvVar eWBA_Fahrstufe_02Def
{
    putValue( eWBA_Fahrstufe_02S, 0 );
}

on EnvVar eWBA_ZielFahrstufeDec
{
    if( getValue( this ))  putValue( eWBA_ZielFahrstufeS, getValue( eWBA_ZielFahrstufeS ) - 1 );
}

on EnvVar eWBA_ZielFahrstufeInc
{
    if( getValue( this ))  putValue( eWBA_ZielFahrstufeS, getValue( eWBA_ZielFahrstufeS ) + 1 );
}

on EnvVar eWBA_ZielFahrstufeDef
{
    putValue( eWBA_ZielFahrstufeS, 0 );
}

on EnvVar eWBA_GE_Warnung_02Dec
{
    if( getValue( this ))  putValue( eWBA_GE_Warnung_02S, getValue( eWBA_GE_Warnung_02S ) - 1 );
}

on EnvVar eWBA_GE_Warnung_02Inc
{
    if( getValue( this ))  putValue( eWBA_GE_Warnung_02S, getValue( eWBA_GE_Warnung_02S ) + 1 );
}

on EnvVar eWBA_GE_Warnung_02Def
{
    putValue( eWBA_GE_Warnung_02S, 0 );
}

on EnvVar eWBA_eing_Gang_02Dec
{
    if( getValue( this ))  putValue( eWBA_eing_Gang_02S, getValue( eWBA_eing_Gang_02S ) - 1 );
}

on EnvVar eWBA_eing_Gang_02Inc
{
    if( getValue( this ))  putValue( eWBA_eing_Gang_02S, getValue( eWBA_eing_Gang_02S ) + 1 );
}

on EnvVar eWBA_eing_Gang_02Def
{
    putValue( eWBA_eing_Gang_02S, 0 );
}

on EnvVar eWBA_GE_TexteDec
{
    if( getValue( this ))  putValue( eWBA_GE_TexteS, getValue( eWBA_GE_TexteS ) - 1 );
}

on EnvVar eWBA_GE_TexteInc
{
    if( getValue( this ))  putValue( eWBA_GE_TexteS, getValue( eWBA_GE_TexteS ) + 1 );
}

on EnvVar eWBA_GE_TexteDef
{
    putValue( eWBA_GE_TexteS, 0 );
}

on EnvVar eWBA_SchaltschemaDec
{
    if( getValue( this ))  putValue( eWBA_SchaltschemaS, getValue( eWBA_SchaltschemaS ) - 1 );
}

on EnvVar eWBA_SchaltschemaInc
{
    if( getValue( this ))  putValue( eWBA_SchaltschemaS, getValue( eWBA_SchaltschemaS ) + 1 );
}

on EnvVar eWBA_SchaltschemaDef
{
    putValue( eWBA_SchaltschemaS, 0 );
}

on EnvVar eWIV_VerschleissindexDec
{
    if( getValue( this ))  putValue( eWIV_VerschleissindexS, getValue( eWIV_VerschleissindexS ) - 2E-08 );
}

on EnvVar eWIV_VerschleissindexInc
{
    if( getValue( this ))  putValue( eWIV_VerschleissindexS, getValue( eWIV_VerschleissindexS ) + 2E-08 );
}

on EnvVar eWIV_VerschleissindexDef
{
    putValue( eWIV_VerschleissindexS, 0 );
}

on EnvVar eWIV_RussindexDec
{
    if( getValue( this ))  putValue( eWIV_RussindexS, getValue( eWIV_RussindexS ) - 2E-08 );
}

on EnvVar eWIV_RussindexInc
{
    if( getValue( this ))  putValue( eWIV_RussindexS, getValue( eWIV_RussindexS ) + 2E-08 );
}

on EnvVar eWIV_RussindexDef
{
    putValue( eWIV_RussindexS, 0 );
}

on EnvVar eWIV_t_minDec
{
    if( getValue( this ))  putValue( eWIV_t_minS, getValue( eWIV_t_minS ) - 1 );
}

on EnvVar eWIV_t_minInc
{
    if( getValue( this ))  putValue( eWIV_t_minS, getValue( eWIV_t_minS ) + 1 );
}

on EnvVar eWIV_t_minDef
{
    putValue( eWIV_t_minS, 12 );
}

on EnvVar eWIV_t_maxDec
{
    if( getValue( this ))  putValue( eWIV_t_maxS, getValue( eWIV_t_maxS ) - 1 );
}

on EnvVar eWIV_t_maxInc
{
    if( getValue( this ))  putValue( eWIV_t_maxS, getValue( eWIV_t_maxS ) + 1 );
}

on EnvVar eWIV_t_maxDef
{
    putValue( eWIV_t_maxS, 24 );
}

on EnvVar eWIV_W_minDec
{
    if( getValue( this ))  putValue( eWIV_W_minS, getValue( eWIV_W_minS ) - 1000 );
}

on EnvVar eWIV_W_minInc
{
    if( getValue( this ))  putValue( eWIV_W_minS, getValue( eWIV_W_minS ) + 1000 );
}

on EnvVar eWIV_W_minDef
{
    putValue( eWIV_W_minS, 17000 );
}

on EnvVar eWIV_W_maxDec
{
    if( getValue( this ))  putValue( eWIV_W_maxS, getValue( eWIV_W_maxS ) - 1000 );
}

on EnvVar eWIV_W_maxInc
{
    if( getValue( this ))  putValue( eWIV_W_maxS, getValue( eWIV_W_maxS ) + 1000 );
}

on EnvVar eWIV_W_maxDef
{
    putValue( eWIV_W_maxS, 31000 );
}

on EnvVar eDEV_Kombi_SUP1_DummySigDec
{
    if( getValue( this ))  putValue( eDEV_Kombi_SUP1_DummySigS, getValue( eDEV_Kombi_SUP1_DummySigS ) - 1 );
}

on EnvVar eDEV_Kombi_SUP1_DummySigInc
{
    if( getValue( this ))  putValue( eDEV_Kombi_SUP1_DummySigS, getValue( eDEV_Kombi_SUP1_DummySigS ) + 1 );
}

on EnvVar eDEV_Kombi_SUP1_DummySigDef
{
    putValue( eDEV_Kombi_SUP1_DummySigS, 0 );
}

on EnvVar eDEV_Kombi_SUP2_DummySigDec
{
    if( getValue( this ))  putValue( eDEV_Kombi_SUP2_DummySigS, getValue( eDEV_Kombi_SUP2_DummySigS ) - 1 );
}

on EnvVar eDEV_Kombi_SUP2_DummySigInc
{
    if( getValue( this ))  putValue( eDEV_Kombi_SUP2_DummySigS, getValue( eDEV_Kombi_SUP2_DummySigS ) + 1 );
}

on EnvVar eDEV_Kombi_SUP2_DummySigDef
{
    putValue( eDEV_Kombi_SUP2_DummySigS, 0 );
}

on EnvVar eDEV_Kombi_SUP3_DummySigDec
{
    if( getValue( this ))  putValue( eDEV_Kombi_SUP3_DummySigS, getValue( eDEV_Kombi_SUP3_DummySigS ) - 1 );
}

on EnvVar eDEV_Kombi_SUP3_DummySigInc
{
    if( getValue( this ))  putValue( eDEV_Kombi_SUP3_DummySigS, getValue( eDEV_Kombi_SUP3_DummySigS ) + 1 );
}

on EnvVar eDEV_Kombi_SUP3_DummySigDef
{
    putValue( eDEV_Kombi_SUP3_DummySigS, 0 );
}

on EnvVar eDEV_Kombi_UD1_Byte1Dec
{
    if( getValue( this ))  putValue( eDEV_Kombi_UD1_Byte1S, getValue( eDEV_Kombi_UD1_Byte1S ) - 1 );
}

on EnvVar eDEV_Kombi_UD1_Byte1Inc
{
    if( getValue( this ))  putValue( eDEV_Kombi_UD1_Byte1S, getValue( eDEV_Kombi_UD1_Byte1S ) + 1 );
}

on EnvVar eDEV_Kombi_UD1_Byte1Def
{
    putValue( eDEV_Kombi_UD1_Byte1S, 0 );
}

on EnvVar eDEV_Kombi_UD1_Byte2Dec
{
    if( getValue( this ))  putValue( eDEV_Kombi_UD1_Byte2S, getValue( eDEV_Kombi_UD1_Byte2S ) - 1 );
}

on EnvVar eDEV_Kombi_UD1_Byte2Inc
{
    if( getValue( this ))  putValue( eDEV_Kombi_UD1_Byte2S, getValue( eDEV_Kombi_UD1_Byte2S ) + 1 );
}

on EnvVar eDEV_Kombi_UD1_Byte2Def
{
    putValue( eDEV_Kombi_UD1_Byte2S, 0 );
}

on EnvVar eDEV_Kombi_UD1_Byte3Dec
{
    if( getValue( this ))  putValue( eDEV_Kombi_UD1_Byte3S, getValue( eDEV_Kombi_UD1_Byte3S ) - 1 );
}

on EnvVar eDEV_Kombi_UD1_Byte3Inc
{
    if( getValue( this ))  putValue( eDEV_Kombi_UD1_Byte3S, getValue( eDEV_Kombi_UD1_Byte3S ) + 1 );
}

on EnvVar eDEV_Kombi_UD1_Byte3Def
{
    putValue( eDEV_Kombi_UD1_Byte3S, 0 );
}

on EnvVar eDEV_Kombi_UD1_Byte4Dec
{
    if( getValue( this ))  putValue( eDEV_Kombi_UD1_Byte4S, getValue( eDEV_Kombi_UD1_Byte4S ) - 1 );
}

on EnvVar eDEV_Kombi_UD1_Byte4Inc
{
    if( getValue( this ))  putValue( eDEV_Kombi_UD1_Byte4S, getValue( eDEV_Kombi_UD1_Byte4S ) + 1 );
}

//GVJ-4663

on EnvVar eTBEM_06Dec
{
    if( getValue( this ))  putValue( eTBEM_06, dec( getValue( eTBEM_06 ) ) );
}

on EnvVar eTBEM_06Def
{
    putValue( eTBEM_06,100 );
}

on EnvVar eTBEM_06Inc
{
    if( getValue( this ))  putValue( eTBEM_06, inc( getValue( eTBEM_06 ) ) );
}

on EnvVar eTOTBEM_06Dec
{
    if( getValue( this ))  putValue( eTOTBEM_06, dec( getValue( eTOTBEM_06 ) ) );
}

on EnvVar eTOTBEM_06Def
{
    putValue( eTOTBEM_06, 1000 );
}

on EnvVar eTOTBEM_06Inc
{
    if( getValue( this ))  putValue( eTOTBEM_06, inc( getValue( eTOTBEM_06 ) ) );
}

on EnvVar eDlcBEM_06Dec
{
    if( getValue( this ))  putValue( eDlcBEM_06, getValue( eDlcBEM_06 ) - 1 );
}

on EnvVar eDlcBEM_06Def
{
    putValue( eDlcBEM_06, 8 );
}

on EnvVar eDlcBEM_06Inc
{
    if( getValue( this ))  putValue( eDlcBEM_06, getValue( eDlcBEM_06 ) + 1 );
}

on EnvVar eBEM_06_CRCDec
{
    if( getValue( this ))  putValue( eBEM_06_CRCS, getValue( eBEM_06_CRCS ) - 1);
}

on EnvVar eBEM_06_CRCDef
{
    putValue( eBEM_06_CRCS, 0);
}

on EnvVar eBEM_06_CRCInc
{
    if( getValue( this ))  putValue( eBEM_06_CRCS, getValue( eBEM_06_CRCS ) + 1);
}

on EnvVar eBEM_06_BZDec
{
    if( getValue( this ))  putValue( eBEM_06_BZS, getValue( eBEM_06_BZS ) - 1);
}

on EnvVar eBEM_06_BZDef
{
    putValue( eBEM_06_BZS, 0);
}

on EnvVar eBEM_06_BZInc
{
    if( getValue( this ))  putValue( eBEM_06_BZS, getValue( eBEM_06_BZS ) + 1);
}

on EnvVar eBZStepBEM_06Dec
{
    if( getValue( this ))  putValue( eBZStepBEM_06, getValue( eBZStepBEM_06 ) - 1 );
}

on EnvVar eBZStepBEM_06Inc
{
    if( getValue( this ))  putValue( eBZStepBEM_06, getValue( eBZStepBEM_06 ) + 1 );
}

on EnvVar eBZStepBEM_06Def
{
    putValue( eBZStepBEM_06, 1 );
}

on EnvVar eTGateway_77Dec
{
    if( getValue( this ))  putValue( eTGateway_77, dec( getValue( eTGateway_77 ) ) );
}

on EnvVar eTGateway_77Def
{
    putValue( eTGateway_77,200 );
}

on EnvVar eTGateway_77Inc
{
    if( getValue( this ))  putValue( eTGateway_77, inc( getValue( eTGateway_77 ) ) );
}

on EnvVar eTOTGateway_77Dec
{
    if( getValue( this ))  putValue( eTOTGateway_77, dec( getValue( eTOTGateway_77 ) ) );
}

on EnvVar eTOTGateway_77Def
{
    putValue( eTOTGateway_77, 2000 );
}

on EnvVar eTOTGateway_77Inc
{
    if( getValue( this ))  putValue( eTOTGateway_77, inc( getValue( eTOTGateway_77 ) ) );
}

on EnvVar eDlcGateway_77Dec
{
    if( getValue( this ))  putValue( eDlcGateway_77, getValue( eDlcGateway_77 ) - 1 );
}

on EnvVar eDlcGateway_77Def
{
    putValue( eDlcGateway_77, 8 );
}

on EnvVar eDlcGateway_77Inc
{
    if( getValue( this ))  putValue( eDlcGateway_77, getValue( eDlcGateway_77 ) + 1 );
}

on EnvVar eTGNSS_02Dec
{
    if( getValue( this ))  putValue( eTGNSS_02, dec( getValue( eTGNSS_02 ) ) );
}

on EnvVar eTGNSS_02Def
{
    putValue( eTGNSS_02,1000 );
}

on EnvVar eTGNSS_02Inc
{
    if( getValue( this ))  putValue( eTGNSS_02, inc( getValue( eTGNSS_02 ) ) );
}

on EnvVar eTOTGNSS_02Dec
{
    if( getValue( this ))  putValue( eTOTGNSS_02, dec( getValue( eTOTGNSS_02 ) ) );
}

on EnvVar eTOTGNSS_02Def
{
    putValue( eTOTGNSS_02, 5000 );
}

on EnvVar eTOTGNSS_02Inc
{
    if( getValue( this ))  putValue( eTOTGNSS_02, inc( getValue( eTOTGNSS_02 ) ) );
}

on EnvVar eDlcGNSS_02Dec
{
    if( getValue( this ))  putValue( eDlcGNSS_02, getValue( eDlcGNSS_02 ) - 1 );
}

on EnvVar eDlcGNSS_02Def
{
    putValue( eDlcGNSS_02, 8 );
}

on EnvVar eDlcGNSS_02Inc
{
    if( getValue( this ))  putValue( eDlcGNSS_02, getValue( eDlcGNSS_02 ) + 1 );
}

on EnvVar eTGNSS_03Dec
{
    if( getValue( this ))  putValue( eTGNSS_03, dec( getValue( eTGNSS_03 ) ) );
}

on EnvVar eTGNSS_03Def
{
    putValue( eTGNSS_03,1000 );
}

on EnvVar eTGNSS_03Inc
{
    if( getValue( this ))  putValue( eTGNSS_03, inc( getValue( eTGNSS_03 ) ) );
}

on EnvVar eTOTGNSS_03Dec
{
    if( getValue( this ))  putValue( eTOTGNSS_03, dec( getValue( eTOTGNSS_03 ) ) );
}

on EnvVar eTOTGNSS_03Def
{
    putValue( eTOTGNSS_03, 5000 );
}

on EnvVar eTOTGNSS_03Inc
{
    if( getValue( this ))  putValue( eTOTGNSS_03, inc( getValue( eTOTGNSS_03 ) ) );
}

on EnvVar eDlcGNSS_03Dec
{
    if( getValue( this ))  putValue( eDlcGNSS_03, getValue( eDlcGNSS_03 ) - 1 );
}

on EnvVar eDlcGNSS_03Def
{
    putValue( eDlcGNSS_03, 8 );
}

on EnvVar eDlcGNSS_03Inc
{
    if( getValue( this ))  putValue( eDlcGNSS_03, getValue( eDlcGNSS_03 ) + 1 );
}

on EnvVar eTHUD_01Dec
{
    if( getValue( this ))  putValue( eTHUD_01, dec( getValue( eTHUD_01 ) ) );
}

on EnvVar eTHUD_01Def
{
    putValue( eTHUD_01,1000 );
}

on EnvVar eTHUD_01Inc
{
    if( getValue( this ))  putValue( eTHUD_01, inc( getValue( eTHUD_01 ) ) );
}

on EnvVar eTOTHUD_01Dec
{
    if( getValue( this ))  putValue( eTOTHUD_01, dec( getValue( eTOTHUD_01 ) ) );
}

on EnvVar eTOTHUD_01Def
{
    putValue( eTOTHUD_01, 5000 );
}

on EnvVar eTOTHUD_01Inc
{
    if( getValue( this ))  putValue( eTOTHUD_01, inc( getValue( eTOTHUD_01 ) ) );
}

on EnvVar eDlcHUD_01Dec
{
    if( getValue( this ))  putValue( eDlcHUD_01, getValue( eDlcHUD_01 ) - 1 );
}

on EnvVar eDlcHUD_01Def
{
    putValue( eDlcHUD_01, 8 );
}

on EnvVar eDlcHUD_01Inc
{
    if( getValue( this ))  putValue( eDlcHUD_01, getValue( eDlcHUD_01 ) + 1 );
}

on EnvVar eTHVK_01Dec
{
    if( getValue( this ))  putValue( eTHVK_01, dec( getValue( eTHVK_01 ) ) );
}

on EnvVar eTHVK_01Def
{
    putValue( eTHVK_01,100 );
}

on EnvVar eTHVK_01Inc
{
    if( getValue( this ))  putValue( eTHVK_01, inc( getValue( eTHVK_01 ) ) );
}

on EnvVar eTOTHVK_01Dec
{
    if( getValue( this ))  putValue( eTOTHVK_01, dec( getValue( eTOTHVK_01 ) ) );
}

on EnvVar eTOTHVK_01Def
{
    putValue( eTOTHVK_01, 1000 );
}

on EnvVar eTOTHVK_01Inc
{
    if( getValue( this ))  putValue( eTOTHVK_01, inc( getValue( eTOTHVK_01 ) ) );
}

on EnvVar eDlcHVK_01Dec
{
    if( getValue( this ))  putValue( eDlcHVK_01, getValue( eDlcHVK_01 ) - 1 );
}

on EnvVar eDlcHVK_01Def
{
    putValue( eDlcHVK_01, 8 );
}

on EnvVar eDlcHVK_01Inc
{
    if( getValue( this ))  putValue( eDlcHVK_01, getValue( eDlcHVK_01 ) + 1 );
}

on EnvVar eTLoGeWa_03Dec
{
    if( getValue( this ))  putValue( eTLoGeWa_03, dec( getValue( eTLoGeWa_03 ) ) );
}

on EnvVar eTLoGeWa_03Def
{
    putValue( eTLoGeWa_03,200 );
}

on EnvVar eTLoGeWa_03Inc
{
    if( getValue( this ))  putValue( eTLoGeWa_03, inc( getValue( eTLoGeWa_03 ) ) );
}

on EnvVar eTOTLoGeWa_03Dec
{
    if( getValue( this ))  putValue( eTOTLoGeWa_03, dec( getValue( eTOTLoGeWa_03 ) ) );
}

on EnvVar eTOTLoGeWa_03Def
{
    putValue( eTOTLoGeWa_03, 2000 );
}

on EnvVar eTOTLoGeWa_03Inc
{
    if( getValue( this ))  putValue( eTOTLoGeWa_03, inc( getValue( eTOTLoGeWa_03 ) ) );
}

on EnvVar eDlcLoGeWa_03Dec
{
    if( getValue( this ))  putValue( eDlcLoGeWa_03, getValue( eDlcLoGeWa_03 ) - 1 );
}

on EnvVar eDlcLoGeWa_03Def
{
    putValue( eDlcLoGeWa_03, 8 );
}

on EnvVar eDlcLoGeWa_03Inc
{
    if( getValue( this ))  putValue( eDlcLoGeWa_03, getValue( eDlcLoGeWa_03 ) + 1 );
}

on EnvVar eTMVK_01Dec
{
    if( getValue( this ))  putValue( eTMVK_01, dec( getValue( eTMVK_01 ) ) );
}

on EnvVar eTMVK_01Def
{
    putValue( eTMVK_01, 100 );
}

on EnvVar eTMVK_01Inc
{
    if( getValue( this ))  putValue( eTMVK_01, inc( getValue( eTMVK_01 ) ) );
}

on EnvVar eTOTMVK_01Dec
{
    if( getValue( this ))  putValue( eTOTMVK_01, dec( getValue( eTOTMVK_01 ) ) );
}

on EnvVar eTOTMVK_01Def
{
    putValue( eTOTMVK_01, 1000 );
}

on EnvVar eTOTMVK_01Inc
{
    if( getValue( this ))  putValue( eTOTMVK_01, inc( getValue( eTOTMVK_01 ) ) );
}

on EnvVar eDlcMVK_01Dec
{
    if( getValue( this ))  putValue( eDlcMVK_01, getValue( eDlcMVK_01 ) - 1 );
}

on EnvVar eDlcMVK_01Def
{
    putValue( eDlcMVK_01, 8 );
}

on EnvVar eDlcMVK_01Inc
{
    if( getValue( this ))  putValue( eDlcMVK_01, getValue( eDlcMVK_01 ) + 1 );
}

on EnvVar eBZStepMVK_01Dec
{
    if( getValue( this ))  putValue( eBZStepMVK_01, getValue( eBZStepMVK_01 ) - 1 );
}

on EnvVar eBZStepMVK_01Def
{
    putValue( eBZStepMVK_01, 1 );
}

on EnvVar eBZStepMVK_01Inc
{
    if( getValue( this ))  putValue( eBZStepMVK_01, getValue( eBZStepMVK_01 ) + 1 );
}

on EnvVar eTParkhilfe_04Dec
{
    if( getValue( this ))  putValue( eTParkhilfe_04, dec( getValue( eTParkhilfe_04 ) ) );
}

on EnvVar eTParkhilfe_04Def
{
    putValue( eTParkhilfe_04,500 );
}

on EnvVar eTParkhilfe_04Inc
{
    if( getValue( this ))  putValue( eTParkhilfe_04, inc( getValue( eTParkhilfe_04 ) ) );
}

on EnvVar eTOTParkhilfe_04Dec
{
    if( getValue( this ))  putValue( eTOTParkhilfe_04, dec( getValue( eTOTParkhilfe_04 ) ) );
}

on EnvVar eTOTParkhilfe_04Def
{
    putValue( eTOTParkhilfe_04, 5000 );
}

on EnvVar eTOTParkhilfe_04Inc
{
    if( getValue( this ))  putValue( eTOTParkhilfe_04, inc( getValue( eTOTParkhilfe_04 ) ) );
}

on EnvVar eDlcParkhilfe_04Dec
{
    if( getValue( this ))  putValue( eDlcParkhilfe_04, getValue( eDlcParkhilfe_04 ) - 1 );
}

on EnvVar eDlcParkhilfe_04Def
{
    putValue( eDlcParkhilfe_04, 8 );
}

on EnvVar eDlcParkhilfe_04Inc
{
    if( getValue( this ))  putValue( eDlcParkhilfe_04, getValue( eDlcParkhilfe_04 ) + 1 );
}

on EnvVar eTZentralrechner_03Dec
{
    if( getValue( this ))  putValue( eTZentralrechner_03, dec( getValue( eTZentralrechner_03 ) ) );
}

on EnvVar eTZentralrechner_03Def
{
    putValue( eTZentralrechner_03,1000 );
}

on EnvVar eTZentralrechner_03Inc
{
    if( getValue( this ))  putValue( eTZentralrechner_03, inc( getValue( eTZentralrechner_03 ) ) );
}

on EnvVar eTOTZentralrechner_03Dec
{
    if( getValue( this ))  putValue( eTOTZentralrechner_03, dec( getValue( eTOTZentralrechner_03 ) ) );
}

on EnvVar eTOTZentralrechner_03Def
{
    putValue( eTOTZentralrechner_03, 5000 );
}

on EnvVar eTOTZentralrechner_03Inc
{
    if( getValue( this ))  putValue( eTOTZentralrechner_03, inc( getValue( eTOTZentralrechner_03 ) ) );
}

on EnvVar eDlcZentralrechner_03Dec
{
    if( getValue( this ))  putValue( eDlcZentralrechner_03, getValue( eDlcZentralrechner_03 ) - 1 );
}

on EnvVar eDlcZentralrechner_03Def
{
    putValue( eDlcZentralrechner_03, 8 );
}

on EnvVar eDlcZentralrechner_03Inc
{
    if( getValue( this ))  putValue( eDlcZentralrechner_03, getValue( eDlcZentralrechner_03 ) + 1 );
}

// ===== END OF GENERATED CODE =====

on EnvVar eSTH_KVSDef
{
    putValue( eSTH_KVS, 0 );
}

on EnvVar eSTH_KVSInc
{
    if( getValue( this ))  putValue( eSTH_KVS, getValue( eSTH_KVS ) + 1 );
}

on EnvVar eSTH_KVSDec
{
    if( getValue( this ))  putValue( eSTH_KVS, getValue( eSTH_KVS ) - 1 );
}

on EnvVar eMO_Verbrauch_CNGDec
{
    if( getValue( this ))  putValue( eMO_Verbrauch_CNG, getValue( eMO_Verbrauch_CNG ) - 1 );
}

on EnvVar eMO_Verbrauch_CNGInc
{
    if( getValue( this ))  putValue( eMO_Verbrauch_CNG, getValue( eMO_Verbrauch_CNG ) + 1 );
}

on EnvVar eMO_Verbrauch_CNGDef
{
    putValue( eMO_Verbrauch_CNG, 0 );
}

on EnvVar eMO_rel_LadedruckDec
{
    if( getValue( this ))  putValue( eMO_rel_LadedruckS, getValue( eMO_rel_LadedruckS ) - 0.4 );
}

on EnvVar eMO_rel_LadedruckDef
{
    putValue( eMO_rel_LadedruckS, 0 );
}

on EnvVar eMO_rel_LadedruckInc
{
    if( getValue( this ))  putValue( eMO_rel_LadedruckS, getValue( eMO_rel_LadedruckS ) + 0.4 );
}

on EnvVar eMO_max_LadedruckDec
{
    if( getValue( this ))  putValue( eMO_max_LadedruckS, getValue( eMO_max_LadedruckS) - 0.1);
}

on EnvVar eMO_max_LadedruckDef
{
    putValue( eMO_max_LadedruckS, 0 );
}

on EnvVar eMO_max_LadedruckInc
{
    if( getValue( this ))  putValue( eMO_max_LadedruckS, getValue( eMO_max_LadedruckS ) + 0.1 );
}

on EnvVar eMO_E_WarnungenDec
{
    if( getValue( this ))  putValue( eMO_E_WarnungenS, getValue( eMO_E_WarnungenS ) - 1 );
}

on EnvVar eMO_E_TexteDec
{
    if( getValue( this ))  putValue( eMO_E_TexteS, getValue( eMO_E_TexteS ) - 1 );
}

on EnvVar eMO_E_ModeDec
{
    if( getValue( this ))  putValue( eMO_E_ModeS, getValue( eMO_E_ModeS ) - 1 );
}

on EnvVar eMO_E_WarnungenDef
{
    putValue( eMO_E_WarnungenS, 0 );
}

on EnvVar eMO_E_TexteDef
{
    putValue( eMO_E_TexteS, 0 );
}

on EnvVar eMO_E_ModeDef
{
    putValue( eMO_E_ModeS, 0 );
}

on EnvVar eMO_E_WarnungenInc
{
    if( getValue( this ))  putValue( eMO_E_WarnungenS, getValue( eMO_E_WarnungenS ) + 1 );
}

on EnvVar eMO_E_TexteInc
{
    if( getValue( this ))  putValue( eMO_E_TexteS, getValue( eMO_E_TexteS ) + 1 );
}

on EnvVar eMO_E_ModeInc
{
    if( getValue( this ))  putValue( eMO_E_ModeS, getValue( eMO_E_ModeS ) + 1 );
}

on EnvVar eDlcHSP_01Dec
{
    if( getValue( this ))  putValue( eDlcHSP_01, getValue( eDlcHSP_01) - 1 );
}

on EnvVar eDlcHSP_01Def
{
    putValue( eDlcHSP_01, 6 );
}

on EnvVar eDlcHSP_01Inc
{
    if( getValue( this ))  putValue( eDlcHSP_01, getValue( eDlcHSP_01 ) + 1 );
}

on EnvVar eTHVLM_05Dec
{
    if( getValue( this ))  putValue( eTHVLM_05, dec( getValue( eTHVLM_05 ) ) );
}

on EnvVar eTHVLM_05Def
{
    putValue( eTHVLM_05, 500 );
}

on EnvVar eTHVLM_05Inc
{
    if( getValue( this ))  putValue( eTHVLM_05, inc( getValue( eTHVLM_05 ) ) );
}

on EnvVar eTHSP_01Dec
{
    if( getValue( this ))  putValue( eTHSP_01, dec( getValue( eTHSP_01 ) ) );
}

on EnvVar eTHSP_01Def
{
    putValue( eTHSP_01, 200 );
}

on EnvVar eTHSP_01Inc
{
    if( getValue( this ))  putValue( eTHSP_01, inc( getValue( eTHSP_01 ) ) );
}

on EnvVar eTOTHVLM_05Dec
{
    if( getValue( this ))  putValue( eTOTHVLM_05, dec( getValue( eTOTHVLM_05 ) ) );
}

on EnvVar eTOTHVLM_05Def
{
    putValue( eTOTHVLM_05, 5000 );
}

on EnvVar eTOTHVLM_05Inc
{
    if( getValue( this ))  putValue( eTOTHVLM_05, inc( getValue( eTOTHVLM_05 ) ) );
}

on EnvVar eTOTHSP_01Dec
{
    if( getValue( this ))  putValue( eTOTHSP_01, dec( getValue( eTOTHSP_01 ) ) );
}

on EnvVar eTOTHSP_01Def
{
    putValue( eTOTHSP_01, 2000 );
}

on EnvVar eTOTHSP_01Inc
{
    if( getValue( this ))  putValue( eTOTHSP_01, inc( getValue( eTOTHSP_01 ) ) );
}

on EnvVar eDlcHVLM_05Dec
{
    if( getValue( this ))  putValue( eDlcHVLM_05, getValue( eDlcHVLM_05 ) - 1 );
}

on EnvVar eDlcHVLM_05Def
{
    putValue( eDlcHVLM_05, 8 );
}

on EnvVar eDlcHVLM_05Inc
{
    if( getValue( this ))  putValue( eDlcHVLM_05, getValue( eDlcHVLM_05 ) + 1 );
}

on EnvVar eHVEM_Anf_ReichweiteNVDec
{
    if( getValue( this ))  putValue( eHVEM_Anf_ReichweiteNVS, getValue( eHVEM_Anf_ReichweiteNVS ) - 1 );
}

on EnvVar eHVEM_Anf_ReichweiteNVDef
{
    putValue( eHVEM_Anf_ReichweiteNVS, 0 );
}

on EnvVar eHVEM_Anf_ReichweiteNVInc
{
    if( getValue( this ))  putValue( eHVEM_Anf_ReichweiteNVS, getValue( eHVEM_Anf_ReichweiteNVS ) + 1 );
}

on EnvVar eHVEM_KlimaMaxHVStromDec
{
    if( getValue( this ))  putValue( eHVEM_KlimaMaxHVStromS, getValue( eHVEM_KlimaMaxHVStromS ) - 1 );
}

on EnvVar eHVEM_KlimaMaxHVStromDef
{
    putValue( eHVEM_KlimaMaxHVStromS, 0 );
}

on EnvVar eHVEM_KlimaMaxHVStromInc
{
    if( getValue( this ))  putValue( eHVEM_KlimaMaxHVStromS, getValue( eHVEM_KlimaMaxHVStromS ) + 1 );
}

on EnvVar eHVEM_Nachlad_StatusDec
{
    if( getValue( this ))  putValue( eHVEM_Nachlad_StatusS, getValue( eHVEM_Nachlad_StatusS ) - 1 );
}

on EnvVar eHVEM_Nachlad_StatusDef
{
    putValue( eHVEM_Nachlad_StatusS, 3 );
}

on EnvVar eHVEM_Nachlad_StatusInc
{
    if( getValue( this ))  putValue( eHVEM_Nachlad_StatusS, getValue( eHVEM_Nachlad_StatusS ) + 1 );
}

on EnvVar eHVEM_NVLeistungEmpfDec
{
    if( getValue( this ))  putValue( eHVEM_NVLeistungEmpfS, getValue( eHVEM_NVLeistungEmpfS ) - 100 );
}

on EnvVar eHVEM_NVLeistungEmpfDef
{
    putValue( eHVEM_NVLeistungEmpfS, 0 );
}

on EnvVar eHVEM_NVLeistungEmpfInc
{
    if( getValue( this ))  putValue( eHVEM_NVLeistungEmpfS, getValue( eHVEM_NVLeistungEmpfS ) + 100 );
}

on EnvVar eHVLM_Klima_TempDec
{
     if( getValue( this ))  putValue( eHVLM_Klima_TempS, getValue( eHVLM_Klima_TempS) - 0.1);
}

on EnvVar eHVLM_Klima_TempDef
{
    putValue( eHVLM_Klima_TempS, 10.00 );
}

on EnvVar eHVLM_Klima_TempInc
{
    if( getValue( this ))  putValue( eHVLM_Klima_TempS, getValue( eHVLM_Klima_TempS ) + 0.1 );
}

on EnvVar eHVLM_LadeartDec
{
    if( getValue( this ))  putValue( eHVLM_LadeartS, getValue( eHVLM_LadeartS ) - 1 );
}

on EnvVar eHVLM_LadeartDef
{
    putValue( eHVLM_LadeartS, 0 );
}

on EnvVar eHVLM_LadeartInc
{
    if( getValue( this ))  putValue( eHVLM_LadeartS, getValue( eHVLM_LadeartS ) + 1 );
}

on EnvVar eHVLM_Lademodus_HV_BatDec
{
    if( getValue( this ))  putValue( eHVLM_Lademodus_HV_BatS, getValue( eHVLM_Lademodus_HV_BatS ) - 1 );
}

on EnvVar eHVLM_Lademodus_HV_BatDef
{
    putValue( eHVLM_Lademodus_HV_BatS, 0 );
}

on EnvVar eHVLM_Lademodus_HV_BatInc
{
    if( getValue( this ))  putValue( eHVLM_Lademodus_HV_BatS, getValue( eHVLM_Lademodus_HV_BatS ) + 1 );
}

on EnvVar eHVLM_LadesystemhinweiseDec
{
    if( getValue( this ))  putValue( eHVLM_LadesystemhinweiseS, getValue( eHVLM_LadesystemhinweiseS ) - 1 );
}

on EnvVar eHVLM_LadesystemhinweiseDef
{
    putValue( eHVLM_LadesystemhinweiseS, 0 );
}

on EnvVar eHVLM_LadesystemhinweiseInc
{
    if( getValue( this ))  putValue( eHVLM_LadesystemhinweiseS, getValue( eHVLM_LadesystemhinweiseS ) + 1 );
}

on EnvVar eHVLM_Langzeit_LadenDec
{
    if( getValue( this ))  putValue( eHVLM_Langzeit_LadenS, getValue( eHVLM_Langzeit_LadenS ) - 1 );
}

on EnvVar eHVLM_Langzeit_LadenDef
{
    putValue( eHVLM_Langzeit_LadenS, 0 );
}

on EnvVar eHVLM_Langzeit_LadenInc
{
    if( getValue( this ))  putValue( eHVLM_Langzeit_LadenS, getValue( eHVLM_Langzeit_LadenS ) + 1 );
}

on EnvVar eHVLM_Restladezeit_HV_BatDec
{
    if( getValue( this ))  putValue( eHVLM_Restladezeit_HV_BatS, getValue( eHVLM_Restladezeit_HV_BatS ) - 5 );
}

on EnvVar eHVLM_Restladezeit_HV_BatDef
{
  //putValue( eHVLM_Restladezeit_HV_BatS, 635 );
    putValue( eHVLM_Restladezeit_HV_BatS, 2550 );
}

on EnvVar eHVLM_Restladezeit_HV_BatInc
{
    if( getValue( this ))  putValue( eHVLM_Restladezeit_HV_BatS, getValue( eHVLM_Restladezeit_HV_BatS ) + 5 );
}

on EnvVar eHVLM_Stecker_StatusDec
{
    if( getValue( this ))  putValue( eHVLM_Stecker_StatusS, getValue( eHVLM_Stecker_StatusS ) - 1 );
}

on EnvVar eHVLM_Stecker_StatusDef
{
    putValue( eHVLM_Stecker_StatusS, 0 );
}

on EnvVar eHVLM_Stecker_StatusInc
{
    if( getValue( this ))  putValue( eHVLM_Stecker_StatusS, getValue( eHVLM_Stecker_StatusS ) + 1 );
}

on EnvVar eMO_WaehlposDec
{
    if( getValue( this ))  putValue( eMO_WaehlposS, getValue( eMO_WaehlposS ) - 1 );
}

on EnvVar eMO_WaehlposDef
{
    putValue( eMO_WaehlposS, 0 );
}

on EnvVar eMO_WaehlposInc
{
    if( getValue( this ))  putValue( eMO_WaehlposS, getValue( eMO_WaehlposS ) + 1 );
}

on EnvVar eMO_ePowermeterDec
{
    if( getValue( this ))  putValue( eMO_ePowermeterS, getValue( eMO_ePowermeterS ) - (0.4) );
}

on EnvVar eMO_ePowermeterDef
{
    putValue( eMO_ePowermeterS, -0.4 );
}

on EnvVar eMO_ePowermeterInc
{
    if( getValue( this ))  putValue( eMO_ePowermeterS, getValue( eMO_ePowermeterS ) + (0.4) );
}

on EnvVar eLadezustand_02Dec
{
    if( getValue( this ))  putValue( eLadezustand_02S, getValue( eLadezustand_02S ) - 0.5 );
}

on EnvVar eLadezustand_02Def
{
    putValue( eLadezustand_02S, 127);
}

on EnvVar eLadezustand_02Inc
{
    if( getValue( this ))  putValue( eLadezustand_02S, getValue( eLadezustand_02S ) + 0.5 );
}

on EnvVar eEnrgfluss_StateDec
{
    if( getValue( this ))  putValue( eEnrgfluss_StateS, getValue( eEnrgfluss_StateS ) - 1 );
}

on EnvVar eEnrgfluss_StateDef
{
    putValue( eEnrgfluss_StateS, 0);
}

on EnvVar eEnrgfluss_StateInc
{
    if( getValue( this ))  putValue( eEnrgfluss_StateS, getValue( eEnrgfluss_StateS ) + 1 );
}

on EnvVar eMO_Powermeter_Elm_02Dec
{
    if( getValue( this ))  putValue( eMO_Powermeter_Elm_02S, getValue( eMO_Powermeter_Elm_02S ) - 0.05 );
}

on EnvVar eMO_Powermeter_Elm_02Def
{
    putValue( eMO_Powermeter_Elm_02S, 102.3);
}

on EnvVar eMO_Powermeter_Elm_02Inc
{
    if( getValue( this ))  putValue( eMO_Powermeter_Elm_02S, getValue( eMO_Powermeter_Elm_02S ) + 0.05 );
}

on EnvVar eMO_PowermeterDec
{
    if( getValue( this ))  putValue( eMO_PowermeterS, getValue( eMO_PowermeterS ) - 1 );
}

on EnvVar eMO_PowermeterDef
{
    putValue( eMO_PowermeterS, 4093);
}

on EnvVar eMO_PowermeterInc
{
    if( getValue( this ))  putValue( eMO_PowermeterS, getValue( eMO_PowermeterS ) + 1 );
}

on EnvVar eMO_Verbrauch_EM_GesDec
{
    if( getValue( this ))  putValue( eMO_Verbrauch_EM_GesS, getValue( eMO_Verbrauch_EM_GesS ) - 10 );
}

on EnvVar eMO_Verbrauch_EM_GesDef
{
    putValue( eMO_Verbrauch_EM_GesS, 0);
}

on EnvVar eMO_Verbrauch_EM_GesInc
{
    if( getValue( this ))  putValue( eMO_Verbrauch_EM_GesS, getValue( eMO_Verbrauch_EM_GesS ) + 10 );
}

on EnvVar eMO_Rekuperation_Ges_EMDec
{
    if( getValue( this ))  putValue( eMO_Rekuperation_Ges_EMS, getValue( eMO_Rekuperation_Ges_EMS ) - 10 );
}

on EnvVar eMO_Rekuperation_Ges_EMDef
{
    putValue( eMO_Rekuperation_Ges_EMS, 0);
}

on EnvVar eMO_Rekuperation_Ges_EMInc
{
    if( getValue( this ))  putValue( eMO_Rekuperation_Ges_EMS, getValue( eMO_Rekuperation_Ges_EMS ) + 10 );
}

on EnvVar eTReichweite_01Dec
{
    if( getValue( this ))  putValue( eTReichweite_01, dec( getValue( eTReichweite_01 ) ) );
}

on EnvVar eTReichweite_01Def
{
    putValue( eTReichweite_01, 1000 );
}

on EnvVar eTReichweite_01Inc
{
    if( getValue( this ))  putValue( eTReichweite_01, inc( getValue( eTReichweite_01 ) ) );
}

on EnvVar eTOTReichweite_01Dec
{
    if( getValue( this ))  putValue( eTOTReichweite_01, dec( getValue( eTOTReichweite_01 ) ) );
}

on EnvVar eTOTReichweite_01Def
{
    putValue( eTOTReichweite_01, 5000 );
}

on EnvVar eTOTReichweite_01Inc
{
    if( getValue( this ))  putValue( eTOTReichweite_01, inc( getValue( eTOTReichweite_01 ) ) );
}

on EnvVar eDlcReichweite_01Dec
{
    if( getValue( this ))  putValue( eDlcReichweite_01, getValue( eDlcReichweite_01 ) - 1 );
}

on EnvVar eDlcReichweite_01Def
{
    putValue( eDlcReichweite_01, 8 );
}

on EnvVar eDlcReichweite_01Inc
{
    if( getValue( this ))  putValue( eDlcReichweite_01, getValue( eDlcReichweite_01 ) + 1 );
}

on EnvVar eTReichweite_02Dec
{
    if( getValue( this ))  putValue( eTReichweite_02, dec( getValue( eTReichweite_02 ) ) );
}

on EnvVar eTReichweite_02Def
{
    putValue( eTReichweite_02, 1000 );
}

on EnvVar eTReichweite_02Inc
{
    if( getValue( this ))  putValue( eTReichweite_02, inc( getValue( eTReichweite_02 ) ) );
}

on EnvVar eTOTReichweite_02Dec
{
    if( getValue( this ))  putValue( eTOTReichweite_02, dec( getValue( eTOTReichweite_02 ) ) );
}

on EnvVar eTOTReichweite_02Def
{
    putValue( eTOTReichweite_02, 5000 );
}

on EnvVar eTOTReichweite_02Inc
{
    if( getValue( this ))  putValue( eTOTReichweite_02, inc( getValue( eTOTReichweite_02 ) ) );
}

on EnvVar eDlcReichweite_02Dec
{
    if( getValue( this ))  putValue( eDlcReichweite_02, getValue( eDlcReichweite_02 ) - 1 );
}

on EnvVar eDlcReichweite_02Def
{
    putValue( eDlcReichweite_02, 8 );
}

on EnvVar eDlcReichweite_02Inc
{
    if( getValue( this ))  putValue( eDlcReichweite_02, getValue( eDlcReichweite_02 ) + 1 );
}

on EnvVar eRW_RWDS_LastprofilDec
{
    if( getValue( this ))  putValue( eRW_RWDS_LastprofilS, getValue( eRW_RWDS_LastprofilS ) - 1);
}

on EnvVar eRW_RWDS_LastprofilDef
{
    putValue( eRW_RWDS_LastprofilS, 0);
}

on EnvVar eRW_RWDS_LastprofilInc
{
    if( getValue( this ))  putValue( eRW_RWDS_LastprofilS, getValue( eRW_RWDS_LastprofilS ) + 1 );
}

on EnvVar eRW_Prim_ReichweitenverbrauchDec
{
    if( getValue( this ))  putValue( eRW_Prim_ReichweitenverbrauchS, getValue( eRW_Prim_ReichweitenverbrauchS ) - 0.1);
}

on EnvVar eRW_Prim_ReichweitenverbrauchDef
{
    putValue( eRW_Prim_ReichweitenverbrauchS, 204.7);
}

on EnvVar eRW_Prim_ReichweitenverbrauchInc
{
    if( getValue( this ))  putValue( eRW_Prim_ReichweitenverbrauchS, getValue( eRW_Prim_ReichweitenverbrauchS ) +0.1 );
}

on EnvVar eRW_Prim_Reichweitenv_EinheitDec
{
    if( getValue( this ))  putValue( eRW_Prim_Reichweitenv_EinheitS, getValue( eRW_Prim_Reichweitenv_EinheitS ) -1);
}

on EnvVar eRW_Prim_Reichweitenv_EinheitDef
{
    putValue( eRW_Prim_Reichweitenv_EinheitS, 3);
}

on EnvVar eRW_Prim_Reichweitenv_EinheitInc
{
    if( getValue( this ))  putValue( eRW_Prim_Reichweitenv_EinheitS, getValue( eRW_Prim_Reichweitenv_EinheitS ) + 1);
}

on EnvVar eRW_Primaer_ReichweiteDec
{
    if( getValue( this ))  putValue( eRW_Primaer_ReichweiteS, getValue( eRW_Primaer_ReichweiteS ) -1);
}

on EnvVar eRW_Primaer_ReichweiteDef
{
    putValue( eRW_Primaer_ReichweiteS, 2046);
}

on EnvVar eRW_Primaer_ReichweiteInc
{
    if( getValue( this ))  putValue( eRW_Primaer_ReichweiteS, getValue( eRW_Primaer_ReichweiteS ) + 1);
}

on EnvVar eRW_Sekundaer_ReichweiteDec
{
    if( getValue( this ))  putValue( eRW_Sekundaer_ReichweiteS, getValue( eRW_Sekundaer_ReichweiteS ) -1);
}

on EnvVar eRW_Sekundaer_ReichweiteDef
{
    putValue( eRW_Sekundaer_ReichweiteS, 2046);
}

on EnvVar eRW_Sekundaer_ReichweiteInc
{
    if( getValue( this ))  putValue( eRW_Sekundaer_ReichweiteS, getValue( eRW_Sekundaer_ReichweiteS ) + 1);
}

on EnvVar eRW_Sek_Reichweitenv_EinheitDec
{
    if( getValue( this ))  putValue( eRW_Sek_Reichweitenv_EinheitS, getValue( eRW_Sek_Reichweitenv_EinheitS ) -1);
}

on EnvVar eRW_Sek_Reichweitenv_EinheitDef
{
    putValue( eRW_Sek_Reichweitenv_EinheitS, 3);
}

on EnvVar eRW_Sek_Reichweitenv_EinheitInc
{
    if( getValue( this ))  putValue( eRW_Sek_Reichweitenv_EinheitS, getValue( eRW_Sek_Reichweitenv_EinheitS ) + 1);
}

on EnvVar eRW_Sek_ReichweitenverbrauchDec
{
    if( getValue( this ))  putValue( eRW_Sek_ReichweitenverbrauchS, getValue( eRW_Sek_ReichweitenverbrauchS ) - 0.1);
}

on EnvVar eRW_Sek_ReichweitenverbrauchDef
{
    putValue( eRW_Sek_ReichweitenverbrauchS, 204.7);
}

on EnvVar eRW_Sek_ReichweitenverbrauchInc
{
    if( getValue( this ))  putValue( eRW_Sek_ReichweitenverbrauchS, getValue( eRW_Sek_ReichweitenverbrauchS ) + 0.1);
}

on EnvVar eRW_TexteDec
{
    if(( getValue( this )) && (getValue( eRW_TexteS ) > 0)) putValue( eRW_TexteS, getValue( eRW_TexteS ) -1);
}

on EnvVar eRW_TexteDef
{
    putValue( eRW_TexteS, 0);
}

on EnvVar eRW_TexteInc
{
    if(( getValue( this )) && (getValue( eRW_TexteS ) < 3)) putValue( eRW_TexteS, getValue( eRW_TexteS ) +1);
}

on EnvVar eTAGA_01Dec
{
    if( getValue( this ))  putValue( eTAGA_01, dec( getValue( eTAGA_01 ) ) );
}

on EnvVar eTAGA_01Def
{
    putValue( eTAGA_01, 1000 );
}

on EnvVar eTAGA_01Inc
{
    if( getValue( this ))  putValue( eTAGA_01, inc( getValue( eTAGA_01 ) ) );
}

on EnvVar eTOTAGA_01Dec
{
    if( getValue( this ))  putValue( eTOTAGA_01, dec( getValue( eTOTAGA_01 ) ) );
}

on EnvVar eTOTAGA_01Def
{
    putValue( eTOTAGA_01, 5000 );
}

on EnvVar eTOTAGA_01Inc
{
    if( getValue( this ))  putValue( eTOTAGA_01, inc( getValue( eTOTAGA_01 ) ) );
}

on EnvVar eDlcAGA_01Dec
{
    if( getValue( this ))  putValue( eDlcAGA_01, getValue( eDlcAGA_01 ) - 1 );
}

on EnvVar eDlcAGA_01Def
{
    putValue( eDlcAGA_01, 8 );
}

on EnvVar eDlcAGA_01Inc
{
    if( getValue( this ))  putValue( eDlcAGA_01, getValue( eDlcAGA_01 ) + 1 );
}

on EnvVar eTBMS_07Dec
{
    if( getValue( this ))  putValue( eTBMS_07, dec( getValue( eTBMS_07 ) ) );
}

on EnvVar eTBMS_07Def
{
    putValue( eTBMS_07, 500 );
}

on EnvVar eTBMS_07Inc
{
    if( getValue( this ))  putValue( eTBMS_07, inc( getValue( eTBMS_07 ) ) );
}

on EnvVar eTOTBMS_07Dec
{
    if( getValue( this ))  putValue( eTOTBMS_07, dec( getValue( eTOTBMS_07 ) ) );
}

on EnvVar eTOTBMS_07Def
{
    putValue( eTOTBMS_07, 5000 );
}

on EnvVar eTOTBMS_07Inc
{
    if( getValue( this ))  putValue( eTOTBMS_07, inc( getValue( eTOTBMS_07 ) ) );
}

on EnvVar eDlcBMS_07Dec
{
    if( getValue( this ))  putValue( eDlcBMS_07, getValue( eDlcBMS_07 ) - 1 );
}

on EnvVar eDlcBMS_07Def
{
    putValue( eDlcBMS_07, 8 );
}

on EnvVar eDlcBMS_07Inc
{
    if( getValue( this ))  putValue( eDlcBMS_07, getValue( eDlcBMS_07 ) + 1 );
}

on EnvVar eAGA_Charisma_FahrPrDec
{
    if( getValue( this ))  putValue( eAGA_Charisma_FahrPrS, getValue( eAGA_Charisma_FahrPrS ) - 1);
}

on EnvVar eAGA_Charisma_FahrPrDef
{
    putValue( eAGA_Charisma_FahrPrS, 0);
}

on EnvVar eAGA_Charisma_FahrPrInc
{
    if( getValue( this ))  putValue( eAGA_Charisma_FahrPrS, getValue( eAGA_Charisma_FahrPrS ) +1);
}

on EnvVar eAGA_Charisma_StatusDec
{
    if( getValue( this ))  putValue( eAGA_Charisma_StatusS, getValue( eAGA_Charisma_StatusS ) - 1);
}

on EnvVar eAGA_Charisma_StatusDef
{
    putValue( eAGA_Charisma_StatusS, 0);
}

on EnvVar eAGA_Charisma_StatusInc
{
    if( getValue( this ))  putValue( eAGA_Charisma_StatusS, getValue( eAGA_Charisma_StatusS ) +1);
}

on EnvVar eAGA_01_BZDec
{
    if( getValue( this ))  putValue( eAGA_01_BZS, getValue( eAGA_01_BZS ) - 1);
}

on EnvVar eAGA_01_BZDef
{
    putValue( eAGA_01_BZS, 0);
}

on EnvVar eAGA_01_BZInc
{
    if( getValue( this ))  putValue( eAGA_01_BZS, getValue( eAGA_01_BZS ) +1);
}

on EnvVar eBMS_07_BZDec
{
    if( getValue( this ))  putValue( eBMS_07_BZS, getValue( eBMS_07_BZS ) - 1);
}

on EnvVar eBMS_07_BZDef
{
    putValue( eBMS_07_BZS, 0);
}

on EnvVar eBMS_07_BZInc
{
    if( getValue( this ))  putValue( eBMS_07_BZS, getValue( eBMS_07_BZS ) +1);
}

on EnvVar eBMS_MaxEnergieinhaltDec
{
    if( getValue( this ))  putValue( eBMS_MaxEnergieinhaltS, getValue( eBMS_MaxEnergieinhaltS ) - 50);
}

on EnvVar eBMS_MaxEnergieinhaltDef
{
    putValue( eBMS_MaxEnergieinhaltS, 102300);
}

on EnvVar eBMS_MaxEnergieinhaltInc
{
    if( getValue( this ))  putValue( eBMS_MaxEnergieinhaltS, getValue( eBMS_MaxEnergieinhaltS ) + 50);
}

on EnvVar eBMS_Gesamtst_SpgfreiheitDec
{
    if( getValue( this ))  putValue( eBMS_Gesamtst_SpgfreiheitS, getValue( eBMS_Gesamtst_SpgfreiheitS ) - 1);
}

on EnvVar eBMS_Gesamtst_SpgfreiheitDef
{
    putValue( eBMS_Gesamtst_SpgfreiheitS, 0);
}

on EnvVar eBMS_Gesamtst_SpgfreiheitInc
{
    if( getValue( this ))  putValue( eBMS_Gesamtst_SpgfreiheitS, getValue( eBMS_Gesamtst_SpgfreiheitS ) + 1);
}

on EnvVar eEBKV_HinweiseDec
{
    if( getValue( this ))  putValue( eEBKV_HinweiseS, getValue( eEBKV_HinweiseS ) - 1);
}

on EnvVar eEBKV_HinweiseDef
{
    putValue( eEBKV_HinweiseS, 0);
}

on EnvVar eEBKV_HinweiseInc
{
    if( getValue( this ))  putValue( eEBKV_HinweiseS, getValue( eEBKV_HinweiseS ) + 1);
}

on EnvVar eEBKV_WarnungenDec
{
    if( getValue( this ))  putValue( eEBKV_WarnungenS, getValue( eEBKV_WarnungenS ) - 1);
}

on EnvVar eEBKV_WarnungenDef
{
    putValue( eEBKV_WarnungenS, 0);
}

on EnvVar eEBKV_WarnungenInc
{
    if( getValue( this ))  putValue( eEBKV_WarnungenS, getValue( eEBKV_WarnungenS ) + 1);
}

on EnvVar eBMS_07_DummyDec
{
    if( getValue( this ))  putValue( eBMS_07_DummyS, getValue( eBMS_07_DummyS ) - 1);
}

on EnvVar eBMS_07_DummyDef
{
    putValue( eBMS_07_DummyS, 0);
}

on EnvVar eBMS_07_DummyInc
{
    if( getValue( this ))  putValue( eBMS_07_DummyS, getValue( eBMS_07_DummyS ) + 1);
}

on EnvVar eTPLA_Status_02Dec
{
    if( getValue( this ))  putValue( eTPLA_Status_02, dec( getValue( eTPLA_Status_02 ) ) );
}

on EnvVar eTPLA_Status_02Def
{
    putValue( eTPLA_Status_02, 100 );
}

on EnvVar eTPLA_Status_02Inc
{
    if( getValue( this ))  putValue( eTPLA_Status_02, inc( getValue( eTPLA_Status_02 ) ) );
}

on EnvVar eTOTPLA_Status_02Dec
{
    if( getValue( this ))  putValue( eTOTPLA_Status_02, dec( getValue( eTOTPLA_Status_02 ) ) );
}

on EnvVar eTOTPLA_Status_02Def
{
    putValue( eTOTPLA_Status_02, 1000 );
}

on EnvVar eTOTPLA_Status_02Inc
{
    if( getValue( this ))  putValue( eTOTPLA_Status_02, inc( getValue( eTOTPLA_Status_02 ) ) );
}

on EnvVar eDlcPLA_Status_02Dec
{
    if( getValue( this ))  putValue( eDlcPLA_Status_02, getValue( eDlcPLA_Status_02 ) - 1 );
}

on EnvVar eDlcPLA_Status_02Def
{
    putValue( eDlcPLA_Status_02, 8 );
}

on EnvVar eDlcPLA_Status_02Inc
{
    if( getValue( this ))  putValue( eDlcPLA_Status_02, getValue( eDlcPLA_Status_02 ) + 1 );
}

on EnvVar eSMLS_01_BZDec
{
    if( getValue( this ))  putValue( eSMLS_01_BZS, getValue( eSMLS_01_BZS ) - 1 );
}

on EnvVar eSMLS_01_BZDef
{
    putValue( eSMLS_01_BZS, 0 );
}

on EnvVar eSMLS_01_BZInc
{
    if( getValue( this ))  putValue( eSMLS_01_BZS, getValue( eSMLS_01_BZS ) + 1 );
}

//MR53874
on EnvVar eTACC_13Dec
{
    if( getValue( this ))  putValue( eTACC_13, dec( getValue( eTACC_13 ) ) );
}

//MR53874
on EnvVar eTACC_13Def
{
    putValue( eTACC_13, 60 );
}

//MR53874
on EnvVar eTACC_13Inc
{
    if( getValue( this ))  putValue( eTACC_13, inc( getValue( eTACC_13 ) ) );
}

//MR53874
on EnvVar eTOTACC_13Dec
{
    if( getValue( this ))  putValue( eTOTACC_13, dec( getValue( eTOTACC_13 ) ) );
}

//MR53874
on EnvVar eTOTACC_13Def
{
    putValue( eTOTACC_13, 600 );
}

//MR53874
on EnvVar eTOTACC_13Inc
{
    if( getValue( this ))  putValue( eTOTACC_13, inc( getValue( eTOTACC_13 ) ) );
}

//MR53874
on EnvVar eDlcACC_13Dec
{
    if( getValue( this ))  putValue( eDlcACC_13, getValue( eDlcACC_13 ) - 1 );
}

//MR53874
on EnvVar eDlcACC_13Def
{
    putValue( eDlcACC_13, 8 );
}

//MR53874
on EnvVar eDlcACC_13Inc
{
    if( getValue( this ))  putValue( eDlcACC_13, getValue( eDlcACC_13 ) + 1 );
}

//MR53874
on EnvVar eTMotor_23Dec
{
    if( getValue( this ))  putValue( eTMotor_23, dec( getValue( eTMotor_23 ) ) );
}

//MR53874
on EnvVar eTMotor_23Def
{
    putValue( eTMotor_23, 50 );
}

//MR53874
on EnvVar eTOTMotor_23Dec
{
    if( getValue( this ))  putValue( eTOTMotor_23, dec( getValue( eTOTMotor_23 ) ) );
}

//MR53874
on EnvVar eTOTMotor_23Def
{
    putValue( eTOTMotor_23, 500 );
}

//MR53874
on EnvVar eDlcMotor_23Dec
{
    if( getValue( this ))  putValue( eDlcMotor_23, getValue( eDlcMotor_23 ) - 1 );
}

//MR53874
on EnvVar eDlcMotor_23Def
{
    putValue( eDlcMotor_23, 8 );
}

//MR53874
on EnvVar eTMotor_23Inc
{
    if( getValue( this ))  putValue( eTMotor_23, inc( getValue( eTMotor_23 ) ) );
}

//MR53874
on EnvVar eTOTMotor_23Inc
{
    if( getValue( this ))  putValue( eTOTMotor_23, inc( getValue( eTOTMotor_23 ) ) );
}

//MR53874
on EnvVar eDlcMotor_23Inc
{
    if( getValue( this ))  putValue( eDlcMotor_23, getValue( eDlcMotor_23 ) + 1 );
}

//MR53874
on EnvVar eAGW_Blinkfrequenz_absDec
{
    if( getValue( this ))  putValue( eAGW_Blinkfrequenz_absS, getValue( eAGW_Blinkfrequenz_absS ) - 0.5);
}

//MR53874
on EnvVar eAGW_Blinkfrequenz_absDef
{
    putValue( eAGW_Blinkfrequenz_absS, 0);
}

//MR53874
on EnvVar eAGW_Blinkfrequenz_absInc
{
    if( getValue( this ))  putValue( eAGW_Blinkfrequenz_absS, getValue( eAGW_Blinkfrequenz_absS ) + 0.5);
}

//MR53874
on EnvVar eAGW_Helligkeit_relDec
{
    if( getValue( this ))  putValue( eAGW_Helligkeit_relS, getValue( eAGW_Helligkeit_relS ) - 1);
}

//MR53874
on EnvVar eAGW_Helligkeit_relDef
{
    putValue( eAGW_Helligkeit_relS, 0);
}

//MR53874
on EnvVar eAGW_Helligkeit_relInc
{
    if( getValue( this ))  putValue( eAGW_Helligkeit_relS, getValue( eAGW_Helligkeit_relS ) + 1);
}

//MR53874
on EnvVar eACC_RegelgeschwDec
{
    if(( getValue( this ))  && getValue(KCAN_ACC_Regelgeschw_INT) > 0) putValue( KCAN_ACC_Regelgeschw_INT, getValue(KCAN_ACC_Regelgeschw_INT) - 1);
}

//MR53874
on EnvVar eACC_RegelgeschwDef
{
    putValue( KCAN_ACC_Regelgeschw_INT, 0);
}

//MR53874
on EnvVar eACC_RegelgeschwInc
{
    if(( getValue( this ))  && getValue(KCAN_ACC_Regelgeschw_INT) < 1023) putValue( KCAN_ACC_Regelgeschw_INT, getValue(KCAN_ACC_Regelgeschw_INT) + 1);
}

//MR53874
on EnvVar eACC_maxSetzgeschwDec
{
    if( getValue( this ))  putValue( eACC_maxSetzgeschwS, getValue( eACC_maxSetzgeschwS ) - 1);
}

//MR53874
on EnvVar eACC_maxSetzgeschwDef
{
    putValue( eACC_maxSetzgeschwS, 0);
}

//MR53874
on EnvVar eACC_maxSetzgeschwInc
{
    if( getValue( this ))  putValue( eACC_maxSetzgeschwS, getValue( eACC_maxSetzgeschwS ) + 1);
}

//MR53874
on EnvVar eACC_maxRegelgeschwDec
{
    if(( getValue( this ))  && getValue(KCAN_ACC_maxRegelgeschw_INT) > 0) putValue( KCAN_ACC_maxRegelgeschw_INT, getValue(KCAN_ACC_maxRegelgeschw_INT) - 1);
}

//MR53874
on EnvVar eACC_maxRegelgeschwDef
{
    putValue( KCAN_ACC_maxRegelgeschw_INT, 0);
}

//MR53874
on EnvVar eACC_maxRegelgeschwInc
{
    if(( getValue( this ))  && getValue(KCAN_ACC_maxRegelgeschw_INT) < 255) putValue( KCAN_ACC_maxRegelgeschw_INT, getValue(KCAN_ACC_maxRegelgeschw_INT) + 1);
}

//MR53874
on EnvVar eACC_minRegelgeschwDec
{
    if(( getValue( this ))  && getValue(KCAN_ACC_minRegelgeschw_INT) > 0) putValue( KCAN_ACC_minRegelgeschw_INT, getValue(KCAN_ACC_minRegelgeschw_INT) - 1);
}

//MR53874
on EnvVar eACC_minRegelgeschwDef
{
    putValue( KCAN_ACC_minRegelgeschw_INT, 0);
}

//MR53874
on EnvVar eACC_minRegelgeschwInc
{
    if(( getValue( this ))  && getValue(KCAN_ACC_minRegelgeschw_INT) < 255) putValue( KCAN_ACC_minRegelgeschw_INT, getValue(KCAN_ACC_minRegelgeschw_INT) + 1);
}

//MR53874
on EnvVar eACC_KurvenassistentDec
{
    if( getValue( this ))  putValue( eACC_KurvenassistentS, getValue( eACC_KurvenassistentS ) - 1);
}

//MR53874
on EnvVar eACC_KurvenassistentDef
{
    putValue( eACC_KurvenassistentS, 0);
}

//MR53874
on EnvVar eACC_KurvenassistentInc
{
    if( getValue( this ))  putValue( eACC_KurvenassistentS, getValue( eACC_KurvenassistentS ) + 1);
}

//MR53874
//GVJ-4663
/*
on EnvVar eACC_TempolimitassistentDec
{
    if( getValue( this ))  putValue( eACC_TempolimitassistentS, getValue( eACC_TempolimitassistentS ) - 1);
}

//MR53874
on EnvVar eACC_TempolimitassistentDef
{
    putValue( eACC_TempolimitassistentS, 0);
}

//MR53874
on EnvVar eACC_TempolimitassistentInc
{
    if( getValue( this ))  putValue( eACC_TempolimitassistentS, getValue( eACC_TempolimitassistentS ) + 1);
}
*/

//MR53874
on EnvVar eACC_RUVDec
{
    if( getValue( this ))  putValue( eACC_RUVS, getValue( eACC_RUVS ) - 1);
}

//MR53874
on EnvVar eACC_RUVDef
{
    putValue( eACC_RUVS, 0);
}

//MR53874
on EnvVar eACC_RUVInc
{
    if( getValue( this ))  putValue( eACC_RUVS, getValue( eACC_RUVS ) + 1);
}

//MR53874
on EnvVar eMO_Antriebsstrang_Warnung_HSDec
{
    if( getValue( this ))  putValue( eMO_Antriebsstrang_Warnung_HSS, getValue( eMO_Antriebsstrang_Warnung_HSS ) - 1);
}

//MR53874
on EnvVar eMO_Antriebsstrang_Warnung_HSDef
{
    putValue( eMO_Antriebsstrang_Warnung_HSS, 0);
}

//MR53874
on EnvVar eMO_Antriebsstrang_Warnung_HSInc
{
    if( getValue( this ))  putValue( eMO_Antriebsstrang_Warnung_HSS, getValue( eMO_Antriebsstrang_Warnung_HSS ) + 1);
}

//MR53874
on EnvVar eDC_VerbrauchDec
{
    if( getValue( this ))  putValue( eDC_VerbrauchS, getValue( eDC_VerbrauchS ) - 1);
}

//MR53874
on EnvVar eDC_VerbrauchDef
{
    putValue( eDC_VerbrauchS, 0);
}

//MR53874
on EnvVar eDC_VerbrauchInc
{
    if( getValue( this ))  putValue( eDC_VerbrauchS, getValue( eDC_VerbrauchS ) + 1);
}

//MR53874
on EnvVar eDC_HYB_iAktLVDec
{
    if( getValue( this ))  putValue( eDC_HYB_iAktLVS, getValue( eDC_HYB_iAktLVS ) - 1);
}

//MR53874
on EnvVar eDC_HYB_iAktLVDef
{
    putValue( eDC_HYB_iAktLVS, -511);
}

//MR53874
on EnvVar eDC_HYB_iAktLVInc
{
    if( getValue( this ))  putValue( eDC_HYB_iAktLVS, getValue( eDC_HYB_iAktLVS ) + 1);
}

//MR53874
on EnvVar eDC_HYB_iAktReserveLVDec
{
    if( getValue( this ))  putValue( eDC_HYB_iAktReserveLVS, getValue( eDC_HYB_iAktReserveLVS ) - 1);
}

//MR53874
on EnvVar eDC_HYB_iAktReserveLVDef
{
    putValue( eDC_HYB_iAktReserveLVS, -511);
}

//MR53874
on EnvVar eDC_HYB_iAktReserveLVInc
{
    if( getValue( this ))  putValue( eDC_HYB_iAktReserveLVS, getValue( eDC_HYB_iAktReserveLVS ) + 1);
}

//MR53874
on EnvVar eDC_IstStrom_HV_02Dec
{
    if( getValue( this ))  putValue( eDC_IstStrom_HV_02S, getValue( eDC_IstStrom_HV_02S ) - 0.4);
}

//MR53874
on EnvVar eDC_IstStrom_HV_02Def
{
    putValue( eDC_IstStrom_HV_02S, -204);
}

//MR53874
on EnvVar eDC_IstStrom_HV_02Inc
{
    if( getValue( this ))  putValue( eDC_IstStrom_HV_02S, getValue( eDC_IstStrom_HV_02S ) + 0.4);
}

//MR53874
on EnvVar eDC_HYB_uAktLVDec
{
    if( getValue( this ))  putValue( eDC_HYB_uAktLVS, getValue( eDC_HYB_uAktLVS ) - 0.1);
}

//MR53874
on EnvVar eDC_HYB_uAktLVDef
{
    putValue( eDC_HYB_uAktLVS, 0);
}

//MR53874
on EnvVar eDC_HYB_uAktLVInc
{
    if( getValue( this ))  putValue( eDC_HYB_uAktLVS, getValue( eDC_HYB_uAktLVS ) + 0.1);
}

//MR53874
on EnvVar eDC_HYB_AuslastungsgradDec
{
    if( getValue( this ))  putValue( eDC_HYB_AuslastungsgradS, getValue( eDC_HYB_AuslastungsgradS ) - 0.4);
}

//MR53874
on EnvVar eDC_HYB_AuslastungsgradDef
{
    putValue( eDC_HYB_AuslastungsgradS, 0);
}

//MR53874
on EnvVar eDC_HYB_AuslastungsgradInc
{
    if( getValue( this ))  putValue( eDC_HYB_AuslastungsgradS, getValue( eDC_HYB_AuslastungsgradS ) + 0.4);
}

//MR53874
on EnvVar eMO_Zust_AntriebDec
{
    if( getValue( this ))  putValue( eMO_Zust_AntriebS, getValue( eMO_Zust_AntriebS ) - 1);
}

//MR53874
on EnvVar eMO_Zust_AntriebDef
{
    putValue( eMO_Zust_AntriebS, 0);
}

//MR53874
on EnvVar eMO_Zust_AntriebInc
{
    if( getValue( this ))  putValue( eMO_Zust_AntriebS, getValue( eMO_Zust_AntriebS ) + 1);
}

//MR53874
on EnvVar eARA_Knickwinkel_SollDec
{
    if( getValue( this ))  putValue( eARA_Knickwinkel_SollS, getValue( eARA_Knickwinkel_SollS ) - 1);
}

//MR53874
on EnvVar eARA_Knickwinkel_SollDef
{
    putValue( eARA_Knickwinkel_SollS, -125);
}

//MR53874
on EnvVar eARA_Knickwinkel_SollInc
{
    if( getValue( this ))  putValue( eARA_Knickwinkel_SollS, getValue( eARA_Knickwinkel_SollS ) + 1);
}

//MR53874
on EnvVar eARA_Knickwinkel_IstDec
{
    if( getValue( this ))  putValue( eARA_Knickwinkel_IstS, getValue( eARA_Knickwinkel_IstS ) - 1);
}

//MR53874
on EnvVar eARA_Knickwinkel_IstDef
{
    putValue( eARA_Knickwinkel_IstS, -125);
}

//MR53874
on EnvVar eARA_Knickwinkel_IstInc
{
    if( getValue( this ))  putValue( eARA_Knickwinkel_IstS, getValue( eARA_Knickwinkel_IstS ) + 1);
}

//MR53874
on EnvVar eARA_Knickwinkel_MaxDec
{
    if( getValue( this ))  putValue( eARA_Knickwinkel_MaxS, getValue( eARA_Knickwinkel_MaxS ) - 1);
}

//MR53874
on EnvVar eARA_Knickwinkel_MaxDef
{
    putValue( eARA_Knickwinkel_MaxS, 0);
}

//MR53874
on EnvVar eARA_Knickwinkel_MaxInc
{
    if( getValue( this ))  putValue( eARA_Knickwinkel_MaxS, getValue( eARA_Knickwinkel_MaxS ) + 1);
}

//MR53874
on EnvVar eARA_TexteDec
{
    if( getValue( this ))  putValue( eARA_TexteS, getValue( eARA_TexteS ) - 1);
}

//MR53874
on EnvVar eARA_TexteDef
{
    putValue( eARA_TexteS, 0);
}

//MR53874
on EnvVar eARA_TexteInc
{
    if( getValue( this ))  putValue( eARA_TexteS, getValue( eARA_TexteS ) + 1);
}

//MR53874
on EnvVar eARA_Knickwinkel_KomfortDec
{
    if( getValue( this ))  putValue( eARA_Knickwinkel_KomfortS, getValue( eARA_Knickwinkel_KomfortS ) - 1);
}

//MR53874
on EnvVar eARA_Knickwinkel_KomfortDef
{
    putValue( eARA_Knickwinkel_KomfortS, 0);
}

//MR53874
on EnvVar eARA_Knickwinkel_KomfortInc
{
    if( getValue( this ))  putValue( eARA_Knickwinkel_KomfortS, getValue( eARA_Knickwinkel_KomfortS ) + 1);
}

//MR53874
on EnvVar eARA_StatusDec
{
    if( getValue( this ))  putValue( eARA_StatusS, getValue( eARA_StatusS ) - 1);
}

on EnvVar eARA_StatusDef
{
    putValue( eARA_StatusS, 0);
}

on EnvVar eARA_StatusInc
{
    if( getValue( this ))  putValue( eARA_StatusS, getValue( eARA_StatusS ) + 1);
}

on EnvVar eESP_HDC_RegelgeschwDec
{
    if( getValue( this ))  putValue( eESP_HDC_RegelgeschwS, getValue( eESP_HDC_RegelgeschwS ) - 0.32);
}

//MR53874
on EnvVar eESP_HDC_RegelgeschwDef
{
    putValue( eESP_HDC_RegelgeschwS, 40.32);
}

//MR53874
on EnvVar eESP_HDC_RegelgeschwInc
{
    if( getValue( this ))  putValue( eESP_HDC_RegelgeschwS, getValue( eESP_HDC_RegelgeschwS ) + 0.32);
}

//MR53874
on EnvVar eTSK_Limiter_FahrerinfoDec
{
    if( getValue( this ))  putValue( eTSK_Limiter_FahrerinfoS, getValue( eTSK_Limiter_FahrerinfoS ) - 1);
}

//MR53874
on EnvVar eTSK_Limiter_FahrerinfoDef
{
    putValue( eTSK_Limiter_FahrerinfoS, 0);
}

//MR53874
on EnvVar eTSK_Limiter_FahrerinfoInc
{
    if( getValue( this ))  putValue( eTSK_Limiter_FahrerinfoS, getValue( eTSK_Limiter_FahrerinfoS ) + 1);
}

//MR53874
on EnvVar eACC_Texte_SekundaeranzDec
{
    if( getValue( this ))  putValue( eACC_Texte_SekundaeranzS, getValue( eACC_Texte_SekundaeranzS ) - 1);
}

//MR53874
on EnvVar eACC_Texte_SekundaeranzDef
{
    putValue( eACC_Texte_SekundaeranzS, 0);
}

//MR53874
on EnvVar eACC_Texte_SekundaeranzInc
{
    if( getValue( this ))  putValue( eACC_Texte_SekundaeranzS, getValue( eACC_Texte_SekundaeranzS ) + 1);
}

//MR53874
on EnvVar eACC_TempolimitDec
{
    if( getValue( this ))  putValue( eACC_TempolimitS, getValue( eACC_TempolimitS ) - 1);
}

//MR53874
on EnvVar eACC_TempolimitDef
{
    putValue( eACC_TempolimitS, 0);
}

//MR53874
on EnvVar eACC_TempolimitInc
{
    if( getValue( this ))  putValue( eACC_TempolimitS, getValue( eACC_TempolimitS ) + 1);
}

//MR53874
on EnvVar eCHA_Offroad_LEDDec
{
    if( getValue( this ))  putValue( eCHA_Offroad_LEDS, getValue( eCHA_Offroad_LEDS ) - 1);
}

//MR53874
on EnvVar eCHA_Offroad_LEDDef
{
    putValue( eCHA_Offroad_LEDS, 0);
}

//MR53874
on EnvVar eCHA_Offroad_LEDInc
{
    if( getValue( this ))  putValue( eCHA_Offroad_LEDS, getValue( eCHA_Offroad_LEDS ) + 1);
}

//MR53874
on EnvVar ePH_StoermeldungDec
{
    if( getValue( this ))  putValue( ePH_StoermeldungS, getValue( ePH_StoermeldungS ) - 1);
}

//MR53874
on EnvVar ePH_StoermeldungDef
{
    putValue( ePH_StoermeldungS, 0);
}

//MR53874
on EnvVar ePH_StoermeldungInc
{
    if( getValue( this ))  putValue( ePH_StoermeldungS, getValue( ePH_StoermeldungS ) + 1);
}

//MR53874
on EnvVar ePLA_Mini_ModusDec
{
    if( getValue( this ))  putValue( ePLA_Mini_ModusS, getValue( ePLA_Mini_ModusS ) - 1);
}

//MR53874
on EnvVar ePLA_Mini_ModusDef
{
    putValue( ePLA_Mini_ModusS, 0);
}

//MR53874
on EnvVar ePLA_Mini_ModusInc
{
    if( getValue( this ))  putValue( ePLA_Mini_ModusS, getValue( ePLA_Mini_ModusS ) + 1);
}

//MR53874
on EnvVar eMO_StartStopp_PopUpDec
{
    if( getValue( this ))  putValue( eMO_StartStopp_PopUpS, getValue( eMO_StartStopp_PopUpS ) - 1);
}

//MR53874
on EnvVar eMO_StartStopp_PopUpDef
{
    putValue( eMO_StartStopp_PopUpS, 0);
}

//MR53874
on EnvVar eMO_StartStopp_PopUpInc
{
    if( getValue( this ))  putValue( eMO_StartStopp_PopUpS, getValue( eMO_StartStopp_PopUpS ) + 1);
}

//MR53874
on EnvVar eMO_FahrzeugtypDec
{
    if( getValue( this ))  putValue( eMO_FahrzeugtypS, getValue( eMO_FahrzeugtypS ) - 1);
}

//MR53874
on EnvVar eMO_FahrzeugtypDef
{
    putValue( eMO_FahrzeugtypS, 0);
}

//MR53874
on EnvVar eMO_FahrzeugtypInc
{
    if( getValue( this ))  putValue( eMO_FahrzeugtypS, getValue( eMO_FahrzeugtypS ) + 1);
}

//MR53874
on EnvVar eAGA_TexteDec
{
    if( getValue( this ))  putValue( eAGA_TexteS, getValue( eAGA_TexteS ) - 1);
}

//MR53874
on EnvVar eAGA_TexteDef
{
    putValue( eAGA_TexteS, 0);
}

//MR53874
on EnvVar eAGA_TexteInc
{
    if( getValue( this ))  putValue( eAGA_TexteS, getValue( eAGA_TexteS ) + 1);
}

on EnvVar eMO_ePerformanceDec
{
    if( getValue( this ))  putValue( eMO_ePerformanceS, getValue( eMO_ePerformanceS ) - (0.4));
}

on EnvVar eMO_ePerformanceDef
{
    putValue( eMO_ePerformanceS, -0.4);
}

on EnvVar eMO_ePerformanceInc
{
    if( getValue( this ))  putValue( eMO_ePerformanceS, getValue( eMO_ePerformanceS ) + (0.4));
}




on EnvVar eHeckradar_KombitexteDec
{
    if( getValue( this ))  putValue( eHeckradar_KombitexteS, getValue( eHeckradar_KombitexteS ) -1);
}

on EnvVar eHeckradar_KombitexteDef
{
    putValue( eHeckradar_KombitexteS, 0);
}

on EnvVar eHeckradar_KombitexteInc
{
    if( getValue( this ))  putValue( eHeckradar_KombitexteS, getValue( eHeckradar_KombitexteS ) + 1);
}

on EnvVar eRCTA_KombitexteDec
{
    if( getValue( this ))  putValue( eRCTA_KombitexteS, getValue( eRCTA_KombitexteS ) -1);
}

on EnvVar eRCTA_KombitexteDef
{
    putValue( eRCTA_KombitexteS, 0);
}

on EnvVar eRCTA_KombitexteInc
{
    if( getValue( this ))  putValue( eRCTA_KombitexteS, getValue( eRCTA_KombitexteS ) + 1);
}

// MR 56253
on EnvVar eARA_Knickwinkel_konfidenzDec
{
    if( getValue( this ))  putValue( eARA_Knickwinkel_konfidenzS, getValue( eARA_Knickwinkel_konfidenzS ) - 1);
}

// MR 56253
on EnvVar eARA_Knickwinkel_konfidenzDef
{
    putValue( eARA_Knickwinkel_konfidenzS, 126);
}

// MR 56253
on EnvVar eARA_Knickwinkel_konfidenzInc
{
    if( getValue( this ))  putValue( eARA_Knickwinkel_konfidenzS, getValue( eARA_Knickwinkel_konfidenzS ) + 1);
}

//IssueList #205
on EnvVar eMO_EPCLDec
{
    if( getValue( this ))  putValue( eMO_EPCLS, getValue( eMO_EPCLS ) - 1);
}

//IssueList #205
on EnvVar eMO_EPCLDef
{
    putValue( eMO_EPCLS, 0);
}

//IssueList #205
on EnvVar eMO_EPCLInc
{
    if( getValue( this ))  putValue( eMO_EPCLS, getValue( eMO_EPCLS ) + 1);
}

//IssueList #205
on EnvVar eMO_Zust_BetriebsstrategieDec
{
    if( getValue( this ))  putValue( eMO_Zust_BetriebsstrategieS, getValue( eMO_Zust_BetriebsstrategieS ) - 1);
}

//IssueList #205
on EnvVar eMO_Zust_BetriebsstrategieDef
{
    putValue( eMO_Zust_BetriebsstrategieS, 0);
}

//IssueList #205
on EnvVar eMO_Zust_BetriebsstrategieInc
{
    if( getValue( this ))  putValue( eMO_Zust_BetriebsstrategieS, getValue( eMO_Zust_BetriebsstrategieS ) + 1);
}

//IssueList #205
on EnvVar eACC_ENG_TexteDec
{
    if( getValue( this ))  putValue( eACC_ENG_TexteS, getValue( eACC_ENG_TexteS ) - 1);
}

//IssueList #205
on EnvVar eACC_ENG_TexteDef
{
    putValue( eACC_ENG_TexteS, 0);
}

//IssueList #205
on EnvVar eACC_ENG_TexteInc
{
    if( getValue( this ))  putValue( eACC_ENG_TexteS, getValue( eACC_ENG_TexteS ) + 1);
}

//MR 57547
on EnvVar eMO_WH_TexteDec
{
    if( getValue( this ))  putValue( eMO_WH_TexteS, getValue( eMO_WH_TexteS ) - 1);
}

//MR 57547
on EnvVar eMO_WH_TexteDef
{
    putValue( eMO_WH_TexteS, 0);
}

//MR 57547
on EnvVar eMO_WH_TexteInc
{
    if( getValue( this ))  putValue( eMO_WH_TexteS, getValue( eMO_WH_TexteS ) + 1);
}

//MR57568
on EnvVar eTMotor_36Dec
{
    if( getValue( this ))  putValue( eTMotor_36, dec( getValue( eTMotor_36 ) ) );
}

//MR57568
on EnvVar eTMotor_36Def
{
    putValue( eTMotor_36, 1000);
}

//MR57568
on EnvVar eTMotor_36Inc
{
    if( getValue( this ))  putValue( eTMotor_36, inc( getValue( eTMotor_36 ) ) );
}

//MR57568
on EnvVar eTOTMotor_36Dec
{
    if( getValue( this ))  putValue( eTOTMotor_36, dec( getValue( eTOTMotor_36 ) ) );
}

//MR57568
on EnvVar eTOTMotor_36Def
{
    putValue( eTOTMotor_36, 5000 );
}

//MR57568
on EnvVar eTOTMotor_36Inc
{
    if( getValue( this ))  putValue( eTOTMotor_36, inc( getValue( eTOTMotor_36 ) ) );
}

//MR57568
on EnvVar eDlcMotor_36Dec
{
    if( getValue( this ))  putValue( eDlcMotor_36, getValue( eDlcMotor_36 ) - 1 );
}

//MR57568
on EnvVar eDlcMotor_36Def
{
    putValue( eDlcMotor_36, 8 );
}

//MR57568
on EnvVar eDlcMotor_36Inc
{
    if( getValue( this ))  putValue( eDlcMotor_36, getValue( eDlcMotor_36 ) + 1 );
}

//MR57568
on EnvVar eSCR_ZustandDec
{
    if( getValue( this ))  putValue( eSCR_ZustandS, getValue( eSCR_ZustandS ) - 1);
}

//MR57568
on EnvVar eSCR_ZustandDef
{
    putValue( eSCR_ZustandS, 0);
}

//MR57568
on EnvVar eSCR_ZustandInc
{
    if( getValue( this ))  putValue( eSCR_ZustandS, getValue( eSCR_ZustandS ) + 1);
}

//MR57568
on EnvVar eSCR_Nachfuellmenge_minDec
{
    if( getValue( this ))  putValue( eSCR_Nachfuellmenge_minS, getValue( eSCR_Nachfuellmenge_minS ) - 0.25);
}

//MR57568
on EnvVar eSCR_Nachfuellmenge_minDef
{
    putValue( eSCR_Nachfuellmenge_minS, 31.75);
}

//MR57568
on EnvVar eSCR_Nachfuellmenge_minInc
{
    if( getValue( this ))  putValue( eSCR_Nachfuellmenge_minS, getValue( eSCR_Nachfuellmenge_minS ) + 0.25);
}

//MR57568
on EnvVar eSCR_Nachfuellmenge_maxDec
{
    if( getValue( this ))  putValue( eSCR_Nachfuellmenge_maxS, getValue( eSCR_Nachfuellmenge_maxS ) - 0.25);
}

//MR57568
on EnvVar eSCR_Nachfuellmenge_maxDef
{
    putValue( eSCR_Nachfuellmenge_maxS, 63.75);
}

//MR57568
on EnvVar eSCR_Nachfuellmenge_maxInc
{
    if( getValue( this ))  putValue( eSCR_Nachfuellmenge_maxS, getValue( eSCR_Nachfuellmenge_maxS ) + 0.25);
}

//MR57568
on EnvVar eSCR_Nachfuellmenge_EinheitDec
{
    if( getValue( this ))  putValue( eSCR_Nachfuellmenge_EinheitS, getValue( eSCR_Nachfuellmenge_EinheitS ) - 1);
}

//MR57568
on EnvVar eSCR_Nachfuellmenge_EinheitDef
{
    putValue( eSCR_Nachfuellmenge_EinheitS, 0);
}

//MR57568
on EnvVar eSCR_Nachfuellmenge_EinheitInc
{
    if( getValue( this ))  putValue( eSCR_Nachfuellmenge_EinheitS, getValue( eSCR_Nachfuellmenge_EinheitS ) + 1);
}

//MR57568
on EnvVar eSCR_TankvolumenDec
{
    if( getValue( this ))  putValue( eSCR_TankvolumenS, getValue( eSCR_TankvolumenS ) - 1);
}

//MR57568
on EnvVar eSCR_TankvolumenDef
{
    putValue( eSCR_TankvolumenS, 0);
}

//MR57568
on EnvVar eSCR_TankvolumenInc
{
    if( getValue( this ))  putValue( eSCR_TankvolumenS, getValue( eSCR_TankvolumenS ) + 1);
}

//MR57568
on EnvVar eSCR_FuellstandDec
{
    if( getValue( this ))  putValue( eSCR_FuellstandS, getValue( eSCR_FuellstandS ) - 1);
}

//MR57568
on EnvVar eSCR_FuellstandDef
{
    putValue( eSCR_FuellstandS, 127);
}

//MR57568
on EnvVar eSCR_FuellstandInc
{
    if( getValue( this ))  putValue( eSCR_FuellstandS, getValue( eSCR_FuellstandS ) + 1);
}

//MR57568
on EnvVar eSCR_RestreichweiteDec
{
    if( getValue( this ))  putValue( eSCR_RestreichweiteS, getValue( eSCR_RestreichweiteS ) - 1);
}

//MR57568
on EnvVar eSCR_RestreichweiteDef
{
    putValue( eSCR_RestreichweiteS, 0);
}

//MR57568
on EnvVar eSCR_RestreichweiteInc
{
    if( getValue( this ))  putValue( eSCR_RestreichweiteS, getValue( eSCR_RestreichweiteS ) + 1);
}

//MR58905
on EnvVar eMO_Anzeige_BetriebsmodusDec
{
    if( getValue( this ))  putValue( eMO_Anzeige_BetriebsmodusS, getValue( eMO_Anzeige_BetriebsmodusS ) - 1);
}

//MR58905
on EnvVar eMO_Anzeige_BetriebsmodusDef
{
    putValue( eMO_Anzeige_BetriebsmodusS, 0);
}

//MR58905
on EnvVar eMO_Anzeige_BetriebsmodusInc
{
    if( getValue( this ))  putValue( eMO_Anzeige_BetriebsmodusS, getValue( eMO_Anzeige_BetriebsmodusS ) + 1);
}

//MR59661
on EnvVar eMO_EFLEX_LampeDec
{
    if( getValue( this ))  putValue( eMO_EFLEX_LampeS, getValue( eMO_EFLEX_LampeS ) - 1);
}

//MR59661
on EnvVar eMO_EFLEX_LampeDef
{
    putValue( eMO_EFLEX_LampeS, 0);
}

//MR59661
on EnvVar eMO_EFLEX_LampeInc
{
    if( getValue( this ))  putValue( eMO_EFLEX_LampeS, getValue( eMO_EFLEX_LampeS ) + 1);
}

//MR59661
on EnvVar eCHA_Kombi_Texte_02Dec
{
    if( getValue( this ))  putValue( eCHA_Kombi_Texte_02S, getValue( eCHA_Kombi_Texte_02S ) - 1);
}

//MR59661
on EnvVar eCHA_Kombi_Texte_02Def
{
    putValue( eCHA_Kombi_Texte_02S, 0);
}

//MR59661
on EnvVar eCHA_Kombi_Texte_02Inc
{
    if( getValue( this ))  putValue( eCHA_Kombi_Texte_02S, getValue( eCHA_Kombi_Texte_02S ) + 1);
}

//MR59661
on EnvVar eMo_Powermeter_GrenzeDec
{
    if( getValue( this ))  putValue( eMo_Powermeter_GrenzeS, getValue( eMo_Powermeter_GrenzeS ) - 1);
}

//MR59661
on EnvVar eMo_Powermeter_GrenzeDef
{
    putValue( eMo_Powermeter_GrenzeS, 4093);
}

//MR59661
on EnvVar eMo_Powermeter_GrenzeInc
{
    if( getValue( this ))  putValue( eMo_Powermeter_GrenzeS, getValue( eMo_Powermeter_GrenzeS ) + 1);
}

//MR59661
on EnvVar eMO_Powermeter_Charge_GrenzeDec
{
    if( getValue( this ))  putValue( eMO_Powermeter_Charge_GrenzeS, getValue( eMO_Powermeter_Charge_GrenzeS ) - 1);
}

//MR59661
on EnvVar eMO_Powermeter_Charge_GrenzeDef
{
    putValue( eMO_Powermeter_Charge_GrenzeS, 1022);
}

//MR59661
on EnvVar eMO_Powermeter_Charge_GrenzeInc
{
    if( getValue( this ))  putValue( eMO_Powermeter_Charge_GrenzeS, getValue( eMO_Powermeter_Charge_GrenzeS ) + 1);
}

//MR59661
on EnvVar eMO_Powermeter_Grenze_strategischDec
{
    if( getValue( this ))  putValue( eMO_Powermeter_Grenze_strategischS, getValue( eMO_Powermeter_Grenze_strategischS ) - 1);
}

//MR59661
on EnvVar eMO_Powermeter_Grenze_strategischDef
{
    putValue( eMO_Powermeter_Grenze_strategischS, 4094);
}

//MR59661
on EnvVar eMO_Powermeter_Grenze_strategischInc
{
    if( getValue( this ))  putValue( eMO_Powermeter_Grenze_strategischS, getValue( eMO_Powermeter_Grenze_strategischS ) + 1);
}

//MR59661
on EnvVar eMO_Powermeter_untere_E_GrenzeDec
{
    if( getValue( this ))  putValue( eMO_Powermeter_untere_E_GrenzeS, getValue( eMO_Powermeter_untere_E_GrenzeS ) - 1);
}

//MR59661
on EnvVar eMO_Powermeter_untere_E_GrenzeDef
{
    putValue( eMO_Powermeter_untere_E_GrenzeS, 4094);
}

//MR59661
on EnvVar eMO_Powermeter_untere_E_GrenzeInc
{
    if( getValue( this ))  putValue( eMO_Powermeter_untere_E_GrenzeS, getValue( eMO_Powermeter_untere_E_GrenzeS ) + 1);
}

//MR59661
on EnvVar eMO_Powermeter_obere_E_GrenzeDec
{
    if( getValue( this ))  putValue( eMO_Powermeter_obere_E_GrenzeS, getValue( eMO_Powermeter_obere_E_GrenzeS ) - 1);
}

//MR59661
on EnvVar eMO_Powermeter_obere_E_GrenzeDef
{
    putValue( eMO_Powermeter_obere_E_GrenzeS, 4094);
}

//MR59661
on EnvVar eMO_Powermeter_obere_E_GrenzeInc
{
    if( getValue( this ))  putValue( eMO_Powermeter_obere_E_GrenzeS, getValue( eMO_Powermeter_obere_E_GrenzeS ) + 1);
}

//MR 63119

on EnvVar eTGateway_71Dec
{
    if( getValue( this ))  putValue( eTGateway_71, dec( getValue( eTGateway_71 ) ) );
}

//MR 63119
on EnvVar eTGateway_71Def
{
    putValue( eTGateway_71,100 );
}

//MR 63119
on EnvVar eTGateway_71Inc
{
    if( getValue( this ))  putValue( eTGateway_71, inc( getValue( eTGateway_71 ) ) );
}

//MR 63119
on EnvVar eTOTGateway_71Dec
{
    if( getValue( this ))  putValue( eTOTGateway_71, dec( getValue( eTOTGateway_71 ) ) );
}

//MR 63119
on EnvVar eTOTGateway_71Def
{
    putValue( eTOTGateway_71, 1000 );
}

//MR 63119
on EnvVar eTOTGateway_71Inc
{
    if( getValue( this ))  putValue( eTOTGateway_71, inc( getValue( eTOTGateway_71 ) ) );
}

//MR 63119
on EnvVar eDlcGateway_71Dec
{
    if( getValue( this ))  putValue( eDlcGateway_71, getValue( eDlcGateway_71 ) - 1 );
}

//MR 63119
on EnvVar eDlcGateway_71Def
{
    putValue( eDlcGateway_71, 8 );
}

//MR 63119
on EnvVar eDlcGateway_71Inc
{
    if( getValue( this ))  putValue( eDlcGateway_71, getValue( eDlcGateway_71 ) + 1 );
}

//MR 63119
on EnvVar eTMotor_29Dec
{
    if( getValue( this ))  putValue( eTMotor_29, dec( getValue( eTMotor_29 ) ) );
}

//MR 63119
on EnvVar eTMotor_29Def
{
    putValue( eTMotor_29,20 );
}

//MR 63119
on EnvVar eTMotor_29Inc
{
    if( getValue( this ))  putValue( eTMotor_29, inc( getValue( eTMotor_29 ) ) );
}

//MR 63119
on EnvVar eTOTMotor_29Dec
{
    if( getValue( this ))  putValue( eTOTMotor_29, dec( getValue( eTOTMotor_29 ) ) );
}

//MR 63119
on EnvVar eTOTMotor_29Def
{
    putValue( eTOTMotor_29, 500 );
}

//MR 63119
on EnvVar eTOTMotor_29Inc
{
    if( getValue( this ))  putValue( eTOTMotor_29, inc( getValue( eTOTMotor_29 ) ) );
}

//MR 63119
on EnvVar eDlcMotor_29Dec
{
    if( getValue( this ))  putValue( eDlcMotor_29, getValue( eDlcMotor_29 ) - 1 );
}

//MR 63119
on EnvVar eDlcMotor_29Def
{
    putValue( eDlcMotor_29, 8 );
}

//MR 63119
on EnvVar eDlcMotor_29Inc
{
    if( getValue( this ))  putValue( eDlcMotor_29, getValue( eDlcMotor_29 ) + 1 );
}

//MR 63119
on EnvVar eCHA_Current_ModeDec
{
    if( getValue( this ))  putValue( eCHA_Current_ModeS, getValue( eCHA_Current_ModeS ) - 1);
}

//MR 63119
on EnvVar eCHA_Current_ModeDef
{
    putValue( eCHA_Current_ModeS, 0);
}

//MR 63119
on EnvVar eCHA_Current_ModeInc
{
    if( getValue( this ))  putValue( eCHA_Current_ModeS, getValue( eCHA_Current_ModeS ) + 1);
}

//MR 63119
on EnvVar eLWI_LenkradwinkelDec
{
    if( getValue( this ))  putValue( eLWI_LenkradwinkelS, getValue( eLWI_LenkradwinkelS ) - 0.1);
}

//MR 63119
on EnvVar eLWI_LenkradwinkelDef
{
    putValue( eLWI_LenkradwinkelS, 819);
}

//MR 63119
on EnvVar eLWI_LenkradwinkelInc
{
    if( getValue( this ))  putValue( eLWI_LenkradwinkelS, getValue( eLWI_LenkradwinkelS ) + 0.1);
}

//MR 63119
on EnvVar eMO_Anzeige_LeistungDec
{
    if( getValue( this ))  putValue( eMO_Anzeige_LeistungS, getValue( eMO_Anzeige_LeistungS ) - 0.6);
}

//MR 63119
on EnvVar eMO_Anzeige_LeistungDef
{
    putValue( eMO_Anzeige_LeistungS, 0);
}

//MR 63119
on EnvVar eMO_Anzeige_LeistungInc
{
    if( getValue( this ))  putValue( eMO_Anzeige_LeistungS, getValue( eMO_Anzeige_LeistungS ) + 0.6);
}

//MR 64266
on EnvVar eACC_Zeitluecke_AbstandswarnerDec
{
    if( getValue( this ))  putValue( eACC_Zeitluecke_AbstandswarnerS, getValue( eACC_Zeitluecke_AbstandswarnerS ) - 0.1);
}

//MR 64266
on EnvVar eACC_Zeitluecke_AbstandswarnerDef
{
    putValue( eACC_Zeitluecke_AbstandswarnerS, 6.3);
}

//MR 64266
on EnvVar eACC_Zeitluecke_AbstandswarnerInc
{
    if( getValue( this ))  putValue( eACC_Zeitluecke_AbstandswarnerS, getValue( eACC_Zeitluecke_AbstandswarnerS ) + 0.1);
}

//MR 64266
on EnvVar eACC_Abstand_AbstandswarnerDec
{
    if( getValue( this ))  putValue( eACC_Abstand_AbstandswarnerS, getValue( eACC_Abstand_AbstandswarnerS ) - 1);
}

//MR 64266
on EnvVar eACC_Abstand_AbstandswarnerDef
{
    putValue( eACC_Abstand_AbstandswarnerS, 511);
}

//MR 64266
on EnvVar eACC_Abstand_AbstandswarnerInc
{
    if( getValue( this ))  putValue( eACC_Abstand_AbstandswarnerS, getValue( eACC_Abstand_AbstandswarnerS ) +1);
}

//MR 64266
on EnvVar eACC_Texte_AbstandswarnerDec
{
    if( getValue( this ))  putValue( eACC_Texte_AbstandswarnerS, getValue( eACC_Texte_AbstandswarnerS ) - 1);
}

//MR 64266
on EnvVar eACC_Texte_AbstandswarnerDef
{
    putValue( eACC_Texte_AbstandswarnerS, 0);
}

//MR 64266
on EnvVar eACC_Texte_AbstandswarnerInc
{
    if( getValue( this ))  putValue( eACC_Texte_AbstandswarnerS, getValue( eACC_Texte_AbstandswarnerS ) +1);
}

//MR 64266
on EnvVar eAWV_WarnungDec
{
    if( getValue( this ))  putValue( eAWV_WarnungS, getValue( eAWV_WarnungS ) - 1);
}

//MR 64266
on EnvVar eAWV_WarnungDef
{
    putValue( eAWV_WarnungS, 0);
}

//MR 64266
on EnvVar eAWV_WarnungInc
{
    if( getValue( this ))  putValue( eAWV_WarnungS, getValue( eAWV_WarnungS ) +1);
}

//MR 64266
on EnvVar eAWV_TexteDec
{
    if( getValue( this ))  putValue( eAWV_TexteS, getValue( eAWV_TexteS ) - 1);
}

//MR 64266
on EnvVar eAWV_TexteDef
{
    putValue( eAWV_TexteS, 0);
}

//MR 64266
on EnvVar eAWV_TexteInc
{
    if( getValue( this ))  putValue( eAWV_TexteS, getValue( eAWV_TexteS ) +1);
}

//MR 70392
on EnvVar eTLSH_02Dec
{
    if( getValue( this ))  putValue( eTLSH_02, dec( getValue( eTLSH_02 ) ) );
}

//MR 70392
on EnvVar eTLSH_02Def
{
    putValue( eTLSH_02,200 );
}

//MR 70392
on EnvVar eTLSH_02Inc
{
    if( getValue( this ))  putValue( eTLSH_02, inc( getValue( eTLSH_02 ) ) );
}

//MR 70392
on EnvVar eTOTLSH_02Dec
{
    if( getValue( this ))  putValue( eTOTLSH_02, dec( getValue( eTOTLSH_02 ) ) );
}

//MR 70392
on EnvVar eTOTLSH_02Def
{
    putValue( eTOTLSH_02, 2000 );
}

//MR 70392
on EnvVar eTOTLSH_02Inc
{
    if( getValue( this ))  putValue( eTOTLSH_02, inc( getValue( eTOTLSH_02 ) ) );
}

//MR 70392
on EnvVar eDlcLSH_02Dec
{
    if( getValue( this ))  putValue( eDlcLSH_02, getValue( eDlcLSH_02 ) - 1 );
}

//MR 70392
on EnvVar eDlcLSH_02Def
{
    putValue( eDlcLSH_02, 8 );
}

//MR 70392
on EnvVar eDlcLSH_02Inc
{
    if( getValue( this ))  putValue( eDlcLSH_02, getValue( eDlcLSH_02 ) + 1 );
}

//MR 70392
on EnvVar eLSH_KVSDec
{
    if( getValue( this ))  putValue( eLSH_KVSS, getValue( eLSH_KVSS ) - 1);
}

//MR 70392
on EnvVar eLSH_KVSDef
{
    putValue( eLSH_KVSS, 0);
}

//MR 70392
on EnvVar eLSH_KVSInc
{
    if( getValue( this ))  putValue( eLSH_KVSS, getValue( eLSH_KVSS ) +1);
}

on EnvVar eLSH_HeizleistungDec
{
    if( getValue( this ))  putValue( eLSH_HeizleistungS, getValue( eLSH_HeizleistungS ) - 1);
}

on EnvVar eLSH_HeizleistungDef
{
    putValue( eLSH_HeizleistungS, 0);
}

on EnvVar eLSH_HeizleistungInc
{
    if( getValue( this ))  putValue( eLSH_HeizleistungS, getValue( eLSH_HeizleistungS ) +1);
}

on EnvVar eTBMS_05Dec
{
    if( getValue( this ))  putValue( eTBMS_05, dec( getValue( eTBMS_05 ) ) );
}

on EnvVar eTBMS_05Def
{
    putValue( eTBMS_05,50 );
}

on EnvVar eTBMS_05Inc
{
    if( getValue( this ))  putValue( eTBMS_05, inc( getValue( eTBMS_05 ) ) );
}

on EnvVar eTOTBMS_05Dec
{
    if( getValue( this ))  putValue( eTOTBMS_05, dec( getValue( eTOTBMS_05 ) ) );
}

on EnvVar eTOTBMS_05Def
{
    putValue( eTOTBMS_05, 500 );
}

on EnvVar eTOTBMS_05Inc
{
    if( getValue( this ))  putValue( eTOTBMS_05, inc( getValue( eTOTBMS_05 ) ) );
}

on EnvVar eDlcBMS_05Dec
{
    if( getValue( this ))  putValue( eDlcBMS_05, getValue( eDlcBMS_05 ) - 1 );
}

//MR 73103
on EnvVar eDlcBMS_05Def
{
    putValue( eDlcBMS_05, 8 );
}

//MR 73103
on EnvVar eDlcBMS_05Inc
{
    if( getValue( this ))  putValue( eDlcBMS_05, getValue( eDlcBMS_05 ) + 1 );
}

//MR 73103
on EnvVar eTMotor_25Dec
{
    if( getValue( this ))  putValue( eTMotor_25, dec( getValue( eTMotor_25 ) ) );
}

//MR 73103
on EnvVar eTMotor_25Def
{
    putValue( eTMotor_25,500 );
}

//MR 73103
on EnvVar eTMotor_25Inc
{
    if( getValue( this ))  putValue( eTMotor_25, inc( getValue( eTMotor_25 ) ) );
}

//MR 73103
on EnvVar eTOTMotor_25Dec
{
    if( getValue( this ))  putValue( eTOTMotor_25, dec( getValue( eTOTMotor_25 ) ) );
}

//MR 73103
on EnvVar eTOTMotor_25Def
{
    putValue( eTOTMotor_25, 5000 );
}

//MR 73103
on EnvVar eTOTMotor_25Inc
{
    if( getValue( this ))  putValue( eTOTMotor_25, inc( getValue( eTOTMotor_25 ) ) );
}

//MR 73103
on EnvVar eDlcMotor_25Dec
{
    if( getValue( this ))  putValue( eDlcMotor_25, getValue( eDlcMotor_25 ) - 1 );
}

//MR 73103
on EnvVar eDlcMotor_25Def
{
    putValue( eDlcMotor_25, 8 );
}

//MR 73103
on EnvVar eDlcMotor_25Inc
{
    if( getValue( this ))  putValue( eDlcMotor_25, getValue( eDlcMotor_25 ) + 1 );
}

//MR 73103
on EnvVar eALR_gMeter_axDec
{
    if( getValue( this ))  putValue( eALR_gMeter_axS, getValue( eALR_gMeter_axS ) - 0.003);
}

//MR 73103
on EnvVar eALR_gMeter_axDef
{
    putValue( eALR_gMeter_axS, 1.566);
}

//MR 73103
on EnvVar eALR_gMeter_axInc
{
    if( getValue( this ))  putValue( eALR_gMeter_axS, getValue( eALR_gMeter_axS ) +0.003);
}

//MR 73103
on EnvVar eALR_gMeter_ayDec
{
    if( getValue( this ))  putValue( eALR_gMeter_ayS, getValue( eALR_gMeter_ayS ) - 0.003);
}

//MR 73103
on EnvVar eALR_gMeter_ayDef
{
    putValue( eALR_gMeter_ayS, 1.566);
}

//MR 73103
on EnvVar eALR_gMeter_ayInc
{
    if( getValue( this ))  putValue( eALR_gMeter_ayS, getValue( eALR_gMeter_ayS ) +0.003);
}

//MR 73103
on EnvVar eBMS_RekuperationDec
{
    if( getValue( this ))  putValue( eBMS_RekuperationS, getValue( eBMS_RekuperationS ) - 10);
}

//MR 73103
on EnvVar eBMS_RekuperationDef
{
    putValue( eBMS_RekuperationS, 0);
}

//MR 73103
on EnvVar eBMS_RekuperationInc
{
    if( getValue( this ))  putValue( eBMS_RekuperationS, getValue( eBMS_RekuperationS ) +10);
}

//MR 73103
on EnvVar eBMS_VerbrauchDec
{
    if( getValue( this ))  putValue( eBMS_VerbrauchS, getValue( eBMS_VerbrauchS ) - 10);
}

//MR 73103
on EnvVar eBMS_VerbrauchDef
{
    putValue( eBMS_VerbrauchS, 0);
}

//MR 73103
on EnvVar eBMS_VerbrauchInc
{
    if( getValue( this ))  putValue( eBMS_VerbrauchS, getValue( eBMS_VerbrauchS ) +10);
}

on envVar eMO_Schaltblitz_AnzDec
{
    if( getValue( this ))  putValue( eMO_Schaltblitz_AnzS, getValue( eMO_Schaltblitz_AnzS ) - 1);
}

on envVar eMO_Schaltblitz_AnzDef
{
    putValue( eMO_Schaltblitz_AnzS, 126);
}

on envVar eMO_Schaltblitz_AnzInc
{
    if( getValue( this ))  putValue( eMO_Schaltblitz_AnzS, getValue( eMO_Schaltblitz_AnzS ) +1);
}

//MR 73103
on EnvVar eMO_Anzeige_DrehmomentDec
{
    if( getValue( this ))  putValue( eMO_Anzeige_DrehmomentS, getValue( eMO_Anzeige_DrehmomentS ) - 1);
}

//MR 73103
on EnvVar eMO_Anzeige_DrehmomentDef
{
    putValue( eMO_Anzeige_DrehmomentS, 0);
}

//MR 73103
on EnvVar eMO_Anzeige_DrehmomentInc
{
    if( getValue( this ))  putValue( eMO_Anzeige_DrehmomentS, getValue( eMO_Anzeige_DrehmomentS ) +1);
}

//MR 73103
on EnvVar eTMotor_41Dec
{
    if( getValue( this ))  putValue( eTMotor_41, dec( getValue( eTMotor_41 ) ) );
}

//MR 73103
on EnvVar eTMotor_41Def
{
    putValue( eTMotor_41,500 );
}

//MR 73103
on EnvVar eTMotor_41Inc
{
    if( getValue( this ))  putValue( eTMotor_41, inc( getValue( eTMotor_41 ) ) );
}

//MR 73103
on EnvVar eTOTMotor_41Dec
{
    if( getValue( this ))  putValue( eTOTMotor_41, dec( getValue( eTOTMotor_41 ) ) );
}

//MR 73103
on EnvVar eTOTMotor_41Def
{
    putValue( eTOTMotor_41, 5000 );
}

//MR 73103
on EnvVar eTOTMotor_41Inc
{
    if( getValue( this ))  putValue( eTOTMotor_41, inc( getValue( eTOTMotor_41 ) ) );
}

//MR 73103
on EnvVar eDlcMotor_41Dec
{
    if( getValue( this ))  putValue( eDlcMotor_41, getValue( eDlcMotor_41 ) - 1 );
}

//MR 73103
on EnvVar eDlcMotor_41Def
{
    putValue( eDlcMotor_41, 8 );
}

//MR 73103
on EnvVar eDlcMotor_41Inc
{
    if( getValue( this ))  putValue( eDlcMotor_41, getValue( eDlcMotor_41 ) + 1 );
}

//MR 73103
on EnvVar eMO_AGA_Sound_TexteDec
{
    if( getValue( this ))  putValue( eMO_AGA_Sound_TexteS, getValue( eMO_AGA_Sound_TexteS ) - 1);
}

on EnvVar eMO_AGA_Sound_TexteDef
{
    putValue( eMO_AGA_Sound_TexteS, 0);
}

on EnvVar eMO_AGA_Sound_TexteInc
{
    if( getValue( this ))  putValue( eMO_AGA_Sound_TexteS, getValue( eMO_AGA_Sound_TexteS ) +1);
}

on EnvVar eMO_Anzeige_StSt_SymbolDec
{
    if( getValue( this ))  putValue( eMO_Anzeige_StSt_SymbolS, getValue( eMO_Anzeige_StSt_SymbolS ) - 1);
}

on EnvVar eMO_Anzeige_StSt_SymbolDef
{
    putValue( eMO_Anzeige_StSt_SymbolS, 0);
}

on EnvVar eMO_Anzeige_StSt_SymbolInc
{
    if( getValue( this ))  putValue( eMO_Anzeige_StSt_SymbolS, getValue( eMO_Anzeige_StSt_SymbolS ) +1);
}

on EnvVar eTMotor_31Dec
{
    if( getValue( this ))  putValue( eTMotor_31, dec( getValue( eTMotor_31 ) ) );
}

on EnvVar eTMotor_31Def
{
    putValue( eTMotor_31,1000 );
}

on EnvVar eTMotor_31Inc
{
    if( getValue( this ))  putValue( eTMotor_31, inc( getValue( eTMotor_31 ) ) );
}

on EnvVar eTOTMotor_31Dec
{
    if( getValue( this ))  putValue( eTOTMotor_31, dec( getValue( eTOTMotor_31 ) ) );
}

on EnvVar eTOTMotor_31Def
{
    putValue( eTOTMotor_31, 5000 );
}

on EnvVar eTOTMotor_31Inc
{
    if( getValue( this ))  putValue( eTOTMotor_31, inc( getValue( eTOTMotor_31 ) ) );
}

on EnvVar eDlcMotor_31Dec
{
    if( getValue( this ))  putValue( eDlcMotor_31, getValue( eDlcMotor_31 ) - 1 );
}

on EnvVar eDlcMotor_31Def
{
    putValue( eDlcMotor_31, 8 );
}

on EnvVar eDlcMotor_31Inc
{
    if( getValue( this ))  putValue( eDlcMotor_31, getValue( eDlcMotor_31 ) + 1 );
}

on EnvVar eTSK_06_altDef
{
    putValue( eTSK_06_altS,0 );
}

on EnvVar eTSK_Hauptschalter_GRA_ACCDef
{
    putValue( eTSK_Hauptschalter_GRA_ACCS, 0 );
}

on EnvVar eTSK_Hauptschalter_GRA_ACCDec
{
    if( getValue( this ))  putValue( eTSK_Hauptschalter_GRA_ACCS, getValue( eTSK_Hauptschalter_GRA_ACCS ) - 1);
}

on EnvVar eTSK_Hauptschalter_GRA_ACCInc
{
    if( getValue( this ))  putValue( eTSK_Hauptschalter_GRA_ACCS, getValue( eTSK_Hauptschalter_GRA_ACCS ) +1);
}

on EnvVar eMO_Anzeige_FMAus_TextDef
{
    putValue( eMO_Anzeige_FMAus_TextS, 0);
}

on EnvVar eASW_KombitexteDef
{
    putValue( eASW_KombitexteS, 0);
}

on EnvVar eASW_KombitexteDec
{
    if( getValue( this ))  putValue( eASW_KombitexteS, getValue( eASW_KombitexteS ) -1);
}

on EnvVar eASW_KombitexteInc
{
    if( getValue( this ))  putValue( eASW_KombitexteS, getValue( eASW_KombitexteS ) +1);
}

on EnvVar eAAG_ASTA_StatusDef
{
    putValue( eAAG_ASTA_StatusS, 0);
}

//ACC_14
on EnvVar eTACC_14Dec
{
    if( getValue( this ))  putValue( eTACC_14, dec( getValue( eTACC_14 ) ) );
}

//ACC_14
on EnvVar eTACC_14Def
{
    putValue( eTACC_14,60 );
}

//ACC_14
on EnvVar eTACC_14Inc
{
    if( getValue( this ))  putValue( eTACC_14, inc( getValue( eTACC_14 ) ) );
}

//ACC_14
on EnvVar eTOTACC_14Dec
{
    if( getValue( this ))  putValue( eTOTACC_14, dec( getValue( eTOTACC_14 ) ) );
}

//ACC_14
on EnvVar eTOTACC_14Def
{
    putValue( eTOTACC_14, 600 );
}

//ACC_14
on EnvVar eTOTACC_14Inc
{
    if( getValue( this ))  putValue( eTOTACC_14, inc( getValue( eTOTACC_14 ) ) );
}

//ACC_14
on EnvVar eDlcACC_14Dec
{
    if( getValue( this ))  putValue( eDlcACC_14, getValue( eDlcACC_14 ) - 1 );
}

//ACC_14
on EnvVar eDlcACC_14Def
{
    putValue( eDlcACC_14, 8 );
}

//ACC_14
on EnvVar eDlcACC_14Inc
{
    if( getValue( this ))  putValue( eDlcACC_14, getValue( eDlcACC_14 ) + 1 );
}

//AWV_02
on EnvVar eTAWV_02Dec
{
    if( getValue( this ))  putValue( eTAWV_02, dec( getValue( eTAWV_02 ) ) );
}

//AWV_02
on EnvVar eTAWV_02Def
{
    putValue( eTAWV_02,200 );
}

//AWV_02
on EnvVar eTAWV_02Inc
{
    if( getValue( this ))  putValue( eTAWV_02, inc( getValue( eTAWV_02 ) ) );
}

//AWV_02
on EnvVar eTOTAWV_02Dec
{
    if( getValue( this ))  putValue( eTOTAWV_02, dec( getValue( eTOTAWV_02 ) ) );
}

//AWV_02
on EnvVar eTOTAWV_02Def
{
    putValue( eTOTAWV_02, 2000 );
}

//AWV_02
on EnvVar eTOTAWV_02Inc
{
    if( getValue( this ))  putValue( eTOTAWV_02, inc( getValue( eTOTAWV_02 ) ) );
}

//AWV_02
on EnvVar eDlcAWV_02Dec
{
    if( getValue( this ))  putValue( eDlcAWV_02, getValue( eDlcAWV_02 ) - 1 );
}

//AWV_02
on EnvVar eDlcAWV_02Def
{
    putValue( eDlcAWV_02, 8 );
}

//AWV_02
on EnvVar eDlcAWV_02Inc
{
    if( getValue( this ))  putValue( eDlcAWV_02, getValue( eDlcAWV_02 ) + 1 );
}

//Airbag_04
on EnvVar eTAirbag_04Dec
{
    if( getValue( this ))  putValue( eTAirbag_04, dec( getValue( eTAirbag_04 ) ) );
}

//Airbag_04
on EnvVar eTAirbag_04Def
{
    putValue( eTAirbag_04,200 );
}

//Airbag_04
on EnvVar eTAirbag_04Inc
{
    if( getValue( this ))  putValue( eTAirbag_04, inc( getValue( eTAirbag_04 ) ) );
}

//Airbag_04
on EnvVar eTOTAirbag_04Dec
{
    if( getValue( this ))  putValue( eTOTAirbag_04, dec( getValue( eTOTAirbag_04 ) ) );
}

//Airbag_04
on EnvVar eTOTAirbag_04Def
{
    putValue( eTOTAirbag_04, 2000 );
}

//Airbag_04
on EnvVar eTOTAirbag_04Inc
{
    if( getValue( this ))  putValue( eTOTAirbag_04, inc( getValue( eTOTAirbag_04 ) ) );
}

//Airbag_04
on EnvVar eDlcAirbag_04Dec
{
    if( getValue( this ))  putValue( eDlcAirbag_04, getValue( eDlcAirbag_04 ) - 1 );
}

//Airbag_04
on EnvVar eDlcAirbag_04Def
{
    putValue( eDlcAirbag_04, 8 );
}

//Airbag_04
on EnvVar eDlcAirbag_04Inc
{
    if( getValue( this ))  putValue( eDlcAirbag_04, getValue( eDlcAirbag_04 ) + 1 );
}

//EPB_03
on EnvVar eTEPB_03Dec
{
    if( getValue( this ))  putValue( eTEPB_03, dec( getValue( eTEPB_03 ) ) );
}

//EPB_03
on EnvVar eTEPB_03Def
{
    putValue( eTEPB_03,200 );
}

//EPB_03
on EnvVar eTEPB_03Inc
{
    if( getValue( this ))  putValue( eTEPB_03, inc( getValue( eTEPB_03 ) ) );
}

//EPB_03
on EnvVar eTOTEPB_03Dec
{
    if( getValue( this ))  putValue( eTOTEPB_03, dec( getValue( eTOTEPB_03 ) ) );
}

//EPB_03
on EnvVar eTOTEPB_03Def
{
    putValue( eTOTEPB_03, 2000 );
}

//EPB_03
on EnvVar eTOTEPB_03Inc
{
    if( getValue( this ))  putValue( eTOTEPB_03, inc( getValue( eTOTEPB_03 ) ) );
}

//EPB_03
on EnvVar eDlcEPB_03Dec
{
    if( getValue( this ))  putValue( eDlcEPB_03, getValue( eDlcEPB_03 ) - 1 );
}

//EPB_03
on EnvVar eDlcEPB_03Def
{
    putValue( eDlcEPB_03, 8 );
}

//EPB_03
on EnvVar eDlcEPB_03Inc
{
    if( getValue( this ))  putValue( eDlcEPB_03, getValue( eDlcEPB_03 ) + 1 );
}

on EnvVar eBZStepEPB_03Dec
{
    if( getValue( this ))  putValue( eBZStepEPB_03, getValue( eBZStepEPB_03 ) - 1 );
}

on EnvVar eBZStepEPB_03Inc
{
    if( getValue( this ))  putValue( eBZStepEPB_03, getValue( eBZStepEPB_03 ) + 1 );
}

on EnvVar eBZStepEPB_03Def
{
    putValue( eBZStepEPB_03, 1 );
}

//NMH_STSG_HBFS
on EnvVar eTNMH_STSG_HBFSDec
{
    if( getValue( this ))  putValue( eTNMH_STSG_HBFS, dec( getValue( eTNMH_STSG_HBFS ) ) );
}

//NMH_STSG_HBFS
on EnvVar eTNMH_STSG_HBFSDef
{
    putValue( eTNMH_STSG_HBFS,200 );
}

//NMH_STSG_HBFS
on EnvVar eTNMH_STSG_HBFSInc
{
    if( getValue( this ))  putValue( eTNMH_STSG_HBFS, inc( getValue( eTNMH_STSG_HBFS ) ) );
}

//NMH_STSG_HBFS
on EnvVar eTOTNMH_STSG_HBFSDec
{
    if( getValue( this ))  putValue( eTOTNMH_STSG_HBFS, dec( getValue( eTOTNMH_STSG_HBFS ) ) );
}

//NMH_STSG_HBFS
on EnvVar eTOTNMH_STSG_HBFSDef
{
    putValue( eTOTNMH_STSG_HBFS, 2000 );
}

//NMH_STSG_HBFS
on EnvVar eTOTNMH_STSG_HBFSInc
{
    if( getValue( this ))  putValue( eTOTNMH_STSG_HBFS, inc( getValue( eTOTNMH_STSG_HBFS ) ) );
}

//NMH_STSG_HBFS
on EnvVar eDlcNMH_STSG_HBFSDec
{
    if( getValue( this ))  putValue( eDlcNMH_STSG_HBFS, getValue( eDlcNMH_STSG_HBFS ) - 1 );
}

//NMH_STSG_HBFS
on EnvVar eDlcNMH_STSG_HBFSDef
{
    putValue( eDlcNMH_STSG_HBFS, 8 );
}

//NMH_STSG_HBFS
on EnvVar eDlcNMH_STSG_HBFSInc
{
    if( getValue( this ))  putValue( eDlcNMH_STSG_HBFS, getValue( eDlcNMH_STSG_HBFS ) + 1 );
}

//NMH_STSG_HFS
on EnvVar eTNMH_STSG_HFSDec
{
    if( getValue( this ))  putValue( eTNMH_STSG_HFS, dec( getValue( eTNMH_STSG_HFS ) ) );
}

//NMH_STSG_HFS
on EnvVar eTNMH_STSG_HFSDef
{
    putValue( eTNMH_STSG_HFS,200 );
}

//NMH_STSG_HFS
on EnvVar eTNMH_STSG_HFSInc
{
    if( getValue( this ))  putValue( eTNMH_STSG_HFS, inc( getValue( eTNMH_STSG_HFS ) ) );
}

//NMH_STSG_HFS
on EnvVar eTOTNMH_STSG_HFSDec
{
    if( getValue( this ))  putValue( eTOTNMH_STSG_HFS, dec( getValue( eTOTNMH_STSG_HFS ) ) );
}

//NMH_STSG_HFS
on EnvVar eTOTNMH_STSG_HFSDef
{
    putValue( eTOTNMH_STSG_HFS, 2000 );
}

//NMH_STSG_HFS
on EnvVar eTOTNMH_STSG_HFSInc
{
    if( getValue( this ))  putValue( eTOTNMH_STSG_HFS, inc( getValue( eTOTNMH_STSG_HFS ) ) );
}

//NMH_STSG_HFS
on EnvVar eDlcNMH_STSG_HFSDec
{
    if( getValue( this ))  putValue( eDlcNMH_STSG_HFS, getValue( eDlcNMH_STSG_HFS ) - 1 );
}

//NMH_STSG_HFS
on EnvVar eDlcNMH_STSG_HFSDef
{
    putValue( eDlcNMH_STSG_HFS, 8 );
}

//NMH_STSG_HFS
on EnvVar eDlcNMH_STSG_HFSInc
{
    if( getValue( this ))  putValue( eDlcNMH_STSG_HFS, getValue( eDlcNMH_STSG_HFS ) + 1 );
}

//OBDC_Funktionaler_Req_All
on EnvVar eTOBDC_Funktionaler_Req_AllDec
{
    if( getValue( this ))  putValue( eTOBDC_Funktionaler_Req_All, dec( getValue( eTOBDC_Funktionaler_Req_All ) ) );
}

//OBDC_Funktionaler_Req_All
on EnvVar eTOBDC_Funktionaler_Req_AllDef
{
    putValue( eTOBDC_Funktionaler_Req_All,200 );
}

//OBDC_Funktionaler_Req_All
on EnvVar eTOBDC_Funktionaler_Req_AllInc
{
    if( getValue( this ))  putValue( eTOBDC_Funktionaler_Req_All, inc( getValue( eTOBDC_Funktionaler_Req_All ) ) );
}

//OBDC_Funktionaler_Req_All
on EnvVar eTOTOBDC_Funktionaler_Req_AllDec
{
    if( getValue( this ))  putValue( eTOTOBDC_Funktionaler_Req_All, dec( getValue( eTOTOBDC_Funktionaler_Req_All ) ) );
}

//OBDC_Funktionaler_Req_All
on EnvVar eTOTOBDC_Funktionaler_Req_AllDef
{
    putValue( eTOTOBDC_Funktionaler_Req_All, 2000 );
}

//OBDC_Funktionaler_Req_All
on EnvVar eTOTOBDC_Funktionaler_Req_AllInc
{
    if( getValue( this ))  putValue( eTOTOBDC_Funktionaler_Req_All, inc( getValue( eTOTOBDC_Funktionaler_Req_All ) ) );
}

//OBDC_Funktionaler_Req_All
on EnvVar eDlcOBDC_Funktionaler_Req_AllDec
{
    if( getValue( this ))  putValue( eDlcOBDC_Funktionaler_Req_All, getValue( eDlcOBDC_Funktionaler_Req_All ) - 1 );
}

//OBDC_Funktionaler_Req_All
on EnvVar eDlcOBDC_Funktionaler_Req_AllDef
{
    putValue( eDlcOBDC_Funktionaler_Req_All, 8 );
}

//OBDC_Funktionaler_Req_All
on EnvVar eDlcOBDC_Funktionaler_Req_AllInc
{
    if( getValue( this ))  putValue( eDlcOBDC_Funktionaler_Req_All, getValue( eDlcOBDC_Funktionaler_Req_All ) + 1 );
}

//WFS_Transponder_Req_02
on EnvVar eTWFS_Transponder_Req_02Dec
{
    if( getValue( this ))  putValue( eTWFS_Transponder_Req_02, dec( getValue( eTWFS_Transponder_Req_02 ) ) );
}

//WFS_Transponder_Req_02
on EnvVar eTWFS_Transponder_Req_02Def
{
    putValue( eTWFS_Transponder_Req_02,200 );
}

//WFS_Transponder_Req_02
on EnvVar eTWFS_Transponder_Req_02Inc
{
    if( getValue( this ))  putValue( eTWFS_Transponder_Req_02, inc( getValue( eTWFS_Transponder_Req_02 ) ) );
}

//WFS_Transponder_Req_02
on EnvVar eTOTWFS_Transponder_Req_02Dec
{
    if( getValue( this ))  putValue( eTOTWFS_Transponder_Req_02, dec( getValue( eTOTWFS_Transponder_Req_02 ) ) );
}

//WFS_Transponder_Req_02
on EnvVar eTOTWFS_Transponder_Req_02Def
{
    putValue( eTOTWFS_Transponder_Req_02, 2000 );
}

//WFS_Transponder_Req_02
on EnvVar eTOTWFS_Transponder_Req_02Inc
{
    if( getValue( this ))  putValue( eTOTWFS_Transponder_Req_02, inc( getValue( eTOTWFS_Transponder_Req_02 ) ) );
}

//WFS_Transponder_Req_02
on EnvVar eDlcWFS_Transponder_Req_02Dec
{
    if( getValue( this ))  putValue( eDlcWFS_Transponder_Req_02, getValue( eDlcWFS_Transponder_Req_02 ) - 1 );
}

//WFS_Transponder_Req_02
on EnvVar eDlcWFS_Transponder_Req_02Def
{
    putValue( eDlcWFS_Transponder_Req_02, 8 );
}

//WFS_Transponder_Req_02
on EnvVar eDlcWFS_Transponder_Req_02Inc
{
    if( getValue( this ))  putValue( eDlcWFS_Transponder_Req_02, getValue( eDlcWFS_Transponder_Req_02 ) + 1 );
}

//AB_Gurtwarn_Reihe2_FA
on EnvVar eAB_Gurtwarn_Reihe2_FADec
{
    if( getValue( this ))  putValue( eAB_Gurtwarn_Reihe2_FAS, getValue( eAB_Gurtwarn_Reihe2_FAS ) - 1);
}

//AB_Gurtwarn_Reihe2_FA
on EnvVar eAB_Gurtwarn_Reihe2_FADef
{
    putValue( eAB_Gurtwarn_Reihe2_FAS, 0);
}

//AB_Gurtwarn_Reihe2_FA
on EnvVar eAB_Gurtwarn_Reihe2_FAInc
{
    if( getValue( this ))  putValue( eAB_Gurtwarn_Reihe2_FAS, getValue( eAB_Gurtwarn_Reihe2_FAS ) + 1);
}

//AB_Gurtwarn_Reihe2_BF
on EnvVar eAB_Gurtwarn_Reihe2_BFDec
{
    if( getValue( this ))  putValue( eAB_Gurtwarn_Reihe2_BFS, getValue( eAB_Gurtwarn_Reihe2_BFS ) - 1);
}

//AB_Gurtwarn_Reihe2_BF
on EnvVar eAB_Gurtwarn_Reihe2_BFDef
{
    putValue( eAB_Gurtwarn_Reihe2_BFS, 0);
}

//AB_Gurtwarn_Reihe2_BF
on EnvVar eAB_Gurtwarn_Reihe2_BFInc
{
    if( getValue( this ))  putValue( eAB_Gurtwarn_Reihe2_BFS, getValue( eAB_Gurtwarn_Reihe2_BFS ) + 1);
}

//AbstWarn_MV_FAS_Fkt_Status
on EnvVar eAbstWarn_MV_FAS_Fkt_StatusDec
{
    if( getValue( this ))  putValue( eAbstWarn_MV_FAS_Fkt_StatusS, getValue( eAbstWarn_MV_FAS_Fkt_StatusS ) - 1);
}

//AbstWarn_MV_FAS_Fkt_Status
on EnvVar eAbstWarn_MV_FAS_Fkt_StatusDef
{
    putValue( eAbstWarn_MV_FAS_Fkt_StatusS, 0);
}

//AbstWarn_MV_FAS_Fkt_Status
on EnvVar eAbstWarn_MV_FAS_Fkt_StatusInc
{
    if( getValue( this ))  putValue( eAbstWarn_MV_FAS_Fkt_StatusS, getValue( eAbstWarn_MV_FAS_Fkt_StatusS ) + 1);
}

//WarnBrems_Charisma_Status
on EnvVar eWarnBrems_Charisma_StatusDec
{
    if( getValue( this ))  putValue( eWarnBrems_Charisma_StatusS, getValue( eWarnBrems_Charisma_StatusS ) - 1);
}

//WarnBrems_Charisma_Status
on EnvVar eWarnBrems_Charisma_StatusDef
{
    putValue( eWarnBrems_Charisma_StatusS, 0);
}

//WarnBrems_Charisma_Status
on EnvVar eWarnBrems_Charisma_StatusInc
{
    if( getValue( this ))  putValue( eWarnBrems_Charisma_StatusS, getValue( eWarnBrems_Charisma_StatusS ) + 1);
}

//WarnBrems_Charisma_FahrPr
on EnvVar eWarnBrems_Charisma_FahrPrDec
{
    if( getValue( this ))  putValue( eWarnBrems_Charisma_FahrPrS, getValue( eWarnBrems_Charisma_FahrPrS ) - 1);
}

//WarnBrems_Charisma_FahrPr
on EnvVar eWarnBrems_Charisma_FahrPrDef
{
    putValue( eWarnBrems_Charisma_FahrPrS, 0);
}

//WarnBrems_Charisma_FahrPr
on EnvVar eWarnBrems_Charisma_FahrPrInc
{
    if( getValue( this ))  putValue( eWarnBrems_Charisma_FahrPrS, getValue( eWarnBrems_Charisma_FahrPrS ) + 1);
}

//AB_Gurtwarn_Reihe2_MI
on EnvVar eAB_Gurtwarn_Reihe2_MIDec
{
    if( getValue( this ))  putValue( eAB_Gurtwarn_Reihe2_MIS, getValue( eAB_Gurtwarn_Reihe2_MIS ) - 1);
}

//AB_Gurtwarn_Reihe2_MI
on EnvVar eAB_Gurtwarn_Reihe2_MIDef
{
    putValue( eAB_Gurtwarn_Reihe2_MIS, 0);
}

//AB_Gurtwarn_Reihe2_MI
on EnvVar eAB_Gurtwarn_Reihe2_MIInc
{
    if( getValue( this ))  putValue( eAB_Gurtwarn_Reihe2_MIS, getValue( eAB_Gurtwarn_Reihe2_MIS ) + 1);
}

//AB_Gurtwarn_Reihe3_FA
on EnvVar eAB_Gurtwarn_Reihe3_FADec
{
    if( getValue( this ))  putValue( eAB_Gurtwarn_Reihe3_FAS, getValue( eAB_Gurtwarn_Reihe3_FAS ) - 1);
}

//AB_Gurtwarn_Reihe3_FA
on EnvVar eAB_Gurtwarn_Reihe3_FADef
{
    putValue( eAB_Gurtwarn_Reihe3_FAS, 0);
}

//AB_Gurtwarn_Reihe3_FA
on EnvVar eAB_Gurtwarn_Reihe3_FAInc
{
    if( getValue( this ))  putValue( eAB_Gurtwarn_Reihe3_FAS, getValue( eAB_Gurtwarn_Reihe3_FAS ) + 1);
}

//AB_Gurtwarn_Reihe3_MI
on EnvVar eAB_Gurtwarn_Reihe3_MIDec
{
    if( getValue( this ))  putValue( eAB_Gurtwarn_Reihe3_MIS, getValue( eAB_Gurtwarn_Reihe3_MIS ) - 1);
}

//AB_Gurtwarn_Reihe3_MI
on EnvVar eAB_Gurtwarn_Reihe3_MIDef
{
    putValue( eAB_Gurtwarn_Reihe3_MIS, 0);
}

//AB_Gurtwarn_Reihe3_MI
on EnvVar eAB_Gurtwarn_Reihe3_MIInc
{
    if( getValue( this ))  putValue( eAB_Gurtwarn_Reihe3_MIS, getValue( eAB_Gurtwarn_Reihe3_MIS ) + 1);
}

//AB_Gurtwarn_Reihe3_BF
on EnvVar eAB_Gurtwarn_Reihe3_BFDec
{
    if( getValue( this ))  putValue( eAB_Gurtwarn_Reihe3_BFS, getValue( eAB_Gurtwarn_Reihe3_BFS ) - 1);
}

//AB_Gurtwarn_Reihe3_BF
on EnvVar eAB_Gurtwarn_Reihe3_BFDef
{
    putValue( eAB_Gurtwarn_Reihe3_BFS, 0);
}

//AB_Gurtwarn_Reihe3_BF
on EnvVar eAB_Gurtwarn_Reihe3_BFInc
{
    if( getValue( this ))  putValue( eAB_Gurtwarn_Reihe3_BFS, getValue( eAB_Gurtwarn_Reihe3_BFS ) + 1);
}

//LGI_FAS_Fkt_Status
on EnvVar eLGI_FAS_Fkt_StatusDec
{
    if( getValue( this ))  putValue( eLGI_FAS_Fkt_StatusS, getValue( eLGI_FAS_Fkt_StatusS ) - 1);
}

//LGI_FAS_Fkt_Status
on EnvVar eLGI_FAS_Fkt_StatusDef
{
    putValue( eLGI_FAS_Fkt_StatusS, 0);
}

//LGI_FAS_Fkt_Status
on EnvVar eLGI_FAS_Fkt_StatusInc
{
    if( getValue( this ))  putValue( eLGI_FAS_Fkt_StatusS, getValue( eLGI_FAS_Fkt_StatusS ) + 1);
}

//PreCrash_FAS_Fkt_Status
on EnvVar ePreCrash_FAS_Fkt_StatusDec
{
    if( getValue( this ))  putValue( ePreCrash_FAS_Fkt_StatusS, getValue( ePreCrash_FAS_Fkt_StatusS ) - 1);
}

//PreCrash_FAS_Fkt_Status
on EnvVar ePreCrash_FAS_Fkt_StatusDef
{
    putValue( ePreCrash_FAS_Fkt_StatusS, 0);
}

//PreCrash_FAS_Fkt_Status
on EnvVar ePreCrash_FAS_Fkt_StatusInc
{
    if( getValue( this ))  putValue( ePreCrash_FAS_Fkt_StatusS, getValue( ePreCrash_FAS_Fkt_StatusS ) + 1);
}

//AB_SBR_hinten_verbau
on EnvVar eAB_SBR_hinten_verbauDec
{
    if( getValue( this ))  putValue( eAB_SBR_hinten_verbauS, getValue( eAB_SBR_hinten_verbauS ) - 1);
}

//AB_SBR_hinten_verbau
on EnvVar eAB_SBR_hinten_verbauDef
{
    putValue( eAB_SBR_hinten_verbauS, 3);
}

//AB_SBR_hinten_verbau
on EnvVar eAB_SBR_hinten_verbauInc
{
    if( getValue( this ))  putValue( eAB_SBR_hinten_verbauS, getValue( eAB_SBR_hinten_verbauS ) + 1);
}

//AWV_Einstellung_System_ASG
on EnvVar eAWV_Einstellung_System_ASGDec
{
    if( getValue( this ))  putValue( eAWV_Einstellung_System_ASGS, getValue( eAWV_Einstellung_System_ASGS ) - 1);
}

//AWV_Einstellung_System_ASG
on EnvVar eAWV_Einstellung_System_ASGDef
{
    putValue( eAWV_Einstellung_System_ASGS, 0);
}

//AWV_Einstellung_System_ASG
on EnvVar eAWV_Einstellung_System_ASGInc
{
    if( getValue( this ))  putValue( eAWV_Einstellung_System_ASGS, getValue( eAWV_Einstellung_System_ASGS ) + 1);
}

//AWV_Einstellung_Warnung_ASG
on EnvVar eAWV_Einstellung_Warnung_ASGDec
{
    if( getValue( this ))  putValue( eAWV_Einstellung_Warnung_ASGS, getValue( eAWV_Einstellung_Warnung_ASGS ) - 1);
}

//AWV_Einstellung_Warnung_ASG
on EnvVar eAWV_Einstellung_Warnung_ASGDef
{
    putValue( eAWV_Einstellung_Warnung_ASGS, 0);
}

//AWV_Einstellung_Warnung_ASG
on EnvVar eAWV_Einstellung_Warnung_ASGInc
{
    if( getValue( this ))  putValue( eAWV_Einstellung_Warnung_ASGS, getValue( eAWV_Einstellung_Warnung_ASGS ) + 1);
}

//SC_PreSense_Modus_Warnung_NV
on EnvVar eSC_PreSense_Modus_Warnung_NVDec
{
    if( getValue( this ))  putValue( eSC_PreSense_Modus_Warnung_NVS, getValue( eSC_PreSense_Modus_Warnung_NVS ) - 1);
}

//SC_PreSense_Modus_Warnung_NV
on EnvVar eSC_PreSense_Modus_Warnung_NVDef
{
    putValue( eSC_PreSense_Modus_Warnung_NVS, 0);
}

//SC_PreSense_Modus_Warnung_NV
on EnvVar eSC_PreSense_Modus_Warnung_NVInc
{
    if( getValue( this ))  putValue( eSC_PreSense_Modus_Warnung_NVS, getValue( eSC_PreSense_Modus_Warnung_NVS ) + 1);
}

//SC_PreSense_Modus_Warnung_MV
on EnvVar eSC_PreSense_Modus_Warnung_MVDec
{
    if( getValue( this ))  putValue( eSC_PreSense_Modus_Warnung_MVS, getValue( eSC_PreSense_Modus_Warnung_MVS ) - 1);
}

//SC_PreSense_Modus_Warnung_MV
on EnvVar eSC_PreSense_Modus_Warnung_MVDef
{
    putValue( eSC_PreSense_Modus_Warnung_MVS, 0);
}

//SC_PreSense_Modus_Warnung_MV
on EnvVar eSC_PreSense_Modus_Warnung_MVInc
{
    if( getValue( this ))  putValue( eSC_PreSense_Modus_Warnung_MVS, getValue( eSC_PreSense_Modus_Warnung_MVS ) + 1);
}

//SC_PreSense_Modus_System_MV
on EnvVar eSC_PreSense_Modus_System_MVDec
{
    if( getValue( this ))  putValue( eSC_PreSense_Modus_System_MVS, getValue( eSC_PreSense_Modus_System_MVS ) - 1);
}

//SC_PreSense_Modus_System_MV
on EnvVar eSC_PreSense_Modus_System_MVDef
{
    putValue( eSC_PreSense_Modus_System_MVS, 0);
}

//SC_PreSense_Modus_System_MV
on EnvVar eSC_PreSense_Modus_System_MVInc
{
    if( getValue( this ))  putValue( eSC_PreSense_Modus_System_MVS, getValue( eSC_PreSense_Modus_System_MVS ) + 1);
}

//SC_PreSense_Modus_System_NV
on EnvVar eSC_PreSense_Modus_System_NVDec
{
    if( getValue( this ))  putValue( eSC_PreSense_Modus_System_NVS, getValue( eSC_PreSense_Modus_System_NVS ) - 1);
}

//SC_PreSense_Modus_System_NV
on EnvVar eSC_PreSense_Modus_System_NVDef
{
    putValue( eSC_PreSense_Modus_System_NVS, 0);
}

//SC_PreSense_Modus_System_NV
on EnvVar eSC_PreSense_Modus_System_NVInc
{
    if( getValue( this ))  putValue( eSC_PreSense_Modus_System_NVS, getValue( eSC_PreSense_Modus_System_NVS ) + 1);
}

//SC_PreSense_Modus_System_KAS
on EnvVar eSC_PreSense_Modus_System_KASDec
{
    if( getValue( this ))  putValue( eSC_PreSense_Modus_System_KASS, getValue( eSC_PreSense_Modus_System_KASS ) - 1);
}

//SC_PreSense_Modus_System_KAS
on EnvVar eSC_PreSense_Modus_System_KASDef
{
    putValue( eSC_PreSense_Modus_System_KASS, 0);
}

//SC_PreSense_Modus_System_KAS
on EnvVar eSC_PreSense_Modus_System_KASInc
{
    if( getValue( this ))  putValue( eSC_PreSense_Modus_System_KASS, getValue( eSC_PreSense_Modus_System_KASS ) + 1);
}

//AWV_Warnlevel
on EnvVar eAWV_WarnlevelDec
{
    if( getValue( this ))  putValue( eAWV_WarnlevelS, getValue( eAWV_WarnlevelS ) - 1);
}

//AWV_Warnlevel
on EnvVar eAWV_WarnlevelDef
{
    putValue( eAWV_WarnlevelS, 0);
}

//AWV_Warnlevel
on EnvVar eAWV_WarnlevelInc
{
    if( getValue( this ))  putValue( eAWV_WarnlevelS, getValue( eAWV_WarnlevelS ) + 1);
}

//AWV_Einstellung_System_FSG
on EnvVar eAWV_Einstellung_System_FSGDec
{
    if( getValue( this ))  putValue( eAWV_Einstellung_System_FSGS, getValue( eAWV_Einstellung_System_FSGS ) - 1);
}

//AWV_Einstellung_System_FSG
on EnvVar eAWV_Einstellung_System_FSGDef
{
    putValue( eAWV_Einstellung_System_FSGS, 0);
}

//AWV_Einstellung_System_FSG
on EnvVar eAWV_Einstellung_System_FSGInc
{
    if( getValue( this ))  putValue( eAWV_Einstellung_System_FSGS, getValue( eAWV_Einstellung_System_FSGS ) + 1);
}

//AWV_Einstellung_Warnung_FSG
on EnvVar eAWV_Einstellung_Warnung_FSGDec
{
    if( getValue( this ))  putValue( eAWV_Einstellung_Warnung_FSGS, getValue( eAWV_Einstellung_Warnung_FSGS ) - 1);
}

//AWV_Einstellung_Warnung_FSG
on EnvVar eAWV_Einstellung_Warnung_FSGDef
{
    putValue( eAWV_Einstellung_Warnung_FSGS, 0);
}

//AWV_Einstellung_Warnung_FSG
on EnvVar eAWV_Einstellung_Warnung_FSGInc
{
    if( getValue( this ))  putValue( eAWV_Einstellung_Warnung_FSGS, getValue( eAWV_Einstellung_Warnung_FSGS ) + 1);
}

//AWV_Status_Anzeige
on EnvVar eAWV_Status_AnzeigeDec
{
    if( getValue( this ))  putValue( eAWV_Status_AnzeigeS, getValue( eAWV_Status_AnzeigeS ) - 1);
}

//AWV_Status_Anzeige
on EnvVar eAWV_Status_AnzeigeDef
{
    putValue( eAWV_Status_AnzeigeS, 0);
}

//AWV_Status_Anzeige
on EnvVar eAWV_Status_AnzeigeInc
{
    if( getValue( this ))  putValue( eAWV_Status_AnzeigeS, getValue( eAWV_Status_AnzeigeS ) + 1);
}

//AWV_LED_Leiste
on EnvVar eAWV_LED_LeisteDec
{
    if( getValue( this ))  putValue( eAWV_LED_LeisteS, getValue( eAWV_LED_LeisteS ) - 1);
}

//AWV_LED_Leiste
on EnvVar eAWV_LED_LeisteDef
{
    putValue( eAWV_LED_LeisteS, 0);
}

//AWV_LED_Leiste
on EnvVar eAWV_LED_LeisteInc
{
    if( getValue( this ))  putValue( eAWV_LED_LeisteS, getValue( eAWV_LED_LeisteS ) + 1);
}

//AWV_Priowarnung
on EnvVar eAWV_PriowarnungDec
{
    if( getValue( this ))  putValue( eAWV_PriowarnungS, getValue( eAWV_PriowarnungS ) - 1);
}

//AWV_Priowarnung
on EnvVar eAWV_PriowarnungDef
{
    putValue( eAWV_PriowarnungS, 0);
}

//AWV_Priowarnung
on EnvVar eAWV_PriowarnungInc
{
    if( getValue( this ))  putValue( eAWV_PriowarnungS, getValue( eAWV_PriowarnungS ) + 1);
}

//EPB_03_CRC
on EnvVar eEPB_03_CRCDec
{
    if( getValue( this ))  putValue( eEPB_03_CRCS, getValue( eEPB_03_CRCS ) - 1);
}

//EPB_03_CRC
on EnvVar eEPB_03_CRCDef
{
    putValue( eEPB_03_CRCS, 0);
}

//EPB_03_CRC
on EnvVar eEPB_03_CRCInc
{
    if( getValue( this ))  putValue( eEPB_03_CRCS, getValue( eEPB_03_CRCS ) + 1);
}

//EPB_03_BZ
on EnvVar eEPB_03_BZDec
{
    if( getValue( this ))  putValue( eEPB_03_BZS, getValue( eEPB_03_BZS ) - 1);
}

//EPB_03_BZ
on EnvVar eEPB_03_BZDef
{
    putValue( eEPB_03_BZS, 0);
}

//EPB_03_BZ
on EnvVar eEPB_03_BZInc
{
    if( getValue( this ))  putValue( eEPB_03_BZS, getValue( eEPB_03_BZS ) + 1);
}

//EPB_Texte_02
on EnvVar eEPB_Texte_02Dec
{
    if( getValue( this ))  putValue( eEPB_Texte_02S, getValue( eEPB_Texte_02S ) - 1);
}

//EPB_Texte_02
on EnvVar eEPB_Texte_02Def
{
    putValue( eEPB_Texte_02S, 0);
}

//EPB_Texte_02
on EnvVar eEPB_Texte_02Inc
{
    if( getValue( this ))  putValue( eEPB_Texte_02S, getValue( eEPB_Texte_02S ) + 1);
}

//EPB_Fehlermeldungen_02
on EnvVar eEPB_Fehlermeldungen_02Dec
{
    if( getValue( this ))  putValue( eEPB_Fehlermeldungen_02S, getValue( eEPB_Fehlermeldungen_02S ) - 1);
}

//EPB_Fehlermeldungen_02
on EnvVar eEPB_Fehlermeldungen_02Def
{
    putValue( eEPB_Fehlermeldungen_02S, 0);
}

//EPB_Fehlermeldungen_02
on EnvVar eEPB_Fehlermeldungen_02Inc
{
    if( getValue( this ))  putValue( eEPB_Fehlermeldungen_02S, getValue( eEPB_Fehlermeldungen_02S ) + 1);
}


//EPB_Autoholdlampe_02


//NM_STSG_HBFS_CBV_AWB
on EnvVar eNM_STSG_HBFS_CBV_AWBDec
{
    if( getValue( this ))  putValue( eNM_STSG_HBFS_CBV_AWBS, getValue( eNM_STSG_HBFS_CBV_AWBS ) - 1);
}

//NM_STSG_HBFS_CBV_AWB
on EnvVar eNM_STSG_HBFS_CBV_AWBDef
{
    putValue( eNM_STSG_HBFS_CBV_AWBS, 0);
}

//NM_STSG_HBFS_CBV_AWB
on EnvVar eNM_STSG_HBFS_CBV_AWBInc
{
    if( getValue( this ))  putValue( eNM_STSG_HBFS_CBV_AWBS, getValue( eNM_STSG_HBFS_CBV_AWBS ) + 1);
}

//NM_STSG_HBFS_CBV_CRI
on EnvVar eNM_STSG_HBFS_CBV_CRIDec
{
    if( getValue( this ))  putValue( eNM_STSG_HBFS_CBV_CRIS, getValue( eNM_STSG_HBFS_CBV_CRIS ) - 1);
}

//NM_STSG_HBFS_CBV_CRI
on EnvVar eNM_STSG_HBFS_CBV_CRIDef
{
    putValue( eNM_STSG_HBFS_CBV_CRIS, 0);
}

//NM_STSG_HBFS_CBV_CRI
on EnvVar eNM_STSG_HBFS_CBV_CRIInc
{
    if( getValue( this ))  putValue( eNM_STSG_HBFS_CBV_CRIS, getValue( eNM_STSG_HBFS_CBV_CRIS ) + 1);
}

//NM_STSG_HBFS_NM_State
on EnvVar eNM_STSG_HBFS_NM_StateDec
{
    if( getValue( this ))  putValue( eNM_STSG_HBFS_NM_StateS, getValue( eNM_STSG_HBFS_NM_StateS ) - 1);
}

//NM_STSG_HBFS_NM_State
on EnvVar eNM_STSG_HBFS_NM_StateDef
{
    putValue( eNM_STSG_HBFS_NM_StateS, 0);
}

//NM_STSG_HBFS_NM_State
on EnvVar eNM_STSG_HBFS_NM_StateInc
{
    if( getValue( this ))  putValue( eNM_STSG_HBFS_NM_StateS, getValue( eNM_STSG_HBFS_NM_StateS ) + 1);
}

//NM_STSG_HBFS_Car_Wakeup
on EnvVar eNM_STSG_HBFS_Car_WakeupDec
{
    if( getValue( this ))  putValue( eNM_STSG_HBFS_Car_WakeupS, getValue( eNM_STSG_HBFS_Car_WakeupS ) - 1);
}

//NM_STSG_HBFS_Car_Wakeup
on EnvVar eNM_STSG_HBFS_Car_WakeupDef
{
    putValue( eNM_STSG_HBFS_Car_WakeupS, 0);
}

//NM_STSG_HBFS_Car_Wakeup
on EnvVar eNM_STSG_HBFS_Car_WakeupInc
{
    if( getValue( this ))  putValue( eNM_STSG_HBFS_Car_WakeupS, getValue( eNM_STSG_HBFS_Car_WakeupS ) + 1);
}

//NM_STSG_HBFS_UDS_CC
on EnvVar eNM_STSG_HBFS_UDS_CCDec
{
    if( getValue( this ))  putValue( eNM_STSG_HBFS_UDS_CCS, getValue( eNM_STSG_HBFS_UDS_CCS ) - 1);
}

//NM_STSG_HBFS_UDS_CC
on EnvVar eNM_STSG_HBFS_UDS_CCDef
{
    putValue( eNM_STSG_HBFS_UDS_CCS, 0);
}

//NM_STSG_HBFS_UDS_CC
on EnvVar eNM_STSG_HBFS_UDS_CCInc
{
    if( getValue( this ))  putValue( eNM_STSG_HBFS_UDS_CCS, getValue( eNM_STSG_HBFS_UDS_CCS ) + 1);
}

//NM_STSG_HBFS_NM_aktiv_KL15
on EnvVar eNM_STSG_HBFS_NM_aktiv_KL15Dec
{
    if( getValue( this ))  putValue( eNM_STSG_HBFS_NM_aktiv_KL15S, getValue( eNM_STSG_HBFS_NM_aktiv_KL15S ) - 1);
}

//NM_STSG_HBFS_NM_aktiv_KL15
on EnvVar eNM_STSG_HBFS_NM_aktiv_KL15Def
{
    putValue( eNM_STSG_HBFS_NM_aktiv_KL15S, 0);
}

//NM_STSG_HBFS_NM_aktiv_KL15
on EnvVar eNM_STSG_HBFS_NM_aktiv_KL15Inc
{
    if( getValue( this ))  putValue( eNM_STSG_HBFS_NM_aktiv_KL15S, getValue( eNM_STSG_HBFS_NM_aktiv_KL15S ) + 1);
}

//NM_STSG_HBFS_NM_aktiv_Diagnose
on EnvVar eNM_STSG_HBFS_NM_aktiv_DiagnoseDec
{
    if( getValue( this ))  putValue( eNM_STSG_HBFS_NM_aktiv_DiagnoseS, getValue( eNM_STSG_HBFS_NM_aktiv_DiagnoseS ) - 1);
}

//NM_STSG_HBFS_NM_aktiv_Diagnose
on EnvVar eNM_STSG_HBFS_NM_aktiv_DiagnoseDef
{
    putValue( eNM_STSG_HBFS_NM_aktiv_DiagnoseS, 0);
}

//NM_STSG_HBFS_NM_aktiv_Diagnose
on EnvVar eNM_STSG_HBFS_NM_aktiv_DiagnoseInc
{
    if( getValue( this ))  putValue( eNM_STSG_HBFS_NM_aktiv_DiagnoseS, getValue( eNM_STSG_HBFS_NM_aktiv_DiagnoseS ) + 1);
}

//NM_STSG_HBFS_NM_aktiv_Tmin
on EnvVar eNM_STSG_HBFS_NM_aktiv_TminDec
{
    if( getValue( this ))  putValue( eNM_STSG_HBFS_NM_aktiv_TminS, getValue( eNM_STSG_HBFS_NM_aktiv_TminS ) - 1);
}

//NM_STSG_HBFS_NM_aktiv_Tmin
on EnvVar eNM_STSG_HBFS_NM_aktiv_TminDef
{
    putValue( eNM_STSG_HBFS_NM_aktiv_TminS, 0);
}

//NM_STSG_HBFS_NM_aktiv_Tmin
on EnvVar eNM_STSG_HBFS_NM_aktiv_TminInc
{
    if( getValue( this ))  putValue( eNM_STSG_HBFS_NM_aktiv_TminS, getValue( eNM_STSG_HBFS_NM_aktiv_TminS ) + 1);
}

//NM_STSG_HBFS_CAB_V09
on EnvVar eNM_STSG_HBFS_CAB_V09Dec
{
    if( getValue( this ))  putValue( eNM_STSG_HBFS_CAB_V09S, getValue( eNM_STSG_HBFS_CAB_V09S ) - 1);
}

//NM_STSG_HBFS_CAB_V09
on EnvVar eNM_STSG_HBFS_CAB_V09Def
{
    putValue( eNM_STSG_HBFS_CAB_V09S, 0);
}

//NM_STSG_HBFS_CAB_V09
on EnvVar eNM_STSG_HBFS_CAB_V09Inc
{
    if( getValue( this ))  putValue( eNM_STSG_HBFS_CAB_V09S, getValue( eNM_STSG_HBFS_CAB_V09S ) + 1);
}

//NM_STSG_HFS_CBV_AWB
on EnvVar eNM_STSG_HFS_CBV_AWBDec
{
    if( getValue( this ))  putValue( eNM_STSG_HFS_CBV_AWBS, getValue( eNM_STSG_HFS_CBV_AWBS ) - 1);
}

//NM_STSG_HFS_CBV_AWB
on EnvVar eNM_STSG_HFS_CBV_AWBDef
{
    putValue( eNM_STSG_HFS_CBV_AWBS, 0);
}

//NM_STSG_HFS_CBV_AWB
on EnvVar eNM_STSG_HFS_CBV_AWBInc
{
    if( getValue( this ))  putValue( eNM_STSG_HFS_CBV_AWBS, getValue( eNM_STSG_HFS_CBV_AWBS ) + 1);
}

//NM_STSG_HFS_CBV_CRI
on EnvVar eNM_STSG_HFS_CBV_CRIDec
{
    if( getValue( this ))  putValue( eNM_STSG_HFS_CBV_CRIS, getValue( eNM_STSG_HFS_CBV_CRIS ) - 1);
}

//NM_STSG_HFS_CBV_CRI
on EnvVar eNM_STSG_HFS_CBV_CRIDef
{
    putValue( eNM_STSG_HFS_CBV_CRIS, 0);
}

//NM_STSG_HFS_CBV_CRI
on EnvVar eNM_STSG_HFS_CBV_CRIInc
{
    if( getValue( this ))  putValue( eNM_STSG_HFS_CBV_CRIS, getValue( eNM_STSG_HFS_CBV_CRIS ) + 1);
}

//NM_STSG_HFS_NM_State
on EnvVar eNM_STSG_HFS_NM_StateDec
{
    if( getValue( this ))  putValue( eNM_STSG_HFS_NM_StateS, getValue( eNM_STSG_HFS_NM_StateS ) - 1);
}

//NM_STSG_HFS_NM_State
on EnvVar eNM_STSG_HFS_NM_StateDef
{
    putValue( eNM_STSG_HFS_NM_StateS, 0);
}

//NM_STSG_HFS_NM_State
on EnvVar eNM_STSG_HFS_NM_StateInc
{
    if( getValue( this ))  putValue( eNM_STSG_HFS_NM_StateS, getValue( eNM_STSG_HFS_NM_StateS ) + 1);
}

//NM_STSG_HFS_Car_Wakeup
on EnvVar eNM_STSG_HFS_Car_WakeupDec
{
    if( getValue( this ))  putValue( eNM_STSG_HFS_Car_WakeupS, getValue( eNM_STSG_HFS_Car_WakeupS ) - 1);
}

//NM_STSG_HFS_Car_Wakeup
on EnvVar eNM_STSG_HFS_Car_WakeupDef
{
    putValue( eNM_STSG_HFS_Car_WakeupS, 0);
}

//NM_STSG_HFS_Car_Wakeup
on EnvVar eNM_STSG_HFS_Car_WakeupInc
{
    if( getValue( this ))  putValue( eNM_STSG_HFS_Car_WakeupS, getValue( eNM_STSG_HFS_Car_WakeupS ) + 1);
}

//NM_STSG_HFS_UDS_CC
on EnvVar eNM_STSG_HFS_UDS_CCDec
{
    if( getValue( this ))  putValue( eNM_STSG_HFS_UDS_CCS, getValue( eNM_STSG_HFS_UDS_CCS ) - 1);
}

//NM_STSG_HFS_UDS_CC
on EnvVar eNM_STSG_HFS_UDS_CCDef
{
    putValue( eNM_STSG_HFS_UDS_CCS, 0);
}

//NM_STSG_HFS_UDS_CC
on EnvVar eNM_STSG_HFS_UDS_CCInc
{
    if( getValue( this ))  putValue( eNM_STSG_HFS_UDS_CCS, getValue( eNM_STSG_HFS_UDS_CCS ) + 1);
}

//NM_STSG_HFS_NM_aktiv_KL15
on EnvVar eNM_STSG_HFS_NM_aktiv_KL15Dec
{
    if( getValue( this ))  putValue( eNM_STSG_HFS_NM_aktiv_KL15S, getValue( eNM_STSG_HFS_NM_aktiv_KL15S ) - 1);
}

//NM_STSG_HFS_NM_aktiv_KL15
on EnvVar eNM_STSG_HFS_NM_aktiv_KL15Def
{
    putValue( eNM_STSG_HFS_NM_aktiv_KL15S, 0);
}

//NM_STSG_HFS_NM_aktiv_KL15
on EnvVar eNM_STSG_HFS_NM_aktiv_KL15Inc
{
    if( getValue( this ))  putValue( eNM_STSG_HFS_NM_aktiv_KL15S, getValue( eNM_STSG_HFS_NM_aktiv_KL15S ) + 1);
}

//NM_STSG_HFS_NM_aktiv_Diagnose
on EnvVar eNM_STSG_HFS_NM_aktiv_DiagnoseDec
{
    if( getValue( this ))  putValue( eNM_STSG_HFS_NM_aktiv_DiagnoseS, getValue( eNM_STSG_HFS_NM_aktiv_DiagnoseS ) - 1);
}

//NM_STSG_HFS_NM_aktiv_Diagnose
on EnvVar eNM_STSG_HFS_NM_aktiv_DiagnoseDef
{
    putValue( eNM_STSG_HFS_NM_aktiv_DiagnoseS, 0);
}

//NM_STSG_HFS_NM_aktiv_Diagnose
on EnvVar eNM_STSG_HFS_NM_aktiv_DiagnoseInc
{
    if( getValue( this ))  putValue( eNM_STSG_HFS_NM_aktiv_DiagnoseS, getValue( eNM_STSG_HFS_NM_aktiv_DiagnoseS ) + 1);
}

//NM_STSG_HFS_NM_aktiv_Tmin
on EnvVar eNM_STSG_HFS_NM_aktiv_TminDec
{
    if( getValue( this ))  putValue( eNM_STSG_HFS_NM_aktiv_TminS, getValue( eNM_STSG_HFS_NM_aktiv_TminS ) - 1);
}

//NM_STSG_HFS_NM_aktiv_Tmin
on EnvVar eNM_STSG_HFS_NM_aktiv_TminDef
{
    putValue( eNM_STSG_HFS_NM_aktiv_TminS, 0);
}

//NM_STSG_HFS_NM_aktiv_Tmin
on EnvVar eNM_STSG_HFS_NM_aktiv_TminInc
{
    if( getValue( this ))  putValue( eNM_STSG_HFS_NM_aktiv_TminS, getValue( eNM_STSG_HFS_NM_aktiv_TminS ) + 1);
}

//NM_STSG_HFS_CAB_V09
on EnvVar eNM_STSG_HFS_CAB_V09Dec
{
    if( getValue( this ))  putValue( eNM_STSG_HFS_CAB_V09S, getValue( eNM_STSG_HFS_CAB_V09S ) - 1);
}

//NM_STSG_HFS_CAB_V09
on EnvVar eNM_STSG_HFS_CAB_V09Def
{
    putValue( eNM_STSG_HFS_CAB_V09S, 0);
}

//NM_STSG_HFS_CAB_V09
on EnvVar eNM_STSG_HFS_CAB_V09Inc
{
    if( getValue( this ))  putValue( eNM_STSG_HFS_CAB_V09S, getValue( eNM_STSG_HFS_CAB_V09S ) + 1);
}

//OBDC_Funktionaler_Req_All_Data
on EnvVar eOBDC_Funktionaler_Req_All_DataDec
{
    if( getValue( this ))  putValue( eOBDC_Funktionaler_Req_All_DataS, getValue( eOBDC_Funktionaler_Req_All_DataS ) - 1);
}

//OBDC_Funktionaler_Req_All_Data
on EnvVar eOBDC_Funktionaler_Req_All_DataDef
{
    putValue( eOBDC_Funktionaler_Req_All_DataS, 0);
}

//OBDC_Funktionaler_Req_All_Data
on EnvVar eOBDC_Funktionaler_Req_All_DataInc
{
    if( getValue( this ))  putValue( eOBDC_Funktionaler_Req_All_DataS, getValue( eOBDC_Funktionaler_Req_All_DataS ) + 1);
}

//WFS_Transponder_Req_02_Data
on EnvVar eWFS_Transponder_Req_02_DataDec
{
    if( getValue( this ))  putValue( eWFS_Transponder_Req_02_DataS, getValue( eWFS_Transponder_Req_02_DataS ) - 1);
}

//WFS_Transponder_Req_02_Data
on EnvVar eWFS_Transponder_Req_02_DataDef
{
    putValue( eWFS_Transponder_Req_02_DataS, 0);
}

//WFS_Transponder_Req_02_Data
on EnvVar eWFS_Transponder_Req_02_DataInc
{
    if( getValue( this ))  putValue( eWFS_Transponder_Req_02_DataS, getValue( eWFS_Transponder_Req_02_DataS ) + 1);
}

//CHA_Charge_LED
on EnvVar eCHA_Charge_LEDDec
{
    if( getValue( this ))  putValue( eCHA_Charge_LEDS, getValue( eCHA_Charge_LEDS ) - 1);
}

//CHA_Charge_LED
on EnvVar eCHA_Charge_LEDDef
{
    putValue( eCHA_Charge_LEDS, 0);
}

//CHA_Charge_LED
on EnvVar eCHA_Charge_LEDInc
{
    if( getValue( this ))  putValue( eCHA_Charge_LEDS, getValue( eCHA_Charge_LEDS ) + 1);
}

//ACC_Abstandsindex_02
on EnvVar eACC_Abstandsindex_02Dec
{
    if( getValue( this ))  putValue( eACC_Abstandsindex_02S, getValue( eACC_Abstandsindex_02S ) - 1);
}

//ACC_Abstandsindex_02
on EnvVar eACC_Abstandsindex_02Def
{
    putValue( eACC_Abstandsindex_02S, 0);
}

//ACC_Abstandsindex_02
on EnvVar eACC_Abstandsindex_02Inc
{
    if( getValue( this ))  putValue( eACC_Abstandsindex_02S, getValue( eACC_Abstandsindex_02S ) + 1);
}

//ACC_Relevantes_Objekt_02
on EnvVar eACC_Relevantes_Objekt_02Dec
{
    if( getValue( this ))  putValue( eACC_Relevantes_Objekt_02S, getValue( eACC_Relevantes_Objekt_02S ) - 1);
}

//ACC_Relevantes_Objekt_02
on EnvVar eACC_Relevantes_Objekt_02Def
{
    putValue( eACC_Relevantes_Objekt_02S, 0);
}

on EnvVar eACC_Relevantes_Objekt_02Inc
{
    if( getValue( this ))  putValue( eACC_Relevantes_Objekt_02S, getValue( eACC_Relevantes_Objekt_02S ) + 1);
}

//ACC_Texte_Primaeranz_03
on EnvVar eACC_Texte_Primaeranz_03Dec
{
    if( getValue( this ))  putValue( eACC_Texte_Primaeranz_03S, getValue( eACC_Texte_Primaeranz_03S ) - 1);
}

on EnvVar eACC_Texte_Primaeranz_03Def
{
    putValue( eACC_Texte_Primaeranz_03S, 0);
}

on EnvVar eACC_Texte_Primaeranz_03Inc
{
    if( getValue( this ))  putValue( eACC_Texte_Primaeranz_03S, getValue( eACC_Texte_Primaeranz_03S ) + 1);
}

on EnvVar eACC_Akustik_03Dec
{
    if( getValue( this ))  putValue( eACC_Akustik_03S, getValue( eACC_Akustik_03S ) - 1);
}

//ACC_Akustik_03
on EnvVar eACC_Akustik_03Def
{
    putValue( eACC_Akustik_03S, 0);
}

//ACC_Akustik_03
on EnvVar eACC_Akustik_03Inc
{
    if( getValue( this ))  putValue( eACC_Akustik_03S, getValue( eACC_Akustik_03S ) + 1);
}

//ACC_Texte_02
on EnvVar eACC_Texte_02Dec
{
    if( getValue( this ))  putValue( eACC_Texte_02S, getValue( eACC_Texte_02S ) - 1);
}

//ACC_Texte_02
on EnvVar eACC_Texte_02Def
{
    putValue( eACC_Texte_02S, 0);
}

//ACC_Texte_02
on EnvVar eACC_Texte_02Inc
{
    if( getValue( this ))  putValue( eACC_Texte_02S, getValue( eACC_Texte_02S ) + 1);
}

on EnvVar eTTA_01Dec
{
    if( getValue( this ))  putValue( eTTA_01, dec( getValue( eTTA_01 ) ) );
}

on EnvVar eTTA_01Def
{
    putValue( eTTA_01,100 );
}

on EnvVar eTTA_01Inc
{
    if( getValue( this ))  putValue( eTTA_01, inc( getValue( eTTA_01 ) ) );
}

on EnvVar eTOTTA_01Dec
{
    if( getValue( this ))  putValue( eTOTTA_01, dec( getValue( eTOTTA_01 ) ) );
}

on EnvVar eTOTTA_01Def
{
    putValue( eTOTTA_01, 1000 );
}

on EnvVar eTOTTA_01Inc
{
    if( getValue( this ))  putValue( eTOTTA_01, inc( getValue( eTOTTA_01 ) ) );
}

on EnvVar eDlcTA_01Dec
{
    if( getValue( this ))  putValue( eDlcTA_01, getValue( eDlcTA_01 ) - 1 );
}

on EnvVar eDlcTA_01Def
{
    putValue( eDlcTA_01, 8 );
}

on EnvVar eDlcTA_01Inc
{
    if( getValue( this ))  putValue( eDlcTA_01, getValue( eDlcTA_01 ) + 1 );
}

on EnvVar eTNavPos_01Dec
{
    if( getValue( this ))  putValue( eTNavPos_01, dec( getValue( eTNavPos_01 ) ) );
}

on EnvVar eTNavPos_01Def
{
    putValue( eTNavPos_01,200 );
}

on EnvVar eTNavPos_01Inc
{
    if( getValue( this ))  putValue( eTNavPos_01, inc( getValue( eTNavPos_01 ) ) );
}

on EnvVar eTOTNavPos_01Dec
{
    if( getValue( this ))  putValue( eTOTNavPos_01, dec( getValue( eTOTNavPos_01 ) ) );
}

on EnvVar eTOTNavPos_01Def
{
    putValue( eTOTNavPos_01, 2000 );
}

on EnvVar eTOTNavPos_01Inc
{
    if( getValue( this ))  putValue( eTOTNavPos_01, inc( getValue( eTOTNavPos_01 ) ) );
}

on EnvVar eDlcNavPos_01Dec
{
    if( getValue( this ))  putValue( eDlcNavPos_01, getValue( eDlcNavPos_01 ) - 1 );
}

on EnvVar eDlcNavPos_01Def
{
    putValue( eDlcNavPos_01, 8 );
}

on EnvVar eDlcNavPos_01Inc
{
    if( getValue( this ))  putValue( eDlcNavPos_01, getValue( eDlcNavPos_01 ) + 1 );
}

on EnvVar eNP_LatDegreeDec
{
    if( getValue( this ))  putValue( eNP_LatDegreeS, getValue( eNP_LatDegreeS ) - 0.000001);
}

on EnvVar eNP_LatDegreeDef
{
    putValue( eNP_LatDegreeS, 134.217726);
}

on EnvVar eNP_LatDegreeInc
{
    if( getValue( this ))  putValue( eNP_LatDegreeS, getValue( eNP_LatDegreeS ) +0.000001);
}

on EnvVar eAWV_AW_AbstandDec
{
    if( getValue( this ))  putValue( eAWV_AW_AbstandS, getValue( eAWV_AW_AbstandS ) - 1);
}

on EnvVar eAWV_AW_AbstandDef
{
    putValue( eAWV_AW_AbstandS, 511);
}

on EnvVar eAWV_AW_AbstandInc
{
    if( getValue( this ))  putValue( eAWV_AW_AbstandS, getValue( eAWV_AW_AbstandS ) +1);
}

on EnvVar eAWV_AW_ZeitlueckeDec
{
    if( getValue( this ))  putValue( eAWV_AW_ZeitlueckeS, getValue( eAWV_AW_ZeitlueckeS ) - 1);
}

on EnvVar eAWV_AW_ZeitlueckeDef
{
    putValue( eAWV_AW_ZeitlueckeS, 0);
}

on EnvVar eAWV_AW_ZeitlueckeInc
{
    if( getValue( this ))  putValue( eAWV_AW_ZeitlueckeS, getValue( eAWV_AW_ZeitlueckeS ) + 1);
}

on EnvVar eMO_Anzeige_RekuperationDec
{
    if( getValue( this ))  putValue( eMO_Anzeige_RekuperationS, getValue( eMO_Anzeige_RekuperationS ) - 0.5);
}

on EnvVar eMO_Anzeige_RekuperationDef
{
    putValue( eMO_Anzeige_RekuperationS, -0.5);
}

on EnvVar eMO_Anzeige_RekuperationInc
{
    if( getValue( this ))  putValue( eMO_Anzeige_RekuperationS, getValue( eMO_Anzeige_RekuperationS ) + 0.5);
}

on EnvVar eMO_Anzeige_Verbrauch_oEDec
{
    if( getValue( this ))  putValue( eMO_Anzeige_Verbrauch_oES, getValue( eMO_Anzeige_Verbrauch_oES ) - 0.005);
}

on EnvVar eMO_Anzeige_Verbrauch_oEDef
{
    putValue( eMO_Anzeige_Verbrauch_oES, 0);
}

on EnvVar eMO_Anzeige_Verbrauch_oEInc
{
    if( getValue( this ))  putValue( eMO_Anzeige_Verbrauch_oES, getValue( eMO_Anzeige_Verbrauch_oES ) + 0.005);
}

/*on EnvVar eMO_Anzeige_Verbr_EinheitDec
{
    if( getValue( this ))  putValue( eMO_Anzeige_Verbr_EinheitS, getValue( eMO_Anzeige_Verbr_EinheitS ) - 1);
}*/

/*on EnvVar eMO_Anzeige_Verbr_EinheitDef
{
  p*utValue( eMO_Anzeige_Verbr_EinheitS, 0);
}*/

/*on EnvVar eMO_Anzeige_Verbr_EinheitInc
{
    if( getValue( this ))  putValue( eMO_Anzeige_Verbr_EinheitS, getValue( eMO_Anzeige_Verbr_EinheitS ) +1);
}*/

on EnvVar eNP_LongDegreeDec
{
    if( getValue( this ))  putValue( eNP_LongDegreeS, getValue( eNP_LongDegreeS ) - 0.000001);
}

on EnvVar eNP_LongDegreeDef
{
    putValue( eNP_LongDegreeS, 268.435454);
}

on EnvVar eNP_LongDegreeInc
{
    if( getValue( this ))  putValue( eNP_LongDegreeS, getValue( eNP_LongDegreeS ) +0.000001);
}

on EnvVar eNP_FixDec
{
    if( getValue( this ))  putValue( eNP_FixS, getValue( eNP_FixS ) - 1);
}

on EnvVar eNP_FixDef
{
    putValue( eNP_FixS, 0);
}

on EnvVar eNP_FixInc
{
    if( getValue( this ))  putValue( eNP_FixS, getValue( eNP_FixS ) +1);
}

on EnvVar eTA_StatusDec
{
    if( getValue( this ))  putValue( eTA_StatusS, getValue( eTA_StatusS ) - 1);
}

on EnvVar eTA_StatusDef
{
    putValue( eTA_StatusS, 0);
}

on EnvVar eTA_StatusInc
{
    if( getValue( this ))  putValue( eTA_StatusS, getValue( eTA_StatusS ) +1);
}

on EnvVar eTA_SpurwechselDec
{
    if( getValue( this ))  putValue( eTA_SpurwechselS, getValue( eTA_SpurwechselS ) - 1);
}

on EnvVar eTA_SpurwechselDef
{
    putValue( eTA_SpurwechselS, 0);
}

on EnvVar eTA_SpurwechselInc
{
    if( getValue( this ))  putValue( eTA_SpurwechselS, getValue( eTA_SpurwechselS ) +1);
}

on EnvVar eTA_TexteDec
{
    if( getValue( this ))  putValue( eTA_TexteS, getValue( eTA_TexteS ) - 1);
}

on EnvVar eTA_TexteDef
{
    putValue( eTA_TexteS, 0);
}

on EnvVar eTA_TexteInc
{
    if( getValue( this ))  putValue( eTA_TexteS, getValue( eTA_TexteS ) +1);
}

on EnvVar eWFS_FahrerhinweiseDec
{
    if( getValue( this ))  putValue( eWFS_FahrerhinweiseS, getValue( eWFS_FahrerhinweiseS ) - 1);
}

on EnvVar eWFS_FahrerhinweiseDef
{
    putValue( eWFS_FahrerhinweiseS, 0);
}

on EnvVar eWFS_FahrerhinweiseInc
{
    if( getValue( this ))  putValue( eWFS_FahrerhinweiseS, getValue( eWFS_FahrerhinweiseS ) +1);
}

on EnvVar eASTA_StuetzlastDef
{
    putValue( eASTA_StuetzlastS, 0);
}

on EnvVar eASTA_EinheitDef
{
    putValue( eASTA_EinheitS, 0);
}

on EnvVar eASTA_AnhaengerlastDef
{
    putValue( eASTA_AnhaengerlastS, 0);
}

on EnvVar eASTA_StuetzlastInc
{
    if( getValue( this ))
  {
    if(getValue( eASTA_StuetzlastS ) < 300)
      putValue( eASTA_StuetzlastS, getValue( eASTA_StuetzlastS ) + 1 );
  }
}

on EnvVar eASTA_StuetzlastDec
{
    if( getValue( this ))
  {
    if(getValue( eASTA_StuetzlastS ) > 0)
      putValue( eASTA_StuetzlastS, getValue( eASTA_StuetzlastS ) - 1 );
  }
}

on EnvVar eASTA_EinheitInc
{
    if( getValue( this ))
  {
    if(getValue( eASTA_EinheitS ) < 3)
      putValue( eASTA_EinheitS, getValue( eASTA_EinheitS ) + 1 );
  }
}

on EnvVar eASTA_EinheitDec
{
    if( getValue( this ))
  {
    if(getValue( eASTA_EinheitS ) > 0)
      putValue( eASTA_EinheitS, getValue( eASTA_EinheitS ) - 1 );
  }
}

on EnvVar eASTA_AnhaengerlastInc
{
    if( getValue( this ))
  {
    if(getValue( eASTA_AnhaengerlastS ) < 5000)
      putValue( eASTA_AnhaengerlastS, getValue( eASTA_AnhaengerlastS ) + 1 );
  }
}

on EnvVar eASTA_AnhaengerlastDec
{
    if( getValue( this ))
  {
    if(getValue( eASTA_AnhaengerlastS ) > 0)
      putValue( eASTA_AnhaengerlastS, getValue( eASTA_AnhaengerlastS ) - 1 );
  }
}

//GVJ-5409
on EnvVar eACC_Texte_Zusatzanz_03Dec
{
    if( getValue( this ))  putValue( eACC_Texte_Zusatzanz_03S, getValue( eACC_Texte_Zusatzanz_03S ) - 1);
}

//GVJ-5409
on EnvVar eACC_Texte_Zusatzanz_03Def
{
    putValue( eACC_Texte_Zusatzanz_03S, 0);
}

//GVJ-5409
on EnvVar eACC_Texte_Zusatzanz_03Inc
{
    if( getValue( this ))  putValue( eACC_Texte_Zusatzanz_03S, getValue( eACC_Texte_Zusatzanz_03S ) + 1);
}

//GVJ-5409
on EnvVar eCHA_Current_Mode_FPADec
{
    if( getValue( this ))  putValue( eCHA_Current_Mode_FPAS, getValue( eCHA_Current_Mode_FPAS ) - 1);
}

//GVJ-5409
on EnvVar eCHA_Current_Mode_FPADef
{
    putValue( eCHA_Current_Mode_FPAS, 0);
}

//GVJ-5409
on EnvVar eCHA_Current_Mode_FPAInc
{
    if( getValue( this ))  putValue( eCHA_Current_Mode_FPAS, getValue( eCHA_Current_Mode_FPAS ) + 1);
}

//GVJ-5409

on EnvVar eKST_ZuendungswarnungDec
{
    if( getValue( this ))  putValue( eKST_ZuendungswarnungS, getValue( eKST_ZuendungswarnungS ) - 1);
}

//GVJ-5409
on EnvVar eKST_ZuendungswarnungDef
{
    putValue( eKST_ZuendungswarnungS, 0);
}

//GVJ-5409
on EnvVar eKST_ZuendungswarnungInc
{
    if( getValue( this ))  putValue( eKST_ZuendungswarnungS, getValue( eKST_ZuendungswarnungS ) + 1);
}

//GVJ-5409
on EnvVar ePLA_Fortschritt_bis_ZugendeDec
{
    if( getValue( this ))  putValue( ePLA_Fortschritt_bis_ZugendeS, getValue( ePLA_Fortschritt_bis_ZugendeS ) - 1);
}

//GVJ-5409
on EnvVar ePLA_Fortschritt_bis_ZugendeDef
{
    putValue( ePLA_Fortschritt_bis_ZugendeS, 126);
}

//GVJ-5409
on EnvVar ePLA_Fortschritt_bis_ZugendeInc
{
    if( getValue( this ))  putValue( ePLA_Fortschritt_bis_ZugendeS, getValue( ePLA_Fortschritt_bis_ZugendeS ) + 1);
}

//GVJ-5409
on EnvVar ePLA_Abstand_zur_ParklueckeDec
{
    if( getValue( this ))  putValue( ePLA_Abstand_zur_ParklueckeS, getValue( ePLA_Abstand_zur_ParklueckeS ) - 1);
}

//GVJ-5409
on EnvVar ePLA_Abstand_zur_ParklueckeDef
{
    putValue( ePLA_Abstand_zur_ParklueckeS, 2540);
}

//GVJ-5409
on EnvVar ePLA_Abstand_zur_ParklueckeInc
{
    if( getValue( this ))  putValue( ePLA_Abstand_zur_ParklueckeS, getValue( ePLA_Abstand_zur_ParklueckeS ) + 1);
}

//GVJ-5409
on EnvVar eWBA_Schaltschema_02Dec
{
    if( getValue( this ))  putValue( eWBA_Schaltschema_02S, getValue( eWBA_Schaltschema_02S ) - 1);
}

//GVJ-5409
on EnvVar eWBA_Schaltschema_02Def
{
    putValue( eWBA_Schaltschema_02S, 0);
}

//GVJ-5409
on EnvVar eWBA_Schaltschema_02Inc
{
    if( getValue( this ))  putValue( eWBA_Schaltschema_02S, getValue( eWBA_Schaltschema_02S ) + 1);
}

//GVJ-5409
on EnvVar eRW_Gesamt_ReichweiteDec
{
    if( getValue( this ))  putValue( eRW_Gesamt_ReichweiteS, getValue( eRW_Gesamt_ReichweiteS ) - 1);
}

//GVJ-5409
on EnvVar eRW_Gesamt_ReichweiteDef
{
    putValue( eRW_Gesamt_ReichweiteS, 2046);
}

//GVJ-5409
on EnvVar eRW_Gesamt_ReichweiteInc
{
    if( getValue( this ))  putValue( eRW_Gesamt_ReichweiteS, getValue( eRW_Gesamt_ReichweiteS ) + 1);
}

//GVJ-5409
on EnvVar eWBA_Schaltschema_FS_vorwaertsDec
{
    if( getValue( this ))  putValue( eWBA_Schaltschema_FS_vorwaertsS, getValue( eWBA_Schaltschema_FS_vorwaertsS ) - 1);
}

//GVJ-5409
on EnvVar eWBA_Schaltschema_FS_vorwaertsDef
{
    putValue( eWBA_Schaltschema_FS_vorwaertsS, 0);
}

//GVJ-5409
on EnvVar eWBA_Schaltschema_FS_vorwaertsInc
{
    if( getValue( this ))  putValue( eWBA_Schaltschema_FS_vorwaertsS, getValue( eWBA_Schaltschema_FS_vorwaertsS ) + 1);
}

//GVJ-5409
on EnvVar eWBA_GE_Texte_02Dec
{
    if( getValue( this ))  putValue( eWBA_GE_Texte_02S, getValue( eWBA_GE_Texte_02S ) - 1);
}

//GVJ-5409
on EnvVar eWBA_GE_Texte_02Def
{
    putValue( eWBA_GE_Texte_02S, 0);
}

//GVJ-5409
on EnvVar eWBA_GE_Texte_02Inc
{
    if( getValue( this ))  putValue( eWBA_GE_Texte_02S, getValue( eWBA_GE_Texte_02S ) + 1);
}

//GVJ-5409
on EnvVar eWBA_Schaltschema_FS_inaktivDec
{
    if( getValue( this ))  putValue( eWBA_Schaltschema_FS_inaktivS, getValue( eWBA_Schaltschema_FS_inaktivS ) - 1);
}

//GVJ-5409
on EnvVar eWBA_Schaltschema_FS_inaktivDef
{
    putValue( eWBA_Schaltschema_FS_inaktivS, 0);
}

//GVJ-5409
on EnvVar eWBA_Schaltschema_FS_inaktivInc
{
    if( getValue( this ))  putValue( eWBA_Schaltschema_FS_inaktivS, getValue( eWBA_Schaltschema_FS_inaktivS ) + 1);
}

//GVJ-5409
on EnvVar eACC_StatusiconDec
{
    if( getValue( this ))  putValue( eACC_StatusiconS, getValue( eACC_StatusiconS ) - 1);
}

//GVJ-5409
on EnvVar eACC_StatusiconDef
{
    putValue( eACC_StatusiconS, 0);
}

//GVJ-5409
on EnvVar eACC_StatusiconInc
{
    if( getValue( this ))  putValue( eACC_StatusiconS, getValue( eACC_StatusiconS ) + 1);
}

//GVJ-5409
on EnvVar eACC_Anzeige_ObjektregelungDec
{
    if( getValue( this ))  putValue( eACC_Anzeige_ObjektregelungS, getValue( eACC_Anzeige_ObjektregelungS ) - 1);
}

//GVJ-5409
on EnvVar eACC_Anzeige_ObjektregelungDef
{
    putValue( eACC_Anzeige_ObjektregelungS, 0);
}

//GVJ-5409
on EnvVar eACC_Anzeige_ObjektregelungInc
{
    if( getValue( this ))  putValue( eACC_Anzeige_ObjektregelungS, getValue( eACC_Anzeige_ObjektregelungS ) + 1);
}

//GVJ-5409
on EnvVar eACC_Anzeige_MaximalabstandDec
{
    if( getValue( this ))  putValue( eACC_Anzeige_MaximalabstandS, getValue( eACC_Anzeige_MaximalabstandS ) - 2);
}

//GVJ-5409
on EnvVar eACC_Anzeige_MaximalabstandDef
{
    putValue( eACC_Anzeige_MaximalabstandS, 0);
}

//GVJ-5409
on EnvVar eACC_Anzeige_MaximalabstandInc
{
    if( getValue( this ))  putValue( eACC_Anzeige_MaximalabstandS, getValue( eACC_Anzeige_MaximalabstandS ) + 2);
}

//GVJ-5409
on EnvVar eACC_Typ_LNSDec
{
    if( getValue( this ))  putValue( eACC_Typ_LNSS, getValue( eACC_Typ_LNSS ) - 1);
}

//GVJ-5409
on EnvVar eACC_Typ_LNSDef
{
    putValue( eACC_Typ_LNSS, 0);
}

//GVJ-5409
on EnvVar eACC_Typ_LNSInc
{
    if( getValue( this ))  putValue( eACC_Typ_LNSS, getValue( eACC_Typ_LNSS ) + 1);
}

//GVJ-5409
on EnvVar eACC_Typ_RNSDec
{
    if( getValue( this ))  putValue( eACC_Typ_RNSS, getValue( eACC_Typ_RNSS ) - 1);
}

//GVJ-5409
on EnvVar eACC_Typ_RNSDef
{
    putValue( eACC_Typ_RNSS, 0);
}

//GVJ-5409
on EnvVar eACC_Typ_RNSInc
{
    if( getValue( this ))  putValue( eACC_Typ_RNSS, getValue( eACC_Typ_RNSS ) + 1);
}

//GVJ-5409
on EnvVar eACC_Typ_WZODec
{
    if( getValue( this ))  putValue( eACC_Typ_WZOS, getValue( eACC_Typ_WZOS ) - 1);
}

//GVJ-5409
on EnvVar eACC_Typ_WZODef
{
    putValue( eACC_Typ_WZOS, 0);
}

//GVJ-5409
on EnvVar eACC_Typ_WZOInc
{
    if( getValue( this ))  putValue( eACC_Typ_WZOS, getValue( eACC_Typ_WZOS ) + 1);
}

//GVJ-5409
on EnvVar eACC_Abstand_WZODec
{
    if( getValue( this ))  putValue( eACC_Abstand_WZOS, getValue( eACC_Abstand_WZOS ) - 0.2);
}

//GVJ-5409
on EnvVar eACC_Abstand_WZODef
{
    putValue( eACC_Abstand_WZOS, 0);
}

//GVJ-5409
on EnvVar eACC_Abstand_WZOInc
{
    if( getValue( this ))  putValue( eACC_Abstand_WZOS, getValue( eACC_Abstand_WZOS ) + 0.2);
}

//GVJ-5409
on EnvVar eACC_Abstand_RNSDec
{
    if( getValue( this ))  putValue( eACC_Abstand_RNSS, getValue( eACC_Abstand_RNSS ) - 0.2);
}

//GVJ-5409
on EnvVar eACC_Abstand_RNSDef
{
    putValue( eACC_Abstand_RNSS, 0);
}

//GVJ-5409
on EnvVar eACC_Abstand_RNSInc
{
    if( getValue( this ))  putValue( eACC_Abstand_RNSS, getValue( eACC_Abstand_RNSS ) + 0.2);
}

//GVJ-5409
on EnvVar eACC_Abstand_LNSDec
{
    if( getValue( this ))  putValue( eACC_Abstand_LNSS, getValue( eACC_Abstand_LNSS ) - 0.2);
}

//GVJ-5409
on EnvVar eACC_Abstand_LNSDef
{
    putValue( eACC_Abstand_LNSS, 0);
}

//GVJ-5409
on EnvVar eACC_Abstand_LNSInc
{
    if( getValue( this ))  putValue( eACC_Abstand_LNSS, getValue( eACC_Abstand_LNSS ) + 0.2);
}

//GVJ-5409
on EnvVar eACC_Texte_Sekundaeranz_02Dec
{
    if( getValue( this ))  putValue( eACC_Texte_Sekundaeranz_02S, getValue( eACC_Texte_Sekundaeranz_02S ) - 1);
}

//GVJ-5409
on EnvVar eACC_Texte_Sekundaeranz_02Def
{
    putValue( eACC_Texte_Sekundaeranz_02S, 0);
}

//GVJ-5409
on EnvVar eACC_Texte_Sekundaeranz_02Inc
{
    if( getValue( this ))  putValue( eACC_Texte_Sekundaeranz_02S, getValue( eACC_Texte_Sekundaeranz_02S ) + 1);
}

//GVJ-5409
on EnvVar eACC_Sollabstand_1Dec
{
    if( getValue( this ))  putValue( eACC_Sollabstand_1S, getValue( eACC_Sollabstand_1S ) - 0.2);
}

//GVJ-5409
on EnvVar eACC_Sollabstand_1Def
{
    putValue( eACC_Sollabstand_1S, 0);
}

//GVJ-5409
on EnvVar eACC_Sollabstand_1Inc
{
    if( getValue( this ))  putValue( eACC_Sollabstand_1S, getValue( eACC_Sollabstand_1S ) + 0.2);
}

//GVJ-5409
on EnvVar eACC_Sollabstand_2Dec
{
    if( getValue( this ))  putValue( eACC_Sollabstand_2S, getValue( eACC_Sollabstand_2S ) - 0.2);
}

//GVJ-5409
on EnvVar eACC_Sollabstand_2Def
{
    putValue( eACC_Sollabstand_2S, 0);
}

//GVJ-5409
on EnvVar eACC_Sollabstand_2Inc
{
    if( getValue( this ))  putValue( eACC_Sollabstand_2S, getValue( eACC_Sollabstand_2S ) + 0.2);
}

//GVJ-5409
on EnvVar eACC_Sollabstand_3Dec
{
    if( getValue( this ))  putValue( eACC_Sollabstand_3S, getValue( eACC_Sollabstand_3S ) - 0.2);
}

//GVJ-5409
on EnvVar eACC_Sollabstand_3Def
{
    putValue( eACC_Sollabstand_3S, 0);
}

//GVJ-5409
on EnvVar eACC_Sollabstand_3Inc
{
    if( getValue( this ))  putValue( eACC_Sollabstand_3S, getValue( eACC_Sollabstand_3S ) + 0.2);
}

//GVJ-5409
on EnvVar eACC_Sollabstand_4Dec
{
    if( getValue( this ))  putValue( eACC_Sollabstand_4S, getValue( eACC_Sollabstand_4S ) - 0.2);
}

//GVJ-5409
on EnvVar eACC_Sollabstand_4Def
{
    putValue( eACC_Sollabstand_4S, 0);
}

//GVJ-5409
on EnvVar eACC_Sollabstand_4Inc
{
    if( getValue( this ))  putValue( eACC_Sollabstand_4S, getValue( eACC_Sollabstand_4S ) + 0.2);
}

//GVJ-5409
on EnvVar eACC_Sollabstand_5Dec
{
    if( getValue( this ))  putValue( eACC_Sollabstand_5S, getValue( eACC_Sollabstand_5S ) - 0.2);
}

//GVJ-5409
on EnvVar eACC_Sollabstand_5Def
{
    putValue( eACC_Sollabstand_5S, 0);
}

//GVJ-5409
on EnvVar eACC_Sollabstand_5Inc
{
    if( getValue( this ))  putValue( eACC_Sollabstand_5S, getValue( eACC_Sollabstand_5S ) + 0.2);
}

//GVJ-5409
on EnvVar eAB_Gurtschloss_Reihe4_FADec
{
    if( getValue( this ))  putValue( eAB_Gurtschloss_Reihe4_FAS, getValue( eAB_Gurtschloss_Reihe4_FAS ) - 1);
}

//GVJ-5409
on EnvVar eAB_Gurtschloss_Reihe4_FADef
{
    putValue( eAB_Gurtschloss_Reihe4_FAS, 1);
}

//GVJ-5409
on EnvVar eAB_Gurtschloss_Reihe4_FAInc
{
    if( getValue( this ))  putValue( eAB_Gurtschloss_Reihe4_FAS, getValue( eAB_Gurtschloss_Reihe4_FAS ) + 1);
}

//GVJ-5409
on EnvVar eAB_Gurtschloss_Reihe4_BFDec
{
    if( getValue( this ))  putValue( eAB_Gurtschloss_Reihe4_BFS, getValue( eAB_Gurtschloss_Reihe4_BFS ) - 1);
}

//GVJ-5409
on EnvVar eAB_Gurtschloss_Reihe4_BFDef
{
    putValue( eAB_Gurtschloss_Reihe4_BFS, 1);
}

//GVJ-5409
on EnvVar eAB_Gurtschloss_Reihe4_BFInc
{
    if( getValue( this ))  putValue( eAB_Gurtschloss_Reihe4_BFS, getValue( eAB_Gurtschloss_Reihe4_BFS ) + 1);
}

//GVJ-5409
on EnvVar eAB_Gurtschloss_Reihe4_MIDec
{
    if( getValue( this ))  putValue( eAB_Gurtschloss_Reihe4_MIS, getValue( eAB_Gurtschloss_Reihe4_MIS ) - 1);
}

//GVJ-5409
on EnvVar eAB_Gurtschloss_Reihe4_MIDef
{
    putValue( eAB_Gurtschloss_Reihe4_MIS, 1);
}

on EnvVar eAB_Gurtschloss_Reihe4_MIInc
{
    if( getValue( this ))  putValue( eAB_Gurtschloss_Reihe4_MIS, getValue( eAB_Gurtschloss_Reihe4_MIS ) + 1);
}

on EnvVar eMO_Tankbereitschaft_StatusDec
{
    if( getValue( this ))  putValue( eMO_Tankbereitschaft_StatusS, getValue( eMO_Tankbereitschaft_StatusS ) - 1);
}

on EnvVar eMO_Tankbereitschaft_StatusDef
{
    putValue( eMO_Tankbereitschaft_StatusS, 0);
}

on EnvVar eMO_Tankbereitschaft_StatusInc
{
    if( getValue( this ))  putValue( eMO_Tankbereitschaft_StatusS, getValue( eMO_Tankbereitschaft_StatusS ) + 1);
}

//GVJ-5409

//GVJ-5409
on EnvVar eSC_PreCrash_WarnungDec
{
    if( getValue( this ))  putValue( eSC_PreCrash_WarnungS, getValue( eSC_PreCrash_WarnungS ) - 1);
}

//GVJ-5409
on EnvVar eSC_PreCrash_WarnungDef
{
    putValue( eSC_PreCrash_WarnungS, 0);
}

//GVJ-5409
on EnvVar eSC_PreCrash_WarnungInc
{
    if( getValue( this ))  putValue( eSC_PreCrash_WarnungS, getValue( eSC_PreCrash_WarnungS ) + 1);
}

//GVJ-5409
on EnvVar eSC_PreCrash_TexteDec
{
    if( getValue( this ))  putValue( eSC_PreCrash_TexteS, getValue( eSC_PreCrash_TexteS ) - 1);
}

//GVJ-5409
on EnvVar eSC_PreCrash_TexteDef
{
    putValue( eSC_PreCrash_TexteS, 0);
}

//GVJ-5409
on EnvVar eSC_PreCrash_TexteInc
{
    if( getValue( this ))  putValue( eSC_PreCrash_TexteS, getValue( eSC_PreCrash_TexteS ) + 1);
}

//GVJ-5409
on EnvVar eSOK_ungeschuetzte_ZeitDec
{
    if( getValue( this ))  putValue( eSOK_ungeschuetzte_ZeitS, getValue( eSOK_ungeschuetzte_ZeitS ) - 1);
}

//GVJ-5409
on EnvVar eSOK_ungeschuetzte_ZeitDef
{
    putValue( eSOK_ungeschuetzte_ZeitS, 1);
}

//GVJ-5409
on EnvVar eSOK_ungeschuetzte_ZeitInc
{
    if( getValue( this ))  putValue( eSOK_ungeschuetzte_ZeitS, getValue( eSOK_ungeschuetzte_ZeitS ) + 1);
}

//GVJ-5409
on EnvVar eWH_Warnung_02Dec
{
    if( getValue( this ))  putValue( eWH_Warnung_02S, getValue( eWH_Warnung_02S ) - 1);
}

//GVJ-5409
on EnvVar eWH_Warnung_02Def
{
    putValue( eWH_Warnung_02S, 0);
}

//GVJ-5409
on EnvVar eWH_Warnung_02Inc
{
    if( getValue( this ))  putValue( eWH_Warnung_02S, getValue( eWH_Warnung_02S ) + 1);
}

//GVJ-5409
on EnvVar eTACC_20Dec
{
    if( getValue( this ))  putValue( eTACC_20, dec( getValue( eTACC_20 ) ) );
}

//GVJ-5409
on EnvVar eTACC_20Def
{
    putValue( eTACC_20,60 );
}

//GVJ-5409
on EnvVar eTACC_20Inc
{
    if( getValue( this ))  putValue( eTACC_20, inc( getValue( eTACC_20 ) ) );
}

//GVJ-5409
on EnvVar eTOTACC_20Dec
{
    if( getValue( this ))  putValue( eTOTACC_20, dec( getValue( eTOTACC_20 ) ) );
}

//GVJ-5409
on EnvVar eTOTACC_20Def
{
    putValue( eTOTACC_20, 600 );
}

//GVJ-5409
on EnvVar eTOTACC_20Inc
{
    if( getValue( this ))  putValue( eTOTACC_20, inc( getValue( eTOTACC_20 ) ) );
}

//GVJ-5409
on EnvVar eDlcACC_20Dec
{
    if( getValue( this ))  putValue( eDlcACC_20, getValue( eDlcACC_20 ) - 1 );
}

//GVJ-5409
on EnvVar eDlcACC_20Def
{
    putValue( eDlcACC_20, 8 );
}

//GVJ-5409
on EnvVar eDlcACC_20Inc
{
    if( getValue( this ))  putValue( eDlcACC_20, getValue( eDlcACC_20 ) + 1 );
}

//GVJ-5409
on EnvVar eTACC_21Dec
{
    if( getValue( this ))  putValue( eTACC_21, dec( getValue( eTACC_21 ) ) );
}

//GVJ-5409
on EnvVar eTACC_21Def
{
    putValue( eTACC_21,60 );
}

//GVJ-5409
on EnvVar eTACC_21Inc
{
    if( getValue( this ))  putValue( eTACC_21, inc( getValue( eTACC_21 ) ) );
}

//GVJ-5409
on EnvVar eTOTACC_21Dec
{
    if( getValue( this ))  putValue( eTOTACC_21, dec( getValue( eTOTACC_21 ) ) );
}

//GVJ-5409
on EnvVar eTOTACC_21Def
{
    putValue( eTOTACC_21, 600 );
}

//GVJ-5409
on EnvVar eTOTACC_21Inc
{
    if( getValue( this ))  putValue( eTOTACC_21, inc( getValue( eTOTACC_21 ) ) );
}

//GVJ-5409
on EnvVar eDlcACC_21Dec
{
    if( getValue( this ))  putValue( eDlcACC_21, getValue( eDlcACC_21 ) - 1 );
}

//GVJ-5409
on EnvVar eDlcACC_21Def
{
    putValue( eDlcACC_21, 8 );
}

//GVJ-5409
on EnvVar eDlcACC_21Inc
{
    if( getValue( this ))  putValue( eDlcACC_21, getValue( eDlcACC_21 ) + 1 );
}

//GVJ-5409
on EnvVar eTAirbag_06Dec
{
    if( getValue( this ))  putValue( eTAirbag_06, dec( getValue( eTAirbag_06 ) ) );
}

//GVJ-5409
on EnvVar eTAirbag_06Def
{
    putValue( eTAirbag_06,200 );
}

//GVJ-5409
on EnvVar eTAirbag_06Inc
{
    if( getValue( this ))  putValue( eTAirbag_06, inc( getValue( eTAirbag_06 ) ) );
}

//GVJ-5409
on EnvVar eTOTAirbag_06Dec
{
    if( getValue( this ))  putValue( eTOTAirbag_06, dec( getValue( eTOTAirbag_06 ) ) );
}

//GVJ-5409
on EnvVar eTOTAirbag_06Def
{
    putValue( eTOTAirbag_06, 2000 );
}

//GVJ-5409
on EnvVar eTOTAirbag_06Inc
{
    if( getValue( this ))  putValue( eTOTAirbag_06, inc( getValue( eTOTAirbag_06 ) ) );
}

//GVJ-5409
on EnvVar eDlcAirbag_06Dec
{
    if( getValue( this ))  putValue( eDlcAirbag_06, getValue( eDlcAirbag_06 ) - 1 );
}

//GVJ-5409
on EnvVar eDlcAirbag_06Def
{
    putValue( eDlcAirbag_06, 8 );
}

//GVJ-5409
on EnvVar eDlcAirbag_06Inc
{
    if( getValue( this ))  putValue( eDlcAirbag_06, getValue( eDlcAirbag_06 ) + 1 );
}

//GVJ-5409
on EnvVar eTEM1_HYB_13Dec
{
    if( getValue( this ))  putValue( eTEM1_HYB_13, dec( getValue( eTEM1_HYB_13 ) ) );
}

//GVJ-5409
on EnvVar eTEM1_HYB_13Def
{
    putValue( eTEM1_HYB_13,500 );
}

//GVJ-5409
on EnvVar eTEM1_HYB_13Inc
{
    if( getValue( this ))  putValue( eTEM1_HYB_13, inc( getValue( eTEM1_HYB_13 ) ) );
}

//GVJ-5409
on EnvVar eTOTEM1_HYB_13Dec
{
    if( getValue( this ))  putValue( eTOTEM1_HYB_13, dec( getValue( eTOTEM1_HYB_13 ) ) );
}

//GVJ-5409
on EnvVar eTOTEM1_HYB_13Def
{
    putValue( eTOTEM1_HYB_13, 5000 );
}

//GVJ-5409
on EnvVar eTOTEM1_HYB_13Inc
{
    if( getValue( this ))  putValue( eTOTEM1_HYB_13, inc( getValue( eTOTEM1_HYB_13 ) ) );
}

//GVJ-5409
on EnvVar eDlcEM1_HYB_13Dec
{
    if( getValue( this ))  putValue( eDlcEM1_HYB_13, getValue( eDlcEM1_HYB_13 ) - 1 );
}

//GVJ-5409
on EnvVar eDlcEM1_HYB_13Def
{
    putValue( eDlcEM1_HYB_13, 8 );
}

//GVJ-5409
on EnvVar eDlcEM1_HYB_13Inc
{
    if( getValue( this ))  putValue( eDlcEM1_HYB_13, getValue( eDlcEM1_HYB_13 ) + 1 );
}

//GVJ-5409
on EnvVar eTDCDC_02Dec
{
    if( getValue( this ))  putValue( eTDCDC_02, dec( getValue( eTDCDC_02 ) ) );
}

//GVJ-5409
on EnvVar eTDCDC_02Def
{
    putValue( eTDCDC_02,50 );
}

//GVJ-5409
on EnvVar eTDCDC_02Inc
{
    if( getValue( this ))  putValue( eTDCDC_02, inc( getValue( eTDCDC_02 ) ) );
}

//GVJ-5409
on EnvVar eTOTDCDC_02Dec
{
    if( getValue( this ))  putValue( eTOTDCDC_02, dec( getValue( eTOTDCDC_02 ) ) );
}

//GVJ-5409
on EnvVar eTOTDCDC_02Def
{
    putValue( eTOTDCDC_02, 500 );
}

//GVJ-5409
on EnvVar eTOTDCDC_02Inc
{
    if( getValue( this ))  putValue( eTOTDCDC_02, inc( getValue( eTOTDCDC_02 ) ) );
}

//GVJ-5409
on EnvVar eDlcDCDC_02Dec
{
    if( getValue( this ))  putValue( eDlcDCDC_02, getValue( eDlcDCDC_02 ) - 1 );
}

//GVJ-5409
on EnvVar eDlcDCDC_02Def
{
    putValue( eDlcDCDC_02, 8 );
}

//GVJ-5409
on EnvVar eDlcDCDC_02Inc
{
    if( getValue( this ))  putValue( eDlcDCDC_02, getValue( eDlcDCDC_02 ) + 1 );
}

//GVJ-5409
on EnvVar eTHVEM_04Dec
{
    if( getValue( this ))  putValue( eTHVEM_04, dec( getValue( eTHVEM_04 ) ) );
}

//GVJ-5409
on EnvVar eTHVEM_04Def
{
    putValue( eTHVEM_04,500 );
}

//GVJ-5409
on EnvVar eTHVEM_04Inc
{
    if( getValue( this ))  putValue( eTHVEM_04, inc( getValue( eTHVEM_04 ) ) );
}

//GVJ-5409
on EnvVar eTOTHVEM_04Dec
{
    if( getValue( this ))  putValue( eTOTHVEM_04, dec( getValue( eTOTHVEM_04 ) ) );
}

//GVJ-5409
on EnvVar eTOTHVEM_04Def
{
    putValue( eTOTHVEM_04, 5000 );
}

//GVJ-5409
on EnvVar eTOTHVEM_04Inc
{
    if( getValue( this ))  putValue( eTOTHVEM_04, inc( getValue( eTOTHVEM_04 ) ) );
}

//GVJ-5409
on EnvVar eDlcHVEM_04Dec
{
    if( getValue( this ))  putValue( eDlcHVEM_04, getValue( eDlcHVEM_04 ) - 1 );
}

//GVJ-5409
on EnvVar eDlcHVEM_04Def
{
    putValue( eDlcHVEM_04, 8 );
}

//GVJ-5409
on EnvVar eDlcHVEM_04Inc
{
    if( getValue( this ))  putValue( eDlcHVEM_04, getValue( eDlcHVEM_04 ) + 1 );
}

//GVJ-5409
on EnvVar eTMotor_EV_01Dec
{
    if( getValue( this ))  putValue( eTMotor_EV_01, dec( getValue( eTMotor_EV_01 ) ) );
}

//GVJ-5409
on EnvVar eTMotor_EV_01Def
{
    putValue( eTMotor_EV_01,100 );
}

//GVJ-5409
on EnvVar eTMotor_EV_01Inc
{
    if( getValue( this ))  putValue( eTMotor_EV_01, inc( getValue( eTMotor_EV_01 ) ) );
}

//GVJ-5409
on EnvVar eTOTMotor_EV_01Dec
{
    if( getValue( this ))  putValue( eTOTMotor_EV_01, dec( getValue( eTOTMotor_EV_01 ) ) );
}

//GVJ-5409
on EnvVar eTOTMotor_EV_01Def
{
    putValue( eTOTMotor_EV_01, 1000 );
}

//GVJ-5409
on EnvVar eTOTMotor_EV_01Inc
{
    if( getValue( this ))  putValue( eTOTMotor_EV_01, inc( getValue( eTOTMotor_EV_01 ) ) );
}

//GVJ-5409
on EnvVar eDlcMotor_EV_01Dec
{
    if( getValue( this ))  putValue( eDlcMotor_EV_01, getValue( eDlcMotor_EV_01 ) - 1 );
}

//GVJ-5409
on EnvVar eDlcMotor_EV_01Def
{
    putValue( eDlcMotor_EV_01, 8 );
}

//GVJ-5409
on EnvVar eDlcMotor_EV_01Inc
{
    if( getValue( this ))  putValue( eDlcMotor_EV_01, getValue( eDlcMotor_EV_01 ) + 1 );
}

//GVJ-5409
on EnvVar eTMotor_EV_03Dec
{
    if( getValue( this ))  putValue( eTMotor_EV_03, dec( getValue( eTMotor_EV_03 ) ) );
}

//GVJ-5409
on EnvVar eTMotor_EV_03Def
{
    putValue( eTMotor_EV_03,50 );
}

//GVJ-5409
on EnvVar eTMotor_EV_03Inc
{
    if( getValue( this ))  putValue( eTMotor_EV_03, inc( getValue( eTMotor_EV_03 ) ) );
}

//GVJ-5409
on EnvVar eTOTMotor_EV_03Dec
{
    if( getValue( this ))  putValue( eTOTMotor_EV_03, dec( getValue( eTOTMotor_EV_03 ) ) );
}

//GVJ-5409
on EnvVar eTOTMotor_EV_03Def
{
    putValue( eTOTMotor_EV_03, 500 );
}

//GVJ-5409
on EnvVar eTOTMotor_EV_03Inc
{
    if( getValue( this ))  putValue( eTOTMotor_EV_03, inc( getValue( eTOTMotor_EV_03 ) ) );
}

//GVJ-5409
on EnvVar eDlcMotor_EV_03Dec
{
    if( getValue( this ))  putValue( eDlcMotor_EV_03, getValue( eDlcMotor_EV_03 ) - 1 );
}

//GVJ-5409
on EnvVar eDlcMotor_EV_03Def
{
    putValue( eDlcMotor_EV_03, 8 );
}

//GVJ-5409
on EnvVar eDlcMotor_EV_03Inc
{
    if( getValue( this ))  putValue( eDlcMotor_EV_03, getValue( eDlcMotor_EV_03 ) + 1 );
}

//GVJ-5409
on EnvVar eTMotor_Hybrid_03Dec
{
    if( getValue( this ))  putValue( eTMotor_Hybrid_03, dec( getValue( eTMotor_Hybrid_03 ) ) );
}

//GVJ-5409
on EnvVar eTMotor_Hybrid_03Def
{
    putValue( eTMotor_Hybrid_03,20 );
}

//GVJ-5409
on EnvVar eTMotor_Hybrid_03Inc
{
    if( getValue( this ))  putValue( eTMotor_Hybrid_03, inc( getValue( eTMotor_Hybrid_03 ) ) );
}

//GVJ-5409
on EnvVar eTOTMotor_Hybrid_03Dec
{
    if( getValue( this ))  putValue( eTOTMotor_Hybrid_03, dec( getValue( eTOTMotor_Hybrid_03 ) ) );
}

//GVJ-5409
on EnvVar eTOTMotor_Hybrid_03Def
{
    putValue( eTOTMotor_Hybrid_03, 500 );
}

//GVJ-5409
on EnvVar eTOTMotor_Hybrid_03Inc
{
    if( getValue( this ))  putValue( eTOTMotor_Hybrid_03, inc( getValue( eTOTMotor_Hybrid_03 ) ) );
}

//GVJ-5409
on EnvVar eDlcMotor_Hybrid_03Dec
{
    if( getValue( this ))  putValue( eDlcMotor_Hybrid_03, getValue( eDlcMotor_Hybrid_03 ) - 1 );
}

//GVJ-5409
on EnvVar eDlcMotor_Hybrid_03Def
{
    putValue( eDlcMotor_Hybrid_03, 8 );
}

//GVJ-5409
on EnvVar eDlcMotor_Hybrid_03Inc
{
    if( getValue( this ))  putValue( eDlcMotor_Hybrid_03, getValue( eDlcMotor_Hybrid_03 ) + 1 );
}

//GVJ-5409
on EnvVar eTPreCrash_02Dec
{
    if( getValue( this ))  putValue( eTPreCrash_02, dec( getValue( eTPreCrash_02 ) ) );
}

//GVJ-5409
on EnvVar eTPreCrash_02Def
{
    putValue( eTPreCrash_02,200 );
}

//GVJ-5409
on EnvVar eTPreCrash_02Inc
{
    if( getValue( this ))  putValue( eTPreCrash_02, inc( getValue( eTPreCrash_02 ) ) );
}

//GVJ-5409
on EnvVar eTOTPreCrash_02Dec
{
    if( getValue( this ))  putValue( eTOTPreCrash_02, dec( getValue( eTOTPreCrash_02 ) ) );
}

//GVJ-5409
on EnvVar eTOTPreCrash_02Def
{
    putValue( eTOTPreCrash_02, 2000 );
}

//GVJ-5409
on EnvVar eTOTPreCrash_02Inc
{
    if( getValue( this ))  putValue( eTOTPreCrash_02, inc( getValue( eTOTPreCrash_02 ) ) );
}

//GVJ-5409
on EnvVar eDlcPreCrash_02Dec
{
    if( getValue( this ))  putValue( eDlcPreCrash_02, getValue( eDlcPreCrash_02 ) - 1 );
}

//GVJ-5409
on EnvVar eDlcPreCrash_02Def
{
    putValue( eDlcPreCrash_02, 8 );
}

//GVJ-5409
on EnvVar eDlcPreCrash_02Inc
{
    if( getValue( this ))  putValue( eDlcPreCrash_02, getValue( eDlcPreCrash_02 ) + 1 );
}

//GVJ-5409
on EnvVar eTMotor_Hybrid_06Dec
{
    if( getValue( this ))  putValue( eTMotor_Hybrid_06, dec( getValue( eTMotor_Hybrid_06 ) ) );
}

//GVJ-5409
on EnvVar eTMotor_Hybrid_06Def
{
    putValue( eTMotor_Hybrid_06,500 );
}

//GVJ-5409
on EnvVar eTMotor_Hybrid_06Inc
{
    if( getValue( this ))  putValue( eTMotor_Hybrid_06, inc( getValue( eTMotor_Hybrid_06 ) ) );
}

//GVJ-5409
on EnvVar eTOTMotor_Hybrid_06Dec
{
    if( getValue( this ))  putValue( eTOTMotor_Hybrid_06, dec( getValue( eTOTMotor_Hybrid_06 ) ) );
}

//GVJ-5409
on EnvVar eTOTMotor_Hybrid_06Def
{
    putValue( eTOTMotor_Hybrid_06, 5000 );
}

//GVJ-5409
on EnvVar eTOTMotor_Hybrid_06Inc
{
    if( getValue( this ))  putValue( eTOTMotor_Hybrid_06, inc( getValue( eTOTMotor_Hybrid_06 ) ) );
}

//GVJ-5409
on EnvVar eDlcMotor_Hybrid_06Dec
{
    if( getValue( this ))  putValue( eDlcMotor_Hybrid_06, getValue( eDlcMotor_Hybrid_06 ) - 1 );
}

//GVJ-5409
on EnvVar eDlcMotor_Hybrid_06Def
{
    putValue( eDlcMotor_Hybrid_06, 8 );
}

//GVJ-5409
on EnvVar eDlcMotor_Hybrid_06Inc
{
    if( getValue( this ))  putValue( eDlcMotor_Hybrid_06, getValue( eDlcMotor_Hybrid_06 ) + 1 );
}

//GVJ-5409
on EnvVar eTWaehlhebel_05Dec
{
    if( getValue( this ))  putValue( eTWaehlhebel_05, dec( getValue( eTWaehlhebel_05 ) ) );
}

//GVJ-5409
on EnvVar eTWaehlhebel_05Def
{
    putValue( eTWaehlhebel_05,1000 );
}

//GVJ-5409
on EnvVar eTWaehlhebel_05Inc
{
    if( getValue( this ))  putValue( eTWaehlhebel_05, inc( getValue( eTWaehlhebel_05 ) ) );
}

//GVJ-5409
on EnvVar eTOTWaehlhebel_05Dec
{
    if( getValue( this ))  putValue( eTOTWaehlhebel_05, dec( getValue( eTOTWaehlhebel_05 ) ) );
}

//GVJ-5409
on EnvVar eTOTWaehlhebel_05Def
{
    putValue( eTOTWaehlhebel_05, 5000 );
}

//GVJ-5409
on EnvVar eTOTWaehlhebel_05Inc
{
    if( getValue( this ))  putValue( eTOTWaehlhebel_05, inc( getValue( eTOTWaehlhebel_05 ) ) );
}

//GVJ-5409
on EnvVar eDlcWaehlhebel_05Dec
{
    if( getValue( this ))  putValue( eDlcWaehlhebel_05, getValue( eDlcWaehlhebel_05 ) - 1 );
}

//GVJ-5409
on EnvVar eDlcWaehlhebel_05Def
{
    putValue( eDlcWaehlhebel_05, 8 );
}

//GVJ-5409
on EnvVar eDlcWaehlhebel_05Inc
{
    if( getValue( this ))  putValue( eDlcWaehlhebel_05, getValue( eDlcWaehlhebel_05 ) + 1 );
}

//GVJ-5409
on EnvVar eTSOK_NoAuthenticTime_01Dec
{
    if( getValue( this ))  putValue( eTSOK_NoAuthenticTime_01, dec( getValue( eTSOK_NoAuthenticTime_01 ) ) );
}

//GVJ-5409
on EnvVar eTSOK_NoAuthenticTime_01Def
{
    putValue( eTSOK_NoAuthenticTime_01,1000 );
}

//GVJ-5409
on EnvVar eTSOK_NoAuthenticTime_01Inc
{
    if( getValue( this ))  putValue( eTSOK_NoAuthenticTime_01, inc( getValue( eTSOK_NoAuthenticTime_01 ) ) );
}

//GVJ-5409
on EnvVar eTOTSOK_NoAuthenticTime_01Dec
{
    if( getValue( this ))  putValue( eTOTSOK_NoAuthenticTime_01, dec( getValue( eTOTSOK_NoAuthenticTime_01 ) ) );
}

//GVJ-5409
on EnvVar eTOTSOK_NoAuthenticTime_01Def
{
    putValue( eTOTSOK_NoAuthenticTime_01, 5000 );
}

//GVJ-5409
on EnvVar eTOTSOK_NoAuthenticTime_01Inc
{
    if( getValue( this ))  putValue( eTOTSOK_NoAuthenticTime_01, inc( getValue( eTOTSOK_NoAuthenticTime_01 ) ) );
}

//GVJ-5409
on EnvVar eDlcSOK_NoAuthenticTime_01Dec
{
    if( getValue( this ))  putValue( eDlcSOK_NoAuthenticTime_01, getValue( eDlcSOK_NoAuthenticTime_01 ) - 1 );
}

//GVJ-5409
on EnvVar eDlcSOK_NoAuthenticTime_01Def
{
    putValue( eDlcSOK_NoAuthenticTime_01, 8 );
}

//GVJ-5409
on EnvVar eDlcSOK_NoAuthenticTime_01Inc
{
    if( getValue( this ))  putValue( eDlcSOK_NoAuthenticTime_01, getValue( eDlcSOK_NoAuthenticTime_01 ) + 1 );
}

//GVJ-23927
on EnvVar eSTH_HeizleistungDec
{
    if( getValue( this ))  putValue( eSTH_HeizleistungS, getValue( eSTH_HeizleistungS ) - 1 );
}

//GVJ-23927
on EnvVar eSTH_HeizleistungDef
{
    putValue( eSTH_HeizleistungS, 0);
}

//GVJ-23927
on EnvVar eSTH_HeizleistungInc
{
    if( getValue( this ))  putValue( eSTH_HeizleistungS, getValue( eSTH_HeizleistungS ) + 1 );
}

//GVJ-79733
on EnvVar eTEA_02Dec
{
    if( getValue( this ))  putValue( eTEA_02, dec( getValue( eTEA_02 ) ) );
}

//GVJ-79733
on EnvVar eTEA_02Def
{
    putValue( eTEA_02,500 );
}

//GVJ-79733
on EnvVar eTEA_02Inc
{
    if( getValue( this ))  putValue( eTEA_02, inc( getValue( eTEA_02 ) ) );
}

//GVJ-79733
on EnvVar eTOTEA_02Dec
{
    if( getValue( this ))  putValue( eTOTEA_02, dec( getValue( eTOTEA_02 ) ) );
}

//GVJ-79733
on EnvVar eTOTEA_02Def
{
    putValue( eTOTEA_02, 5000 );
}

//GVJ-79733
on EnvVar eTOTEA_02Inc
{
    if( getValue( this ))  putValue( eTOTEA_02, inc( getValue( eTOTEA_02 ) ) );
}

//GVJ-79733
on EnvVar eDlcEA_02Dec
{
    if( getValue( this ))  putValue( eDlcEA_02, getValue( eDlcEA_02 ) - 1 );
}

//GVJ-79733
on EnvVar eDlcEA_02Def
{
    putValue( eDlcEA_02, 8 );
}

//GVJ-79733
on EnvVar eDlcEA_02Inc
{
    if( getValue( this ))  putValue( eDlcEA_02, getValue( eDlcEA_02 ) + 1 );
}