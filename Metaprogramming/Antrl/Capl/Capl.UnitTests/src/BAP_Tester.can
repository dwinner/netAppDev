/*@!Encoding:1252*/
includes
{
  // Import required CAPL include files
  //--- begin generated part --- Block start #Hdr_Includes#; do not delete this line and do not add application code in this code block!
  /* #ChannelStart# |CAN1| #BusStart# |E3V_ABCANFD| */
  /* #ChannelEnd# |CAN1| #BusEnd# |E3V_ABCANFD| */
  //--- end generated part --- Block end #Hdr_Includes#; do not delete this line! Add application code below this line.
  //--- begin generated part --- Block start #Body_Includes#; do not delete this line and do not add application code in this code block!
  /* #ChannelStart# |CAN1| #BusStart# |E3V_ABCANFD| */
  #include "..\..\CAPL\VAG-NM-Panel-Helper_CAN1.cin"
  #include "..\..\CAPL\VAG-IL-KL15-Helper_CAN1.cin"
  /* #ChannelEnd# |CAN1| #BusEnd# |E3V_ABCANFD| */
  //--- end generated part --- Block end #Body_Includes#; do not delete this line! Add application code below this line.
}

variables
{
  // Define global variables for this CAPL file

  /*--- #GenHeader Begin# --- begin generated comment ---
  | Generated on Friday, Januar 17, 2020, 09:38:11
  | By ModelGenerator for VAG 1.4.3.7, ModelGeneratorVAGDLL 1.4.3.46
  | Package VAG 3.1.3.3 Hotfix
  | Target Bus: E3V_ABCANFD; Channel: CAN1; DB Cluster: E3_1_1_MEB_ABCANFD_KMatrix_V100604F_20191202_MB;
  | From Database: E3_1_1_MEB_ABCANFD_KMatrix_V10.06.04F_20191202_MB.dbc
  | CANoe Version 12.0.189.0
    --- #GenHeader End  # --- end generated comment --- */

  char gECU[256] = "BAP_Tester";
  //--- begin generated part --- Block start #Hdr_GlobalVariables#; do not delete this line and do not add application code in this code block!
  /* #ChannelStart# |CAN1| #BusStart# |E3V_ABCANFD| */
  /* #ChannelEnd# |CAN1| #BusEnd# |E3V_ABCANFD| */
  //--- end generated part --- Block end #Hdr_GlobalVariables#; do not delete this line! Add application code below this line.
  //--- begin generated part --- Block start #Body_GlobalVariables#; do not delete this line and do not add application code in this code block!
  /* #ChannelStart# |CAN1| #BusStart# |E3V_ABCANFD| */
  char gCAN1BusName[256] = "AB_CAN";
  int gCAN1Channel = 1; //// The channel the bus is attached to

  long gCAN1DisturbanceMode;
  long gCAN1DisturbanceCount;
  long gCAN1DisturbanceValue;
  long gCAN1DisturbanceContinueMode;
  double gCAN1DisturbancePeriod;
  /* #ChannelEnd# |CAN1| #BusEnd# |E3V_ABCANFD| */
  //--- end generated part --- Block end #Body_GlobalVariables#; do not delete this line! Add application code below this line.
}

on preStart
{
  // Initialize CAPL includes and node's modules/DLLs
  //--- begin generated part --- Block start #Hdr_OnInit#; do not delete this line and do not add application code in this code block!
  /* #ChannelStart# |CAN1| #BusStart# |E3V_ABCANFD| */
  /* #ChannelEnd# |CAN1| #BusEnd# |E3V_ABCANFD| */
  //--- end generated part --- Block end #Hdr_OnInit#; do not delete this line! Add application code below this line.
  //--- begin generated part --- Block start #Body_OnInit#; do not delete this line and do not add application code in this code block!
  /* #ChannelStart# |CAN1| #BusStart# |E3V_ABCANFD| */
  ILCAN1_OnInit();
  /* #ChannelEnd# |CAN1| #BusEnd# |E3V_ABCANFD| */
  //--- end generated part --- Block end #Body_OnInit#; do not delete this line! Add application code below this line.
}

on start
{
  // Start CAPL includes and node's modules/DLLs
  //--- begin generated part --- Block start #Hdr_OnStart#; do not delete this line and do not add application code in this code block!
  /* #ChannelStart# |CAN1| #BusStart# |E3V_ABCANFD| */
  /* #ChannelEnd# |CAN1| #BusEnd# |E3V_ABCANFD| */
  //--- end generated part --- Block end #Hdr_OnStart#; do not delete this line! Add application code below this line.
  //--- begin generated part --- Block start #Body_OnStart#; do not delete this line and do not add application code in this code block!
  /* #ChannelStart# |CAN1| #BusStart# |E3V_ABCANFD| */
  ILCAN1_OnStart();
  /* #ChannelEnd# |CAN1| #BusEnd# |E3V_ABCANFD| */
  //--- end generated part --- Block end #Body_OnStart#; do not delete this line! Add application code below this line.
}

on preStop
{
  // Prepare stopping
  //--- begin generated part --- Block start #Hdr_OnStopping#; do not delete this line and do not add application code in this code block!
  /* #ChannelStart# |CAN1| #BusStart# |E3V_ABCANFD| */
  /* #ChannelEnd# |CAN1| #BusEnd# |E3V_ABCANFD| */
  //--- end generated part --- Block end #Hdr_OnStopping#; do not delete this line! Add application code below this line.
  //--- begin generated part --- Block start #Body_OnStopping#; do not delete this line and do not add application code in this code block!
  /* #ChannelStart# |CAN1| #BusStart# |E3V_ABCANFD| */
  /* #ChannelEnd# |CAN1| #BusEnd# |E3V_ABCANFD| */
  //--- end generated part --- Block end #Body_OnStopping#; do not delete this line! Add application code below this line.
}

on stopMeasurement
{
  // Stop actions
  //--- begin generated part --- Block start #Hdr_OnStop#; do not delete this line and do not add application code in this code block!
  /* #ChannelStart# |CAN1| #BusStart# |E3V_ABCANFD| */
  /* #ChannelEnd# |CAN1| #BusEnd# |E3V_ABCANFD| */
  //--- end generated part --- Block end #Hdr_OnStop#; do not delete this line! Add application code below this line.
  //--- begin generated part --- Block start #Body_OnStop#; do not delete this line and do not add application code in this code block!
  /* #ChannelStart# |CAN1| #BusStart# |E3V_ABCANFD| */
  /* #ChannelEnd# |CAN1| #BusEnd# |E3V_ABCANFD| */
  //--- end generated part --- Block end #Body_OnStop#; do not delete this line! Add application code below this line.
}

void StartSim(dword busContext, int busActive, int mode)
{
  // Called when ... due to ...
  //   mode == 1: ILControlResume
  //   mode == 2: ILControlStart
  //   mode == 3: ILControlSimulationOn
  //--- begin generated part --- Block start #Hdr_StartSim#; do not delete this line and do not add application code in this code block!
  /* #ChannelStart# |CAN1| #BusStart# |E3V_ABCANFD| */
  /* #ChannelEnd# |CAN1| #BusEnd# |E3V_ABCANFD| */
  //--- end generated part --- Block end #Hdr_StartSim#; do not delete this line! Add application code below this line.
  //write("[%.6f %NODE_NAME%] StartSim(0x%X, %d, %d)", TimeNowNS()/1e9, busContext, busActive, mode);
  //--- begin generated part --- Block start #Body_StartSim#; do not delete this line and do not add application code in this code block!
  /* #ChannelStart# |CAN1| #BusStart# |E3V_ABCANFD| */
  /* #ChannelEnd# |CAN1| #BusEnd# |E3V_ABCANFD| */
  //--- end generated part --- Block end #Body_StartSim#; do not delete this line! Add application code below this line.
}

void StopSim(dword busContext, int busActive, int mode)
{
  // Called when ... due to ...
  //   mode == 1: ILControlWait
  //   mode == 2: ILControlStop
  //   mode == 3: ILControlSimulationOff
  //--- begin generated part --- Block start #Hdr_StopSim#; do not delete this line and do not add application code in this code block!
  /* #ChannelStart# |CAN1| #BusStart# |E3V_ABCANFD| */
  /* #ChannelEnd# |CAN1| #BusEnd# |E3V_ABCANFD| */
  //--- end generated part --- Block end #Hdr_StopSim#; do not delete this line! Add application code below this line.
  //write("[%.6f %NODE_NAME%] StopSim(0x%X, %d, %d)", TimeNowNS()/1e9, busContext, busActive, mode);
  //--- begin generated part --- Block start #Body_StopSim#; do not delete this line and do not add application code in this code block!
  /* #ChannelStart# |CAN1| #BusStart# |E3V_ABCANFD| */
  /* #ChannelEnd# |CAN1| #BusEnd# |E3V_ABCANFD| */
  //--- end generated part --- Block end #Body_StopSim#; do not delete this line! Add application code below this line.
}

on envVar EnvKlemme15
{
  // Handle system state variable
  //--- begin generated part --- Block start #Hdr_KL15_EnvKlemme15#; do not delete this line and do not add application code in this code block!
  /* #ChannelStart# |CAN1| #BusStart# |E3V_ABCANFD| */
  /* #ChannelEnd# |CAN1| #BusEnd# |E3V_ABCANFD| */
  //--- end generated part --- Block end #Hdr_KL15_EnvKlemme15#; do not delete this line! Add application code below this line.
  //--- begin generated part --- Block start #Body_KL15_EnvKlemme15#; do not delete this line and do not add application code in this code block!
  /* #ChannelStart# |CAN1| #BusStart# |E3V_ABCANFD| */
  ILCAN1_OnEnvKlemme15(@this);
  /* #ChannelEnd# |CAN1| #BusEnd# |E3V_ABCANFD| */
  //--- end generated part --- Block end #Body_KL15_EnvKlemme15#; do not delete this line! Add application code below this line.
}

on envVar EnvStartWithoutSending
{
  // Handle system state variable
  //--- begin generated part --- Block start #Hdr_StartManner_EnvStartWithoutSending#; do not delete this line and do not add application code in this code block!
  /* #ChannelStart# |CAN1| #BusStart# |E3V_ABCANFD| */
  /* #ChannelEnd# |CAN1| #BusEnd# |E3V_ABCANFD| */
  //--- end generated part --- Block end #Hdr_StartManner_EnvStartWithoutSending#; do not delete this line! Add application code below this line.
  //--- begin generated part --- Block start #Body_StartManner_EnvStartWithoutSending#; do not delete this line and do not add application code in this code block!
  /* #ChannelStart# |CAN1| #BusStart# |E3V_ABCANFD| */
  ILCAN1_OnEnvStartWithoutSending(@this);
  /* #ChannelEnd# |CAN1| #BusEnd# |E3V_ABCANFD| */
  //--- end generated part --- Block end #Body_StartManner_EnvStartWithoutSending#; do not delete this line! Add application code below this line.
}

dword applILTxPending(long aId, dword aDlc, byte data[])
{
  dword ret = 1;
  //--- begin generated part --- Block start #Hdr_applILTxPending#; do not delete this line and do not add application code in this code block!
  /* #ChannelStart# |CAN1| #BusStart# |E3V_ABCANFD| */
  /* #ChannelEnd# |CAN1| #BusEnd# |E3V_ABCANFD| */
  //--- end generated part --- Block end #Hdr_applILTxPending#; do not delete this line! Add application code below this line.
  //--- begin generated part --- Block start #Body_applILTxPending#; do not delete this line and do not add application code in this code block!
  /* #ChannelStart# |CAN1| #BusStart# |E3V_ABCANFD| */
  /* #ChannelEnd# |CAN1| #BusEnd# |E3V_ABCANFD| */
  //--- end generated part --- Block end #Body_applILTxPending#; do not delete this line! Add application code below this line.
  return ret;
}

//--- begin generated part --- Block start <#Helper_Functions#> do not delete this line and do not add application code in this code block!
/* #ChannelStart# |CAN1| #BusStart# |E3V_ABCANFD| */
/* #ChannelEnd# |CAN1| #BusEnd# |E3V_ABCANFD| */
//--- end generated part --- Block end <#Helper_Functions#> do not delete this line! Add application code below this line.

//--- begin generated part --- Block start <#SysVar_Handler#> do not delete this line and do not add application code in this code block!
/* #ChannelStart# |CAN1| #BusStart# |E3V_ABCANFD| */
on sysvar_update sysvar::IL_CAN1::EnableNode::BAP_Tester
{
  ILCAN1_Enable(@this && @sysvar::IL_CAN1::enable_AllNodes);
}

on sysvar_update sysvar::IL_CAN1::enable_AllNodes
{
  ILCAN1_Enable(@this && @sysvar::IL_CAN1::EnableNode::BAP_Tester);
}

on sysvar_update sysvar::NM_CAN1::BAP_Tester::OpenNodePanel
{
  OpenNodePanel("E3V_ABCANFD::BAP_Tester", 1);
}

on sysvar_update sysvar::NM_CAN1::StateControl::CloseNodePanels
{
  OpenNodePanel("E3V_ABCANFD::BAP_Tester", 0);
}

/* #ChannelEnd# |CAN1| #BusEnd# |E3V_ABCANFD| */
//--- end generated part --- Block end <#SysVar_Handler#> do not delete this line! Add application code below this line.

//--- begin generated part --- Block start <#MsgUpdateFcns#> do not delete this line and do not add application code in this code block!
/* #ChannelStart# |CAN1| #BusStart# |E3V_ABCANFD| */
/* #ChannelEnd# |CAN1| #BusEnd# |E3V_ABCANFD| */
//--- end generated part --- Block end <#MsgUpdateFcns#> do not delete this line! Add application code below this line.

