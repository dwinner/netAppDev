/*@@var:*/
/***************************************************************************
*=====================      Copyright by Continental AG      ===============
****************************************************************************
* Title            : TimeToWarning.can
*
* Description  : Test 02.21 (T_125)
*                This is to test the time between the single line message
*                request and the response by HIL ID (Meas_IC_5).
*
* Responsible  : Wolfgang Mauder <Wolfgang.Mauder-EXT@continental-corporation.com>
*
* Revision List: (Will NOT be filled by XStudio)
*
* Archive: Rev. 1 WolMau: Inital check´in
*          Rev  2 WolMau: Bug fix, start-up procedure description
*          Rev  3 WolMau: Report format changed
*          Rev  4 WolMau: Report format changed
*
****************************************************************************/

/***************************************************************************/
/* Start-up-procedure:                                                     */
/*                                                                         */
/* (1) IC power OFF                                                        */
/* (2) CanOe OFF                                                           */
/* (3) CanOe ON, wait for start messages                                   */
/* (4) IC power ON, start stresstest and key animation                     */
/* (5) IC IGN_ON                                                           */
/* (6) Start measurement with 't'                                          */
/*                                                                         */
/* Print current measurement, min, avg, max with 'p'                       */
/* Re-initialize measurement, min, avg, max with 'd'                       */
/***************************************************************************/


 
variables
{
   dword ttwStartTime;
   
   float ttwDiffTime;
   float ttwDiffTimeMin;
   float ttwDiffTimeMax;
   float ttwDiffTimeAvg;
   float ttwDiffTimeSum;
   float ttwDiffTimeNum;
   
   dword ttwPutTime = 10000;//must be larger than system reaction time (~500ms)
   dword dMeasStarted = 0; 
   dword dCurRoofState;

   MsTimer timerPutValue;
}
/*@@end*/

/*@@key:'t':*/
on key 't'
{   
    write("Keypress \"t\" recieved");

    //Initialize variables
    ttwDiffTimeMin =  100000.0;
    ttwDiffTimeMax = -100000.0;
    ttwDiffTimeAvg = 0.0;
    ttwDiffTimeSum = 0.0;
    ttwDiffTimeNum = 0.0;

    //Measurement is started
    dMeasStarted = 1;

    //Initialize roof state
    putValue(HMI_TranspChg_Roof_Stat, 1);

    dCurRoofState = 1;

    setTimer(timerPutValue, ttwPutTime);

}
/*@@end*/

/*@@timer:timerPutValue:*/
on timer timerPutValue
{

   if( 1 == dMeasStarted )
   {
       if(1 == getValue(HMI_TranspChg_Roof_Stat)) {
          putValue(HMI_TranspChg_Roof_Stat, 2); //set to 2
          write("Timer set roof state 1");
          dCurRoofState = 2;
       }
       else if (2 == getValue(HMI_TranspChg_Roof_Stat)) {
          putValue(HMI_TranspChg_Roof_Stat, 1); //set to 1
          write("Timer set roof state 1");
          dCurRoofState = 1;
       }  
       else {//was 0
          putValue(HMI_TranspChg_Roof_Stat, 1); //set to 1
          write("Timer set roof state 1");
          dCurRoofState = 1;
       }
              
       
       ttwStartTime = timeNow();//get timestamp
   }

   setTimer(timerPutValue, ttwPutTime);//restart timer  
}
/*@@end*/

/*@@changeSignal:Meas_IC_5H:*/
on signal Meas_IC_5H
{

   write("Message sent recieved");

   if ( ( 1 == dMeasStarted &&  1 == dCurRoofState && 16 == this ) ||
        ( 1 == dMeasStarted &&  2 == dCurRoofState && 17 == this ))    
   {
      write("->measure time delay");

      ttwDiffTime = ( timeNow() - ttwStartTime ) / 100.0;

      if( 3000 < ttwDiffTime) 
         return;
          
      if(ttwDiffTime > ttwDiffTimeMax) ttwDiffTimeMax = ttwDiffTime;
      if(ttwDiffTime < ttwDiffTimeMin) ttwDiffTimeMin = ttwDiffTime;
   
      ttwDiffTimeSum += ttwDiffTime;
      ttwDiffTimeNum++;
      ttwDiffTimeAvg = ttwDiffTimeSum / ttwDiffTimeNum;
    
      write("Calls %5.2f\nCur: %5.2f ms\nMin: %5.2f ms\nMax: %5.2f ms\nAvg: %5.2f ms", ttwDiffTimeNum, ttwDiffTime, ttwDiffTimeMin, ttwDiffTimeMax, ttwDiffTimeAvg);
     
          
   }

}
/*@@end*/

/*@@preStart:PreStart:*/
on preStart
{
}
/*@@end*/

/*@@startStart:Start:*/
on start
{
   putValue(HMI_TranspChg_Roof_Stat, 0); //set to 0
}
/*@@end*/

/*@@key:'d':*/
on key 'd'
{
    write("Keypress \"d\" recieved");

    //Re-Initialize variables
    ttwDiffTimeMin =  100000.0;
    ttwDiffTimeMax = -100000.0;
    ttwDiffTimeAvg = 0.0;
    ttwDiffTimeSum = 0.0;
    ttwDiffTimeNum = 0.0;
}
/*@@end*/

/*@@key:'p':*/
on key 'p'
{
   write("Calls %5.2f / Cur %5.2f ms/ Min %5.2f ms/ Max %5.2f ms/ Avg %5.2f ms", ttwDiffTimeNum, ttwDiffTime, ttwDiffTimeMin, ttwDiffTimeMax, ttwDiffTimeAvg);
}
/*@@end*/

