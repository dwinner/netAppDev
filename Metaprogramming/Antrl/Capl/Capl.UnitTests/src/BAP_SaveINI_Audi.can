/*@!Encoding:1252*/

includes
{
 //   #pragma library ("..\_DLL\BAP1101_v7800\BAP1101.dll")
}

variables
{
}

//IssueList #80
on EnvVar eBAPLoadSettings
{

  char orgfile[1024];   // original filename/path
  char modfile[1024];   // modified filename
  char modpath[1024];   // modified path
  dword handle;         // fileread result
  int orgidx;           // original file array index
  int nameidx;          // modified name index
  int pathidx;          // modified path index
  int bslctr;           // backslash counter     (to find how many)
  int bslctr2;          // backslash counter2    (to know when filename starts)
  int ctr;              // general purpose counter

  // init arrays
  for (ctr = 0; ctr < 1024; ctr++)
  {
    orgfile[ctr] = 0;   // init original filename/path
    modfile[ctr] = 0;   // init modified filename
    modpath[ctr] = 0;   // init modified path
  }

  if (getValue( this ))
  {
    getValue( eLoadSettingsFile, orgfile );

    // count the number of "backslash"
    bslctr = 0;
    orgidx = 0;
    while (orgfile[orgidx] != 0)
    {
      if (orgfile[orgidx] == 0x5C)
      {
        bslctr++;   // backslash counter
      }
      orgidx++;
    }

    // store path and filename
    orgidx = 0;
    bslctr2 = 0;
    pathidx = 0;
    nameidx = 0;
    while (orgfile[orgidx] != 0)
    {
      if (bslctr2 != bslctr)    // store path until last backslash
      {
        if (orgfile[orgidx] == 0x5C)
        {
          bslctr2++;
        }
        // store path
        modpath[pathidx] = orgfile[orgidx];
        pathidx++;
      }
      else
      {
        // store filename
        modfile[nameidx] = orgfile[orgidx];
        nameidx++;
      }
      orgidx++;
    }

    setFilePath(modpath, 0);      //set path for *.ini file
    handle = openFileRead( modfile, 1 );

    if (handle > 0)
    {
      fileClose( handle );
      loadBAP_buttonSettings( modfile );
      strncat( modfile, " loaded", elcount( modfile ) );

    }
    else
    {
      strncat( modfile, " NOT FOUND", elcount( modfile ) );
    }
    //putValue( eSettingsResult, orgfile );
    putValue( eSettingsResult, modfile );
  }
}

//IssueList #80
on EnvVar eBAPSaveSettings
{
  char file[1024], filepath[1200], dirpath[1200], StrFileName[100];
  dword handle, i =0, j =0, index =0, StrLength =0;

  if (getValue( this ))
  {
    getValue( eSaveSettingsFile, file );

    //write("\n Selected file path is %s", file);

    while(file[i] != '\0')
    {
        if (file[i] != '\\')
        {
            filepath[j] = file[i];
            j++;
            i++;
        }
        else
        {
            index = j;
            filepath[j] = file[i];
            filepath[j+1] = file[i];
            j+=2;
            i++;
        }
    }

    filepath[j] = '\0';
    StrLength = strlen(filepath);

    for(i=0; i<index; i++)
    {
        dirpath[i] = filepath[i];
    }
    dirpath[i] = '\0';

    j=0;
    for(i=index+2; i<StrLength; i++)
    {
        StrFileName[j] = filepath[i];
        j++;
    }

    StrFileName[j] = '\0';

    //write("\n Dir path is %s", dirpath);
    //write("\n File name is %s", StrFileName);

    setWritePath(dirpath);
    /*handle = openFileWrite (file, 1);
    if (handle > 0)
    {
        saveSettings(file);
        fileClose( handle );
    }*/
    saveBAP_button_Settings(StrFileName);

    if (writeProfileInt( "Settings", "Test", 1, StrFileName ) == 0)
    {
      strncat( StrFileName, " NOT", elcount( StrFileName ) );
    }
    strncat( StrFileName, " written", elcount( StrFileName ) );
    //putValue( eSettingsResult, file );
    putValue( eSettingsResult, StrFileName );

    file[0] = '\0';
    filepath[0] = '\0';
    dirpath[0] = '\0';
    StrFileName[0] = '\0';
    i=j=index=StrLength=0;

    setWritePath("");
  }
}

on start
{
  //IssueList #80 & 161
  loadBAP_buttonSettings("RBS.ini"  );

  //IssueList #200
  putValue(ON_OFF_BAP_LoadSave_INI,1);
  EnableControl("Main", "EnvVar:eBAPLoadSettings",1);
  EnableControl("Main", "EnvVar:eBAPSaveSettings",1);
  EnableControl("Main", "EnvVar:eLoadAllSettings",1);
  EnableControl("Main", "EnvVar:eSaveAllSettings",1);
    putValue(ON_OFF_BAP_Main, 0);
}

void saveALLSettings( char profileFile[] )
{
    saveBAP_button_Settings(profileFile);
    saveBAP_OtherSettings(profileFile);
}

on stopMeasurement
{
    saveBAP_button_Settings( "RBS.ini" );
}

//IssueList #200 - Addition of LoadAll button
void loadBAP_audioSettings( char profileFile[] )
{
    putValue(BAPCFG_FSG_AudioSD_DFMinor,getProfileInt("BAP AUDIO", "BAPCFG_FSG_AudioSD_DFMinor", 1, profileFile));
    putValue(BAPCFG_FSG_AudioSD_LsgClassMajor,getProfileInt("BAP AUDIO", "BAPCFG_FSG_AudioSD_LsgClassMajor", 1, profileFile));
    putValue(BAPCFG_FSG_AudioSD_LsgClassMinor,getProfileInt("BAP AUDIO", "BAPCFG_FSG_AudioSD_LsgClassMinor", 1, profileFile));
    putValue(BAPCFG_FSG_AudioSD_ProtocolMajor,getProfileInt("BAP AUDIO", "BAPCFG_FSG_AudioSD_ProtocolMajor", 1, profileFile));
    putValue(BAPCFG_FSG_AudioSD_ProtocolMinor,getProfileInt("BAP AUDIO", "BAPCFG_FSG_AudioSD_ProtocolMinor", 1, profileFile));
    putValue(env_Audio_Update_Mode,getProfileInt("BAP AUDIO", "env_Audio_Update_Mode", 1, profileFile));
    putValue(env_AudioSD_activeSourceName_up,getProfileInt("BAP AUDIO", "env_AudioSD_activeSourceName_up", 1, profileFile));
    putValue(env_AudioSD_activeSrc_ListState,getProfileInt("BAP AUDIO", "env_AudioSD_activeSrc_ListState", 1, profileFile));
    putValue(env_AudioSD_activeSrc_MedBrList,getProfileInt("BAP AUDIO", "env_AudioSD_activeSrc_MedBrList", 1, profileFile));
    putValue(env_AudioSD_activeSrc_number,getProfileInt("BAP AUDIO", "env_AudioSD_activeSrc_number", 1, profileFile));
    putValue(env_AudioSD_activeSrc_PresetList,getProfileInt("BAP AUDIO", "env_AudioSD_activeSrc_PresetList", 1, profileFile));
    putValue(env_AudioSD_activeSrc_ReceptList,getProfileInt("BAP AUDIO", "env_AudioSD_activeSrc_ReceptList", 1, profileFile));
    putValue(env_AudioSD_activeSrc_SLRef,getProfileInt("BAP AUDIO", "env_AudioSD_activeSrc_SLRef", 1, profileFile));
    putValue(env_AudioSD_activeSrc_Type,getProfileInt("BAP AUDIO", "env_AudioSD_activeSrc_Type", 1, profileFile));
    putValue(env_AudioSD_activeSrc_TypeOfNum,getProfileInt("BAP AUDIO", "env_AudioSD_activeSrc_TypeOfNum", 1, profileFile));
    putValue(env_AudioSD_activeSrc_update,getProfileInt("BAP AUDIO", "env_AudioSD_activeSrc_update", 1, profileFile));
    putValue(env_AudioSD_AnE_Abort,getProfileInt("BAP AUDIO", "env_AudioSD_AnE_Abort", 1, profileFile));
    putValue(env_AudioSD_AnE_Error_on,getProfileInt("BAP AUDIO", "env_AudioSD_AnE_Error_on", 1, profileFile));
    putValue(env_AudioSD_AnE_ErrorCode,getProfileInt("BAP AUDIO", "env_AudioSD_AnE_ErrorCode", 1, profileFile));
    putValue(env_AudioSD_AnE_NotActive,getProfileInt("BAP AUDIO", "env_AudioSD_AnE_NotActive", 1, profileFile));
    putValue(env_AudioSD_AnE_Res,getProfileInt("BAP AUDIO", "env_AudioSD_AnE_Res", 1, profileFile));
    putValue(env_AudioSD_AnInfo_Type,getProfileInt("BAP AUDIO", "env_AudioSD_AnInfo_Type", 1, profileFile));
    putValue(env_AudioSD_AnInfo_update,getProfileInt("BAP AUDIO", "env_AudioSD_AnInfo_update", 1, profileFile));
    putValue(env_AudioSD_ASGCapa_Error_on,getProfileInt("BAP AUDIO", "env_AudioSD_ASGCapa_Error_on", 1, profileFile));
    putValue(env_AudioSD_ASGCapa_ErrorCode,getProfileInt("BAP AUDIO", "env_AudioSD_ASGCapa_ErrorCode", 1, profileFile));
    putValue(env_AudioSD_ASGCapa_PresCa_DAB,getProfileInt("BAP AUDIO", "env_AudioSD_ASGCapa_PresCa_DAB", 1, profileFile));
    putValue(env_AudioSD_ASGCapa_PresCa_SDARS,getProfileInt("BAP AUDIO", "env_AudioSD_ASGCapa_PresCa_SDARS", 1, profileFile));
    putValue(env_AudioSD_ASGCapa_update,getProfileInt("BAP AUDIO", "env_AudioSD_ASGCapa_update", 1, profileFile));
    putValue(env_AudioSD_CSH_DABEnsAbsPos,getProfileInt("BAP AUDIO", "env_AudioSD_CSH_DABEnsAbsPos", 1, profileFile));
    putValue(env_AudioSD_CSH_DABEnsHandle,getProfileInt("BAP AUDIO", "env_AudioSD_CSH_DABEnsHandle", 1, profileFile));
    putValue(env_AudioSD_CSH_FSGAbsPos,getProfileInt("BAP AUDIO", "env_AudioSD_CSH_FSGAbsPos", 1, profileFile));
    putValue(env_AudioSD_CSH_FSGhandle,getProfileInt("BAP AUDIO", "env_AudioSD_CSH_FSGhandle", 1, profileFile));
    putValue(env_AudioSD_CSH_PresetListAbsPos,getProfileInt("BAP AUDIO", "env_AudioSD_CSH_PresetListAbsPos", 1, profileFile));
    putValue(env_AudioSD_CSH_PresetListRef,getProfileInt("BAP AUDIO", "env_AudioSD_CSH_PresetListRef", 1, profileFile));
    putValue(env_AudioSD_CSH_update,getProfileInt("BAP AUDIO", "env_AudioSD_CSH_update", 1, profileFile));
    putValue(env_AudioSD_CSI_ChannelID,getProfileInt("BAP AUDIO", "env_AudioSD_CSI_ChannelID", 1, profileFile));
    putValue(env_AudioSD_CSI_IBOC,getProfileInt("BAP AUDIO", "env_AudioSD_CSI_IBOC", 1, profileFile));
    putValue(env_AudioSD_CSI_PIID,getProfileInt("BAP AUDIO", "env_AudioSD_CSI_PIID", 1, profileFile));
    putValue(env_AudioSD_CSI_PIType,getProfileInt("BAP AUDIO", "env_AudioSD_CSI_PIType", 1, profileFile));
    putValue(env_AudioSD_CSI_QIType,getProfileInt("BAP AUDIO", "env_AudioSD_CSI_QIType", 1, profileFile));
    putValue(env_AudioSD_CSI_SIType,getProfileInt("BAP AUDIO", "env_AudioSD_CSI_SIType", 1, profileFile));
    putValue(env_AudioSD_CSI_StProp_AuSignal,getProfileInt("BAP AUDIO", "env_AudioSD_CSI_StProp_AuSignal", 1, profileFile));
    putValue(env_AudioSD_CSI_StProp_IBOC,getProfileInt("BAP AUDIO", "env_AudioSD_CSI_StProp_IBOC", 1, profileFile));
    putValue(env_AudioSD_CSI_StProp_linked,getProfileInt("BAP AUDIO", "env_AudioSD_CSI_StProp_linked", 1, profileFile));
    putValue(env_AudioSD_CSI_StProp_Station,getProfileInt("BAP AUDIO", "env_AudioSD_CSI_StProp_Station", 1, profileFile));
    putValue(env_AudioSD_CSI_TATP,getProfileInt("BAP AUDIO", "env_AudioSD_CSI_TATP", 1, profileFile));
    putValue(env_AudioSD_CSI_TIType,getProfileInt("BAP AUDIO", "env_AudioSD_CSI_TIType", 1, profileFile));
    putValue(env_AudioSD_CSI_TMC,getProfileInt("BAP AUDIO", "env_AudioSD_CSI_TMC", 1, profileFile));
    putValue(env_AudioSD_CSI_update,getProfileInt("BAP AUDIO", "env_AudioSD_CSI_update", 1, profileFile));
    putValue(env_AudioSD_CSI_VICS,getProfileInt("BAP AUDIO", "env_AudioSD_CSI_VICS", 1, profileFile));
    putValue(env_AudioSD_currentVolume_Change,getProfileInt("BAP AUDIO", "env_AudioSD_currentVolume_Change", 1, profileFile));
    putValue(env_AudioSD_currentVolume_EntVol,getProfileInt("BAP AUDIO", "env_AudioSD_currentVolume_EntVol", 1, profileFile));
    putValue(env_AudioSD_currentVolume_NavVol,getProfileInt("BAP AUDIO", "env_AudioSD_currentVolume_NavVol", 1, profileFile));
    putValue(env_AudioSD_currentVolume_PhoVol,getProfileInt("BAP AUDIO", "env_AudioSD_currentVolume_PhoVol", 1, profileFile));
    putValue(env_AudioSD_currentVolume_SdsVol,getProfileInt("BAP AUDIO", "env_AudioSD_currentVolume_SdsVol", 1, profileFile));
    putValue(env_AudioSD_currentVolume_TaVol,getProfileInt("BAP AUDIO", "env_AudioSD_currentVolume_TaVol", 1, profileFile));
    putValue(env_AudioSD_currentVolume_update,getProfileInt("BAP AUDIO", "env_AudioSD_currentVolume_update", 1, profileFile));
    putValue(env_AudioSD_DABList_Long,getProfileInt("BAP AUDIO", "env_AudioSD_DABList_Long", 1, profileFile));
    putValue(env_AudioSD_DABList_Short,getProfileInt("BAP AUDIO", "env_AudioSD_DABList_Short", 1, profileFile));
    putValue(env_AudioSD_DAC_Abort,getProfileInt("BAP AUDIO", "env_AudioSD_DAC_Abort", 1, profileFile));
    putValue(env_AudioSD_DAC_Error_on,getProfileInt("BAP AUDIO", "env_AudioSD_DAC_Error_on", 1, profileFile));
    putValue(env_AudioSD_DAC_ErrorCode,getProfileInt("BAP AUDIO", "env_AudioSD_DAC_ErrorCode", 1, profileFile));
    putValue(env_AudioSD_DAC_FSGHandle,getProfileInt("BAP AUDIO", "env_AudioSD_DAC_FSGHandle", 1, profileFile));
    putValue(env_AudioSD_DAC_Res,getProfileInt("BAP AUDIO", "env_AudioSD_DAC_Res", 1, profileFile));
    putValue(env_AudioSD_ErrorGen_ErrorCode,getProfileInt("BAP AUDIO", "env_AudioSD_ErrorGen_ErrorCode", 1, profileFile));
    putValue(env_AudioSD_ErrorGen_ErrorCode_h,getProfileInt("BAP AUDIO", "env_AudioSD_ErrorGen_ErrorCode_h", 1, profileFile));
    putValue(env_AudioSD_ErrorGen_FctID,getProfileInt("BAP AUDIO", "env_AudioSD_ErrorGen_FctID", 1, profileFile));
    putValue(env_AudioSD_ErrorGen_send,getProfileInt("BAP AUDIO", "env_AudioSD_ErrorGen_send", 1, profileFile));
    putValue(env_AudioSD_FctList_0x01,getProfileInt("BAP AUDIO", "env_AudioSD_FctList_0x01", 1, profileFile));
    putValue(env_AudioSD_FctList_0x01_HB,getProfileInt("BAP AUDIO", "env_AudioSD_FctList_0x01_HB", 1, profileFile));
    putValue(env_AudioSD_FctList_0x01_TimeOut,getProfileInt("BAP AUDIO", "env_AudioSD_FctList_0x01_TimeOut", 1, profileFile));
    putValue(env_AudioSD_FctList_0x02,getProfileInt("BAP AUDIO", "env_AudioSD_FctList_0x02", 1, profileFile));
    putValue(env_AudioSD_FctList_0x02_HB,getProfileInt("BAP AUDIO", "env_AudioSD_FctList_0x02_HB", 1, profileFile));
    putValue(env_AudioSD_FctList_0x03,getProfileInt("BAP AUDIO", "env_AudioSD_FctList_0x03", 1, profileFile));
    putValue(env_AudioSD_FctList_0x03_HB,getProfileInt("BAP AUDIO", "env_AudioSD_FctList_0x03_HB", 1, profileFile));
    putValue(env_AudioSD_FctList_0x04,getProfileInt("BAP AUDIO", "env_AudioSD_FctList_0x04", 1, profileFile));
    putValue(env_AudioSD_FctList_0x04_HB,getProfileInt("BAP AUDIO", "env_AudioSD_FctList_0x04_HB", 1, profileFile));
    putValue(env_AudioSD_FctList_0x0E,getProfileInt("BAP AUDIO", "env_AudioSD_FctList_0x0E", 1, profileFile));
    putValue(env_AudioSD_FctList_0x0E_HB,getProfileInt("BAP AUDIO", "env_AudioSD_FctList_0x0E_HB", 1, profileFile));
    putValue(env_AudioSD_FctList_0x0E_TimeOut,getProfileInt("BAP AUDIO", "env_AudioSD_FctList_0x0E_TimeOut", 1, profileFile));
    putValue(env_AudioSD_FctList_0x0F,getProfileInt("BAP AUDIO", "env_AudioSD_FctList_0x0F", 1, profileFile));
    putValue(env_AudioSD_FctList_0x0F_HB,getProfileInt("BAP AUDIO", "env_AudioSD_FctList_0x0F_HB", 1, profileFile));
    putValue(env_AudioSD_FctList_0x0F_TimeOut,getProfileInt("BAP AUDIO", "env_AudioSD_FctList_0x0F_TimeOut", 1, profileFile));
    putValue(env_AudioSD_FctList_0x10,getProfileInt("BAP AUDIO", "env_AudioSD_FctList_0x10", 1, profileFile));
    putValue(env_AudioSD_FctList_0x10_HB,getProfileInt("BAP AUDIO", "env_AudioSD_FctList_0x10_HB", 1, profileFile));
    putValue(env_AudioSD_FctList_0x10_TimeOut,getProfileInt("BAP AUDIO", "env_AudioSD_FctList_0x10_TimeOut", 1, profileFile));
    putValue(env_AudioSD_FctList_0x11,getProfileInt("BAP AUDIO", "env_AudioSD_FctList_0x11", 1, profileFile));
    putValue(env_AudioSD_FctList_0x11_HB,getProfileInt("BAP AUDIO", "env_AudioSD_FctList_0x11_HB", 1, profileFile));
    putValue(env_AudioSD_FctList_0x11_TimeOut,getProfileInt("BAP AUDIO", "env_AudioSD_FctList_0x11_TimeOut", 1, profileFile));
    putValue(env_AudioSD_FctList_0x12,getProfileInt("BAP AUDIO", "env_AudioSD_FctList_0x12", 1, profileFile));
    putValue(env_AudioSD_FctList_0x12_HB,getProfileInt("BAP AUDIO", "env_AudioSD_FctList_0x12_HB", 1, profileFile));
    putValue(env_AudioSD_FctList_0x12_TimeOut,getProfileInt("BAP AUDIO", "env_AudioSD_FctList_0x12_TimeOut", 1, profileFile));
    putValue(env_AudioSD_FctList_0x13,getProfileInt("BAP AUDIO", "env_AudioSD_FctList_0x13", 1, profileFile));
    putValue(env_AudioSD_FctList_0x13_HB,getProfileInt("BAP AUDIO", "env_AudioSD_FctList_0x13_HB", 1, profileFile));
    putValue(env_AudioSD_FctList_0x13_TimeOut,getProfileInt("BAP AUDIO", "env_AudioSD_FctList_0x13_TimeOut", 1, profileFile));
    putValue(env_AudioSD_FctList_0x14,getProfileInt("BAP AUDIO", "env_AudioSD_FctList_0x14", 1, profileFile));
    putValue(env_AudioSD_FctList_0x14_HB,getProfileInt("BAP AUDIO", "env_AudioSD_FctList_0x14_HB", 1, profileFile));
    putValue(env_AudioSD_FctList_0x14_TimeOut,getProfileInt("BAP AUDIO", "env_AudioSD_FctList_0x14_TimeOut", 1, profileFile));
    putValue(env_AudioSD_FctList_0x15,getProfileInt("BAP AUDIO", "env_AudioSD_FctList_0x15", 1, profileFile));
    putValue(env_AudioSD_FctList_0x15_HB,getProfileInt("BAP AUDIO", "env_AudioSD_FctList_0x15_HB", 1, profileFile));
    putValue(env_AudioSD_FctList_0x15_TimeOut,getProfileInt("BAP AUDIO", "env_AudioSD_FctList_0x15_TimeOut", 1, profileFile));
    putValue(env_AudioSD_FctList_0x16,getProfileInt("BAP AUDIO", "env_AudioSD_FctList_0x16", 1, profileFile));
    putValue(env_AudioSD_FctList_0x16_HB,getProfileInt("BAP AUDIO", "env_AudioSD_FctList_0x16_HB", 1, profileFile));
    putValue(env_AudioSD_FctList_0x16_TimeOut,getProfileInt("BAP AUDIO", "env_AudioSD_FctList_0x16_TimeOut", 1, profileFile));
    putValue(env_AudioSD_FctList_0x17,getProfileInt("BAP AUDIO", "env_AudioSD_FctList_0x17", 1, profileFile));
    putValue(env_AudioSD_FctList_0x17_HB,getProfileInt("BAP AUDIO", "env_AudioSD_FctList_0x17_HB", 1, profileFile));
    putValue(env_AudioSD_FctList_0x17_TimeOut,getProfileInt("BAP AUDIO", "env_AudioSD_FctList_0x17_TimeOut", 1, profileFile));
    putValue(env_AudioSD_FctList_0x18,getProfileInt("BAP AUDIO", "env_AudioSD_FctList_0x18", 1, profileFile));
    putValue(env_AudioSD_FctList_0x18_3min_TO,getProfileInt("BAP AUDIO", "env_AudioSD_FctList_0x18_3min_TO", 1, profileFile));
    putValue(env_AudioSD_FctList_0x18_HB,getProfileInt("BAP AUDIO", "env_AudioSD_FctList_0x18_HB", 1, profileFile));
    putValue(env_AudioSD_FctList_0x18_TimeOut,getProfileInt("BAP AUDIO", "env_AudioSD_FctList_0x18_TimeOut", 1, profileFile));
    putValue(env_AudioSD_FctList_0x19,getProfileInt("BAP AUDIO", "env_AudioSD_FctList_0x19", 1, profileFile));
    putValue(env_AudioSD_FctList_0x19_HB,getProfileInt("BAP AUDIO", "env_AudioSD_FctList_0x19_HB", 1, profileFile));
    putValue(env_AudioSD_FctList_0x19_TimeOut,getProfileInt("BAP AUDIO", "env_AudioSD_FctList_0x19_TimeOut", 1, profileFile));
    putValue(env_AudioSD_FctList_0x1A,getProfileInt("BAP AUDIO", "env_AudioSD_FctList_0x1A", 1, profileFile));
    putValue(env_AudioSD_FctList_0x1A_HB,getProfileInt("BAP AUDIO", "env_AudioSD_FctList_0x1A_HB", 1, profileFile));
    putValue(env_AudioSD_FctList_0x1A_TimeOut,getProfileInt("BAP AUDIO", "env_AudioSD_FctList_0x1A_TimeOut", 1, profileFile));
    putValue(env_AudioSD_FctList_0x1B,getProfileInt("BAP AUDIO", "env_AudioSD_FctList_0x1B", 1, profileFile));
    putValue(env_AudioSD_FctList_0x1B_HB,getProfileInt("BAP AUDIO", "env_AudioSD_FctList_0x1B_HB", 1, profileFile));
    putValue(env_AudioSD_FctList_0x1B_TimeOut,getProfileInt("BAP AUDIO", "env_AudioSD_FctList_0x1B_TimeOut", 1, profileFile));
    putValue(env_AudioSD_FctList_0x1C,getProfileInt("BAP AUDIO", "env_AudioSD_FctList_0x1C", 1, profileFile));
    putValue(env_AudioSD_FctList_0x1C_HB,getProfileInt("BAP AUDIO", "env_AudioSD_FctList_0x1C_HB", 1, profileFile));
    putValue(env_AudioSD_FctList_0x1C_TimeOut,getProfileInt("BAP AUDIO", "env_AudioSD_FctList_0x1C_TimeOut", 1, profileFile));
    putValue(env_AudioSD_FctList_0x1D,getProfileInt("BAP AUDIO", "env_AudioSD_FctList_0x1D", 1, profileFile));
    putValue(env_AudioSD_FctList_0x1D_3min_TO,getProfileInt("BAP AUDIO", "env_AudioSD_FctList_0x1D_3min_TO", 1, profileFile));
    putValue(env_AudioSD_FctList_0x1D_HB,getProfileInt("BAP AUDIO", "env_AudioSD_FctList_0x1D_HB", 1, profileFile));
    putValue(env_AudioSD_FctList_0x1D_TimeOut,getProfileInt("BAP AUDIO", "env_AudioSD_FctList_0x1D_TimeOut", 1, profileFile));
    putValue(env_AudioSD_FctList_0x1E,getProfileInt("BAP AUDIO", "env_AudioSD_FctList_0x1E", 1, profileFile));
    putValue(env_AudioSD_FctList_0x1E_HB,getProfileInt("BAP AUDIO", "env_AudioSD_FctList_0x1E_HB", 1, profileFile));
    putValue(env_AudioSD_FctList_0x1E_TimeOut,getProfileInt("BAP AUDIO", "env_AudioSD_FctList_0x1E_TimeOut", 1, profileFile));
    putValue(env_AudioSD_FctList_0x1F,getProfileInt("BAP AUDIO", "env_AudioSD_FctList_0x1F", 1, profileFile));
    putValue(env_AudioSD_FctList_0x1F_HB,getProfileInt("BAP AUDIO", "env_AudioSD_FctList_0x1F_HB", 1, profileFile));
    putValue(env_AudioSD_FctList_0x1F_TimeOut,getProfileInt("BAP AUDIO", "env_AudioSD_FctList_0x1F_TimeOut", 1, profileFile));
    putValue(env_AudioSD_FctList_0x20,getProfileInt("BAP AUDIO", "env_AudioSD_FctList_0x20", 1, profileFile));
    putValue(env_AudioSD_FctList_0x20_HB,getProfileInt("BAP AUDIO", "env_AudioSD_FctList_0x20_HB", 1, profileFile));
    putValue(env_AudioSD_FctList_0x20_TimeOut,getProfileInt("BAP AUDIO", "env_AudioSD_FctList_0x20_TimeOut", 1, profileFile));
    putValue(env_AudioSD_FctList_0x21,getProfileInt("BAP AUDIO", "env_AudioSD_FctList_0x21", 1, profileFile));
    putValue(env_AudioSD_FctList_0x21_HB,getProfileInt("BAP AUDIO", "env_AudioSD_FctList_0x21_HB", 1, profileFile));
    putValue(env_AudioSD_FctList_0x21_TimeOut,getProfileInt("BAP AUDIO", "env_AudioSD_FctList_0x21_TimeOut", 1, profileFile));
    putValue(env_AudioSD_FctList_0x22,getProfileInt("BAP AUDIO", "env_AudioSD_FctList_0x22", 1, profileFile));
    putValue(env_AudioSD_FctList_0x22_3min_TO,getProfileInt("BAP AUDIO", "env_AudioSD_FctList_0x22_3min_TO", 1, profileFile));
    putValue(env_AudioSD_FctList_0x22_HB,getProfileInt("BAP AUDIO", "env_AudioSD_FctList_0x22_HB", 1, profileFile));
    putValue(env_AudioSD_FctList_0x22_TimeOut,getProfileInt("BAP AUDIO", "env_AudioSD_FctList_0x22_TimeOut", 1, profileFile));
    putValue(env_AudioSD_FctList_0x23,getProfileInt("BAP AUDIO", "env_AudioSD_FctList_0x23", 1, profileFile));
    putValue(env_AudioSD_FctList_0x23_HB,getProfileInt("BAP AUDIO", "env_AudioSD_FctList_0x23_HB", 1, profileFile));
    putValue(env_AudioSD_FctList_0x23_TimeOut,getProfileInt("BAP AUDIO", "env_AudioSD_FctList_0x23_TimeOut", 1, profileFile));
    putValue(env_AudioSD_FctList_0x24,getProfileInt("BAP AUDIO", "env_AudioSD_FctList_0x24", 1, profileFile));
    putValue(env_AudioSD_FctList_0x24_HB,getProfileInt("BAP AUDIO", "env_AudioSD_FctList_0x24_HB", 1, profileFile));
    putValue(env_AudioSD_FctList_0x24_TimeOut,getProfileInt("BAP AUDIO", "env_AudioSD_FctList_0x24_TimeOut", 1, profileFile));
    putValue(env_AudioSD_FctList_0x25,getProfileInt("BAP AUDIO", "env_AudioSD_FctList_0x25", 1, profileFile));
    putValue(env_AudioSD_FctList_0x25_HB,getProfileInt("BAP AUDIO", "env_AudioSD_FctList_0x25_HB", 1, profileFile));
    putValue(env_AudioSD_FctList_0x25_TimeOut,getProfileInt("BAP AUDIO", "env_AudioSD_FctList_0x25_TimeOut", 1, profileFile));
    putValue(env_AudioSD_FctList_0x26,getProfileInt("BAP AUDIO", "env_AudioSD_FctList_0x26", 1, profileFile));
    putValue(env_AudioSD_FctList_0x26_3min_TO,getProfileInt("BAP AUDIO", "env_AudioSD_FctList_0x26_3min_TO", 1, profileFile));
    putValue(env_AudioSD_FctList_0x26_HB,getProfileInt("BAP AUDIO", "env_AudioSD_FctList_0x26_HB", 1, profileFile));
    putValue(env_AudioSD_FctList_0x26_TimeOut,getProfileInt("BAP AUDIO", "env_AudioSD_FctList_0x26_TimeOut", 1, profileFile));
    putValue(env_AudioSD_FctList_0x27,getProfileInt("BAP AUDIO", "env_AudioSD_FctList_0x27", 1, profileFile));
    putValue(env_AudioSD_FctList_0x27_3min_TO,getProfileInt("BAP AUDIO", "env_AudioSD_FctList_0x27_3min_TO", 1, profileFile));
    putValue(env_AudioSD_FctList_0x27_HB,getProfileInt("BAP AUDIO", "env_AudioSD_FctList_0x27_HB", 1, profileFile));
    putValue(env_AudioSD_FctList_0x27_TimeOut,getProfileInt("BAP AUDIO", "env_AudioSD_FctList_0x27_TimeOut", 1, profileFile));
    putValue(env_AudioSD_FctList_0x28,getProfileInt("BAP AUDIO", "env_AudioSD_FctList_0x28", 1, profileFile));
    putValue(env_AudioSD_FctList_0x28_HB,getProfileInt("BAP AUDIO", "env_AudioSD_FctList_0x28_HB", 1, profileFile));
    putValue(env_AudioSD_FctList_0x28_TimeOut,getProfileInt("BAP AUDIO", "env_AudioSD_FctList_0x28_TimeOut", 1, profileFile));
    putValue(env_AudioSD_FctList_0x29,getProfileInt("BAP AUDIO", "env_AudioSD_FctList_0x29", 1, profileFile));
    putValue(env_AudioSD_FctList_0x29_HB,getProfileInt("BAP AUDIO", "env_AudioSD_FctList_0x29_HB", 1, profileFile));
    putValue(env_AudioSD_FctList_0x29_TimeOut,getProfileInt("BAP AUDIO", "env_AudioSD_FctList_0x29_TimeOut", 1, profileFile));
    putValue(env_AudioSD_FctList_0x2A,getProfileInt("BAP AUDIO", "env_AudioSD_FctList_0x2A", 1, profileFile));
    putValue(env_AudioSD_FctList_0x2A_HB,getProfileInt("BAP AUDIO", "env_AudioSD_FctList_0x2A_HB", 1, profileFile));
    putValue(env_AudioSD_FctList_0x2A_TimeOut,getProfileInt("BAP AUDIO", "env_AudioSD_FctList_0x2A_TimeOut", 1, profileFile));
    putValue(env_AudioSD_FctList_0x2B,getProfileInt("BAP AUDIO", "env_AudioSD_FctList_0x2B", 1, profileFile));
    putValue(env_AudioSD_FctList_0x2B_HB,getProfileInt("BAP AUDIO", "env_AudioSD_FctList_0x2B_HB", 1, profileFile));
    putValue(env_AudioSD_FctList_0x2B_TimeOut,getProfileInt("BAP AUDIO", "env_AudioSD_FctList_0x2B_TimeOut", 1, profileFile));
    putValue(env_AudioSD_FctList_0x2C,getProfileInt("BAP AUDIO", "env_AudioSD_FctList_0x2C", 1, profileFile));
    putValue(env_AudioSD_FctList_0x2C_3min_TO,getProfileInt("BAP AUDIO", "env_AudioSD_FctList_0x2C_3min_TO", 1, profileFile));
    putValue(env_AudioSD_FctList_0x2C_HB,getProfileInt("BAP AUDIO", "env_AudioSD_FctList_0x2C_HB", 1, profileFile));
    putValue(env_AudioSD_FctList_0x2C_TimeOut,getProfileInt("BAP AUDIO", "env_AudioSD_FctList_0x2C_TimeOut", 1, profileFile));
    putValue(env_AudioSD_FctList_0x2D_TimeOut,getProfileInt("BAP AUDIO", "env_AudioSD_FctList_0x2D_TimeOut", 1, profileFile));
    putValue(env_AudioSD_FctList_0x2E_TimeOut,getProfileInt("BAP AUDIO", "env_AudioSD_FctList_0x2E_TimeOut", 1, profileFile));
    putValue(env_AudioSD_FctList_0x2F_TimeOut,getProfileInt("BAP AUDIO", "env_AudioSD_FctList_0x2F_TimeOut", 1, profileFile));
    putValue(env_AudioSD_FctList_0x30_TimeOut,getProfileInt("BAP AUDIO", "env_AudioSD_FctList_0x30_TimeOut", 1, profileFile));
    putValue(env_AudioSD_FctSync_Bit16_aS,getProfileInt("BAP AUDIO", "env_AudioSD_FctSync_Bit16_aS", 1, profileFile));
    putValue(env_AudioSD_FctSync_Bit17_aSn,getProfileInt("BAP AUDIO", "env_AudioSD_FctSync_Bit17_aSn", 1, profileFile));
    putValue(env_AudioSD_FctSync_Bit18_cV,getProfileInt("BAP AUDIO", "env_AudioSD_FctSync_Bit18_cV", 1, profileFile));
    putValue(env_AudioSD_FctSync_Bit19_Mute,getProfileInt("BAP AUDIO", "env_AudioSD_FctSync_Bit19_Mute", 1, profileFile));
    putValue(env_AudioSD_FctSync_Bit20_SrcS,getProfileInt("BAP AUDIO", "env_AudioSD_FctSync_Bit20_SrcS", 1, profileFile));
    putValue(env_AudioSD_FctSync_Bit21_CSI,getProfileInt("BAP AUDIO", "env_AudioSD_FctSync_Bit21_CSI", 1, profileFile));
    putValue(env_AudioSD_FctSync_Bit22_CSH,getProfileInt("BAP AUDIO", "env_AudioSD_FctSync_Bit22_CSH", 1, profileFile));
    putValue(env_AudioSD_FctSync_Bit23_RL,getProfileInt("BAP AUDIO", "env_AudioSD_FctSync_Bit23_RL", 1, profileFile));
    putValue(env_AudioSD_FctSync_Bit24_DAC,getProfileInt("BAP AUDIO", "env_AudioSD_FctSync_Bit24_DAC", 1, profileFile));
    putValue(env_AudioSD_FctSync_Bit25_GIS,getProfileInt("BAP AUDIO", "env_AudioSD_FctSync_Bit25_GIS", 1, profileFile));
    putValue(env_AudioSD_FctSync_Bit26_TPm,getProfileInt("BAP AUDIO", "env_AudioSD_FctSync_Bit26_TPm", 1, profileFile));
    putValue(env_AudioSD_FctSync_Bit27_TPmL,getProfileInt("BAP AUDIO", "env_AudioSD_FctSync_Bit27_TPmL", 1, profileFile));
    putValue(env_AudioSD_FctSync_Bit28_AnIn,getProfileInt("BAP AUDIO", "env_AudioSD_FctSync_Bit28_AnIn", 1, profileFile));
    putValue(env_AudioSD_FctSync_Bit29_AnEs,getProfileInt("BAP AUDIO", "env_AudioSD_FctSync_Bit29_AnEs", 1, profileFile));
    putValue(env_AudioSD_FctSync_Bit30_InfS,getProfileInt("BAP AUDIO", "env_AudioSD_FctSync_Bit30_InfS", 1, profileFile));
    putValue(env_AudioSD_FctSync_Bit31_RLT,getProfileInt("BAP AUDIO", "env_AudioSD_FctSync_Bit31_RLT", 1, profileFile));
    putValue(env_AudioSD_FctSync_Bit32_SL,getProfileInt("BAP AUDIO", "env_AudioSD_FctSync_Bit32_SL", 1, profileFile));
    putValue(env_AudioSD_FctSync_Bit33_RTPL,getProfileInt("BAP AUDIO", "env_AudioSD_FctSync_Bit33_RTPL", 1, profileFile));
    putValue(env_AudioSD_FctSync_Bit34_SwS,getProfileInt("BAP AUDIO", "env_AudioSD_FctSync_Bit34_SwS", 1, profileFile));
    putValue(env_AudioSD_FctSync_Bit35_MBFL,getProfileInt("BAP AUDIO", "env_AudioSD_FctSync_Bit35_MBFL", 1, profileFile));
    putValue(env_AudioSD_FctSync_Bit36_MB,getProfileInt("BAP AUDIO", "env_AudioSD_FctSync_Bit36_MB", 1, profileFile));
    putValue(env_AudioSD_FctSync_Bit37_MPa,getProfileInt("BAP AUDIO", "env_AudioSD_FctSync_Bit37_MPa", 1, profileFile));
    putValue(env_AudioSD_FctSync_Bit38_MBCt,getProfileInt("BAP AUDIO", "env_AudioSD_FctSync_Bit38_MBCt", 1, profileFile));
    putValue(env_AudioSD_FctSync_Bit39_MFIn,getProfileInt("BAP AUDIO", "env_AudioSD_FctSync_Bit39_MFIn", 1, profileFile));
    putValue(env_AudioSD_FctSync_Bit40_PrfL,getProfileInt("BAP AUDIO", "env_AudioSD_FctSync_Bit40_PrfL", 1, profileFile));
    putValue(env_AudioSD_FctSync_Bit41_SDS,getProfileInt("BAP AUDIO", "env_AudioSD_FctSync_Bit41_SDS", 1, profileFile));
    putValue(env_AudioSD_FctSync_Bit42_FctS,getProfileInt("BAP AUDIO", "env_AudioSD_FctSync_Bit42_FctS", 1, profileFile));
    putValue(env_AudioSD_FctSync_Bit43_ASGC,getProfileInt("BAP AUDIO", "env_AudioSD_FctSync_Bit43_ASGC", 1, profileFile));
    putValue(env_AudioSD_FctSync_Bit44_GNLP,getProfileInt("BAP AUDIO", "env_AudioSD_FctSync_Bit44_GNLP", 1, profileFile));
    putValue(env_AudioSD_FctSync_update,getProfileInt("BAP AUDIO", "env_AudioSD_FctSync_update", 1, profileFile));
    putValue(env_AudioSD_FSGOpState_HMIState,getProfileInt("BAP AUDIO", "env_AudioSD_FSGOpState_HMIState", 1, profileFile));
    putValue(env_AudioSD_FSGOpState_OpState,getProfileInt("BAP AUDIO", "env_AudioSD_FSGOpState_OpState", 1, profileFile));
    putValue(env_AudioSD_FSGOpState_update,getProfileInt("BAP AUDIO", "env_AudioSD_FSGOpState_update", 1, profileFile));
    putValue(env_AudioSD_FSGSetup_AM,getProfileInt("BAP AUDIO", "env_AudioSD_FSGSetup_AM", 1, profileFile));
    putValue(env_AudioSD_FSGSetup_AMLW,getProfileInt("BAP AUDIO", "env_AudioSD_FSGSetup_AMLW", 1, profileFile));
    putValue(env_AudioSD_FSGSetup_AMSW,getProfileInt("BAP AUDIO", "env_AudioSD_FSGSetup_AMSW", 1, profileFile));
    putValue(env_AudioSD_FSGSetup_DAB,getProfileInt("BAP AUDIO", "env_AudioSD_FSGSetup_DAB", 1, profileFile));
    putValue(env_AudioSD_FSGSetup_entertainm,getProfileInt("BAP AUDIO", "env_AudioSD_FSGSetup_entertainm", 1, profileFile));
    putValue(env_AudioSD_FSGSetup_Ext_DAB,getProfileInt("BAP AUDIO", "env_AudioSD_FSGSetup_Ext_DAB", 1, profileFile));
    putValue(env_AudioSD_FSGSetup_FM,getProfileInt("BAP AUDIO", "env_AudioSD_FSGSetup_FM", 1, profileFile));
    putValue(env_AudioSD_FSGSetup_MaxVol,getProfileInt("BAP AUDIO", "env_AudioSD_FSGSetup_MaxVol", 1, profileFile));
    putValue(env_AudioSD_FSGSetup_Nav,getProfileInt("BAP AUDIO", "env_AudioSD_FSGSetup_Nav", 1, profileFile));
    putValue(env_AudioSD_FSGSetup_OnRL,getProfileInt("BAP AUDIO", "env_AudioSD_FSGSetup_OnRL", 1, profileFile));
    putValue(env_AudioSD_FSGSetup_Phone,getProfileInt("BAP AUDIO", "env_AudioSD_FSGSetup_Phone", 1, profileFile));
    putValue(env_AudioSD_FSGSetup_SDARS,getProfileInt("BAP AUDIO", "env_AudioSD_FSGSetup_SDARS", 1, profileFile));
    putValue(env_AudioSD_FSGSetup_SDS,getProfileInt("BAP AUDIO", "env_AudioSD_FSGSetup_SDS", 1, profileFile));
    putValue(env_AudioSD_FSGSetup_TA,getProfileInt("BAP AUDIO", "env_AudioSD_FSGSetup_TA", 1, profileFile));
    putValue(env_AudioSD_FSGSetup_TV,getProfileInt("BAP AUDIO", "env_AudioSD_FSGSetup_TV", 1, profileFile));
    putValue(env_AudioSD_FSGSetup_update,getProfileInt("BAP AUDIO", "env_AudioSD_FSGSetup_update", 1, profileFile));
    putValue(env_AudioSD_GIS_Error_on,getProfileInt("BAP AUDIO", "env_AudioSD_GIS_Error_on", 1, profileFile));
    putValue(env_AudioSD_GIS_ErrorCode,getProfileInt("BAP AUDIO", "env_AudioSD_GIS_ErrorCode", 1, profileFile));
    putValue(env_AudioSD_GIS_Mod_JPtraffic,getProfileInt("BAP AUDIO", "env_AudioSD_GIS_Mod_JPtraffic", 1, profileFile));
    putValue(env_AudioSD_GIS_Mod_OLtraffic,getProfileInt("BAP AUDIO", "env_AudioSD_GIS_Mod_OLtraffic", 1, profileFile));
    putValue(env_AudioSD_GIS_Mod_RDS,getProfileInt("BAP AUDIO", "env_AudioSD_GIS_Mod_RDS", 1, profileFile));
    putValue(env_AudioSD_GIS_Mod_Reserve1,getProfileInt("BAP AUDIO", "env_AudioSD_GIS_Mod_Reserve1", 1, profileFile));
    putValue(env_AudioSD_GIS_Mod_Reserve2,getProfileInt("BAP AUDIO", "env_AudioSD_GIS_Mod_Reserve2", 1, profileFile));
    putValue(env_AudioSD_GIS_Mod_TMC,getProfileInt("BAP AUDIO", "env_AudioSD_GIS_Mod_TMC", 1, profileFile));
    putValue(env_AudioSD_GIS_Mod_TPTA,getProfileInt("BAP AUDIO", "env_AudioSD_GIS_Mod_TPTA", 1, profileFile));
    putValue(env_AudioSD_GIS_Mod_VICS,getProfileInt("BAP AUDIO", "env_AudioSD_GIS_Mod_VICS", 1, profileFile));
    putValue(env_AudioSD_GIS_OnOff_JPtraffic,getProfileInt("BAP AUDIO", "env_AudioSD_GIS_OnOff_JPtraffic", 1, profileFile));
    putValue(env_AudioSD_GIS_OnOff_OLtraffic,getProfileInt("BAP AUDIO", "env_AudioSD_GIS_OnOff_OLtraffic", 1, profileFile));
    putValue(env_AudioSD_GIS_OnOff_RDS,getProfileInt("BAP AUDIO", "env_AudioSD_GIS_OnOff_RDS", 1, profileFile));
    putValue(env_AudioSD_GIS_OnOff_Reserve1,getProfileInt("BAP AUDIO", "env_AudioSD_GIS_OnOff_Reserve1", 1, profileFile));
    putValue(env_AudioSD_GIS_OnOff_Reserve2,getProfileInt("BAP AUDIO", "env_AudioSD_GIS_OnOff_Reserve2", 1, profileFile));
    putValue(env_AudioSD_GIS_OnOff_TMC,getProfileInt("BAP AUDIO", "env_AudioSD_GIS_OnOff_TMC", 1, profileFile));
    putValue(env_AudioSD_GIS_OnOff_TPTA,getProfileInt("BAP AUDIO", "env_AudioSD_GIS_OnOff_TPTA", 1, profileFile));
    putValue(env_AudioSD_GIS_OnOff_VICS,getProfileInt("BAP AUDIO", "env_AudioSD_GIS_OnOff_VICS", 1, profileFile));
    putValue(env_AudioSD_GIS_update,getProfileInt("BAP AUDIO", "env_AudioSD_GIS_update", 1, profileFile));
    putValue(env_AudioSD_GNLP_Abort,getProfileInt("BAP AUDIO", "env_AudioSD_GNLP_Abort", 1, profileFile));
    putValue(env_AudioSD_GNLP_absPos,getProfileInt("BAP AUDIO", "env_AudioSD_GNLP_absPos", 1, profileFile));
    putValue(env_AudioSD_GNLP_CurrPos,getProfileInt("BAP AUDIO", "env_AudioSD_GNLP_CurrPos", 1, profileFile));
    putValue(env_AudioSD_GNLP_Error_on,getProfileInt("BAP AUDIO", "env_AudioSD_GNLP_Error_on", 1, profileFile));
    putValue(env_AudioSD_GNLP_ErrorCode,getProfileInt("BAP AUDIO", "env_AudioSD_GNLP_ErrorCode", 1, profileFile));
    putValue(env_AudioSD_GNLP_nextPos,getProfileInt("BAP AUDIO", "env_AudioSD_GNLP_nextPos", 1, profileFile));
    putValue(env_AudioSD_GNLP_Offset,getProfileInt("BAP AUDIO", "env_AudioSD_GNLP_Offset", 1, profileFile));
    putValue(env_AudioSD_GNLP_Result,getProfileInt("BAP AUDIO", "env_AudioSD_GNLP_Result", 1, profileFile));
    putValue(env_AudioSD_InfoStates_states,getProfileInt("BAP AUDIO", "env_AudioSD_InfoStates_states", 1, profileFile));
    putValue(env_AudioSD_InfoStates_update,getProfileInt("BAP AUDIO", "env_AudioSD_InfoStates_update", 1, profileFile));
    putValue(env_AudioSD_MB_ActiveListPos,getProfileInt("BAP AUDIO", "env_AudioSD_MB_ActiveListPos", 1, profileFile));
    putValue(env_AudioSD_MB_AH_dir,getProfileInt("BAP AUDIO", "env_AudioSD_MB_AH_dir", 1, profileFile));
    putValue(env_AudioSD_MB_AH_elements,getProfileInt("BAP AUDIO", "env_AudioSD_MB_AH_elements", 1, profileFile));
    putValue(env_AudioSD_MB_AH_IS,getProfileInt("BAP AUDIO", "env_AudioSD_MB_AH_IS", 1, profileFile));
    putValue(env_AudioSD_MB_AH_POS,getProfileInt("BAP AUDIO", "env_AudioSD_MB_AH_POS", 1, profileFile));
    putValue(env_AudioSD_MB_AH_RA,getProfileInt("BAP AUDIO", "env_AudioSD_MB_AH_RA", 1, profileFile));
    putValue(env_AudioSD_MB_AH_shift,getProfileInt("BAP AUDIO", "env_AudioSD_MB_AH_shift", 1, profileFile));
    putValue(env_AudioSD_MB_AH_start,getProfileInt("BAP AUDIO", "env_AudioSD_MB_AH_start", 1, profileFile));
    putValue(env_AudioSD_MB_ASGID,getProfileInt("BAP AUDIO", "env_AudioSD_MB_ASGID", 1, profileFile));
    putValue(env_AudioSD_MB_ASGID_error,getProfileInt("BAP AUDIO", "env_AudioSD_MB_ASGID_error", 1, profileFile));
    putValue(env_AudioSD_MB_CA,getProfileInt("BAP AUDIO", "env_AudioSD_MB_CA", 1, profileFile));
    putValue(env_AudioSD_MB_CA_switch,getProfileInt("BAP AUDIO", "env_AudioSD_MB_CA_switch", 1, profileFile));
    putValue(env_AudioSD_MB_Error_on,getProfileInt("BAP AUDIO", "env_AudioSD_MB_Error_on", 1, profileFile));
    putValue(env_AudioSD_MB_ErrorCode,getProfileInt("BAP AUDIO", "env_AudioSD_MB_ErrorCode", 1, profileFile));
    putValue(env_AudioSD_MB_FRU,getProfileInt("BAP AUDIO", "env_AudioSD_MB_FRU", 1, profileFile));
    putValue(env_AudioSD_MB_reload,getProfileInt("BAP AUDIO", "env_AudioSD_MB_reload", 1, profileFile));
    putValue(env_AudioSD_MB_StatusArray,getProfileInt("BAP AUDIO", "env_AudioSD_MB_StatusArray", 1, profileFile));
    putValue(env_AudioSD_MB_TAID,getProfileInt("BAP AUDIO", "env_AudioSD_MB_TAID", 1, profileFile));
    putValue(env_AudioSD_MB_TAID_error,getProfileInt("BAP AUDIO", "env_AudioSD_MB_TAID_error", 1, profileFile));
    putValue(env_AudioSD_MB_Timeout,getProfileInt("BAP AUDIO", "env_AudioSD_MB_Timeout", 1, profileFile));
    putValue(env_AudioSD_MB_TotalNumLE,getProfileInt("BAP AUDIO", "env_AudioSD_MB_TotalNumLE", 1, profileFile));
    putValue(env_AudioSD_MBList_Long,getProfileInt("BAP AUDIO", "env_AudioSD_MBList_Long", 1, profileFile));
    putValue(env_AudioSD_MBList_Short,getProfileInt("BAP AUDIO", "env_AudioSD_MBList_Short", 1, profileFile));
    putValue(env_AudioSD_MBrC_Abort,getProfileInt("BAP AUDIO", "env_AudioSD_MBrC_Abort", 1, profileFile));
    putValue(env_AudioSD_MBrC_Error_on,getProfileInt("BAP AUDIO", "env_AudioSD_MBrC_Error_on", 1, profileFile));
    putValue(env_AudioSD_MBrC_ErrorCode,getProfileInt("BAP AUDIO", "env_AudioSD_MBrC_ErrorCode", 1, profileFile));
    putValue(env_AudioSD_MBrC_Ref,getProfileInt("BAP AUDIO", "env_AudioSD_MBrC_Ref", 1, profileFile));
    putValue(env_AudioSD_MBrC_Res,getProfileInt("BAP AUDIO", "env_AudioSD_MBrC_Res", 1, profileFile));
    putValue(env_AudioSD_MedBrFoLev_FolLev,getProfileInt("BAP AUDIO", "env_AudioSD_MedBrFoLev_FolLev", 1, profileFile));
    putValue(env_AudioSD_MedBrFoLev_Ref,getProfileInt("BAP AUDIO", "env_AudioSD_MedBrFoLev_Ref", 1, profileFile));
    putValue(env_AudioSD_MedBrFoLev_Ref_abs,getProfileInt("BAP AUDIO", "env_AudioSD_MedBrFoLev_Ref_abs", 1, profileFile));
    putValue(env_AudioSD_MedBrFoLev_update,getProfileInt("BAP AUDIO", "env_AudioSD_MedBrFoLev_update", 1, profileFile));
    putValue(env_AudioSD_MedPath_Type,getProfileInt("BAP AUDIO", "env_AudioSD_MedPath_Type", 1, profileFile));
    putValue(env_AudioSD_MedPath_update,getProfileInt("BAP AUDIO", "env_AudioSD_MedPath_update", 1, profileFile));
    putValue(env_AudioSD_MFI_Abort,getProfileInt("BAP AUDIO", "env_AudioSD_MFI_Abort", 1, profileFile));
    putValue(env_AudioSD_MFI_Error_on,getProfileInt("BAP AUDIO", "env_AudioSD_MFI_Error_on", 1, profileFile));
    putValue(env_AudioSD_MFI_ErrorCode,getProfileInt("BAP AUDIO", "env_AudioSD_MFI_ErrorCode", 1, profileFile));
    putValue(env_AudioSD_MFI_Ref,getProfileInt("BAP AUDIO", "env_AudioSD_MFI_Ref", 1, profileFile));
    putValue(env_AudioSD_MFI_Result,getProfileInt("BAP AUDIO", "env_AudioSD_MFI_Result", 1, profileFile));
    putValue(env_AudioSD_Mute_DAB,getProfileInt("BAP AUDIO", "env_AudioSD_Mute_DAB", 1, profileFile));
    putValue(env_AudioSD_Mute_DVB,getProfileInt("BAP AUDIO", "env_AudioSD_Mute_DVB", 1, profileFile));
    putValue(env_AudioSD_Mute_Error_on,getProfileInt("BAP AUDIO", "env_AudioSD_Mute_Error_on", 1, profileFile));
    putValue(env_AudioSD_Mute_ErrorCode,getProfileInt("BAP AUDIO", "env_AudioSD_Mute_ErrorCode", 1, profileFile));
    putValue(env_AudioSD_Mute_IBOC,getProfileInt("BAP AUDIO", "env_AudioSD_Mute_IBOC", 1, profileFile));
    putValue(env_AudioSD_Mute_Mute,getProfileInt("BAP AUDIO", "env_AudioSD_Mute_Mute", 1, profileFile));
    putValue(env_AudioSD_Mute_PhoneCall,getProfileInt("BAP AUDIO", "env_AudioSD_Mute_PhoneCall", 1, profileFile));
    putValue(env_AudioSD_Mute_Reserve1,getProfileInt("BAP AUDIO", "env_AudioSD_Mute_Reserve1", 1, profileFile));
    putValue(env_AudioSD_Mute_Reserve2,getProfileInt("BAP AUDIO", "env_AudioSD_Mute_Reserve2", 1, profileFile));
    putValue(env_AudioSD_Mute_SDARS,getProfileInt("BAP AUDIO", "env_AudioSD_Mute_SDARS", 1, profileFile));
    putValue(env_AudioSD_Mute_update,getProfileInt("BAP AUDIO", "env_AudioSD_Mute_update", 1, profileFile));
    putValue(env_AudioSD_PowerOnOff,getProfileInt("BAP AUDIO", "env_AudioSD_PowerOnOff", 1, profileFile));
    putValue(env_AudioSD_PreferredList_List,getProfileInt("BAP AUDIO", "env_AudioSD_PreferredList_List", 1, profileFile));
    putValue(env_AudioSD_PreferredList_update,getProfileInt("BAP AUDIO", "env_AudioSD_PreferredList_update", 1, profileFile));
    putValue(env_AudioSD_RadioTVPreList_Long,getProfileInt("BAP AUDIO", "env_AudioSD_RadioTVPreList_Long", 1, profileFile));
    putValue(env_AudioSD_RadioTVPreList_Short,getProfileInt("BAP AUDIO", "env_AudioSD_RadioTVPreList_Short", 1, profileFile));
    putValue(env_AudioSD_ReceptionList_Long,getProfileInt("BAP AUDIO", "env_AudioSD_ReceptionList_Long", 1, profileFile));
    putValue(env_AudioSD_ReceptionList_Short,getProfileInt("BAP AUDIO", "env_AudioSD_ReceptionList_Short", 1, profileFile));
    putValue(env_AudioSD_RecListType_Type,getProfileInt("BAP AUDIO", "env_AudioSD_RecListType_Type", 1, profileFile));
    putValue(env_AudioSD_RecListType_update,getProfileInt("BAP AUDIO", "env_AudioSD_RecListType_update", 1, profileFile));
    putValue(env_AudioSD_RL_AH_dir,getProfileInt("BAP AUDIO", "env_AudioSD_RL_AH_dir", 1, profileFile));
    putValue(env_AudioSD_RL_AH_elements,getProfileInt("BAP AUDIO", "env_AudioSD_RL_AH_elements", 1, profileFile));
    putValue(env_AudioSD_RL_AH_IS,getProfileInt("BAP AUDIO", "env_AudioSD_RL_AH_IS", 1, profileFile));
    putValue(env_AudioSD_RL_AH_POS,getProfileInt("BAP AUDIO", "env_AudioSD_RL_AH_POS", 1, profileFile));
    putValue(env_AudioSD_RL_AH_RA,getProfileInt("BAP AUDIO", "env_AudioSD_RL_AH_RA", 1, profileFile));
    putValue(env_AudioSD_RL_AH_shift,getProfileInt("BAP AUDIO", "env_AudioSD_RL_AH_shift", 1, profileFile));
    putValue(env_AudioSD_RL_AH_start,getProfileInt("BAP AUDIO", "env_AudioSD_RL_AH_start", 1, profileFile));
    putValue(env_AudioSD_RL_ASGID,getProfileInt("BAP AUDIO", "env_AudioSD_RL_ASGID", 1, profileFile));
    putValue(env_AudioSD_RL_ASGID_error,getProfileInt("BAP AUDIO", "env_AudioSD_RL_ASGID_error", 1, profileFile));
    putValue(env_AudioSD_RL_CA,getProfileInt("BAP AUDIO", "env_AudioSD_RL_CA", 1, profileFile));
    putValue(env_AudioSD_RL_CA_switch,getProfileInt("BAP AUDIO", "env_AudioSD_RL_CA_switch", 1, profileFile));
    putValue(env_AudioSD_RL_DataSource,getProfileInt("BAP AUDIO", "env_AudioSD_RL_DataSource", 1, profileFile));
    putValue(env_AudioSD_RL_ElementType,getProfileInt("BAP AUDIO", "env_AudioSD_RL_ElementType", 1, profileFile));
    putValue(env_AudioSD_RL_Error_on,getProfileInt("BAP AUDIO", "env_AudioSD_RL_Error_on", 1, profileFile));
    putValue(env_AudioSD_RL_ErrorCode,getProfileInt("BAP AUDIO", "env_AudioSD_RL_ErrorCode", 1, profileFile));
    putValue(env_AudioSD_RL_FRU,getProfileInt("BAP AUDIO", "env_AudioSD_RL_FRU", 1, profileFile));
    putValue(env_AudioSD_RL_ParentID,getProfileInt("BAP AUDIO", "env_AudioSD_RL_ParentID", 1, profileFile));
    putValue(env_AudioSD_RL_reload,getProfileInt("BAP AUDIO", "env_AudioSD_RL_reload", 1, profileFile));
    putValue(env_AudioSD_RL_StatusArray,getProfileInt("BAP AUDIO", "env_AudioSD_RL_StatusArray", 1, profileFile));
    putValue(env_AudioSD_RL_TAID,getProfileInt("BAP AUDIO", "env_AudioSD_RL_TAID", 1, profileFile));
    putValue(env_AudioSD_RL_TAID_error,getProfileInt("BAP AUDIO", "env_AudioSD_RL_TAID_error", 1, profileFile));
    putValue(env_AudioSD_RL_Timeout,getProfileInt("BAP AUDIO", "env_AudioSD_RL_Timeout", 1, profileFile));
    putValue(env_AudioSD_RL_TotalNumLE,getProfileInt("BAP AUDIO", "env_AudioSD_RL_TotalNumLE", 1, profileFile));
    putValue(env_AudioSD_RTPL__delete_size,getProfileInt("BAP AUDIO", "env_AudioSD_RTPL__delete_size", 1, profileFile));
    putValue(env_AudioSD_RTPL_AH_dir,getProfileInt("BAP AUDIO", "env_AudioSD_RTPL_AH_dir", 1, profileFile));
    putValue(env_AudioSD_RTPL_AH_elements,getProfileInt("BAP AUDIO", "env_AudioSD_RTPL_AH_elements", 1, profileFile));
    putValue(env_AudioSD_RTPL_AH_IS,getProfileInt("BAP AUDIO", "env_AudioSD_RTPL_AH_IS", 1, profileFile));
    putValue(env_AudioSD_RTPL_AH_POS,getProfileInt("BAP AUDIO", "env_AudioSD_RTPL_AH_POS", 1, profileFile));
    putValue(env_AudioSD_RTPL_AH_RA,getProfileInt("BAP AUDIO", "env_AudioSD_RTPL_AH_RA", 1, profileFile));
    putValue(env_AudioSD_RTPL_AH_shift,getProfileInt("BAP AUDIO", "env_AudioSD_RTPL_AH_shift", 1, profileFile));
    putValue(env_AudioSD_RTPL_AH_start,getProfileInt("BAP AUDIO", "env_AudioSD_RTPL_AH_start", 1, profileFile));
    putValue(env_AudioSD_RTPL_ASGID,getProfileInt("BAP AUDIO", "env_AudioSD_RTPL_ASGID", 1, profileFile));
    putValue(env_AudioSD_RTPL_ASGID_error,getProfileInt("BAP AUDIO", "env_AudioSD_RTPL_ASGID_error", 1, profileFile));
    putValue(env_AudioSD_RTPL_CA,getProfileInt("BAP AUDIO", "env_AudioSD_RTPL_CA", 1, profileFile));
    putValue(env_AudioSD_RTPL_CA_switch,getProfileInt("BAP AUDIO", "env_AudioSD_RTPL_CA_switch", 1, profileFile));
    putValue(env_AudioSD_RTPL_DataSource,getProfileInt("BAP AUDIO", "env_AudioSD_RTPL_DataSource", 1, profileFile));
    putValue(env_AudioSD_RTPL_del_ErrHandler,getProfileInt("BAP AUDIO", "env_AudioSD_RTPL_del_ErrHandler", 1, profileFile));
    putValue(env_AudioSD_RTPL_Error_on,getProfileInt("BAP AUDIO", "env_AudioSD_RTPL_Error_on", 1, profileFile));
    putValue(env_AudioSD_RTPL_ErrorCode,getProfileInt("BAP AUDIO", "env_AudioSD_RTPL_ErrorCode", 1, profileFile));
    putValue(env_AudioSD_RTPL_FRU,getProfileInt("BAP AUDIO", "env_AudioSD_RTPL_FRU", 1, profileFile));
    putValue(env_AudioSD_RTPL_reload,getProfileInt("BAP AUDIO", "env_AudioSD_RTPL_reload", 1, profileFile));
    putValue(env_AudioSD_RTPL_StatusArray,getProfileInt("BAP AUDIO", "env_AudioSD_RTPL_StatusArray", 1, profileFile));
    putValue(env_AudioSD_RTPL_TAID,getProfileInt("BAP AUDIO", "env_AudioSD_RTPL_TAID", 1, profileFile));
    putValue(env_AudioSD_RTPL_TAID_error,getProfileInt("BAP AUDIO", "env_AudioSD_RTPL_TAID_error", 1, profileFile));
    putValue(env_AudioSD_RTPL_Timeout,getProfileInt("BAP AUDIO", "env_AudioSD_RTPL_Timeout", 1, profileFile));
    putValue(env_AudioSD_RTPL_TotalNumLE,getProfileInt("BAP AUDIO", "env_AudioSD_RTPL_TotalNumLE", 1, profileFile));
    putValue(env_AudioSD_SDSState_State,getProfileInt("BAP AUDIO", "env_AudioSD_SDSState_State", 1, profileFile));
    putValue(env_AudioSD_SDSState_update,getProfileInt("BAP AUDIO", "env_AudioSD_SDSState_update", 1, profileFile));
    putValue(env_AudioSD_SL_AH_dir,getProfileInt("BAP AUDIO", "env_AudioSD_SL_AH_dir", 1, profileFile));
    putValue(env_AudioSD_SL_AH_elements,getProfileInt("BAP AUDIO", "env_AudioSD_SL_AH_elements", 1, profileFile));
    putValue(env_AudioSD_SL_AH_IS,getProfileInt("BAP AUDIO", "env_AudioSD_SL_AH_IS", 1, profileFile));
    putValue(env_AudioSD_SL_AH_POS,getProfileInt("BAP AUDIO", "env_AudioSD_SL_AH_POS", 1, profileFile));
    putValue(env_AudioSD_SL_AH_RA,getProfileInt("BAP AUDIO", "env_AudioSD_SL_AH_RA", 1, profileFile));
    putValue(env_AudioSD_SL_AH_shift,getProfileInt("BAP AUDIO", "env_AudioSD_SL_AH_shift", 1, profileFile));
    putValue(env_AudioSD_SL_AH_start,getProfileInt("BAP AUDIO", "env_AudioSD_SL_AH_start", 1, profileFile));
    putValue(env_AudioSD_SL_ASGID,getProfileInt("BAP AUDIO", "env_AudioSD_SL_ASGID", 1, profileFile));
    putValue(env_AudioSD_SL_ASGID_error,getProfileInt("BAP AUDIO", "env_AudioSD_SL_ASGID_error", 1, profileFile));
    putValue(env_AudioSD_SL_CA,getProfileInt("BAP AUDIO", "env_AudioSD_SL_CA", 1, profileFile));
    putValue(env_AudioSD_SL_CA_switch,getProfileInt("BAP AUDIO", "env_AudioSD_SL_CA_switch", 1, profileFile));
    putValue(env_AudioSD_SL_DataSource,getProfileInt("BAP AUDIO", "env_AudioSD_SL_DataSource", 1, profileFile));
    putValue(env_AudioSD_SL_Error_on,getProfileInt("BAP AUDIO", "env_AudioSD_SL_Error_on", 1, profileFile));
    putValue(env_AudioSD_SL_ErrorCode,getProfileInt("BAP AUDIO", "env_AudioSD_SL_ErrorCode", 1, profileFile));
    putValue(env_AudioSD_SL_FRU,getProfileInt("BAP AUDIO", "env_AudioSD_SL_FRU", 1, profileFile));
    putValue(env_AudioSD_SL_reload,getProfileInt("BAP AUDIO", "env_AudioSD_SL_reload", 1, profileFile));
    putValue(env_AudioSD_SL_StatusArray,getProfileInt("BAP AUDIO", "env_AudioSD_SL_StatusArray", 1, profileFile));
    putValue(env_AudioSD_SL_TAID,getProfileInt("BAP AUDIO", "env_AudioSD_SL_TAID", 1, profileFile));
    putValue(env_AudioSD_SL_TAID_error,getProfileInt("BAP AUDIO", "env_AudioSD_SL_TAID_error", 1, profileFile));
    putValue(env_AudioSD_SL_Timeout,getProfileInt("BAP AUDIO", "env_AudioSD_SL_Timeout", 1, profileFile));
    putValue(env_AudioSD_SL_TotalNumLE,getProfileInt("BAP AUDIO", "env_AudioSD_SL_TotalNumLE", 1, profileFile));
    putValue(env_AudioSD_SourceList_Long,getProfileInt("BAP AUDIO", "env_AudioSD_SourceList_Long", 1, profileFile));
    putValue(env_AudioSD_SourceList_Short,getProfileInt("BAP AUDIO", "env_AudioSD_SourceList_Short", 1, profileFile));
    putValue(env_AudioSD_SourceState_Error_on,getProfileInt("BAP AUDIO", "env_AudioSD_SourceState_Error_on", 1, profileFile));
    putValue(env_AudioSD_SourceState_ErrorC,getProfileInt("BAP AUDIO", "env_AudioSD_SourceState_ErrorC", 1, profileFile));
    putValue(env_AudioSD_SourceState_Scope,getProfileInt("BAP AUDIO", "env_AudioSD_SourceState_Scope", 1, profileFile));
    putValue(env_AudioSD_SourceState_StInfo,getProfileInt("BAP AUDIO", "env_AudioSD_SourceState_StInfo", 1, profileFile));
    putValue(env_AudioSD_SourceState_update,getProfileInt("BAP AUDIO", "env_AudioSD_SourceState_update", 1, profileFile));
    putValue(env_AudioSD_SwitchSource_Abort,getProfileInt("BAP AUDIO", "env_AudioSD_SwitchSource_Abort", 1, profileFile));
    putValue(env_AudioSD_SwitchSource_ErrorC,getProfileInt("BAP AUDIO", "env_AudioSD_SwitchSource_ErrorC", 1, profileFile));
    putValue(env_AudioSD_SwitchSource_ErrorON,getProfileInt("BAP AUDIO", "env_AudioSD_SwitchSource_ErrorON", 1, profileFile));
    putValue(env_AudioSD_SwitchSource_Ref,getProfileInt("BAP AUDIO", "env_AudioSD_SwitchSource_Ref", 1, profileFile));
    putValue(env_AudioSD_SwitchSource_Result,getProfileInt("BAP AUDIO", "env_AudioSD_SwitchSource_Result", 1, profileFile));
    putValue(env_AudioSD_TML_AH_dir,getProfileInt("BAP AUDIO", "env_AudioSD_TML_AH_dir", 1, profileFile));
    putValue(env_AudioSD_TML_AH_elements,getProfileInt("BAP AUDIO", "env_AudioSD_TML_AH_elements", 1, profileFile));
    putValue(env_AudioSD_TML_AH_IS,getProfileInt("BAP AUDIO", "env_AudioSD_TML_AH_IS", 1, profileFile));
    putValue(env_AudioSD_TML_AH_POS,getProfileInt("BAP AUDIO", "env_AudioSD_TML_AH_POS", 1, profileFile));
    putValue(env_AudioSD_TML_AH_RA,getProfileInt("BAP AUDIO", "env_AudioSD_TML_AH_RA", 1, profileFile));
    putValue(env_AudioSD_TML_AH_shift,getProfileInt("BAP AUDIO", "env_AudioSD_TML_AH_shift", 1, profileFile));
    putValue(env_AudioSD_TML_AH_start,getProfileInt("BAP AUDIO", "env_AudioSD_TML_AH_start", 1, profileFile));
    putValue(env_AudioSD_TML_ASGID,getProfileInt("BAP AUDIO", "env_AudioSD_TML_ASGID", 1, profileFile));
    putValue(env_AudioSD_TML_CA,getProfileInt("BAP AUDIO", "env_AudioSD_TML_CA", 1, profileFile));
    putValue(env_AudioSD_TML_CA_switch,getProfileInt("BAP AUDIO", "env_AudioSD_TML_CA_switch", 1, profileFile));
    putValue(env_AudioSD_TML_DataSource,getProfileInt("BAP AUDIO", "env_AudioSD_TML_DataSource", 1, profileFile));
    putValue(env_AudioSD_TML_Error_on,getProfileInt("BAP AUDIO", "env_AudioSD_TML_Error_on", 1, profileFile));
    putValue(env_AudioSD_TML_ErrorCode,getProfileInt("BAP AUDIO", "env_AudioSD_TML_ErrorCode", 1, profileFile));
    putValue(env_AudioSD_TML_FRU,getProfileInt("BAP AUDIO", "env_AudioSD_TML_FRU", 1, profileFile));
    putValue(env_AudioSD_TML_reload,getProfileInt("BAP AUDIO", "env_AudioSD_TML_reload", 1, profileFile));
    putValue(env_AudioSD_TML_StatusArray,getProfileInt("BAP AUDIO", "env_AudioSD_TML_StatusArray", 1, profileFile));
    putValue(env_AudioSD_TML_TAID,getProfileInt("BAP AUDIO", "env_AudioSD_TML_TAID", 1, profileFile));
    putValue(env_AudioSD_TML_TotalNumLE,getProfileInt("BAP AUDIO", "env_AudioSD_TML_TotalNumLE", 1, profileFile));
    putValue(env_AudioSD_TPMemInfo_CMN,getProfileInt("BAP AUDIO", "env_AudioSD_TPMemInfo_CMN", 1, profileFile));
    putValue(env_AudioSD_TPMemInfo_hour,getProfileInt("BAP AUDIO", "env_AudioSD_TPMemInfo_hour", 1, profileFile));
    putValue(env_AudioSD_TPMemInfo_min,getProfileInt("BAP AUDIO", "env_AudioSD_TPMemInfo_min", 1, profileFile));
    putValue(env_AudioSD_TPMemInfo_TMN,getProfileInt("BAP AUDIO", "env_AudioSD_TPMemInfo_TMN", 1, profileFile));
    putValue(env_AudioSD_TPMemInfo_update,getProfileInt("BAP AUDIO", "env_AudioSD_TPMemInfo_update", 1, profileFile));
    putValue(env_BAPCFG_FSG_AudioSD_ErrCode,getProfileInt("BAP AUDIO", "env_BAPCFG_FSG_AudioSD_ErrCode", 1, profileFile));
    putValue(env_BAPCFG_FSG_AudioSD_ErrEn,getProfileInt("BAP AUDIO", "env_BAPCFG_FSG_AudioSD_ErrEn", 1, profileFile));
    putValue(env_BAPCFG_FSG_AudioSD_FctEn,getProfileInt("BAP AUDIO", "env_BAPCFG_FSG_AudioSD_FctEn", 1, profileFile));
    putValue(env_FSG_Audio_HB_button,getProfileInt("BAP AUDIO", "env_FSG_Audio_HB_button", 1, profileFile));
    putValue(env_FSG_Audio_HB_input,getProfileInt("BAP AUDIO", "env_FSG_Audio_HB_input", 1, profileFile));
    putValue(env_FSG_AudioSD_BAPCFG_ResetSet,getProfileInt("BAP AUDIO", "env_FSG_AudioSD_BAPCFG_ResetSet", 1, profileFile));
    putValue(env_FSG_AudioSD_FctList_ErrCode,getProfileInt("BAP AUDIO", "env_FSG_AudioSD_FctList_ErrCode", 1, profileFile));
    putValue(env_FSG_AudioSD_FctList_ErrEn,getProfileInt("BAP AUDIO", "env_FSG_AudioSD_FctList_ErrEn", 1, profileFile));
    putValue(env_FSG_AudioSD_FctList_FctEn,getProfileInt("BAP AUDIO", "env_FSG_AudioSD_FctList_FctEn", 1, profileFile));
    putValue(env_FSG_AudioSD_FctList_IntTlgEn,getProfileInt("BAP AUDIO", "env_FSG_AudioSD_FctList_IntTlgEn", 1, profileFile));
    putValue(env_FSG_AudioSD_FctList_SegmEn,getProfileInt("BAP AUDIO", "env_FSG_AudioSD_FctList_SegmEn", 1, profileFile));
    putValue(env_FSG_AudioSD_GetAll_ErrCode,getProfileInt("BAP AUDIO", "env_FSG_AudioSD_GetAll_ErrCode", 1, profileFile));
    putValue(env_FSG_AudioSD_GetAll_ErrEn,getProfileInt("BAP AUDIO", "env_FSG_AudioSD_GetAll_ErrEn", 1, profileFile));
    putValue(env_FSG_AudioSD_GetAll_FctEn,getProfileInt("BAP AUDIO", "env_FSG_AudioSD_GetAll_FctEn", 1, profileFile));
    putValue(env_FSG_AudioSD_GetAll_IntTlgEn,getProfileInt("BAP AUDIO", "env_FSG_AudioSD_GetAll_IntTlgEn", 1, profileFile));
    putValue(env_FSG_AudioSD_GetAll_SegmEn,getProfileInt("BAP AUDIO", "env_FSG_AudioSD_GetAll_SegmEn", 1, profileFile));
}

//IssueList #200 - Addition of LoadAll button
/* 26.08.2014 Update on FPK_15S1 Navi
void loadBAP_naviSettings( char profileFile[] )
{
    putValue(env_NaviLG_reload,getProfileInt("BAP NAVI", "env_NaviLG_reload", 1, profileFile));
    putValue(env_NaviLG_Switch,getProfileInt("BAP NAVI", "env_NaviLG_Switch", 1, profileFile));
    putValue(env_NaviLG_Enable_7,getProfileInt("BAP NAVI", "env_NaviLG_Enable_7", 1, profileFile));
    putValue(env_NaviLG_Enable_6,getProfileInt("BAP NAVI", "env_NaviLG_Enable_6", 1, profileFile));
    putValue(env_NaviLG_Enable_5,getProfileInt("BAP NAVI", "env_NaviLG_Enable_5", 1, profileFile));
    putValue(env_NaviLG_Enable_4,getProfileInt("BAP NAVI", "env_NaviLG_Enable_4", 1, profileFile));
    putValue(env_NaviLG_Enable_3,getProfileInt("BAP NAVI", "env_NaviLG_Enable_3", 1, profileFile));
    putValue(env_NaviLG_Enable_2,getProfileInt("BAP NAVI", "env_NaviLG_Enable_2", 1, profileFile));
    putValue(env_NaviLG_Enable_1,getProfileInt("BAP NAVI", "env_NaviLG_Enable_1", 1, profileFile));
    putValue(env_NaviLG_Enable_0,getProfileInt("BAP NAVI", "env_NaviLG_Enable_0", 1, profileFile));
    putValue(env_NaviLG_GuidInfo_7,getProfileInt("BAP NAVI", "env_NaviLG_GuidInfo_7", 1, profileFile));
    putValue(env_NaviLG_GuidInfo_6,getProfileInt("BAP NAVI", "env_NaviLG_GuidInfo_6", 1, profileFile));
    putValue(env_NaviLG_GuidInfo_5,getProfileInt("BAP NAVI", "env_NaviLG_GuidInfo_5", 1, profileFile));
    putValue(env_NaviLG_GuidInfo_4,getProfileInt("BAP NAVI", "env_NaviLG_GuidInfo_4", 1, profileFile));
    putValue(env_NaviLG_GuidInfo_3,getProfileInt("BAP NAVI", "env_NaviLG_GuidInfo_3", 1, profileFile));
    putValue(env_NaviLG_GuidInfo_2,getProfileInt("BAP NAVI", "env_NaviLG_GuidInfo_2", 1, profileFile));
    putValue(env_NaviLG_GuidInfo_1,getProfileInt("BAP NAVI", "env_NaviLG_GuidInfo_1", 1, profileFile));
    putValue(env_NaviLG_GuidInfo_0,getProfileInt("BAP NAVI", "env_NaviLG_GuidInfo_0", 1, profileFile));
    putValue(env_NaviLG_LaneDesc_7,getProfileInt("BAP NAVI", "env_NaviLG_LaneDesc_7", 1, profileFile));
    putValue(env_NaviLG_LaneDesc_6,getProfileInt("BAP NAVI", "env_NaviLG_LaneDesc_6", 1, profileFile));
    putValue(env_NaviLG_LaneDesc_5,getProfileInt("BAP NAVI", "env_NaviLG_LaneDesc_5", 1, profileFile));
    putValue(env_NaviLG_LaneDesc_4,getProfileInt("BAP NAVI", "env_NaviLG_LaneDesc_4", 1, profileFile));
    putValue(env_NaviLG_LaneDesc_3,getProfileInt("BAP NAVI", "env_NaviLG_LaneDesc_3", 1, profileFile));
    putValue(env_NaviLG_LaneDesc_2,getProfileInt("BAP NAVI", "env_NaviLG_LaneDesc_2", 1, profileFile));
    putValue(env_NaviLG_LaneDesc_1,getProfileInt("BAP NAVI", "env_NaviLG_LaneDesc_1", 1, profileFile));
    putValue(env_NaviLG_LaneDesc_0,getProfileInt("BAP NAVI", "env_NaviLG_LaneDesc_0", 1, profileFile));
    putValue(env_NaviLG_LaneMark_R_7,getProfileInt("BAP NAVI", "env_NaviLG_LaneMark_R_7", 1, profileFile));
    putValue(env_NaviLG_LaneMark_R_6,getProfileInt("BAP NAVI", "env_NaviLG_LaneMark_R_6", 1, profileFile));
    putValue(env_NaviLG_LaneMark_R_5,getProfileInt("BAP NAVI", "env_NaviLG_LaneMark_R_5", 1, profileFile));
    putValue(env_NaviLG_LaneMark_R_4,getProfileInt("BAP NAVI", "env_NaviLG_LaneMark_R_4", 1, profileFile));
    putValue(env_NaviLG_LaneMark_R_3,getProfileInt("BAP NAVI", "env_NaviLG_LaneMark_R_3", 1, profileFile));
    putValue(env_NaviLG_LaneMark_R_2,getProfileInt("BAP NAVI", "env_NaviLG_LaneMark_R_2", 1, profileFile));
    putValue(env_NaviLG_LaneMark_R_1,getProfileInt("BAP NAVI", "env_NaviLG_LaneMark_R_1", 1, profileFile));
    putValue(env_NaviLG_LaneMark_R_0,getProfileInt("BAP NAVI", "env_NaviLG_LaneMark_R_0", 1, profileFile));
    putValue(env_NaviLG_LaneMark_L_7,getProfileInt("BAP NAVI", "env_NaviLG_LaneMark_L_7", 1, profileFile));
    putValue(env_NaviLG_LaneMark_L_6,getProfileInt("BAP NAVI", "env_NaviLG_LaneMark_L_6", 1, profileFile));
    putValue(env_NaviLG_LaneMark_L_5,getProfileInt("BAP NAVI", "env_NaviLG_LaneMark_L_5", 1, profileFile));
    putValue(env_NaviLG_LaneMark_L_4,getProfileInt("BAP NAVI", "env_NaviLG_LaneMark_L_4", 1, profileFile));
    putValue(env_NaviLG_LaneMark_L_3,getProfileInt("BAP NAVI", "env_NaviLG_LaneMark_L_3", 1, profileFile));
    putValue(env_NaviLG_LaneMark_L_2,getProfileInt("BAP NAVI", "env_NaviLG_LaneMark_L_2", 1, profileFile));
    putValue(env_NaviLG_LaneMark_L_1,getProfileInt("BAP NAVI", "env_NaviLG_LaneMark_L_1", 1, profileFile));
    putValue(env_NaviLG_LaneMark_L_0,getProfileInt("BAP NAVI", "env_NaviLG_LaneMark_L_0", 1, profileFile));
    putValue(env_NaviLG_LaneType_7,getProfileInt("BAP NAVI", "env_NaviLG_LaneType_7", 1, profileFile));
    putValue(env_NaviLG_LaneType_6,getProfileInt("BAP NAVI", "env_NaviLG_LaneType_6", 1, profileFile));
    putValue(env_NaviLG_LaneType_5,getProfileInt("BAP NAVI", "env_NaviLG_LaneType_5", 1, profileFile));
    putValue(env_NaviLG_LaneType_4,getProfileInt("BAP NAVI", "env_NaviLG_LaneType_4", 1, profileFile));
    putValue(env_NaviLG_LaneType_3,getProfileInt("BAP NAVI", "env_NaviLG_LaneType_3", 1, profileFile));
    putValue(env_NaviLG_LaneType_2,getProfileInt("BAP NAVI", "env_NaviLG_LaneType_2", 1, profileFile));
    putValue(env_NaviLG_LaneType_1,getProfileInt("BAP NAVI", "env_NaviLG_LaneType_1", 1, profileFile));
    putValue(env_NaviLG_LaneType_0,getProfileInt("BAP NAVI", "env_NaviLG_LaneType_0", 1, profileFile));
    putValue(env_NaviLG_LaneDir_7,getProfileInt("BAP NAVI", "env_NaviLG_LaneDir_7", 1, profileFile));
    putValue(env_NaviLG_LaneDir_6,getProfileInt("BAP NAVI", "env_NaviLG_LaneDir_6", 1, profileFile));
    putValue(env_NaviLG_LaneDir_5,getProfileInt("BAP NAVI", "env_NaviLG_LaneDir_5", 1, profileFile));
    putValue(env_NaviLG_LaneDir_4,getProfileInt("BAP NAVI", "env_NaviLG_LaneDir_4", 1, profileFile));
    putValue(env_NaviLG_LaneDir_3,getProfileInt("BAP NAVI", "env_NaviLG_LaneDir_3", 1, profileFile));
    putValue(env_NaviLG_LaneDir_2,getProfileInt("BAP NAVI", "env_NaviLG_LaneDir_2", 1, profileFile));
    putValue(env_NaviLG_LaneDir_1,getProfileInt("BAP NAVI", "env_NaviLG_LaneDir_1", 1, profileFile));
    putValue(env_NaviLG_LaneDir_0,getProfileInt("BAP NAVI", "env_NaviLG_LaneDir_0", 1, profileFile));
    putValue(env_NaviLG_Pos_7,getProfileInt("BAP NAVI", "env_NaviLG_Pos_7", 1, profileFile));
    putValue(env_NaviLG_Pos_6,getProfileInt("BAP NAVI", "env_NaviLG_Pos_6", 1, profileFile));
    putValue(env_NaviLG_Pos_5,getProfileInt("BAP NAVI", "env_NaviLG_Pos_5", 1, profileFile));
    putValue(env_NaviLG_Pos_4,getProfileInt("BAP NAVI", "env_NaviLG_Pos_4", 1, profileFile));
    putValue(env_NaviLG_Pos_3,getProfileInt("BAP NAVI", "env_NaviLG_Pos_3", 1, profileFile));
    putValue(env_NaviLG_Pos_2,getProfileInt("BAP NAVI", "env_NaviLG_Pos_2", 1, profileFile));
    putValue(env_NaviLG_Pos_1,getProfileInt("BAP NAVI", "env_NaviLG_Pos_1", 1, profileFile));
    putValue(env_NaviLG_Pos_0,getProfileInt("BAP NAVI", "env_NaviLG_Pos_0", 1, profileFile));
    putValue(env_NaviSD_TTD_VI_Disp,getProfileInt("BAP NAVI", "env_NaviSD_TTD_VI_Disp", 1, profileFile));
    putValue(env_NaviSD_TTD_VI,getProfileInt("BAP NAVI", "env_NaviSD_TTD_VI", 1, profileFile));
    putValue(env_NaviSD_TTD_Reserved7_VI,getProfileInt("BAP NAVI", "env_NaviSD_TTD_Reserved7_VI", 1, profileFile));
    putValue(env_NaviSD_TTD_Reserved6_VI,getProfileInt("BAP NAVI", "env_NaviSD_TTD_Reserved6_VI", 1, profileFile));
    putValue(env_NaviSD_TTD_Reserved0_VI,getProfileInt("BAP NAVI", "env_NaviSD_TTD_Reserved0_VI", 1, profileFile));
    putValue(env_NaviSD_FctList_0x01_TimeOut,getProfileInt("BAP NAVI", "env_NaviSD_FctList_0x01_TimeOut", 1, profileFile));
    putValue(env_FSG_Navi_HB_button,getProfileInt("BAP NAVI", "env_FSG_Navi_HB_button", 1, profileFile));
    putValue(env_FSG_Navi_HB_input,getProfileInt("BAP NAVI", "env_FSG_Navi_HB_input", 1, profileFile));
    putValue(env_Navi_LaneGuidanceList_Short,getProfileInt("BAP NAVI", "env_Navi_LaneGuidanceList_Short", 1, profileFile));
    putValue(env_Navi_LaneGuidanceList_Long,getProfileInt("BAP NAVI", "env_Navi_LaneGuidanceList_Long", 1, profileFile));
    putValue(env_NaviSD_BAP_Longlist,getProfileInt("BAP NAVI", "env_NaviSD_BAP_Longlist", 1, profileFile));
    putValue(env_NaviSD_BAP_Shortlist,getProfileInt("BAP NAVI", "env_NaviSD_BAP_Shortlist", 1, profileFile));
    putValue(env_NaviSD_RepeatLastNavAnn_ErrC,getProfileInt("BAP NAVI", "env_NaviSD_RepeatLastNavAnn_ErrC", 1, profileFile));
    putValue(env_NaviSD_RepeatLastNavAnn_Err,getProfileInt("BAP NAVI", "env_NaviSD_RepeatLastNavAnn_Err", 1, profileFile));
    putValue(env_NaviSD_NbSpeller_Error_on,getProfileInt("BAP NAVI", "env_NaviSD_NbSpeller_Error_on", 1, profileFile));
    putValue(env_NaviSD_NbSpeller_ErrorCode,getProfileInt("BAP NAVI", "env_NaviSD_NbSpeller_ErrorCode", 1, profileFile));
    putValue(env_NaviSD_GetNextLiPos_Error_on,getProfileInt("BAP NAVI", "env_NaviSD_GetNextLiPos_Error_on", 1, profileFile));
    putValue(env_NaviSD_GetNextLiPos_ErrorCo,getProfileInt("BAP NAVI", "env_NaviSD_GetNextLiPos_ErrorCo", 1, profileFile));
    putValue(env_NaviSD_RGActDeact_ErrorCode,getProfileInt("BAP NAVI", "env_NaviSD_RGActDeact_ErrorCode", 1, profileFile));
    putValue(env_NaviSD_RGActDeact_Error_on,getProfileInt("BAP NAVI", "env_NaviSD_RGActDeact_Error_on", 1, profileFile));
    putValue(env_NaviSD_AL_CA,getProfileInt("BAP NAVI", "env_NaviSD_AL_CA", 1, profileFile));
    putValue(env_NaviSD_NB_AL_switch,getProfileInt("BAP NAVI", "env_NaviSD_NB_AL_switch", 1, profileFile));
    putValue(env_NaviSD_NB_CA_switch,getProfileInt("BAP NAVI", "env_NaviSD_NB_CA_switch", 1, profileFile));
    putValue(env_NaviSD_FDL_CA_switch,getProfileInt("BAP NAVI", "env_NaviSD_FDL_CA_switch", 1, profileFile));
    putValue(env_NaviSD_LDL_CA_switch,getProfileInt("BAP NAVI", "env_NaviSD_LDL_CA_switch", 1, profileFile));
    putValue(env_ASG_NaviSD_LG_AH_IS,getProfileInt("BAP NAVI", "env_ASG_NaviSD_LG_AH_IS", 1, profileFile));
    putValue(env_NaviSD_LG_CA_switch,getProfileInt("BAP NAVI", "env_NaviSD_LG_CA_switch", 1, profileFile));
    putValue(env_NaviSD_AL_ErrorCode,getProfileInt("BAP NAVI", "env_NaviSD_AL_ErrorCode", 1, profileFile));
    putValue(env_NaviSD_AL_Error_on,getProfileInt("BAP NAVI", "env_NaviSD_AL_Error_on", 1, profileFile));
    putValue(env_NaviSD_NB_ErrorCode,getProfileInt("BAP NAVI", "env_NaviSD_NB_ErrorCode", 1, profileFile));
    putValue(env_NaviSD_NB_Error_on,getProfileInt("BAP NAVI", "env_NaviSD_NB_Error_on", 1, profileFile));
    putValue(env_NaviSD_FDL_ErrorCode,getProfileInt("BAP NAVI", "env_NaviSD_FDL_ErrorCode", 1, profileFile));
    putValue(env_NaviSD_FDL_Error_on,getProfileInt("BAP NAVI", "env_NaviSD_FDL_Error_on", 1, profileFile));
    putValue(env_NaviSD_LDL_ErrorCode,getProfileInt("BAP NAVI", "env_NaviSD_LDL_ErrorCode", 1, profileFile));
    putValue(env_NaviSD_LDL_Error_on,getProfileInt("BAP NAVI", "env_NaviSD_LDL_Error_on", 1, profileFile));
    putValue(env_NaviSD_LG_Error_on,getProfileInt("BAP NAVI", "env_NaviSD_LG_Error_on", 1, profileFile));
    putValue(env_NaviSD_LG_ErrorCode,getProfileInt("BAP NAVI", "env_NaviSD_LG_ErrorCode", 1, profileFile));
    putValue(env_NaviSD_MFZone_ErrorCode,getProfileInt("BAP NAVI", "env_NaviSD_MFZone_ErrorCode", 1, profileFile));
    putValue(env_NaviSD_MFZone_Error_on,getProfileInt("BAP NAVI", "env_NaviSD_MFZone_Error_on", 1, profileFile));
    putValue(env_NaviSD_ActRGTy_Error_on,getProfileInt("BAP NAVI", "env_NaviSD_ActRGTy_Error_on", 1, profileFile));
    putValue(env_NaviSD_ActRGTy_ErrorCode,getProfileInt("BAP NAVI", "env_NaviSD_ActRGTy_ErrorCode", 1, profileFile));
    putValue(env_NaviSD_VG_Error_on,getProfileInt("BAP NAVI", "env_NaviSD_VG_Error_on", 1, profileFile));
    putValue(env_NaviSD_VG_ErrorCode,getProfileInt("BAP NAVI", "env_NaviSD_VG_ErrorCode", 1, profileFile));
    putValue(env_NaviSD_TMCI_Error_on,getProfileInt("BAP NAVI", "env_NaviSD_TMCI_Error_on", 1, profileFile));
    putValue(env_NaviSD_TMCI_ErrorCode,getProfileInt("BAP NAVI", "env_NaviSD_TMCI_ErrorCode", 1, profileFile));
    putValue(env_NaviSD_CaliState_Error_on,getProfileInt("BAP NAVI", "env_NaviSD_CaliState_Error_on", 1, profileFile));
    putValue(env_NaviSD_CaliState_ErrorCode,getProfileInt("BAP NAVI", "env_NaviSD_CaliState_ErrorCode", 1, profileFile));
    putValue(env_NaviSD_ASGcap_ErrorCode,getProfileInt("BAP NAVI", "env_NaviSD_ASGcap_ErrorCode", 1, profileFile));
    putValue(env_NaviSD_ASGcap_Error_on,getProfileInt("BAP NAVI", "env_NaviSD_ASGcap_Error_on", 1, profileFile));
    putValue(env_NaviSD_FctList_0x2A,getProfileInt("BAP NAVI", "env_NaviSD_FctList_0x2A", 1, profileFile));
    putValue(env_NaviSD_FctList_0x29,getProfileInt("BAP NAVI", "env_NaviSD_FctList_0x29", 1, profileFile));
    putValue(env_NaviSD_FctList_0x28,getProfileInt("BAP NAVI", "env_NaviSD_FctList_0x28", 1, profileFile));
    putValue(env_NaviSD_FctList_0x27,getProfileInt("BAP NAVI", "env_NaviSD_FctList_0x27", 1, profileFile));
    putValue(env_NaviSD_FctList_0x26,getProfileInt("BAP NAVI", "env_NaviSD_FctList_0x26", 1, profileFile));
    putValue(env_NaviSD_FctList_0x25,getProfileInt("BAP NAVI", "env_NaviSD_FctList_0x25", 1, profileFile));
    putValue(env_NaviSD_FctList_0x24,getProfileInt("BAP NAVI", "env_NaviSD_FctList_0x24", 1, profileFile));
    putValue(env_NaviSD_FctList_0x23,getProfileInt("BAP NAVI", "env_NaviSD_FctList_0x23", 1, profileFile));
    putValue(env_NaviSD_FctList_0x22,getProfileInt("BAP NAVI", "env_NaviSD_FctList_0x22", 1, profileFile));
    putValue(env_NaviSD_FctList_0x21,getProfileInt("BAP NAVI", "env_NaviSD_FctList_0x21", 1, profileFile));
    putValue(env_NaviSD_FctList_0x20,getProfileInt("BAP NAVI", "env_NaviSD_FctList_0x20", 1, profileFile));
    putValue(env_NaviSD_FctList_0x1F,getProfileInt("BAP NAVI", "env_NaviSD_FctList_0x1F", 1, profileFile));
    putValue(env_NaviSD_FctList_0x1E,getProfileInt("BAP NAVI", "env_NaviSD_FctList_0x1E", 1, profileFile));
    putValue(env_NaviSD_FctList_0x1D,getProfileInt("BAP NAVI", "env_NaviSD_FctList_0x1D", 1, profileFile));
    putValue(env_NaviSD_FctList_0x1C,getProfileInt("BAP NAVI", "env_NaviSD_FctList_0x1C", 1, profileFile));
    putValue(env_NaviSD_FctList_0x1B,getProfileInt("BAP NAVI", "env_NaviSD_FctList_0x1B", 1, profileFile));
    putValue(env_NaviSD_FctList_0x1A,getProfileInt("BAP NAVI", "env_NaviSD_FctList_0x1A", 1, profileFile));
    putValue(env_NaviSD_FctList_0x19,getProfileInt("BAP NAVI", "env_NaviSD_FctList_0x19", 1, profileFile));
    putValue(env_NaviSD_FctList_0x18,getProfileInt("BAP NAVI", "env_NaviSD_FctList_0x18", 1, profileFile));
    putValue(env_NaviSD_FctList_0x17,getProfileInt("BAP NAVI", "env_NaviSD_FctList_0x17", 1, profileFile));
    putValue(env_NaviSD_FctList_0x16,getProfileInt("BAP NAVI", "env_NaviSD_FctList_0x16", 1, profileFile));
    putValue(env_NaviSD_FctList_0x15,getProfileInt("BAP NAVI", "env_NaviSD_FctList_0x15", 1, profileFile));
    putValue(env_NaviSD_FctList_0x14,getProfileInt("BAP NAVI", "env_NaviSD_FctList_0x14", 1, profileFile));
    putValue(env_NaviSD_FctList_0x13,getProfileInt("BAP NAVI", "env_NaviSD_FctList_0x13", 1, profileFile));
    putValue(env_NaviSD_FctList_0x12,getProfileInt("BAP NAVI", "env_NaviSD_FctList_0x12", 1, profileFile));
    putValue(env_NaviSD_FctList_0x11,getProfileInt("BAP NAVI", "env_NaviSD_FctList_0x11", 1, profileFile));
    putValue(env_NaviSD_FctList_0x10,getProfileInt("BAP NAVI", "env_NaviSD_FctList_0x10", 1, profileFile));
    putValue(env_NaviSD_FctList_0x0F,getProfileInt("BAP NAVI", "env_NaviSD_FctList_0x0F", 1, profileFile));
    putValue(env_NaviSD_FctList_0x04,getProfileInt("BAP NAVI", "env_NaviSD_FctList_0x04", 1, profileFile));
    putValue(env_NaviSD_FctList_0x03,getProfileInt("BAP NAVI", "env_NaviSD_FctList_0x03", 1, profileFile));
    putValue(env_NaviSD_FctList_0x02,getProfileInt("BAP NAVI", "env_NaviSD_FctList_0x02", 1, profileFile));
    putValue(env_NaviSD_FctList_0x01,getProfileInt("BAP NAVI", "env_NaviSD_FctList_0x01", 1, profileFile));
    putValue(env_NaviSD_FDL_FRU,getProfileInt("BAP NAVI", "env_NaviSD_FDL_FRU", 1, profileFile));
    putValue(env_NaviSD_LDL_FRU,getProfileInt("BAP NAVI", "env_NaviSD_LDL_FRU", 1, profileFile));
    putValue(env_NaviSD_NB_FRU,getProfileInt("BAP NAVI", "env_NaviSD_NB_FRU", 1, profileFile));
    putValue(env_NaviSD_AL_FRU,getProfileInt("BAP NAVI", "env_NaviSD_AL_FRU", 1, profileFile));
    putValue(env_NaviSD_LG_FRU,getProfileInt("BAP NAVI", "env_NaviSD_LG_FRU", 1, profileFile));
    putValue(env_NaviSD_RG_Status_update,getProfileInt("BAP NAVI", "env_NaviSD_RG_Status_update", 1, profileFile));
    putValue(env_NaviSD_FSG_OP_State_update,getProfileInt("BAP NAVI", "env_NaviSD_FSG_OP_State_update", 1, profileFile));
    putValue(env_NaviSD_AL_TotalNumLE,getProfileInt("BAP NAVI", "env_NaviSD_AL_TotalNumLE", 1, profileFile));
    putValue(env_NaviSD_AL_TAID,getProfileInt("BAP NAVI", "env_NaviSD_AL_TAID", 1, profileFile));
    putValue(env_NaviSD_AL_StatusArray,getProfileInt("BAP NAVI", "env_NaviSD_AL_StatusArray", 1, profileFile));
    putValue(env_NaviSD_AL_reload,getProfileInt("BAP NAVI", "env_NaviSD_AL_reload", 1, profileFile));
    putValue(env_NaviSD_AL_DataSource,getProfileInt("BAP NAVI", "env_NaviSD_AL_DataSource", 1, profileFile));
    putValue(env_NaviSD_AL_CA_switch,getProfileInt("BAP NAVI", "env_NaviSD_AL_CA_switch", 1, profileFile));
    putValue(env_NaviSD_AL_ASGID,getProfileInt("BAP NAVI", "env_NaviSD_AL_ASGID", 1, profileFile));
    putValue(env_NaviSD_AL_AH_start,getProfileInt("BAP NAVI", "env_NaviSD_AL_AH_start", 1, profileFile));
    putValue(env_NaviSD_AL_AH_shift,getProfileInt("BAP NAVI", "env_NaviSD_AL_AH_shift", 1, profileFile));
    putValue(env_NaviSD_AL_AH_RA,getProfileInt("BAP NAVI", "env_NaviSD_AL_AH_RA", 1, profileFile));
    putValue(env_NaviSD_AL_AH_POS,getProfileInt("BAP NAVI", "env_NaviSD_AL_AH_POS", 1, profileFile));
    putValue(env_NaviSD_AL_AH_IS,getProfileInt("BAP NAVI", "env_NaviSD_AL_AH_IS", 1, profileFile));
    putValue(env_NaviSD_AL_AH_elements,getProfileInt("BAP NAVI", "env_NaviSD_AL_AH_elements", 1, profileFile));
    putValue(env_NaviSD_AL_AH_dir,getProfileInt("BAP NAVI", "env_NaviSD_AL_AH_dir", 1, profileFile));
    putValue(env_NaviSD_AL_OtherList_Ref,getProfileInt("BAP NAVI", "env_NaviSD_AL_OtherList_Ref", 1, profileFile));
    putValue(env_NaviSD_AL_OtherListType,getProfileInt("BAP NAVI", "env_NaviSD_AL_OtherListType", 1, profileFile));
    putValue(env_NaviSD_NB_TotalNumLE,getProfileInt("BAP NAVI", "env_NaviSD_NB_TotalNumLE", 1, profileFile));
    putValue(env_NaviSD_NB_TAID,getProfileInt("BAP NAVI", "env_NaviSD_NB_TAID", 1, profileFile));
    putValue(env_NaviSD_NB_StatusArray,getProfileInt("BAP NAVI", "env_NaviSD_NB_StatusArray", 1, profileFile));
    putValue(env_NaviSD_NB_reload,getProfileInt("BAP NAVI", "env_NaviSD_NB_reload", 1, profileFile));
    putValue(env_NaviSD_NB_DataSource,getProfileInt("BAP NAVI", "env_NaviSD_NB_DataSource", 1, profileFile));
    putValue(env_NaviSD_NB_CA,getProfileInt("BAP NAVI", "env_NaviSD_NB_CA", 1, profileFile));
    putValue(env_NaviSD_NB_ASGID,getProfileInt("BAP NAVI", "env_NaviSD_NB_ASGID", 1, profileFile));
    putValue(env_NaviSD_NB_AH_start,getProfileInt("BAP NAVI", "env_NaviSD_NB_AH_start", 1, profileFile));
    putValue(env_NaviSD_NB_AH_shift,getProfileInt("BAP NAVI", "env_NaviSD_NB_AH_shift", 1, profileFile));
    putValue(env_NaviSD_NB_AH_RA,getProfileInt("BAP NAVI", "env_NaviSD_NB_AH_RA", 1, profileFile));
    putValue(env_NaviSD_NB_AH_POS,getProfileInt("BAP NAVI", "env_NaviSD_NB_AH_POS", 1, profileFile));
    putValue(env_NaviSD_NB_AH_IS,getProfileInt("BAP NAVI", "env_NaviSD_NB_AH_IS", 1, profileFile));
    putValue(env_NaviSD_NB_AH_elements,getProfileInt("BAP NAVI", "env_NaviSD_NB_AH_elements", 1, profileFile));
    putValue(env_NaviSD_NB_AH_dir,getProfileInt("BAP NAVI", "env_NaviSD_NB_AH_dir", 1, profileFile));
    putValue(env_NaviSD_LG_LGOnOff,getProfileInt("BAP NAVI", "env_NaviSD_LG_LGOnOff", 1, profileFile));
    putValue(env_NaviSD_LG_TAID,getProfileInt("BAP NAVI", "env_NaviSD_LG_TAID", 1, profileFile));
    putValue(env_NaviSD_LG_StatusArray,getProfileInt("BAP NAVI", "env_NaviSD_LG_StatusArray", 1, profileFile));
    putValue(env_NaviSD_LG_reload,getProfileInt("BAP NAVI", "env_NaviSD_LG_reload", 1, profileFile));
    putValue(env_NaviSD_LG_DataSource,getProfileInt("BAP NAVI", "env_NaviSD_LG_DataSource", 1, profileFile));
    putValue(env_NaviSD_LG_CA,getProfileInt("BAP NAVI", "env_NaviSD_LG_CA", 1, profileFile));
    putValue(env_NaviSD_LG_ASGID,getProfileInt("BAP NAVI", "env_NaviSD_LG_ASGID", 1, profileFile));
    putValue(env_NaviSD_LG_AH_start,getProfileInt("BAP NAVI", "env_NaviSD_LG_AH_start", 1, profileFile));
    putValue(env_NaviSD_LG_AH_shift,getProfileInt("BAP NAVI", "env_NaviSD_LG_AH_shift", 1, profileFile));
    putValue(env_NaviSD_LG_AH_RA,getProfileInt("BAP NAVI", "env_NaviSD_LG_AH_RA", 1, profileFile));
    putValue(env_NaviSD_LG_AH_POS,getProfileInt("BAP NAVI", "env_NaviSD_LG_AH_POS", 1, profileFile));
    putValue(env_NaviSD_LG_AH_IS,getProfileInt("BAP NAVI", "env_NaviSD_LG_AH_IS", 1, profileFile));
    putValue(env_NaviSD_LG_AH_elements,getProfileInt("BAP NAVI", "env_NaviSD_LG_AH_elements", 1, profileFile));
    putValue(env_NaviSD_LG_AH_dir,getProfileInt("BAP NAVI", "env_NaviSD_LG_AH_dir", 1, profileFile));
    putValue(env_NaviSD_FDL_AH_dir,getProfileInt("BAP NAVI", "env_NaviSD_FDL_AH_dir", 1, profileFile));
    putValue(env_NaviSD_FDL_AH_elements,getProfileInt("BAP NAVI", "env_NaviSD_FDL_AH_elements", 1, profileFile));
    putValue(env_NaviSD_FDL_AH_IS,getProfileInt("BAP NAVI", "env_NaviSD_FDL_AH_IS", 1, profileFile));
    putValue(env_NaviSD_FDL_AH_POS,getProfileInt("BAP NAVI", "env_NaviSD_FDL_AH_POS", 1, profileFile));
    putValue(env_NaviSD_FDL_AH_RA,getProfileInt("BAP NAVI", "env_NaviSD_FDL_AH_RA", 1, profileFile));
    putValue(env_NaviSD_FDL_AH_shift,getProfileInt("BAP NAVI", "env_NaviSD_FDL_AH_shift", 1, profileFile));
    putValue(env_NaviSD_FDL_AH_start,getProfileInt("BAP NAVI", "env_NaviSD_FDL_AH_start", 1, profileFile));
    putValue(env_NaviSD_FDL_ASGID,getProfileInt("BAP NAVI", "env_NaviSD_FDL_ASGID", 1, profileFile));
    putValue(env_NaviSD_FDL_CA,getProfileInt("BAP NAVI", "env_NaviSD_FDL_CA", 1, profileFile));
    putValue(env_NaviSD_FDL_DataSource,getProfileInt("BAP NAVI", "env_NaviSD_FDL_DataSource", 1, profileFile));
    putValue(env_NaviSD_FDL_reload,getProfileInt("BAP NAVI", "env_NaviSD_FDL_reload", 1, profileFile));
    putValue(env_NaviSD_FDL_StatusArray,getProfileInt("BAP NAVI", "env_NaviSD_FDL_StatusArray", 1, profileFile));
    putValue(env_NaviSD_FDL_TAID,getProfileInt("BAP NAVI", "env_NaviSD_FDL_TAID", 1, profileFile));
    putValue(env_NaviSD_FDL_TotalNumLE,getProfileInt("BAP NAVI", "env_NaviSD_FDL_TotalNumLE", 1, profileFile));
    putValue(env_NaviSD_LDL_StatusArray,getProfileInt("BAP NAVI", "env_NaviSD_LDL_StatusArray", 1, profileFile));
    putValue(env_NaviSD_LDL_ASGID,getProfileInt("BAP NAVI", "env_NaviSD_LDL_ASGID", 1, profileFile));
    putValue(env_NaviSD_LDL_TAID,getProfileInt("BAP NAVI", "env_NaviSD_LDL_TAID", 1, profileFile));
    putValue(env_NaviSD_LDL_TotalNumLE,getProfileInt("BAP NAVI", "env_NaviSD_LDL_TotalNumLE", 1, profileFile));
    putValue(env_NaviSD_LDL_CA,getProfileInt("BAP NAVI", "env_NaviSD_LDL_CA", 1, profileFile));
    putValue(env_NaviSD_LDL_reload,getProfileInt("BAP NAVI", "env_NaviSD_LDL_reload", 1, profileFile));
    putValue(env_NaviSD_LDL_DataSource,getProfileInt("BAP NAVI", "env_NaviSD_LDL_DataSource", 1, profileFile));
    putValue(env_NaviSD_LDL_AH_start,getProfileInt("BAP NAVI", "env_NaviSD_LDL_AH_start", 1, profileFile));
    putValue(env_NaviSD_LDL_AH_elements,getProfileInt("BAP NAVI", "env_NaviSD_LDL_AH_elements", 1, profileFile));
    putValue(env_NaviSD_LDL_AH_IS,getProfileInt("BAP NAVI", "env_NaviSD_LDL_AH_IS", 1, profileFile));
    putValue(env_NaviSD_LDL_AH_POS,getProfileInt("BAP NAVI", "env_NaviSD_LDL_AH_POS", 1, profileFile));
    putValue(env_NaviSD_LDL_AH_dir,getProfileInt("BAP NAVI", "env_NaviSD_LDL_AH_dir", 1, profileFile));
    putValue(env_NaviSD_LDL_AH_shift,getProfileInt("BAP NAVI", "env_NaviSD_LDL_AH_shift", 1, profileFile));
    putValue(env_NaviSD_LDL_AH_RA,getProfileInt("BAP NAVI", "env_NaviSD_LDL_AH_RA", 1, profileFile));
    putValue(env_NaviSD_NbSpeller_Pos,getProfileInt("BAP NAVI", "env_NaviSD_NbSpeller_Pos", 1, profileFile));
    putValue(env_NaviSD_NbSpeller_MatchEntr,getProfileInt("BAP NAVI", "env_NaviSD_NbSpeller_MatchEntr", 1, profileFile));
    putValue(env_NaviSD_NbSpeller_Abort,getProfileInt("BAP NAVI", "env_NaviSD_NbSpeller_Abort", 1, profileFile));
    putValue(env_NaviSD_NbSpeller_Result,getProfileInt("BAP NAVI", "env_NaviSD_NbSpeller_Result", 1, profileFile));
    putValue(env_NaviSD_GetNextLiPos_Offset,getProfileInt("BAP NAVI", "env_NaviSD_GetNextLiPos_Offset", 1, profileFile));
    putValue(env_NaviSD_GetNextLiPos_AbsPos,getProfileInt("BAP NAVI", "env_NaviSD_GetNextLiPos_AbsPos", 1, profileFile));
    putValue(env_NaviSD_GetNextLiPos_NePos,getProfileInt("BAP NAVI", "env_NaviSD_GetNextLiPos_NePos", 1, profileFile));
    putValue(env_NaviSD_GetNextLiPos_CuPos,getProfileInt("BAP NAVI", "env_NaviSD_GetNextLiPos_CuPos", 1, profileFile));
    putValue(env_NaviSD_GetNextLiPos_Abort,getProfileInt("BAP NAVI", "env_NaviSD_GetNextLiPos_Abort", 1, profileFile));
    putValue(env_NaviSD_GetNextLiPos_Result,getProfileInt("BAP NAVI", "env_NaviSD_GetNextLiPos_Result", 1, profileFile));
    putValue(env_NaviSD_RepeatLastNavAnn_Abo,getProfileInt("BAP NAVI", "env_NaviSD_RepeatLastNavAnn_Abo", 1, profileFile));
    putValue(env_NaviSD_RepeatLastNavAnn_Res,getProfileInt("BAP NAVI", "env_NaviSD_RepeatLastNavAnn_Res", 1, profileFile));
    putValue(env_NaviSD_RGActDeact_AbortRes,getProfileInt("BAP NAVI", "env_NaviSD_RGActDeact_AbortRes", 1, profileFile));
    putValue(env_NaviSD_RGActDeact_CIInfo,getProfileInt("BAP NAVI", "env_NaviSD_RGActDeact_CIInfo", 1, profileFile));
    putValue(env_NaviSD_RGActDeact_Res,getProfileInt("BAP NAVI", "env_NaviSD_RGActDeact_Res", 1, profileFile));
    putValue(env_NaviSD_TBInd_TMCSym_update,getProfileInt("BAP NAVI", "env_NaviSD_TBInd_TMCSym_update", 1, profileFile));
    putValue(env_NaviSD_TBInd_TMCSym,getProfileInt("BAP NAVI", "env_NaviSD_TBInd_TMCSym", 1, profileFile));
    putValue(env_NaviSD_ActRGTy_RGType,getProfileInt("BAP NAVI", "env_NaviSD_ActRGTy_RGType", 1, profileFile));
    putValue(env_NaviSD_ActRGTy_RGType_update,getProfileInt("BAP NAVI", "env_NaviSD_ActRGTy_RGType_update", 1, profileFile));
    putValue(env_NaviSD_InfoStates_update,getProfileInt("BAP NAVI", "env_NaviSD_InfoStates_update", 1, profileFile));
    putValue(env_NaviSD_InfoStates_states,getProfileInt("BAP NAVI", "env_NaviSD_InfoStates_states", 1, profileFile));
    putValue(env_NaviSD_FctSync_update,getProfileInt("BAP NAVI", "env_NaviSD_FctSync_update", 1, profileFile));
    putValue(env_NaviSD_FctSync_Bit40_TBI,getProfileInt("BAP NAVI", "env_NaviSD_FctSync_Bit40_TBI", 1, profileFile));
    putValue(env_NaviSD_FctSync_Bit39_AGRT,getProfileInt("BAP NAVI", "env_NaviSD_FctSync_Bit39_AGRT", 1, profileFile));
putValue(env_NaviSD_FctSync_Bit38_IS,getProfileInt("BAP NAVI", "env_NaviSD_FctSync_Bit38_IS", 1, profileFile));
putValue(env_NaviSD_FctSync_Bit36_VG,getProfileInt("BAP NAVI", "env_NaviSD_FctSync_Bit36_VG", 1, profileFile));
putValue(env_NaviSD_FctSync_Bit34_RGL,getProfileInt("BAP NAVI", "env_NaviSD_FctSync_Bit34_RGL", 1, profileFile));
putValue(env_NaviSD_FctSync_Bit33_AL,getProfileInt("BAP NAVI", "env_NaviSD_FctSync_Bit33_AL", 1, profileFile));
putValue(env_NaviSD_FctSync_Bit32_NavB,getProfileInt("BAP NAVI", "env_NaviSD_FctSync_Bit32_NavB", 1, profileFile));
putValue(env_NaviSD_FctSync_Bit31_PrList,getProfileInt("BAP NAVI", "env_NaviSD_FctSync_Bit31_PrList", 1, profileFile));
putValue(env_NaviSD_FctSync_Bit30_FaList,getProfileInt("BAP NAVI", "env_NaviSD_FctSync_Bit30_FaList", 1, profileFile));
putValue(env_NaviSD_FctSync_Bit29_LDList,getProfileInt("BAP NAVI", "env_NaviSD_FctSync_Bit29_LDList", 1, profileFile));
putValue(env_NaviSD_FctSync_Bit27_Cal,getProfileInt("BAP NAVI", "env_NaviSD_FctSync_Bit27_Cal", 1, profileFile));
putValue(env_NaviSD_FctSync_Bit26_MFZ,getProfileInt("BAP NAVI", "env_NaviSD_FctSync_Bit26_MFZ", 1, profileFile));
putValue(env_NaviSD_FctSync_Bit25_TMCI,getProfileInt("BAP NAVI", "env_NaviSD_FctSync_Bit25_TMCI", 1, profileFile));
putValue(env_NaviSD_FctSync_Bit24_LG,getProfileInt("BAP NAVI", "env_NaviSD_FctSync_Bit24_LG", 1, profileFile));
putValue(env_NaviSD_FctSync_Bit23_MD,getProfileInt("BAP NAVI", "env_NaviSD_FctSync_Bit23_MD", 1, profileFile));
putValue(env_NaviSD_FctSync_Bit22_TTD,getProfileInt("BAP NAVI", "env_NaviSD_FctSync_Bit22_TTD", 1, profileFile));
putValue(env_NaviSD_FctSync_Bit21_DTD,getProfileInt("BAP NAVI", "env_NaviSD_FctSync_Bit21_DTD", 1, profileFile));
putValue(env_NaviSD_FctSync_Bit20_TTI,getProfileInt("BAP NAVI", "env_NaviSD_FctSync_Bit20_TTI", 1, profileFile));
putValue(env_NaviSD_FctSync_Bit19_CPI,getProfileInt("BAP NAVI", "env_NaviSD_FctSync_Bit19_CPI", 1, profileFile));
putValue(env_NaviSD_FctSync_Bit18_DTNM,getProfileInt("BAP NAVI", "env_NaviSD_FctSync_Bit18_DTNM", 1, profileFile));
putValue(env_NaviSD_FctSync_Bit17_RGS,getProfileInt("BAP NAVI", "env_NaviSD_FctSync_Bit17_RGS", 1, profileFile));
putValue(env_NaviSD_FctSync_Bit16_CI,getProfileInt("BAP NAVI", "env_NaviSD_FctSync_Bit16_CI", 1, profileFile));
putValue(env_NaviSD_VG_State,getProfileInt("BAP NAVI", "env_NaviSD_VG_State", 1, profileFile));
putValue(env_NaviSD_VG_State_update,getProfileInt("BAP NAVI", "env_NaviSD_VG_State_update", 1, profileFile));
putValue(NeueVariable_100,getProfileInt("BAP NAVI", "NeueVariable_100", 1, profileFile));
putValue(env_NaviSD_PrefDeLis_Type_update,getProfileInt("BAP NAVI", "env_NaviSD_PrefDeLis_Type_update", 1, profileFile));
putValue(env_NaviSD_PrefDeLis_Type,getProfileInt("BAP NAVI", "env_NaviSD_PrefDeLis_Type", 1, profileFile));
putValue(env_NaviSD_ASGcap_Pres,getProfileInt("BAP NAVI", "env_NaviSD_ASGcap_Pres", 1, profileFile));
putValue(env_NaviSD_ASGcap_Pres_update,getProfileInt("BAP NAVI", "env_NaviSD_ASGcap_Pres_update", 1, profileFile));
putValue(env_NaviSD_CaliState_set,getProfileInt("BAP NAVI", "env_NaviSD_CaliState_set", 1, profileFile));
putValue(env_NaviSD_CaliState_update,getProfileInt("BAP NAVI", "env_NaviSD_CaliState_update", 1, profileFile));
putValue(env_NaviSD_MFZone_Zone_set,getProfileInt("BAP NAVI", "env_NaviSD_MFZone_Zone_set", 1, profileFile));
putValue(env_NaviSD_MFZone_update,getProfileInt("BAP NAVI", "env_NaviSD_MFZone_update", 1, profileFile));
putValue(env_NaviSD_TMCI_MessageID,getProfileInt("BAP NAVI", "env_NaviSD_TMCI_MessageID", 1, profileFile));
putValue(env_NaviSD_TMCI_Length_Validity,getProfileInt("BAP NAVI", "env_NaviSD_TMCI_Length_Validity", 1, profileFile));
putValue(env_NaviSD_TTD_Year_VI,getProfileInt("BAP NAVI", "env_NaviSD_TTD_Year_VI", 1, profileFile));
putValue(env_NaviSD_TTD_Month_VI,getProfileInt("BAP NAVI", "env_NaviSD_TTD_Month_VI", 1, profileFile));
putValue(env_NaviSD_TTD_Day_VI,getProfileInt("BAP NAVI", "env_NaviSD_TTD_Day_VI", 1, profileFile));
putValue(env_NaviSD_TTD_Hour_VI,getProfileInt("BAP NAVI", "env_NaviSD_TTD_Hour_VI", 1, profileFile));
putValue(env_NaviSD_TTD_update,getProfileInt("BAP NAVI", "env_NaviSD_TTD_update", 1, profileFile));
putValue(env_NaviSD_DTNM_ValidityInfo,getProfileInt("BAP NAVI", "env_NaviSD_DTNM_ValidityInfo", 1, profileFile));
putValue(env_NaviSD_TMCI_Length_Unit,getProfileInt("BAP NAVI", "env_NaviSD_TMCI_Length_Unit", 1, profileFile));
putValue(env_NaviSD_TMCI_Length_Value,getProfileInt("BAP NAVI", "env_NaviSD_TMCI_Length_Value", 1, profileFile));
putValue(env_NaviSD_TMCI_Priority,getProfileInt("BAP NAVI", "env_NaviSD_TMCI_Priority", 1, profileFile));
putValue(env_NaviSD_TMCI_MessageWaitInd,getProfileInt("BAP NAVI", "env_NaviSD_TMCI_MessageWaitInd", 1, profileFile));
putValue(env_NaviSD_TTD_Minute_VI,getProfileInt("BAP NAVI", "env_NaviSD_TTD_Minute_VI", 1, profileFile));
putValue(env_NaviSD_DTD_ValidityInfo,getProfileInt("BAP NAVI", "env_NaviSD_DTD_ValidityInfo", 1, profileFile));
putValue(env_NaviSD_CompassInfo_update,getProfileInt("BAP NAVI", "env_NaviSD_CompassInfo_update", 1, profileFile));
putValue(env_NaviSD_TTI_update,getProfileInt("BAP NAVI", "env_NaviSD_TTI_update", 1, profileFile));
putValue(env_NaviSD_PositionInfo_update,getProfileInt("BAP NAVI", "env_NaviSD_PositionInfo_update", 1, profileFile));
putValue(env_NaviSD_DTD_update,getProfileInt("BAP NAVI", "env_NaviSD_DTD_update", 1, profileFile));
putValue(env_NaviSD_DTNM_update,getProfileInt("BAP NAVI", "env_NaviSD_DTNM_update", 1, profileFile));
putValue(env_NaviSD_TMCI_update,getProfileInt("BAP NAVI", "env_NaviSD_TMCI_update", 1, profileFile));
putValue(env_NaviSD_TMCI_MS,getProfileInt("BAP NAVI", "env_NaviSD_TMCI_MS", 1, profileFile));
putValue(env_NaviSD_LNG_Changed,getProfileInt("BAP NAVI", "env_NaviSD_LNG_Changed", 1, profileFile));
putValue(env_NaviSD_LaneGuidanceOnOff,getProfileInt("BAP NAVI", "env_NaviSD_LaneGuidanceOnOff", 1, profileFile));
putValue(env_NaviSD_MD_Z_Level3,getProfileInt("BAP NAVI", "env_NaviSD_MD_Z_Level3", 1, profileFile));
putValue(env_NaviSD_MD_Z_Level2,getProfileInt("BAP NAVI", "env_NaviSD_MD_Z_Level2", 1, profileFile));
putValue(env_NaviSD_MD_Z_Level1,getProfileInt("BAP NAVI", "env_NaviSD_MD_Z_Level1", 1, profileFile));
putValue(env_NaviSD_PowerOnOff,getProfileInt("BAP NAVI", "env_NaviSD_PowerOnOff", 1, profileFile));
putValue(env_NaviSD_MD_update,getProfileInt("BAP NAVI", "env_NaviSD_MD_update", 1, profileFile));
putValue(env_NaviSD_DTNM_BG_Info,getProfileInt("BAP NAVI", "env_NaviSD_DTNM_BG_Info", 1, profileFile));
putValue(env_NaviSD_Direction_Symbolik,getProfileInt("BAP NAVI", "env_NaviSD_Direction_Symbolik", 1, profileFile));
putValue(env_NaviSD_MD_Direction3,getProfileInt("BAP NAVI", "env_NaviSD_MD_Direction3", 1, profileFile));
putValue(env_NaviSD_MD_MainElement3,getProfileInt("BAP NAVI", "env_NaviSD_MD_MainElement3", 1, profileFile));
putValue(env_NaviSD_MD_Direction2,getProfileInt("BAP NAVI", "env_NaviSD_MD_Direction2", 1, profileFile));
putValue(env_NaviSD_MD_MainElement2,getProfileInt("BAP NAVI", "env_NaviSD_MD_MainElement2", 1, profileFile));
putValue(env_NaviSD_MD_Direction1,getProfileInt("BAP NAVI", "env_NaviSD_MD_Direction1", 1, profileFile));
putValue(env_NaviSD_MD_MainElement1,getProfileInt("BAP NAVI", "env_NaviSD_MD_MainElement1", 1, profileFile));
putValue(env_NaviSD_TTD_Year,getProfileInt("BAP NAVI", "env_NaviSD_TTD_Year", 1, profileFile));
putValue(env_NaviSD_TTD_Month,getProfileInt("BAP NAVI", "env_NaviSD_TTD_Month", 1, profileFile));
putValue(env_NaviSD_TTD_Day,getProfileInt("BAP NAVI", "env_NaviSD_TTD_Day", 1, profileFile));
putValue(env_NaviSD_TTD_Hour,getProfileInt("BAP NAVI", "env_NaviSD_TTD_Hour", 1, profileFile));
putValue(env_NaviSD_TTD_Minute,getProfileInt("BAP NAVI", "env_NaviSD_TTD_Minute", 1, profileFile));
putValue(env_NaviSD_TTD_NavigationTF,getProfileInt("BAP NAVI", "env_NaviSD_TTD_NavigationTF", 1, profileFile));
putValue(env_NaviSD_TTD_TimeInfoType,getProfileInt("BAP NAVI", "env_NaviSD_TTD_TimeInfoType", 1, profileFile));
putValue(env_NaviSD_DTD_Unit,getProfileInt("BAP NAVI", "env_NaviSD_DTD_Unit", 1, profileFile));
putValue(env_NaviSD_DTD_Distance,getProfileInt("BAP NAVI", "env_NaviSD_DTD_Distance", 1, profileFile));
putValue(env_NaviSD_DTNM_BG,getProfileInt("BAP NAVI", "env_NaviSD_DTNM_BG", 1, profileFile));
putValue(env_NaviSD_DTNM_BG_ON_OFF,getProfileInt("BAP NAVI", "env_NaviSD_DTNM_BG_ON_OFF", 1, profileFile));
putValue(env_NaviSD_DTNM_Unit,getProfileInt("BAP NAVI", "env_NaviSD_DTNM_Unit", 1, profileFile));
putValue(env_NaviSD_DTNM_Distance,getProfileInt("BAP NAVI", "env_NaviSD_DTNM_Distance", 1, profileFile));
putValue(env_NaviSD_RG_Status,getProfileInt("BAP NAVI", "env_NaviSD_RG_Status", 1, profileFile));
putValue(env_NaviSD_Direction_Angle,getProfileInt("BAP NAVI", "env_NaviSD_Direction_Angle", 1, profileFile));
putValue(env_NaviSD_FSG_OP_State,getProfileInt("BAP NAVI", "env_NaviSD_FSG_OP_State", 1, profileFile));
putValue(BAPCFG_FSG_NaviSD_ProtocolMinor,getProfileInt("BAP NAVI", "BAPCFG_FSG_NaviSD_ProtocolMinor", 1, profileFile));
putValue(BAPCFG_FSG_NaviSD_ProtocolMajor,getProfileInt("BAP NAVI", "BAPCFG_FSG_NaviSD_ProtocolMajor", 1, profileFile));
putValue(BAPCFG_FSG_NaviSD_LsgClassMinor,getProfileInt("BAP NAVI", "BAPCFG_FSG_NaviSD_LsgClassMinor", 1, profileFile));
putValue(BAPCFG_FSG_NaviSD_LsgClassMajor,getProfileInt("BAP NAVI", "BAPCFG_FSG_NaviSD_LsgClassMajor", 1, profileFile));
putValue(BAPCFG_FSG_NaviSD_DFMinor,getProfileInt("BAP NAVI", "BAPCFG_FSG_NaviSD_DFMinor", 1, profileFile));
putValue(BAPCFG_FSG_NaviSD_DFMajor,getProfileInt("BAP NAVI", "BAPCFG_FSG_NaviSD_DFMajor", 1, profileFile));
putValue(env_NaviSD_FctList_0x2A_HB,getProfileInt("BAP NAVI", "env_NaviSD_FctList_0x2A_HB", 1, profileFile));
putValue(env_NaviSD_FctList_0x29_HB,getProfileInt("BAP NAVI", "env_NaviSD_FctList_0x29_HB", 1, profileFile));
putValue(env_NaviSD_FctList_0x28_HB,getProfileInt("BAP NAVI", "env_NaviSD_FctList_0x28_HB", 1, profileFile));
putValue(env_NaviSD_FctList_0x27_HB,getProfileInt("BAP NAVI", "env_NaviSD_FctList_0x27_HB", 1, profileFile));
putValue(env_NaviSD_FctList_0x26_HB,getProfileInt("BAP NAVI", "env_NaviSD_FctList_0x26_HB", 1, profileFile));
putValue(env_NaviSD_FctList_0x25_HB,getProfileInt("BAP NAVI", "env_NaviSD_FctList_0x25_HB", 1, profileFile));
putValue(env_NaviSD_FctList_0x24_HB,getProfileInt("BAP NAVI", "env_NaviSD_FctList_0x24_HB", 1, profileFile));
putValue(env_NaviSD_FctList_0x23_HB,getProfileInt("BAP NAVI", "env_NaviSD_FctList_0x23_HB", 1, profileFile));
putValue(env_NaviSD_FctList_0x22_HB,getProfileInt("BAP NAVI", "env_NaviSD_FctList_0x22_HB", 1, profileFile));
putValue(env_NaviSD_FctList_0x21_HB,getProfileInt("BAP NAVI", "env_NaviSD_FctList_0x21_HB", 1, profileFile));
putValue(env_NaviSD_FctList_0x20_HB,getProfileInt("BAP NAVI", "env_NaviSD_FctList_0x20_HB", 1, profileFile));
putValue(env_NaviSD_FctList_0x1F_HB,getProfileInt("BAP NAVI", "env_NaviSD_FctList_0x1F_HB", 1, profileFile));
putValue(env_NaviSD_FctList_0x1E_HB,getProfileInt("BAP NAVI", "env_NaviSD_FctList_0x1E_HB", 1, profileFile));
putValue(env_NaviSD_FctList_0x1D_HB,getProfileInt("BAP NAVI", "env_NaviSD_FctList_0x1D_HB", 1, profileFile));
putValue(env_NaviSD_FctList_0x1C_HB,getProfileInt("BAP NAVI", "env_NaviSD_FctList_0x1C_HB", 1, profileFile));
putValue(env_NaviSD_FctList_0x1B_HB,getProfileInt("BAP NAVI", "env_NaviSD_FctList_0x1B_HB", 1, profileFile));
putValue(env_NaviSD_FctList_0x1A_HB,getProfileInt("BAP NAVI", "env_NaviSD_FctList_0x1A_HB", 1, profileFile));
putValue(env_NaviSD_FctList_0x19_HB,getProfileInt("BAP NAVI", "env_NaviSD_FctList_0x19_HB", 1, profileFile));
putValue(env_NaviSD_FctList_0x18_HB,getProfileInt("BAP NAVI", "env_NaviSD_FctList_0x18_HB", 1, profileFile));
putValue(env_NaviSD_FctList_0x17_HB,getProfileInt("BAP NAVI", "env_NaviSD_FctList_0x17_HB", 1, profileFile));
putValue(env_NaviSD_FctList_0x16_HB,getProfileInt("BAP NAVI", "env_NaviSD_FctList_0x16_HB", 1, profileFile));
putValue(env_NaviSD_FctList_0x15_HB,getProfileInt("BAP NAVI", "env_NaviSD_FctList_0x15_HB", 1, profileFile));
putValue(env_NaviSD_FctList_0x14_HB,getProfileInt("BAP NAVI", "env_NaviSD_FctList_0x14_HB", 1, profileFile));
putValue(env_NaviSD_FctList_0x13_HB,getProfileInt("BAP NAVI", "env_NaviSD_FctList_0x13_HB", 1, profileFile));
putValue(env_NaviSD_FctList_0x12_HB,getProfileInt("BAP NAVI", "env_NaviSD_FctList_0x12_HB", 1, profileFile));
putValue(env_NaviSD_FctList_0x11_HB,getProfileInt("BAP NAVI", "env_NaviSD_FctList_0x11_HB", 1, profileFile));
putValue(env_NaviSD_FctList_0x10_HB,getProfileInt("BAP NAVI", "env_NaviSD_FctList_0x10_HB", 1, profileFile));
putValue(env_NaviSD_FctList_0x0F_HB,getProfileInt("BAP NAVI", "env_NaviSD_FctList_0x0F_HB", 1, profileFile));
putValue(env_NaviSD_FctList_0x04_HB,getProfileInt("BAP NAVI", "env_NaviSD_FctList_0x04_HB", 1, profileFile));
putValue(env_NaviSD_FctList_0x03_HB,getProfileInt("BAP NAVI", "env_NaviSD_FctList_0x03_HB", 1, profileFile));
putValue(env_NaviSD_FctList_0x02_HB,getProfileInt("BAP NAVI", "env_NaviSD_FctList_0x02_HB", 1, profileFile));
putValue(env_NaviSD_FctList_0x01_HB,getProfileInt("BAP NAVI", "env_NaviSD_FctList_0x01_HB", 1, profileFile));
putValue(env_NaviSD_AL_TAID_error,getProfileInt("BAP NAVI", "env_NaviSD_AL_TAID_error", 1, profileFile));
putValue(env_NaviSD_AL_ASGID_error,getProfileInt("BAP NAVI", "env_NaviSD_AL_ASGID_error", 1, profileFile));
putValue(env_NaviSD_FDL_TAID_error,getProfileInt("BAP NAVI", "env_NaviSD_FDL_TAID_error", 1, profileFile));
putValue(env_NaviSD_FDL_ASGID_error,getProfileInt("BAP NAVI", "env_NaviSD_FDL_ASGID_error", 1, profileFile));
putValue(env_NaviSD_LDL_TAID_error,getProfileInt("BAP NAVI", "env_NaviSD_LDL_TAID_error", 1, profileFile));
putValue(env_NaviSD_LDL_ASGID_error,getProfileInt("BAP NAVI", "env_NaviSD_LDL_ASGID_error", 1, profileFile));
putValue(env_NaviSD_LG_TAID_error,getProfileInt("BAP NAVI", "env_NaviSD_LG_TAID_error", 1, profileFile));
putValue(env_NaviSD_LG_ASGID_error,getProfileInt("BAP NAVI", "env_NaviSD_LG_ASGID_error", 1, profileFile));
putValue(env_NaviSD_AL_Timeout,getProfileInt("BAP NAVI", "env_NaviSD_AL_Timeout", 1, profileFile));
putValue(env_NaviSD_FDL_Timeout,getProfileInt("BAP NAVI", "env_NaviSD_FDL_Timeout", 1, profileFile));
putValue(env_NaviSD_LDL_Timeout,getProfileInt("BAP NAVI", "env_NaviSD_LDL_Timeout", 1, profileFile));
putValue(env_NaviSD_LG_Timeout,getProfileInt("BAP NAVI", "env_NaviSD_LG_Timeout", 1, profileFile));
putValue(env_NaviSD_FctList_0x0F_TimeOut,getProfileInt("BAP NAVI", "env_NaviSD_FctList_0x0F_TimeOut", 1, profileFile));
putValue(env_NaviSD_FctList_0x10_TimeOut,getProfileInt("BAP NAVI", "env_NaviSD_FctList_0x10_TimeOut", 1, profileFile));
putValue(env_NaviSD_FctList_0x11_TimeOut,getProfileInt("BAP NAVI", "env_NaviSD_FctList_0x11_TimeOut", 1, profileFile));
putValue(env_NaviSD_FctList_0x12_TimeOut,getProfileInt("BAP NAVI", "env_NaviSD_FctList_0x12_TimeOut", 1, profileFile));
putValue(env_NaviSD_FctList_0x13_TimeOut,getProfileInt("BAP NAVI", "env_NaviSD_FctList_0x13_TimeOut", 1, profileFile));
putValue(env_NaviSD_FctList_0x14_TimeOut,getProfileInt("BAP NAVI", "env_NaviSD_FctList_0x14_TimeOut", 1, profileFile));
putValue(env_NaviSD_FctList_0x15_TimeOut,getProfileInt("BAP NAVI", "env_NaviSD_FctList_0x15_TimeOut", 1, profileFile));
putValue(env_NaviSD_FctList_0x16_TimeOut,getProfileInt("BAP NAVI", "env_NaviSD_FctList_0x16_TimeOut", 1, profileFile));
putValue(env_NaviSD_FctList_0x17_TimeOut,getProfileInt("BAP NAVI", "env_NaviSD_FctList_0x17_TimeOut", 1, profileFile));
putValue(env_NaviSD_FctList_0x18_TimeOut,getProfileInt("BAP NAVI", "env_NaviSD_FctList_0x18_TimeOut", 1, profileFile));
putValue(env_NaviSD_FctList_0x19_TimeOut,getProfileInt("BAP NAVI", "env_NaviSD_FctList_0x19_TimeOut", 1, profileFile));
putValue(env_NaviSD_FctList_0x1A_TimeOut,getProfileInt("BAP NAVI", "env_NaviSD_FctList_0x1A_TimeOut", 1, profileFile));
putValue(env_NaviSD_FctList_0x1B_TimeOut,getProfileInt("BAP NAVI", "env_NaviSD_FctList_0x1B_TimeOut", 1, profileFile));
putValue(env_NaviSD_FctList_0x1C_TimeOut,getProfileInt("BAP NAVI", "env_NaviSD_FctList_0x1C_TimeOut", 1, profileFile));
putValue(env_NaviSD_FctList_0x1D_TimeOut,getProfileInt("BAP NAVI", "env_NaviSD_FctList_0x1D_TimeOut", 1, profileFile));
putValue(env_NaviSD_FctList_0x1E_TimeOut,getProfileInt("BAP NAVI", "env_NaviSD_FctList_0x1E_TimeOut", 1, profileFile));
putValue(env_NaviSD_FctList_0x1F_TimeOut,getProfileInt("BAP NAVI", "env_NaviSD_FctList_0x1F_TimeOut", 1, profileFile));
putValue(env_NaviSD_FctList_0x20_TimeOut,getProfileInt("BAP NAVI", "env_NaviSD_FctList_0x20_TimeOut", 1, profileFile));
putValue(env_NaviSD_FctList_0x21_TimeOut,getProfileInt("BAP NAVI", "env_NaviSD_FctList_0x21_TimeOut", 1, profileFile));
putValue(env_NaviSD_FctList_0x22_TimeOut,getProfileInt("BAP NAVI", "env_NaviSD_FctList_0x22_TimeOut", 1, profileFile));
putValue(env_NaviSD_FctList_0x23_TimeOut,getProfileInt("BAP NAVI", "env_NaviSD_FctList_0x23_TimeOut", 1, profileFile));
putValue(env_NaviSD_FctList_0x24_TimeOut,getProfileInt("BAP NAVI", "env_NaviSD_FctList_0x24_TimeOut", 1, profileFile));
putValue(env_NaviSD_FctList_0x25_TimeOut,getProfileInt("BAP NAVI", "env_NaviSD_FctList_0x25_TimeOut", 1, profileFile));
putValue(env_NaviSD_FctList_0x26_TimeOut,getProfileInt("BAP NAVI", "env_NaviSD_FctList_0x26_TimeOut", 1, profileFile));
putValue(env_NaviSD_FctList_0x27_TimeOut,getProfileInt("BAP NAVI", "env_NaviSD_FctList_0x27_TimeOut", 1, profileFile));
putValue(env_NaviSD_FctList_0x28_TimeOut,getProfileInt("BAP NAVI", "env_NaviSD_FctList_0x28_TimeOut", 1, profileFile));
putValue(env_NaviSD_FctList_0x29_TimeOut,getProfileInt("BAP NAVI", "env_NaviSD_FctList_0x29_TimeOut", 1, profileFile));
putValue(env_NaviSD_FctList_0x2A_TimeOut,getProfileInt("BAP NAVI", "env_NaviSD_FctList_0x2A_TimeOut", 1, profileFile));
putValue(env_NaviSD_FctList_0x22_3min_TO,getProfileInt("BAP NAVI", "env_NaviSD_FctList_0x22_3min_TO", 1, profileFile));
putValue(env_NaviSD_FctList_0x29_3min_TO,getProfileInt("BAP NAVI", "env_NaviSD_FctList_0x29_3min_TO", 1, profileFile));
putValue(env_NaviSD_FctList_0x2A_3min_TO,getProfileInt("BAP NAVI", "env_NaviSD_FctList_0x2A_3min_TO", 1, profileFile));
putValue(env_NaviSD_FctList_0x23_3min_TO,getProfileInt("BAP NAVI", "env_NaviSD_FctList_0x23_3min_TO", 1, profileFile));
putValue(env_FSG_NaviSD_FctList_ErrCode,getProfileInt("BAP NAVI", "env_FSG_NaviSD_FctList_ErrCode", 1, profileFile));
putValue(env_FSG_NaviSD_GetAll_ErrCode,getProfileInt("BAP NAVI", "env_FSG_NaviSD_GetAll_ErrCode", 1, profileFile));
putValue(env_BAPCFG_FSG_NaviSD_ErrCode,getProfileInt("BAP NAVI", "env_BAPCFG_FSG_NaviSD_ErrCode", 1, profileFile));
    putValue(env_FSG_NaviSD_FctList_SegmEn,getProfileInt("BAP NAVI", "env_FSG_NaviSD_FctList_SegmEn", 1, profileFile));
    putValue(env_FSG_NaviSD_FctList_IntTlgEn,getProfileInt("BAP NAVI", "env_FSG_NaviSD_FctList_IntTlgEn", 1, profileFile));
    putValue(env_FSG_NaviSD_FctList_FctEn,getProfileInt("BAP NAVI", "env_FSG_NaviSD_FctList_FctEn", 1, profileFile));
    putValue(env_FSG_NaviSD_FctList_ErrEn,getProfileInt("BAP NAVI", "env_FSG_NaviSD_FctList_ErrEn", 1, profileFile));
    putValue(env_BAPCFG_FSG_NaviSD_FctEn,getProfileInt("BAP NAVI", "env_BAPCFG_FSG_NaviSD_FctEn", 1, profileFile));
    putValue(env_BAPCFG_FSG_NaviSD_ErrEn,getProfileInt("BAP NAVI", "env_BAPCFG_FSG_NaviSD_ErrEn", 1, profileFile));
    putValue(env_FSG_NaviSD_GetAll_FctEn,getProfileInt("BAP NAVI", "env_FSG_NaviSD_GetAll_FctEn", 1, profileFile));
    putValue(env_FSG_NaviSD_GetAll_ErrEn,getProfileInt("BAP NAVI", "env_FSG_NaviSD_GetAll_ErrEn", 1, profileFile));
    putValue(env_FSG_NaviSD_GetAll_IntTlgEn,getProfileInt("BAP NAVI", "env_FSG_NaviSD_GetAll_IntTlgEn", 1, profileFile));
    putValue(env_FSG_NaviSD_GetAll_SegmEn,getProfileInt("BAP NAVI", "env_FSG_NaviSD_GetAll_SegmEn", 1, profileFile));
    putValue(env_FSG_NaviSD_BAPCFG_ResetSet,getProfileInt("BAP NAVI", "env_FSG_NaviSD_BAPCFG_ResetSet", 1, profileFile));
}
*/

//IssueList #200 - Addition of LoadAll button
void loadBAP_telSettings( char profileFile[] )
{
    putValue(env_FSG_GetAll_FctEn,getProfileInt("BAP TEL", "env_FSG_GetAll_FctEn", 1, profileFile));
    putValue(env_BAPCFG_FSG_FctEn,getProfileInt("BAP TEL", "env_BAPCFG_FSG_FctEn", 1, profileFile));
    putValue(env_FSG_FctList_FctEn,getProfileInt("BAP TEL", "env_FSG_FctList_FctEn", 1, profileFile));
    putValue(env_BAPCFG_FSG_ResetSet,getProfileInt("BAP TEL", "env_BAPCFG_FSG_ResetSet", 1, profileFile));
    putValue(env_FSG_FctList_ErrCode,getProfileInt("BAP TEL", "env_FSG_FctList_ErrCode", 1, profileFile));
    putValue(env_FSG_GetAll_ErrCode,getProfileInt("BAP TEL", "env_FSG_GetAll_ErrCode", 1, profileFile));
    putValue(env_BAPCFG_FSG_ErrCode,getProfileInt("BAP TEL", "env_BAPCFG_FSG_ErrCode", 1, profileFile));
    putValue(env_FSG_FctList_SegmEn,getProfileInt("BAP TEL", "env_FSG_FctList_SegmEn", 1, profileFile));
    putValue(env_FSG_FctList_IntTlgEn,getProfileInt("BAP TEL", "env_FSG_FctList_IntTlgEn", 1, profileFile));
    putValue(env_FSG_FctList_ErrEn,getProfileInt("BAP TEL", "env_FSG_FctList_ErrEn", 1, profileFile));
    putValue(env_BAPCFG_FSG_Tel_ErrEn,getProfileInt("BAP TEL", "env_BAPCFG_FSG_Tel_ErrEn", 1, profileFile));
    putValue(env_FSG_GetAll_ErrEn,getProfileInt("BAP TEL", "env_FSG_GetAll_ErrEn", 1, profileFile));
    putValue(env_FSG_GetAll_IntTlgEn,getProfileInt("BAP TEL", "env_FSG_GetAll_IntTlgEn", 1, profileFile));
    putValue(env_FSG_GetAll_SegmEn,getProfileInt("BAP TEL", "env_FSG_GetAll_SegmEn", 1, profileFile));
    putValue(env_FSG_Phonebook_FRU,getProfileInt("BAP TEL", "env_FSG_Phonebook_FRU", 1, profileFile));
    putValue(env_FSG_CN_FRU,getProfileInt("BAP TEL", "env_FSG_CN_FRU", 1, profileFile));
    putValue(env_FSG_Panel_PhoneBook_Insert,getProfileInt("BAP TEL", "env_FSG_Panel_PhoneBook_Insert", 1, profileFile));
    putValue(env_FSG_Tel_FctList_0x22_TimeOut,getProfileInt("BAP TEL", "env_FSG_Tel_FctList_0x22_TimeOut", 1, profileFile));
    putValue(env_FSG_Tel_FctList_0x0E_TimeOut,getProfileInt("BAP TEL", "env_FSG_Tel_FctList_0x0E_TimeOut", 1, profileFile));
    putValue(env_FSG_AutoRedialExtInfo_Cat,getProfileInt("BAP TEL", "env_FSG_AutoRedialExtInfo_Cat", 1, profileFile));
    putValue(env_FSG_AutoRedialExtInfo_OK,getProfileInt("BAP TEL", "env_FSG_AutoRedialExtInfo_OK", 1, profileFile));
    putValue(env_FSG_Telephone_HB_input,getProfileInt("BAP TEL", "env_FSG_Telephone_HB_input", 1, profileFile));
    putValue(env_FSG_Telephone_HB_button,getProfileInt("BAP TEL", "env_FSG_Telephone_HB_button", 1, profileFile));
    putValue(env_FSG_HandsFreeOnOff_OK,getProfileInt("BAP TEL", "env_FSG_HandsFreeOnOff_OK", 1, profileFile));
    putValue(env_FSG_MicroMuteOnOff_OK,getProfileInt("BAP TEL", "env_FSG_MicroMuteOnOff_OK", 1, profileFile));
    putValue(env_FSG_RingToneMuteOnOff_OK,getProfileInt("BAP TEL", "env_FSG_RingToneMuteOnOff_OK", 1, profileFile));
    putValue(env_FSG_AutoRedial_OK,getProfileInt("BAP TEL", "env_FSG_AutoRedial_OK", 1, profileFile));
    putValue(env_FSG_DataConnInd_OK,getProfileInt("BAP TEL", "env_FSG_DataConnInd_OK", 1, profileFile));
    putValue(env_FSG_SignalQuality_OK,getProfileInt("BAP TEL", "env_FSG_SignalQuality_OK", 1, profileFile));
    putValue(env_FSG_Tel_AcceptCall_ErrorCode,getProfileInt("BAP TEL", "env_FSG_Tel_AcceptCall_ErrorCode", 1, profileFile));
    putValue(env_FSG_Tel_GetNextListPos_E_O,getProfileInt("BAP TEL", "env_FSG_Tel_GetNextListPos_E_O", 1, profileFile));
    putValue(env_FSG_Tel_MPSWCOH_Error_On,getProfileInt("BAP TEL", "env_FSG_Tel_MPSWCOH_Error_On", 1, profileFile));
    putValue(env_FSG_Tel_MPRAllCAWC_Error_On,getProfileInt("BAP TEL", "env_FSG_Tel_MPRAllCAWC_Error_On", 1, profileFile));
    putValue(env_FSG_Tel_CCJoin_Error_On,getProfileInt("BAP TEL", "env_FSG_Tel_CCJoin_Error_On", 1, profileFile));
    putValue(env_FSG_Tel_ECall_Error_On,getProfileInt("BAP TEL", "env_FSG_Tel_ECall_Error_On", 1, profileFile));
    putValue(env_FSG_Tel_PbSpeller_Error_On,getProfileInt("BAP TEL", "env_FSG_Tel_PbSpeller_Error_On", 1, profileFile));
    putValue(env_FSG_Tel_MPCHAWC_Error_On,getProfileInt("BAP TEL", "env_FSG_Tel_MPCHAWC_Error_On", 1, profileFile));
    putValue(env_FSG_Tel_MPSWAP_Error_On,getProfileInt("BAP TEL", "env_FSG_Tel_MPSWAP_Error_On", 1, profileFile));
    putValue(env_FSG_Tel_MPRACAWC_Error_On,getProfileInt("BAP TEL", "env_FSG_Tel_MPRACAWC_Error_On", 1, profileFile));
    putValue(env_FSG_Tel_HangUpCall_Error_On,getProfileInt("BAP TEL", "env_FSG_Tel_HangUpCall_Error_On", 1, profileFile));
    putValue(env_FSG_Tel_DialServ_Error_On,getProfileInt("BAP TEL", "env_FSG_Tel_DialServ_Error_On", 1, profileFile));
    putValue(env_FSG_Tel_CallHold_Error_On,getProfileInt("BAP TEL", "env_FSG_Tel_CallHold_Error_On", 1, profileFile));
    putValue(env_FSG_Tel_ResumeCall_Error_On,getProfileInt("BAP TEL", "env_FSG_Tel_ResumeCall_Error_On", 1, profileFile));
    putValue(env_FSG_Tel_AcceptCall_Error_On,getProfileInt("BAP TEL", "env_FSG_Tel_AcceptCall_Error_On", 1, profileFile));
    putValue(env_FSG_Tel_DialNumber_Error_On,getProfileInt("BAP TEL", "env_FSG_Tel_DialNumber_Error_On", 1, profileFile));
    putValue(env_FSG_Tel_MPSWCOH_ErrorCode,getProfileInt("BAP TEL", "env_FSG_Tel_MPSWCOH_ErrorCode", 1, profileFile));
    putValue(env_FSG_Tel_MPRAllCAWC_ErrorCode,getProfileInt("BAP TEL", "env_FSG_Tel_MPRAllCAWC_ErrorCode", 1, profileFile));
    putValue(env_FSG_Tel_CCJoin_ErrorCode,getProfileInt("BAP TEL", "env_FSG_Tel_CCJoin_ErrorCode", 1, profileFile));
    putValue(env_FSG_Tel_ECall_ErrorCode,getProfileInt("BAP TEL", "env_FSG_Tel_ECall_ErrorCode", 1, profileFile));
    putValue(env_FSG_Tel_PbSpeller_ErrorCode,getProfileInt("BAP TEL", "env_FSG_Tel_PbSpeller_ErrorCode", 1, profileFile));
    putValue(env_FSG_Tel_MPCHAWC_ErrorCode,getProfileInt("BAP TEL", "env_FSG_Tel_MPCHAWC_ErrorCode", 1, profileFile));
    putValue(env_FSG_Tel_MPSWAP_ErrorCode,getProfileInt("BAP TEL", "env_FSG_Tel_MPSWAP_ErrorCode", 1, profileFile));
    putValue(env_FSG_Tel_MPRACAWC_ErrorCode,getProfileInt("BAP TEL", "env_FSG_Tel_MPRACAWC_ErrorCode", 1, profileFile));
    putValue(env_FSG_Tel_HangUpCall_ErrorCode,getProfileInt("BAP TEL", "env_FSG_Tel_HangUpCall_ErrorCode", 1, profileFile));
    putValue(env_FSG_Tel_DialServ_ErrorCode,getProfileInt("BAP TEL", "env_FSG_Tel_DialServ_ErrorCode", 1, profileFile));
    putValue(env_FSG_Tel_CallHold_ErrorCode,getProfileInt("BAP TEL", "env_FSG_Tel_CallHold_ErrorCode", 1, profileFile));
    putValue(env_FSG_Tel_ResumeCall_ErrorCode,getProfileInt("BAP TEL", "env_FSG_Tel_ResumeCall_ErrorCode", 1, profileFile));
    putValue(env_FSG_Tel_DialNumber_ErrorCode,getProfileInt("BAP TEL", "env_FSG_Tel_DialNumber_ErrorCode", 1, profileFile));
    putValue(env_FSG_Tel_GetNextListPos_EC,getProfileInt("BAP TEL", "env_FSG_Tel_GetNextListPos_EC", 1, profileFile));
    putValue(env_FSG_PbSpeller_Pos,getProfileInt("BAP TEL", "env_FSG_PbSpeller_Pos", 1, profileFile));
    putValue(env_FSG_PbSpeller_Mode,getProfileInt("BAP TEL", "env_FSG_PbSpeller_Mode", 1, profileFile));
    putValue(env_FSG_PbSpeller_Result,getProfileInt("BAP TEL", "env_FSG_PbSpeller_Result", 1, profileFile));
    putValue(env_FSG_GetNextListPos_AbsLpos,getProfileInt("BAP TEL", "env_FSG_GetNextListPos_AbsLpos", 1, profileFile));
    putValue(env_FSG_GetNextListPos_nextPos,getProfileInt("BAP TEL", "env_FSG_GetNextListPos_nextPos", 1, profileFile));
    putValue(env_FSG_GetNextListPos_Offset,getProfileInt("BAP TEL", "env_FSG_GetNextListPos_Offset", 1, profileFile));
    putValue(env_FSG_GetNextListPos_current,getProfileInt("BAP TEL", "env_FSG_GetNextListPos_current", 1, profileFile));
    putValue(env_FSG_GetNextListPos_Result,getProfileInt("BAP TEL", "env_FSG_GetNextListPos_Result", 1, profileFile));
    putValue(env_FSG_GetNextListPos_ListType,getProfileInt("BAP TEL", "env_FSG_GetNextListPos_ListType", 1, profileFile));
    putValue(env_FSG_AutoRedialExtInfo_Ctgry,getProfileInt("BAP TEL", "env_FSG_AutoRedialExtInfo_Ctgry", 1, profileFile));
    putValue(env_FSG_AutoRedialExtInfo_Tstamp,getProfileInt("BAP TEL", "env_FSG_AutoRedialExtInfo_Tstamp", 1, profileFile));
    putValue(env_FSG_DialService_Result,getProfileInt("BAP TEL", "env_FSG_DialService_Result", 1, profileFile));
    putValue(env_FSG_DialService_Type,getProfileInt("BAP TEL", "env_FSG_DialService_Type", 1, profileFile));
    putValue(env_FSG_ConfirmECall_Control,getProfileInt("BAP TEL", "env_FSG_ConfirmECall_Control", 1, profileFile));
    putValue(env_FSG_ConfirmECall_Result,getProfileInt("BAP TEL", "env_FSG_ConfirmECall_Result", 1, profileFile));
    putValue(env_FSG_MPRAllCAWC_Result,getProfileInt("BAP TEL", "env_FSG_MPRAllCAWC_Result", 1, profileFile));
    putValue(env_FSG_CCJoin_Result,getProfileInt("BAP TEL", "env_FSG_CCJoin_Result", 1, profileFile));
    putValue(env_FSG_MPSWCOH_Result,getProfileInt("BAP TEL", "env_FSG_MPSWCOH_Result", 1, profileFile));
    putValue(env_FSG_MPCHAWC_Result,getProfileInt("BAP TEL", "env_FSG_MPCHAWC_Result", 1, profileFile));
    putValue(env_FSG_MPSwap_Result,getProfileInt("BAP TEL", "env_FSG_MPSwap_Result", 1, profileFile));
    putValue(env_FSG_MPRACAWC_Result,getProfileInt("BAP TEL", "env_FSG_MPRACAWC_Result", 1, profileFile));
    putValue(env_FSG_HangupCall_CallID_M,getProfileInt("BAP TEL", "env_FSG_HangupCall_CallID_M", 1, profileFile));
    putValue(env_FSG_DialNumber_Result,getProfileInt("BAP TEL", "env_FSG_DialNumber_Result", 1, profileFile));
    putValue(env_FSG_HangUpCall_Result,getProfileInt("BAP TEL", "env_FSG_HangUpCall_Result", 1, profileFile));
    putValue(env_FSG_CallResume_Result,getProfileInt("BAP TEL", "env_FSG_CallResume_Result", 1, profileFile));
    putValue(env_FSG_CallHold_Result,getProfileInt("BAP TEL", "env_FSG_CallHold_Result", 1, profileFile));
    putValue(env_FSG_AcceptCall_Result,getProfileInt("BAP TEL", "env_FSG_AcceptCall_Result", 1, profileFile));
    putValue(env_BAPCFG_FSG_Tel_LsgClssMnr,getProfileInt("BAP TEL", "env_BAPCFG_FSG_Tel_LsgClssMnr", 1, profileFile));
    putValue(env_BAPCFG_FSG_Tel_DFMinor,getProfileInt("BAP TEL", "env_BAPCFG_FSG_Tel_DFMinor", 1, profileFile));
    putValue(env_BAPCFG_FSG_Tel_DFMajor,getProfileInt("BAP TEL", "env_BAPCFG_FSG_Tel_DFMajor", 1, profileFile));
    putValue(env_BAPCFG_FSG_Tel_LsgClssMjr,getProfileInt("BAP TEL", "env_BAPCFG_FSG_Tel_LsgClssMjr", 1, profileFile));
    putValue(env_BAPCFG_FSG_Tel_PrtclMnr,getProfileInt("BAP TEL", "env_BAPCFG_FSG_Tel_PrtclMnr", 1, profileFile));
    putValue(env_BAPCFG_FSG_Tel_PrtclMjr,getProfileInt("BAP TEL", "env_BAPCFG_FSG_Tel_PrtclMjr", 1, profileFile));
    putValue(env_Phone_Phonebook_list_short,getProfileInt("BAP TEL", "env_Phone_Phonebook_list_short", 1, profileFile));
    putValue(env_Phone_Phonebook_list_long,getProfileInt("BAP TEL", "env_Phone_Phonebook_list_long", 1, profileFile));
    putValue(env_Phone_CombNum_list_long,getProfileInt("BAP TEL", "env_Phone_CombNum_list_long", 1, profileFile));
    putValue(env_Phone_CombNum_list_short,getProfileInt("BAP TEL", "env_Phone_CombNum_list_short", 1, profileFile));
    putValue(env_FSG_Telephone_MSS_0x3F,getProfileInt("BAP TEL", "env_FSG_Telephone_MSS_0x3F", 1, profileFile));
    putValue(env_FSG_Telephone_MSS_0x3E,getProfileInt("BAP TEL", "env_FSG_Telephone_MSS_0x3E", 1, profileFile));
    putValue(env_FSG_Telephone_MSS_0x3D,getProfileInt("BAP TEL", "env_FSG_Telephone_MSS_0x3D", 1, profileFile));
    putValue(env_FSG_Telephone_MSS_0x3C,getProfileInt("BAP TEL", "env_FSG_Telephone_MSS_0x3C", 1, profileFile));
    putValue(env_FSG_Telephone_MSS_0x3B,getProfileInt("BAP TEL", "env_FSG_Telephone_MSS_0x3B", 1, profileFile));
    putValue(env_FSG_Telephone_MSS_0x3A,getProfileInt("BAP TEL", "env_FSG_Telephone_MSS_0x3A", 1, profileFile));
    putValue(env_FSG_Telephone_MSS_0x39,getProfileInt("BAP TEL", "env_FSG_Telephone_MSS_0x39", 1, profileFile));
    putValue(env_FSG_Telephone_MSS_0x38,getProfileInt("BAP TEL", "env_FSG_Telephone_MSS_0x38", 1, profileFile));
    putValue(env_FSG_AutomaticRedial_Active,getProfileInt("BAP TEL", "env_FSG_AutomaticRedial_Active", 1, profileFile));
    putValue(env_FSG_Panel_Methods,getProfileInt("BAP TEL", "env_FSG_Panel_Methods", 1, profileFile));
    putValue(env_FSG_Panel_Properties1,getProfileInt("BAP TEL", "env_FSG_Panel_Properties1", 1, profileFile));
    putValue(env_FSG_Panel_CombNum_Array,getProfileInt("BAP TEL", "env_FSG_Panel_CombNum_Array", 1, profileFile));
    putValue(env_FSG_Panel_Properties2,getProfileInt("BAP TEL", "env_FSG_Panel_Properties2", 1, profileFile));
    putValue(env_FSG_Panel_ServiceSupport,getProfileInt("BAP TEL", "env_FSG_Panel_ServiceSupport", 1, profileFile));
    putValue(env_FSG_Panel_LoadUtf8OutputPanels,getProfileInt("BAP TEL", "env_FSG_Panel_LoadUtf8OutputPanels", 1, profileFile));
    putValue(env_FSG_Panel_MissedCalls_Array,getProfileInt("BAP TEL", "env_FSG_Panel_MissedCalls_Array", 1, profileFile));
    putValue(env_FSG_Panel_SendData,getProfileInt("BAP TEL", "env_FSG_Panel_SendData", 1, profileFile));
    putValue(env_FSG_Panel_MissedCalls,getProfileInt("BAP TEL", "env_FSG_Panel_MissedCalls", 1, profileFile));
    putValue(env_FSG_Panel_DialedNumbers,getProfileInt("BAP TEL", "env_FSG_Panel_DialedNumbers", 1, profileFile));
    putValue(env_FSG_Panel_RecCalls_Array,getProfileInt("BAP TEL", "env_FSG_Panel_RecCalls_Array", 1, profileFile));
    putValue(env_FSG_Panel_CombinedNumbers,getProfileInt("BAP TEL", "env_FSG_Panel_CombinedNumbers", 1, profileFile));
    putValue(env_FSG_Panel_Phonebook_Array,getProfileInt("BAP TEL", "env_FSG_Panel_Phonebook_Array", 1, profileFile));
    putValue(env_FSG_Panel_Phonebook,getProfileInt("BAP TEL", "env_FSG_Panel_Phonebook", 1, profileFile));
    putValue(env_FSG_Panel_RemoteSide,getProfileInt("BAP TEL", "env_FSG_Panel_RemoteSide", 1, profileFile));
    putValue(env_FSG_Schalter_OnOff,getProfileInt("BAP TEL", "env_FSG_Schalter_OnOff", 1, profileFile));
    putValue(env_FSG_ConfirmCall_Cancel,getProfileInt("BAP TEL", "env_FSG_ConfirmCall_Cancel", 1, profileFile));
    putValue(env_FSG_ConfirmCall_Confirm,getProfileInt("BAP TEL", "env_FSG_ConfirmCall_Confirm", 1, profileFile));
    putValue(env_FSG_DialService_Enabled,getProfileInt("BAP TEL", "env_FSG_DialService_Enabled", 1, profileFile));
    putValue(env_FSG_DN_TotalNumLE,getProfileInt("BAP TEL", "env_FSG_DN_TotalNumLE", 1, profileFile));
    putValue(env_FSG_DN_TAID,getProfileInt("BAP TEL", "env_FSG_DN_TAID", 1, profileFile));
    putValue(env_FSG_DN_StatusArray,getProfileInt("BAP TEL", "env_FSG_DN_StatusArray", 1, profileFile));
    putValue(env_FSG_DN_SetGetArray_behaviour,getProfileInt("BAP TEL", "env_FSG_DN_SetGetArray_behaviour", 1, profileFile));
    putValue(env_FSG_DN_reload,getProfileInt("BAP TEL", "env_FSG_DN_reload", 1, profileFile));
    putValue(env_FSG_DN_DataSource,getProfileInt("BAP TEL", "env_FSG_DN_DataSource", 1, profileFile));
    putValue(env_FSG_DN_CA_switch,getProfileInt("BAP TEL", "env_FSG_DN_CA_switch", 1, profileFile));
    putValue(env_FSG_DN_CA,getProfileInt("BAP TEL", "env_FSG_DN_CA", 1, profileFile));
    putValue(env_FSG_DN_ASGID,getProfileInt("BAP TEL", "env_FSG_DN_ASGID", 1, profileFile));
    putValue(env_FSG_DN_AH_start,getProfileInt("BAP TEL", "env_FSG_DN_AH_start", 1, profileFile));
    putValue(env_FSG_DN_AH_shift,getProfileInt("BAP TEL", "env_FSG_DN_AH_shift", 1, profileFile));
    putValue(env_FSG_DN_AH_RA,getProfileInt("BAP TEL", "env_FSG_DN_AH_RA", 1, profileFile));
    putValue(env_FSG_DN_AH_POS,getProfileInt("BAP TEL", "env_FSG_DN_AH_POS", 1, profileFile));
    putValue(env_FSG_DN_AH_IS,getProfileInt("BAP TEL", "env_FSG_DN_AH_IS", 1, profileFile));
    putValue(env_FSG_DN_AH_elements,getProfileInt("BAP TEL", "env_FSG_DN_AH_elements", 1, profileFile));
    putValue(env_FSG_DN_AH_dir,getProfileInt("BAP TEL", "env_FSG_DN_AH_dir", 1, profileFile));
    putValue(env_FSG_RC_TotalNumLE,getProfileInt("BAP TEL", "env_FSG_RC_TotalNumLE", 1, profileFile));
    putValue(env_FSG_RC_TAID,getProfileInt("BAP TEL", "env_FSG_RC_TAID", 1, profileFile));
    putValue(env_FSG_RC_StatusArray,getProfileInt("BAP TEL", "env_FSG_RC_StatusArray", 1, profileFile));
    putValue(env_FSG_RC_SetGetArray_behaviour,getProfileInt("BAP TEL", "env_FSG_RC_SetGetArray_behaviour", 1, profileFile));
    putValue(env_FSG_RC_reload,getProfileInt("BAP TEL", "env_FSG_RC_reload", 1, profileFile));
    putValue(env_FSG_RC_CA_switch,getProfileInt("BAP TEL", "env_FSG_RC_CA_switch", 1, profileFile));
    putValue(env_FSG_RC_DataSource,getProfileInt("BAP TEL", "env_FSG_RC_DataSource", 1, profileFile));
    putValue(env_FSG_RC_CA,getProfileInt("BAP TEL", "env_FSG_RC_CA", 1, profileFile));
    putValue(env_FSG_RC_ASGID,getProfileInt("BAP TEL", "env_FSG_RC_ASGID", 1, profileFile));
    putValue(env_FSG_RC_AH_start,getProfileInt("BAP TEL", "env_FSG_RC_AH_start", 1, profileFile));
    putValue(env_FSG_RC_AH_shift,getProfileInt("BAP TEL", "env_FSG_RC_AH_shift", 1, profileFile));
    putValue(env_FSG_RC_AH_RA,getProfileInt("BAP TEL", "env_FSG_RC_AH_RA", 1, profileFile));
    putValue(env_FSG_RC_AH_POS,getProfileInt("BAP TEL", "env_FSG_RC_AH_POS", 1, profileFile));
    putValue(env_FSG_RC_AH_IS,getProfileInt("BAP TEL", "env_FSG_RC_AH_IS", 1, profileFile));
    putValue(env_FSG_RC_AH_elements,getProfileInt("BAP TEL", "env_FSG_RC_AH_elements", 1, profileFile));
    putValue(env_FSG_RC_AH_dir,getProfileInt("BAP TEL", "env_FSG_RC_AH_dir", 1, profileFile));
    putValue(env_FSG_CN_SetGetArray_behaviour,getProfileInt("BAP TEL", "env_FSG_CN_SetGetArray_behaviour", 1, profileFile));
    putValue(env_FSG_CN_CA_switch,getProfileInt("BAP TEL", "env_FSG_CN_CA_switch", 1, profileFile));
    putValue(env_FSG_CN_reload,getProfileInt("BAP TEL", "env_FSG_CN_reload", 1, profileFile));
    putValue(env_FSG_CN_DataSource,getProfileInt("BAP TEL", "env_FSG_CN_DataSource", 1, profileFile));
    putValue(env_FSG_CN_StatusArray,getProfileInt("BAP TEL", "env_FSG_CN_StatusArray", 1, profileFile));
    putValue(env_FSG_CN_CA,getProfileInt("BAP TEL", "env_FSG_CN_CA", 1, profileFile));
    putValue(env_FSG_CN_AH_elements,getProfileInt("BAP TEL", "env_FSG_CN_AH_elements", 1, profileFile));
    putValue(env_FSG_CN_AH_start,getProfileInt("BAP TEL", "env_FSG_CN_AH_start", 1, profileFile));
    putValue(env_FSG_CN_AH_RA,getProfileInt("BAP TEL", "env_FSG_CN_AH_RA", 1, profileFile));
    putValue(env_FSG_CN_AH_IS,getProfileInt("BAP TEL", "env_FSG_CN_AH_IS", 1, profileFile));
    putValue(env_FSG_CN_AH_POS,getProfileInt("BAP TEL", "env_FSG_CN_AH_POS", 1, profileFile));
    putValue(env_FSG_CN_AH_dir,getProfileInt("BAP TEL", "env_FSG_CN_AH_dir", 1, profileFile));
    putValue(env_FSG_CN_AH_shift,getProfileInt("BAP TEL", "env_FSG_CN_AH_shift", 1, profileFile));
    putValue(env_FSG_CN_TotalNumLE,getProfileInt("BAP TEL", "env_FSG_CN_TotalNumLE", 1, profileFile));
    putValue(env_FSG_CN_TAID,getProfileInt("BAP TEL", "env_FSG_CN_TAID", 1, profileFile));
    putValue(env_FSG_CN_ASGID,getProfileInt("BAP TEL", "env_FSG_CN_ASGID", 1, profileFile));
    putValue(env_FSG_RingToneMuteOnOff,getProfileInt("BAP TEL", "env_FSG_RingToneMuteOnOff", 1, profileFile));
    putValue(env_FSG_CallInfo_update,getProfileInt("BAP TEL", "env_FSG_CallInfo_update", 1, profileFile));
    putValue(env_FSG_open_send_data_panel,getProfileInt("BAP TEL", "env_FSG_open_send_data_panel", 1, profileFile));
    putValue(env_FSG_CallType_CallID_6_set,getProfileInt("BAP TEL", "env_FSG_CallType_CallID_6_set", 1, profileFile));
    putValue(env_FSG_CallType_CallID_5_set,getProfileInt("BAP TEL", "env_FSG_CallType_CallID_5_set", 1, profileFile));
    putValue(env_FSG_CallType_CallID_4_set,getProfileInt("BAP TEL", "env_FSG_CallType_CallID_4_set", 1, profileFile));
    putValue(env_FSG_CallType_CallID_3_set,getProfileInt("BAP TEL", "env_FSG_CallType_CallID_3_set", 1, profileFile));
    putValue(env_FSG_CallType_CallID_2_set,getProfileInt("BAP TEL", "env_FSG_CallType_CallID_2_set", 1, profileFile));
    putValue(env_FSG_CallType_CallID_1_set,getProfileInt("BAP TEL", "env_FSG_CallType_CallID_1_set", 1, profileFile));
    putValue(env_FSG_CallType_CallID_0_set,getProfileInt("BAP TEL", "env_FSG_CallType_CallID_0_set", 1, profileFile));
    putValue(env_FSG_CallState_CallID_6_set,getProfileInt("BAP TEL", "env_FSG_CallState_CallID_6_set", 1, profileFile));
    putValue(env_FSG_CallState_CallID_5_set,getProfileInt("BAP TEL", "env_FSG_CallState_CallID_5_set", 1, profileFile));
    putValue(env_FSG_CallState_CallID_4_set,getProfileInt("BAP TEL", "env_FSG_CallState_CallID_4_set", 1, profileFile));
    putValue(env_FSG_CallState_CallID_3_set,getProfileInt("BAP TEL", "env_FSG_CallState_CallID_3_set", 1, profileFile));
    putValue(env_FSG_CallState_CallID_2_set,getProfileInt("BAP TEL", "env_FSG_CallState_CallID_2_set", 1, profileFile));
    putValue(env_FSG_CallState_CallID_1_set,getProfileInt("BAP TEL", "env_FSG_CallState_CallID_1_set", 1, profileFile));
    putValue(env_FSG_CallState_CallID_0_set,getProfileInt("BAP TEL", "env_FSG_CallState_CallID_0_set", 1, profileFile));
    putValue(env_FSG_CallState_update,getProfileInt("BAP TEL", "env_FSG_CallState_update", 1, profileFile));
    putValue(env_FSG_Phonebook19_TelNumberQuantity,getProfileInt("BAP TEL", "env_FSG_Phonebook19_TelNumberQua", 1, profileFile));
    putValue(env_FSG_Phonebook19_AddressInd,getProfileInt("BAP TEL", "env_FSG_Phonebook19_AddressInd", 1, profileFile));
    putValue(env_FSG_Phonebook19_VoiceTag1,getProfileInt("BAP TEL", "env_FSG_Phonebook19_VoiceTag1", 1, profileFile));
    putValue(env_FSG_Phonebook19_AnyVoiceTag,getProfileInt("BAP TEL", "env_FSG_Phonebook19_AnyVoiceTag", 1, profileFile));
    putValue(env_FSG_Phonebook19_Storage,getProfileInt("BAP TEL", "env_FSG_Phonebook19_Storage", 1, profileFile));
    putValue(env_FSG_Phonebook19_Pos,getProfileInt("BAP TEL", "env_FSG_Phonebook19_Pos", 1, profileFile));
    putValue(env_FSG_Phonebook18_TelNumberQuantity,getProfileInt("BAP TEL", "env_FSG_Phonebook18_TelNumberQua", 1, profileFile));
    putValue(env_FSG_Phonebook18_AddressInd,getProfileInt("BAP TEL", "env_FSG_Phonebook18_AddressInd", 1, profileFile));
    putValue(env_FSG_Phonebook18_VoiceTag1,getProfileInt("BAP TEL", "env_FSG_Phonebook18_VoiceTag1", 1, profileFile));
    putValue(env_FSG_Phonebook18_AnyVoiceTag,getProfileInt("BAP TEL", "env_FSG_Phonebook18_AnyVoiceTag", 1, profileFile));
    putValue(env_FSG_Phonebook18_Storage,getProfileInt("BAP TEL", "env_FSG_Phonebook18_Storage", 1, profileFile));
    putValue(env_FSG_Phonebook18_Pos,getProfileInt("BAP TEL", "env_FSG_Phonebook18_Pos", 1, profileFile));
    putValue(env_FSG_Phonebook17_TelNumberQuantity,getProfileInt("BAP TEL", "env_FSG_Phonebook17_TelNumberQua", 1, profileFile));
    putValue(env_FSG_Phonebook17_AddressInd,getProfileInt("BAP TEL", "env_FSG_Phonebook17_AddressInd", 1, profileFile));
    putValue(env_FSG_Phonebook17_VoiceTag1,getProfileInt("BAP TEL", "env_FSG_Phonebook17_VoiceTag1", 1, profileFile));
    putValue(env_FSG_Phonebook17_AnyVoiceTag,getProfileInt("BAP TEL", "env_FSG_Phonebook17_AnyVoiceTag", 1, profileFile));
    putValue(env_FSG_Phonebook17_Storage,getProfileInt("BAP TEL", "env_FSG_Phonebook17_Storage", 1, profileFile));
    putValue(env_FSG_Phonebook17_Pos,getProfileInt("BAP TEL", "env_FSG_Phonebook17_Pos", 1, profileFile));
    putValue(env_FSG_Phonebook16_TelNumberQuantity,getProfileInt("BAP TEL", "env_FSG_Phonebook16_TelNumberQua", 1, profileFile));
    putValue(env_FSG_Phonebook16_AddressInd,getProfileInt("BAP TEL", "env_FSG_Phonebook16_AddressInd", 1, profileFile));
    putValue(env_FSG_Phonebook16_VoiceTag1,getProfileInt("BAP TEL", "env_FSG_Phonebook16_VoiceTag1", 1, profileFile));
    putValue(env_FSG_Phonebook16_AnyVoiceTag,getProfileInt("BAP TEL", "env_FSG_Phonebook16_AnyVoiceTag", 1, profileFile));
    putValue(env_FSG_Phonebook16_Storage,getProfileInt("BAP TEL", "env_FSG_Phonebook16_Storage", 1, profileFile));
    putValue(env_FSG_Phonebook16_Pos,getProfileInt("BAP TEL", "env_FSG_Phonebook16_Pos", 1, profileFile));
    putValue(env_FSG_Phonebook15_TelNumberQuantity,getProfileInt("BAP TEL", "env_FSG_Phonebook15_TelNumberQua", 1, profileFile));
    putValue(env_FSG_Phonebook15_AddressInd,getProfileInt("BAP TEL", "env_FSG_Phonebook15_AddressInd", 1, profileFile));
    putValue(env_FSG_Phonebook15_VoiceTag1,getProfileInt("BAP TEL", "env_FSG_Phonebook15_VoiceTag1", 1, profileFile));
    putValue(env_FSG_Phonebook15_AnyVoiceTag,getProfileInt("BAP TEL", "env_FSG_Phonebook15_AnyVoiceTag", 1, profileFile));
    putValue(env_FSG_Phonebook15_Storage,getProfileInt("BAP TEL", "env_FSG_Phonebook15_Storage", 1, profileFile));
    putValue(env_FSG_Phonebook15_Pos,getProfileInt("BAP TEL", "env_FSG_Phonebook15_Pos", 1, profileFile));
    putValue(env_FSG_Phonebook14_TelNumberQuantity,getProfileInt("BAP TEL", "env_FSG_Phonebook14_TelNumberQua", 1, profileFile));
    putValue(env_FSG_Phonebook14_AddressInd,getProfileInt("BAP TEL", "env_FSG_Phonebook14_AddressInd", 1, profileFile));
    putValue(env_FSG_Phonebook14_VoiceTag1,getProfileInt("BAP TEL", "env_FSG_Phonebook14_VoiceTag1", 1, profileFile));
    putValue(env_FSG_Phonebook14_AnyVoiceTag,getProfileInt("BAP TEL", "env_FSG_Phonebook14_AnyVoiceTag", 1, profileFile));
    putValue(env_FSG_Phonebook14_Storage,getProfileInt("BAP TEL", "env_FSG_Phonebook14_Storage", 1, profileFile));
    putValue(env_FSG_Phonebook14_Pos,getProfileInt("BAP TEL", "env_FSG_Phonebook14_Pos", 1, profileFile));
    putValue(env_FSG_Phonebook13_TelNumberQuantity,getProfileInt("BAP TEL", "env_FSG_Phonebook13_TelNumberQua", 1, profileFile));
    putValue(env_FSG_Phonebook13_AddressInd,getProfileInt("BAP TEL", "env_FSG_Phonebook13_AddressInd", 1, profileFile));
    putValue(env_FSG_Phonebook13_VoiceTag1,getProfileInt("BAP TEL", "env_FSG_Phonebook13_VoiceTag1", 1, profileFile));
    putValue(env_FSG_Phonebook13_AnyVoiceTag,getProfileInt("BAP TEL", "env_FSG_Phonebook13_AnyVoiceTag", 1, profileFile));
    putValue(env_FSG_Phonebook13_Storage,getProfileInt("BAP TEL", "env_FSG_Phonebook13_Storage", 1, profileFile));
    putValue(env_FSG_Phonebook13_Pos,getProfileInt("BAP TEL", "env_FSG_Phonebook13_Pos", 1, profileFile));
    putValue(env_FSG_Phonebook12_TelNumberQuantity,getProfileInt("BAP TEL", "env_FSG_Phonebook12_TelNumberQua", 1, profileFile));
    putValue(env_FSG_Phonebook12_AddressInd,getProfileInt("BAP TEL", "env_FSG_Phonebook12_AddressInd", 1, profileFile));
    putValue(env_FSG_Phonebook12_VoiceTag1,getProfileInt("BAP TEL", "env_FSG_Phonebook12_VoiceTag1", 1, profileFile));
    putValue(env_FSG_Phonebook12_AnyVoiceTag,getProfileInt("BAP TEL", "env_FSG_Phonebook12_AnyVoiceTag", 1, profileFile));
    putValue(env_FSG_Phonebook12_Storage,getProfileInt("BAP TEL", "env_FSG_Phonebook12_Storage", 1, profileFile));
    putValue(env_FSG_Phonebook12_Pos,getProfileInt("BAP TEL", "env_FSG_Phonebook12_Pos", 1, profileFile));
    putValue(env_FSG_Phonebook11_TelNumberQuantity,getProfileInt("BAP TEL", "env_FSG_Phonebook11_TelNumberQua", 1, profileFile));
    putValue(env_FSG_Phonebook11_AddressInd,getProfileInt("BAP TEL", "env_FSG_Phonebook11_AddressInd", 1, profileFile));
    putValue(env_FSG_Phonebook11_VoiceTag1,getProfileInt("BAP TEL", "env_FSG_Phonebook11_VoiceTag1", 1, profileFile));
    putValue(env_FSG_Phonebook11_AnyVoiceTag,getProfileInt("BAP TEL", "env_FSG_Phonebook11_AnyVoiceTag", 1, profileFile));
    putValue(env_FSG_Phonebook11_Storage,getProfileInt("BAP TEL", "env_FSG_Phonebook11_Storage", 1, profileFile));
    putValue(env_FSG_Phonebook11_Pos,getProfileInt("BAP TEL", "env_FSG_Phonebook11_Pos", 1, profileFile));
    putValue(env_FSG_Phonebook10_TelNumberQuantity,getProfileInt("BAP TEL", "env_FSG_Phonebook10_TelNumberQua", 1, profileFile));
    putValue(env_FSG_Phonebook10_AddressInd,getProfileInt("BAP TEL", "env_FSG_Phonebook10_AddressInd", 1, profileFile));
    putValue(env_FSG_Phonebook10_VoiceTag1,getProfileInt("BAP TEL", "env_FSG_Phonebook10_VoiceTag1", 1, profileFile));
    putValue(env_FSG_Phonebook10_AnyVoiceTag,getProfileInt("BAP TEL", "env_FSG_Phonebook10_AnyVoiceTag", 1, profileFile));
    putValue(env_FSG_Phonebook10_Storage,getProfileInt("BAP TEL", "env_FSG_Phonebook10_Storage", 1, profileFile));
    putValue(env_FSG_Phonebook10_Pos,getProfileInt("BAP TEL", "env_FSG_Phonebook10_Pos", 1, profileFile));
    putValue(env_FSG_Phonebook9_TelNumberQuantity,getProfileInt("BAP TEL", "env_FSG_Phonebook9_TelNumberQua", 1, profileFile));
    putValue(env_FSG_Phonebook9_AddressInd,getProfileInt("BAP TEL", "env_FSG_Phonebook9_AddressInd", 1, profileFile));
    putValue(env_FSG_Phonebook9_VoiceTag1,getProfileInt("BAP TEL", "env_FSG_Phonebook9_VoiceTag1", 1, profileFile));
    putValue(env_FSG_Phonebook9_AnyVoiceTag,getProfileInt("BAP TEL", "env_FSG_Phonebook9_AnyVoiceTag", 1, profileFile));
    putValue(env_FSG_Phonebook9_Storage,getProfileInt("BAP TEL", "env_FSG_Phonebook9_Storage", 1, profileFile));
    putValue(env_FSG_Phonebook9_Pos,getProfileInt("BAP TEL", "env_FSG_Phonebook9_Pos", 1, profileFile));
    putValue(env_FSG_Phonebook8_TelNumberQuantity,getProfileInt("BAP TEL", "env_FSG_Phonebook8_TelNumberQuan", 1, profileFile));
    putValue(env_FSG_Phonebook8_AddressInd,getProfileInt("BAP TEL", "env_FSG_Phonebook8_AddressInd", 1, profileFile));
    putValue(env_FSG_Phonebook8_VoiceTag1,getProfileInt("BAP TEL", "env_FSG_Phonebook8_VoiceTag1", 1, profileFile));
    putValue(env_FSG_Phonebook8_AnyVoiceTag,getProfileInt("BAP TEL", "env_FSG_Phonebook8_AnyVoiceTag", 1, profileFile));
    putValue(env_FSG_Phonebook8_Storage,getProfileInt("BAP TEL", "env_FSG_Phonebook8_Storage", 1, profileFile));
    putValue(env_FSG_Phonebook8_Pos,getProfileInt("BAP TEL", "env_FSG_Phonebook8_Pos", 1, profileFile));
    putValue(env_FSG_Phonebook7_TelNumberQuantity,getProfileInt("BAP TEL", "env_FSG_Phonebook7_TelNumberQuan", 1, profileFile));
    putValue(env_FSG_Phonebook7_AddressInd,getProfileInt("BAP TEL", "env_FSG_Phonebook7_AddressInd", 1, profileFile));
    putValue(env_FSG_Phonebook7_VoiceTag1,getProfileInt("BAP TEL", "env_FSG_Phonebook7_VoiceTag1", 1, profileFile));
    putValue(env_FSG_Phonebook7_AnyVoiceTag,getProfileInt("BAP TEL", "env_FSG_Phonebook7_AnyVoiceTag", 1, profileFile));
    putValue(env_FSG_Phonebook7_Storage,getProfileInt("BAP TEL", "env_FSG_Phonebook7_Storage", 1, profileFile));
    putValue(env_FSG_Phonebook7_Pos,getProfileInt("BAP TEL", "env_FSG_Phonebook7_Pos", 1, profileFile));
    putValue(env_FSG_Phonebook6_TelNumberQuantity,getProfileInt("BAP TEL", "env_FSG_Phonebook6_TelNumberQuan", 1, profileFile));
    putValue(env_FSG_Phonebook6_AddressInd,getProfileInt("BAP TEL", "env_FSG_Phonebook6_AddressInd", 1, profileFile));
    putValue(env_FSG_Phonebook6_VoiceTag1,getProfileInt("BAP TEL", "env_FSG_Phonebook6_VoiceTag1", 1, profileFile));
    putValue(env_FSG_Phonebook6_AnyVoiceTag,getProfileInt("BAP TEL", "env_FSG_Phonebook6_AnyVoiceTag", 1, profileFile));
    putValue(env_FSG_Phonebook6_Storage,getProfileInt("BAP TEL", "env_FSG_Phonebook6_Storage", 1, profileFile));
    putValue(env_FSG_Phonebook6_Pos,getProfileInt("BAP TEL", "env_FSG_Phonebook6_Pos", 1, profileFile));
    putValue(env_FSG_Phonebook5_TelNumberQuantity,getProfileInt("BAP TEL", "env_FSG_Phonebook5_TelNumberQuan", 1, profileFile));
    putValue(env_FSG_Phonebook5_AddressInd,getProfileInt("BAP TEL", "env_FSG_Phonebook5_AddressInd", 1, profileFile));
    putValue(env_FSG_Phonebook5_VoiceTag1,getProfileInt("BAP TEL", "env_FSG_Phonebook5_VoiceTag1", 1, profileFile));
    putValue(env_FSG_Phonebook5_AnyVoiceTag,getProfileInt("BAP TEL", "env_FSG_Phonebook5_AnyVoiceTag", 1, profileFile));
    putValue(env_FSG_Phonebook5_Storage,getProfileInt("BAP TEL", "env_FSG_Phonebook5_Storage", 1, profileFile));
    putValue(env_FSG_Phonebook5_Pos,getProfileInt("BAP TEL", "env_FSG_Phonebook5_Pos", 1, profileFile));
    putValue(env_FSG_Phonebook4_TelNumberQuantity,getProfileInt("BAP TEL", "env_FSG_Phonebook4_TelNumberQuan", 1, profileFile));
    putValue(env_FSG_Phonebook4_AddressInd,getProfileInt("BAP TEL", "env_FSG_Phonebook4_AddressInd", 1, profileFile));
    putValue(env_FSG_Phonebook4_VoiceTag1,getProfileInt("BAP TEL", "env_FSG_Phonebook4_VoiceTag1", 1, profileFile));
    putValue(env_FSG_Phonebook4_AnyVoiceTag,getProfileInt("BAP TEL", "env_FSG_Phonebook4_AnyVoiceTag", 1, profileFile));
    putValue(env_FSG_Phonebook4_Storage,getProfileInt("BAP TEL", "env_FSG_Phonebook4_Storage", 1, profileFile));
    putValue(env_FSG_Phonebook4_Pos,getProfileInt("BAP TEL", "env_FSG_Phonebook4_Pos", 1, profileFile));
    putValue(env_FSG_Phonebook3_TelNumberQuantity,getProfileInt("BAP TEL", "env_FSG_Phonebook3_TelNumberQuan", 1, profileFile));
    putValue(env_FSG_Phonebook3_AddressInd,getProfileInt("BAP TEL", "env_FSG_Phonebook3_AddressInd", 1, profileFile));
    putValue(env_FSG_Phonebook3_VoiceTag1,getProfileInt("BAP TEL", "env_FSG_Phonebook3_VoiceTag1", 1, profileFile));
    putValue(env_FSG_Phonebook3_AnyVoiceTag,getProfileInt("BAP TEL", "env_FSG_Phonebook3_AnyVoiceTag", 1, profileFile));
    putValue(env_FSG_Phonebook3_Storage,getProfileInt("BAP TEL", "env_FSG_Phonebook3_Storage", 1, profileFile));
    putValue(env_FSG_Phonebook3_Pos,getProfileInt("BAP TEL", "env_FSG_Phonebook3_Pos", 1, profileFile));
    putValue(env_FSG_Phonebook2_TelNumberQuantity,getProfileInt("BAP TEL", "env_FSG_Phonebook2_TelNumberQuan", 1, profileFile));
    putValue(env_FSG_Phonebook2_AddressInd,getProfileInt("BAP TEL", "env_FSG_Phonebook2_AddressInd", 1, profileFile));
    putValue(env_FSG_Phonebook2_VoiceTag1,getProfileInt("BAP TEL", "env_FSG_Phonebook2_VoiceTag1", 1, profileFile));
    putValue(env_FSG_Phonebook2_AnyVoiceTag,getProfileInt("BAP TEL", "env_FSG_Phonebook2_AnyVoiceTag", 1, profileFile));
    putValue(env_FSG_Phonebook2_Storage,getProfileInt("BAP TEL", "env_FSG_Phonebook2_Storage", 1, profileFile));
    putValue(env_FSG_Phonebook2_Pos,getProfileInt("BAP TEL", "env_FSG_Phonebook2_Pos", 1, profileFile));
    putValue(env_FSG_Phonebook1_TelNumberQuantity,getProfileInt("BAP TEL", "env_FSG_Phonebook1_TelNumberQuan", 1, profileFile));
    putValue(env_FSG_Phonebook1_AddressInd,getProfileInt("BAP TEL", "env_FSG_Phonebook1_AddressInd", 1, profileFile));
    putValue(env_FSG_Phonebook1_VoiceTag1,getProfileInt("BAP TEL", "env_FSG_Phonebook1_VoiceTag1", 1, profileFile));
    putValue(env_FSG_Phonebook1_AnyVoiceTag,getProfileInt("BAP TEL", "env_FSG_Phonebook1_AnyVoiceTag", 1, profileFile));
    putValue(env_FSG_Phonebook1_Storage,getProfileInt("BAP TEL", "env_FSG_Phonebook1_Storage", 1, profileFile));
    putValue(env_FSG_Phonebook1_Pos,getProfileInt("BAP TEL", "env_FSG_Phonebook1_Pos", 1, profileFile));
    putValue(env_FSG_Phonebook0_TelNumberQuantity,getProfileInt("BAP TEL", "env_FSG_Phonebook0_TelNumberQuan", 1, profileFile));
    putValue(env_FSG_Phonebook0_AddressInd,getProfileInt("BAP TEL", "env_FSG_Phonebook0_AddressInd", 1, profileFile));
    putValue(env_FSG_Phonebook0_VoiceTag1,getProfileInt("BAP TEL", "env_FSG_Phonebook0_VoiceTag1", 1, profileFile));
    putValue(env_FSG_Phonebook0_AnyVoiceTag,getProfileInt("BAP TEL", "env_FSG_Phonebook0_AnyVoiceTag", 1, profileFile));
    putValue(env_FSG_Phonebook0_Storage,getProfileInt("BAP TEL", "env_FSG_Phonebook0_Storage", 1, profileFile));
    putValue(env_FSG_Phonebook0_Pos,getProfileInt("BAP TEL", "env_FSG_Phonebook0_Pos", 1, profileFile));
    putValue(env_FSG_Phonebook_AutoOnOff,getProfileInt("BAP TEL", "env_FSG_Phonebook_AutoOnOff", 1, profileFile));
    putValue(env_FSG_Phonebook_reload,getProfileInt("BAP TEL", "env_FSG_Phonebook_reload", 1, profileFile));
    putValue(env_FSG_Phonebook_DataSource,getProfileInt("BAP TEL", "env_FSG_Phonebook_DataSource", 1, profileFile));
    putValue(env_FSG_Phonebook_StatusArray,getProfileInt("BAP TEL", "env_FSG_Phonebook_StatusArray", 1, profileFile));
    putValue(env_FSG_Phonebook_ChangedArray,getProfileInt("BAP TEL", "env_FSG_Phonebook_ChangedArray", 1, profileFile));
    putValue(env_FSG_Phonebook_AH_elements,getProfileInt("BAP TEL", "env_FSG_Phonebook_AH_elements", 1, profileFile));
    putValue(env_FSG_Phonebook_AH_start,getProfileInt("BAP TEL", "env_FSG_Phonebook_AH_start", 1, profileFile));
    putValue(env_FSG_Phonebook_AH_RA,getProfileInt("BAP TEL", "env_FSG_Phonebook_AH_RA", 1, profileFile));
    putValue(env_FSG_Phonebook_AH_IS,getProfileInt("BAP TEL", "env_FSG_Phonebook_AH_IS", 1, profileFile));
    putValue(env_FSG_Phonebook_AH_POS,getProfileInt("BAP TEL", "env_FSG_Phonebook_AH_POS", 1, profileFile));
    putValue(env_FSG_Phonebook_AH_dir,getProfileInt("BAP TEL", "env_FSG_Phonebook_AH_dir", 1, profileFile));
    putValue(env_FSG_Phonebook_AH_shift,getProfileInt("BAP TEL", "env_FSG_Phonebook_AH_shift", 1, profileFile));
    putValue(env_FSG_Phonebook_TotalNumLE,getProfileInt("BAP TEL", "env_FSG_Phonebook_TotalNumLE", 1, profileFile));
    putValue(env_FSG_Phonebook_TAID,getProfileInt("BAP TEL", "env_FSG_Phonebook_TAID", 1, profileFile));
    putValue(env_FSG_Phonebook_ASG_ID,getProfileInt("BAP TEL", "env_FSG_Phonebook_ASG_ID", 1, profileFile));
    putValue(env_FSG_missedcall19_Pos,getProfileInt("BAP TEL", "env_FSG_missedcall19_Pos", 1, profileFile));
    putValue(env_FSG_missedcall18_Pos,getProfileInt("BAP TEL", "env_FSG_missedcall18_Pos", 1, profileFile));
    putValue(env_FSG_missedcall17_Pos,getProfileInt("BAP TEL", "env_FSG_missedcall17_Pos", 1, profileFile));
    putValue(env_FSG_missedcall16_Pos,getProfileInt("BAP TEL", "env_FSG_missedcall16_Pos", 1, profileFile));
    putValue(env_FSG_missedcall15_Pos,getProfileInt("BAP TEL", "env_FSG_missedcall15_Pos", 1, profileFile));
    putValue(env_FSG_missedcall14_Pos,getProfileInt("BAP TEL", "env_FSG_missedcall14_Pos", 1, profileFile));
    putValue(env_FSG_missedcall13_Pos,getProfileInt("BAP TEL", "env_FSG_missedcall13_Pos", 1, profileFile));
    putValue(env_FSG_missedcall12_Pos,getProfileInt("BAP TEL", "env_FSG_missedcall12_Pos", 1, profileFile));
    putValue(env_FSG_missedcall11_Pos,getProfileInt("BAP TEL", "env_FSG_missedcall11_Pos", 1, profileFile));
    putValue(env_FSG_missedcall10_Pos,getProfileInt("BAP TEL", "env_FSG_missedcall10_Pos", 1, profileFile));
    putValue(env_FSG_missedcall9_Pos,getProfileInt("BAP TEL", "env_FSG_missedcall9_Pos", 1, profileFile));
    putValue(env_FSG_missedcall8_Pos,getProfileInt("BAP TEL", "env_FSG_missedcall8_Pos", 1, profileFile));
    putValue(env_FSG_missedcall7_Pos,getProfileInt("BAP TEL", "env_FSG_missedcall7_Pos", 1, profileFile));
    putValue(env_FSG_missedcall6_Pos,getProfileInt("BAP TEL", "env_FSG_missedcall6_Pos", 1, profileFile));
    putValue(env_FSG_missedcall5_Pos,getProfileInt("BAP TEL", "env_FSG_missedcall5_Pos", 1, profileFile));
    putValue(env_FSG_missedcall4_Pos,getProfileInt("BAP TEL", "env_FSG_missedcall4_Pos", 1, profileFile));
    putValue(env_FSG_missedcall3_Pos,getProfileInt("BAP TEL", "env_FSG_missedcall3_Pos", 1, profileFile));
    putValue(env_FSG_missedcall2_Pos,getProfileInt("BAP TEL", "env_FSG_missedcall2_Pos", 1, profileFile));
    putValue(env_FSG_missedcall1_Pos,getProfileInt("BAP TEL", "env_FSG_missedcall1_Pos", 1, profileFile));
    putValue(env_FSG_missedcall0_Pos,getProfileInt("BAP TEL", "env_FSG_missedcall0_Pos", 1, profileFile));
    putValue(env_FSG_CallState_CallInDivert_6,getProfileInt("BAP TEL", "env_FSG_CallState_CallInDivert_6", 1, profileFile));
    putValue(env_FSG_CallState_CallInDivert_5,getProfileInt("BAP TEL", "env_FSG_CallState_CallInDivert_5", 1, profileFile));
    putValue(env_FSG_CallState_CallInDivert_4,getProfileInt("BAP TEL", "env_FSG_CallState_CallInDivert_4", 1, profileFile));
    putValue(env_FSG_CallState_CallInDivert_3,getProfileInt("BAP TEL", "env_FSG_CallState_CallInDivert_3", 1, profileFile));
    putValue(env_FSG_CallState_CallInDivert_2,getProfileInt("BAP TEL", "env_FSG_CallState_CallInDivert_2", 1, profileFile));
    putValue(env_FSG_CallState_CallInDivert_1,getProfileInt("BAP TEL", "env_FSG_CallState_CallInDivert_1", 1, profileFile));
    putValue(env_FSG_CallState_CallInDivert_0,getProfileInt("BAP TEL", "env_FSG_CallState_CallInDivert_0", 1, profileFile));
    putValue(env_FSG_CallState_Opt_CCSplit_6,getProfileInt("BAP TEL", "env_FSG_CallState_Opt_CCSplit_6", 1, profileFile));
    putValue(env_FSG_CallState_Opt_CCSplit_5,getProfileInt("BAP TEL", "env_FSG_CallState_Opt_CCSplit_5", 1, profileFile));
    putValue(env_FSG_CallState_Opt_CCSplit_4,getProfileInt("BAP TEL", "env_FSG_CallState_Opt_CCSplit_4", 1, profileFile));
    putValue(env_FSG_CallState_Opt_CCSplit_3,getProfileInt("BAP TEL", "env_FSG_CallState_Opt_CCSplit_3", 1, profileFile));
    putValue(env_FSG_CallState_Opt_CCSplit_2,getProfileInt("BAP TEL", "env_FSG_CallState_Opt_CCSplit_2", 1, profileFile));
    putValue(env_FSG_CallState_Opt_CCSplit_1,getProfileInt("BAP TEL", "env_FSG_CallState_Opt_CCSplit_1", 1, profileFile));
    putValue(env_FSG_CallState_Opt_CCSplit_0,getProfileInt("BAP TEL", "env_FSG_CallState_Opt_CCSplit_0", 1, profileFile));
    putValue(env_FSG_CallState_Opt_CCJoin_6,getProfileInt("BAP TEL", "env_FSG_CallState_Opt_CCJoin_6", 1, profileFile));
    putValue(env_FSG_CallState_Opt_CCJoin_5,getProfileInt("BAP TEL", "env_FSG_CallState_Opt_CCJoin_5", 1, profileFile));
    putValue(env_FSG_CallState_Opt_CCJoin_4,getProfileInt("BAP TEL", "env_FSG_CallState_Opt_CCJoin_4", 1, profileFile));
    putValue(env_FSG_CallState_Opt_CCJoin_3,getProfileInt("BAP TEL", "env_FSG_CallState_Opt_CCJoin_3", 1, profileFile));
    putValue(env_FSG_CallState_Opt_CCJoin_2,getProfileInt("BAP TEL", "env_FSG_CallState_Opt_CCJoin_2", 1, profileFile));
    putValue(env_FSG_CallState_Opt_CCJoin_1,getProfileInt("BAP TEL", "env_FSG_CallState_Opt_CCJoin_1", 1, profileFile));
    putValue(env_FSG_CallState_Opt_CCJoin_0,getProfileInt("BAP TEL", "env_FSG_CallState_Opt_CCJoin_0", 1, profileFile));
    putValue(env_FSG_CallState_Opt_MPSwap_6,getProfileInt("BAP TEL", "env_FSG_CallState_Opt_MPSwap_6", 1, profileFile));
    putValue(env_FSG_CallState_Opt_MPSwap_5,getProfileInt("BAP TEL", "env_FSG_CallState_Opt_MPSwap_5", 1, profileFile));
    putValue(env_FSG_CallState_Opt_MPSwap_4,getProfileInt("BAP TEL", "env_FSG_CallState_Opt_MPSwap_4", 1, profileFile));
    putValue(env_FSG_CallState_Opt_MPSwap_3,getProfileInt("BAP TEL", "env_FSG_CallState_Opt_MPSwap_3", 1, profileFile));
    putValue(env_FSG_CallState_Opt_MPSwap_2,getProfileInt("BAP TEL", "env_FSG_CallState_Opt_MPSwap_2", 1, profileFile));
    putValue(env_FSG_CallState_Opt_MPSwap_1,getProfileInt("BAP TEL", "env_FSG_CallState_Opt_MPSwap_1", 1, profileFile));
    putValue(env_FSG_CallState_Opt_MPSwap_0,getProfileInt("BAP TEL", "env_FSG_CallState_Opt_MPSwap_0", 1, profileFile));
    putValue(env_FSG_CallState_Opt_ResCall_6,getProfileInt("BAP TEL", "env_FSG_CallState_Opt_ResCall_6", 1, profileFile));
    putValue(env_FSG_CallState_Opt_ResCall_5,getProfileInt("BAP TEL", "env_FSG_CallState_Opt_ResCall_5", 1, profileFile));
    putValue(env_FSG_CallState_Opt_ResCall_4,getProfileInt("BAP TEL", "env_FSG_CallState_Opt_ResCall_4", 1, profileFile));
    putValue(env_FSG_CallState_Opt_ResCall_3,getProfileInt("BAP TEL", "env_FSG_CallState_Opt_ResCall_3", 1, profileFile));
    putValue(env_FSG_CallState_Opt_ResCall_2,getProfileInt("BAP TEL", "env_FSG_CallState_Opt_ResCall_2", 1, profileFile));
    putValue(env_FSG_CallState_Opt_ResCall_1,getProfileInt("BAP TEL", "env_FSG_CallState_Opt_ResCall_1", 1, profileFile));
    putValue(env_FSG_CallState_Opt_ResCall_0,getProfileInt("BAP TEL", "env_FSG_CallState_Opt_ResCall_0", 1, profileFile));
    putValue(env_FSG_CallState_Opt_CallHold_6,getProfileInt("BAP TEL", "env_FSG_CallState_Opt_CallHold_6", 1, profileFile));
    putValue(env_FSG_CallState_Opt_CallHold_5,getProfileInt("BAP TEL", "env_FSG_CallState_Opt_CallHold_5", 1, profileFile));
    putValue(env_FSG_CallState_Opt_CallHold_4,getProfileInt("BAP TEL", "env_FSG_CallState_Opt_CallHold_4", 1, profileFile));
    putValue(env_FSG_CallState_Opt_CallHold_3,getProfileInt("BAP TEL", "env_FSG_CallState_Opt_CallHold_3", 1, profileFile));
    putValue(env_FSG_CallState_Opt_CallHold_2,getProfileInt("BAP TEL", "env_FSG_CallState_Opt_CallHold_2", 1, profileFile));
    putValue(env_FSG_CallState_Opt_CallHold_1,getProfileInt("BAP TEL", "env_FSG_CallState_Opt_CallHold_1", 1, profileFile));
    putValue(env_FSG_CallState_Opt_CallHold_0,getProfileInt("BAP TEL", "env_FSG_CallState_Opt_CallHold_0", 1, profileFile));
    putValue(env_FSG_CallState_Opt_CallAc_6,getProfileInt("BAP TEL", "env_FSG_CallState_Opt_CallAc_6", 1, profileFile));
    putValue(env_FSG_CallState_Opt_CallAc_5,getProfileInt("BAP TEL", "env_FSG_CallState_Opt_CallAc_5", 1, profileFile));
    putValue(env_FSG_CallState_Opt_CallAc_4,getProfileInt("BAP TEL", "env_FSG_CallState_Opt_CallAc_4", 1, profileFile));
    putValue(env_FSG_CallState_Opt_CallAc_3,getProfileInt("BAP TEL", "env_FSG_CallState_Opt_CallAc_3", 1, profileFile));
    putValue(env_FSG_CallState_Opt_CallAc_2,getProfileInt("BAP TEL", "env_FSG_CallState_Opt_CallAc_2", 1, profileFile));
    putValue(env_FSG_CallState_Opt_CallAc_1,getProfileInt("BAP TEL", "env_FSG_CallState_Opt_CallAc_1", 1, profileFile));
    putValue(env_FSG_CallState_Opt_CallAc_0,getProfileInt("BAP TEL", "env_FSG_CallState_Opt_CallAc_0", 1, profileFile));
    putValue(env_FSG_CallState_Opt_HoldAc_6,getProfileInt("BAP TEL", "env_FSG_CallState_Opt_HoldAc_6", 1, profileFile));
    putValue(env_FSG_CallState_Opt_HoldAc_5,getProfileInt("BAP TEL", "env_FSG_CallState_Opt_HoldAc_5", 1, profileFile));
    putValue(env_FSG_CallState_Opt_HoldAc_4,getProfileInt("BAP TEL", "env_FSG_CallState_Opt_HoldAc_4", 1, profileFile));
    putValue(env_FSG_CallState_Opt_HoldAc_3,getProfileInt("BAP TEL", "env_FSG_CallState_Opt_HoldAc_3", 1, profileFile));
    putValue(env_FSG_CallState_Opt_HoldAc_2,getProfileInt("BAP TEL", "env_FSG_CallState_Opt_HoldAc_2", 1, profileFile));
    putValue(env_FSG_CallState_Opt_HoldAc_1,getProfileInt("BAP TEL", "env_FSG_CallState_Opt_HoldAc_1", 1, profileFile));
    putValue(env_FSG_CallState_Opt_HoldAc_0,getProfileInt("BAP TEL", "env_FSG_CallState_Opt_HoldAc_0", 1, profileFile));
    putValue(env_FSG_CallState_Opt_AcCall_6,getProfileInt("BAP TEL", "env_FSG_CallState_Opt_AcCall_6", 1, profileFile));
    putValue(env_FSG_CallState_Opt_AcCall_5,getProfileInt("BAP TEL", "env_FSG_CallState_Opt_AcCall_5", 1, profileFile));
    putValue(env_FSG_CallState_Opt_AcCall_4,getProfileInt("BAP TEL", "env_FSG_CallState_Opt_AcCall_4", 1, profileFile));
    putValue(env_FSG_CallState_Opt_AcCall_3,getProfileInt("BAP TEL", "env_FSG_CallState_Opt_AcCall_3", 1, profileFile));
    putValue(env_FSG_CallState_Opt_AcCall_2,getProfileInt("BAP TEL", "env_FSG_CallState_Opt_AcCall_2", 1, profileFile));
    putValue(env_FSG_CallState_Opt_AcCall_1,getProfileInt("BAP TEL", "env_FSG_CallState_Opt_AcCall_1", 1, profileFile));
    putValue(env_FSG_CallState_Opt_AcCall_0,getProfileInt("BAP TEL", "env_FSG_CallState_Opt_AcCall_0", 1, profileFile));
    putValue(env_FSG_CallState_CallOuDivert_6,getProfileInt("BAP TEL", "env_FSG_CallState_CallOuDivert_6", 1, profileFile));
    putValue(env_FSG_CallState_CallOuDivert_5,getProfileInt("BAP TEL", "env_FSG_CallState_CallOuDivert_5", 1, profileFile));
    putValue(env_FSG_CallState_CallOuDivert_4,getProfileInt("BAP TEL", "env_FSG_CallState_CallOuDivert_4", 1, profileFile));
    putValue(env_FSG_CallState_CallOuDivert_3,getProfileInt("BAP TEL", "env_FSG_CallState_CallOuDivert_3", 1, profileFile));
    putValue(env_FSG_CallState_CallOuDivert_2,getProfileInt("BAP TEL", "env_FSG_CallState_CallOuDivert_2", 1, profileFile));
    putValue(env_FSG_CallState_CallOuDivert_1,getProfileInt("BAP TEL", "env_FSG_CallState_CallOuDivert_1", 1, profileFile));
    putValue(env_FSG_CallState_CallOuDivert_0,getProfileInt("BAP TEL", "env_FSG_CallState_CallOuDivert_0", 1, profileFile));
    putValue(env_FSG_MPSWCOH,getProfileInt("BAP TEL", "env_FSG_MPSWCOH", 1, profileFile));
    putValue(env_FSG_MissedCalls_AutoOnOff,getProfileInt("BAP TEL", "env_FSG_MissedCalls_AutoOnOff", 1, profileFile));
    putValue(env_FSG_MicroMuteOnOff,getProfileInt("BAP TEL", "env_FSG_MicroMuteOnOff", 1, profileFile));
    putValue(env_FSG_MissedCalls_reload,getProfileInt("BAP TEL", "env_FSG_MissedCalls_reload", 1, profileFile));
    putValue(env_FSG_MissedCalls_DataSource,getProfileInt("BAP TEL", "env_FSG_MissedCalls_DataSource", 1, profileFile));
    putValue(env_FSG_MissedCalls_StatusArray,getProfileInt("BAP TEL", "env_FSG_MissedCalls_StatusArray", 1, profileFile));
    putValue(env_FSG_MissedCalls_ChangedArray,getProfileInt("BAP TEL", "env_FSG_MissedCalls_ChangedArray", 1, profileFile));
    putValue(env_FSG_MissedCalls_AH_elements,getProfileInt("BAP TEL", "env_FSG_MissedCalls_AH_elements", 1, profileFile));
    putValue(env_FSG_MissedCalls_AH_start,getProfileInt("BAP TEL", "env_FSG_MissedCalls_AH_start", 1, profileFile));
    putValue(env_FSG_MissedCalls_AH_RA,getProfileInt("BAP TEL", "env_FSG_MissedCalls_AH_RA", 1, profileFile));
    putValue(env_FSG_MissedCalls_AH_IS,getProfileInt("BAP TEL", "env_FSG_MissedCalls_AH_IS", 1, profileFile));
    putValue(env_FSG_MissedCalls_AH_POS,getProfileInt("BAP TEL", "env_FSG_MissedCalls_AH_POS", 1, profileFile));
    putValue(env_FSG_MissedCalls_AH_dir,getProfileInt("BAP TEL", "env_FSG_MissedCalls_AH_dir", 1, profileFile));
    putValue(env_FSG_MissedCalls_AH_shift,getProfileInt("BAP TEL", "env_FSG_MissedCalls_AH_shift", 1, profileFile));
    putValue(env_FSG_MissedCalls_TotalNumLE,getProfileInt("BAP TEL", "env_FSG_MissedCalls_TotalNumLE", 1, profileFile));
    putValue(env_FSG_MissedCalls_TAID,getProfileInt("BAP TEL", "env_FSG_MissedCalls_TAID", 1, profileFile));
    putValue(env_FSG_MissedCalls_ASG_ID,getProfileInt("BAP TEL", "env_FSG_MissedCalls_ASG_ID", 1, profileFile));
    putValue(env_FSG_PbState_OK,getProfileInt("BAP TEL", "env_FSG_PbState_OK", 1, profileFile));
    putValue(env_FSG_CallDurationSync_OK,getProfileInt("BAP TEL", "env_FSG_CallDurationSync_OK", 1, profileFile));
    putValue(env_FSG_CallDurationSync_6,getProfileInt("BAP TEL", "env_FSG_CallDurationSync_6", 1, profileFile));
    putValue(env_FSG_CallDurationSync_5,getProfileInt("BAP TEL", "env_FSG_CallDurationSync_5", 1, profileFile));
    putValue(env_FSG_CallDurationSync_4,getProfileInt("BAP TEL", "env_FSG_CallDurationSync_4", 1, profileFile));
    putValue(env_FSG_CallDurationSync_3,getProfileInt("BAP TEL", "env_FSG_CallDurationSync_3", 1, profileFile));
    putValue(env_FSG_CallDurationSync_2,getProfileInt("BAP TEL", "env_FSG_CallDurationSync_2", 1, profileFile));
    putValue(env_FSG_CallDurationSync_1,getProfileInt("BAP TEL", "env_FSG_CallDurationSync_1", 1, profileFile));
    putValue(env_FSG_CallDurationSync_0,getProfileInt("BAP TEL", "env_FSG_CallDurationSync_0", 1, profileFile));
    putValue(env_FSG_DialNumber,getProfileInt("BAP TEL", "env_FSG_DialNumber", 1, profileFile));
    putValue(env_FSG_ChargeLevelM2_Init,getProfileInt("BAP TEL", "env_FSG_ChargeLevelM2_Init", 1, profileFile));
    putValue(env_FSG_ChargeLevelM1_Init,getProfileInt("BAP TEL", "env_FSG_ChargeLevelM1_Init", 1, profileFile));
    putValue(env_FSG_ChargeLevelH2_Init,getProfileInt("BAP TEL", "env_FSG_ChargeLevelH2_Init", 1, profileFile));
    putValue(env_FSG_ChargeLevelH1_Init,getProfileInt("BAP TEL", "env_FSG_ChargeLevelH1_Init", 1, profileFile));
    putValue(env_FSG_HangupCall_CallID,getProfileInt("BAP TEL", "env_FSG_HangupCall_CallID", 1, profileFile));
    putValue(env_FSG_HangupCall,getProfileInt("BAP TEL", "env_FSG_HangupCall", 1, profileFile));
    putValue(env_FSG_DataVolumeDownlink,getProfileInt("BAP TEL", "env_FSG_DataVolumeDownlink", 1, profileFile));
    putValue(env_FSG_DataVolumeUplink,getProfileInt("BAP TEL", "env_FSG_DataVolumeUplink", 1, profileFile));
    putValue(env_FSG_ConIndication_Reset,getProfileInt("BAP TEL", "env_FSG_ConIndication_Reset", 1, profileFile));
    putValue(env_FSG_ConnectionIndication,getProfileInt("BAP TEL", "env_FSG_ConnectionIndication", 1, profileFile));
    putValue(env_FSG_ChargeLevelH2,getProfileInt("BAP TEL", "env_FSG_ChargeLevelH2", 1, profileFile));
    putValue(env_FSG_ChargeLevelH1,getProfileInt("BAP TEL", "env_FSG_ChargeLevelH1", 1, profileFile));
    putValue(env_FSG_ChargeLevelM2,getProfileInt("BAP TEL", "env_FSG_ChargeLevelM2", 1, profileFile));
    putValue(env_FSG_ChargeLevelM1,getProfileInt("BAP TEL", "env_FSG_ChargeLevelM1", 1, profileFile));
    putValue(env_FSG_Keypad_eCall_long,getProfileInt("BAP TEL", "env_FSG_Keypad_eCall_long", 1, profileFile));
    putValue(env_FSG_Keypad_eCall_short,getProfileInt("BAP TEL", "env_FSG_Keypad_eCall_short", 1, profileFile));
    putValue(env_FSG_DisconnectReason_OK,getProfileInt("BAP TEL", "env_FSG_DisconnectReason_OK", 1, profileFile));
    putValue(env_FSG_ServiceProviderState,getProfileInt("BAP TEL", "env_FSG_ServiceProviderState", 1, profileFile));
    putValue(env_FSG_NetworkProviderState,getProfileInt("BAP TEL", "env_FSG_NetworkProviderState", 1, profileFile));
    putValue(env_FSG_Telephone_MSS_0x37,getProfileInt("BAP TEL", "env_FSG_Telephone_MSS_0x37", 1, profileFile));
    putValue(env_FSG_Telephone_MSS_0x36,getProfileInt("BAP TEL", "env_FSG_Telephone_MSS_0x36", 1, profileFile));
    putValue(env_FSG_Telephone_MSS_0x35,getProfileInt("BAP TEL", "env_FSG_Telephone_MSS_0x35", 1, profileFile));
    putValue(env_FSG_Telephone_MSS_0x34,getProfileInt("BAP TEL", "env_FSG_Telephone_MSS_0x34", 1, profileFile));
    putValue(env_FSG_Telephone_MSS_0x33,getProfileInt("BAP TEL", "env_FSG_Telephone_MSS_0x33", 1, profileFile));
    putValue(env_FSG_Telephone_MSS_0x32,getProfileInt("BAP TEL", "env_FSG_Telephone_MSS_0x32", 1, profileFile));
    putValue(env_FSG_Telephone_MSS_0x31,getProfileInt("BAP TEL", "env_FSG_Telephone_MSS_0x31", 1, profileFile));
    putValue(env_FSG_PacketDataNetworkType,getProfileInt("BAP TEL", "env_FSG_PacketDataNetworkType", 1, profileFile));
    putValue(env_FSG_NetworkType,getProfileInt("BAP TEL", "env_FSG_NetworkType", 1, profileFile));
    putValue(env_FSG_EnhancedPrivacyMode,getProfileInt("BAP TEL", "env_FSG_EnhancedPrivacyMode", 1, profileFile));
    putValue(env_FSG_PrivacyModeBit,getProfileInt("BAP TEL", "env_FSG_PrivacyModeBit", 1, profileFile));
    putValue(env_FSG_Tel_State,getProfileInt("BAP TEL", "env_FSG_Tel_State", 1, profileFile));
    putValue(env_FSG_Debug_on_off,getProfileInt("BAP TEL", "env_FSG_Debug_on_off", 1, profileFile));
    putValue(env_FSG_PbStartDownload_Result,getProfileInt("BAP TEL", "env_FSG_PbStartDownload_Result", 1, profileFile));
    putValue(env_FSG_PbSpeller_Matching,getProfileInt("BAP TEL", "env_FSG_PbSpeller_Matching", 1, profileFile));
    putValue(env_FSG_Restore_PhoneOne,getProfileInt("BAP TEL", "env_FSG_Restore_PhoneOne", 1, profileFile));
    putValue(env_FSG_Phonebook_Pb_Changed,getProfileInt("BAP TEL", "env_FSG_Phonebook_Pb_Changed", 1, profileFile));
    putValue(env_FSG_Telephone_FctList_update,getProfileInt("BAP TEL", "env_FSG_Telephone_FctList_update", 1, profileFile));
    putValue(env_FSG_Telephone_MSS_mode,getProfileInt("BAP TEL", "env_FSG_Telephone_MSS_mode", 1, profileFile));
    putValue(env_FSG_Telephone_FctList_mode,getProfileInt("BAP TEL", "env_FSG_Telephone_FctList_mode", 1, profileFile));
    putValue(env_FSG_receivedcall_DateTime,getProfileInt("BAP TEL", "env_FSG_receivedcall_DateTime", 1, profileFile));
    putValue(env_FSG_dialednumber_DateTime,getProfileInt("BAP TEL", "env_FSG_dialednumber_DateTime", 1, profileFile));
    putValue(env_FSG_missedcall_DateTime,getProfileInt("BAP TEL", "env_FSG_missedcall_DateTime", 1, profileFile));
    putValue(env_FSG_RemoteSide_HangUpWait,getProfileInt("BAP TEL", "env_FSG_RemoteSide_HangUpWait", 1, profileFile));
    putValue(env_FSG_RemoteSide_HangUp,getProfileInt("BAP TEL", "env_FSG_RemoteSide_HangUp", 1, profileFile));
    putValue(env_FSG_MP_CHAWC,getProfileInt("BAP TEL", "env_FSG_MP_CHAWC", 1, profileFile));
    putValue(env_FSG_MP_RAllCAWC,getProfileInt("BAP TEL", "env_FSG_MP_RAllCAWC", 1, profileFile));
    putValue(env_FSG_IncomingCall_Divert,getProfileInt("BAP TEL", "env_FSG_IncomingCall_Divert", 1, profileFile));
    putValue(env_FSG_RegisterState_OK,getProfileInt("BAP TEL", "env_FSG_RegisterState_OK", 1, profileFile));
    putValue(env_FSG_RegisterState,getProfileInt("BAP TEL", "env_FSG_RegisterState", 1, profileFile));
    putValue(env_FSG_SMSState_OK,getProfileInt("BAP TEL", "env_FSG_SMSState_OK", 1, profileFile));
    putValue(env_FSG_NumberOfNewSMS,getProfileInt("BAP TEL", "env_FSG_NumberOfNewSMS", 1, profileFile));
    putValue(env_FSG_StorageState,getProfileInt("BAP TEL", "env_FSG_StorageState", 1, profileFile));
    putValue(env_FSG_SIMReady,getProfileInt("BAP TEL", "env_FSG_SIMReady", 1, profileFile));
    putValue(env_FSG_Keypad_Pannenruf_long,getProfileInt("BAP TEL", "env_FSG_Keypad_Pannenruf_long", 1, profileFile));
    putValue(env_FSG_Keypad_Pannenruf_short,getProfileInt("BAP TEL", "env_FSG_Keypad_Pannenruf_short", 1, profileFile));
    putValue(env_FSG_Keypad_Inforuf_long,getProfileInt("BAP TEL", "env_FSG_Keypad_Inforuf_long", 1, profileFile));
    putValue(env_FSG_Keypad_Inforuf_short,getProfileInt("BAP TEL", "env_FSG_Keypad_Inforuf_short", 1, profileFile));
    putValue(env_FSG_MP_RACAWC,getProfileInt("BAP TEL", "env_FSG_MP_RACAWC", 1, profileFile));
    putValue(env_FSG_hangup_all_calls,getProfileInt("BAP TEL", "env_FSG_hangup_all_calls", 1, profileFile));
    putValue(env_FSG_hangup_held_active_calls,getProfileInt("BAP TEL", "env_FSG_hangup_held_active_calls", 1, profileFile));
    putValue(env_FSG_hangup_held_calls,getProfileInt("BAP TEL", "env_FSG_hangup_held_calls", 1, profileFile));
    putValue(env_FSG_CCSplit6,getProfileInt("BAP TEL", "env_FSG_CCSplit6", 1, profileFile));
    putValue(env_FSG_CCSplit5,getProfileInt("BAP TEL", "env_FSG_CCSplit5", 1, profileFile));
    putValue(env_FSG_CCSplit4,getProfileInt("BAP TEL", "env_FSG_CCSplit4", 1, profileFile));
    putValue(env_FSG_CCSplit3,getProfileInt("BAP TEL", "env_FSG_CCSplit3", 1, profileFile));
    putValue(env_FSG_CCSplit0,getProfileInt("BAP TEL", "env_FSG_CCSplit0", 1, profileFile));
    putValue(env_FSG_CCSplit2,getProfileInt("BAP TEL", "env_FSG_CCSplit2", 1, profileFile));
    putValue(env_FSG_CCSplit1,getProfileInt("BAP TEL", "env_FSG_CCSplit1", 1, profileFile));
    putValue(env_FSG_CCJoin,getProfileInt("BAP TEL", "env_FSG_CCJoin", 1, profileFile));
    putValue(env_FSG_MPSwap,getProfileInt("BAP TEL", "env_FSG_MPSwap", 1, profileFile));
    putValue(env_FSG_CallResume,getProfileInt("BAP TEL", "env_FSG_CallResume", 1, profileFile));
    putValue(env_FSG_PbState_update,getProfileInt("BAP TEL", "env_FSG_PbState_update", 1, profileFile));
    putValue(env_FSG_no_User_active,getProfileInt("BAP TEL", "env_FSG_no_User_active", 1, profileFile));
    putValue(env_FSG_Telephone_FctList_0x24,getProfileInt("BAP TEL", "env_FSG_Telephone_FctList_0x24", 1, profileFile));
    putValue(env_FSG_Telephone_FctList_set,getProfileInt("BAP TEL", "env_FSG_Telephone_FctList_set", 1, profileFile));
    putValue(env_FSG_Telephone_FctList_0x30,getProfileInt("BAP TEL", "env_FSG_Telephone_FctList_0x30", 1, profileFile));
    putValue(env_FSG_Telephone_FctList_0x2F,getProfileInt("BAP TEL", "env_FSG_Telephone_FctList_0x2F", 1, profileFile));
    putValue(env_FSG_Telephone_FctList_0x2E,getProfileInt("BAP TEL", "env_FSG_Telephone_FctList_0x2E", 1, profileFile));
    putValue(env_FSG_Telephone_FctList_0x2D,getProfileInt("BAP TEL", "env_FSG_Telephone_FctList_0x2D", 1, profileFile));
    putValue(env_FSG_Telephone_FctList_0x2C,getProfileInt("BAP TEL", "env_FSG_Telephone_FctList_0x2C", 1, profileFile));
    putValue(env_FSG_Telephone_FctList_0x2B,getProfileInt("BAP TEL", "env_FSG_Telephone_FctList_0x2B", 1, profileFile));
    putValue(env_FSG_Telephone_FctList_0x2A,getProfileInt("BAP TEL", "env_FSG_Telephone_FctList_0x2A", 1, profileFile));
    putValue(env_FSG_Telephone_FctList_0x29,getProfileInt("BAP TEL", "env_FSG_Telephone_FctList_0x29", 1, profileFile));
    putValue(env_FSG_Telephone_FctList_0x28,getProfileInt("BAP TEL", "env_FSG_Telephone_FctList_0x28", 1, profileFile));
    putValue(env_FSG_Telephone_FctList_0x27,getProfileInt("BAP TEL", "env_FSG_Telephone_FctList_0x27", 1, profileFile));
    putValue(env_FSG_Telephone_FctList_0x26,getProfileInt("BAP TEL", "env_FSG_Telephone_FctList_0x26", 1, profileFile));
    putValue(env_FSG_Telephone_FctList_0x25,getProfileInt("BAP TEL", "env_FSG_Telephone_FctList_0x25", 1, profileFile));
    putValue(env_FSG_Telephone_FctList_0x23,getProfileInt("BAP TEL", "env_FSG_Telephone_FctList_0x23", 1, profileFile));
    putValue(env_FSG_Telephone_FctList_0x22,getProfileInt("BAP TEL", "env_FSG_Telephone_FctList_0x22", 1, profileFile));
    putValue(env_FSG_Telephone_FctList_0x21,getProfileInt("BAP TEL", "env_FSG_Telephone_FctList_0x21", 1, profileFile));
    putValue(env_FSG_Telephone_FctList_0x20,getProfileInt("BAP TEL", "env_FSG_Telephone_FctList_0x20", 1, profileFile));
    putValue(env_FSG_Telephone_FctList_0x1F,getProfileInt("BAP TEL", "env_FSG_Telephone_FctList_0x1F", 1, profileFile));
    putValue(env_FSG_Telephone_FctList_0x1E,getProfileInt("BAP TEL", "env_FSG_Telephone_FctList_0x1E", 1, profileFile));
    putValue(env_FSG_Telephone_FctList_0x1D,getProfileInt("BAP TEL", "env_FSG_Telephone_FctList_0x1D", 1, profileFile));
    putValue(env_FSG_Telephone_FctList_0x1C,getProfileInt("BAP TEL", "env_FSG_Telephone_FctList_0x1C", 1, profileFile));
    putValue(env_FSG_Telephone_FctList_0x1B,getProfileInt("BAP TEL", "env_FSG_Telephone_FctList_0x1B", 1, profileFile));
    putValue(env_FSG_Telephone_FctList_0x1A,getProfileInt("BAP TEL", "env_FSG_Telephone_FctList_0x1A", 1, profileFile));
    putValue(env_FSG_Telephone_FctList_0x19,getProfileInt("BAP TEL", "env_FSG_Telephone_FctList_0x19", 1, profileFile));
    putValue(env_FSG_Telephone_FctList_0x18,getProfileInt("BAP TEL", "env_FSG_Telephone_FctList_0x18", 1, profileFile));
    putValue(env_FSG_Telephone_FctList_0x17,getProfileInt("BAP TEL", "env_FSG_Telephone_FctList_0x17", 1, profileFile));
    putValue(env_FSG_Telephone_FctList_0x16,getProfileInt("BAP TEL", "env_FSG_Telephone_FctList_0x16", 1, profileFile));
    putValue(env_FSG_Telephone_FctList_0x15,getProfileInt("BAP TEL", "env_FSG_Telephone_FctList_0x15", 1, profileFile));
    putValue(env_FSG_Telephone_FctList_0x14,getProfileInt("BAP TEL", "env_FSG_Telephone_FctList_0x14", 1, profileFile));
    putValue(env_FSG_Telephone_FctList_0x13,getProfileInt("BAP TEL", "env_FSG_Telephone_FctList_0x13", 1, profileFile));
    putValue(env_FSG_Telephone_FctList_0x12,getProfileInt("BAP TEL", "env_FSG_Telephone_FctList_0x12", 1, profileFile));
    putValue(env_FSG_Telephone_FctList_0x11,getProfileInt("BAP TEL", "env_FSG_Telephone_FctList_0x11", 1, profileFile));
    putValue(env_FSG_Telephone_FctList_0x10,getProfileInt("BAP TEL", "env_FSG_Telephone_FctList_0x10", 1, profileFile));
    putValue(env_FSG_Telephone_FctList_0x0F,getProfileInt("BAP TEL", "env_FSG_Telephone_FctList_0x0F", 1, profileFile));
    putValue(env_FSG_Telephone_FctList_0x0E,getProfileInt("BAP TEL", "env_FSG_Telephone_FctList_0x0E", 1, profileFile));
    putValue(env_FSG_Telephone_FctList_0x04,getProfileInt("BAP TEL", "env_FSG_Telephone_FctList_0x04", 1, profileFile));
    putValue(env_FSG_Telephone_FctList_0x03,getProfileInt("BAP TEL", "env_FSG_Telephone_FctList_0x03", 1, profileFile));
    putValue(env_FSG_Telephone_FctList_0x02,getProfileInt("BAP TEL", "env_FSG_Telephone_FctList_0x02", 1, profileFile));
    putValue(env_FSG_Telephone_FctList_0x01,getProfileInt("BAP TEL", "env_FSG_Telephone_FctList_0x01", 1, profileFile));
    putValue(env_FSG_Telephone_MSS_update,getProfileInt("BAP TEL", "env_FSG_Telephone_MSS_update", 1, profileFile));
    putValue(env_FSG_Telephone_MSS_0x30,getProfileInt("BAP TEL", "env_FSG_Telephone_MSS_0x30", 1, profileFile));
    putValue(env_FSG_Telephone_MSS_0x2F,getProfileInt("BAP TEL", "env_FSG_Telephone_MSS_0x2F", 1, profileFile));
    putValue(env_FSG_Telephone_MSS_0x2E,getProfileInt("BAP TEL", "env_FSG_Telephone_MSS_0x2E", 1, profileFile));
    putValue(env_FSG_Telephone_MSS_0x2D,getProfileInt("BAP TEL", "env_FSG_Telephone_MSS_0x2D", 1, profileFile));
    putValue(env_FSG_Telephone_MSS_0x2C,getProfileInt("BAP TEL", "env_FSG_Telephone_MSS_0x2C", 1, profileFile));
    putValue(env_FSG_Telephone_MSS_0x2B,getProfileInt("BAP TEL", "env_FSG_Telephone_MSS_0x2B", 1, profileFile));
    putValue(env_FSG_Telephone_MSS_0x2A,getProfileInt("BAP TEL", "env_FSG_Telephone_MSS_0x2A", 1, profileFile));
    putValue(env_FSG_Telephone_MSS_0x29,getProfileInt("BAP TEL", "env_FSG_Telephone_MSS_0x29", 1, profileFile));
    putValue(env_FSG_Telephone_MSS_0x28,getProfileInt("BAP TEL", "env_FSG_Telephone_MSS_0x28", 1, profileFile));
    putValue(env_FSG_Telephone_MSS_0x27,getProfileInt("BAP TEL", "env_FSG_Telephone_MSS_0x27", 1, profileFile));
    putValue(env_FSG_Telephone_MSS_0x26,getProfileInt("BAP TEL", "env_FSG_Telephone_MSS_0x26", 1, profileFile));
    putValue(env_FSG_Telephone_MSS_0x25,getProfileInt("BAP TEL", "env_FSG_Telephone_MSS_0x25", 1, profileFile));
    putValue(env_FSG_Telephone_MSS_0x24,getProfileInt("BAP TEL", "env_FSG_Telephone_MSS_0x24", 1, profileFile));
    putValue(env_FSG_Telephone_MSS_0x23,getProfileInt("BAP TEL", "env_FSG_Telephone_MSS_0x23", 1, profileFile));
putValue(env_FSG_Telephone_MSS_0x22,getProfileInt("BAP TEL", "env_FSG_Telephone_MSS_0x22", 1, profileFile));
putValue(env_FSG_Telephone_MSS_0x21,getProfileInt("BAP TEL", "env_FSG_Telephone_MSS_0x21", 1, profileFile));
putValue(env_FSG_Telephone_MSS_0x20,getProfileInt("BAP TEL", "env_FSG_Telephone_MSS_0x20", 1, profileFile));
putValue(env_FSG_Telephone_MSS_0x1D,getProfileInt("BAP TEL", "env_FSG_Telephone_MSS_0x1D", 1, profileFile));
putValue(env_FSG_Telephone_MSS_0x1F,getProfileInt("BAP TEL", "env_FSG_Telephone_MSS_0x1F", 1, profileFile));
putValue(env_FSG_Telephone_MSS_0x1E,getProfileInt("BAP TEL", "env_FSG_Telephone_MSS_0x1E", 1, profileFile));
putValue(env_FSG_Telephone_MSS_0x1C,getProfileInt("BAP TEL", "env_FSG_Telephone_MSS_0x1C", 1, profileFile));
putValue(env_FSG_Telephone_MSS_0x1B,getProfileInt("BAP TEL", "env_FSG_Telephone_MSS_0x1B", 1, profileFile));
putValue(env_FSG_Telephone_MSS_0x1A,getProfileInt("BAP TEL", "env_FSG_Telephone_MSS_0x1A", 1, profileFile));
putValue(env_FSG_Telephone_MSS_0x19,getProfileInt("BAP TEL", "env_FSG_Telephone_MSS_0x19", 1, profileFile));
putValue(env_FSG_Telephone_MSS_0x18,getProfileInt("BAP TEL", "env_FSG_Telephone_MSS_0x18", 1, profileFile));
putValue(env_FSG_Telephone_MSS_0x17,getProfileInt("BAP TEL", "env_FSG_Telephone_MSS_0x17", 1, profileFile));
putValue(env_FSG_Telephone_MSS_0x16,getProfileInt("BAP TEL", "env_FSG_Telephone_MSS_0x16", 1, profileFile));
putValue(env_FSG_Telephone_MSS_0x15,getProfileInt("BAP TEL", "env_FSG_Telephone_MSS_0x15", 1, profileFile));
putValue(env_FSG_Telephone_MSS_0x14,getProfileInt("BAP TEL", "env_FSG_Telephone_MSS_0x14", 1, profileFile));
putValue(env_FSG_Telephone_MSS_0x13,getProfileInt("BAP TEL", "env_FSG_Telephone_MSS_0x13", 1, profileFile));
putValue(env_FSG_Telephone_MSS_0x12,getProfileInt("BAP TEL", "env_FSG_Telephone_MSS_0x12", 1, profileFile));
putValue(env_FSG_Telephone_MSS_0x11,getProfileInt("BAP TEL", "env_FSG_Telephone_MSS_0x11", 1, profileFile));
putValue(env_FSG_Telephone_MSS_0x10,getProfileInt("BAP TEL", "env_FSG_Telephone_MSS_0x10", 1, profileFile));
putValue(env_FSG_Telephone_MSS_0x0F,getProfileInt("BAP TEL", "env_FSG_Telephone_MSS_0x0F", 1, profileFile));
putValue(env_FSG_Telephone_MSS_0x0E,getProfileInt("BAP TEL", "env_FSG_Telephone_MSS_0x0E", 1, profileFile));
putValue(env_FSG_Telephone_MSS_0x04,getProfileInt("BAP TEL", "env_FSG_Telephone_MSS_0x04", 1, profileFile));
putValue(env_FSG_Telephone_MSS_0x03,getProfileInt("BAP TEL", "env_FSG_Telephone_MSS_0x03", 1, profileFile));
putValue(env_FSG_Telephone_MSS_0x02,getProfileInt("BAP TEL", "env_FSG_Telephone_MSS_0x02", 1, profileFile));
putValue(env_FSG_Telephone_MSS_0x01,getProfileInt("BAP TEL", "env_FSG_Telephone_MSS_0x01", 1, profileFile));
putValue(env_FSG_dialednumber_reject,getProfileInt("BAP TEL", "env_FSG_dialednumber_reject", 1, profileFile));
putValue(env_FSG_PbState_DownloadAbort,getProfileInt("BAP TEL", "env_FSG_PbState_DownloadAbort", 1, profileFile));
putValue(env_FSG_PbState_DownloadState,getProfileInt("BAP TEL", "env_FSG_PbState_DownloadState", 1, profileFile));
putValue(env_FSG_PbState_EntriesUHV,getProfileInt("BAP TEL", "env_FSG_PbState_EntriesUHV", 1, profileFile));
putValue(env_FSG_FSG_Setup_OK,getProfileInt("BAP TEL", "env_FSG_FSG_Setup_OK", 1, profileFile));
putValue(env_FSG_HFPConnection,getProfileInt("BAP TEL", "env_FSG_HFPConnection", 1, profileFile));
putValue(env_FSG_LockState_OK,getProfileInt("BAP TEL", "env_FSG_LockState_OK", 1, profileFile));
putValue(env_FSG_FSG_OperationState_OK,getProfileInt("BAP TEL", "env_FSG_FSG_OperationState_OK", 1, profileFile));
putValue(env_FSG_MobileConnectionType,getProfileInt("BAP TEL", "env_FSG_MobileConnectionType", 1, profileFile));
putValue(env_FSG_RSAPConnection,getProfileInt("BAP TEL", "env_FSG_RSAPConnection", 1, profileFile));
putValue(env_FSG_CableConnection,getProfileInt("BAP TEL", "env_FSG_CableConnection", 1, profileFile));
putValue(env_FSG_SIMCardReader,getProfileInt("BAP TEL", "env_FSG_SIMCardReader", 1, profileFile));
putValue(env_FSG_MissedCallIndication,getProfileInt("BAP TEL", "env_FSG_MissedCallIndication", 1, profileFile));
putValue(env_FSG_MissedNumbers,getProfileInt("BAP TEL", "env_FSG_MissedNumbers", 1, profileFile));
putValue(env_FSG_MissedCalls,getProfileInt("BAP TEL", "env_FSG_MissedCalls", 1, profileFile));
putValue(env_FSG_receivedcall_select,getProfileInt("BAP TEL", "env_FSG_receivedcall_select", 1, profileFile));
putValue(env_FSG_receivedcall_numbertype,getProfileInt("BAP TEL", "env_FSG_receivedcall_numbertype", 1, profileFile));
putValue(env_FSG_receivedcall_callstack,getProfileInt("BAP TEL", "env_FSG_receivedcall_callstack", 1, profileFile));
putValue(env_FSG_receivedcall_add_type,getProfileInt("BAP TEL", "env_FSG_receivedcall_add_type", 1, profileFile));
putValue(env_FSG_receivedcall_add,getProfileInt("BAP TEL", "env_FSG_receivedcall_add", 1, profileFile));
putValue(env_FSG_dial_receivedcall,getProfileInt("BAP TEL", "env_FSG_dial_receivedcall", 1, profileFile));
putValue(env_FSG_MissedCalls_update,getProfileInt("BAP TEL", "env_FSG_MissedCalls_update", 1, profileFile));
putValue(env_FSG_missedcall_add_type,getProfileInt("BAP TEL", "env_FSG_missedcall_add_type", 1, profileFile));
putValue(env_FSG_missedcall_add,getProfileInt("BAP TEL", "env_FSG_missedcall_add", 1, profileFile));
putValue(env_FSG_missedcall_select,getProfileInt("BAP TEL", "env_FSG_missedcall_select", 1, profileFile));
putValue(env_FSG_missedcall_numbertype,getProfileInt("BAP TEL", "env_FSG_missedcall_numbertype", 1, profileFile));
putValue(env_FSG_missedcall_callstack,getProfileInt("BAP TEL", "env_FSG_missedcall_callstack", 1, profileFile));
putValue(env_FSG_dialednumber_add_type,getProfileInt("BAP TEL", "env_FSG_dialednumber_add_type", 1, profileFile));
putValue(env_FSG_dialednumber_add,getProfileInt("BAP TEL", "env_FSG_dialednumber_add", 1, profileFile));
putValue(env_FSG_SignalQuality_Mode,getProfileInt("BAP TEL", "env_FSG_SignalQuality_Mode", 1, profileFile));
putValue(env_FSG_SignalQuality,getProfileInt("BAP TEL", "env_FSG_SignalQuality", 1, profileFile));
putValue(env_FSG_ActiveUser_OK,getProfileInt("BAP TEL", "env_FSG_ActiveUser_OK", 1, profileFile));
putValue(env_FSG_LockState,getProfileInt("BAP TEL", "env_FSG_LockState", 1, profileFile));
putValue(env_FSG_NetInfoCiphering,getProfileInt("BAP TEL", "env_FSG_NetInfoCiphering", 1, profileFile));
putValue(env_FSG_NetInfoCallDivert,getProfileInt("BAP TEL", "env_FSG_NetInfoCallDivert", 1, profileFile));
putValue(env_FSG_Power_on_off,getProfileInt("BAP TEL", "env_FSG_Power_on_off", 1, profileFile));
putValue(env_FSG_OP_State,getProfileInt("BAP TEL", "env_FSG_OP_State", 1, profileFile));
putValue(env_FSG_phonebook_numbertype,getProfileInt("BAP TEL", "env_FSG_phonebook_numbertype", 1, profileFile));
putValue(env_FSG_dialednumber_numbertype,getProfileInt("BAP TEL", "env_FSG_dialednumber_numbertype", 1, profileFile));
putValue(env_FSG_dialednumber_select,getProfileInt("BAP TEL", "env_FSG_dialednumber_select", 1, profileFile));
putValue(env_FSG_dial_dialednumber,getProfileInt("BAP TEL", "env_FSG_dial_dialednumber", 1, profileFile));
putValue(env_FSG_AcceptCall,getProfileInt("BAP TEL", "env_FSG_AcceptCall", 1, profileFile));
putValue(env_FSG_dialednumber_accepted,getProfileInt("BAP TEL", "env_FSG_dialednumber_accepted", 1, profileFile));
putValue(env_FSG_Headset_available,getProfileInt("BAP TEL", "env_FSG_Headset_available", 1, profileFile));
putValue(env_FSG_HandsFreeOnOff,getProfileInt("BAP TEL", "env_FSG_HandsFreeOnOff", 1, profileFile));
putValue(env_FSG_BAP_Indication_datalengt,getProfileInt("BAP TEL", "env_FSG_BAP_Indication_datalengt", 1, profileFile));
putValue(env_FSG_BAP_Request_datalength,getProfileInt("BAP TEL", "env_FSG_BAP_Request_datalength", 1, profileFile));
putValue(env_FSG_hangup_active_calls,getProfileInt("BAP TEL", "env_FSG_hangup_active_calls", 1, profileFile));
putValue(env_FSG_CallHold,getProfileInt("BAP TEL", "env_FSG_CallHold", 1, profileFile));
putValue(env_FSG_CallID_6_hangup,getProfileInt("BAP TEL", "env_FSG_CallID_6_hangup", 1, profileFile));
putValue(env_FSG_CallID_5_hangup,getProfileInt("BAP TEL", "env_FSG_CallID_5_hangup", 1, profileFile));
putValue(env_FSG_CallID_4_hangup,getProfileInt("BAP TEL", "env_FSG_CallID_4_hangup", 1, profileFile));
putValue(env_FSG_CallID_3_hangup,getProfileInt("BAP TEL", "env_FSG_CallID_3_hangup", 1, profileFile));
putValue(env_FSG_CallID_2_hangup,getProfileInt("BAP TEL", "env_FSG_CallID_2_hangup", 1, profileFile));
putValue(env_FSG_CallID_1_hangup,getProfileInt("BAP TEL", "env_FSG_CallID_1_hangup", 1, profileFile));
putValue(env_FSG_CallID_0_hangup,getProfileInt("BAP TEL", "env_FSG_CallID_0_hangup", 1, profileFile));
putValue(env_FSG_dialednumber_free_busy,getProfileInt("BAP TEL", "env_FSG_dialednumber_free_busy", 1, profileFile));
putValue(env_FSG_DisconnectReason,getProfileInt("BAP TEL", "env_FSG_DisconnectReason", 1, profileFile));
putValue(env_FSG_SIMstatus,getProfileInt("BAP TEL", "env_FSG_SIMstatus", 1, profileFile));
putValue(env_FSG_IncomingCall,getProfileInt("BAP TEL", "env_FSG_IncomingCall", 1, profileFile));
putValue(env_FSG_NetworkProvider_OK,getProfileInt("BAP TEL", "env_FSG_NetworkProvider_OK", 1, profileFile));
putValue(env_Tel_HandsFree_Error_Code,getProfileInt("BAP TEL", "env_Tel_HandsFree_Error_Code", 1, profileFile));
putValue(env_Tel_HandsFree_Error_On,getProfileInt("BAP TEL", "env_Tel_HandsFree_Error_On", 1, profileFile));
putValue(env_Tel_MicroMute_Error_Code,getProfileInt("BAP TEL", "env_Tel_MicroMute_Error_Code", 1, profileFile));
putValue(env_Tel_MicroMute_Error_On,getProfileInt("BAP TEL", "env_Tel_MicroMute_Error_On", 1, profileFile));
putValue(env_Tel_MissedCallInd_Error_Code,getProfileInt("BAP TEL", "env_Tel_MissedCallInd_Error_Code", 1, profileFile));
putValue(env_Tel_MissedCallInd_Error_On,getProfileInt("BAP TEL", "env_Tel_MissedCallInd_Error_On", 1, profileFile));
putValue(env_Tel_RingToneMute_Error_Code,getProfileInt("BAP TEL", "env_Tel_RingToneMute_Error_Code", 1, profileFile));
putValue(env_Tel_RingToneMute_Error_On,getProfileInt("BAP TEL", "env_Tel_RingToneMute_Error_On", 1, profileFile));
putValue(env_Tel_AutoRedial_Error_Code,getProfileInt("BAP TEL", "env_Tel_AutoRedial_Error_Code", 1, profileFile));
putValue(env_Tel_AutoRedial_Error_On,getProfileInt("BAP TEL", "env_Tel_AutoRedial_Error_On", 1, profileFile));
putValue(env_FSG_Telephone_FctList_0x3C,getProfileInt("BAP TEL", "env_FSG_Telephone_FctList_0x3C", 1, profileFile));
putValue(env_FSG_Telephone_FctList_0x3B,getProfileInt("BAP TEL", "env_FSG_Telephone_FctList_0x3B", 1, profileFile));
putValue(env_FSG_Telephone_FctList_0x3A,getProfileInt("BAP TEL", "env_FSG_Telephone_FctList_0x3A", 1, profileFile));
putValue(env_FSG_Telephone_FctList_0x39,getProfileInt("BAP TEL", "env_FSG_Telephone_FctList_0x39", 1, profileFile));
putValue(env_FSG_Telephone_FctList_0x38,getProfileInt("BAP TEL", "env_FSG_Telephone_FctList_0x38", 1, profileFile));
putValue(env_FSG_Telephone_FctList_0x37,getProfileInt("BAP TEL", "env_FSG_Telephone_FctList_0x37", 1, profileFile));
putValue(env_FSG_Telephone_FctList_0x36,getProfileInt("BAP TEL", "env_FSG_Telephone_FctList_0x36", 1, profileFile));
putValue(env_FSG_Telephone_FctList_0x35,getProfileInt("BAP TEL", "env_FSG_Telephone_FctList_0x35", 1, profileFile));
putValue(env_FSG_Telephone_FctList_0x34,getProfileInt("BAP TEL", "env_FSG_Telephone_FctList_0x34", 1, profileFile));
putValue(env_FSG_Telephone_FctList_0x33,getProfileInt("BAP TEL", "env_FSG_Telephone_FctList_0x33", 1, profileFile));
putValue(env_FSG_Telephone_FctList_0x32,getProfileInt("BAP TEL", "env_FSG_Telephone_FctList_0x32", 1, profileFile));
putValue(env_FSG_Telephone_FctList_0x31,getProfileInt("BAP TEL", "env_FSG_Telephone_FctList_0x31", 1, profileFile));
putValue(env_Telefon_FuncList,getProfileInt("BAP TEL", "env_Telefon_FuncList", 1, profileFile));
putValue(env_FSG_Telephone_FctList_0x3A_HB,getProfileInt("BAP TEL", "env_FSG_Telephone_FctList_0x3A_HB", 1, profileFile));
putValue(env_FSG_Telephone_FctList_0x39_HB,getProfileInt("BAP TEL", "env_FSG_Telephone_FctList_0x39_HB", 1, profileFile));
putValue(env_FSG_Telephone_FctList_0x38_HB,getProfileInt("BAP TEL", "env_FSG_Telephone_FctList_0x38_HB", 1, profileFile));
putValue(env_FSG_Telephone_FctList_0x37_HB,getProfileInt("BAP TEL", "env_FSG_Telephone_FctList_0x37_HB", 1, profileFile));
putValue(env_FSG_Telephone_FctList_0x36_HB,getProfileInt("BAP TEL", "env_FSG_Telephone_FctList_0x36_HB", 1, profileFile));
putValue(env_FSG_Telephone_FctList_0x35_HB,getProfileInt("BAP TEL", "env_FSG_Telephone_FctList_0x35_HB", 1, profileFile));
putValue(env_FSG_Telephone_FctList_0x34_HB,getProfileInt("BAP TEL", "env_FSG_Telephone_FctList_0x34_HB", 1, profileFile));
putValue(env_FSG_Telephone_FctList_0x33_HB,getProfileInt("BAP TEL", "env_FSG_Telephone_FctList_0x33_HB", 1, profileFile));
putValue(env_FSG_Telephone_FctList_0x32_HB,getProfileInt("BAP TEL", "env_FSG_Telephone_FctList_0x32_HB", 1, profileFile));
putValue(env_FSG_Telephone_FctList_0x31_HB,getProfileInt("BAP TEL", "env_FSG_Telephone_FctList_0x31_HB", 1, profileFile));
putValue(env_FSG_Telephone_FctList_0x30_HB,getProfileInt("BAP TEL", "env_FSG_Telephone_FctList_0x30_HB", 1, profileFile));
putValue(env_FSG_Telephone_FctList_0x2F_HB,getProfileInt("BAP TEL", "env_FSG_Telephone_FctList_0x2F_HB", 1, profileFile));
putValue(env_FSG_Telephone_FctList_0x2E_HB,getProfileInt("BAP TEL", "env_FSG_Telephone_FctList_0x2E_HB", 1, profileFile));
putValue(env_FSG_Telephone_FctList_0x2D_HB,getProfileInt("BAP TEL", "env_FSG_Telephone_FctList_0x2D_HB", 1, profileFile));
putValue(env_FSG_Telephone_FctList_0x2C_HB,getProfileInt("BAP TEL", "env_FSG_Telephone_FctList_0x2C_HB", 1, profileFile));
putValue(env_FSG_Telephone_FctList_0x2B_HB,getProfileInt("BAP TEL", "env_FSG_Telephone_FctList_0x2B_HB", 1, profileFile));
putValue(env_FSG_Telephone_FctList_0x2A_HB,getProfileInt("BAP TEL", "env_FSG_Telephone_FctList_0x2A_HB", 1, profileFile));
putValue(env_FSG_Telephone_FctList_0x29_HB,getProfileInt("BAP TEL", "env_FSG_Telephone_FctList_0x29_HB", 1, profileFile));
putValue(env_FSG_Telephone_FctList_0x28_HB,getProfileInt("BAP TEL", "env_FSG_Telephone_FctList_0x28_HB", 1, profileFile));
putValue(env_FSG_Telephone_FctList_0x27_HB,getProfileInt("BAP TEL", "env_FSG_Telephone_FctList_0x27_HB", 1, profileFile));
putValue(env_FSG_Telephone_FctList_0x26_HB,getProfileInt("BAP TEL", "env_FSG_Telephone_FctList_0x26_HB", 1, profileFile));
putValue(env_FSG_Telephone_FctList_0x25_HB,getProfileInt("BAP TEL", "env_FSG_Telephone_FctList_0x25_HB", 1, profileFile));
putValue(env_FSG_Telephone_FctList_0x23_HB,getProfileInt("BAP TEL", "env_FSG_Telephone_FctList_0x23_HB", 1, profileFile));
putValue(env_FSG_Telephone_FctList_0x22_HB,getProfileInt("BAP TEL", "env_FSG_Telephone_FctList_0x22_HB", 1, profileFile));
putValue(env_FSG_Telephone_FctList_0x21_HB,getProfileInt("BAP TEL", "env_FSG_Telephone_FctList_0x21_HB", 1, profileFile));
putValue(env_FSG_Telephone_FctList_0x20_HB,getProfileInt("BAP TEL", "env_FSG_Telephone_FctList_0x20_HB", 1, profileFile));
putValue(env_FSG_Telephone_FctList_0x1F_HB,getProfileInt("BAP TEL", "env_FSG_Telephone_FctList_0x1F_HB", 1, profileFile));
putValue(env_FSG_Telephone_FctList_0x1E_HB,getProfileInt("BAP TEL", "env_FSG_Telephone_FctList_0x1E_HB", 1, profileFile));
putValue(env_FSG_Telephone_FctList_0x1D_HB,getProfileInt("BAP TEL", "env_FSG_Telephone_FctList_0x1D_HB", 1, profileFile));
putValue(env_FSG_Telephone_FctList_0x1C_HB,getProfileInt("BAP TEL", "env_FSG_Telephone_FctList_0x1C_HB", 1, profileFile));
putValue(env_FSG_Telephone_FctList_0x1B_HB,getProfileInt("BAP TEL", "env_FSG_Telephone_FctList_0x1B_HB", 1, profileFile));
putValue(env_FSG_Telephone_FctList_0x1A_HB,getProfileInt("BAP TEL", "env_FSG_Telephone_FctList_0x1A_HB", 1, profileFile));
putValue(env_FSG_Telephone_FctList_0x19_HB,getProfileInt("BAP TEL", "env_FSG_Telephone_FctList_0x19_HB", 1, profileFile));
putValue(env_FSG_Telephone_FctList_0x18_HB,getProfileInt("BAP TEL", "env_FSG_Telephone_FctList_0x18_HB", 1, profileFile));
putValue(env_FSG_Telephone_FctList_0x17_HB,getProfileInt("BAP TEL", "env_FSG_Telephone_FctList_0x17_HB", 1, profileFile));
putValue(env_FSG_Telephone_FctList_0x16_HB,getProfileInt("BAP TEL", "env_FSG_Telephone_FctList_0x16_HB", 1, profileFile));
putValue(env_FSG_Telephone_FctList_0x15_HB,getProfileInt("BAP TEL", "env_FSG_Telephone_FctList_0x15_HB", 1, profileFile));
putValue(env_FSG_Telephone_FctList_0x14_HB,getProfileInt("BAP TEL", "env_FSG_Telephone_FctList_0x14_HB", 1, profileFile));
putValue(env_FSG_Telephone_FctList_0x13_HB,getProfileInt("BAP TEL", "env_FSG_Telephone_FctList_0x13_HB", 1, profileFile));
putValue(env_FSG_Telephone_FctList_0x12_HB,getProfileInt("BAP TEL", "env_FSG_Telephone_FctList_0x12_HB", 1, profileFile));
putValue(env_FSG_Telephone_FctList_0x11_HB,getProfileInt("BAP TEL", "env_FSG_Telephone_FctList_0x11_HB", 1, profileFile));
putValue(env_FSG_Telephone_FctList_0x10_HB,getProfileInt("BAP TEL", "env_FSG_Telephone_FctList_0x10_HB", 1, profileFile));
putValue(env_FSG_Telephone_FctList_0x0F_HB,getProfileInt("BAP TEL", "env_FSG_Telephone_FctList_0x0F_HB", 1, profileFile));
putValue(env_FSG_Telephone_FctList_0x0E_HB,getProfileInt("BAP TEL", "env_FSG_Telephone_FctList_0x0E_HB", 1, profileFile));
putValue(env_FSG_Telephone_FctList_0x04_HB,getProfileInt("BAP TEL", "env_FSG_Telephone_FctList_0x04_HB", 1, profileFile));
putValue(env_FSG_Telephone_FctList_0x03_HB,getProfileInt("BAP TEL", "env_FSG_Telephone_FctList_0x03_HB", 1, profileFile));
putValue(env_FSG_Telephone_FctList_0x02_HB,getProfileInt("BAP TEL", "env_FSG_Telephone_FctList_0x02_HB", 1, profileFile));
putValue(env_FSG_Telephone_FctList_0x01_HB,getProfileInt("BAP TEL", "env_FSG_Telephone_FctList_0x01_HB", 1, profileFile));
putValue(env_FSG_DisconnectReason_Active,getProfileInt("BAP TEL", "env_FSG_DisconnectReason_Active", 1, profileFile));
putValue(env_FSG_CN_TAID_error,getProfileInt("BAP TEL", "env_FSG_CN_TAID_error", 1, profileFile));
putValue(env_FSG_CN_ASGID_error,getProfileInt("BAP TEL", "env_FSG_CN_ASGID_error", 1, profileFile));
putValue(env_FSG_Phonebook_TAID_error,getProfileInt("BAP TEL", "env_FSG_Phonebook_TAID_error", 1, profileFile));
putValue(env_FSG_Phonebook_ASGID_error,getProfileInt("BAP TEL", "env_FSG_Phonebook_ASGID_error", 1, profileFile));
putValue(env_FSG_CN_Timeout,getProfileInt("BAP TEL", "env_FSG_CN_Timeout", 1, profileFile));
putValue(env_FSG_Phonebook_Timeout,getProfileInt("BAP TEL", "env_FSG_Phonebook_Timeout", 1, profileFile));
putValue(env_FSG_Tel_FctList_0x01_TimeOut,getProfileInt("BAP TEL", "env_FSG_Tel_FctList_0x01_TimeOut", 1, profileFile));
putValue(env_FSG_Tel_FctList_0x02_TimeOut,getProfileInt("BAP TEL", "env_FSG_Tel_FctList_0x02_TimeOut", 1, profileFile));
putValue(env_FSG_Tel_FctList_0x03_TimeOut,getProfileInt("BAP TEL", "env_FSG_Tel_FctList_0x03_TimeOut", 1, profileFile));
putValue(env_FSG_Tel_FctList_0x04_TimeOut,getProfileInt("BAP TEL", "env_FSG_Tel_FctList_0x04_TimeOut", 1, profileFile));
putValue(env_FSG_Tel_FctList_0x05_TimeOut,getProfileInt("BAP TEL", "env_FSG_Tel_FctList_0x05_TimeOut", 1, profileFile));
putValue(env_FSG_Tel_FctList_0x06_TimeOut,getProfileInt("BAP TEL", "env_FSG_Tel_FctList_0x06_TimeOut", 1, profileFile));
putValue(env_FSG_Tel_FctList_0x07_TimeOut,getProfileInt("BAP TEL", "env_FSG_Tel_FctList_0x07_TimeOut", 1, profileFile));
putValue(env_FSG_Tel_FctList_0x08_TimeOut,getProfileInt("BAP TEL", "env_FSG_Tel_FctList_0x08_TimeOut", 1, profileFile));
putValue(env_FSG_Tel_FctList_0x09_TimeOut,getProfileInt("BAP TEL", "env_FSG_Tel_FctList_0x09_TimeOut", 1, profileFile));
putValue(env_FSG_Tel_FctList_0x0A_TimeOut,getProfileInt("BAP TEL", "env_FSG_Tel_FctList_0x0A_TimeOut", 1, profileFile));
putValue(env_FSG_Tel_FctList_0x0B_TimeOut,getProfileInt("BAP TEL", "env_FSG_Tel_FctList_0x0B_TimeOut", 1, profileFile));
putValue(env_FSG_Tel_FctList_0x0C_TimeOut,getProfileInt("BAP TEL", "env_FSG_Tel_FctList_0x0C_TimeOut", 1, profileFile));
putValue(env_FSG_Tel_FctList_0x0D_TimeOut,getProfileInt("BAP TEL", "env_FSG_Tel_FctList_0x0D_TimeOut", 1, profileFile));
putValue(env_FSG_Tel_FctList_0x0F_TimeOut,getProfileInt("BAP TEL", "env_FSG_Tel_FctList_0x0F_TimeOut", 1, profileFile));
putValue(env_FSG_Tel_FctList_0x10_TimeOut,getProfileInt("BAP TEL", "env_FSG_Tel_FctList_0x10_TimeOut", 1, profileFile));
putValue(env_FSG_Tel_FctList_0x11_TimeOut,getProfileInt("BAP TEL", "env_FSG_Tel_FctList_0x11_TimeOut", 1, profileFile));
putValue(env_FSG_Tel_FctList_0x12_TimeOut,getProfileInt("BAP TEL", "env_FSG_Tel_FctList_0x12_TimeOut", 1, profileFile));
putValue(env_FSG_Tel_FctList_0x13_TimeOut,getProfileInt("BAP TEL", "env_FSG_Tel_FctList_0x13_TimeOut", 1, profileFile));
putValue(env_FSG_Tel_FctList_0x14_TimeOut,getProfileInt("BAP TEL", "env_FSG_Tel_FctList_0x14_TimeOut", 1, profileFile));
putValue(env_FSG_Tel_FctList_0x15_TimeOut,getProfileInt("BAP TEL", "env_FSG_Tel_FctList_0x15_TimeOut", 1, profileFile));
putValue(env_FSG_Tel_FctList_0x16_TimeOut,getProfileInt("BAP TEL", "env_FSG_Tel_FctList_0x16_TimeOut", 1, profileFile));
putValue(env_FSG_Tel_FctList_0x17_TimeOut,getProfileInt("BAP TEL", "env_FSG_Tel_FctList_0x17_TimeOut", 1, profileFile));
putValue(env_FSG_Tel_FctList_0x18_TimeOut,getProfileInt("BAP TEL", "env_FSG_Tel_FctList_0x18_TimeOut", 1, profileFile));
putValue(env_FSG_Tel_FctList_0x19_TimeOut,getProfileInt("BAP TEL", "env_FSG_Tel_FctList_0x19_TimeOut", 1, profileFile));
putValue(env_FSG_Tel_FctList_0x1A_TimeOut,getProfileInt("BAP TEL", "env_FSG_Tel_FctList_0x1A_TimeOut", 1, profileFile));
putValue(env_FSG_Tel_FctList_0x1B_TimeOut,getProfileInt("BAP TEL", "env_FSG_Tel_FctList_0x1B_TimeOut", 1, profileFile));
putValue(env_FSG_Tel_FctList_0x1C_TimeOut,getProfileInt("BAP TEL", "env_FSG_Tel_FctList_0x1C_TimeOut", 1, profileFile));
putValue(env_FSG_Tel_FctList_0x1D_TimeOut,getProfileInt("BAP TEL", "env_FSG_Tel_FctList_0x1D_TimeOut", 1, profileFile));
putValue(env_FSG_Tel_FctList_0x1E_TimeOut,getProfileInt("BAP TEL", "env_FSG_Tel_FctList_0x1E_TimeOut", 1, profileFile));
putValue(env_FSG_Tel_FctList_0x1F_TimeOut,getProfileInt("BAP TEL", "env_FSG_Tel_FctList_0x1F_TimeOut", 1, profileFile));
putValue(env_FSG_Tel_FctList_0x20_TimeOut,getProfileInt("BAP TEL", "env_FSG_Tel_FctList_0x20_TimeOut", 1, profileFile));
putValue(env_FSG_Tel_FctList_0x21_TimeOut,getProfileInt("BAP TEL", "env_FSG_Tel_FctList_0x21_TimeOut", 1, profileFile));
putValue(env_FSG_Tel_FctList_0x23_TimeOut,getProfileInt("BAP TEL", "env_FSG_Tel_FctList_0x23_TimeOut", 1, profileFile));
putValue(env_FSG_Tel_FctList_0x24_TimeOut,getProfileInt("BAP TEL", "env_FSG_Tel_FctList_0x24_TimeOut", 1, profileFile));
putValue(env_FSG_Tel_FctList_0x25_TimeOut,getProfileInt("BAP TEL", "env_FSG_Tel_FctList_0x25_TimeOut", 1, profileFile));
putValue(env_FSG_Tel_FctList_0x26_TimeOut,getProfileInt("BAP TEL", "env_FSG_Tel_FctList_0x26_TimeOut", 1, profileFile));
putValue(env_FSG_Tel_FctList_0x27_TimeOut,getProfileInt("BAP TEL", "env_FSG_Tel_FctList_0x27_TimeOut", 1, profileFile));
putValue(env_FSG_Tel_FctList_0x28_TimeOut,getProfileInt("BAP TEL", "env_FSG_Tel_FctList_0x28_TimeOut", 1, profileFile));
putValue(env_FSG_Tel_FctList_0x29_TimeOut,getProfileInt("BAP TEL", "env_FSG_Tel_FctList_0x29_TimeOut", 1, profileFile));
putValue(env_FSG_Tel_FctList_0x2A_TimeOut,getProfileInt("BAP TEL", "env_FSG_Tel_FctList_0x2A_TimeOut", 1, profileFile));
putValue(env_FSG_Tel_FctList_0x2B_TimeOut,getProfileInt("BAP TEL", "env_FSG_Tel_FctList_0x2B_TimeOut", 1, profileFile));
putValue(env_FSG_Tel_FctList_0x2C_TimeOut,getProfileInt("BAP TEL", "env_FSG_Tel_FctList_0x2C_TimeOut", 1, profileFile));
putValue(env_FSG_Tel_FctList_0x2D_TimeOut,getProfileInt("BAP TEL", "env_FSG_Tel_FctList_0x2D_TimeOut", 1, profileFile));
putValue(env_FSG_Tel_FctList_0x2E_TimeOut,getProfileInt("BAP TEL", "env_FSG_Tel_FctList_0x2E_TimeOut", 1, profileFile));
putValue(env_FSG_Tel_FctList_0x2F_TimeOut,getProfileInt("BAP TEL", "env_FSG_Tel_FctList_0x2F_TimeOut", 1, profileFile));
putValue(env_FSG_Tel_FctList_0x30_TimeOut,getProfileInt("BAP TEL", "env_FSG_Tel_FctList_0x30_TimeOut", 1, profileFile));
putValue(env_FSG_Tel_FctList_0x31_TimeOut,getProfileInt("BAP TEL", "env_FSG_Tel_FctList_0x31_TimeOut", 1, profileFile));
putValue(env_FSG_Tel_FctList_0x32_TimeOut,getProfileInt("BAP TEL", "env_FSG_Tel_FctList_0x32_TimeOut", 1, profileFile));
putValue(env_FSG_Tel_FctList_0x33_TimeOut,getProfileInt("BAP TEL", "env_FSG_Tel_FctList_0x33_TimeOut", 1, profileFile));
putValue(env_FSG_Tel_FctList_0x34_TimeOut,getProfileInt("BAP TEL", "env_FSG_Tel_FctList_0x34_TimeOut", 1, profileFile));
putValue(env_FSG_Tel_FctList_0x35_TimeOut,getProfileInt("BAP TEL", "env_FSG_Tel_FctList_0x35_TimeOut", 1, profileFile));
putValue(env_FSG_Tel_FctList_0x36_TimeOut,getProfileInt("BAP TEL", "env_FSG_Tel_FctList_0x36_TimeOut", 1, profileFile));
putValue(env_FSG_Tel_FctList_0x37_TimeOut,getProfileInt("BAP TEL", "env_FSG_Tel_FctList_0x37_TimeOut", 1, profileFile));
putValue(env_FSG_Tel_FctList_0x38_TimeOut,getProfileInt("BAP TEL", "env_FSG_Tel_FctList_0x38_TimeOut", 1, profileFile));
putValue(env_FSG_Tel_FctList_0x39_TimeOut,getProfileInt("BAP TEL", "env_FSG_Tel_FctList_0x39_TimeOut", 1, profileFile));
putValue(env_FSG_Tel_FctList_0x3A_TimeOut,getProfileInt("BAP TEL", "env_FSG_Tel_FctList_0x3A_TimeOut", 1, profileFile));
putValue(env_FSG_Tel_FctList_0x1A_3min_TO,getProfileInt("BAP TEL", "env_FSG_Tel_FctList_0x1A_3min_TO", 1, profileFile));
putValue(env_FSG_Tel_FctList_0x1E_3min_TO,getProfileInt("BAP TEL", "env_FSG_Tel_FctList_0x1E_3min_TO", 1, profileFile));
putValue(env_FSG_Tel_FctList_0x20_3min_TO,getProfileInt("BAP TEL", "env_FSG_Tel_FctList_0x20_3min_TO", 1, profileFile));
putValue(env_FSG_Tel_FctList_0x1F_3min_TO,getProfileInt("BAP TEL", "env_FSG_Tel_FctList_0x1F_3min_TO", 1, profileFile));
putValue(env_FSG_Tel_FctList_0x1B_3min_TO,getProfileInt("BAP TEL", "env_FSG_Tel_FctList_0x1B_3min_TO", 1, profileFile));
    putValue(env_FSG_Tel_FctList_0x1D_3min_TO,getProfileInt("BAP TEL", "env_FSG_Tel_FctList_0x1D_3min_TO", 1, profileFile));
    putValue(env_FSG_Tel_FctList_0x23_3min_TO,getProfileInt("BAP TEL", "env_FSG_Tel_FctList_0x23_3min_TO", 1, profileFile));
    putValue(env_FSG_Tel_FctList_0x24_3min_TO,getProfileInt("BAP TEL", "env_FSG_Tel_FctList_0x24_3min_TO", 1, profileFile));
    putValue(env_FSG_Tel_FctList_0x25_3min_TO,getProfileInt("BAP TEL", "env_FSG_Tel_FctList_0x25_3min_TO", 1, profileFile));
    putValue(env_FSG_Tel_FctList_0x35_3min_TO,getProfileInt("BAP TEL", "env_FSG_Tel_FctList_0x35_3min_TO", 1, profileFile));
    putValue(env_FSG_Tel_FctList_0x1C_3min_TO,getProfileInt("BAP TEL", "env_FSG_Tel_FctList_0x1C_3min_TO", 1, profileFile));
    putValue(env_FSG_Tel_FctList_0x28_3min_TO,getProfileInt("BAP TEL", "env_FSG_Tel_FctList_0x28_3min_TO", 1, profileFile));
    putValue(env_FSG_Tel_FctList_0x26_3min_TO,getProfileInt("BAP TEL", "env_FSG_Tel_FctList_0x26_3min_TO", 1, profileFile));
    putValue(env_FSG_Tel_FctList_0x27_3min_TO,getProfileInt("BAP TEL", "env_FSG_Tel_FctList_0x27_3min_TO", 1, profileFile));
    putValue(env_FSG_Tel_FctList_0x36_3min_TO,getProfileInt("BAP TEL", "env_FSG_Tel_FctList_0x36_3min_TO", 1, profileFile));
}

//IssueList #200 - Addition of LoadAll button
void loadBAP_buttonSettings( char profileFile[] )
{
    putValue( ON_OFF_ASG15_2, getProfileInt( "BAP", "ON_OFF_ASG15_2", 1, profileFile ) );
    putValue( ON_OFF_ASG17_1, getProfileInt( "BAP", "ON_OFF_ASG17_1", 1, profileFile ) );
    putValue( ON_OFF_ASG18_1, getProfileInt( "BAP", "ON_OFF_ASG18_1", 1, profileFile ) );
    putValue( ON_OFF_ASG19_4, getProfileInt( "BAP", "ON_OFF_ASG19_4", 1, profileFile ) );
    putValue( ON_OFF_ASG69_1, getProfileInt( "BAP", "ON_OFF_ASG69_1", 1, profileFile ) );
    putValue( env_DisplayConfig_v100_PowerOnOff, getProfileInt( "BAP", "env_DisplayConfig_v100_PowerOnOff", 1, profileFile ) );

//    putValue( ON_OFF_FSG1_0,  getProfileInt( "BAP", "ON_OFF_FSG1_0",  1, profileFile ) );
//    putValue( ON_OFF_FSG2_0,  getProfileInt( "BAP", "ON_OFF_FSG2_0",  1, profileFile ) );
    putValue( ON_OFF_FSG7_0,  getProfileInt( "BAP", "ON_OFF_FSG7_0",  1, profileFile ) );
//    putValue( ON_OFF_FSG8_0,  getProfileInt( "BAP", "ON_OFF_FSG8_0",  1, profileFile ) );
//    putValue( ON_OFF_FSG9_0,  getProfileInt( "BAP", "ON_OFF_FSG9_0",  1, profileFile ) );
//    putValue( ON_OFF_FSG13_0, getProfileInt( "BAP", "ON_OFF_FSG13_0", 1, profileFile ) );
//    putValue( ON_OFF_FSG23_0, getProfileInt( "BAP", "ON_OFF_FSG23_0", 1, profileFile ) );
    putValue( ON_OFF_FSG25_0, getProfileInt( "BAP", "ON_OFF_FSG25_0", 1, profileFile ) );
    putValue( ON_OFF_FSG26_0, getProfileInt( "BAP", "ON_OFF_FSG26_0", 1, profileFile ) );
    putValue( ON_OFF_FSG27_0, getProfileInt( "BAP", "ON_OFF_FSG27_0", 1, profileFile ) );
    putValue( ON_OFF_FSG29_0, getProfileInt( "BAP", "ON_OFF_FSG29_0", 1, profileFile ) );
//    putValue( ON_OFF_FSG31_0, getProfileInt( "BAP", "ON_OFF_FSG31_0", 1, profileFile ) );
    putValue( ON_OFF_FSG33_0, getProfileInt( "BAP", "ON_OFF_FSG33_0", 1, profileFile ) );
    putValue( ON_OFF_FSG35_0, getProfileInt( "BAP", "ON_OFF_FSG35_0", 1, profileFile ) );
    putValue( ON_OFF_FSG39_0, getProfileInt( "BAP", "ON_OFF_FSG39_0", 1, profileFile ) );
    putValue( ON_OFF_FSG40_0, getProfileInt( "BAP", "ON_OFF_FSG40_0", 1, profileFile ) );
    putValue( ON_OFF_FSG41_0, getProfileInt( "BAP", "ON_OFF_FSG41_0", 1, profileFile ) );
    putValue( ON_OFF_FSG42_0, getProfileInt( "BAP", "ON_OFF_FSG42_0", 1, profileFile ) );
    putValue( ON_OFF_FSG49_0, getProfileInt( "BAP", "ON_OFF_FSG49_0", 1, profileFile ) );
    putValue( ON_OFF_FSG50_0, getProfileInt( "BAP", "ON_OFF_FSG50_0", 1, profileFile ) );
    putValue( ON_OFF_FSG52_0, getProfileInt( "BAP", "ON_OFF_FSG52_0", 1, profileFile ) );
    putValue( ON_OFF_FSG58_0, getProfileInt( "BAP", "ON_OFF_FSG58_0", 1, profileFile ) );
    putValue( ON_OFF_FSG60_0, getProfileInt( "BAP", "ON_OFF_FSG60_0", 1, profileFile ) );
 //   putValue( ON_OFF_FSG66_0, getProfileInt( "BAP", "ON_OFF_FSG66_0", 1, profileFile ) );
    putValue( ON_OFF_FSG70_0, getProfileInt( "BAP", "ON_OFF_FSG70_0", 1, profileFile ) );
    putValue( ON_OFF_FSG82_0, getProfileInt( "BAP", "ON_OFF_FSG82_0", 1, profileFile ) );
    putValue( env_NaviSD_PowerOnOff, getProfileInt( "BAP", "env_NaviSD_PowerOnOff", 1, profileFile ) );
    putValue( env_AudioSD_PowerOnOff, getProfileInt( "BAP", "env_AudioSD_PowerOnOff", 1, profileFile ) );
    putValue( env_FSG_Schalter_OnOff, getProfileInt( "BAP", "env_FSG_Schalter_OnOff", 1, profileFile ) );
    putValue( env_SDS_v100_PowerOnOff, getProfileInt( "BAP", "env_SDS_v100_PowerOnOff", 1, profileFile ) );
    putValue( ON_OFF_BAP_LoadSave_INI, getProfileInt( "BAP", "ON_OFF_BAP_LoadSave_INI", 1, profileFile ) );
}

void loadAllSettings( char profileFile[] )
{
    loadBAP_buttonSettings( profileFile );
    loadBAP_OtherSettings( profileFile );
}

on EnvVar eLoadAllSettings
{

  char orgfile[1024];   // original filename/path
  char modfile[1024];   // modified name
  char modpath[1024];   // modified path
  dword handle;         // fileread result
  int orgidx;           // original file array index
  int nameidx;          // modified name index
  int pathidx;          // modified path index
  int bslctr;           // backslash counter     (to find how many)
  int bslctr2;          // backslash counter2    (to know when filename starts)
  int ctr;              // general purpose counter

  // init arrays
  for (ctr = 0; ctr < 1024; ctr++)
  {
    orgfile[ctr] = 0;   // init original filename/path
    modfile[ctr] = 0;   // init modified filename
    modpath[ctr] = 0;   // init modified path
  }

  if (getValue( this ))
  {
    getValue( eLoadSettingsFile, orgfile );

    // count the number of "backslash"
    bslctr = 0;
    orgidx = 0;
    while (orgfile[orgidx] != 0)
    {
      if (orgfile[orgidx] == 0x5C)
      {
        bslctr++;   // backslash counter
      }
      orgidx++;
    }

    // store path and filename
    orgidx = 0;
    bslctr2 = 0;
    pathidx = 0;
    nameidx = 0;
    while (orgfile[orgidx] != 0)
    {
      if (bslctr2 != bslctr)    // store path until last backslash
      {
        if (orgfile[orgidx] == 0x5C)
        {
          bslctr2++;
        }
        // store path
        modpath[pathidx] = orgfile[orgidx];
        pathidx++;
      }
      else
      {
        // store filename
        modfile[nameidx] = orgfile[orgidx];
        nameidx++;
      }
      orgidx++;
    }

    setFilePath(modpath, 0);      //set path for *.ini file
    handle = openFileRead( modfile, 1 );

    if (handle > 0)
    {
      fileClose( handle );
      loadAllSettings( modfile );
      strncat( modfile, " LOADED", elcount( modfile ) );

    }
    else
    {
      strncat( modfile, " NOT FOUND", elcount( modfile ) );
    }
    putValue( eSettingsResult, modfile );
  }
}

on EnvVar eSaveAllSettings
{
  char file[1024], filepath[1200], dirpath[1200], StrFileName[100];
  dword handle, i =0, j =0, index =0, StrLength =0;

  if (getValue( this ))
  {
    getValue( eSaveSettingsFile, file );

    //write("\n Selected file path is %s", file);

    while(file[i] != '\0')
    {
        if (file[i] != '\\')
        {
            filepath[j] = file[i];
            j++;
            i++;
        }
        else
        {
            index = j;
            filepath[j] = file[i];
            filepath[j+1] = file[i];
            j+=2;
            i++;
        }
    }

    filepath[j] = '\0';
    StrLength = strlen(filepath);

    for(i=0; i<index; i++)
    {
        dirpath[i] = filepath[i];
    }
    dirpath[i] = '\0';

    j=0;
    for(i=index+2; i<StrLength; i++)
    {
        StrFileName[j] = filepath[i];
        j++;
    }

    StrFileName[j] = '\0';

    setWritePath(dirpath);

    saveAllSettings(StrFileName);

    if (writeProfileInt( "Settings", "Test", 1, StrFileName ) == 0)
    {
      strncat( StrFileName, " NOT", elcount( StrFileName ) );
    }
    strncat( StrFileName, " WRITTEN", elcount( StrFileName ) );
    putValue( eSettingsResult, StrFileName );

    file[0] = '\0';
    filepath[0] = '\0';
    dirpath[0] = '\0';
    StrFileName[0] = '\0';
    i=j=index=StrLength=0;

    setWritePath("");
  }
}

void saveBAP_audioSettings( char profile[] )
{
  //BAP AUDIO
writeProfileInt( "BAP AUDIO", "env_AudioSD_ASGCapa_PresCa_SDARS", getValue(env_AudioSD_ASGCapa_PresCa_SDARS), profile);
writeProfileInt( "BAP AUDIO", "env_AudioSD_CSI_StProp_Station", getValue(env_AudioSD_CSI_StProp_Station), profile);
writeProfileInt( "BAP AUDIO", "env_AudioSD_CSI_StProp_AuSignal", getValue(env_AudioSD_CSI_StProp_AuSignal), profile);
writeProfileInt( "BAP AUDIO", "env_AudioSD_FSGSetup_OnRL", getValue(env_AudioSD_FSGSetup_OnRL), profile);
writeProfileInt( "BAP AUDIO", "env_BAPCFG_FSG_AudioSD_ErrEn", getValue(env_BAPCFG_FSG_AudioSD_ErrEn), profile);
writeProfileInt( "BAP AUDIO", "env_AudioSD_FctList_0x01_TimeOut", getValue(env_AudioSD_FctList_0x01_TimeOut), profile);
writeProfileInt( "BAP AUDIO", "env_AudioSD_GIS_OnOff_Reserve2", getValue(env_AudioSD_GIS_OnOff_Reserve2), profile);
writeProfileInt( "BAP AUDIO", "env_AudioSD_GIS_Mod_Reserve2", getValue(env_AudioSD_GIS_Mod_Reserve2), profile);
writeProfileInt( "BAP AUDIO", "env_AudioSD_GIS_Mod_VICS", getValue(env_AudioSD_GIS_Mod_VICS), profile);
writeProfileInt( "BAP AUDIO", "env_AudioSD_GIS_Mod_Reserve1", getValue(env_AudioSD_GIS_Mod_Reserve1), profile);
writeProfileInt( "BAP AUDIO", "env_AudioSD_GIS_OnOff_Reserve1", getValue(env_AudioSD_GIS_OnOff_Reserve1), profile);
writeProfileInt( "BAP AUDIO", "env_AudioSD_GIS_OnOff_OLtraffic", getValue(env_AudioSD_GIS_OnOff_OLtraffic), profile);
writeProfileInt( "BAP AUDIO", "env_AudioSD_Mute_Reserve1", getValue(env_AudioSD_Mute_Reserve1), profile);
writeProfileInt( "BAP AUDIO", "env_FSG_Audio_HB_button", getValue(env_FSG_Audio_HB_button), profile);
writeProfileInt( "BAP AUDIO", "env_FSG_Audio_HB_input", getValue(env_FSG_Audio_HB_input), profile);
writeProfileInt( "BAP AUDIO", "env_Audio_Update_Mode", getValue(env_Audio_Update_Mode), profile);
writeProfileInt( "BAP AUDIO", "env_AudioSD_SourceList_Short", getValue(env_AudioSD_SourceList_Short), profile);
writeProfileInt( "BAP AUDIO", "env_AudioSD_SourceList_Long", getValue(env_AudioSD_SourceList_Long), profile);
writeProfileInt( "BAP AUDIO", "env_AudioSD_MBList_Short", getValue(env_AudioSD_MBList_Short), profile);
writeProfileInt( "BAP AUDIO", "env_AudioSD_MBList_Long", getValue(env_AudioSD_MBList_Long), profile);
writeProfileInt( "BAP AUDIO", "env_AudioSD_FSGSetup_Ext_DAB", getValue(env_AudioSD_FSGSetup_Ext_DAB), profile);
writeProfileInt( "BAP AUDIO", "env_AudioSD_Mute_Reserve2", getValue(env_AudioSD_Mute_Reserve2), profile);
writeProfileInt( "BAP AUDIO", "env_AudioSD_CSI_StProp_IBOC", getValue(env_AudioSD_CSI_StProp_IBOC), profile);
writeProfileInt( "BAP AUDIO", "env_AudioSD_RadioTVPreList_Short", getValue(env_AudioSD_RadioTVPreList_Short), profile);
writeProfileInt( "BAP AUDIO", "env_AudioSD_DABList_Long", getValue(env_AudioSD_DABList_Long), profile);
writeProfileInt( "BAP AUDIO", "env_AudioSD_DABList_Short", getValue(env_AudioSD_DABList_Short), profile);
writeProfileInt( "BAP AUDIO", "env_AudioSD_ReceptionList_Long", getValue(env_AudioSD_ReceptionList_Long), profile);
writeProfileInt( "BAP AUDIO", "env_AudioSD_RadioTVPreList_Long", getValue(env_AudioSD_RadioTVPreList_Long), profile);
writeProfileInt( "BAP AUDIO", "env_AudioSD_ReceptionList_Short", getValue(env_AudioSD_ReceptionList_Short), profile);
writeProfileInt( "BAP AUDIO", "env_AudioSD_MB_CA_switch", getValue(env_AudioSD_MB_CA_switch), profile);
writeProfileInt( "BAP AUDIO", "env_AudioSD_MB_FRU", getValue(env_AudioSD_MB_FRU), profile);
writeProfileInt( "BAP AUDIO", "env_AudioSD_MB_ErrorCode", getValue(env_AudioSD_MB_ErrorCode), profile);
writeProfileInt( "BAP AUDIO", "env_AudioSD_MB_Error_on", getValue(env_AudioSD_MB_Error_on), profile);
writeProfileInt( "BAP AUDIO", "env_AudioSD_RTPL_ErrorCode", getValue(env_AudioSD_RTPL_ErrorCode), profile);
writeProfileInt( "BAP AUDIO", "env_AudioSD_RTPL_Error_on", getValue(env_AudioSD_RTPL_Error_on), profile);
writeProfileInt( "BAP AUDIO", "env_AudioSD_RTPL_CA_switch", getValue(env_AudioSD_RTPL_CA_switch), profile);
writeProfileInt( "BAP AUDIO", "env_AudioSD_RTPL_FRU", getValue(env_AudioSD_RTPL_FRU), profile);
writeProfileInt( "BAP AUDIO", "env_AudioSD_SL_ErrorCode", getValue(env_AudioSD_SL_ErrorCode), profile);
writeProfileInt( "BAP AUDIO", "env_AudioSD_SL_Error_on", getValue(env_AudioSD_SL_Error_on), profile);
writeProfileInt( "BAP AUDIO", "env_AudioSD_SL_CA_switch", getValue(env_AudioSD_SL_CA_switch), profile);
writeProfileInt( "BAP AUDIO", "env_AudioSD_SL_FRU", getValue(env_AudioSD_SL_FRU), profile);
writeProfileInt( "BAP AUDIO", "env_AudioSD_TML_ErrorCode", getValue(env_AudioSD_TML_ErrorCode), profile);
writeProfileInt( "BAP AUDIO", "env_AudioSD_TML_Error_on", getValue(env_AudioSD_TML_Error_on), profile);
writeProfileInt( "BAP AUDIO", "env_AudioSD_TML_CA_switch", getValue(env_AudioSD_TML_CA_switch), profile);
writeProfileInt( "BAP AUDIO", "env_AudioSD_TML_FRU", getValue(env_AudioSD_TML_FRU), profile);
writeProfileInt( "BAP AUDIO", "env_AudioSD_RL_Error_on", getValue(env_AudioSD_RL_Error_on), profile);
writeProfileInt( "BAP AUDIO", "env_AudioSD_RL_ErrorCode", getValue(env_AudioSD_RL_ErrorCode), profile);
writeProfileInt( "BAP AUDIO", "env_AudioSD_RL_FRU", getValue(env_AudioSD_RL_FRU), profile);
writeProfileInt( "BAP AUDIO", "env_AudioSD_RL_CA_switch", getValue(env_AudioSD_RL_CA_switch), profile);
writeProfileInt( "BAP AUDIO", "env_AudioSD_GNLP_ErrorCode", getValue(env_AudioSD_GNLP_ErrorCode), profile);
writeProfileInt( "BAP AUDIO", "env_AudioSD_GNLP_Error_on", getValue(env_AudioSD_GNLP_Error_on), profile);
writeProfileInt( "BAP AUDIO", "env_AudioSD_ASGCapa_ErrorCode", getValue(env_AudioSD_ASGCapa_ErrorCode), profile);
writeProfileInt( "BAP AUDIO", "env_AudioSD_ASGCapa_Error_on", getValue(env_AudioSD_ASGCapa_Error_on), profile);
writeProfileInt( "BAP AUDIO", "env_AudioSD_MFI_ErrorCode", getValue(env_AudioSD_MFI_ErrorCode), profile);
writeProfileInt( "BAP AUDIO", "env_AudioSD_MFI_Error_on", getValue(env_AudioSD_MFI_Error_on), profile);
writeProfileInt( "BAP AUDIO", "env_AudioSD_MBrC_ErrorCode", getValue(env_AudioSD_MBrC_ErrorCode), profile);
writeProfileInt( "BAP AUDIO", "env_AudioSD_MBrC_Error_on", getValue(env_AudioSD_MBrC_Error_on), profile);
writeProfileInt( "BAP AUDIO", "env_AudioSD_SwitchSource_ErrorC", getValue(env_AudioSD_SwitchSource_ErrorC), profile);
writeProfileInt( "BAP AUDIO", "env_AudioSD_SwitchSource_ErrorON", getValue(env_AudioSD_SwitchSource_ErrorON), profile);
writeProfileInt( "BAP AUDIO", "env_AudioSD_AnE_ErrorCode", getValue(env_AudioSD_AnE_ErrorCode), profile);
writeProfileInt( "BAP AUDIO", "env_AudioSD_AnE_Error_on", getValue(env_AudioSD_AnE_Error_on), profile);
writeProfileInt( "BAP AUDIO", "env_AudioSD_GIS_ErrorCode", getValue(env_AudioSD_GIS_ErrorCode), profile);
writeProfileInt( "BAP AUDIO", "env_AudioSD_GIS_Error_on", getValue(env_AudioSD_GIS_Error_on), profile);
writeProfileInt( "BAP AUDIO", "env_AudioSD_DAC_ErrorCode", getValue(env_AudioSD_DAC_ErrorCode), profile);
writeProfileInt( "BAP AUDIO", "env_AudioSD_DAC_Error_on", getValue(env_AudioSD_DAC_Error_on), profile);
writeProfileInt( "BAP AUDIO", "env_AudioSD_SourceState_ErrorC", getValue(env_AudioSD_SourceState_ErrorC), profile);
writeProfileInt( "BAP AUDIO", "env_AudioSD_SourceState_Error_on", getValue(env_AudioSD_SourceState_Error_on), profile);
writeProfileInt( "BAP AUDIO", "env_AudioSD_Mute_ErrorCode", getValue(env_AudioSD_Mute_ErrorCode), profile);
writeProfileInt( "BAP AUDIO", "env_AudioSD_Mute_Error_on", getValue(env_AudioSD_Mute_Error_on), profile);
writeProfileInt( "BAP AUDIO", "env_AudioSD_FctList_0x2C", getValue(env_AudioSD_FctList_0x2C), profile);
writeProfileInt( "BAP AUDIO", "env_AudioSD_FctList_0x2B", getValue(env_AudioSD_FctList_0x2B), profile);
writeProfileInt( "BAP AUDIO", "env_AudioSD_FctList_0x2A", getValue(env_AudioSD_FctList_0x2A), profile);
writeProfileInt( "BAP AUDIO", "env_AudioSD_FctList_0x29", getValue(env_AudioSD_FctList_0x29), profile);
writeProfileInt( "BAP AUDIO", "env_AudioSD_FctList_0x28", getValue(env_AudioSD_FctList_0x28), profile);
writeProfileInt( "BAP AUDIO", "env_AudioSD_FctList_0x27", getValue(env_AudioSD_FctList_0x27), profile);
writeProfileInt( "BAP AUDIO", "env_AudioSD_FctList_0x26", getValue(env_AudioSD_FctList_0x26), profile);
writeProfileInt( "BAP AUDIO", "env_AudioSD_FctList_0x25", getValue(env_AudioSD_FctList_0x25), profile);
writeProfileInt( "BAP AUDIO", "env_AudioSD_FctList_0x24", getValue(env_AudioSD_FctList_0x24), profile);
writeProfileInt( "BAP AUDIO", "env_AudioSD_FctList_0x23", getValue(env_AudioSD_FctList_0x23), profile);
writeProfileInt( "BAP AUDIO", "env_AudioSD_FctList_0x22", getValue(env_AudioSD_FctList_0x22), profile);
writeProfileInt( "BAP AUDIO", "env_AudioSD_FctList_0x21", getValue(env_AudioSD_FctList_0x21), profile);
writeProfileInt( "BAP AUDIO", "env_AudioSD_FctList_0x20", getValue(env_AudioSD_FctList_0x20), profile);
writeProfileInt( "BAP AUDIO", "env_AudioSD_FctList_0x1F", getValue(env_AudioSD_FctList_0x1F), profile);
writeProfileInt( "BAP AUDIO", "env_AudioSD_FctList_0x1E", getValue(env_AudioSD_FctList_0x1E), profile);
writeProfileInt( "BAP AUDIO", "env_AudioSD_FctList_0x1D", getValue(env_AudioSD_FctList_0x1D), profile);
writeProfileInt( "BAP AUDIO", "env_AudioSD_FctList_0x1C", getValue(env_AudioSD_FctList_0x1C), profile);
writeProfileInt( "BAP AUDIO", "env_AudioSD_FctList_0x1B", getValue(env_AudioSD_FctList_0x1B), profile);
writeProfileInt( "BAP AUDIO", "env_AudioSD_FctList_0x1A", getValue(env_AudioSD_FctList_0x1A), profile);
writeProfileInt( "BAP AUDIO", "env_AudioSD_FctList_0x19", getValue(env_AudioSD_FctList_0x19), profile);
writeProfileInt( "BAP AUDIO", "env_AudioSD_FctList_0x18", getValue(env_AudioSD_FctList_0x18), profile);
writeProfileInt( "BAP AUDIO", "env_AudioSD_FctList_0x17", getValue(env_AudioSD_FctList_0x17), profile);
writeProfileInt( "BAP AUDIO", "env_AudioSD_FctList_0x16", getValue(env_AudioSD_FctList_0x16), profile);
writeProfileInt( "BAP AUDIO", "env_AudioSD_FctList_0x15", getValue(env_AudioSD_FctList_0x15), profile);
writeProfileInt( "BAP AUDIO", "env_AudioSD_FctList_0x14", getValue(env_AudioSD_FctList_0x14), profile);
writeProfileInt( "BAP AUDIO", "env_AudioSD_FctList_0x13", getValue(env_AudioSD_FctList_0x13), profile);
writeProfileInt( "BAP AUDIO", "env_AudioSD_FctList_0x12", getValue(env_AudioSD_FctList_0x12), profile);
writeProfileInt( "BAP AUDIO", "env_AudioSD_FctList_0x11", getValue(env_AudioSD_FctList_0x11), profile);
writeProfileInt( "BAP AUDIO", "env_AudioSD_FctList_0x10", getValue(env_AudioSD_FctList_0x10), profile);
writeProfileInt( "BAP AUDIO", "env_AudioSD_FctList_0x0F", getValue(env_AudioSD_FctList_0x0F), profile);
writeProfileInt( "BAP AUDIO", "env_AudioSD_FctList_0x0E", getValue(env_AudioSD_FctList_0x0E), profile);
writeProfileInt( "BAP AUDIO", "env_AudioSD_FctList_0x04", getValue(env_AudioSD_FctList_0x04), profile);
writeProfileInt( "BAP AUDIO", "env_AudioSD_FctList_0x03", getValue(env_AudioSD_FctList_0x03), profile);
writeProfileInt( "BAP AUDIO", "env_AudioSD_FctList_0x02", getValue(env_AudioSD_FctList_0x02), profile);
writeProfileInt( "BAP AUDIO", "env_AudioSD_FctList_0x01", getValue(env_AudioSD_FctList_0x01), profile);
writeProfileInt( "BAP AUDIO", "env_AudioSD_TML_AH_IS", getValue(env_AudioSD_TML_AH_IS), profile);
writeProfileInt( "BAP AUDIO", "env_AudioSD_RTPL_AH_IS", getValue(env_AudioSD_RTPL_AH_IS), profile);
writeProfileInt( "BAP AUDIO", "env_AudioSD_MB_reload", getValue(env_AudioSD_MB_reload), profile);
writeProfileInt( "BAP AUDIO", "env_AudioSD_MB_DataSource", getValue(env_AudioSD_MB_DataSource), profile);
writeProfileInt( "BAP AUDIO", "env_AudioSD_MB_StatusArray", getValue(env_AudioSD_MB_StatusArray), profile);
writeProfileInt( "BAP AUDIO", "env_AudioSD_MB_CA", getValue(env_AudioSD_MB_CA), profile);
writeProfileInt( "BAP AUDIO", "env_AudioSD_MB_AH_elements", getValue(env_AudioSD_MB_AH_elements), profile);
writeProfileInt( "BAP AUDIO", "env_AudioSD_MB_AH_start", getValue(env_AudioSD_MB_AH_start), profile);
writeProfileInt( "BAP AUDIO", "env_AudioSD_MB_AH_RA", getValue(env_AudioSD_MB_AH_RA), profile);
writeProfileInt( "BAP AUDIO", "env_AudioSD_MB_AH_IS", getValue(env_AudioSD_MB_AH_IS), profile);
writeProfileInt( "BAP AUDIO", "env_AudioSD_MB_AH_POS", getValue(env_AudioSD_MB_AH_POS), profile);
writeProfileInt( "BAP AUDIO", "env_AudioSD_MB_AH_dir", getValue(env_AudioSD_MB_AH_dir), profile);
writeProfileInt( "BAP AUDIO", "env_AudioSD_MB_AH_shift", getValue(env_AudioSD_MB_AH_shift), profile);
writeProfileInt( "BAP AUDIO", "env_AudioSD_MB_TotalNumLE", getValue(env_AudioSD_MB_TotalNumLE), profile);
writeProfileInt( "BAP AUDIO", "env_AudioSD_MB_ActiveListPos", getValue(env_AudioSD_MB_ActiveListPos), profile);
writeProfileInt( "BAP AUDIO", "env_AudioSD_MB_TAID", getValue(env_AudioSD_MB_TAID), profile);
writeProfileInt( "BAP AUDIO", "env_AudioSD_MB_ASGID", getValue(env_AudioSD_MB_ASGID), profile);
writeProfileInt( "BAP AUDIO", "env_AudioSD_ErrorGen_send", getValue(env_AudioSD_ErrorGen_send), profile);
writeProfileInt( "BAP AUDIO", "env_AudioSD_ErrorGen_ErrorCode_h", getValue(env_AudioSD_ErrorGen_ErrorCode_h), profile);
writeProfileInt( "BAP AUDIO", "env_AudioSD_ErrorGen_ErrorCode", getValue(env_AudioSD_ErrorGen_ErrorCode), profile);
writeProfileInt( "BAP AUDIO", "env_AudioSD_ErrorGen_FctID", getValue(env_AudioSD_ErrorGen_FctID), profile);
writeProfileInt( "BAP AUDIO", "env_AudioSD_TML_TotalNumLE", getValue(env_AudioSD_TML_TotalNumLE), profile);
writeProfileInt( "BAP AUDIO", "env_AudioSD_TML_TAID", getValue(env_AudioSD_TML_TAID), profile);
writeProfileInt( "BAP AUDIO", "env_AudioSD_TML_StatusArray", getValue(env_AudioSD_TML_StatusArray), profile);
writeProfileInt( "BAP AUDIO", "env_AudioSD_TML_reload", getValue(env_AudioSD_TML_reload), profile);

writeProfileInt( "BAP AUDIO", "env_AudioSD_TML_CA", getValue(env_AudioSD_TML_CA), profile);
writeProfileInt( "BAP AUDIO", "env_AudioSD_TML_ASGID", getValue(env_AudioSD_TML_ASGID), profile);
writeProfileInt( "BAP AUDIO", "env_AudioSD_TML_AH_start", getValue(env_AudioSD_TML_AH_start), profile);
writeProfileInt( "BAP AUDIO", "env_AudioSD_TML_AH_shift", getValue(env_AudioSD_TML_AH_shift), profile);
writeProfileInt( "BAP AUDIO", "env_AudioSD_TML_AH_RA", getValue(env_AudioSD_TML_AH_RA), profile);
writeProfileInt( "BAP AUDIO", "env_AudioSD_TML_AH_POS", getValue(env_AudioSD_TML_AH_POS), profile);
writeProfileInt( "BAP AUDIO", "env_AudioSD_TML_AH_elements", getValue(env_AudioSD_TML_AH_elements), profile);
writeProfileInt( "BAP AUDIO", "env_AudioSD_TML_AH_dir", getValue(env_AudioSD_TML_AH_dir), profile);
writeProfileInt( "BAP AUDIO", "env_AudioSD_RTPL_TotalNumLE", getValue(env_AudioSD_RTPL_TotalNumLE), profile);
writeProfileInt( "BAP AUDIO", "env_AudioSD_RTPL_TAID", getValue(env_AudioSD_RTPL_TAID), profile);
writeProfileInt( "BAP AUDIO", "env_AudioSD_RTPL_StatusArray", getValue(env_AudioSD_RTPL_StatusArray), profile);
writeProfileInt( "BAP AUDIO", "env_AudioSD_RTPL_reload", getValue(env_AudioSD_RTPL_reload), profile);
writeProfileInt( "BAP AUDIO", "env_AudioSD_RTPL_CA", getValue(env_AudioSD_RTPL_CA), profile);
writeProfileInt( "BAP AUDIO", "env_AudioSD_RTPL_ASGID", getValue(env_AudioSD_RTPL_ASGID), profile);
writeProfileInt( "BAP AUDIO", "env_AudioSD_RTPL_AH_start", getValue(env_AudioSD_RTPL_AH_start), profile);
writeProfileInt( "BAP AUDIO", "env_AudioSD_RTPL_AH_shift", getValue(env_AudioSD_RTPL_AH_shift), profile);
writeProfileInt( "BAP AUDIO", "env_AudioSD_RTPL_AH_RA", getValue(env_AudioSD_RTPL_AH_RA), profile);
writeProfileInt( "BAP AUDIO", "env_AudioSD_RTPL_AH_POS", getValue(env_AudioSD_RTPL_AH_POS), profile);
writeProfileInt( "BAP AUDIO", "env_AudioSD_RTPL_AH_elements", getValue(env_AudioSD_RTPL_AH_elements), profile);
writeProfileInt( "BAP AUDIO", "env_AudioSD_RTPL_AH_dir", getValue(env_AudioSD_RTPL_AH_dir), profile);
writeProfileInt( "BAP AUDIO", "env_AudioSD_SL_reload", getValue(env_AudioSD_SL_reload), profile);
writeProfileInt( "BAP AUDIO", "env_AudioSD_SL_StatusArray", getValue(env_AudioSD_SL_StatusArray), profile);
writeProfileInt( "BAP AUDIO", "env_AudioSD_SL_CA", getValue(env_AudioSD_SL_CA), profile);
writeProfileInt( "BAP AUDIO", "env_AudioSD_SL_AH_elements", getValue(env_AudioSD_SL_AH_elements), profile);
writeProfileInt( "BAP AUDIO", "env_AudioSD_SL_AH_start", getValue(env_AudioSD_SL_AH_start), profile);
writeProfileInt( "BAP AUDIO", "env_AudioSD_SL_AH_RA", getValue(env_AudioSD_SL_AH_RA), profile);
writeProfileInt( "BAP AUDIO", "env_AudioSD_SL_AH_IS", getValue(env_AudioSD_SL_AH_IS), profile);
writeProfileInt( "BAP AUDIO", "env_AudioSD_SL_AH_POS", getValue(env_AudioSD_SL_AH_POS), profile);
writeProfileInt( "BAP AUDIO", "env_AudioSD_SL_AH_dir", getValue(env_AudioSD_SL_AH_dir), profile);
writeProfileInt( "BAP AUDIO", "env_AudioSD_SL_AH_shift", getValue(env_AudioSD_SL_AH_shift), profile);
writeProfileInt( "BAP AUDIO", "env_AudioSD_SL_TotalNumLE", getValue(env_AudioSD_SL_TotalNumLE), profile);
writeProfileInt( "BAP AUDIO", "env_AudioSD_SL_TAID", getValue(env_AudioSD_SL_TAID), profile);
writeProfileInt( "BAP AUDIO", "env_AudioSD_SL_ASGID", getValue(env_AudioSD_SL_ASGID), profile);
writeProfileInt( "BAP AUDIO", "env_AudioSD_RL_reload", getValue(env_AudioSD_RL_reload), profile);
writeProfileInt( "BAP AUDIO", "env_AudioSD_RL_StatusArray", getValue(env_AudioSD_RL_StatusArray), profile);
writeProfileInt( "BAP AUDIO", "env_AudioSD_RL_CA", getValue(env_AudioSD_RL_CA), profile);
writeProfileInt( "BAP AUDIO", "env_AudioSD_RL_AH_elements", getValue(env_AudioSD_RL_AH_elements), profile);
writeProfileInt( "BAP AUDIO", "env_AudioSD_RL_AH_start", getValue(env_AudioSD_RL_AH_start), profile);
writeProfileInt( "BAP AUDIO", "env_AudioSD_RL_AH_RA", getValue(env_AudioSD_RL_AH_RA), profile);
writeProfileInt( "BAP AUDIO", "env_AudioSD_RL_AH_IS", getValue(env_AudioSD_RL_AH_IS), profile);
writeProfileInt( "BAP AUDIO", "env_AudioSD_RL_AH_POS", getValue(env_AudioSD_RL_AH_POS), profile);
writeProfileInt( "BAP AUDIO", "env_AudioSD_RL_AH_dir", getValue(env_AudioSD_RL_AH_dir), profile);
writeProfileInt( "BAP AUDIO", "env_AudioSD_RL_AH_shift", getValue(env_AudioSD_RL_AH_shift), profile);
writeProfileInt( "BAP AUDIO", "env_AudioSD_RL_ElementType", getValue(env_AudioSD_RL_ElementType), profile);
writeProfileInt( "BAP AUDIO", "env_AudioSD_RL_TotalNumLE", getValue(env_AudioSD_RL_TotalNumLE), profile);
writeProfileInt( "BAP AUDIO", "env_AudioSD_RL_ParentID", getValue(env_AudioSD_RL_ParentID), profile);
writeProfileInt( "BAP AUDIO", "env_AudioSD_RL_TAID", getValue(env_AudioSD_RL_TAID), profile);
writeProfileInt( "BAP AUDIO", "env_AudioSD_RL_ASGID", getValue(env_AudioSD_RL_ASGID), profile);
writeProfileInt( "BAP AUDIO", "env_AudioSD_GNLP_Offset", getValue(env_AudioSD_GNLP_Offset), profile);
writeProfileInt( "BAP AUDIO", "env_AudioSD_GNLP_absPos", getValue(env_AudioSD_GNLP_absPos), profile);
writeProfileInt( "BAP AUDIO", "env_AudioSD_GNLP_nextPos", getValue(env_AudioSD_GNLP_nextPos), profile);
writeProfileInt( "BAP AUDIO", "env_AudioSD_GNLP_CurrPos", getValue(env_AudioSD_GNLP_CurrPos), profile);
writeProfileInt( "BAP AUDIO", "env_AudioSD_GNLP_Result", getValue(env_AudioSD_GNLP_Result), profile);
writeProfileInt( "BAP AUDIO", "env_AudioSD_GNLP_Abort", getValue(env_AudioSD_GNLP_Abort), profile);
writeProfileInt( "BAP AUDIO", "env_AudioSD_MFI_Abort", getValue(env_AudioSD_MFI_Abort), profile);
writeProfileInt( "BAP AUDIO", "env_AudioSD_MFI_Ref", getValue(env_AudioSD_MFI_Ref), profile);
writeProfileInt( "BAP AUDIO", "env_AudioSD_MFI_Result", getValue(env_AudioSD_MFI_Result), profile);
writeProfileInt( "BAP AUDIO", "env_AudioSD_MBrC_Ref", getValue(env_AudioSD_MBrC_Ref), profile);
writeProfileInt( "BAP AUDIO", "env_AudioSD_MBrC_Abort", getValue(env_AudioSD_MBrC_Abort), profile);
writeProfileInt( "BAP AUDIO", "env_AudioSD_MBrC_Res", getValue(env_AudioSD_MBrC_Res), profile);
writeProfileInt( "BAP AUDIO", "env_AudioSD_AnE_NotActive", getValue(env_AudioSD_AnE_NotActive), profile);
writeProfileInt( "BAP AUDIO", "env_AudioSD_AnE_Abort", getValue(env_AudioSD_AnE_Abort), profile);
writeProfileInt( "BAP AUDIO", "env_AudioSD_AnE_Res", getValue(env_AudioSD_AnE_Res), profile);
writeProfileInt( "BAP AUDIO", "env_AudioSD_MedBrFoLev_Ref_abs", getValue(env_AudioSD_MedBrFoLev_Ref_abs), profile);
writeProfileInt( "BAP AUDIO", "env_AudioSD_FctSync_update", getValue(env_AudioSD_FctSync_update), profile);
writeProfileInt( "BAP AUDIO", "env_AudioSD_FctSync_Bit44_GNLP", getValue(env_AudioSD_FctSync_Bit44_GNLP), profile);
writeProfileInt( "BAP AUDIO", "env_AudioSD_FctSync_Bit43_ASGC", getValue(env_AudioSD_FctSync_Bit43_ASGC), profile);
writeProfileInt( "BAP AUDIO", "env_AudioSD_FctSync_Bit42_FctS", getValue(env_AudioSD_FctSync_Bit42_FctS), profile);
writeProfileInt( "BAP AUDIO", "env_AudioSD_FctSync_Bit41_SDS", getValue(env_AudioSD_FctSync_Bit41_SDS), profile);
writeProfileInt( "BAP AUDIO", "env_AudioSD_FctSync_Bit27_TPmL", getValue(env_AudioSD_FctSync_Bit27_TPmL), profile);
writeProfileInt( "BAP AUDIO", "env_AudioSD_FctSync_Bit40_PrfL", getValue(env_AudioSD_FctSync_Bit40_PrfL), profile);
writeProfileInt( "BAP AUDIO", "env_AudioSD_FctSync_Bit39_MFIn", getValue(env_AudioSD_FctSync_Bit39_MFIn), profile);
writeProfileInt( "BAP AUDIO", "env_AudioSD_FctSync_Bit38_MBCt", getValue(env_AudioSD_FctSync_Bit38_MBCt), profile);
writeProfileInt( "BAP AUDIO", "env_AudioSD_FctSync_Bit37_MPa", getValue(env_AudioSD_FctSync_Bit37_MPa), profile);
writeProfileInt( "BAP AUDIO", "env_AudioSD_FctSync_Bit36_MB", getValue(env_AudioSD_FctSync_Bit36_MB), profile);
writeProfileInt( "BAP AUDIO", "env_AudioSD_FctSync_Bit35_MBFL", getValue(env_AudioSD_FctSync_Bit35_MBFL), profile);
writeProfileInt( "BAP AUDIO", "env_AudioSD_FctSync_Bit34_SwS", getValue(env_AudioSD_FctSync_Bit34_SwS), profile);
writeProfileInt( "BAP AUDIO", "env_AudioSD_FctSync_Bit33_RTPL", getValue(env_AudioSD_FctSync_Bit33_RTPL), profile);
writeProfileInt( "BAP AUDIO", "env_AudioSD_FctSync_Bit32_SL", getValue(env_AudioSD_FctSync_Bit32_SL), profile);
writeProfileInt( "BAP AUDIO", "env_AudioSD_FctSync_Bit31_RLT", getValue(env_AudioSD_FctSync_Bit31_RLT), profile);
writeProfileInt( "BAP AUDIO", "env_AudioSD_FctSync_Bit30_InfS", getValue(env_AudioSD_FctSync_Bit30_InfS), profile);
writeProfileInt( "BAP AUDIO", "env_AudioSD_FctSync_Bit29_AnEs", getValue(env_AudioSD_FctSync_Bit29_AnEs), profile);
writeProfileInt( "BAP AUDIO", "env_AudioSD_FctSync_Bit28_AnIn", getValue(env_AudioSD_FctSync_Bit28_AnIn), profile);
writeProfileInt( "BAP AUDIO", "env_AudioSD_FctSync_Bit26_TPm", getValue(env_AudioSD_FctSync_Bit26_TPm), profile);
writeProfileInt( "BAP AUDIO", "env_AudioSD_FctSync_Bit25_GIS", getValue(env_AudioSD_FctSync_Bit25_GIS), profile);
writeProfileInt( "BAP AUDIO", "env_AudioSD_FctSync_Bit24_DAC", getValue(env_AudioSD_FctSync_Bit24_DAC), profile);
writeProfileInt( "BAP AUDIO", "env_AudioSD_FctSync_Bit23_RL", getValue(env_AudioSD_FctSync_Bit23_RL), profile);
writeProfileInt( "BAP AUDIO", "env_AudioSD_FctSync_Bit22_CSH", getValue(env_AudioSD_FctSync_Bit22_CSH), profile);
writeProfileInt( "BAP AUDIO", "env_AudioSD_FctSync_Bit21_CSI", getValue(env_AudioSD_FctSync_Bit21_CSI), profile);
writeProfileInt( "BAP AUDIO", "env_AudioSD_FctSync_Bit20_SrcS", getValue(env_AudioSD_FctSync_Bit20_SrcS), profile);
writeProfileInt( "BAP AUDIO", "env_AudioSD_FctSync_Bit19_Mute", getValue(env_AudioSD_FctSync_Bit19_Mute), profile);
writeProfileInt( "BAP AUDIO", "env_AudioSD_FctSync_Bit18_cV", getValue(env_AudioSD_FctSync_Bit18_cV), profile);
writeProfileInt( "BAP AUDIO", "env_AudioSD_FctSync_Bit17_aSn", getValue(env_AudioSD_FctSync_Bit17_aSn), profile);
writeProfileInt( "BAP AUDIO", "env_AudioSD_FctSync_Bit16_aS", getValue(env_AudioSD_FctSync_Bit16_aS), profile);
writeProfileInt( "BAP AUDIO", "env_AudioSD_ASGCapa_update", getValue(env_AudioSD_ASGCapa_update), profile);
writeProfileInt( "BAP AUDIO", "env_AudioSD_ASGCapa_PresCa_DAB", getValue(env_AudioSD_ASGCapa_PresCa_DAB), profile);
writeProfileInt( "BAP AUDIO", "env_AudioSD_SDSState_update", getValue(env_AudioSD_SDSState_update), profile);
writeProfileInt( "BAP AUDIO", "env_AudioSD_SDSState_State", getValue(env_AudioSD_SDSState_State), profile);
writeProfileInt( "BAP AUDIO", "env_AudioSD_PreferredList_update", getValue(env_AudioSD_PreferredList_update), profile);
writeProfileInt( "BAP AUDIO", "env_AudioSD_PreferredList_List", getValue(env_AudioSD_PreferredList_List), profile);
writeProfileInt( "BAP AUDIO", "env_AudioSD_MedPath_update", getValue(env_AudioSD_MedPath_update), profile);
writeProfileInt( "BAP AUDIO", "env_AudioSD_MedBrFoLev_update", getValue(env_AudioSD_MedBrFoLev_update), profile);
writeProfileInt( "BAP AUDIO", "env_AudioSD_MedBrFoLev_FolLev", getValue(env_AudioSD_MedBrFoLev_FolLev), profile);
writeProfileInt( "BAP AUDIO", "env_AudioSD_MedBrFoLev_Ref", getValue(env_AudioSD_MedBrFoLev_Ref), profile);
writeProfileInt( "BAP AUDIO", "env_AudioSD_AnInfo_update", getValue(env_AudioSD_AnInfo_update), profile);
writeProfileInt( "BAP AUDIO", "env_AudioSD_AnInfo_Type", getValue(env_AudioSD_AnInfo_Type), profile);
writeProfileInt( "BAP AUDIO", "env_AudioSD_GIS_Mod_OLtraffic", getValue(env_AudioSD_GIS_Mod_OLtraffic), profile);
writeProfileInt( "BAP AUDIO", "env_AudioSD_GIS_Mod_TMC", getValue(env_AudioSD_GIS_Mod_TMC), profile);
writeProfileInt( "BAP AUDIO", "env_AudioSD_GIS_Mod_JPtraffic", getValue(env_AudioSD_GIS_Mod_JPtraffic), profile);
writeProfileInt( "BAP AUDIO", "env_AudioSD_GIS_Mod_RDS", getValue(env_AudioSD_GIS_Mod_RDS), profile);
writeProfileInt( "BAP AUDIO", "env_AudioSD_GIS_Mod_TPTA", getValue(env_AudioSD_GIS_Mod_TPTA), profile);
writeProfileInt( "BAP AUDIO", "env_AudioSD_GIS_OnOff_VICS", getValue(env_AudioSD_GIS_OnOff_VICS), profile);
writeProfileInt( "BAP AUDIO", "env_AudioSD_CSH_update", getValue(env_AudioSD_CSH_update), profile);
writeProfileInt( "BAP AUDIO", "env_AudioSD_CSH_DABEnsAbsPos", getValue(env_AudioSD_CSH_DABEnsAbsPos), profile);
writeProfileInt( "BAP AUDIO", "env_AudioSD_CSH_DABEnsHandle", getValue(env_AudioSD_CSH_DABEnsHandle), profile);
writeProfileInt( "BAP AUDIO", "env_AudioSD_CSH_PresetListAbsPos", getValue(env_AudioSD_CSH_PresetListAbsPos), profile);
writeProfileInt( "BAP AUDIO", "env_AudioSD_CSH_PresetListRef", getValue(env_AudioSD_CSH_PresetListRef), profile);
writeProfileInt( "BAP AUDIO", "env_AudioSD_CSH_FSGAbsPos", getValue(env_AudioSD_CSH_FSGAbsPos), profile);
writeProfileInt( "BAP AUDIO", "env_AudioSD_CSH_FSGhandle", getValue(env_AudioSD_CSH_FSGhandle), profile);
writeProfileInt( "BAP AUDIO", "env_AudioSD_CSI_IBOC", getValue(env_AudioSD_CSI_IBOC), profile);
writeProfileInt( "BAP AUDIO", "env_AudioSD_CSI_VICS", getValue(env_AudioSD_CSI_VICS), profile);
writeProfileInt( "BAP AUDIO", "env_AudioSD_CSI_TMC", getValue(env_AudioSD_CSI_TMC), profile);
writeProfileInt( "BAP AUDIO", "env_AudioSD_CSI_TATP", getValue(env_AudioSD_CSI_TATP), profile);
writeProfileInt( "BAP AUDIO", "env_AudioSD_CSI_StProp_linked", getValue(env_AudioSD_CSI_StProp_linked), profile);
writeProfileInt( "BAP AUDIO", "env_AudioSD_CSI_ChannelID", getValue(env_AudioSD_CSI_ChannelID), profile);
writeProfileInt( "BAP AUDIO", "env_AudioSD_CSI_PIID", getValue(env_AudioSD_CSI_PIID), profile);
writeProfileInt( "BAP AUDIO", "env_AudioSD_CSI_QIType", getValue(env_AudioSD_CSI_QIType), profile);
writeProfileInt( "BAP AUDIO", "env_AudioSD_CSI_TIType", getValue(env_AudioSD_CSI_TIType), profile);
writeProfileInt( "BAP AUDIO", "env_AudioSD_CSI_SIType", getValue(env_AudioSD_CSI_SIType), profile);
writeProfileInt( "BAP AUDIO", "env_AudioSD_CSI_PIType", getValue(env_AudioSD_CSI_PIType), profile);
writeProfileInt( "BAP AUDIO", "env_AudioSD_SourceState_update", getValue(env_AudioSD_SourceState_update), profile);
writeProfileInt( "BAP AUDIO", "env_AudioSD_SourceState_Scope", getValue(env_AudioSD_SourceState_Scope), profile);
writeProfileInt( "BAP AUDIO", "env_AudioSD_Mute_PhoneCall", getValue(env_AudioSD_Mute_PhoneCall), profile);
writeProfileInt( "BAP AUDIO", "env_AudioSD_Mute_SDARS", getValue(env_AudioSD_Mute_SDARS), profile);
writeProfileInt( "BAP AUDIO", "env_AudioSD_Mute_DVB", getValue(env_AudioSD_Mute_DVB), profile);
writeProfileInt( "BAP AUDIO", "env_AudioSD_currentVolume_SdsVol", getValue(env_AudioSD_currentVolume_SdsVol), profile);
writeProfileInt( "BAP AUDIO", "env_AudioSD_currentVolume_PhoVol", getValue(env_AudioSD_currentVolume_PhoVol), profile);
writeProfileInt( "BAP AUDIO", "env_AudioSD_currentVolume_TaVol", getValue(env_AudioSD_currentVolume_TaVol), profile);
writeProfileInt( "BAP AUDIO", "env_AudioSD_currentVolume_NavVol", getValue(env_AudioSD_currentVolume_NavVol), profile);
writeProfileInt( "BAP AUDIO", "env_AudioSD_activeSrc_Type", getValue(env_AudioSD_activeSrc_Type), profile);
writeProfileInt( "BAP AUDIO", "env_AudioSD_activeSrc_number", getValue(env_AudioSD_activeSrc_number), profile);
writeProfileInt( "BAP AUDIO", "env_AudioSD_activeSrc_ListState", getValue(env_AudioSD_activeSrc_ListState), profile);
writeProfileInt( "BAP AUDIO", "env_AudioSD_activeSrc_MedBrList", getValue(env_AudioSD_activeSrc_MedBrList), profile);
writeProfileInt( "BAP AUDIO", "env_AudioSD_activeSrc_PresetList", getValue(env_AudioSD_activeSrc_PresetList), profile);
writeProfileInt( "BAP AUDIO", "env_AudioSD_activeSrc_ReceptList", getValue(env_AudioSD_activeSrc_ReceptList), profile);
writeProfileInt( "BAP AUDIO", "env_AudioSD_activeSrc_TypeOfNum", getValue(env_AudioSD_activeSrc_TypeOfNum), profile);
writeProfileInt( "BAP AUDIO", "env_AudioSD_activeSrc_SLRef", getValue(env_AudioSD_activeSrc_SLRef), profile);
writeProfileInt( "BAP AUDIO", "env_AudioSD_FSGOpState_HMIState", getValue(env_AudioSD_FSGOpState_HMIState), profile);
writeProfileInt( "BAP AUDIO", "env_AudioSD_FSGOpState_update", getValue(env_AudioSD_FSGOpState_update), profile);
writeProfileInt( "BAP AUDIO", "env_AudioSD_FSGSetup_TV", getValue(env_AudioSD_FSGSetup_TV), profile);
writeProfileInt( "BAP AUDIO", "env_AudioSD_FSGSetup_AMSW", getValue(env_AudioSD_FSGSetup_AMSW), profile);
writeProfileInt( "BAP AUDIO", "env_AudioSD_FSGSetup_AMLW", getValue(env_AudioSD_FSGSetup_AMLW), profile);
writeProfileInt( "BAP AUDIO", "env_AudioSD_FSGSetup_SDARS", getValue(env_AudioSD_FSGSetup_SDARS), profile);
writeProfileInt( "BAP AUDIO", "env_AudioSD_FSGSetup_DAB", getValue(env_AudioSD_FSGSetup_DAB), profile);
writeProfileInt( "BAP AUDIO", "env_AudioSD_FSGSetup_AM", getValue(env_AudioSD_FSGSetup_AM), profile);
writeProfileInt( "BAP AUDIO", "env_AudioSD_FSGSetup_FM", getValue(env_AudioSD_FSGSetup_FM), profile);
writeProfileInt( "BAP AUDIO", "env_AudioSD_FSGSetup_SDS", getValue(env_AudioSD_FSGSetup_SDS), profile);
writeProfileInt( "BAP AUDIO", "env_AudioSD_FSGSetup_Phone", getValue(env_AudioSD_FSGSetup_Phone), profile);
writeProfileInt( "BAP AUDIO", "env_AudioSD_FSGSetup_TA", getValue(env_AudioSD_FSGSetup_TA), profile);
writeProfileInt( "BAP AUDIO", "env_AudioSD_FSGSetup_Nav", getValue(env_AudioSD_FSGSetup_Nav), profile);
writeProfileInt( "BAP AUDIO", "env_AudioSD_FSGSetup_entertainm", getValue(env_AudioSD_FSGSetup_entertainm), profile);
writeProfileInt( "BAP AUDIO", "env_AudioSD_DAC_FSGHandle", getValue(env_AudioSD_DAC_FSGHandle), profile);
writeProfileInt( "BAP AUDIO", "env_AudioSD_SwitchSource_Ref", getValue(env_AudioSD_SwitchSource_Ref), profile);
writeProfileInt( "BAP AUDIO", "env_AudioSD_SwitchSource_Abort", getValue(env_AudioSD_SwitchSource_Abort), profile);
writeProfileInt( "BAP AUDIO", "env_AudioSD_SwitchSource_Result", getValue(env_AudioSD_SwitchSource_Result), profile);
writeProfileInt( "BAP AUDIO", "env_AudioSD_RecListType_update", getValue(env_AudioSD_RecListType_update), profile);
writeProfileInt( "BAP AUDIO", "env_AudioSD_Mute_IBOC", getValue(env_AudioSD_Mute_IBOC), profile);
writeProfileInt( "BAP AUDIO", "env_AudioSD_RecListType_Type", getValue(env_AudioSD_RecListType_Type), profile);
writeProfileInt( "BAP AUDIO", "env_AudioSD_Mute_update", getValue(env_AudioSD_Mute_update), profile);
writeProfileInt( "BAP AUDIO", "env_AudioSD_Mute_DAB", getValue(env_AudioSD_Mute_DAB), profile);
writeProfileInt( "BAP AUDIO", "env_AudioSD_DAC_Abort", getValue(env_AudioSD_DAC_Abort), profile);
writeProfileInt( "BAP AUDIO", "env_AudioSD_InfoStates_update", getValue(env_AudioSD_InfoStates_update), profile);
writeProfileInt( "BAP AUDIO", "env_AudioSD_TPMemInfo_update", getValue(env_AudioSD_TPMemInfo_update), profile);
writeProfileInt( "BAP AUDIO", "env_AudioSD_InfoStates_states", getValue(env_AudioSD_InfoStates_states), profile);
writeProfileInt( "BAP AUDIO", "env_AudioSD_TPMemInfo_min", getValue(env_AudioSD_TPMemInfo_min), profile);
writeProfileInt( "BAP AUDIO", "env_AudioSD_TPMemInfo_hour", getValue(env_AudioSD_TPMemInfo_hour), profile);
writeProfileInt( "BAP AUDIO", "env_AudioSD_TPMemInfo_TMN", getValue(env_AudioSD_TPMemInfo_TMN), profile);
writeProfileInt( "BAP AUDIO", "env_AudioSD_TPMemInfo_CMN", getValue(env_AudioSD_TPMemInfo_CMN), profile);
writeProfileInt( "BAP AUDIO", "env_AudioSD_DAC_Res", getValue(env_AudioSD_DAC_Res), profile);
writeProfileInt( "BAP AUDIO", "env_AudioSD_CSI_update", getValue(env_AudioSD_CSI_update), profile);
writeProfileInt( "BAP AUDIO", "env_AudioSD_GIS_update", getValue(env_AudioSD_GIS_update), profile);
writeProfileInt( "BAP AUDIO", "env_AudioSD_GIS_OnOff_TMC", getValue(env_AudioSD_GIS_OnOff_TMC), profile);
writeProfileInt( "BAP AUDIO", "env_AudioSD_GIS_OnOff_JPtraffic", getValue(env_AudioSD_GIS_OnOff_JPtraffic), profile);
writeProfileInt( "BAP AUDIO", "env_AudioSD_GIS_OnOff_RDS", getValue(env_AudioSD_GIS_OnOff_RDS), profile);
writeProfileInt( "BAP AUDIO", "env_AudioSD_GIS_OnOff_TPTA", getValue(env_AudioSD_GIS_OnOff_TPTA), profile);
writeProfileInt( "BAP AUDIO", "env_AudioSD_SourceState_StInfo", getValue(env_AudioSD_SourceState_StInfo), profile);
writeProfileInt( "BAP AUDIO", "env_AudioSD_Mute_Mute", getValue(env_AudioSD_Mute_Mute), profile);
writeProfileInt( "BAP AUDIO", "env_AudioSD_currentVolume_update", getValue(env_AudioSD_currentVolume_update), profile);
writeProfileInt( "BAP AUDIO", "env_AudioSD_currentVolume_Change", getValue(env_AudioSD_currentVolume_Change), profile);
writeProfileInt( "BAP AUDIO", "env_AudioSD_currentVolume_EntVol", getValue(env_AudioSD_currentVolume_EntVol), profile);
writeProfileInt( "BAP AUDIO", "env_AudioSD_activeSourceName_up", getValue(env_AudioSD_activeSourceName_up), profile);
writeProfileInt( "BAP AUDIO", "env_AudioSD_activeSrc_update", getValue(env_AudioSD_activeSrc_update), profile);
writeProfileInt( "BAP AUDIO", "env_AudioSD_FSGOpState_OpState", getValue(env_AudioSD_FSGOpState_OpState), profile);
writeProfileInt( "BAP AUDIO", "env_AudioSD_FSGSetup_update", getValue(env_AudioSD_FSGSetup_update), profile);
writeProfileInt( "BAP AUDIO", "env_AudioSD_FSGSetup_MaxVol", getValue(env_AudioSD_FSGSetup_MaxVol), profile);
writeProfileInt( "BAP AUDIO", "env_AudioSD_PowerOnOff", getValue(env_AudioSD_PowerOnOff), profile);
writeProfileInt( "BAP AUDIO", "BAPCFG_FSG_AudioSD_ProtocolMinor", getValue(BAPCFG_FSG_AudioSD_ProtocolMinor), profile);
writeProfileInt( "BAP AUDIO", "BAPCFG_FSG_AudioSD_ProtocolMajor", getValue(BAPCFG_FSG_AudioSD_ProtocolMajor), profile);
writeProfileInt( "BAP AUDIO", "BAPCFG_FSG_AudioSD_LsgClassMinor", getValue(BAPCFG_FSG_AudioSD_LsgClassMinor), profile);
writeProfileInt( "BAP AUDIO", "BAPCFG_FSG_AudioSD_LsgClassMajor", getValue(BAPCFG_FSG_AudioSD_LsgClassMajor), profile);
writeProfileInt( "BAP AUDIO", "BAPCFG_FSG_AudioSD_DFMinor", getValue(BAPCFG_FSG_AudioSD_DFMinor), profile);
writeProfileInt( "BAP AUDIO", "BAPCFG_FSG_AudioSD_DFMajor", getValue(BAPCFG_FSG_AudioSD_DFMajor), profile);
writeProfileInt( "BAP AUDIO", "env_AudioSD_FctList_0x2C_HB", getValue(env_AudioSD_FctList_0x2C_HB), profile);
writeProfileInt( "BAP AUDIO", "env_AudioSD_FctList_0x2B_HB", getValue(env_AudioSD_FctList_0x2B_HB), profile);
writeProfileInt( "BAP AUDIO", "env_AudioSD_FctList_0x2A_HB", getValue(env_AudioSD_FctList_0x2A_HB), profile);
writeProfileInt( "BAP AUDIO", "env_AudioSD_FctList_0x29_HB", getValue(env_AudioSD_FctList_0x29_HB), profile);
writeProfileInt( "BAP AUDIO", "env_AudioSD_FctList_0x28_HB", getValue(env_AudioSD_FctList_0x28_HB), profile);
writeProfileInt( "BAP AUDIO", "env_AudioSD_FctList_0x27_HB", getValue(env_AudioSD_FctList_0x27_HB), profile);
writeProfileInt( "BAP AUDIO", "env_AudioSD_FctList_0x26_HB", getValue(env_AudioSD_FctList_0x26_HB), profile);
writeProfileInt( "BAP AUDIO", "env_AudioSD_FctList_0x25_HB", getValue(env_AudioSD_FctList_0x25_HB), profile);
writeProfileInt( "BAP AUDIO", "env_AudioSD_FctList_0x24_HB", getValue(env_AudioSD_FctList_0x24_HB), profile);
writeProfileInt( "BAP AUDIO", "env_AudioSD_FctList_0x23_HB", getValue(env_AudioSD_FctList_0x23_HB), profile);
writeProfileInt( "BAP AUDIO", "env_AudioSD_FctList_0x22_HB", getValue(env_AudioSD_FctList_0x22_HB), profile);
writeProfileInt( "BAP AUDIO", "env_AudioSD_FctList_0x21_HB", getValue(env_AudioSD_FctList_0x21_HB), profile);
writeProfileInt( "BAP AUDIO", "env_AudioSD_FctList_0x20_HB", getValue(env_AudioSD_FctList_0x20_HB), profile);
writeProfileInt( "BAP AUDIO", "env_AudioSD_FctList_0x1F_HB", getValue(env_AudioSD_FctList_0x1F_HB), profile);
writeProfileInt( "BAP AUDIO", "env_AudioSD_FctList_0x1E_HB", getValue(env_AudioSD_FctList_0x1E_HB), profile);
writeProfileInt( "BAP AUDIO", "env_AudioSD_FctList_0x1D_HB", getValue(env_AudioSD_FctList_0x1D_HB), profile);
writeProfileInt( "BAP AUDIO", "env_AudioSD_FctList_0x1C_HB", getValue(env_AudioSD_FctList_0x1C_HB), profile);
writeProfileInt( "BAP AUDIO", "env_AudioSD_FctList_0x1B_HB", getValue(env_AudioSD_FctList_0x1B_HB), profile);
writeProfileInt( "BAP AUDIO", "env_AudioSD_FctList_0x1A_HB", getValue(env_AudioSD_FctList_0x1A_HB), profile);
writeProfileInt( "BAP AUDIO", "env_AudioSD_FctList_0x19_HB", getValue(env_AudioSD_FctList_0x19_HB), profile);
writeProfileInt( "BAP AUDIO", "env_AudioSD_FctList_0x18_HB", getValue(env_AudioSD_FctList_0x18_HB), profile);
writeProfileInt( "BAP AUDIO", "env_AudioSD_FctList_0x17_HB", getValue(env_AudioSD_FctList_0x17_HB), profile);
writeProfileInt( "BAP AUDIO", "env_AudioSD_FctList_0x16_HB", getValue(env_AudioSD_FctList_0x16_HB), profile);
writeProfileInt( "BAP AUDIO", "env_AudioSD_FctList_0x15_HB", getValue(env_AudioSD_FctList_0x15_HB), profile);
writeProfileInt( "BAP AUDIO", "env_AudioSD_FctList_0x14_HB", getValue(env_AudioSD_FctList_0x14_HB), profile);
writeProfileInt( "BAP AUDIO", "env_AudioSD_FctList_0x13_HB", getValue(env_AudioSD_FctList_0x13_HB), profile);
writeProfileInt( "BAP AUDIO", "env_AudioSD_FctList_0x12_HB", getValue(env_AudioSD_FctList_0x12_HB), profile);
writeProfileInt( "BAP AUDIO", "env_AudioSD_FctList_0x11_HB", getValue(env_AudioSD_FctList_0x11_HB), profile);
writeProfileInt( "BAP AUDIO", "env_AudioSD_FctList_0x10_HB", getValue(env_AudioSD_FctList_0x10_HB), profile);
writeProfileInt( "BAP AUDIO", "env_AudioSD_FctList_0x0F_HB", getValue(env_AudioSD_FctList_0x0F_HB), profile);
writeProfileInt( "BAP AUDIO", "env_AudioSD_FctList_0x0E_HB", getValue(env_AudioSD_FctList_0x0E_HB), profile);
writeProfileInt( "BAP AUDIO", "env_AudioSD_FctList_0x04_HB", getValue(env_AudioSD_FctList_0x04_HB), profile);
writeProfileInt( "BAP AUDIO", "env_AudioSD_FctList_0x03_HB", getValue(env_AudioSD_FctList_0x03_HB), profile);
writeProfileInt( "BAP AUDIO", "env_AudioSD_FctList_0x02_HB", getValue(env_AudioSD_FctList_0x02_HB), profile);
writeProfileInt( "BAP AUDIO", "env_AudioSD_FctList_0x01_HB", getValue(env_AudioSD_FctList_0x01_HB), profile);
writeProfileInt( "BAP AUDIO", "env_AudioSD_MB_TAID_error", getValue(env_AudioSD_MB_TAID_error), profile);
writeProfileInt( "BAP AUDIO", "env_AudioSD_MB_ASGID_error", getValue(env_AudioSD_MB_ASGID_error), profile);
writeProfileInt( "BAP AUDIO", "env_AudioSD_MB_Timeout", getValue(env_AudioSD_MB_Timeout), profile);
writeProfileInt( "BAP AUDIO", "env_AudioSD_RTPL_TAID_error", getValue(env_AudioSD_RTPL_TAID_error), profile);
writeProfileInt( "BAP AUDIO", "env_AudioSD_RTPL_ASGID_error", getValue(env_AudioSD_RTPL_ASGID_error), profile);
writeProfileInt( "BAP AUDIO", "env_AudioSD_RTPL_Timeout", getValue(env_AudioSD_RTPL_Timeout), profile);
writeProfileInt( "BAP AUDIO", "env_AudioSD_SL_TAID_error", getValue(env_AudioSD_SL_TAID_error), profile);
writeProfileInt( "BAP AUDIO", "env_AudioSD_SL_ASGID_error", getValue(env_AudioSD_SL_ASGID_error), profile);
writeProfileInt( "BAP AUDIO", "env_AudioSD_SL_Timeout", getValue(env_AudioSD_SL_Timeout), profile);
writeProfileInt( "BAP AUDIO", "env_AudioSD_RL_TAID_error", getValue(env_AudioSD_RL_TAID_error), profile);
writeProfileInt( "BAP AUDIO", "env_AudioSD_RL_ASGID_error", getValue(env_AudioSD_RL_ASGID_error), profile);
writeProfileInt( "BAP AUDIO", "env_AudioSD_RL_Timeout", getValue(env_AudioSD_RL_Timeout), profile);
writeProfileInt( "BAP AUDIO", "env_AudioSD_FctList_0x0E_TimeOut", getValue(env_AudioSD_FctList_0x0E_TimeOut), profile);
writeProfileInt( "BAP AUDIO", "env_AudioSD_FctList_0x0F_TimeOut", getValue(env_AudioSD_FctList_0x0F_TimeOut), profile);
writeProfileInt( "BAP AUDIO", "env_AudioSD_FctList_0x10_TimeOut", getValue(env_AudioSD_FctList_0x10_TimeOut), profile);
writeProfileInt( "BAP AUDIO", "env_AudioSD_FctList_0x11_TimeOut", getValue(env_AudioSD_FctList_0x11_TimeOut), profile);
writeProfileInt( "BAP AUDIO", "env_AudioSD_FctList_0x12_TimeOut", getValue(env_AudioSD_FctList_0x12_TimeOut), profile);
writeProfileInt( "BAP AUDIO", "env_AudioSD_FctList_0x13_TimeOut", getValue(env_AudioSD_FctList_0x13_TimeOut), profile);
writeProfileInt( "BAP AUDIO", "env_AudioSD_FctList_0x14_TimeOut", getValue(env_AudioSD_FctList_0x14_TimeOut), profile);
writeProfileInt( "BAP AUDIO", "env_AudioSD_FctList_0x15_TimeOut", getValue(env_AudioSD_FctList_0x15_TimeOut), profile);
writeProfileInt( "BAP AUDIO", "env_AudioSD_FctList_0x16_TimeOut", getValue(env_AudioSD_FctList_0x16_TimeOut), profile);
writeProfileInt( "BAP AUDIO", "env_AudioSD_FctList_0x17_TimeOut", getValue(env_AudioSD_FctList_0x17_TimeOut), profile);
writeProfileInt( "BAP AUDIO", "env_AudioSD_FctList_0x18_TimeOut", getValue(env_AudioSD_FctList_0x18_TimeOut), profile);
writeProfileInt( "BAP AUDIO", "env_AudioSD_FctList_0x19_TimeOut", getValue(env_AudioSD_FctList_0x19_TimeOut), profile);
writeProfileInt( "BAP AUDIO", "env_AudioSD_FctList_0x1A_TimeOut", getValue(env_AudioSD_FctList_0x1A_TimeOut), profile);
writeProfileInt( "BAP AUDIO", "env_AudioSD_FctList_0x1B_TimeOut", getValue(env_AudioSD_FctList_0x1B_TimeOut), profile);
writeProfileInt( "BAP AUDIO", "env_AudioSD_FctList_0x1C_TimeOut", getValue(env_AudioSD_FctList_0x1C_TimeOut), profile);
writeProfileInt( "BAP AUDIO", "env_AudioSD_FctList_0x1D_TimeOut", getValue(env_AudioSD_FctList_0x1D_TimeOut), profile);
writeProfileInt( "BAP AUDIO", "env_AudioSD_FctList_0x1E_TimeOut", getValue(env_AudioSD_FctList_0x1E_TimeOut), profile);
writeProfileInt( "BAP AUDIO", "env_AudioSD_FctList_0x1F_TimeOut", getValue(env_AudioSD_FctList_0x1F_TimeOut), profile);
writeProfileInt( "BAP AUDIO", "env_AudioSD_FctList_0x20_TimeOut", getValue(env_AudioSD_FctList_0x20_TimeOut), profile);
writeProfileInt( "BAP AUDIO", "env_AudioSD_FctList_0x21_TimeOut", getValue(env_AudioSD_FctList_0x21_TimeOut), profile);
writeProfileInt( "BAP AUDIO", "env_AudioSD_FctList_0x22_TimeOut", getValue(env_AudioSD_FctList_0x22_TimeOut), profile);
writeProfileInt( "BAP AUDIO", "env_AudioSD_FctList_0x23_TimeOut", getValue(env_AudioSD_FctList_0x23_TimeOut), profile);
writeProfileInt( "BAP AUDIO", "env_AudioSD_FctList_0x24_TimeOut", getValue(env_AudioSD_FctList_0x24_TimeOut), profile);
writeProfileInt( "BAP AUDIO", "env_AudioSD_FctList_0x25_TimeOut", getValue(env_AudioSD_FctList_0x25_TimeOut), profile);
writeProfileInt( "BAP AUDIO", "env_AudioSD_FctList_0x26_TimeOut", getValue(env_AudioSD_FctList_0x26_TimeOut), profile);
writeProfileInt( "BAP AUDIO", "env_AudioSD_FctList_0x27_TimeOut", getValue(env_AudioSD_FctList_0x27_TimeOut), profile);
writeProfileInt( "BAP AUDIO", "env_AudioSD_FctList_0x28_TimeOut", getValue(env_AudioSD_FctList_0x28_TimeOut), profile);
writeProfileInt( "BAP AUDIO", "env_AudioSD_FctList_0x29_TimeOut", getValue(env_AudioSD_FctList_0x29_TimeOut), profile);
writeProfileInt( "BAP AUDIO", "env_AudioSD_FctList_0x2A_TimeOut", getValue(env_AudioSD_FctList_0x2A_TimeOut), profile);
writeProfileInt( "BAP AUDIO", "env_AudioSD_FctList_0x2B_TimeOut", getValue(env_AudioSD_FctList_0x2B_TimeOut), profile);
writeProfileInt( "BAP AUDIO", "env_AudioSD_FctList_0x2C_TimeOut", getValue(env_AudioSD_FctList_0x2C_TimeOut), profile);
writeProfileInt( "BAP AUDIO", "env_AudioSD_FctList_0x2D_TimeOut", getValue(env_AudioSD_FctList_0x2D_TimeOut), profile);
writeProfileInt( "BAP AUDIO", "env_AudioSD_FctList_0x2E_TimeOut", getValue(env_AudioSD_FctList_0x2E_TimeOut), profile);
writeProfileInt( "BAP AUDIO", "env_AudioSD_FctList_0x2F_TimeOut", getValue(env_AudioSD_FctList_0x2F_TimeOut), profile);
writeProfileInt( "BAP AUDIO", "env_AudioSD_FctList_0x30_TimeOut", getValue(env_AudioSD_FctList_0x30_TimeOut), profile);
writeProfileInt( "BAP AUDIO", "env_AudioSD_FctList_0x18_3min_TO", getValue(env_AudioSD_FctList_0x18_3min_TO), profile);
writeProfileInt( "BAP AUDIO", "env_AudioSD_FctList_0x1D_3min_TO", getValue(env_AudioSD_FctList_0x1D_3min_TO), profile);
writeProfileInt( "BAP AUDIO", "env_AudioSD_FctList_0x22_3min_TO", getValue(env_AudioSD_FctList_0x22_3min_TO), profile);
writeProfileInt( "BAP AUDIO", "env_AudioSD_FctList_0x27_3min_TO", getValue(env_AudioSD_FctList_0x27_3min_TO), profile);
writeProfileInt( "BAP AUDIO", "env_AudioSD_FctList_0x2C_3min_TO", getValue(env_AudioSD_FctList_0x2C_3min_TO), profile);
writeProfileInt( "BAP AUDIO", "env_AudioSD_FctList_0x26_3min_TO", getValue(env_AudioSD_FctList_0x26_3min_TO), profile);
writeProfileInt( "BAP AUDIO", "env_FSG_AudioSD_FctList_ErrCode", getValue(env_FSG_AudioSD_FctList_ErrCode), profile);
writeProfileInt( "BAP AUDIO", "env_FSG_AudioSD_GetAll_ErrCode", getValue(env_FSG_AudioSD_GetAll_ErrCode), profile);
writeProfileInt( "BAP AUDIO", "env_BAPCFG_FSG_AudioSD_ErrCode", getValue(env_BAPCFG_FSG_AudioSD_ErrCode), profile);
writeProfileInt( "BAP AUDIO", "env_FSG_AudioSD_FctList_SegmEn", getValue(env_FSG_AudioSD_FctList_SegmEn), profile);
writeProfileInt( "BAP AUDIO", "env_FSG_AudioSD_FctList_IntTlgEn", getValue(env_FSG_AudioSD_FctList_IntTlgEn), profile);
writeProfileInt( "BAP AUDIO", "env_FSG_AudioSD_FctList_FctEn", getValue(env_FSG_AudioSD_FctList_FctEn), profile);
writeProfileInt( "BAP AUDIO", "env_FSG_AudioSD_FctList_ErrEn", getValue(env_FSG_AudioSD_FctList_ErrEn), profile);
writeProfileInt( "BAP AUDIO", "env_BAPCFG_FSG_AudioSD_FctEn", getValue(env_BAPCFG_FSG_AudioSD_FctEn), profile);
writeProfileInt( "BAP AUDIO", "env_FSG_AudioSD_GetAll_FctEn", getValue(env_FSG_AudioSD_GetAll_FctEn), profile);
writeProfileInt( "BAP AUDIO", "env_FSG_AudioSD_GetAll_ErrEn", getValue(env_FSG_AudioSD_GetAll_ErrEn), profile);
writeProfileInt( "BAP AUDIO", "env_FSG_AudioSD_GetAll_IntTlgEn", getValue(env_FSG_AudioSD_GetAll_IntTlgEn), profile);
writeProfileInt( "BAP AUDIO", "env_FSG_AudioSD_GetAll_SegmEn", getValue(env_FSG_AudioSD_GetAll_SegmEn), profile);
writeProfileInt( "BAP AUDIO", "env_FSG_AudioSD_BAPCFG_ResetSet", getValue(env_FSG_AudioSD_BAPCFG_ResetSet), profile);


}

//IssueList #200 -  Addition of SaveAll button
void saveBAP_button_Settings( char profileFile[] )
{
    writeProfileInt( "BAP", "ON_OFF_ASG15_2", getValue( ON_OFF_ASG15_2 ), profileFile );
    writeProfileInt( "BAP", "ON_OFF_ASG17_1", getValue( ON_OFF_ASG17_1 ), profileFile );
    writeProfileInt( "BAP", "ON_OFF_ASG18_1", getValue( ON_OFF_ASG18_1 ), profileFile );
    writeProfileInt( "BAP", "ON_OFF_ASG19_4", getValue( ON_OFF_ASG19_4 ), profileFile );
    writeProfileInt( "BAP", "ON_OFF_ASG69_1", getValue( ON_OFF_ASG69_1 ), profileFile );

 //   writeProfileInt( "BAP", "ON_OFF_FSG1_0",  getValue( ON_OFF_FSG1_0 ),  profileFile );
 //   writeProfileInt( "BAP", "ON_OFF_FSG2_0",  getValue( ON_OFF_FSG2_0 ),  profileFile );
    writeProfileInt( "BAP", "ON_OFF_FSG7_0",  getValue( ON_OFF_FSG7_0 ),  profileFile );
 //   writeProfileInt( "BAP", "ON_OFF_FSG8_0",  getValue( ON_OFF_FSG8_0 ),  profileFile );
 //   writeProfileInt( "BAP", "ON_OFF_FSG9_0",  getValue( ON_OFF_FSG9_0 ),  profileFile );
 //   writeProfileInt( "BAP", "ON_OFF_FSG10_0", getValue( ON_OFF_FSG10_0 ), profileFile );
 //   writeProfileInt( "BAP", "ON_OFF_FSG13_0", getValue( ON_OFF_FSG13_0 ), profileFile );
 //   writeProfileInt( "BAP", "ON_OFF_FSG23_0", getValue( ON_OFF_FSG23_0 ), profileFile );
    writeProfileInt( "BAP", "ON_OFF_FSG25_0", getValue( ON_OFF_FSG25_0 ), profileFile );
    writeProfileInt( "BAP", "ON_OFF_FSG26_0", getValue( ON_OFF_FSG26_0 ), profileFile );
    writeProfileInt( "BAP", "ON_OFF_FSG27_0", getValue( ON_OFF_FSG27_0 ), profileFile );
    writeProfileInt( "BAP", "ON_OFF_FSG29_0", getValue( ON_OFF_FSG29_0 ), profileFile );
 //   writeProfileInt( "BAP", "ON_OFF_FSG31_0", getValue( ON_OFF_FSG31_0 ), profileFile );
    writeProfileInt( "BAP", "ON_OFF_FSG33_0", getValue( ON_OFF_FSG33_0 ), profileFile );
    writeProfileInt( "BAP", "ON_OFF_FSG35_0", getValue( ON_OFF_FSG35_0 ), profileFile );
    writeProfileInt( "BAP", "ON_OFF_FSG39_0", getValue( ON_OFF_FSG39_0 ), profileFile );
    writeProfileInt( "BAP", "ON_OFF_FSG40_0", getValue( ON_OFF_FSG40_0 ), profileFile );
    writeProfileInt( "BAP", "ON_OFF_FSG41_0", getValue( ON_OFF_FSG41_0 ), profileFile );
    writeProfileInt( "BAP", "ON_OFF_FSG42_0", getValue( ON_OFF_FSG42_0 ), profileFile );
    writeProfileInt( "BAP", "ON_OFF_FSG49_0", getValue( ON_OFF_FSG49_0 ), profileFile );
    writeProfileInt( "BAP", "ON_OFF_FSG50_0", getValue( ON_OFF_FSG50_0 ), profileFile );
    writeProfileInt( "BAP", "ON_OFF_FSG52_0", getValue( ON_OFF_FSG52_0 ), profileFile );
    writeProfileInt( "BAP", "ON_OFF_FSG58_0", getValue( ON_OFF_FSG58_0 ), profileFile );
    writeProfileInt( "BAP", "ON_OFF_FSG60_0", getValue( ON_OFF_FSG60_0 ), profileFile );
 //   writeProfileInt( "BAP", "ON_OFF_FSG66_0", getValue( ON_OFF_FSG66_0 ), profileFile );
    writeProfileInt( "BAP", "ON_OFF_FSG70_0", getValue( ON_OFF_FSG70_0 ), profileFile );
    writeProfileInt( "BAP", "ON_OFF_FSG82_0", getValue( ON_OFF_FSG82_0 ), profileFile );
  writeProfileInt( "BAP", "env_DisplayConfig_v100_PowerOnOff", getValue( env_DisplayConfig_v100_PowerOnOff ), profileFile );
  writeProfileInt( "BAP", "env_NaviSD_PowerOnOff", getValue( env_NaviSD_PowerOnOff ), profileFile );
  writeProfileInt( "BAP", "env_AudioSD_PowerOnOff", getValue( env_AudioSD_PowerOnOff ), profileFile );
  writeProfileInt( "BAP", "env_FSG_Schalter_OnOff", getValue( env_FSG_Schalter_OnOff ), profileFile );
  writeProfileInt( "BAP", "env_SDS_v100_PowerOnOff", getValue( env_SDS_v100_PowerOnOff ), profileFile );
  writeProfileInt( "BAP", "ON_OFF_BAP_LoadSave_INI", getValue( ON_OFF_BAP_LoadSave_INI ), profileFile );
}

//IssueList #200
/* 26.08.2014 Update FPK_15S1 Navi
void saveBAP_naviSettings( char profile[] )
{

writeProfileInt( "BAP NAVI", "env_NaviLG_reload", getValue(env_NaviLG_reload), profile);
writeProfileInt( "BAP NAVI", "env_NaviLG_Switch", getValue(env_NaviLG_Switch), profile);
writeProfileInt( "BAP NAVI", "env_NaviLG_Enable_7", getValue(env_NaviLG_Enable_7), profile);
writeProfileInt( "BAP NAVI", "env_NaviLG_Enable_6", getValue(env_NaviLG_Enable_6), profile);
writeProfileInt( "BAP NAVI", "env_NaviLG_Enable_5", getValue(env_NaviLG_Enable_5), profile);
writeProfileInt( "BAP NAVI", "env_NaviLG_Enable_4", getValue(env_NaviLG_Enable_4), profile);
writeProfileInt( "BAP NAVI", "env_NaviLG_Enable_3", getValue(env_NaviLG_Enable_3), profile);
writeProfileInt( "BAP NAVI", "env_NaviLG_Enable_2", getValue(env_NaviLG_Enable_2), profile);
writeProfileInt( "BAP NAVI", "env_NaviLG_Enable_1", getValue(env_NaviLG_Enable_1), profile);
writeProfileInt( "BAP NAVI", "env_NaviLG_Enable_0", getValue(env_NaviLG_Enable_0), profile);
writeProfileInt( "BAP NAVI", "env_NaviLG_GuidInfo_7", getValue(env_NaviLG_GuidInfo_7), profile);
writeProfileInt( "BAP NAVI", "env_NaviLG_GuidInfo_6", getValue(env_NaviLG_GuidInfo_6), profile);
writeProfileInt( "BAP NAVI", "env_NaviLG_GuidInfo_5", getValue(env_NaviLG_GuidInfo_5), profile);
writeProfileInt( "BAP NAVI", "env_NaviLG_GuidInfo_4", getValue(env_NaviLG_GuidInfo_4), profile);
writeProfileInt( "BAP NAVI", "env_NaviLG_GuidInfo_3", getValue(env_NaviLG_GuidInfo_3), profile);
writeProfileInt( "BAP NAVI", "env_NaviLG_GuidInfo_2", getValue(env_NaviLG_GuidInfo_2), profile);
writeProfileInt( "BAP NAVI", "env_NaviLG_GuidInfo_1", getValue(env_NaviLG_GuidInfo_1), profile);
writeProfileInt( "BAP NAVI", "env_NaviLG_GuidInfo_0", getValue(env_NaviLG_GuidInfo_0), profile);
writeProfileInt( "BAP NAVI", "env_NaviLG_LaneDesc_7", getValue(env_NaviLG_LaneDesc_7), profile);
writeProfileInt( "BAP NAVI", "env_NaviLG_LaneDesc_6", getValue(env_NaviLG_LaneDesc_6), profile);
writeProfileInt( "BAP NAVI", "env_NaviLG_LaneDesc_5", getValue(env_NaviLG_LaneDesc_5), profile);
writeProfileInt( "BAP NAVI", "env_NaviLG_LaneDesc_4", getValue(env_NaviLG_LaneDesc_4), profile);
writeProfileInt( "BAP NAVI", "env_NaviLG_LaneDesc_3", getValue(env_NaviLG_LaneDesc_3), profile);
writeProfileInt( "BAP NAVI", "env_NaviLG_LaneDesc_2", getValue(env_NaviLG_LaneDesc_2), profile);
writeProfileInt( "BAP NAVI", "env_NaviLG_LaneDesc_1", getValue(env_NaviLG_LaneDesc_1), profile);
writeProfileInt( "BAP NAVI", "env_NaviLG_LaneDesc_0", getValue(env_NaviLG_LaneDesc_0), profile);
writeProfileInt( "BAP NAVI", "env_NaviLG_LaneMark_R_7", getValue(env_NaviLG_LaneMark_R_7), profile);
writeProfileInt( "BAP NAVI", "env_NaviLG_LaneMark_R_6", getValue(env_NaviLG_LaneMark_R_6), profile);
writeProfileInt( "BAP NAVI", "env_NaviLG_LaneMark_R_5", getValue(env_NaviLG_LaneMark_R_5), profile);
writeProfileInt( "BAP NAVI", "env_NaviLG_LaneMark_R_4", getValue(env_NaviLG_LaneMark_R_4), profile);
writeProfileInt( "BAP NAVI", "env_NaviLG_LaneMark_R_3", getValue(env_NaviLG_LaneMark_R_3), profile);
writeProfileInt( "BAP NAVI", "env_NaviLG_LaneMark_R_2", getValue(env_NaviLG_LaneMark_R_2), profile);
writeProfileInt( "BAP NAVI", "env_NaviLG_LaneMark_R_1", getValue(env_NaviLG_LaneMark_R_1), profile);
writeProfileInt( "BAP NAVI", "env_NaviLG_LaneMark_R_0", getValue(env_NaviLG_LaneMark_R_0), profile);
writeProfileInt( "BAP NAVI", "env_NaviLG_LaneMark_L_7", getValue(env_NaviLG_LaneMark_L_7), profile);
writeProfileInt( "BAP NAVI", "env_NaviLG_LaneMark_L_6", getValue(env_NaviLG_LaneMark_L_6), profile);
writeProfileInt( "BAP NAVI", "env_NaviLG_LaneMark_L_5", getValue(env_NaviLG_LaneMark_L_5), profile);
writeProfileInt( "BAP NAVI", "env_NaviLG_LaneMark_L_4", getValue(env_NaviLG_LaneMark_L_4), profile);
writeProfileInt( "BAP NAVI", "env_NaviLG_LaneMark_L_3", getValue(env_NaviLG_LaneMark_L_3), profile);
writeProfileInt( "BAP NAVI", "env_NaviLG_LaneMark_L_2", getValue(env_NaviLG_LaneMark_L_2), profile);
writeProfileInt( "BAP NAVI", "env_NaviLG_LaneMark_L_1", getValue(env_NaviLG_LaneMark_L_1), profile);
writeProfileInt( "BAP NAVI", "env_NaviLG_LaneMark_L_0", getValue(env_NaviLG_LaneMark_L_0), profile);
writeProfileInt( "BAP NAVI", "env_NaviLG_LaneType_7", getValue(env_NaviLG_LaneType_7), profile);
writeProfileInt( "BAP NAVI", "env_NaviLG_LaneType_6", getValue(env_NaviLG_LaneType_6), profile);
writeProfileInt( "BAP NAVI", "env_NaviLG_LaneType_5", getValue(env_NaviLG_LaneType_5), profile);
writeProfileInt( "BAP NAVI", "env_NaviLG_LaneType_4", getValue(env_NaviLG_LaneType_4), profile);
writeProfileInt( "BAP NAVI", "env_NaviLG_LaneType_3", getValue(env_NaviLG_LaneType_3), profile);
writeProfileInt( "BAP NAVI", "env_NaviLG_LaneType_2", getValue(env_NaviLG_LaneType_2), profile);
writeProfileInt( "BAP NAVI", "env_NaviLG_LaneType_1", getValue(env_NaviLG_LaneType_1), profile);
writeProfileInt( "BAP NAVI", "env_NaviLG_LaneType_0", getValue(env_NaviLG_LaneType_0), profile);
writeProfileInt( "BAP NAVI", "env_NaviLG_LaneDir_7", getValue(env_NaviLG_LaneDir_7), profile);
writeProfileInt( "BAP NAVI", "env_NaviLG_LaneDir_6", getValue(env_NaviLG_LaneDir_6), profile);
writeProfileInt( "BAP NAVI", "env_NaviLG_LaneDir_5", getValue(env_NaviLG_LaneDir_5), profile);
writeProfileInt( "BAP NAVI", "env_NaviLG_LaneDir_4", getValue(env_NaviLG_LaneDir_4), profile);
writeProfileInt( "BAP NAVI", "env_NaviLG_LaneDir_3", getValue(env_NaviLG_LaneDir_3), profile);
writeProfileInt( "BAP NAVI", "env_NaviLG_LaneDir_2", getValue(env_NaviLG_LaneDir_2), profile);
writeProfileInt( "BAP NAVI", "env_NaviLG_LaneDir_1", getValue(env_NaviLG_LaneDir_1), profile);
writeProfileInt( "BAP NAVI", "env_NaviLG_LaneDir_0", getValue(env_NaviLG_LaneDir_0), profile);
writeProfileInt( "BAP NAVI", "env_NaviLG_Pos_7", getValue(env_NaviLG_Pos_7), profile);
writeProfileInt( "BAP NAVI", "env_NaviLG_Pos_6", getValue(env_NaviLG_Pos_6), profile);
writeProfileInt( "BAP NAVI", "env_NaviLG_Pos_5", getValue(env_NaviLG_Pos_5), profile);
writeProfileInt( "BAP NAVI", "env_NaviLG_Pos_4", getValue(env_NaviLG_Pos_4), profile);
writeProfileInt( "BAP NAVI", "env_NaviLG_Pos_3", getValue(env_NaviLG_Pos_3), profile);
writeProfileInt( "BAP NAVI", "env_NaviLG_Pos_2", getValue(env_NaviLG_Pos_2), profile);
writeProfileInt( "BAP NAVI", "env_NaviLG_Pos_1", getValue(env_NaviLG_Pos_1), profile);
writeProfileInt( "BAP NAVI", "env_NaviLG_Pos_0", getValue(env_NaviLG_Pos_0), profile);
writeProfileInt( "BAP NAVI", "env_NaviSD_TTD_VI_Disp", getValue(env_NaviSD_TTD_VI_Disp), profile);
writeProfileInt( "BAP NAVI", "env_NaviSD_TTD_VI", getValue(env_NaviSD_TTD_VI), profile);
writeProfileInt( "BAP NAVI", "env_NaviSD_TTD_Reserved7_VI", getValue(env_NaviSD_TTD_Reserved7_VI), profile);
writeProfileInt( "BAP NAVI", "env_NaviSD_TTD_Reserved6_VI", getValue(env_NaviSD_TTD_Reserved6_VI), profile);
writeProfileInt( "BAP NAVI", "env_NaviSD_TTD_Reserved0_VI", getValue(env_NaviSD_TTD_Reserved0_VI), profile);
writeProfileInt( "BAP NAVI", "env_NaviSD_FctList_0x01_TimeOut", getValue(env_NaviSD_FctList_0x01_TimeOut), profile);
writeProfileInt( "BAP NAVI", "env_FSG_Navi_HB_button", getValue(env_FSG_Navi_HB_button), profile);
writeProfileInt( "BAP NAVI", "env_FSG_Navi_HB_input", getValue(env_FSG_Navi_HB_input), profile);
writeProfileInt( "BAP NAVI", "env_Navi_LaneGuidanceList_Short", getValue(env_Navi_LaneGuidanceList_Short), profile);
writeProfileInt( "BAP NAVI", "env_Navi_LaneGuidanceList_Long", getValue(env_Navi_LaneGuidanceList_Long), profile);
writeProfileInt( "BAP NAVI", "env_NaviSD_BAP_Longlist", getValue(env_NaviSD_BAP_Longlist), profile);
writeProfileInt( "BAP NAVI", "env_NaviSD_BAP_Shortlist", getValue(env_NaviSD_BAP_Shortlist), profile);
writeProfileInt( "BAP NAVI", "env_NaviSD_RepeatLastNavAnn_ErrC", getValue(env_NaviSD_RepeatLastNavAnn_ErrC), profile);
writeProfileInt( "BAP NAVI", "env_NaviSD_RepeatLastNavAnn_Err", getValue(env_NaviSD_RepeatLastNavAnn_Err), profile);
writeProfileInt( "BAP NAVI", "env_NaviSD_NbSpeller_Error_on", getValue(env_NaviSD_NbSpeller_Error_on), profile);
writeProfileInt( "BAP NAVI", "env_NaviSD_NbSpeller_ErrorCode", getValue(env_NaviSD_NbSpeller_ErrorCode), profile);
writeProfileInt( "BAP NAVI", "env_NaviSD_GetNextLiPos_Error_on", getValue(env_NaviSD_GetNextLiPos_Error_on), profile);
writeProfileInt( "BAP NAVI", "env_NaviSD_GetNextLiPos_ErrorCo", getValue(env_NaviSD_GetNextLiPos_ErrorCo), profile);
writeProfileInt( "BAP NAVI", "env_NaviSD_RGActDeact_ErrorCode", getValue(env_NaviSD_RGActDeact_ErrorCode), profile);
writeProfileInt( "BAP NAVI", "env_NaviSD_RGActDeact_Error_on", getValue(env_NaviSD_RGActDeact_Error_on), profile);
writeProfileInt( "BAP NAVI", "env_NaviSD_AL_CA", getValue(env_NaviSD_AL_CA), profile);
writeProfileInt( "BAP NAVI", "env_NaviSD_NB_AL_switch", getValue(env_NaviSD_NB_AL_switch), profile);
writeProfileInt( "BAP NAVI", "env_NaviSD_NB_CA_switch", getValue(env_NaviSD_NB_CA_switch), profile);
writeProfileInt( "BAP NAVI", "env_NaviSD_FDL_CA_switch", getValue(env_NaviSD_FDL_CA_switch), profile);
writeProfileInt( "BAP NAVI", "env_NaviSD_LDL_CA_switch", getValue(env_NaviSD_LDL_CA_switch), profile);
writeProfileInt( "BAP NAVI", "env_ASG_NaviSD_LG_AH_IS", getValue(env_ASG_NaviSD_LG_AH_IS), profile);
writeProfileInt( "BAP NAVI", "env_NaviSD_LG_CA_switch", getValue(env_NaviSD_LG_CA_switch), profile);
writeProfileInt( "BAP NAVI", "env_NaviSD_AL_ErrorCode", getValue(env_NaviSD_AL_ErrorCode), profile);
writeProfileInt( "BAP NAVI", "env_NaviSD_AL_Error_on", getValue(env_NaviSD_AL_Error_on), profile);
writeProfileInt( "BAP NAVI", "env_NaviSD_NB_ErrorCode", getValue(env_NaviSD_NB_ErrorCode), profile);
writeProfileInt( "BAP NAVI", "env_NaviSD_NB_Error_on", getValue(env_NaviSD_NB_Error_on), profile);
writeProfileInt( "BAP NAVI", "env_NaviSD_FDL_ErrorCode", getValue(env_NaviSD_FDL_ErrorCode), profile);
writeProfileInt( "BAP NAVI", "env_NaviSD_FDL_Error_on", getValue(env_NaviSD_FDL_Error_on), profile);
writeProfileInt( "BAP NAVI", "env_NaviSD_LDL_ErrorCode", getValue(env_NaviSD_LDL_ErrorCode), profile);
writeProfileInt( "BAP NAVI", "env_NaviSD_LDL_Error_on", getValue(env_NaviSD_LDL_Error_on), profile);
writeProfileInt( "BAP NAVI", "env_NaviSD_LG_Error_on", getValue(env_NaviSD_LG_Error_on), profile);
writeProfileInt( "BAP NAVI", "env_NaviSD_LG_ErrorCode", getValue(env_NaviSD_LG_ErrorCode), profile);
writeProfileInt( "BAP NAVI", "env_NaviSD_MFZone_ErrorCode", getValue(env_NaviSD_MFZone_ErrorCode), profile);
writeProfileInt( "BAP NAVI", "env_NaviSD_MFZone_Error_on", getValue(env_NaviSD_MFZone_Error_on), profile);
writeProfileInt( "BAP NAVI", "env_NaviSD_ActRGTy_Error_on", getValue(env_NaviSD_ActRGTy_Error_on), profile);
writeProfileInt( "BAP NAVI", "env_NaviSD_ActRGTy_ErrorCode", getValue(env_NaviSD_ActRGTy_ErrorCode), profile);
writeProfileInt( "BAP NAVI", "env_NaviSD_VG_Error_on", getValue(env_NaviSD_VG_Error_on), profile);
writeProfileInt( "BAP NAVI", "env_NaviSD_VG_ErrorCode", getValue(env_NaviSD_VG_ErrorCode), profile);
writeProfileInt( "BAP NAVI", "env_NaviSD_TMCI_Error_on", getValue(env_NaviSD_TMCI_Error_on), profile);
writeProfileInt( "BAP NAVI", "env_NaviSD_TMCI_ErrorCode", getValue(env_NaviSD_TMCI_ErrorCode), profile);
writeProfileInt( "BAP NAVI", "env_NaviSD_CaliState_Error_on", getValue(env_NaviSD_CaliState_Error_on), profile);
writeProfileInt( "BAP NAVI", "env_NaviSD_CaliState_ErrorCode", getValue(env_NaviSD_CaliState_ErrorCode), profile);
writeProfileInt( "BAP NAVI", "env_NaviSD_ASGcap_ErrorCode", getValue(env_NaviSD_ASGcap_ErrorCode), profile);
writeProfileInt( "BAP NAVI", "env_NaviSD_ASGcap_Error_on", getValue(env_NaviSD_ASGcap_Error_on), profile);
writeProfileInt( "BAP NAVI", "env_NaviSD_FctList_0x2A", getValue(env_NaviSD_FctList_0x2A), profile);
writeProfileInt( "BAP NAVI", "env_NaviSD_FctList_0x29", getValue(env_NaviSD_FctList_0x29), profile);
writeProfileInt( "BAP NAVI", "env_NaviSD_FctList_0x28", getValue(env_NaviSD_FctList_0x28), profile);
writeProfileInt( "BAP NAVI", "env_NaviSD_FctList_0x27", getValue(env_NaviSD_FctList_0x27), profile);
writeProfileInt( "BAP NAVI", "env_NaviSD_FctList_0x26", getValue(env_NaviSD_FctList_0x26), profile);
writeProfileInt( "BAP NAVI", "env_NaviSD_FctList_0x25", getValue(env_NaviSD_FctList_0x25), profile);
writeProfileInt( "BAP NAVI", "env_NaviSD_FctList_0x24", getValue(env_NaviSD_FctList_0x24), profile);
writeProfileInt( "BAP NAVI", "env_NaviSD_FctList_0x23", getValue(env_NaviSD_FctList_0x23), profile);
writeProfileInt( "BAP NAVI", "env_NaviSD_FctList_0x22", getValue(env_NaviSD_FctList_0x22), profile);
writeProfileInt( "BAP NAVI", "env_NaviSD_FctList_0x21", getValue(env_NaviSD_FctList_0x21), profile);
writeProfileInt( "BAP NAVI", "env_NaviSD_FctList_0x20", getValue(env_NaviSD_FctList_0x20), profile);
writeProfileInt( "BAP NAVI", "env_NaviSD_FctList_0x1F", getValue(env_NaviSD_FctList_0x1F), profile);
writeProfileInt( "BAP NAVI", "env_NaviSD_FctList_0x1E", getValue(env_NaviSD_FctList_0x1E), profile);
writeProfileInt( "BAP NAVI", "env_NaviSD_FctList_0x1D", getValue(env_NaviSD_FctList_0x1D), profile);
writeProfileInt( "BAP NAVI", "env_NaviSD_FctList_0x1C", getValue(env_NaviSD_FctList_0x1C), profile);
writeProfileInt( "BAP NAVI", "env_NaviSD_FctList_0x1B", getValue(env_NaviSD_FctList_0x1B), profile);
writeProfileInt( "BAP NAVI", "env_NaviSD_FctList_0x1A", getValue(env_NaviSD_FctList_0x1A), profile);
writeProfileInt( "BAP NAVI", "env_NaviSD_FctList_0x19", getValue(env_NaviSD_FctList_0x19), profile);
writeProfileInt( "BAP NAVI", "env_NaviSD_FctList_0x18", getValue(env_NaviSD_FctList_0x18), profile);
writeProfileInt( "BAP NAVI", "env_NaviSD_FctList_0x17", getValue(env_NaviSD_FctList_0x17), profile);
writeProfileInt( "BAP NAVI", "env_NaviSD_FctList_0x16", getValue(env_NaviSD_FctList_0x16), profile);
writeProfileInt( "BAP NAVI", "env_NaviSD_FctList_0x15", getValue(env_NaviSD_FctList_0x15), profile);
writeProfileInt( "BAP NAVI", "env_NaviSD_FctList_0x14", getValue(env_NaviSD_FctList_0x14), profile);
writeProfileInt( "BAP NAVI", "env_NaviSD_FctList_0x13", getValue(env_NaviSD_FctList_0x13), profile);
writeProfileInt( "BAP NAVI", "env_NaviSD_FctList_0x12", getValue(env_NaviSD_FctList_0x12), profile);
writeProfileInt( "BAP NAVI", "env_NaviSD_FctList_0x11", getValue(env_NaviSD_FctList_0x11), profile);
writeProfileInt( "BAP NAVI", "env_NaviSD_FctList_0x10", getValue(env_NaviSD_FctList_0x10), profile);
writeProfileInt( "BAP NAVI", "env_NaviSD_FctList_0x0F", getValue(env_NaviSD_FctList_0x0F), profile);
writeProfileInt( "BAP NAVI", "env_NaviSD_FctList_0x04", getValue(env_NaviSD_FctList_0x04), profile);
writeProfileInt( "BAP NAVI", "env_NaviSD_FctList_0x03", getValue(env_NaviSD_FctList_0x03), profile);
writeProfileInt( "BAP NAVI", "env_NaviSD_FctList_0x02", getValue(env_NaviSD_FctList_0x02), profile);
writeProfileInt( "BAP NAVI", "env_NaviSD_FctList_0x01", getValue(env_NaviSD_FctList_0x01), profile);
writeProfileInt( "BAP NAVI", "env_NaviSD_FDL_FRU", getValue(env_NaviSD_FDL_FRU), profile);
writeProfileInt( "BAP NAVI", "env_NaviSD_LDL_FRU", getValue(env_NaviSD_LDL_FRU), profile);
writeProfileInt( "BAP NAVI", "env_NaviSD_NB_FRU", getValue(env_NaviSD_NB_FRU), profile);
writeProfileInt( "BAP NAVI", "env_NaviSD_AL_FRU", getValue(env_NaviSD_AL_FRU), profile);
writeProfileInt( "BAP NAVI", "env_NaviSD_LG_FRU", getValue(env_NaviSD_LG_FRU), profile);
writeProfileInt( "BAP NAVI", "env_NaviSD_RG_Status_update", getValue(env_NaviSD_RG_Status_update), profile);
writeProfileInt( "BAP NAVI", "env_NaviSD_FSG_OP_State_update", getValue(env_NaviSD_FSG_OP_State_update), profile);
writeProfileInt( "BAP NAVI", "env_NaviSD_AL_TotalNumLE", getValue(env_NaviSD_AL_TotalNumLE), profile);
writeProfileInt( "BAP NAVI", "env_NaviSD_AL_TAID", getValue(env_NaviSD_AL_TAID), profile);
writeProfileInt( "BAP NAVI", "env_NaviSD_AL_StatusArray", getValue(env_NaviSD_AL_StatusArray), profile);
writeProfileInt( "BAP NAVI", "env_NaviSD_AL_reload", getValue(env_NaviSD_AL_reload), profile);
writeProfileInt( "BAP NAVI", "env_NaviSD_AL_DataSource", getValue(env_NaviSD_AL_DataSource), profile);
writeProfileInt( "BAP NAVI", "env_NaviSD_AL_CA_switch", getValue(env_NaviSD_AL_CA_switch), profile);
writeProfileInt( "BAP NAVI", "env_NaviSD_AL_ASGID", getValue(env_NaviSD_AL_ASGID), profile);
writeProfileInt( "BAP NAVI", "env_NaviSD_AL_AH_start", getValue(env_NaviSD_AL_AH_start), profile);
writeProfileInt( "BAP NAVI", "env_NaviSD_AL_AH_shift", getValue(env_NaviSD_AL_AH_shift), profile);
writeProfileInt( "BAP NAVI", "env_NaviSD_AL_AH_RA", getValue(env_NaviSD_AL_AH_RA), profile);
writeProfileInt( "BAP NAVI", "env_NaviSD_AL_AH_POS", getValue(env_NaviSD_AL_AH_POS), profile);
writeProfileInt( "BAP NAVI", "env_NaviSD_AL_AH_IS", getValue(env_NaviSD_AL_AH_IS), profile);
writeProfileInt( "BAP NAVI", "env_NaviSD_AL_AH_elements", getValue(env_NaviSD_AL_AH_elements), profile);
writeProfileInt( "BAP NAVI", "env_NaviSD_AL_AH_dir", getValue(env_NaviSD_AL_AH_dir), profile);
writeProfileInt( "BAP NAVI", "env_NaviSD_AL_OtherList_Ref", getValue(env_NaviSD_AL_OtherList_Ref), profile);
writeProfileInt( "BAP NAVI", "env_NaviSD_AL_OtherListType", getValue(env_NaviSD_AL_OtherListType), profile);
writeProfileInt( "BAP NAVI", "env_NaviSD_NB_TotalNumLE", getValue(env_NaviSD_NB_TotalNumLE), profile);
writeProfileInt( "BAP NAVI", "env_NaviSD_NB_TAID", getValue(env_NaviSD_NB_TAID), profile);
writeProfileInt( "BAP NAVI", "env_NaviSD_NB_StatusArray", getValue(env_NaviSD_NB_StatusArray), profile);
writeProfileInt( "BAP NAVI", "env_NaviSD_NB_reload", getValue(env_NaviSD_NB_reload), profile);
writeProfileInt( "BAP NAVI", "env_NaviSD_NB_DataSource", getValue(env_NaviSD_NB_DataSource), profile);
writeProfileInt( "BAP NAVI", "env_NaviSD_NB_CA", getValue(env_NaviSD_NB_CA), profile);
writeProfileInt( "BAP NAVI", "env_NaviSD_NB_ASGID", getValue(env_NaviSD_NB_ASGID), profile);
writeProfileInt( "BAP NAVI", "env_NaviSD_NB_AH_start", getValue(env_NaviSD_NB_AH_start), profile);
writeProfileInt( "BAP NAVI", "env_NaviSD_NB_AH_shift", getValue(env_NaviSD_NB_AH_shift), profile);
writeProfileInt( "BAP NAVI", "env_NaviSD_NB_AH_RA", getValue(env_NaviSD_NB_AH_RA), profile);
writeProfileInt( "BAP NAVI", "env_NaviSD_NB_AH_POS", getValue(env_NaviSD_NB_AH_POS), profile);
writeProfileInt( "BAP NAVI", "env_NaviSD_NB_AH_IS", getValue(env_NaviSD_NB_AH_IS), profile);
writeProfileInt( "BAP NAVI", "env_NaviSD_NB_AH_elements", getValue(env_NaviSD_NB_AH_elements), profile);
writeProfileInt( "BAP NAVI", "env_NaviSD_NB_AH_dir", getValue(env_NaviSD_NB_AH_dir), profile);
writeProfileInt( "BAP NAVI", "env_NaviSD_LG_LGOnOff", getValue(env_NaviSD_LG_LGOnOff), profile);
writeProfileInt( "BAP NAVI", "env_NaviSD_LG_TAID", getValue(env_NaviSD_LG_TAID), profile);
writeProfileInt( "BAP NAVI", "env_NaviSD_LG_StatusArray", getValue(env_NaviSD_LG_StatusArray), profile);
writeProfileInt( "BAP NAVI", "env_NaviSD_LG_reload", getValue(env_NaviSD_LG_reload), profile);
writeProfileInt( "BAP NAVI", "env_NaviSD_LG_DataSource", getValue(env_NaviSD_LG_DataSource), profile);
writeProfileInt( "BAP NAVI", "env_NaviSD_LG_CA", getValue(env_NaviSD_LG_CA), profile);
writeProfileInt( "BAP NAVI", "env_NaviSD_LG_ASGID", getValue(env_NaviSD_LG_ASGID), profile);
writeProfileInt( "BAP NAVI", "env_NaviSD_LG_AH_start", getValue(env_NaviSD_LG_AH_start), profile);
writeProfileInt( "BAP NAVI", "env_NaviSD_LG_AH_shift", getValue(env_NaviSD_LG_AH_shift), profile);
writeProfileInt( "BAP NAVI", "env_NaviSD_LG_AH_RA", getValue(env_NaviSD_LG_AH_RA), profile);
writeProfileInt( "BAP NAVI", "env_NaviSD_LG_AH_POS", getValue(env_NaviSD_LG_AH_POS), profile);
writeProfileInt( "BAP NAVI", "env_NaviSD_LG_AH_IS", getValue(env_NaviSD_LG_AH_IS), profile);
writeProfileInt( "BAP NAVI", "env_NaviSD_LG_AH_elements", getValue(env_NaviSD_LG_AH_elements), profile);
writeProfileInt( "BAP NAVI", "env_NaviSD_LG_AH_dir", getValue(env_NaviSD_LG_AH_dir), profile);
writeProfileInt( "BAP NAVI", "env_NaviSD_FDL_AH_dir", getValue(env_NaviSD_FDL_AH_dir), profile);
writeProfileInt( "BAP NAVI", "env_NaviSD_FDL_AH_elements", getValue(env_NaviSD_FDL_AH_elements), profile);
writeProfileInt( "BAP NAVI", "env_NaviSD_FDL_AH_IS", getValue(env_NaviSD_FDL_AH_IS), profile);
writeProfileInt( "BAP NAVI", "env_NaviSD_FDL_AH_POS", getValue(env_NaviSD_FDL_AH_POS), profile);
writeProfileInt( "BAP NAVI", "env_NaviSD_FDL_AH_RA", getValue(env_NaviSD_FDL_AH_RA), profile);
writeProfileInt( "BAP NAVI", "env_NaviSD_FDL_AH_shift", getValue(env_NaviSD_FDL_AH_shift), profile);
writeProfileInt( "BAP NAVI", "env_NaviSD_FDL_AH_start", getValue(env_NaviSD_FDL_AH_start), profile);
writeProfileInt( "BAP NAVI", "env_NaviSD_FDL_ASGID", getValue(env_NaviSD_FDL_ASGID), profile);
writeProfileInt( "BAP NAVI", "env_NaviSD_FDL_CA", getValue(env_NaviSD_FDL_CA), profile);
writeProfileInt( "BAP NAVI", "env_NaviSD_FDL_DataSource", getValue(env_NaviSD_FDL_DataSource), profile);
writeProfileInt( "BAP NAVI", "env_NaviSD_FDL_reload", getValue(env_NaviSD_FDL_reload), profile);
writeProfileInt( "BAP NAVI", "env_NaviSD_FDL_StatusArray", getValue(env_NaviSD_FDL_StatusArray), profile);
writeProfileInt( "BAP NAVI", "env_NaviSD_FDL_TAID", getValue(env_NaviSD_FDL_TAID), profile);
writeProfileInt( "BAP NAVI", "env_NaviSD_FDL_TotalNumLE", getValue(env_NaviSD_FDL_TotalNumLE), profile);
writeProfileInt( "BAP NAVI", "env_NaviSD_LDL_StatusArray", getValue(env_NaviSD_LDL_StatusArray), profile);
writeProfileInt( "BAP NAVI", "env_NaviSD_LDL_ASGID", getValue(env_NaviSD_LDL_ASGID), profile);
writeProfileInt( "BAP NAVI", "env_NaviSD_LDL_TAID", getValue(env_NaviSD_LDL_TAID), profile);
writeProfileInt( "BAP NAVI", "env_NaviSD_LDL_TotalNumLE", getValue(env_NaviSD_LDL_TotalNumLE), profile);
writeProfileInt( "BAP NAVI", "env_NaviSD_LDL_CA", getValue(env_NaviSD_LDL_CA), profile);
writeProfileInt( "BAP NAVI", "env_NaviSD_LDL_reload", getValue(env_NaviSD_LDL_reload), profile);
writeProfileInt( "BAP NAVI", "env_NaviSD_LDL_DataSource", getValue(env_NaviSD_LDL_DataSource), profile);
writeProfileInt( "BAP NAVI", "env_NaviSD_LDL_AH_start", getValue(env_NaviSD_LDL_AH_start), profile);
writeProfileInt( "BAP NAVI", "env_NaviSD_LDL_AH_elements", getValue(env_NaviSD_LDL_AH_elements), profile);
writeProfileInt( "BAP NAVI", "env_NaviSD_LDL_AH_IS", getValue(env_NaviSD_LDL_AH_IS), profile);
writeProfileInt( "BAP NAVI", "env_NaviSD_LDL_AH_POS", getValue(env_NaviSD_LDL_AH_POS), profile);
writeProfileInt( "BAP NAVI", "env_NaviSD_LDL_AH_dir", getValue(env_NaviSD_LDL_AH_dir), profile);
writeProfileInt( "BAP NAVI", "env_NaviSD_LDL_AH_shift", getValue(env_NaviSD_LDL_AH_shift), profile);
writeProfileInt( "BAP NAVI", "env_NaviSD_LDL_AH_RA", getValue(env_NaviSD_LDL_AH_RA), profile);
writeProfileInt( "BAP NAVI", "env_NaviSD_NbSpeller_Pos", getValue(env_NaviSD_NbSpeller_Pos), profile);
writeProfileInt( "BAP NAVI", "env_NaviSD_NbSpeller_MatchEntr", getValue(env_NaviSD_NbSpeller_MatchEntr), profile);
writeProfileInt( "BAP NAVI", "env_NaviSD_NbSpeller_Abort", getValue(env_NaviSD_NbSpeller_Abort), profile);
writeProfileInt( "BAP NAVI", "env_NaviSD_NbSpeller_Result", getValue(env_NaviSD_NbSpeller_Result), profile);
writeProfileInt( "BAP NAVI", "env_NaviSD_GetNextLiPos_Offset", getValue(env_NaviSD_GetNextLiPos_Offset), profile);
writeProfileInt( "BAP NAVI", "env_NaviSD_GetNextLiPos_AbsPos", getValue(env_NaviSD_GetNextLiPos_AbsPos), profile);
writeProfileInt( "BAP NAVI", "env_NaviSD_GetNextLiPos_NePos", getValue(env_NaviSD_GetNextLiPos_NePos), profile);
writeProfileInt( "BAP NAVI", "env_NaviSD_GetNextLiPos_CuPos", getValue(env_NaviSD_GetNextLiPos_CuPos), profile);
writeProfileInt( "BAP NAVI", "env_NaviSD_GetNextLiPos_Abort", getValue(env_NaviSD_GetNextLiPos_Abort), profile);
writeProfileInt( "BAP NAVI", "env_NaviSD_GetNextLiPos_Result", getValue(env_NaviSD_GetNextLiPos_Result), profile);
writeProfileInt( "BAP NAVI", "env_NaviSD_RepeatLastNavAnn_Abo", getValue(env_NaviSD_RepeatLastNavAnn_Abo), profile);
writeProfileInt( "BAP NAVI", "env_NaviSD_RepeatLastNavAnn_Res", getValue(env_NaviSD_RepeatLastNavAnn_Res), profile);
writeProfileInt( "BAP NAVI", "env_NaviSD_RGActDeact_AbortRes", getValue(env_NaviSD_RGActDeact_AbortRes), profile);
writeProfileInt( "BAP NAVI", "env_NaviSD_RGActDeact_CIInfo", getValue(env_NaviSD_RGActDeact_CIInfo), profile);
writeProfileInt( "BAP NAVI", "env_NaviSD_RGActDeact_Res", getValue(env_NaviSD_RGActDeact_Res), profile);
writeProfileInt( "BAP NAVI", "env_NaviSD_TBInd_TMCSym_update", getValue(env_NaviSD_TBInd_TMCSym_update), profile);
writeProfileInt( "BAP NAVI", "env_NaviSD_TBInd_TMCSym", getValue(env_NaviSD_TBInd_TMCSym), profile);
writeProfileInt( "BAP NAVI", "env_NaviSD_ActRGTy_RGType", getValue(env_NaviSD_ActRGTy_RGType), profile);
writeProfileInt( "BAP NAVI", "env_NaviSD_ActRGTy_RGType_update", getValue(env_NaviSD_ActRGTy_RGType_update), profile);
writeProfileInt( "BAP NAVI", "env_NaviSD_InfoStates_update", getValue(env_NaviSD_InfoStates_update), profile);
writeProfileInt( "BAP NAVI", "env_NaviSD_InfoStates_states", getValue(env_NaviSD_InfoStates_states), profile);
writeProfileInt( "BAP NAVI", "env_NaviSD_FctSync_update", getValue(env_NaviSD_FctSync_update), profile);
writeProfileInt( "BAP NAVI", "env_NaviSD_FctSync_Bit40_TBI", getValue(env_NaviSD_FctSync_Bit40_TBI), profile);
writeProfileInt( "BAP NAVI", "env_NaviSD_FctSync_Bit39_AGRT", getValue(env_NaviSD_FctSync_Bit39_AGRT), profile);
writeProfileInt( "BAP NAVI", "env_NaviSD_FctSync_Bit38_IS", getValue(env_NaviSD_FctSync_Bit38_IS), profile);
writeProfileInt( "BAP NAVI", "env_NaviSD_FctSync_Bit36_VG", getValue(env_NaviSD_FctSync_Bit36_VG), profile);
writeProfileInt( "BAP NAVI", "env_NaviSD_FctSync_Bit34_RGL", getValue(env_NaviSD_FctSync_Bit34_RGL), profile);
writeProfileInt( "BAP NAVI", "env_NaviSD_FctSync_Bit33_AL", getValue(env_NaviSD_FctSync_Bit33_AL), profile);
writeProfileInt( "BAP NAVI", "env_NaviSD_FctSync_Bit32_NavB", getValue(env_NaviSD_FctSync_Bit32_NavB), profile);
writeProfileInt( "BAP NAVI", "env_NaviSD_FctSync_Bit31_PrList", getValue(env_NaviSD_FctSync_Bit31_PrList), profile);
writeProfileInt( "BAP NAVI", "env_NaviSD_FctSync_Bit30_FaList", getValue(env_NaviSD_FctSync_Bit30_FaList), profile);
writeProfileInt( "BAP NAVI", "env_NaviSD_FctSync_Bit29_LDList", getValue(env_NaviSD_FctSync_Bit29_LDList), profile);
writeProfileInt( "BAP NAVI", "env_NaviSD_FctSync_Bit27_Cal", getValue(env_NaviSD_FctSync_Bit27_Cal), profile);
writeProfileInt( "BAP NAVI", "env_NaviSD_FctSync_Bit26_MFZ", getValue(env_NaviSD_FctSync_Bit26_MFZ), profile);
writeProfileInt( "BAP NAVI", "env_NaviSD_FctSync_Bit25_TMCI", getValue(env_NaviSD_FctSync_Bit25_TMCI), profile);
writeProfileInt( "BAP NAVI", "env_NaviSD_FctSync_Bit24_LG", getValue(env_NaviSD_FctSync_Bit24_LG), profile);
writeProfileInt( "BAP NAVI", "env_NaviSD_FctSync_Bit23_MD", getValue(env_NaviSD_FctSync_Bit23_MD), profile);
writeProfileInt( "BAP NAVI", "env_NaviSD_FctSync_Bit22_TTD", getValue(env_NaviSD_FctSync_Bit22_TTD), profile);
writeProfileInt( "BAP NAVI", "env_NaviSD_FctSync_Bit21_DTD", getValue(env_NaviSD_FctSync_Bit21_DTD), profile);
writeProfileInt( "BAP NAVI", "env_NaviSD_FctSync_Bit20_TTI", getValue(env_NaviSD_FctSync_Bit20_TTI), profile);
writeProfileInt( "BAP NAVI", "env_NaviSD_FctSync_Bit19_CPI", getValue(env_NaviSD_FctSync_Bit19_CPI), profile);
writeProfileInt( "BAP NAVI", "env_NaviSD_FctSync_Bit18_DTNM", getValue(env_NaviSD_FctSync_Bit18_DTNM), profile);
writeProfileInt( "BAP NAVI", "env_NaviSD_FctSync_Bit17_RGS", getValue(env_NaviSD_FctSync_Bit17_RGS), profile);
writeProfileInt( "BAP NAVI", "env_NaviSD_FctSync_Bit16_CI", getValue(env_NaviSD_FctSync_Bit16_CI), profile);
writeProfileInt( "BAP NAVI", "env_NaviSD_VG_State", getValue(env_NaviSD_VG_State), profile);
writeProfileInt( "BAP NAVI", "env_NaviSD_VG_State_update", getValue(env_NaviSD_VG_State_update), profile);
writeProfileInt( "BAP NAVI", "NeueVariable_100", getValue(NeueVariable_100), profile);
writeProfileInt( "BAP NAVI", "env_NaviSD_PrefDeLis_Type_update", getValue(env_NaviSD_PrefDeLis_Type_update), profile);
writeProfileInt( "BAP NAVI", "env_NaviSD_PrefDeLis_Type", getValue(env_NaviSD_PrefDeLis_Type), profile);
writeProfileInt( "BAP NAVI", "env_NaviSD_ASGcap_Pres", getValue(env_NaviSD_ASGcap_Pres), profile);
writeProfileInt( "BAP NAVI", "env_NaviSD_ASGcap_Pres_update", getValue(env_NaviSD_ASGcap_Pres_update), profile);
writeProfileInt( "BAP NAVI", "env_NaviSD_CaliState_set", getValue(env_NaviSD_CaliState_set), profile);
writeProfileInt( "BAP NAVI", "env_NaviSD_CaliState_update", getValue(env_NaviSD_CaliState_update), profile);
writeProfileInt( "BAP NAVI", "env_NaviSD_MFZone_Zone_set", getValue(env_NaviSD_MFZone_Zone_set), profile);
writeProfileInt( "BAP NAVI", "env_NaviSD_MFZone_update", getValue(env_NaviSD_MFZone_update), profile);
writeProfileInt( "BAP NAVI", "env_NaviSD_TMCI_MessageID", getValue(env_NaviSD_TMCI_MessageID), profile);
writeProfileInt( "BAP NAVI", "env_NaviSD_TMCI_Length_Validity", getValue(env_NaviSD_TMCI_Length_Validity), profile);
writeProfileInt( "BAP NAVI", "env_NaviSD_TTD_Year_VI", getValue(env_NaviSD_TTD_Year_VI), profile);
writeProfileInt( "BAP NAVI", "env_NaviSD_TTD_Month_VI", getValue(env_NaviSD_TTD_Month_VI), profile);
writeProfileInt( "BAP NAVI", "env_NaviSD_TTD_Day_VI", getValue(env_NaviSD_TTD_Day_VI), profile);
writeProfileInt( "BAP NAVI", "env_NaviSD_TTD_Hour_VI", getValue(env_NaviSD_TTD_Hour_VI), profile);
writeProfileInt( "BAP NAVI", "env_NaviSD_TTD_update", getValue(env_NaviSD_TTD_update), profile);
writeProfileInt( "BAP NAVI", "env_NaviSD_DTNM_ValidityInfo", getValue(env_NaviSD_DTNM_ValidityInfo), profile);
writeProfileInt( "BAP NAVI", "env_NaviSD_TMCI_Length_Unit", getValue(env_NaviSD_TMCI_Length_Unit), profile);
writeProfileInt( "BAP NAVI", "env_NaviSD_TMCI_Length_Value", getValue(env_NaviSD_TMCI_Length_Value), profile);
writeProfileInt( "BAP NAVI", "env_NaviSD_TMCI_Priority", getValue(env_NaviSD_TMCI_Priority), profile);
writeProfileInt( "BAP NAVI", "env_NaviSD_TMCI_MessageWaitInd", getValue(env_NaviSD_TMCI_MessageWaitInd), profile);
writeProfileInt( "BAP NAVI", "env_NaviSD_TTD_Minute_VI", getValue(env_NaviSD_TTD_Minute_VI), profile);
writeProfileInt( "BAP NAVI", "env_NaviSD_DTD_ValidityInfo", getValue(env_NaviSD_DTD_ValidityInfo), profile);
writeProfileInt( "BAP NAVI", "env_NaviSD_CompassInfo_update", getValue(env_NaviSD_CompassInfo_update), profile);
writeProfileInt( "BAP NAVI", "env_NaviSD_TTI_update", getValue(env_NaviSD_TTI_update), profile);
writeProfileInt( "BAP NAVI", "env_NaviSD_PositionInfo_update", getValue(env_NaviSD_PositionInfo_update), profile);
writeProfileInt( "BAP NAVI", "env_NaviSD_DTD_update", getValue(env_NaviSD_DTD_update), profile);
writeProfileInt( "BAP NAVI", "env_NaviSD_DTNM_update", getValue(env_NaviSD_DTNM_update), profile);
writeProfileInt( "BAP NAVI", "env_NaviSD_TMCI_update", getValue(env_NaviSD_TMCI_update), profile);
writeProfileInt( "BAP NAVI", "env_NaviSD_TMCI_MS", getValue(env_NaviSD_TMCI_MS), profile);
writeProfileInt( "BAP NAVI", "env_NaviSD_LNG_Changed", getValue(env_NaviSD_LNG_Changed), profile);
writeProfileInt( "BAP NAVI", "env_NaviSD_LaneGuidanceOnOff", getValue(env_NaviSD_LaneGuidanceOnOff), profile);
writeProfileInt( "BAP NAVI", "env_NaviSD_MD_Z_Level3", getValue(env_NaviSD_MD_Z_Level3), profile);
writeProfileInt( "BAP NAVI", "env_NaviSD_MD_Z_Level2", getValue(env_NaviSD_MD_Z_Level2), profile);
writeProfileInt( "BAP NAVI", "env_NaviSD_MD_Z_Level1", getValue(env_NaviSD_MD_Z_Level1), profile);
writeProfileInt( "BAP NAVI", "env_NaviSD_PowerOnOff", getValue(env_NaviSD_PowerOnOff), profile);
writeProfileInt( "BAP NAVI", "env_NaviSD_MD_update", getValue(env_NaviSD_MD_update), profile);
writeProfileInt( "BAP NAVI", "env_NaviSD_DTNM_BG_Info", getValue(env_NaviSD_DTNM_BG_Info), profile);
writeProfileInt( "BAP NAVI", "env_NaviSD_Direction_Symbolik", getValue(env_NaviSD_Direction_Symbolik), profile);
writeProfileInt( "BAP NAVI", "env_NaviSD_MD_Direction3", getValue(env_NaviSD_MD_Direction3), profile);
writeProfileInt( "BAP NAVI", "env_NaviSD_MD_MainElement3", getValue(env_NaviSD_MD_MainElement3), profile);
writeProfileInt( "BAP NAVI", "env_NaviSD_MD_Direction2", getValue(env_NaviSD_MD_Direction2), profile);
writeProfileInt( "BAP NAVI", "env_NaviSD_MD_MainElement2", getValue(env_NaviSD_MD_MainElement2), profile);
writeProfileInt( "BAP NAVI", "env_NaviSD_MD_Direction1", getValue(env_NaviSD_MD_Direction1), profile);
writeProfileInt( "BAP NAVI", "env_NaviSD_MD_MainElement1", getValue(env_NaviSD_MD_MainElement1), profile);
writeProfileInt( "BAP NAVI", "env_NaviSD_TTD_Year", getValue(env_NaviSD_TTD_Year), profile);
writeProfileInt( "BAP NAVI", "env_NaviSD_TTD_Month", getValue(env_NaviSD_TTD_Month), profile);
writeProfileInt( "BAP NAVI", "env_NaviSD_TTD_Day", getValue(env_NaviSD_TTD_Day), profile);
writeProfileInt( "BAP NAVI", "env_NaviSD_TTD_Hour", getValue(env_NaviSD_TTD_Hour), profile);
writeProfileInt( "BAP NAVI", "env_NaviSD_TTD_Minute", getValue(env_NaviSD_TTD_Minute), profile);
writeProfileInt( "BAP NAVI", "env_NaviSD_TTD_NavigationTF", getValue(env_NaviSD_TTD_NavigationTF), profile);
writeProfileInt( "BAP NAVI", "env_NaviSD_TTD_TimeInfoType", getValue(env_NaviSD_TTD_TimeInfoType), profile);
writeProfileInt( "BAP NAVI", "env_NaviSD_DTD_Unit", getValue(env_NaviSD_DTD_Unit), profile);
writeProfileInt( "BAP NAVI", "env_NaviSD_DTD_Distance", getValue(env_NaviSD_DTD_Distance), profile);
writeProfileInt( "BAP NAVI", "env_NaviSD_DTNM_BG", getValue(env_NaviSD_DTNM_BG), profile);
writeProfileInt( "BAP NAVI", "env_NaviSD_DTNM_BG_ON_OFF", getValue(env_NaviSD_DTNM_BG_ON_OFF), profile);
writeProfileInt( "BAP NAVI", "env_NaviSD_DTNM_Unit", getValue(env_NaviSD_DTNM_Unit), profile);
writeProfileInt( "BAP NAVI", "env_NaviSD_DTNM_Distance", getValue(env_NaviSD_DTNM_Distance), profile);
writeProfileInt( "BAP NAVI", "env_NaviSD_RG_Status", getValue(env_NaviSD_RG_Status), profile);
writeProfileInt( "BAP NAVI", "env_NaviSD_Direction_Angle", getValue(env_NaviSD_Direction_Angle), profile);
writeProfileInt( "BAP NAVI", "env_NaviSD_FSG_OP_State", getValue(env_NaviSD_FSG_OP_State), profile);
writeProfileInt( "BAP NAVI", "BAPCFG_FSG_NaviSD_ProtocolMinor", getValue(BAPCFG_FSG_NaviSD_ProtocolMinor), profile);
writeProfileInt( "BAP NAVI", "BAPCFG_FSG_NaviSD_ProtocolMajor", getValue(BAPCFG_FSG_NaviSD_ProtocolMajor), profile);
writeProfileInt( "BAP NAVI", "BAPCFG_FSG_NaviSD_LsgClassMinor", getValue(BAPCFG_FSG_NaviSD_LsgClassMinor), profile);
writeProfileInt( "BAP NAVI", "BAPCFG_FSG_NaviSD_LsgClassMajor", getValue(BAPCFG_FSG_NaviSD_LsgClassMajor), profile);
writeProfileInt( "BAP NAVI", "BAPCFG_FSG_NaviSD_DFMinor", getValue(BAPCFG_FSG_NaviSD_DFMinor), profile);
writeProfileInt( "BAP NAVI", "BAPCFG_FSG_NaviSD_DFMajor", getValue(BAPCFG_FSG_NaviSD_DFMajor), profile);
writeProfileInt( "BAP NAVI", "env_NaviSD_FctList_0x2A_HB", getValue(env_NaviSD_FctList_0x2A_HB), profile);
writeProfileInt( "BAP NAVI", "env_NaviSD_FctList_0x29_HB", getValue(env_NaviSD_FctList_0x29_HB), profile);
writeProfileInt( "BAP NAVI", "env_NaviSD_FctList_0x28_HB", getValue(env_NaviSD_FctList_0x28_HB), profile);
writeProfileInt( "BAP NAVI", "env_NaviSD_FctList_0x27_HB", getValue(env_NaviSD_FctList_0x27_HB), profile);
writeProfileInt( "BAP NAVI", "env_NaviSD_FctList_0x26_HB", getValue(env_NaviSD_FctList_0x26_HB), profile);
writeProfileInt( "BAP NAVI", "env_NaviSD_FctList_0x25_HB", getValue(env_NaviSD_FctList_0x25_HB), profile);
writeProfileInt( "BAP NAVI", "env_NaviSD_FctList_0x24_HB", getValue(env_NaviSD_FctList_0x24_HB), profile);
writeProfileInt( "BAP NAVI", "env_NaviSD_FctList_0x23_HB", getValue(env_NaviSD_FctList_0x23_HB), profile);
writeProfileInt( "BAP NAVI", "env_NaviSD_FctList_0x22_HB", getValue(env_NaviSD_FctList_0x22_HB), profile);
writeProfileInt( "BAP NAVI", "env_NaviSD_FctList_0x21_HB", getValue(env_NaviSD_FctList_0x21_HB), profile);
writeProfileInt( "BAP NAVI", "env_NaviSD_FctList_0x20_HB", getValue(env_NaviSD_FctList_0x20_HB), profile);
writeProfileInt( "BAP NAVI", "env_NaviSD_FctList_0x1F_HB", getValue(env_NaviSD_FctList_0x1F_HB), profile);
writeProfileInt( "BAP NAVI", "env_NaviSD_FctList_0x1E_HB", getValue(env_NaviSD_FctList_0x1E_HB), profile);
writeProfileInt( "BAP NAVI", "env_NaviSD_FctList_0x1D_HB", getValue(env_NaviSD_FctList_0x1D_HB), profile);
writeProfileInt( "BAP NAVI", "env_NaviSD_FctList_0x1C_HB", getValue(env_NaviSD_FctList_0x1C_HB), profile);
writeProfileInt( "BAP NAVI", "env_NaviSD_FctList_0x1B_HB", getValue(env_NaviSD_FctList_0x1B_HB), profile);
writeProfileInt( "BAP NAVI", "env_NaviSD_FctList_0x1A_HB", getValue(env_NaviSD_FctList_0x1A_HB), profile);
writeProfileInt( "BAP NAVI", "env_NaviSD_FctList_0x19_HB", getValue(env_NaviSD_FctList_0x19_HB), profile);
writeProfileInt( "BAP NAVI", "env_NaviSD_FctList_0x18_HB", getValue(env_NaviSD_FctList_0x18_HB), profile);
writeProfileInt( "BAP NAVI", "env_NaviSD_FctList_0x17_HB", getValue(env_NaviSD_FctList_0x17_HB), profile);
writeProfileInt( "BAP NAVI", "env_NaviSD_FctList_0x16_HB", getValue(env_NaviSD_FctList_0x16_HB), profile);
writeProfileInt( "BAP NAVI", "env_NaviSD_FctList_0x15_HB", getValue(env_NaviSD_FctList_0x15_HB), profile);
writeProfileInt( "BAP NAVI", "env_NaviSD_FctList_0x14_HB", getValue(env_NaviSD_FctList_0x14_HB), profile);
writeProfileInt( "BAP NAVI", "env_NaviSD_FctList_0x13_HB", getValue(env_NaviSD_FctList_0x13_HB), profile);
writeProfileInt( "BAP NAVI", "env_NaviSD_FctList_0x12_HB", getValue(env_NaviSD_FctList_0x12_HB), profile);
writeProfileInt( "BAP NAVI", "env_NaviSD_FctList_0x11_HB", getValue(env_NaviSD_FctList_0x11_HB), profile);
writeProfileInt( "BAP NAVI", "env_NaviSD_FctList_0x10_HB", getValue(env_NaviSD_FctList_0x10_HB), profile);
writeProfileInt( "BAP NAVI", "env_NaviSD_FctList_0x0F_HB", getValue(env_NaviSD_FctList_0x0F_HB), profile);
writeProfileInt( "BAP NAVI", "env_NaviSD_FctList_0x04_HB", getValue(env_NaviSD_FctList_0x04_HB), profile);
writeProfileInt( "BAP NAVI", "env_NaviSD_FctList_0x03_HB", getValue(env_NaviSD_FctList_0x03_HB), profile);
writeProfileInt( "BAP NAVI", "env_NaviSD_FctList_0x02_HB", getValue(env_NaviSD_FctList_0x02_HB), profile);
writeProfileInt( "BAP NAVI", "env_NaviSD_FctList_0x01_HB", getValue(env_NaviSD_FctList_0x01_HB), profile);
writeProfileInt( "BAP NAVI", "env_NaviSD_AL_TAID_error", getValue(env_NaviSD_AL_TAID_error), profile);
writeProfileInt( "BAP NAVI", "env_NaviSD_AL_ASGID_error", getValue(env_NaviSD_AL_ASGID_error), profile);
writeProfileInt( "BAP NAVI", "env_NaviSD_FDL_TAID_error", getValue(env_NaviSD_FDL_TAID_error), profile);
writeProfileInt( "BAP NAVI", "env_NaviSD_FDL_ASGID_error", getValue(env_NaviSD_FDL_ASGID_error), profile);
writeProfileInt( "BAP NAVI", "env_NaviSD_LDL_TAID_error", getValue(env_NaviSD_LDL_TAID_error), profile);
writeProfileInt( "BAP NAVI", "env_NaviSD_LDL_ASGID_error", getValue(env_NaviSD_LDL_ASGID_error), profile);
writeProfileInt( "BAP NAVI", "env_NaviSD_LG_TAID_error", getValue(env_NaviSD_LG_TAID_error), profile);
writeProfileInt( "BAP NAVI", "env_NaviSD_LG_ASGID_error", getValue(env_NaviSD_LG_ASGID_error), profile);
writeProfileInt( "BAP NAVI", "env_NaviSD_AL_Timeout", getValue(env_NaviSD_AL_Timeout), profile);
writeProfileInt( "BAP NAVI", "env_NaviSD_FDL_Timeout", getValue(env_NaviSD_FDL_Timeout), profile);
writeProfileInt( "BAP NAVI", "env_NaviSD_LDL_Timeout", getValue(env_NaviSD_LDL_Timeout), profile);
writeProfileInt( "BAP NAVI", "env_NaviSD_LG_Timeout", getValue(env_NaviSD_LG_Timeout), profile);
writeProfileInt( "BAP NAVI", "env_NaviSD_FctList_0x0F_TimeOut", getValue(env_NaviSD_FctList_0x0F_TimeOut), profile);
writeProfileInt( "BAP NAVI", "env_NaviSD_FctList_0x10_TimeOut", getValue(env_NaviSD_FctList_0x10_TimeOut), profile);
writeProfileInt( "BAP NAVI", "env_NaviSD_FctList_0x11_TimeOut", getValue(env_NaviSD_FctList_0x11_TimeOut), profile);
writeProfileInt( "BAP NAVI", "env_NaviSD_FctList_0x12_TimeOut", getValue(env_NaviSD_FctList_0x12_TimeOut), profile);
writeProfileInt( "BAP NAVI", "env_NaviSD_FctList_0x13_TimeOut", getValue(env_NaviSD_FctList_0x13_TimeOut), profile);
writeProfileInt( "BAP NAVI", "env_NaviSD_FctList_0x14_TimeOut", getValue(env_NaviSD_FctList_0x14_TimeOut), profile);
writeProfileInt( "BAP NAVI", "env_NaviSD_FctList_0x15_TimeOut", getValue(env_NaviSD_FctList_0x15_TimeOut), profile);
writeProfileInt( "BAP NAVI", "env_NaviSD_FctList_0x16_TimeOut", getValue(env_NaviSD_FctList_0x16_TimeOut), profile);
writeProfileInt( "BAP NAVI", "env_NaviSD_FctList_0x17_TimeOut", getValue(env_NaviSD_FctList_0x17_TimeOut), profile);
writeProfileInt( "BAP NAVI", "env_NaviSD_FctList_0x18_TimeOut", getValue(env_NaviSD_FctList_0x18_TimeOut), profile);
writeProfileInt( "BAP NAVI", "env_NaviSD_FctList_0x19_TimeOut", getValue(env_NaviSD_FctList_0x19_TimeOut), profile);
writeProfileInt( "BAP NAVI", "env_NaviSD_FctList_0x1A_TimeOut", getValue(env_NaviSD_FctList_0x1A_TimeOut), profile);
writeProfileInt( "BAP NAVI", "env_NaviSD_FctList_0x1B_TimeOut", getValue(env_NaviSD_FctList_0x1B_TimeOut), profile);
writeProfileInt( "BAP NAVI", "env_NaviSD_FctList_0x1C_TimeOut", getValue(env_NaviSD_FctList_0x1C_TimeOut), profile);
writeProfileInt( "BAP NAVI", "env_NaviSD_FctList_0x1D_TimeOut", getValue(env_NaviSD_FctList_0x1D_TimeOut), profile);
writeProfileInt( "BAP NAVI", "env_NaviSD_FctList_0x1E_TimeOut", getValue(env_NaviSD_FctList_0x1E_TimeOut), profile);
writeProfileInt( "BAP NAVI", "env_NaviSD_FctList_0x1F_TimeOut", getValue(env_NaviSD_FctList_0x1F_TimeOut), profile);
writeProfileInt( "BAP NAVI", "env_NaviSD_FctList_0x20_TimeOut", getValue(env_NaviSD_FctList_0x20_TimeOut), profile);
writeProfileInt( "BAP NAVI", "env_NaviSD_FctList_0x21_TimeOut", getValue(env_NaviSD_FctList_0x21_TimeOut), profile);
writeProfileInt( "BAP NAVI", "env_NaviSD_FctList_0x22_TimeOut", getValue(env_NaviSD_FctList_0x22_TimeOut), profile);
writeProfileInt( "BAP NAVI", "env_NaviSD_FctList_0x23_TimeOut", getValue(env_NaviSD_FctList_0x23_TimeOut), profile);
writeProfileInt( "BAP NAVI", "env_NaviSD_FctList_0x24_TimeOut", getValue(env_NaviSD_FctList_0x24_TimeOut), profile);
writeProfileInt( "BAP NAVI", "env_NaviSD_FctList_0x25_TimeOut", getValue(env_NaviSD_FctList_0x25_TimeOut), profile);
writeProfileInt( "BAP NAVI", "env_NaviSD_FctList_0x26_TimeOut", getValue(env_NaviSD_FctList_0x26_TimeOut), profile);
writeProfileInt( "BAP NAVI", "env_NaviSD_FctList_0x27_TimeOut", getValue(env_NaviSD_FctList_0x27_TimeOut), profile);
writeProfileInt( "BAP NAVI", "env_NaviSD_FctList_0x28_TimeOut", getValue(env_NaviSD_FctList_0x28_TimeOut), profile);
writeProfileInt( "BAP NAVI", "env_NaviSD_FctList_0x29_TimeOut", getValue(env_NaviSD_FctList_0x29_TimeOut), profile);
writeProfileInt( "BAP NAVI", "env_NaviSD_FctList_0x2A_TimeOut", getValue(env_NaviSD_FctList_0x2A_TimeOut), profile);
writeProfileInt( "BAP NAVI", "env_NaviSD_FctList_0x22_3min_TO", getValue(env_NaviSD_FctList_0x22_3min_TO), profile);
writeProfileInt( "BAP NAVI", "env_NaviSD_FctList_0x29_3min_TO", getValue(env_NaviSD_FctList_0x29_3min_TO), profile);
writeProfileInt( "BAP NAVI", "env_NaviSD_FctList_0x2A_3min_TO", getValue(env_NaviSD_FctList_0x2A_3min_TO), profile);
writeProfileInt( "BAP NAVI", "env_NaviSD_FctList_0x23_3min_TO", getValue(env_NaviSD_FctList_0x23_3min_TO), profile);
writeProfileInt( "BAP NAVI", "env_FSG_NaviSD_FctList_ErrCode", getValue(env_FSG_NaviSD_FctList_ErrCode), profile);
writeProfileInt( "BAP NAVI", "env_FSG_NaviSD_GetAll_ErrCode", getValue(env_FSG_NaviSD_GetAll_ErrCode), profile);
writeProfileInt( "BAP NAVI", "env_BAPCFG_FSG_NaviSD_ErrCode", getValue(env_BAPCFG_FSG_NaviSD_ErrCode), profile);
writeProfileInt( "BAP NAVI", "env_FSG_NaviSD_FctList_SegmEn", getValue(env_FSG_NaviSD_FctList_SegmEn), profile);
writeProfileInt( "BAP NAVI", "env_FSG_NaviSD_FctList_IntTlgEn", getValue(env_FSG_NaviSD_FctList_IntTlgEn), profile);
writeProfileInt( "BAP NAVI", "env_FSG_NaviSD_FctList_FctEn", getValue(env_FSG_NaviSD_FctList_FctEn), profile);
writeProfileInt( "BAP NAVI", "env_FSG_NaviSD_FctList_ErrEn", getValue(env_FSG_NaviSD_FctList_ErrEn), profile);
writeProfileInt( "BAP NAVI", "env_BAPCFG_FSG_NaviSD_FctEn", getValue(env_BAPCFG_FSG_NaviSD_FctEn), profile);
writeProfileInt( "BAP NAVI", "env_BAPCFG_FSG_NaviSD_ErrEn", getValue(env_BAPCFG_FSG_NaviSD_ErrEn), profile);
writeProfileInt( "BAP NAVI", "env_FSG_NaviSD_GetAll_FctEn", getValue(env_FSG_NaviSD_GetAll_FctEn), profile);
writeProfileInt( "BAP NAVI", "env_FSG_NaviSD_GetAll_ErrEn", getValue(env_FSG_NaviSD_GetAll_ErrEn), profile);
writeProfileInt( "BAP NAVI", "env_FSG_NaviSD_GetAll_IntTlgEn", getValue(env_FSG_NaviSD_GetAll_IntTlgEn), profile);
writeProfileInt( "BAP NAVI", "env_FSG_NaviSD_GetAll_SegmEn", getValue(env_FSG_NaviSD_GetAll_SegmEn), profile);
writeProfileInt( "BAP NAVI", "env_FSG_NaviSD_BAPCFG_ResetSet", getValue(env_FSG_NaviSD_BAPCFG_ResetSet), profile);
}
*/

//IssueList #200
void saveBAP_telSettings( char profile[] )
{
writeProfileInt( "BAP TEL", "env_FSG_GetAll_FctEn", getValue(env_FSG_GetAll_FctEn), profile);
writeProfileInt( "BAP TEL", "env_BAPCFG_FSG_FctEn", getValue(env_BAPCFG_FSG_FctEn), profile);
writeProfileInt( "BAP TEL", "env_FSG_FctList_FctEn", getValue(env_FSG_FctList_FctEn), profile);
writeProfileInt( "BAP TEL", "env_BAPCFG_FSG_ResetSet", getValue(env_BAPCFG_FSG_ResetSet), profile);
writeProfileInt( "BAP TEL", "env_FSG_FctList_ErrCode", getValue(env_FSG_FctList_ErrCode), profile);
writeProfileInt( "BAP TEL", "env_FSG_GetAll_ErrCode", getValue(env_FSG_GetAll_ErrCode), profile);
writeProfileInt( "BAP TEL", "env_BAPCFG_FSG_ErrCode", getValue(env_BAPCFG_FSG_ErrCode), profile);
writeProfileInt( "BAP TEL", "env_FSG_FctList_SegmEn", getValue(env_FSG_FctList_SegmEn), profile);
writeProfileInt( "BAP TEL", "env_FSG_FctList_IntTlgEn", getValue(env_FSG_FctList_IntTlgEn), profile);
writeProfileInt( "BAP TEL", "env_FSG_FctList_ErrEn", getValue(env_FSG_FctList_ErrEn), profile);
writeProfileInt( "BAP TEL", "env_BAPCFG_FSG_Tel_ErrEn", getValue(env_BAPCFG_FSG_Tel_ErrEn), profile);
writeProfileInt( "BAP TEL", "env_FSG_GetAll_ErrEn", getValue(env_FSG_GetAll_ErrEn), profile);
writeProfileInt( "BAP TEL", "env_FSG_GetAll_IntTlgEn", getValue(env_FSG_GetAll_IntTlgEn), profile);
writeProfileInt( "BAP TEL", "env_FSG_GetAll_SegmEn", getValue(env_FSG_GetAll_SegmEn), profile);
writeProfileInt( "BAP TEL", "env_FSG_Phonebook_FRU", getValue(env_FSG_Phonebook_FRU), profile);
writeProfileInt( "BAP TEL", "env_FSG_CN_FRU", getValue(env_FSG_CN_FRU), profile);
writeProfileInt( "BAP TEL", "env_FSG_Panel_PhoneBook_Insert", getValue(env_FSG_Panel_PhoneBook_Insert), profile);
writeProfileInt( "BAP TEL", "env_FSG_Tel_FctList_0x22_TimeOut", getValue(env_FSG_Tel_FctList_0x22_TimeOut), profile);
writeProfileInt( "BAP TEL", "env_FSG_Tel_FctList_0x0E_TimeOut", getValue(env_FSG_Tel_FctList_0x0E_TimeOut), profile);
writeProfileInt( "BAP TEL", "env_FSG_AutoRedialExtInfo_Cat", getValue(env_FSG_AutoRedialExtInfo_Cat), profile);
writeProfileInt( "BAP TEL", "env_FSG_AutoRedialExtInfo_OK", getValue(env_FSG_AutoRedialExtInfo_OK), profile);
writeProfileInt( "BAP TEL", "env_FSG_Telephone_HB_input", getValue(env_FSG_Telephone_HB_input), profile);
writeProfileInt( "BAP TEL", "env_FSG_Telephone_HB_button", getValue(env_FSG_Telephone_HB_button), profile);
writeProfileInt( "BAP TEL", "env_FSG_HandsFreeOnOff_OK", getValue(env_FSG_HandsFreeOnOff_OK), profile);
writeProfileInt( "BAP TEL", "env_FSG_MicroMuteOnOff_OK", getValue(env_FSG_MicroMuteOnOff_OK), profile);
writeProfileInt( "BAP TEL", "env_FSG_RingToneMuteOnOff_OK", getValue(env_FSG_RingToneMuteOnOff_OK), profile);
writeProfileInt( "BAP TEL", "env_FSG_AutoRedial_OK", getValue(env_FSG_AutoRedial_OK), profile);
writeProfileInt( "BAP TEL", "env_FSG_DataConnInd_OK", getValue(env_FSG_DataConnInd_OK), profile);
writeProfileInt( "BAP TEL", "env_FSG_SignalQuality_OK", getValue(env_FSG_SignalQuality_OK), profile);
writeProfileInt( "BAP TEL", "env_FSG_Tel_AcceptCall_ErrorCode", getValue(env_FSG_Tel_AcceptCall_ErrorCode), profile);
writeProfileInt( "BAP TEL", "env_FSG_Tel_GetNextListPos_E_O", getValue(env_FSG_Tel_GetNextListPos_E_O), profile);
writeProfileInt( "BAP TEL", "env_FSG_Tel_MPSWCOH_Error_On", getValue(env_FSG_Tel_MPSWCOH_Error_On), profile);
writeProfileInt( "BAP TEL", "env_FSG_Tel_MPRAllCAWC_Error_On", getValue(env_FSG_Tel_MPRAllCAWC_Error_On), profile);
writeProfileInt( "BAP TEL", "env_FSG_Tel_CCJoin_Error_On", getValue(env_FSG_Tel_CCJoin_Error_On), profile);
writeProfileInt( "BAP TEL", "env_FSG_Tel_ECall_Error_On", getValue(env_FSG_Tel_ECall_Error_On), profile);
writeProfileInt( "BAP TEL", "env_FSG_Tel_PbSpeller_Error_On", getValue(env_FSG_Tel_PbSpeller_Error_On), profile);
writeProfileInt( "BAP TEL", "env_FSG_Tel_MPCHAWC_Error_On", getValue(env_FSG_Tel_MPCHAWC_Error_On), profile);
writeProfileInt( "BAP TEL", "env_FSG_Tel_MPSWAP_Error_On", getValue(env_FSG_Tel_MPSWAP_Error_On), profile);
writeProfileInt( "BAP TEL", "env_FSG_Tel_MPRACAWC_Error_On", getValue(env_FSG_Tel_MPRACAWC_Error_On), profile);
writeProfileInt( "BAP TEL", "env_FSG_Tel_HangUpCall_Error_On", getValue(env_FSG_Tel_HangUpCall_Error_On), profile);
writeProfileInt( "BAP TEL", "env_FSG_Tel_DialServ_Error_On", getValue(env_FSG_Tel_DialServ_Error_On), profile);
writeProfileInt( "BAP TEL", "env_FSG_Tel_CallHold_Error_On", getValue(env_FSG_Tel_CallHold_Error_On), profile);
writeProfileInt( "BAP TEL", "env_FSG_Tel_ResumeCall_Error_On", getValue(env_FSG_Tel_ResumeCall_Error_On), profile);
writeProfileInt( "BAP TEL", "env_FSG_Tel_AcceptCall_Error_On", getValue(env_FSG_Tel_AcceptCall_Error_On), profile);
writeProfileInt( "BAP TEL", "env_FSG_Tel_DialNumber_Error_On", getValue(env_FSG_Tel_DialNumber_Error_On), profile);
writeProfileInt( "BAP TEL", "env_FSG_Tel_MPSWCOH_ErrorCode", getValue(env_FSG_Tel_MPSWCOH_ErrorCode), profile);
writeProfileInt( "BAP TEL", "env_FSG_Tel_MPRAllCAWC_ErrorCode", getValue(env_FSG_Tel_MPRAllCAWC_ErrorCode), profile);
writeProfileInt( "BAP TEL", "env_FSG_Tel_CCJoin_ErrorCode", getValue(env_FSG_Tel_CCJoin_ErrorCode), profile);
writeProfileInt( "BAP TEL", "env_FSG_Tel_ECall_ErrorCode", getValue(env_FSG_Tel_ECall_ErrorCode), profile);
writeProfileInt( "BAP TEL", "env_FSG_Tel_PbSpeller_ErrorCode", getValue(env_FSG_Tel_PbSpeller_ErrorCode), profile);
writeProfileInt( "BAP TEL", "env_FSG_Tel_MPCHAWC_ErrorCode", getValue(env_FSG_Tel_MPCHAWC_ErrorCode), profile);
writeProfileInt( "BAP TEL", "env_FSG_Tel_MPSWAP_ErrorCode", getValue(env_FSG_Tel_MPSWAP_ErrorCode), profile);
writeProfileInt( "BAP TEL", "env_FSG_Tel_MPRACAWC_ErrorCode", getValue(env_FSG_Tel_MPRACAWC_ErrorCode), profile);
writeProfileInt( "BAP TEL", "env_FSG_Tel_HangUpCall_ErrorCode", getValue(env_FSG_Tel_HangUpCall_ErrorCode), profile);
writeProfileInt( "BAP TEL", "env_FSG_Tel_DialServ_ErrorCode", getValue(env_FSG_Tel_DialServ_ErrorCode), profile);
writeProfileInt( "BAP TEL", "env_FSG_Tel_CallHold_ErrorCode", getValue(env_FSG_Tel_CallHold_ErrorCode), profile);
writeProfileInt( "BAP TEL", "env_FSG_Tel_ResumeCall_ErrorCode", getValue(env_FSG_Tel_ResumeCall_ErrorCode), profile);
writeProfileInt( "BAP TEL", "env_FSG_Tel_DialNumber_ErrorCode", getValue(env_FSG_Tel_DialNumber_ErrorCode), profile);
writeProfileInt( "BAP TEL", "env_FSG_Tel_GetNextListPos_EC", getValue(env_FSG_Tel_GetNextListPos_EC), profile);
writeProfileInt( "BAP TEL", "env_FSG_PbSpeller_Pos", getValue(env_FSG_PbSpeller_Pos), profile);
writeProfileInt( "BAP TEL", "env_FSG_PbSpeller_Mode", getValue(env_FSG_PbSpeller_Mode), profile);
writeProfileInt( "BAP TEL", "env_FSG_PbSpeller_Result", getValue(env_FSG_PbSpeller_Result), profile);
writeProfileInt( "BAP TEL", "env_FSG_GetNextListPos_AbsLpos", getValue(env_FSG_GetNextListPos_AbsLpos), profile);
writeProfileInt( "BAP TEL", "env_FSG_GetNextListPos_nextPos", getValue(env_FSG_GetNextListPos_nextPos), profile);
writeProfileInt( "BAP TEL", "env_FSG_GetNextListPos_Offset", getValue(env_FSG_GetNextListPos_Offset), profile);
writeProfileInt( "BAP TEL", "env_FSG_GetNextListPos_current", getValue(env_FSG_GetNextListPos_current), profile);
writeProfileInt( "BAP TEL", "env_FSG_GetNextListPos_Result", getValue(env_FSG_GetNextListPos_Result), profile);
writeProfileInt( "BAP TEL", "env_FSG_GetNextListPos_ListType", getValue(env_FSG_GetNextListPos_ListType), profile);
writeProfileInt( "BAP TEL", "env_FSG_AutoRedialExtInfo_Ctgry", getValue(env_FSG_AutoRedialExtInfo_Ctgry), profile);
writeProfileInt( "BAP TEL", "env_FSG_AutoRedialExtInfo_Tstamp", getValue(env_FSG_AutoRedialExtInfo_Tstamp), profile);
writeProfileInt( "BAP TEL", "env_FSG_DialService_Result", getValue(env_FSG_DialService_Result), profile);
writeProfileInt( "BAP TEL", "env_FSG_DialService_Type", getValue(env_FSG_DialService_Type), profile);
writeProfileInt( "BAP TEL", "env_FSG_ConfirmECall_Control", getValue(env_FSG_ConfirmECall_Control), profile);
writeProfileInt( "BAP TEL", "env_FSG_ConfirmECall_Result", getValue(env_FSG_ConfirmECall_Result), profile);
writeProfileInt( "BAP TEL", "env_FSG_MPRAllCAWC_Result", getValue(env_FSG_MPRAllCAWC_Result), profile);
writeProfileInt( "BAP TEL", "env_FSG_CCJoin_Result", getValue(env_FSG_CCJoin_Result), profile);
writeProfileInt( "BAP TEL", "env_FSG_MPSWCOH_Result", getValue(env_FSG_MPSWCOH_Result), profile);
writeProfileInt( "BAP TEL", "env_FSG_MPCHAWC_Result", getValue(env_FSG_MPCHAWC_Result), profile);
writeProfileInt( "BAP TEL", "env_FSG_MPSwap_Result", getValue(env_FSG_MPSwap_Result), profile);
writeProfileInt( "BAP TEL", "env_FSG_MPRACAWC_Result", getValue(env_FSG_MPRACAWC_Result), profile);
writeProfileInt( "BAP TEL", "env_FSG_HangupCall_CallID_M", getValue(env_FSG_HangupCall_CallID_M), profile);
writeProfileInt( "BAP TEL", "env_FSG_DialNumber_Result", getValue(env_FSG_DialNumber_Result), profile);
writeProfileInt( "BAP TEL", "env_FSG_HangUpCall_Result", getValue(env_FSG_HangUpCall_Result), profile);
writeProfileInt( "BAP TEL", "env_FSG_CallResume_Result", getValue(env_FSG_CallResume_Result), profile);
writeProfileInt( "BAP TEL", "env_FSG_CallHold_Result", getValue(env_FSG_CallHold_Result), profile);
writeProfileInt( "BAP TEL", "env_FSG_AcceptCall_Result", getValue(env_FSG_AcceptCall_Result), profile);
writeProfileInt( "BAP TEL", "env_BAPCFG_FSG_Tel_LsgClssMnr", getValue(env_BAPCFG_FSG_Tel_LsgClssMnr), profile);
writeProfileInt( "BAP TEL", "env_BAPCFG_FSG_Tel_DFMinor", getValue(env_BAPCFG_FSG_Tel_DFMinor), profile);
writeProfileInt( "BAP TEL", "env_BAPCFG_FSG_Tel_DFMajor", getValue(env_BAPCFG_FSG_Tel_DFMajor), profile);
writeProfileInt( "BAP TEL", "env_BAPCFG_FSG_Tel_LsgClssMjr", getValue(env_BAPCFG_FSG_Tel_LsgClssMjr), profile);
writeProfileInt( "BAP TEL", "env_BAPCFG_FSG_Tel_PrtclMnr", getValue(env_BAPCFG_FSG_Tel_PrtclMnr), profile);
writeProfileInt( "BAP TEL", "env_BAPCFG_FSG_Tel_PrtclMjr", getValue(env_BAPCFG_FSG_Tel_PrtclMjr), profile);
writeProfileInt( "BAP TEL", "env_Phone_Phonebook_list_short", getValue(env_Phone_Phonebook_list_short), profile);
writeProfileInt( "BAP TEL", "env_Phone_Phonebook_list_long", getValue(env_Phone_Phonebook_list_long), profile);
writeProfileInt( "BAP TEL", "env_Phone_CombNum_list_long", getValue(env_Phone_CombNum_list_long), profile);
writeProfileInt( "BAP TEL", "env_Phone_CombNum_list_short", getValue(env_Phone_CombNum_list_short), profile);
writeProfileInt( "BAP TEL", "env_FSG_Telephone_MSS_0x3F", getValue(env_FSG_Telephone_MSS_0x3F), profile);
writeProfileInt( "BAP TEL", "env_FSG_Telephone_MSS_0x3E", getValue(env_FSG_Telephone_MSS_0x3E), profile);
writeProfileInt( "BAP TEL", "env_FSG_Telephone_MSS_0x3D", getValue(env_FSG_Telephone_MSS_0x3D), profile);
writeProfileInt( "BAP TEL", "env_FSG_Telephone_MSS_0x3C", getValue(env_FSG_Telephone_MSS_0x3C), profile);
writeProfileInt( "BAP TEL", "env_FSG_Telephone_MSS_0x3B", getValue(env_FSG_Telephone_MSS_0x3B), profile);
writeProfileInt( "BAP TEL", "env_FSG_Telephone_MSS_0x3A", getValue(env_FSG_Telephone_MSS_0x3A), profile);
writeProfileInt( "BAP TEL", "env_FSG_Telephone_MSS_0x39", getValue(env_FSG_Telephone_MSS_0x39), profile);
writeProfileInt( "BAP TEL", "env_FSG_Telephone_MSS_0x38", getValue(env_FSG_Telephone_MSS_0x38), profile);
writeProfileInt( "BAP TEL", "env_FSG_AutomaticRedial_Active", getValue(env_FSG_AutomaticRedial_Active), profile);
writeProfileInt( "BAP TEL", "env_FSG_Panel_Methods", getValue(env_FSG_Panel_Methods), profile);
writeProfileInt( "BAP TEL", "env_FSG_Panel_Properties1", getValue(env_FSG_Panel_Properties1), profile);
writeProfileInt( "BAP TEL", "env_FSG_Panel_CombNum_Array", getValue(env_FSG_Panel_CombNum_Array), profile);
writeProfileInt( "BAP TEL", "env_FSG_Panel_Properties2", getValue(env_FSG_Panel_Properties2), profile);
writeProfileInt( "BAP TEL", "env_FSG_Panel_ServiceSupport", getValue(env_FSG_Panel_ServiceSupport), profile);
writeProfileInt( "BAP TEL", "env_FSG_Panel_LoadUtf8OutputPanels", getValue(env_FSG_Panel_LoadUtf8OutputPanels), profile);
writeProfileInt( "BAP TEL", "env_FSG_Panel_MissedCalls_Array", getValue(env_FSG_Panel_MissedCalls_Array), profile);
writeProfileInt( "BAP TEL", "env_FSG_Panel_SendData", getValue(env_FSG_Panel_SendData), profile);
writeProfileInt( "BAP TEL", "env_FSG_Panel_MissedCalls", getValue(env_FSG_Panel_MissedCalls), profile);
writeProfileInt( "BAP TEL", "env_FSG_Panel_DialedNumbers", getValue(env_FSG_Panel_DialedNumbers), profile);
writeProfileInt( "BAP TEL", "env_FSG_Panel_RecCalls_Array", getValue(env_FSG_Panel_RecCalls_Array), profile);
writeProfileInt( "BAP TEL", "env_FSG_Panel_CombinedNumbers", getValue(env_FSG_Panel_CombinedNumbers), profile);
writeProfileInt( "BAP TEL", "env_FSG_Panel_Phonebook_Array", getValue(env_FSG_Panel_Phonebook_Array), profile);
writeProfileInt( "BAP TEL", "env_FSG_Panel_Phonebook", getValue(env_FSG_Panel_Phonebook), profile);
writeProfileInt( "BAP TEL", "env_FSG_Panel_RemoteSide", getValue(env_FSG_Panel_RemoteSide), profile);
writeProfileInt( "BAP TEL", "env_FSG_Schalter_OnOff", getValue(env_FSG_Schalter_OnOff), profile);
writeProfileInt( "BAP TEL", "env_FSG_ConfirmCall_Cancel", getValue(env_FSG_ConfirmCall_Cancel), profile);
writeProfileInt( "BAP TEL", "env_FSG_ConfirmCall_Confirm", getValue(env_FSG_ConfirmCall_Confirm), profile);
writeProfileInt( "BAP TEL", "env_FSG_DialService_Enabled", getValue(env_FSG_DialService_Enabled), profile);
writeProfileInt( "BAP TEL", "env_FSG_DN_TotalNumLE", getValue(env_FSG_DN_TotalNumLE), profile);
writeProfileInt( "BAP TEL", "env_FSG_DN_TAID", getValue(env_FSG_DN_TAID), profile);
writeProfileInt( "BAP TEL", "env_FSG_DN_StatusArray", getValue(env_FSG_DN_StatusArray), profile);
writeProfileInt( "BAP TEL", "env_FSG_DN_SetGetArray_behaviour", getValue(env_FSG_DN_SetGetArray_behaviour), profile);
writeProfileInt( "BAP TEL", "env_FSG_DN_reload", getValue(env_FSG_DN_reload), profile);
writeProfileInt( "BAP TEL", "env_FSG_DN_DataSource", getValue(env_FSG_DN_DataSource), profile);
writeProfileInt( "BAP TEL", "env_FSG_DN_CA_switch", getValue(env_FSG_DN_CA_switch), profile);
writeProfileInt( "BAP TEL", "env_FSG_DN_CA", getValue(env_FSG_DN_CA), profile);
writeProfileInt( "BAP TEL", "env_FSG_DN_ASGID", getValue(env_FSG_DN_ASGID), profile);
writeProfileInt( "BAP TEL", "env_FSG_DN_AH_start", getValue(env_FSG_DN_AH_start), profile);
writeProfileInt( "BAP TEL", "env_FSG_DN_AH_shift", getValue(env_FSG_DN_AH_shift), profile);
writeProfileInt( "BAP TEL", "env_FSG_DN_AH_RA", getValue(env_FSG_DN_AH_RA), profile);
writeProfileInt( "BAP TEL", "env_FSG_DN_AH_POS", getValue(env_FSG_DN_AH_POS), profile);
writeProfileInt( "BAP TEL", "env_FSG_DN_AH_IS", getValue(env_FSG_DN_AH_IS), profile);
writeProfileInt( "BAP TEL", "env_FSG_DN_AH_elements", getValue(env_FSG_DN_AH_elements), profile);
writeProfileInt( "BAP TEL", "env_FSG_DN_AH_dir", getValue(env_FSG_DN_AH_dir), profile);
writeProfileInt( "BAP TEL", "env_FSG_RC_TotalNumLE", getValue(env_FSG_RC_TotalNumLE), profile);
writeProfileInt( "BAP TEL", "env_FSG_RC_TAID", getValue(env_FSG_RC_TAID), profile);
writeProfileInt( "BAP TEL", "env_FSG_RC_StatusArray", getValue(env_FSG_RC_StatusArray), profile);
writeProfileInt( "BAP TEL", "env_FSG_RC_SetGetArray_behaviour", getValue(env_FSG_RC_SetGetArray_behaviour), profile);
writeProfileInt( "BAP TEL", "env_FSG_RC_reload", getValue(env_FSG_RC_reload), profile);
writeProfileInt( "BAP TEL", "env_FSG_RC_CA_switch", getValue(env_FSG_RC_CA_switch), profile);
writeProfileInt( "BAP TEL", "env_FSG_RC_DataSource", getValue(env_FSG_RC_DataSource), profile);
writeProfileInt( "BAP TEL", "env_FSG_RC_CA", getValue(env_FSG_RC_CA), profile);
writeProfileInt( "BAP TEL", "env_FSG_RC_ASGID", getValue(env_FSG_RC_ASGID), profile);
writeProfileInt( "BAP TEL", "env_FSG_RC_AH_start", getValue(env_FSG_RC_AH_start), profile);
writeProfileInt( "BAP TEL", "env_FSG_RC_AH_shift", getValue(env_FSG_RC_AH_shift), profile);
writeProfileInt( "BAP TEL", "env_FSG_RC_AH_RA", getValue(env_FSG_RC_AH_RA), profile);
writeProfileInt( "BAP TEL", "env_FSG_RC_AH_POS", getValue(env_FSG_RC_AH_POS), profile);
writeProfileInt( "BAP TEL", "env_FSG_RC_AH_IS", getValue(env_FSG_RC_AH_IS), profile);
writeProfileInt( "BAP TEL", "env_FSG_RC_AH_elements", getValue(env_FSG_RC_AH_elements), profile);
writeProfileInt( "BAP TEL", "env_FSG_RC_AH_dir", getValue(env_FSG_RC_AH_dir), profile);
writeProfileInt( "BAP TEL", "env_FSG_CN_SetGetArray_behaviour", getValue(env_FSG_CN_SetGetArray_behaviour), profile);
writeProfileInt( "BAP TEL", "env_FSG_CN_CA_switch", getValue(env_FSG_CN_CA_switch), profile);
writeProfileInt( "BAP TEL", "env_FSG_CN_reload", getValue(env_FSG_CN_reload), profile);
writeProfileInt( "BAP TEL", "env_FSG_CN_DataSource", getValue(env_FSG_CN_DataSource), profile);
writeProfileInt( "BAP TEL", "env_FSG_CN_StatusArray", getValue(env_FSG_CN_StatusArray), profile);
writeProfileInt( "BAP TEL", "env_FSG_CN_CA", getValue(env_FSG_CN_CA), profile);
writeProfileInt( "BAP TEL", "env_FSG_CN_AH_elements", getValue(env_FSG_CN_AH_elements), profile);
writeProfileInt( "BAP TEL", "env_FSG_CN_AH_start", getValue(env_FSG_CN_AH_start), profile);
writeProfileInt( "BAP TEL", "env_FSG_CN_AH_RA", getValue(env_FSG_CN_AH_RA), profile);
writeProfileInt( "BAP TEL", "env_FSG_CN_AH_IS", getValue(env_FSG_CN_AH_IS), profile);
writeProfileInt( "BAP TEL", "env_FSG_CN_AH_POS", getValue(env_FSG_CN_AH_POS), profile);
writeProfileInt( "BAP TEL", "env_FSG_CN_AH_dir", getValue(env_FSG_CN_AH_dir), profile);
writeProfileInt( "BAP TEL", "env_FSG_CN_AH_shift", getValue(env_FSG_CN_AH_shift), profile);
writeProfileInt( "BAP TEL", "env_FSG_CN_TotalNumLE", getValue(env_FSG_CN_TotalNumLE), profile);
writeProfileInt( "BAP TEL", "env_FSG_CN_TAID", getValue(env_FSG_CN_TAID), profile);
writeProfileInt( "BAP TEL", "env_FSG_CN_ASGID", getValue(env_FSG_CN_ASGID), profile);
writeProfileInt( "BAP TEL", "env_FSG_RingToneMuteOnOff", getValue(env_FSG_RingToneMuteOnOff), profile);
writeProfileInt( "BAP TEL", "env_FSG_CallInfo_update", getValue(env_FSG_CallInfo_update), profile);
writeProfileInt( "BAP TEL", "env_FSG_open_send_data_panel", getValue(env_FSG_open_send_data_panel), profile);
writeProfileInt( "BAP TEL", "env_FSG_CallType_CallID_6_set", getValue(env_FSG_CallType_CallID_6_set), profile);
writeProfileInt( "BAP TEL", "env_FSG_CallType_CallID_5_set", getValue(env_FSG_CallType_CallID_5_set), profile);
writeProfileInt( "BAP TEL", "env_FSG_CallType_CallID_4_set", getValue(env_FSG_CallType_CallID_4_set), profile);
writeProfileInt( "BAP TEL", "env_FSG_CallType_CallID_3_set", getValue(env_FSG_CallType_CallID_3_set), profile);
writeProfileInt( "BAP TEL", "env_FSG_CallType_CallID_2_set", getValue(env_FSG_CallType_CallID_2_set), profile);
writeProfileInt( "BAP TEL", "env_FSG_CallType_CallID_1_set", getValue(env_FSG_CallType_CallID_1_set), profile);
writeProfileInt( "BAP TEL", "env_FSG_CallType_CallID_0_set", getValue(env_FSG_CallType_CallID_0_set), profile);
writeProfileInt( "BAP TEL", "env_FSG_CallState_CallID_6_set", getValue(env_FSG_CallState_CallID_6_set), profile);
writeProfileInt( "BAP TEL", "env_FSG_CallState_CallID_5_set", getValue(env_FSG_CallState_CallID_5_set), profile);
writeProfileInt( "BAP TEL", "env_FSG_CallState_CallID_4_set", getValue(env_FSG_CallState_CallID_4_set), profile);
writeProfileInt( "BAP TEL", "env_FSG_CallState_CallID_3_set", getValue(env_FSG_CallState_CallID_3_set), profile);
writeProfileInt( "BAP TEL", "env_FSG_CallState_CallID_2_set", getValue(env_FSG_CallState_CallID_2_set), profile);
writeProfileInt( "BAP TEL", "env_FSG_CallState_CallID_1_set", getValue(env_FSG_CallState_CallID_1_set), profile);
writeProfileInt( "BAP TEL", "env_FSG_CallState_CallID_0_set", getValue(env_FSG_CallState_CallID_0_set), profile);
writeProfileInt( "BAP TEL", "env_FSG_CallState_update", getValue(env_FSG_CallState_update), profile);
writeProfileInt( "BAP TEL", "env_FSG_Phonebook19_TelNumberQua", getValue(env_FSG_Phonebook19_TelNumberQuantity), profile);
writeProfileInt( "BAP TEL", "env_FSG_Phonebook19_AddressInd", getValue(env_FSG_Phonebook19_AddressInd), profile);
writeProfileInt( "BAP TEL", "env_FSG_Phonebook19_VoiceTag1", getValue(env_FSG_Phonebook19_VoiceTag1), profile);
writeProfileInt( "BAP TEL", "env_FSG_Phonebook19_AnyVoiceTag", getValue(env_FSG_Phonebook19_AnyVoiceTag), profile);
writeProfileInt( "BAP TEL", "env_FSG_Phonebook19_Storage", getValue(env_FSG_Phonebook19_Storage), profile);
writeProfileInt( "BAP TEL", "env_FSG_Phonebook19_Pos", getValue(env_FSG_Phonebook19_Pos), profile);
writeProfileInt( "BAP TEL", "env_FSG_Phonebook18_TelNumberQua", getValue(env_FSG_Phonebook18_TelNumberQuantity), profile);
writeProfileInt( "BAP TEL", "env_FSG_Phonebook18_AddressInd", getValue(env_FSG_Phonebook18_AddressInd), profile);
writeProfileInt( "BAP TEL", "env_FSG_Phonebook18_VoiceTag1", getValue(env_FSG_Phonebook18_VoiceTag1), profile);
writeProfileInt( "BAP TEL", "env_FSG_Phonebook18_AnyVoiceTag", getValue(env_FSG_Phonebook18_AnyVoiceTag), profile);
writeProfileInt( "BAP TEL", "env_FSG_Phonebook18_Storage", getValue(env_FSG_Phonebook18_Storage), profile);
writeProfileInt( "BAP TEL", "env_FSG_Phonebook18_Pos", getValue(env_FSG_Phonebook18_Pos), profile);
writeProfileInt( "BAP TEL", "env_FSG_Phonebook17_TelNumberQua", getValue(env_FSG_Phonebook17_TelNumberQuantity), profile);
writeProfileInt( "BAP TEL", "env_FSG_Phonebook17_AddressInd", getValue(env_FSG_Phonebook17_AddressInd), profile);
writeProfileInt( "BAP TEL", "env_FSG_Phonebook17_VoiceTag1", getValue(env_FSG_Phonebook17_VoiceTag1), profile);
writeProfileInt( "BAP TEL", "env_FSG_Phonebook17_AnyVoiceTag", getValue(env_FSG_Phonebook17_AnyVoiceTag), profile);
writeProfileInt( "BAP TEL", "env_FSG_Phonebook17_Storage", getValue(env_FSG_Phonebook17_Storage), profile);
writeProfileInt( "BAP TEL", "env_FSG_Phonebook17_Pos", getValue(env_FSG_Phonebook17_Pos), profile);
writeProfileInt( "BAP TEL", "env_FSG_Phonebook16_TelNumberQua", getValue(env_FSG_Phonebook16_TelNumberQuantity), profile);
writeProfileInt( "BAP TEL", "env_FSG_Phonebook16_AddressInd", getValue(env_FSG_Phonebook16_AddressInd), profile);
writeProfileInt( "BAP TEL", "env_FSG_Phonebook16_VoiceTag1", getValue(env_FSG_Phonebook16_VoiceTag1), profile);
writeProfileInt( "BAP TEL", "env_FSG_Phonebook16_AnyVoiceTag", getValue(env_FSG_Phonebook16_AnyVoiceTag), profile);
writeProfileInt( "BAP TEL", "env_FSG_Phonebook16_Storage", getValue(env_FSG_Phonebook16_Storage), profile);
writeProfileInt( "BAP TEL", "env_FSG_Phonebook16_Pos", getValue(env_FSG_Phonebook16_Pos), profile);
writeProfileInt( "BAP TEL", "env_FSG_Phonebook15_TelNumberQua", getValue(env_FSG_Phonebook15_TelNumberQuantity), profile);
writeProfileInt( "BAP TEL", "env_FSG_Phonebook15_AddressInd", getValue(env_FSG_Phonebook15_AddressInd), profile);
writeProfileInt( "BAP TEL", "env_FSG_Phonebook15_VoiceTag1", getValue(env_FSG_Phonebook15_VoiceTag1), profile);
writeProfileInt( "BAP TEL", "env_FSG_Phonebook15_AnyVoiceTag", getValue(env_FSG_Phonebook15_AnyVoiceTag), profile);
writeProfileInt( "BAP TEL", "env_FSG_Phonebook15_Storage", getValue(env_FSG_Phonebook15_Storage), profile);
writeProfileInt( "BAP TEL", "env_FSG_Phonebook15_Pos", getValue(env_FSG_Phonebook15_Pos), profile);
writeProfileInt( "BAP TEL", "env_FSG_Phonebook14_TelNumberQua", getValue(env_FSG_Phonebook14_TelNumberQuantity), profile);
writeProfileInt( "BAP TEL", "env_FSG_Phonebook14_AddressInd", getValue(env_FSG_Phonebook14_AddressInd), profile);
writeProfileInt( "BAP TEL", "env_FSG_Phonebook14_VoiceTag1", getValue(env_FSG_Phonebook14_VoiceTag1), profile);
writeProfileInt( "BAP TEL", "env_FSG_Phonebook14_AnyVoiceTag", getValue(env_FSG_Phonebook14_AnyVoiceTag), profile);
writeProfileInt( "BAP TEL", "env_FSG_Phonebook14_Storage", getValue(env_FSG_Phonebook14_Storage), profile);
writeProfileInt( "BAP TEL", "env_FSG_Phonebook14_Pos", getValue(env_FSG_Phonebook14_Pos), profile);
writeProfileInt( "BAP TEL", "env_FSG_Phonebook13_TelNumberQua", getValue(env_FSG_Phonebook13_TelNumberQuantity), profile);
writeProfileInt( "BAP TEL", "env_FSG_Phonebook13_AddressInd", getValue(env_FSG_Phonebook13_AddressInd), profile);
writeProfileInt( "BAP TEL", "env_FSG_Phonebook13_VoiceTag1", getValue(env_FSG_Phonebook13_VoiceTag1), profile);
writeProfileInt( "BAP TEL", "env_FSG_Phonebook13_AnyVoiceTag", getValue(env_FSG_Phonebook13_AnyVoiceTag), profile);
writeProfileInt( "BAP TEL", "env_FSG_Phonebook13_Storage", getValue(env_FSG_Phonebook13_Storage), profile);
writeProfileInt( "BAP TEL", "env_FSG_Phonebook13_Pos", getValue(env_FSG_Phonebook13_Pos), profile);
writeProfileInt( "BAP TEL", "env_FSG_Phonebook12_TelNumberQua", getValue(env_FSG_Phonebook12_TelNumberQuantity), profile);
writeProfileInt( "BAP TEL", "env_FSG_Phonebook12_AddressInd", getValue(env_FSG_Phonebook12_AddressInd), profile);
writeProfileInt( "BAP TEL", "env_FSG_Phonebook12_VoiceTag1", getValue(env_FSG_Phonebook12_VoiceTag1), profile);
writeProfileInt( "BAP TEL", "env_FSG_Phonebook12_AnyVoiceTag", getValue(env_FSG_Phonebook12_AnyVoiceTag), profile);
writeProfileInt( "BAP TEL", "env_FSG_Phonebook12_Storage", getValue(env_FSG_Phonebook12_Storage), profile);
writeProfileInt( "BAP TEL", "env_FSG_Phonebook12_Pos", getValue(env_FSG_Phonebook12_Pos), profile);
writeProfileInt( "BAP TEL", "env_FSG_Phonebook11_TelNumberQua", getValue(env_FSG_Phonebook11_TelNumberQuantity), profile);
writeProfileInt( "BAP TEL", "env_FSG_Phonebook11_AddressInd", getValue(env_FSG_Phonebook11_AddressInd), profile);
writeProfileInt( "BAP TEL", "env_FSG_Phonebook11_VoiceTag1", getValue(env_FSG_Phonebook11_VoiceTag1), profile);
writeProfileInt( "BAP TEL", "env_FSG_Phonebook11_AnyVoiceTag", getValue(env_FSG_Phonebook11_AnyVoiceTag), profile);
writeProfileInt( "BAP TEL", "env_FSG_Phonebook11_Storage", getValue(env_FSG_Phonebook11_Storage), profile);
writeProfileInt( "BAP TEL", "env_FSG_Phonebook11_Pos", getValue(env_FSG_Phonebook11_Pos), profile);
writeProfileInt( "BAP TEL", "env_FSG_Phonebook10_TelNumberQua", getValue(env_FSG_Phonebook10_TelNumberQuantity), profile);
writeProfileInt( "BAP TEL", "env_FSG_Phonebook10_AddressInd", getValue(env_FSG_Phonebook10_AddressInd), profile);
writeProfileInt( "BAP TEL", "env_FSG_Phonebook10_VoiceTag1", getValue(env_FSG_Phonebook10_VoiceTag1), profile);
writeProfileInt( "BAP TEL", "env_FSG_Phonebook10_AnyVoiceTag", getValue(env_FSG_Phonebook10_AnyVoiceTag), profile);
writeProfileInt( "BAP TEL", "env_FSG_Phonebook10_Storage", getValue(env_FSG_Phonebook10_Storage), profile);
writeProfileInt( "BAP TEL", "env_FSG_Phonebook10_Pos", getValue(env_FSG_Phonebook10_Pos), profile);
writeProfileInt( "BAP TEL", "env_FSG_Phonebook9_TelNumberQuan", getValue(env_FSG_Phonebook9_TelNumberQuantity), profile);
writeProfileInt( "BAP TEL", "env_FSG_Phonebook9_AddressInd", getValue(env_FSG_Phonebook9_AddressInd), profile);
writeProfileInt( "BAP TEL", "env_FSG_Phonebook9_VoiceTag1", getValue(env_FSG_Phonebook9_VoiceTag1), profile);
writeProfileInt( "BAP TEL", "env_FSG_Phonebook9_AnyVoiceTag", getValue(env_FSG_Phonebook9_AnyVoiceTag), profile);
writeProfileInt( "BAP TEL", "env_FSG_Phonebook9_Storage", getValue(env_FSG_Phonebook9_Storage), profile);
writeProfileInt( "BAP TEL", "env_FSG_Phonebook9_Pos", getValue(env_FSG_Phonebook9_Pos), profile);
writeProfileInt( "BAP TEL", "env_FSG_Phonebook8_TelNumberQuan", getValue(env_FSG_Phonebook8_TelNumberQuantity), profile);
writeProfileInt( "BAP TEL", "env_FSG_Phonebook8_AddressInd", getValue(env_FSG_Phonebook8_AddressInd), profile);
writeProfileInt( "BAP TEL", "env_FSG_Phonebook8_VoiceTag1", getValue(env_FSG_Phonebook8_VoiceTag1), profile);
writeProfileInt( "BAP TEL", "env_FSG_Phonebook8_AnyVoiceTag", getValue(env_FSG_Phonebook8_AnyVoiceTag), profile);
writeProfileInt( "BAP TEL", "env_FSG_Phonebook8_Storage", getValue(env_FSG_Phonebook8_Storage), profile);
writeProfileInt( "BAP TEL", "env_FSG_Phonebook8_Pos", getValue(env_FSG_Phonebook8_Pos), profile);
writeProfileInt( "BAP TEL", "env_FSG_Phonebook7_TelNumberQuan", getValue(env_FSG_Phonebook7_TelNumberQuantity), profile);
writeProfileInt( "BAP TEL", "env_FSG_Phonebook7_AddressInd", getValue(env_FSG_Phonebook7_AddressInd), profile);
writeProfileInt( "BAP TEL", "env_FSG_Phonebook7_VoiceTag1", getValue(env_FSG_Phonebook7_VoiceTag1), profile);
writeProfileInt( "BAP TEL", "env_FSG_Phonebook7_AnyVoiceTag", getValue(env_FSG_Phonebook7_AnyVoiceTag), profile);
writeProfileInt( "BAP TEL", "env_FSG_Phonebook7_Storage", getValue(env_FSG_Phonebook7_Storage), profile);
writeProfileInt( "BAP TEL", "env_FSG_Phonebook7_Pos", getValue(env_FSG_Phonebook7_Pos), profile);
writeProfileInt( "BAP TEL", "env_FSG_Phonebook6_TelNumberQuan", getValue(env_FSG_Phonebook6_TelNumberQuantity), profile);
writeProfileInt( "BAP TEL", "env_FSG_Phonebook6_AddressInd", getValue(env_FSG_Phonebook6_AddressInd), profile);
writeProfileInt( "BAP TEL", "env_FSG_Phonebook6_VoiceTag1", getValue(env_FSG_Phonebook6_VoiceTag1), profile);
writeProfileInt( "BAP TEL", "env_FSG_Phonebook6_AnyVoiceTag", getValue(env_FSG_Phonebook6_AnyVoiceTag), profile);
writeProfileInt( "BAP TEL", "env_FSG_Phonebook6_Storage", getValue(env_FSG_Phonebook6_Storage), profile);
writeProfileInt( "BAP TEL", "env_FSG_Phonebook6_Pos", getValue(env_FSG_Phonebook6_Pos), profile);
writeProfileInt( "BAP TEL", "env_FSG_Phonebook5_TelNumberQuan", getValue(env_FSG_Phonebook5_TelNumberQuantity), profile);
writeProfileInt( "BAP TEL", "env_FSG_Phonebook5_AddressInd", getValue(env_FSG_Phonebook5_AddressInd), profile);
writeProfileInt( "BAP TEL", "env_FSG_Phonebook5_VoiceTag1", getValue(env_FSG_Phonebook5_VoiceTag1), profile);
writeProfileInt( "BAP TEL", "env_FSG_Phonebook5_AnyVoiceTag", getValue(env_FSG_Phonebook5_AnyVoiceTag), profile);
writeProfileInt( "BAP TEL", "env_FSG_Phonebook5_Storage", getValue(env_FSG_Phonebook5_Storage), profile);
writeProfileInt( "BAP TEL", "env_FSG_Phonebook5_Pos", getValue(env_FSG_Phonebook5_Pos), profile);
writeProfileInt( "BAP TEL", "env_FSG_Phonebook4_TelNumberQuan", getValue(env_FSG_Phonebook4_TelNumberQuantity), profile);
writeProfileInt( "BAP TEL", "env_FSG_Phonebook4_AddressInd", getValue(env_FSG_Phonebook4_AddressInd), profile);
writeProfileInt( "BAP TEL", "env_FSG_Phonebook4_VoiceTag1", getValue(env_FSG_Phonebook4_VoiceTag1), profile);
writeProfileInt( "BAP TEL", "env_FSG_Phonebook4_AnyVoiceTag", getValue(env_FSG_Phonebook4_AnyVoiceTag), profile);
writeProfileInt( "BAP TEL", "env_FSG_Phonebook4_Storage", getValue(env_FSG_Phonebook4_Storage), profile);
writeProfileInt( "BAP TEL", "env_FSG_Phonebook4_Pos", getValue(env_FSG_Phonebook4_Pos), profile);
writeProfileInt( "BAP TEL", "env_FSG_Phonebook3_TelNumberQuan", getValue(env_FSG_Phonebook3_TelNumberQuantity), profile);
writeProfileInt( "BAP TEL", "env_FSG_Phonebook3_AddressInd", getValue(env_FSG_Phonebook3_AddressInd), profile);
writeProfileInt( "BAP TEL", "env_FSG_Phonebook3_VoiceTag1", getValue(env_FSG_Phonebook3_VoiceTag1), profile);
writeProfileInt( "BAP TEL", "env_FSG_Phonebook3_AnyVoiceTag", getValue(env_FSG_Phonebook3_AnyVoiceTag), profile);
writeProfileInt( "BAP TEL", "env_FSG_Phonebook3_Storage", getValue(env_FSG_Phonebook3_Storage), profile);
writeProfileInt( "BAP TEL", "env_FSG_Phonebook3_Pos", getValue(env_FSG_Phonebook3_Pos), profile);
writeProfileInt( "BAP TEL", "env_FSG_Phonebook2_TelNumberQuan", getValue(env_FSG_Phonebook2_TelNumberQuantity), profile);
writeProfileInt( "BAP TEL", "env_FSG_Phonebook2_AddressInd", getValue(env_FSG_Phonebook2_AddressInd), profile);
writeProfileInt( "BAP TEL", "env_FSG_Phonebook2_VoiceTag1", getValue(env_FSG_Phonebook2_VoiceTag1), profile);
writeProfileInt( "BAP TEL", "env_FSG_Phonebook2_AnyVoiceTag", getValue(env_FSG_Phonebook2_AnyVoiceTag), profile);
writeProfileInt( "BAP TEL", "env_FSG_Phonebook2_Storage", getValue(env_FSG_Phonebook2_Storage), profile);
writeProfileInt( "BAP TEL", "env_FSG_Phonebook2_Pos", getValue(env_FSG_Phonebook2_Pos), profile);
writeProfileInt( "BAP TEL", "env_FSG_Phonebook1_TelNumberQuan", getValue(env_FSG_Phonebook1_TelNumberQuantity), profile);
writeProfileInt( "BAP TEL", "env_FSG_Phonebook1_AddressInd", getValue(env_FSG_Phonebook1_AddressInd), profile);
writeProfileInt( "BAP TEL", "env_FSG_Phonebook1_VoiceTag1", getValue(env_FSG_Phonebook1_VoiceTag1), profile);
writeProfileInt( "BAP TEL", "env_FSG_Phonebook1_AnyVoiceTag", getValue(env_FSG_Phonebook1_AnyVoiceTag), profile);
writeProfileInt( "BAP TEL", "env_FSG_Phonebook1_Storage", getValue(env_FSG_Phonebook1_Storage), profile);
writeProfileInt( "BAP TEL", "env_FSG_Phonebook1_Pos", getValue(env_FSG_Phonebook1_Pos), profile);
writeProfileInt( "BAP TEL", "env_FSG_Phonebook0_TelNumberQuan", getValue(env_FSG_Phonebook0_TelNumberQuantity), profile);
writeProfileInt( "BAP TEL", "env_FSG_Phonebook0_AddressInd", getValue(env_FSG_Phonebook0_AddressInd), profile);
writeProfileInt( "BAP TEL", "env_FSG_Phonebook0_VoiceTag1", getValue(env_FSG_Phonebook0_VoiceTag1), profile);
writeProfileInt( "BAP TEL", "env_FSG_Phonebook0_AnyVoiceTag", getValue(env_FSG_Phonebook0_AnyVoiceTag), profile);
writeProfileInt( "BAP TEL", "env_FSG_Phonebook0_Storage", getValue(env_FSG_Phonebook0_Storage), profile);
writeProfileInt( "BAP TEL", "env_FSG_Phonebook0_Pos", getValue(env_FSG_Phonebook0_Pos), profile);
writeProfileInt( "BAP TEL", "env_FSG_Phonebook_AutoOnOff", getValue(env_FSG_Phonebook_AutoOnOff), profile);
writeProfileInt( "BAP TEL", "env_FSG_Phonebook_reload", getValue(env_FSG_Phonebook_reload), profile);
writeProfileInt( "BAP TEL", "env_FSG_Phonebook_DataSource", getValue(env_FSG_Phonebook_DataSource), profile);
writeProfileInt( "BAP TEL", "env_FSG_Phonebook_StatusArray", getValue(env_FSG_Phonebook_StatusArray), profile);
writeProfileInt( "BAP TEL", "env_FSG_Phonebook_ChangedArray", getValue(env_FSG_Phonebook_ChangedArray), profile);
writeProfileInt( "BAP TEL", "env_FSG_Phonebook_AH_elements", getValue(env_FSG_Phonebook_AH_elements), profile);
writeProfileInt( "BAP TEL", "env_FSG_Phonebook_AH_start", getValue(env_FSG_Phonebook_AH_start), profile);
writeProfileInt( "BAP TEL", "env_FSG_Phonebook_AH_RA", getValue(env_FSG_Phonebook_AH_RA), profile);
writeProfileInt( "BAP TEL", "env_FSG_Phonebook_AH_IS", getValue(env_FSG_Phonebook_AH_IS), profile);
writeProfileInt( "BAP TEL", "env_FSG_Phonebook_AH_POS", getValue(env_FSG_Phonebook_AH_POS), profile);
writeProfileInt( "BAP TEL", "env_FSG_Phonebook_AH_dir", getValue(env_FSG_Phonebook_AH_dir), profile);
writeProfileInt( "BAP TEL", "env_FSG_Phonebook_AH_shift", getValue(env_FSG_Phonebook_AH_shift), profile);
writeProfileInt( "BAP TEL", "env_FSG_Phonebook_TotalNumLE", getValue(env_FSG_Phonebook_TotalNumLE), profile);
writeProfileInt( "BAP TEL", "env_FSG_Phonebook_TAID", getValue(env_FSG_Phonebook_TAID), profile);
writeProfileInt( "BAP TEL", "env_FSG_Phonebook_ASG_ID", getValue(env_FSG_Phonebook_ASG_ID), profile);
writeProfileInt( "BAP TEL", "env_FSG_missedcall19_Pos", getValue(env_FSG_missedcall19_Pos), profile);
writeProfileInt( "BAP TEL", "env_FSG_missedcall18_Pos", getValue(env_FSG_missedcall18_Pos), profile);
writeProfileInt( "BAP TEL", "env_FSG_missedcall17_Pos", getValue(env_FSG_missedcall17_Pos), profile);
writeProfileInt( "BAP TEL", "env_FSG_missedcall16_Pos", getValue(env_FSG_missedcall16_Pos), profile);
writeProfileInt( "BAP TEL", "env_FSG_missedcall15_Pos", getValue(env_FSG_missedcall15_Pos), profile);
writeProfileInt( "BAP TEL", "env_FSG_missedcall14_Pos", getValue(env_FSG_missedcall14_Pos), profile);
writeProfileInt( "BAP TEL", "env_FSG_missedcall13_Pos", getValue(env_FSG_missedcall13_Pos), profile);
writeProfileInt( "BAP TEL", "env_FSG_missedcall12_Pos", getValue(env_FSG_missedcall12_Pos), profile);
writeProfileInt( "BAP TEL", "env_FSG_missedcall11_Pos", getValue(env_FSG_missedcall11_Pos), profile);
writeProfileInt( "BAP TEL", "env_FSG_missedcall10_Pos", getValue(env_FSG_missedcall10_Pos), profile);
writeProfileInt( "BAP TEL", "env_FSG_missedcall9_Pos", getValue(env_FSG_missedcall9_Pos), profile);
writeProfileInt( "BAP TEL", "env_FSG_missedcall8_Pos", getValue(env_FSG_missedcall8_Pos), profile);
writeProfileInt( "BAP TEL", "env_FSG_missedcall7_Pos", getValue(env_FSG_missedcall7_Pos), profile);
writeProfileInt( "BAP TEL", "env_FSG_missedcall6_Pos", getValue(env_FSG_missedcall6_Pos), profile);
writeProfileInt( "BAP TEL", "env_FSG_missedcall5_Pos", getValue(env_FSG_missedcall5_Pos), profile);
writeProfileInt( "BAP TEL", "env_FSG_missedcall4_Pos", getValue(env_FSG_missedcall4_Pos), profile);
writeProfileInt( "BAP TEL", "env_FSG_missedcall3_Pos", getValue(env_FSG_missedcall3_Pos), profile);
writeProfileInt( "BAP TEL", "env_FSG_missedcall2_Pos", getValue(env_FSG_missedcall2_Pos), profile);
writeProfileInt( "BAP TEL", "env_FSG_missedcall1_Pos", getValue(env_FSG_missedcall1_Pos), profile);
writeProfileInt( "BAP TEL", "env_FSG_missedcall0_Pos", getValue(env_FSG_missedcall0_Pos), profile);
writeProfileInt( "BAP TEL", "env_FSG_CallState_CallInDivert_6", getValue(env_FSG_CallState_CallInDivert_6), profile);
writeProfileInt( "BAP TEL", "env_FSG_CallState_CallInDivert_5", getValue(env_FSG_CallState_CallInDivert_5), profile);
writeProfileInt( "BAP TEL", "env_FSG_CallState_CallInDivert_4", getValue(env_FSG_CallState_CallInDivert_4), profile);
writeProfileInt( "BAP TEL", "env_FSG_CallState_CallInDivert_3", getValue(env_FSG_CallState_CallInDivert_3), profile);
writeProfileInt( "BAP TEL", "env_FSG_CallState_CallInDivert_2", getValue(env_FSG_CallState_CallInDivert_2), profile);
writeProfileInt( "BAP TEL", "env_FSG_CallState_CallInDivert_1", getValue(env_FSG_CallState_CallInDivert_1), profile);
writeProfileInt( "BAP TEL", "env_FSG_CallState_CallInDivert_0", getValue(env_FSG_CallState_CallInDivert_0), profile);
writeProfileInt( "BAP TEL", "env_FSG_CallState_Opt_CCSplit_6", getValue(env_FSG_CallState_Opt_CCSplit_6), profile);
writeProfileInt( "BAP TEL", "env_FSG_CallState_Opt_CCSplit_5", getValue(env_FSG_CallState_Opt_CCSplit_5), profile);
writeProfileInt( "BAP TEL", "env_FSG_CallState_Opt_CCSplit_4", getValue(env_FSG_CallState_Opt_CCSplit_4), profile);
writeProfileInt( "BAP TEL", "env_FSG_CallState_Opt_CCSplit_3", getValue(env_FSG_CallState_Opt_CCSplit_3), profile);
writeProfileInt( "BAP TEL", "env_FSG_CallState_Opt_CCSplit_2", getValue(env_FSG_CallState_Opt_CCSplit_2), profile);
writeProfileInt( "BAP TEL", "env_FSG_CallState_Opt_CCSplit_1", getValue(env_FSG_CallState_Opt_CCSplit_1), profile);
writeProfileInt( "BAP TEL", "env_FSG_CallState_Opt_CCSplit_0", getValue(env_FSG_CallState_Opt_CCSplit_0), profile);
writeProfileInt( "BAP TEL", "env_FSG_CallState_Opt_CCJoin_6", getValue(env_FSG_CallState_Opt_CCJoin_6), profile);
writeProfileInt( "BAP TEL", "env_FSG_CallState_Opt_CCJoin_5", getValue(env_FSG_CallState_Opt_CCJoin_5), profile);
writeProfileInt( "BAP TEL", "env_FSG_CallState_Opt_CCJoin_4", getValue(env_FSG_CallState_Opt_CCJoin_4), profile);
writeProfileInt( "BAP TEL", "env_FSG_CallState_Opt_CCJoin_3", getValue(env_FSG_CallState_Opt_CCJoin_3), profile);
writeProfileInt( "BAP TEL", "env_FSG_CallState_Opt_CCJoin_2", getValue(env_FSG_CallState_Opt_CCJoin_2), profile);
writeProfileInt( "BAP TEL", "env_FSG_CallState_Opt_CCJoin_1", getValue(env_FSG_CallState_Opt_CCJoin_1), profile);
writeProfileInt( "BAP TEL", "env_FSG_CallState_Opt_CCJoin_0", getValue(env_FSG_CallState_Opt_CCJoin_0), profile);
writeProfileInt( "BAP TEL", "env_FSG_CallState_Opt_MPSwap_6", getValue(env_FSG_CallState_Opt_MPSwap_6), profile);
writeProfileInt( "BAP TEL", "env_FSG_CallState_Opt_MPSwap_5", getValue(env_FSG_CallState_Opt_MPSwap_5), profile);
writeProfileInt( "BAP TEL", "env_FSG_CallState_Opt_MPSwap_4", getValue(env_FSG_CallState_Opt_MPSwap_4), profile);
writeProfileInt( "BAP TEL", "env_FSG_CallState_Opt_MPSwap_3", getValue(env_FSG_CallState_Opt_MPSwap_3), profile);
writeProfileInt( "BAP TEL", "env_FSG_CallState_Opt_MPSwap_2", getValue(env_FSG_CallState_Opt_MPSwap_2), profile);
writeProfileInt( "BAP TEL", "env_FSG_CallState_Opt_MPSwap_1", getValue(env_FSG_CallState_Opt_MPSwap_1), profile);
writeProfileInt( "BAP TEL", "env_FSG_CallState_Opt_MPSwap_0", getValue(env_FSG_CallState_Opt_MPSwap_0), profile);
writeProfileInt( "BAP TEL", "env_FSG_CallState_Opt_ResCall_6", getValue(env_FSG_CallState_Opt_ResCall_6), profile);
writeProfileInt( "BAP TEL", "env_FSG_CallState_Opt_ResCall_5", getValue(env_FSG_CallState_Opt_ResCall_5), profile);
writeProfileInt( "BAP TEL", "env_FSG_CallState_Opt_ResCall_4", getValue(env_FSG_CallState_Opt_ResCall_4), profile);
writeProfileInt( "BAP TEL", "env_FSG_CallState_Opt_ResCall_3", getValue(env_FSG_CallState_Opt_ResCall_3), profile);
writeProfileInt( "BAP TEL", "env_FSG_CallState_Opt_ResCall_2", getValue(env_FSG_CallState_Opt_ResCall_2), profile);
writeProfileInt( "BAP TEL", "env_FSG_CallState_Opt_ResCall_1", getValue(env_FSG_CallState_Opt_ResCall_1), profile);
writeProfileInt( "BAP TEL", "env_FSG_CallState_Opt_ResCall_0", getValue(env_FSG_CallState_Opt_ResCall_0), profile);
writeProfileInt( "BAP TEL", "env_FSG_CallState_Opt_CallHold_6", getValue(env_FSG_CallState_Opt_CallHold_6), profile);
writeProfileInt( "BAP TEL", "env_FSG_CallState_Opt_CallHold_5", getValue(env_FSG_CallState_Opt_CallHold_5), profile);
writeProfileInt( "BAP TEL", "env_FSG_CallState_Opt_CallHold_4", getValue(env_FSG_CallState_Opt_CallHold_4), profile);
writeProfileInt( "BAP TEL", "env_FSG_CallState_Opt_CallHold_3", getValue(env_FSG_CallState_Opt_CallHold_3), profile);
writeProfileInt( "BAP TEL", "env_FSG_CallState_Opt_CallHold_2", getValue(env_FSG_CallState_Opt_CallHold_2), profile);
writeProfileInt( "BAP TEL", "env_FSG_CallState_Opt_CallHold_1", getValue(env_FSG_CallState_Opt_CallHold_1), profile);
writeProfileInt( "BAP TEL", "env_FSG_CallState_Opt_CallHold_0", getValue(env_FSG_CallState_Opt_CallHold_0), profile);
writeProfileInt( "BAP TEL", "env_FSG_CallState_Opt_CallAc_6", getValue(env_FSG_CallState_Opt_CallAc_6), profile);
writeProfileInt( "BAP TEL", "env_FSG_CallState_Opt_CallAc_5", getValue(env_FSG_CallState_Opt_CallAc_5), profile);
writeProfileInt( "BAP TEL", "env_FSG_CallState_Opt_CallAc_4", getValue(env_FSG_CallState_Opt_CallAc_4), profile);
writeProfileInt( "BAP TEL", "env_FSG_CallState_Opt_CallAc_3", getValue(env_FSG_CallState_Opt_CallAc_3), profile);
writeProfileInt( "BAP TEL", "env_FSG_CallState_Opt_CallAc_2", getValue(env_FSG_CallState_Opt_CallAc_2), profile);
writeProfileInt( "BAP TEL", "env_FSG_CallState_Opt_CallAc_1", getValue(env_FSG_CallState_Opt_CallAc_1), profile);
writeProfileInt( "BAP TEL", "env_FSG_CallState_Opt_CallAc_0", getValue(env_FSG_CallState_Opt_CallAc_0), profile);
writeProfileInt( "BAP TEL", "env_FSG_CallState_Opt_HoldAc_6", getValue(env_FSG_CallState_Opt_HoldAc_6), profile);
writeProfileInt( "BAP TEL", "env_FSG_CallState_Opt_HoldAc_5", getValue(env_FSG_CallState_Opt_HoldAc_5), profile);
writeProfileInt( "BAP TEL", "env_FSG_CallState_Opt_HoldAc_4", getValue(env_FSG_CallState_Opt_HoldAc_4), profile);
writeProfileInt( "BAP TEL", "env_FSG_CallState_Opt_HoldAc_3", getValue(env_FSG_CallState_Opt_HoldAc_3), profile);
writeProfileInt( "BAP TEL", "env_FSG_CallState_Opt_HoldAc_2", getValue(env_FSG_CallState_Opt_HoldAc_2), profile);
writeProfileInt( "BAP TEL", "env_FSG_CallState_Opt_HoldAc_1", getValue(env_FSG_CallState_Opt_HoldAc_1), profile);
writeProfileInt( "BAP TEL", "env_FSG_CallState_Opt_HoldAc_0", getValue(env_FSG_CallState_Opt_HoldAc_0), profile);
writeProfileInt( "BAP TEL", "env_FSG_CallState_Opt_AcCall_6", getValue(env_FSG_CallState_Opt_AcCall_6), profile);
writeProfileInt( "BAP TEL", "env_FSG_CallState_Opt_AcCall_5", getValue(env_FSG_CallState_Opt_AcCall_5), profile);
writeProfileInt( "BAP TEL", "env_FSG_CallState_Opt_AcCall_4", getValue(env_FSG_CallState_Opt_AcCall_4), profile);
writeProfileInt( "BAP TEL", "env_FSG_CallState_Opt_AcCall_3", getValue(env_FSG_CallState_Opt_AcCall_3), profile);
writeProfileInt( "BAP TEL", "env_FSG_CallState_Opt_AcCall_2", getValue(env_FSG_CallState_Opt_AcCall_2), profile);
writeProfileInt( "BAP TEL", "env_FSG_CallState_Opt_AcCall_1", getValue(env_FSG_CallState_Opt_AcCall_1), profile);
writeProfileInt( "BAP TEL", "env_FSG_CallState_Opt_AcCall_0", getValue(env_FSG_CallState_Opt_AcCall_0), profile);
writeProfileInt( "BAP TEL", "env_FSG_CallState_CallOuDivert_6", getValue(env_FSG_CallState_CallOuDivert_6), profile);
writeProfileInt( "BAP TEL", "env_FSG_CallState_CallOuDivert_5", getValue(env_FSG_CallState_CallOuDivert_5), profile);
writeProfileInt( "BAP TEL", "env_FSG_CallState_CallOuDivert_4", getValue(env_FSG_CallState_CallOuDivert_4), profile);
writeProfileInt( "BAP TEL", "env_FSG_CallState_CallOuDivert_3", getValue(env_FSG_CallState_CallOuDivert_3), profile);
writeProfileInt( "BAP TEL", "env_FSG_CallState_CallOuDivert_2", getValue(env_FSG_CallState_CallOuDivert_2), profile);
writeProfileInt( "BAP TEL", "env_FSG_CallState_CallOuDivert_1", getValue(env_FSG_CallState_CallOuDivert_1), profile);
writeProfileInt( "BAP TEL", "env_FSG_CallState_CallOuDivert_0", getValue(env_FSG_CallState_CallOuDivert_0), profile);
writeProfileInt( "BAP TEL", "env_FSG_MPSWCOH", getValue(env_FSG_MPSWCOH), profile);
writeProfileInt( "BAP TEL", "env_FSG_MissedCalls_AutoOnOff", getValue(env_FSG_MissedCalls_AutoOnOff), profile);
writeProfileInt( "BAP TEL", "env_FSG_MicroMuteOnOff", getValue(env_FSG_MicroMuteOnOff), profile);
writeProfileInt( "BAP TEL", "env_FSG_MissedCalls_reload", getValue(env_FSG_MissedCalls_reload), profile);
writeProfileInt( "BAP TEL", "env_FSG_MissedCalls_DataSource", getValue(env_FSG_MissedCalls_DataSource), profile);
writeProfileInt( "BAP TEL", "env_FSG_MissedCalls_StatusArray", getValue(env_FSG_MissedCalls_StatusArray), profile);
writeProfileInt( "BAP TEL", "env_FSG_MissedCalls_ChangedArray", getValue(env_FSG_MissedCalls_ChangedArray), profile);
writeProfileInt( "BAP TEL", "env_FSG_MissedCalls_AH_elements", getValue(env_FSG_MissedCalls_AH_elements), profile);
writeProfileInt( "BAP TEL", "env_FSG_MissedCalls_AH_start", getValue(env_FSG_MissedCalls_AH_start), profile);
writeProfileInt( "BAP TEL", "env_FSG_MissedCalls_AH_RA", getValue(env_FSG_MissedCalls_AH_RA), profile);
writeProfileInt( "BAP TEL", "env_FSG_MissedCalls_AH_IS", getValue(env_FSG_MissedCalls_AH_IS), profile);
writeProfileInt( "BAP TEL", "env_FSG_MissedCalls_AH_POS", getValue(env_FSG_MissedCalls_AH_POS), profile);
writeProfileInt( "BAP TEL", "env_FSG_MissedCalls_AH_dir", getValue(env_FSG_MissedCalls_AH_dir), profile);
writeProfileInt( "BAP TEL", "env_FSG_MissedCalls_AH_shift", getValue(env_FSG_MissedCalls_AH_shift), profile);
writeProfileInt( "BAP TEL", "env_FSG_MissedCalls_TotalNumLE", getValue(env_FSG_MissedCalls_TotalNumLE), profile);
writeProfileInt( "BAP TEL", "env_FSG_MissedCalls_TAID", getValue(env_FSG_MissedCalls_TAID), profile);
writeProfileInt( "BAP TEL", "env_FSG_MissedCalls_ASG_ID", getValue(env_FSG_MissedCalls_ASG_ID), profile);
writeProfileInt( "BAP TEL", "env_FSG_PbState_OK", getValue(env_FSG_PbState_OK), profile);
writeProfileInt( "BAP TEL", "env_FSG_CallDurationSync_OK", getValue(env_FSG_CallDurationSync_OK), profile);
writeProfileInt( "BAP TEL", "env_FSG_CallDurationSync_6", getValue(env_FSG_CallDurationSync_6), profile);
writeProfileInt( "BAP TEL", "env_FSG_CallDurationSync_5", getValue(env_FSG_CallDurationSync_5), profile);
writeProfileInt( "BAP TEL", "env_FSG_CallDurationSync_4", getValue(env_FSG_CallDurationSync_4), profile);
writeProfileInt( "BAP TEL", "env_FSG_CallDurationSync_3", getValue(env_FSG_CallDurationSync_3), profile);
writeProfileInt( "BAP TEL", "env_FSG_CallDurationSync_2", getValue(env_FSG_CallDurationSync_2), profile);
writeProfileInt( "BAP TEL", "env_FSG_CallDurationSync_1", getValue(env_FSG_CallDurationSync_1), profile);
writeProfileInt( "BAP TEL", "env_FSG_CallDurationSync_0", getValue(env_FSG_CallDurationSync_0), profile);
writeProfileInt( "BAP TEL", "env_FSG_DialNumber", getValue(env_FSG_DialNumber), profile);
writeProfileInt( "BAP TEL", "env_FSG_ChargeLevelM2_Init", getValue(env_FSG_ChargeLevelM2_Init), profile);
writeProfileInt( "BAP TEL", "env_FSG_ChargeLevelM1_Init", getValue(env_FSG_ChargeLevelM1_Init), profile);
writeProfileInt( "BAP TEL", "env_FSG_ChargeLevelH2_Init", getValue(env_FSG_ChargeLevelH2_Init), profile);
writeProfileInt( "BAP TEL", "env_FSG_ChargeLevelH1_Init", getValue(env_FSG_ChargeLevelH1_Init), profile);
writeProfileInt( "BAP TEL", "env_FSG_HangupCall_CallID", getValue(env_FSG_HangupCall_CallID), profile);
writeProfileInt( "BAP TEL", "env_FSG_HangupCall", getValue(env_FSG_HangupCall), profile);
writeProfileInt( "BAP TEL", "env_FSG_DataVolumeDownlink", getValue(env_FSG_DataVolumeDownlink), profile);
writeProfileInt( "BAP TEL", "env_FSG_DataVolumeUplink", getValue(env_FSG_DataVolumeUplink), profile);
writeProfileInt( "BAP TEL", "env_FSG_ConIndication_Reset", getValue(env_FSG_ConIndication_Reset), profile);
writeProfileInt( "BAP TEL", "env_FSG_ConnectionIndication", getValue(env_FSG_ConnectionIndication), profile);
writeProfileInt( "BAP TEL", "env_FSG_ChargeLevelH2", getValue(env_FSG_ChargeLevelH2), profile);
writeProfileInt( "BAP TEL", "env_FSG_ChargeLevelH1", getValue(env_FSG_ChargeLevelH1), profile);
writeProfileInt( "BAP TEL", "env_FSG_ChargeLevelM2", getValue(env_FSG_ChargeLevelM2), profile);
writeProfileInt( "BAP TEL", "env_FSG_ChargeLevelM1", getValue(env_FSG_ChargeLevelM1), profile);
writeProfileInt( "BAP TEL", "env_FSG_Keypad_eCall_long", getValue(env_FSG_Keypad_eCall_long), profile);
writeProfileInt( "BAP TEL", "env_FSG_Keypad_eCall_short", getValue(env_FSG_Keypad_eCall_short), profile);
writeProfileInt( "BAP TEL", "env_FSG_DisconnectReason_OK", getValue(env_FSG_DisconnectReason_OK), profile);
writeProfileInt( "BAP TEL", "env_FSG_ServiceProviderState", getValue(env_FSG_ServiceProviderState), profile);
writeProfileInt( "BAP TEL", "env_FSG_NetworkProviderState", getValue(env_FSG_NetworkProviderState), profile);
writeProfileInt( "BAP TEL", "env_FSG_Telephone_MSS_0x37", getValue(env_FSG_Telephone_MSS_0x37), profile);
writeProfileInt( "BAP TEL", "env_FSG_Telephone_MSS_0x36", getValue(env_FSG_Telephone_MSS_0x36), profile);
writeProfileInt( "BAP TEL", "env_FSG_Telephone_MSS_0x35", getValue(env_FSG_Telephone_MSS_0x35), profile);
writeProfileInt( "BAP TEL", "env_FSG_Telephone_MSS_0x34", getValue(env_FSG_Telephone_MSS_0x34), profile);
writeProfileInt( "BAP TEL", "env_FSG_Telephone_MSS_0x33", getValue(env_FSG_Telephone_MSS_0x33), profile);
writeProfileInt( "BAP TEL", "env_FSG_Telephone_MSS_0x32", getValue(env_FSG_Telephone_MSS_0x32), profile);
writeProfileInt( "BAP TEL", "env_FSG_Telephone_MSS_0x31", getValue(env_FSG_Telephone_MSS_0x31), profile);
writeProfileInt( "BAP TEL", "env_FSG_PacketDataNetworkType", getValue(env_FSG_PacketDataNetworkType), profile);
writeProfileInt( "BAP TEL", "env_FSG_NetworkType", getValue(env_FSG_NetworkType), profile);
writeProfileInt( "BAP TEL", "env_FSG_EnhancedPrivacyMode", getValue(env_FSG_EnhancedPrivacyMode), profile);
writeProfileInt( "BAP TEL", "env_FSG_PrivacyModeBit", getValue(env_FSG_PrivacyModeBit), profile);
writeProfileInt( "BAP TEL", "env_FSG_Tel_State", getValue(env_FSG_Tel_State), profile);
writeProfileInt( "BAP TEL", "env_FSG_Debug_on_off", getValue(env_FSG_Debug_on_off), profile);
writeProfileInt( "BAP TEL", "env_FSG_PbStartDownload_Result", getValue(env_FSG_PbStartDownload_Result), profile);
writeProfileInt( "BAP TEL", "env_FSG_PbSpeller_Matching", getValue(env_FSG_PbSpeller_Matching), profile);
writeProfileInt( "BAP TEL", "env_FSG_Restore_PhoneOne", getValue(env_FSG_Restore_PhoneOne), profile);
writeProfileInt( "BAP TEL", "env_FSG_Phonebook_Pb_Changed", getValue(env_FSG_Phonebook_Pb_Changed), profile);
writeProfileInt( "BAP TEL", "env_FSG_Telephone_FctList_update", getValue(env_FSG_Telephone_FctList_update), profile);
writeProfileInt( "BAP TEL", "env_FSG_Telephone_MSS_mode", getValue(env_FSG_Telephone_MSS_mode), profile);
writeProfileInt( "BAP TEL", "env_FSG_Telephone_FctList_mode", getValue(env_FSG_Telephone_FctList_mode), profile);
writeProfileInt( "BAP TEL", "env_FSG_receivedcall_DateTime", getValue(env_FSG_receivedcall_DateTime), profile);
writeProfileInt( "BAP TEL", "env_FSG_dialednumber_DateTime", getValue(env_FSG_dialednumber_DateTime), profile);
writeProfileInt( "BAP TEL", "env_FSG_missedcall_DateTime", getValue(env_FSG_missedcall_DateTime), profile);
writeProfileInt( "BAP TEL", "env_FSG_RemoteSide_HangUpWait", getValue(env_FSG_RemoteSide_HangUpWait), profile);
writeProfileInt( "BAP TEL", "env_FSG_RemoteSide_HangUp", getValue(env_FSG_RemoteSide_HangUp), profile);
writeProfileInt( "BAP TEL", "env_FSG_MP_CHAWC", getValue(env_FSG_MP_CHAWC), profile);
writeProfileInt( "BAP TEL", "env_FSG_MP_RAllCAWC", getValue(env_FSG_MP_RAllCAWC), profile);
writeProfileInt( "BAP TEL", "env_FSG_IncomingCall_Divert", getValue(env_FSG_IncomingCall_Divert), profile);
writeProfileInt( "BAP TEL", "env_FSG_RegisterState_OK", getValue(env_FSG_RegisterState_OK), profile);
writeProfileInt( "BAP TEL", "env_FSG_RegisterState", getValue(env_FSG_RegisterState), profile);
writeProfileInt( "BAP TEL", "env_FSG_SMSState_OK", getValue(env_FSG_SMSState_OK), profile);
writeProfileInt( "BAP TEL", "env_FSG_NumberOfNewSMS", getValue(env_FSG_NumberOfNewSMS), profile);
writeProfileInt( "BAP TEL", "env_FSG_StorageState", getValue(env_FSG_StorageState), profile);
writeProfileInt( "BAP TEL", "env_FSG_SIMReady", getValue(env_FSG_SIMReady), profile);
writeProfileInt( "BAP TEL", "env_FSG_Keypad_Pannenruf_long", getValue(env_FSG_Keypad_Pannenruf_long), profile);
writeProfileInt( "BAP TEL", "env_FSG_Keypad_Pannenruf_short", getValue(env_FSG_Keypad_Pannenruf_short), profile);
writeProfileInt( "BAP TEL", "env_FSG_Keypad_Inforuf_long", getValue(env_FSG_Keypad_Inforuf_long), profile);
writeProfileInt( "BAP TEL", "env_FSG_Keypad_Inforuf_short", getValue(env_FSG_Keypad_Inforuf_short), profile);
writeProfileInt( "BAP TEL", "env_FSG_MP_RACAWC", getValue(env_FSG_MP_RACAWC), profile);
writeProfileInt( "BAP TEL", "env_FSG_hangup_all_calls", getValue(env_FSG_hangup_all_calls), profile);
writeProfileInt( "BAP TEL", "env_FSG_hangup_held_active_calls", getValue(env_FSG_hangup_held_active_calls), profile);
writeProfileInt( "BAP TEL", "env_FSG_hangup_held_calls", getValue(env_FSG_hangup_held_calls), profile);
writeProfileInt( "BAP TEL", "env_FSG_CCSplit6", getValue(env_FSG_CCSplit6), profile);
writeProfileInt( "BAP TEL", "env_FSG_CCSplit5", getValue(env_FSG_CCSplit5), profile);
writeProfileInt( "BAP TEL", "env_FSG_CCSplit4", getValue(env_FSG_CCSplit4), profile);
writeProfileInt( "BAP TEL", "env_FSG_CCSplit3", getValue(env_FSG_CCSplit3), profile);
writeProfileInt( "BAP TEL", "env_FSG_CCSplit0", getValue(env_FSG_CCSplit0), profile);
writeProfileInt( "BAP TEL", "env_FSG_CCSplit2", getValue(env_FSG_CCSplit2), profile);
writeProfileInt( "BAP TEL", "env_FSG_CCSplit1", getValue(env_FSG_CCSplit1), profile);
writeProfileInt( "BAP TEL", "env_FSG_CCJoin", getValue(env_FSG_CCJoin), profile);
writeProfileInt( "BAP TEL", "env_FSG_MPSwap", getValue(env_FSG_MPSwap), profile);
writeProfileInt( "BAP TEL", "env_FSG_CallResume", getValue(env_FSG_CallResume), profile);
writeProfileInt( "BAP TEL", "env_FSG_PbState_update", getValue(env_FSG_PbState_update), profile);
writeProfileInt( "BAP TEL", "env_FSG_no_User_active", getValue(env_FSG_no_User_active), profile);
writeProfileInt( "BAP TEL", "env_FSG_Telephone_FctList_0x24", getValue(env_FSG_Telephone_FctList_0x24), profile);
writeProfileInt( "BAP TEL", "env_FSG_Telephone_FctList_set", getValue(env_FSG_Telephone_FctList_set), profile);
writeProfileInt( "BAP TEL", "env_FSG_Telephone_FctList_0x30", getValue(env_FSG_Telephone_FctList_0x30), profile);
writeProfileInt( "BAP TEL", "env_FSG_Telephone_FctList_0x2F", getValue(env_FSG_Telephone_FctList_0x2F), profile);
writeProfileInt( "BAP TEL", "env_FSG_Telephone_FctList_0x2E", getValue(env_FSG_Telephone_FctList_0x2E), profile);
writeProfileInt( "BAP TEL", "env_FSG_Telephone_FctList_0x2D", getValue(env_FSG_Telephone_FctList_0x2D), profile);
writeProfileInt( "BAP TEL", "env_FSG_Telephone_FctList_0x2C", getValue(env_FSG_Telephone_FctList_0x2C), profile);
writeProfileInt( "BAP TEL", "env_FSG_Telephone_FctList_0x2B", getValue(env_FSG_Telephone_FctList_0x2B), profile);
writeProfileInt( "BAP TEL", "env_FSG_Telephone_FctList_0x2A", getValue(env_FSG_Telephone_FctList_0x2A), profile);
writeProfileInt( "BAP TEL", "env_FSG_Telephone_FctList_0x29", getValue(env_FSG_Telephone_FctList_0x29), profile);
writeProfileInt( "BAP TEL", "env_FSG_Telephone_FctList_0x28", getValue(env_FSG_Telephone_FctList_0x28), profile);
writeProfileInt( "BAP TEL", "env_FSG_Telephone_FctList_0x27", getValue(env_FSG_Telephone_FctList_0x27), profile);
writeProfileInt( "BAP TEL", "env_FSG_Telephone_FctList_0x26", getValue(env_FSG_Telephone_FctList_0x26), profile);
writeProfileInt( "BAP TEL", "env_FSG_Telephone_FctList_0x25", getValue(env_FSG_Telephone_FctList_0x25), profile);
writeProfileInt( "BAP TEL", "env_FSG_Telephone_FctList_0x23", getValue(env_FSG_Telephone_FctList_0x23), profile);
writeProfileInt( "BAP TEL", "env_FSG_Telephone_FctList_0x22", getValue(env_FSG_Telephone_FctList_0x22), profile);
writeProfileInt( "BAP TEL", "env_FSG_Telephone_FctList_0x21", getValue(env_FSG_Telephone_FctList_0x21), profile);
writeProfileInt( "BAP TEL", "env_FSG_Telephone_FctList_0x20", getValue(env_FSG_Telephone_FctList_0x20), profile);
writeProfileInt( "BAP TEL", "env_FSG_Telephone_FctList_0x1F", getValue(env_FSG_Telephone_FctList_0x1F), profile);
writeProfileInt( "BAP TEL", "env_FSG_Telephone_FctList_0x1E", getValue(env_FSG_Telephone_FctList_0x1E), profile);
writeProfileInt( "BAP TEL", "env_FSG_Telephone_FctList_0x1D", getValue(env_FSG_Telephone_FctList_0x1D), profile);
writeProfileInt( "BAP TEL", "env_FSG_Telephone_FctList_0x1C", getValue(env_FSG_Telephone_FctList_0x1C), profile);
writeProfileInt( "BAP TEL", "env_FSG_Telephone_FctList_0x1B", getValue(env_FSG_Telephone_FctList_0x1B), profile);
writeProfileInt( "BAP TEL", "env_FSG_Telephone_FctList_0x1A", getValue(env_FSG_Telephone_FctList_0x1A), profile);
writeProfileInt( "BAP TEL", "env_FSG_Telephone_FctList_0x19", getValue(env_FSG_Telephone_FctList_0x19), profile);
writeProfileInt( "BAP TEL", "env_FSG_Telephone_FctList_0x18", getValue(env_FSG_Telephone_FctList_0x18), profile);
writeProfileInt( "BAP TEL", "env_FSG_Telephone_FctList_0x17", getValue(env_FSG_Telephone_FctList_0x17), profile);
writeProfileInt( "BAP TEL", "env_FSG_Telephone_FctList_0x16", getValue(env_FSG_Telephone_FctList_0x16), profile);
writeProfileInt( "BAP TEL", "env_FSG_Telephone_FctList_0x15", getValue(env_FSG_Telephone_FctList_0x15), profile);
writeProfileInt( "BAP TEL", "env_FSG_Telephone_FctList_0x14", getValue(env_FSG_Telephone_FctList_0x14), profile);
writeProfileInt( "BAP TEL", "env_FSG_Telephone_FctList_0x13", getValue(env_FSG_Telephone_FctList_0x13), profile);
writeProfileInt( "BAP TEL", "env_FSG_Telephone_FctList_0x12", getValue(env_FSG_Telephone_FctList_0x12), profile);
writeProfileInt( "BAP TEL", "env_FSG_Telephone_FctList_0x11", getValue(env_FSG_Telephone_FctList_0x11), profile);
writeProfileInt( "BAP TEL", "env_FSG_Telephone_FctList_0x10", getValue(env_FSG_Telephone_FctList_0x10), profile);
writeProfileInt( "BAP TEL", "env_FSG_Telephone_FctList_0x0F", getValue(env_FSG_Telephone_FctList_0x0F), profile);
writeProfileInt( "BAP TEL", "env_FSG_Telephone_FctList_0x0E", getValue(env_FSG_Telephone_FctList_0x0E), profile);
writeProfileInt( "BAP TEL", "env_FSG_Telephone_FctList_0x04", getValue(env_FSG_Telephone_FctList_0x04), profile);
writeProfileInt( "BAP TEL", "env_FSG_Telephone_FctList_0x03", getValue(env_FSG_Telephone_FctList_0x03), profile);
writeProfileInt( "BAP TEL", "env_FSG_Telephone_FctList_0x02", getValue(env_FSG_Telephone_FctList_0x02), profile);
writeProfileInt( "BAP TEL", "env_FSG_Telephone_FctList_0x01", getValue(env_FSG_Telephone_FctList_0x01), profile);
writeProfileInt( "BAP TEL", "env_FSG_Telephone_MSS_update", getValue(env_FSG_Telephone_MSS_update), profile);
writeProfileInt( "BAP TEL", "env_FSG_Telephone_MSS_0x30", getValue(env_FSG_Telephone_MSS_0x30), profile);
writeProfileInt( "BAP TEL", "env_FSG_Telephone_MSS_0x2F", getValue(env_FSG_Telephone_MSS_0x2F), profile);
writeProfileInt( "BAP TEL", "env_FSG_Telephone_MSS_0x2E", getValue(env_FSG_Telephone_MSS_0x2E), profile);
writeProfileInt( "BAP TEL", "env_FSG_Telephone_MSS_0x2D", getValue(env_FSG_Telephone_MSS_0x2D), profile);
writeProfileInt( "BAP TEL", "env_FSG_Telephone_MSS_0x2C", getValue(env_FSG_Telephone_MSS_0x2C), profile);
writeProfileInt( "BAP TEL", "env_FSG_Telephone_MSS_0x2B", getValue(env_FSG_Telephone_MSS_0x2B), profile);
writeProfileInt( "BAP TEL", "env_FSG_Telephone_MSS_0x2A", getValue(env_FSG_Telephone_MSS_0x2A), profile);
writeProfileInt( "BAP TEL", "env_FSG_Telephone_MSS_0x29", getValue(env_FSG_Telephone_MSS_0x29), profile);
writeProfileInt( "BAP TEL", "env_FSG_Telephone_MSS_0x28", getValue(env_FSG_Telephone_MSS_0x28), profile);
writeProfileInt( "BAP TEL", "env_FSG_Telephone_MSS_0x27", getValue(env_FSG_Telephone_MSS_0x27), profile);
writeProfileInt( "BAP TEL", "env_FSG_Telephone_MSS_0x26", getValue(env_FSG_Telephone_MSS_0x26), profile);
writeProfileInt( "BAP TEL", "env_FSG_Telephone_MSS_0x25", getValue(env_FSG_Telephone_MSS_0x25), profile);
writeProfileInt( "BAP TEL", "env_FSG_Telephone_MSS_0x24", getValue(env_FSG_Telephone_MSS_0x24), profile);
writeProfileInt( "BAP TEL", "env_FSG_Telephone_MSS_0x23", getValue(env_FSG_Telephone_MSS_0x23), profile);
writeProfileInt( "BAP TEL", "env_FSG_Telephone_MSS_0x22", getValue(env_FSG_Telephone_MSS_0x22), profile);
writeProfileInt( "BAP TEL", "env_FSG_Telephone_MSS_0x21", getValue(env_FSG_Telephone_MSS_0x21), profile);
writeProfileInt( "BAP TEL", "env_FSG_Telephone_MSS_0x20", getValue(env_FSG_Telephone_MSS_0x20), profile);
writeProfileInt( "BAP TEL", "env_FSG_Telephone_MSS_0x1D", getValue(env_FSG_Telephone_MSS_0x1D), profile);
writeProfileInt( "BAP TEL", "env_FSG_Telephone_MSS_0x1F", getValue(env_FSG_Telephone_MSS_0x1F), profile);
writeProfileInt( "BAP TEL", "env_FSG_Telephone_MSS_0x1E", getValue(env_FSG_Telephone_MSS_0x1E), profile);
writeProfileInt( "BAP TEL", "env_FSG_Telephone_MSS_0x1C", getValue(env_FSG_Telephone_MSS_0x1C), profile);
writeProfileInt( "BAP TEL", "env_FSG_Telephone_MSS_0x1B", getValue(env_FSG_Telephone_MSS_0x1B), profile);
writeProfileInt( "BAP TEL", "env_FSG_Telephone_MSS_0x1A", getValue(env_FSG_Telephone_MSS_0x1A), profile);
writeProfileInt( "BAP TEL", "env_FSG_Telephone_MSS_0x19", getValue(env_FSG_Telephone_MSS_0x19), profile);
writeProfileInt( "BAP TEL", "env_FSG_Telephone_MSS_0x18", getValue(env_FSG_Telephone_MSS_0x18), profile);
writeProfileInt( "BAP TEL", "env_FSG_Telephone_MSS_0x17", getValue(env_FSG_Telephone_MSS_0x17), profile);
writeProfileInt( "BAP TEL", "env_FSG_Telephone_MSS_0x16", getValue(env_FSG_Telephone_MSS_0x16), profile);
writeProfileInt( "BAP TEL", "env_FSG_Telephone_MSS_0x15", getValue(env_FSG_Telephone_MSS_0x15), profile);
writeProfileInt( "BAP TEL", "env_FSG_Telephone_MSS_0x14", getValue(env_FSG_Telephone_MSS_0x14), profile);
writeProfileInt( "BAP TEL", "env_FSG_Telephone_MSS_0x13", getValue(env_FSG_Telephone_MSS_0x13), profile);
writeProfileInt( "BAP TEL", "env_FSG_Telephone_MSS_0x12", getValue(env_FSG_Telephone_MSS_0x12), profile);
writeProfileInt( "BAP TEL", "env_FSG_Telephone_MSS_0x11", getValue(env_FSG_Telephone_MSS_0x11), profile);
writeProfileInt( "BAP TEL", "env_FSG_Telephone_MSS_0x10", getValue(env_FSG_Telephone_MSS_0x10), profile);
writeProfileInt( "BAP TEL", "env_FSG_Telephone_MSS_0x0F", getValue(env_FSG_Telephone_MSS_0x0F), profile);
writeProfileInt( "BAP TEL", "env_FSG_Telephone_MSS_0x0E", getValue(env_FSG_Telephone_MSS_0x0E), profile);
writeProfileInt( "BAP TEL", "env_FSG_Telephone_MSS_0x04", getValue(env_FSG_Telephone_MSS_0x04), profile);
writeProfileInt( "BAP TEL", "env_FSG_Telephone_MSS_0x03", getValue(env_FSG_Telephone_MSS_0x03), profile);
writeProfileInt( "BAP TEL", "env_FSG_Telephone_MSS_0x02", getValue(env_FSG_Telephone_MSS_0x02), profile);
writeProfileInt( "BAP TEL", "env_FSG_Telephone_MSS_0x01", getValue(env_FSG_Telephone_MSS_0x01), profile);
writeProfileInt( "BAP TEL", "env_FSG_dialednumber_reject", getValue(env_FSG_dialednumber_reject), profile);
writeProfileInt( "BAP TEL", "env_FSG_PbState_DownloadAbort", getValue(env_FSG_PbState_DownloadAbort), profile);
writeProfileInt( "BAP TEL", "env_FSG_PbState_DownloadState", getValue(env_FSG_PbState_DownloadState), profile);
writeProfileInt( "BAP TEL", "env_FSG_PbState_EntriesUHV", getValue(env_FSG_PbState_EntriesUHV), profile);
writeProfileInt( "BAP TEL", "env_FSG_FSG_Setup_OK", getValue(env_FSG_FSG_Setup_OK), profile);
writeProfileInt( "BAP TEL", "env_FSG_HFPConnection", getValue(env_FSG_HFPConnection), profile);
writeProfileInt( "BAP TEL", "env_FSG_LockState_OK", getValue(env_FSG_LockState_OK), profile);
writeProfileInt( "BAP TEL", "env_FSG_FSG_OperationState_OK", getValue(env_FSG_FSG_OperationState_OK), profile);
writeProfileInt( "BAP TEL", "env_FSG_MobileConnectionType", getValue(env_FSG_MobileConnectionType), profile);
writeProfileInt( "BAP TEL", "env_FSG_RSAPConnection", getValue(env_FSG_RSAPConnection), profile);
writeProfileInt( "BAP TEL", "env_FSG_CableConnection", getValue(env_FSG_CableConnection), profile);
writeProfileInt( "BAP TEL", "env_FSG_SIMCardReader", getValue(env_FSG_SIMCardReader), profile);
writeProfileInt( "BAP TEL", "env_FSG_MissedCallIndication", getValue(env_FSG_MissedCallIndication), profile);
writeProfileInt( "BAP TEL", "env_FSG_MissedNumbers", getValue(env_FSG_MissedNumbers), profile);
writeProfileInt( "BAP TEL", "env_FSG_MissedCalls", getValue(env_FSG_MissedCalls), profile);
writeProfileInt( "BAP TEL", "env_FSG_receivedcall_select", getValue(env_FSG_receivedcall_select), profile);
writeProfileInt( "BAP TEL", "env_FSG_receivedcall_numbertype", getValue(env_FSG_receivedcall_numbertype), profile);
writeProfileInt( "BAP TEL", "env_FSG_receivedcall_callstack", getValue(env_FSG_receivedcall_callstack), profile);
writeProfileInt( "BAP TEL", "env_FSG_receivedcall_add_type", getValue(env_FSG_receivedcall_add_type), profile);
writeProfileInt( "BAP TEL", "env_FSG_receivedcall_add", getValue(env_FSG_receivedcall_add), profile);
writeProfileInt( "BAP TEL", "env_FSG_dial_receivedcall", getValue(env_FSG_dial_receivedcall), profile);
writeProfileInt( "BAP TEL", "env_FSG_MissedCalls_update", getValue(env_FSG_MissedCalls_update), profile);
writeProfileInt( "BAP TEL", "env_FSG_missedcall_add_type", getValue(env_FSG_missedcall_add_type), profile);
writeProfileInt( "BAP TEL", "env_FSG_missedcall_add", getValue(env_FSG_missedcall_add), profile);
writeProfileInt( "BAP TEL", "env_FSG_missedcall_select", getValue(env_FSG_missedcall_select), profile);
writeProfileInt( "BAP TEL", "env_FSG_missedcall_numbertype", getValue(env_FSG_missedcall_numbertype), profile);
writeProfileInt( "BAP TEL", "env_FSG_missedcall_callstack", getValue(env_FSG_missedcall_callstack), profile);
writeProfileInt( "BAP TEL", "env_FSG_dialednumber_add_type", getValue(env_FSG_dialednumber_add_type), profile);
writeProfileInt( "BAP TEL", "env_FSG_dialednumber_add", getValue(env_FSG_dialednumber_add), profile);
writeProfileInt( "BAP TEL", "env_FSG_SignalQuality_Mode", getValue(env_FSG_SignalQuality_Mode), profile);
writeProfileInt( "BAP TEL", "env_FSG_SignalQuality", getValue(env_FSG_SignalQuality), profile);
writeProfileInt( "BAP TEL", "env_FSG_ActiveUser_OK", getValue(env_FSG_ActiveUser_OK), profile);
writeProfileInt( "BAP TEL", "env_FSG_LockState", getValue(env_FSG_LockState), profile);
writeProfileInt( "BAP TEL", "env_FSG_NetInfoCiphering", getValue(env_FSG_NetInfoCiphering), profile);
writeProfileInt( "BAP TEL", "env_FSG_NetInfoCallDivert", getValue(env_FSG_NetInfoCallDivert), profile);
writeProfileInt( "BAP TEL", "env_FSG_Power_on_off", getValue(env_FSG_Power_on_off), profile);
writeProfileInt( "BAP TEL", "env_FSG_OP_State", getValue(env_FSG_OP_State), profile);
writeProfileInt( "BAP TEL", "env_FSG_phonebook_numbertype", getValue(env_FSG_phonebook_numbertype), profile);
writeProfileInt( "BAP TEL", "env_FSG_dialednumber_numbertype", getValue(env_FSG_dialednumber_numbertype), profile);
writeProfileInt( "BAP TEL", "env_FSG_dialednumber_select", getValue(env_FSG_dialednumber_select), profile);
writeProfileInt( "BAP TEL", "env_FSG_dial_dialednumber", getValue(env_FSG_dial_dialednumber), profile);
writeProfileInt( "BAP TEL", "env_FSG_AcceptCall", getValue(env_FSG_AcceptCall), profile);
writeProfileInt( "BAP TEL", "env_FSG_dialednumber_accepted", getValue(env_FSG_dialednumber_accepted), profile);
writeProfileInt( "BAP TEL", "env_FSG_Headset_available", getValue(env_FSG_Headset_available), profile);
writeProfileInt( "BAP TEL", "env_FSG_HandsFreeOnOff", getValue(env_FSG_HandsFreeOnOff), profile);
writeProfileInt( "BAP TEL", "env_FSG_BAP_Indication_datalengt", getValue(env_FSG_BAP_Indication_datalengt), profile);
writeProfileInt( "BAP TEL", "env_FSG_BAP_Request_datalength", getValue(env_FSG_BAP_Request_datalength), profile);
writeProfileInt( "BAP TEL", "env_FSG_hangup_active_calls", getValue(env_FSG_hangup_active_calls), profile);
writeProfileInt( "BAP TEL", "env_FSG_CallHold", getValue(env_FSG_CallHold), profile);
writeProfileInt( "BAP TEL", "env_FSG_CallID_6_hangup", getValue(env_FSG_CallID_6_hangup), profile);
writeProfileInt( "BAP TEL", "env_FSG_CallID_5_hangup", getValue(env_FSG_CallID_5_hangup), profile);
writeProfileInt( "BAP TEL", "env_FSG_CallID_4_hangup", getValue(env_FSG_CallID_4_hangup), profile);
writeProfileInt( "BAP TEL", "env_FSG_CallID_3_hangup", getValue(env_FSG_CallID_3_hangup), profile);
writeProfileInt( "BAP TEL", "env_FSG_CallID_2_hangup", getValue(env_FSG_CallID_2_hangup), profile);
writeProfileInt( "BAP TEL", "env_FSG_CallID_1_hangup", getValue(env_FSG_CallID_1_hangup), profile);
writeProfileInt( "BAP TEL", "env_FSG_CallID_0_hangup", getValue(env_FSG_CallID_0_hangup), profile);
writeProfileInt( "BAP TEL", "env_FSG_dialednumber_free_busy", getValue(env_FSG_dialednumber_free_busy), profile);
writeProfileInt( "BAP TEL", "env_FSG_DisconnectReason", getValue(env_FSG_DisconnectReason), profile);
writeProfileInt( "BAP TEL", "env_FSG_SIMstatus", getValue(env_FSG_SIMstatus), profile);
writeProfileInt( "BAP TEL", "env_FSG_IncomingCall", getValue(env_FSG_IncomingCall), profile);
writeProfileInt( "BAP TEL", "env_FSG_NetworkProvider_OK", getValue(env_FSG_NetworkProvider_OK), profile);
writeProfileInt( "BAP TEL", "env_Tel_HandsFree_Error_Code", getValue(env_Tel_HandsFree_Error_Code), profile);
writeProfileInt( "BAP TEL", "env_Tel_HandsFree_Error_On", getValue(env_Tel_HandsFree_Error_On), profile);
writeProfileInt( "BAP TEL", "env_Tel_MicroMute_Error_Code", getValue(env_Tel_MicroMute_Error_Code), profile);
writeProfileInt( "BAP TEL", "env_Tel_MicroMute_Error_On", getValue(env_Tel_MicroMute_Error_On), profile);
writeProfileInt( "BAP TEL", "env_Tel_MissedCallInd_Error_Code", getValue(env_Tel_MissedCallInd_Error_Code), profile);
writeProfileInt( "BAP TEL", "env_Tel_MissedCallInd_Error_On", getValue(env_Tel_MissedCallInd_Error_On), profile);
writeProfileInt( "BAP TEL", "env_Tel_RingToneMute_Error_Code", getValue(env_Tel_RingToneMute_Error_Code), profile);
writeProfileInt( "BAP TEL", "env_Tel_RingToneMute_Error_On", getValue(env_Tel_RingToneMute_Error_On), profile);
writeProfileInt( "BAP TEL", "env_Tel_AutoRedial_Error_Code", getValue(env_Tel_AutoRedial_Error_Code), profile);
writeProfileInt( "BAP TEL", "env_Tel_AutoRedial_Error_On", getValue(env_Tel_AutoRedial_Error_On), profile);
writeProfileInt( "BAP TEL", "env_FSG_Telephone_FctList_0x3C", getValue(env_FSG_Telephone_FctList_0x3C), profile);
writeProfileInt( "BAP TEL", "env_FSG_Telephone_FctList_0x3B", getValue(env_FSG_Telephone_FctList_0x3B), profile);
writeProfileInt( "BAP TEL", "env_FSG_Telephone_FctList_0x3A", getValue(env_FSG_Telephone_FctList_0x3A), profile);
writeProfileInt( "BAP TEL", "env_FSG_Telephone_FctList_0x39", getValue(env_FSG_Telephone_FctList_0x39), profile);
writeProfileInt( "BAP TEL", "env_FSG_Telephone_FctList_0x38", getValue(env_FSG_Telephone_FctList_0x38), profile);
writeProfileInt( "BAP TEL", "env_FSG_Telephone_FctList_0x37", getValue(env_FSG_Telephone_FctList_0x37), profile);
writeProfileInt( "BAP TEL", "env_FSG_Telephone_FctList_0x36", getValue(env_FSG_Telephone_FctList_0x36), profile);
writeProfileInt( "BAP TEL", "env_FSG_Telephone_FctList_0x35", getValue(env_FSG_Telephone_FctList_0x35), profile);
writeProfileInt( "BAP TEL", "env_FSG_Telephone_FctList_0x34", getValue(env_FSG_Telephone_FctList_0x34), profile);
writeProfileInt( "BAP TEL", "env_FSG_Telephone_FctList_0x33", getValue(env_FSG_Telephone_FctList_0x33), profile);
writeProfileInt( "BAP TEL", "env_FSG_Telephone_FctList_0x32", getValue(env_FSG_Telephone_FctList_0x32), profile);
writeProfileInt( "BAP TEL", "env_FSG_Telephone_FctList_0x31", getValue(env_FSG_Telephone_FctList_0x31), profile);
writeProfileInt( "BAP TEL", "env_Telefon_FuncList", getValue(env_Telefon_FuncList), profile);
writeProfileInt( "BAP TEL", "env_FSG_Telephone_FctList_0x3A_HB", getValue(env_FSG_Telephone_FctList_0x3A_HB), profile);
writeProfileInt( "BAP TEL", "env_FSG_Telephone_FctList_0x39_HB", getValue(env_FSG_Telephone_FctList_0x39_HB), profile);
writeProfileInt( "BAP TEL", "env_FSG_Telephone_FctList_0x38_HB", getValue(env_FSG_Telephone_FctList_0x38_HB), profile);
writeProfileInt( "BAP TEL", "env_FSG_Telephone_FctList_0x37_HB", getValue(env_FSG_Telephone_FctList_0x37_HB), profile);
writeProfileInt( "BAP TEL", "env_FSG_Telephone_FctList_0x36_HB", getValue(env_FSG_Telephone_FctList_0x36_HB), profile);
writeProfileInt( "BAP TEL", "env_FSG_Telephone_FctList_0x35_HB", getValue(env_FSG_Telephone_FctList_0x35_HB), profile);
writeProfileInt( "BAP TEL", "env_FSG_Telephone_FctList_0x34_HB", getValue(env_FSG_Telephone_FctList_0x34_HB), profile);
writeProfileInt( "BAP TEL", "env_FSG_Telephone_FctList_0x33_HB", getValue(env_FSG_Telephone_FctList_0x33_HB), profile);
writeProfileInt( "BAP TEL", "env_FSG_Telephone_FctList_0x32_HB", getValue(env_FSG_Telephone_FctList_0x32_HB), profile);
writeProfileInt( "BAP TEL", "env_FSG_Telephone_FctList_0x31_HB", getValue(env_FSG_Telephone_FctList_0x31_HB), profile);
writeProfileInt( "BAP TEL", "env_FSG_Telephone_FctList_0x30_HB", getValue(env_FSG_Telephone_FctList_0x30_HB), profile);
writeProfileInt( "BAP TEL", "env_FSG_Telephone_FctList_0x2F_HB", getValue(env_FSG_Telephone_FctList_0x2F_HB), profile);
writeProfileInt( "BAP TEL", "env_FSG_Telephone_FctList_0x2E_HB", getValue(env_FSG_Telephone_FctList_0x2E_HB), profile);
writeProfileInt( "BAP TEL", "env_FSG_Telephone_FctList_0x2D_HB", getValue(env_FSG_Telephone_FctList_0x2D_HB), profile);
writeProfileInt( "BAP TEL", "env_FSG_Telephone_FctList_0x2C_HB", getValue(env_FSG_Telephone_FctList_0x2C_HB), profile);
writeProfileInt( "BAP TEL", "env_FSG_Telephone_FctList_0x2B_HB", getValue(env_FSG_Telephone_FctList_0x2B_HB), profile);
writeProfileInt( "BAP TEL", "env_FSG_Telephone_FctList_0x2A_HB", getValue(env_FSG_Telephone_FctList_0x2A_HB), profile);
writeProfileInt( "BAP TEL", "env_FSG_Telephone_FctList_0x29_HB", getValue(env_FSG_Telephone_FctList_0x29_HB), profile);
writeProfileInt( "BAP TEL", "env_FSG_Telephone_FctList_0x28_HB", getValue(env_FSG_Telephone_FctList_0x28_HB), profile);
writeProfileInt( "BAP TEL", "env_FSG_Telephone_FctList_0x27_HB", getValue(env_FSG_Telephone_FctList_0x27_HB), profile);
writeProfileInt( "BAP TEL", "env_FSG_Telephone_FctList_0x26_HB", getValue(env_FSG_Telephone_FctList_0x26_HB), profile);
writeProfileInt( "BAP TEL", "env_FSG_Telephone_FctList_0x25_HB", getValue(env_FSG_Telephone_FctList_0x25_HB), profile);
writeProfileInt( "BAP TEL", "env_FSG_Telephone_FctList_0x23_HB", getValue(env_FSG_Telephone_FctList_0x23_HB), profile);
writeProfileInt( "BAP TEL", "env_FSG_Telephone_FctList_0x22_HB", getValue(env_FSG_Telephone_FctList_0x22_HB), profile);
writeProfileInt( "BAP TEL", "env_FSG_Telephone_FctList_0x21_HB", getValue(env_FSG_Telephone_FctList_0x21_HB), profile);
writeProfileInt( "BAP TEL", "env_FSG_Telephone_FctList_0x20_HB", getValue(env_FSG_Telephone_FctList_0x20_HB), profile);
writeProfileInt( "BAP TEL", "env_FSG_Telephone_FctList_0x1F_HB", getValue(env_FSG_Telephone_FctList_0x1F_HB), profile);
writeProfileInt( "BAP TEL", "env_FSG_Telephone_FctList_0x1E_HB", getValue(env_FSG_Telephone_FctList_0x1E_HB), profile);
writeProfileInt( "BAP TEL", "env_FSG_Telephone_FctList_0x1D_HB", getValue(env_FSG_Telephone_FctList_0x1D_HB), profile);
writeProfileInt( "BAP TEL", "env_FSG_Telephone_FctList_0x1C_HB", getValue(env_FSG_Telephone_FctList_0x1C_HB), profile);
writeProfileInt( "BAP TEL", "env_FSG_Telephone_FctList_0x1B_HB", getValue(env_FSG_Telephone_FctList_0x1B_HB), profile);
writeProfileInt( "BAP TEL", "env_FSG_Telephone_FctList_0x1A_HB", getValue(env_FSG_Telephone_FctList_0x1A_HB), profile);
writeProfileInt( "BAP TEL", "env_FSG_Telephone_FctList_0x19_HB", getValue(env_FSG_Telephone_FctList_0x19_HB), profile);
writeProfileInt( "BAP TEL", "env_FSG_Telephone_FctList_0x18_HB", getValue(env_FSG_Telephone_FctList_0x18_HB), profile);
writeProfileInt( "BAP TEL", "env_FSG_Telephone_FctList_0x17_HB", getValue(env_FSG_Telephone_FctList_0x17_HB), profile);
writeProfileInt( "BAP TEL", "env_FSG_Telephone_FctList_0x16_HB", getValue(env_FSG_Telephone_FctList_0x16_HB), profile);
writeProfileInt( "BAP TEL", "env_FSG_Telephone_FctList_0x15_HB", getValue(env_FSG_Telephone_FctList_0x15_HB), profile);
writeProfileInt( "BAP TEL", "env_FSG_Telephone_FctList_0x14_HB", getValue(env_FSG_Telephone_FctList_0x14_HB), profile);
writeProfileInt( "BAP TEL", "env_FSG_Telephone_FctList_0x13_HB", getValue(env_FSG_Telephone_FctList_0x13_HB), profile);
writeProfileInt( "BAP TEL", "env_FSG_Telephone_FctList_0x12_HB", getValue(env_FSG_Telephone_FctList_0x12_HB), profile);
writeProfileInt( "BAP TEL", "env_FSG_Telephone_FctList_0x11_HB", getValue(env_FSG_Telephone_FctList_0x11_HB), profile);
writeProfileInt( "BAP TEL", "env_FSG_Telephone_FctList_0x10_HB", getValue(env_FSG_Telephone_FctList_0x10_HB), profile);
writeProfileInt( "BAP TEL", "env_FSG_Telephone_FctList_0x0F_HB", getValue(env_FSG_Telephone_FctList_0x0F_HB), profile);
writeProfileInt( "BAP TEL", "env_FSG_Telephone_FctList_0x0E_HB", getValue(env_FSG_Telephone_FctList_0x0E_HB), profile);
writeProfileInt( "BAP TEL", "env_FSG_Telephone_FctList_0x04_HB", getValue(env_FSG_Telephone_FctList_0x04_HB), profile);
writeProfileInt( "BAP TEL", "env_FSG_Telephone_FctList_0x03_HB", getValue(env_FSG_Telephone_FctList_0x03_HB), profile);
writeProfileInt( "BAP TEL", "env_FSG_Telephone_FctList_0x02_HB", getValue(env_FSG_Telephone_FctList_0x02_HB), profile);
writeProfileInt( "BAP TEL", "env_FSG_Telephone_FctList_0x01_HB", getValue(env_FSG_Telephone_FctList_0x01_HB), profile);
writeProfileInt( "BAP TEL", "env_FSG_DisconnectReason_Active", getValue(env_FSG_DisconnectReason_Active), profile);
writeProfileInt( "BAP TEL", "env_FSG_CN_TAID_error", getValue(env_FSG_CN_TAID_error), profile);
writeProfileInt( "BAP TEL", "env_FSG_CN_ASGID_error", getValue(env_FSG_CN_ASGID_error), profile);
writeProfileInt( "BAP TEL", "env_FSG_Phonebook_TAID_error", getValue(env_FSG_Phonebook_TAID_error), profile);
writeProfileInt( "BAP TEL", "env_FSG_Phonebook_ASGID_error", getValue(env_FSG_Phonebook_ASGID_error), profile);
writeProfileInt( "BAP TEL", "env_FSG_CN_Timeout", getValue(env_FSG_CN_Timeout), profile);
writeProfileInt( "BAP TEL", "env_FSG_Phonebook_Timeout", getValue(env_FSG_Phonebook_Timeout), profile);
writeProfileInt( "BAP TEL", "env_FSG_Tel_FctList_0x01_TimeOut", getValue(env_FSG_Tel_FctList_0x01_TimeOut), profile);
writeProfileInt( "BAP TEL", "env_FSG_Tel_FctList_0x02_TimeOut", getValue(env_FSG_Tel_FctList_0x02_TimeOut), profile);
writeProfileInt( "BAP TEL", "env_FSG_Tel_FctList_0x03_TimeOut", getValue(env_FSG_Tel_FctList_0x03_TimeOut), profile);
writeProfileInt( "BAP TEL", "env_FSG_Tel_FctList_0x04_TimeOut", getValue(env_FSG_Tel_FctList_0x04_TimeOut), profile);
writeProfileInt( "BAP TEL", "env_FSG_Tel_FctList_0x05_TimeOut", getValue(env_FSG_Tel_FctList_0x05_TimeOut), profile);
writeProfileInt( "BAP TEL", "env_FSG_Tel_FctList_0x06_TimeOut", getValue(env_FSG_Tel_FctList_0x06_TimeOut), profile);
writeProfileInt( "BAP TEL", "env_FSG_Tel_FctList_0x07_TimeOut", getValue(env_FSG_Tel_FctList_0x07_TimeOut), profile);
writeProfileInt( "BAP TEL", "env_FSG_Tel_FctList_0x08_TimeOut", getValue(env_FSG_Tel_FctList_0x08_TimeOut), profile);
writeProfileInt( "BAP TEL", "env_FSG_Tel_FctList_0x09_TimeOut", getValue(env_FSG_Tel_FctList_0x09_TimeOut), profile);
writeProfileInt( "BAP TEL", "env_FSG_Tel_FctList_0x0A_TimeOut", getValue(env_FSG_Tel_FctList_0x0A_TimeOut), profile);
writeProfileInt( "BAP TEL", "env_FSG_Tel_FctList_0x0B_TimeOut", getValue(env_FSG_Tel_FctList_0x0B_TimeOut), profile);
writeProfileInt( "BAP TEL", "env_FSG_Tel_FctList_0x0C_TimeOut", getValue(env_FSG_Tel_FctList_0x0C_TimeOut), profile);
writeProfileInt( "BAP TEL", "env_FSG_Tel_FctList_0x0D_TimeOut", getValue(env_FSG_Tel_FctList_0x0D_TimeOut), profile);
writeProfileInt( "BAP TEL", "env_FSG_Tel_FctList_0x0F_TimeOut", getValue(env_FSG_Tel_FctList_0x0F_TimeOut), profile);
writeProfileInt( "BAP TEL", "env_FSG_Tel_FctList_0x10_TimeOut", getValue(env_FSG_Tel_FctList_0x10_TimeOut), profile);
writeProfileInt( "BAP TEL", "env_FSG_Tel_FctList_0x11_TimeOut", getValue(env_FSG_Tel_FctList_0x11_TimeOut), profile);
writeProfileInt( "BAP TEL", "env_FSG_Tel_FctList_0x12_TimeOut", getValue(env_FSG_Tel_FctList_0x12_TimeOut), profile);
writeProfileInt( "BAP TEL", "env_FSG_Tel_FctList_0x13_TimeOut", getValue(env_FSG_Tel_FctList_0x13_TimeOut), profile);
writeProfileInt( "BAP TEL", "env_FSG_Tel_FctList_0x14_TimeOut", getValue(env_FSG_Tel_FctList_0x14_TimeOut), profile);
writeProfileInt( "BAP TEL", "env_FSG_Tel_FctList_0x15_TimeOut", getValue(env_FSG_Tel_FctList_0x15_TimeOut), profile);
writeProfileInt( "BAP TEL", "env_FSG_Tel_FctList_0x16_TimeOut", getValue(env_FSG_Tel_FctList_0x16_TimeOut), profile);
writeProfileInt( "BAP TEL", "env_FSG_Tel_FctList_0x17_TimeOut", getValue(env_FSG_Tel_FctList_0x17_TimeOut), profile);
writeProfileInt( "BAP TEL", "env_FSG_Tel_FctList_0x18_TimeOut", getValue(env_FSG_Tel_FctList_0x18_TimeOut), profile);
writeProfileInt( "BAP TEL", "env_FSG_Tel_FctList_0x19_TimeOut", getValue(env_FSG_Tel_FctList_0x19_TimeOut), profile);
writeProfileInt( "BAP TEL", "env_FSG_Tel_FctList_0x1A_TimeOut", getValue(env_FSG_Tel_FctList_0x1A_TimeOut), profile);
writeProfileInt( "BAP TEL", "env_FSG_Tel_FctList_0x1B_TimeOut", getValue(env_FSG_Tel_FctList_0x1B_TimeOut), profile);
writeProfileInt( "BAP TEL", "env_FSG_Tel_FctList_0x1C_TimeOut", getValue(env_FSG_Tel_FctList_0x1C_TimeOut), profile);
writeProfileInt( "BAP TEL", "env_FSG_Tel_FctList_0x1D_TimeOut", getValue(env_FSG_Tel_FctList_0x1D_TimeOut), profile);
writeProfileInt( "BAP TEL", "env_FSG_Tel_FctList_0x1E_TimeOut", getValue(env_FSG_Tel_FctList_0x1E_TimeOut), profile);
writeProfileInt( "BAP TEL", "env_FSG_Tel_FctList_0x1F_TimeOut", getValue(env_FSG_Tel_FctList_0x1F_TimeOut), profile);
writeProfileInt( "BAP TEL", "env_FSG_Tel_FctList_0x20_TimeOut", getValue(env_FSG_Tel_FctList_0x20_TimeOut), profile);
writeProfileInt( "BAP TEL", "env_FSG_Tel_FctList_0x21_TimeOut", getValue(env_FSG_Tel_FctList_0x21_TimeOut), profile);
writeProfileInt( "BAP TEL", "env_FSG_Tel_FctList_0x23_TimeOut", getValue(env_FSG_Tel_FctList_0x23_TimeOut), profile);
writeProfileInt( "BAP TEL", "env_FSG_Tel_FctList_0x24_TimeOut", getValue(env_FSG_Tel_FctList_0x24_TimeOut), profile);
writeProfileInt( "BAP TEL", "env_FSG_Tel_FctList_0x25_TimeOut", getValue(env_FSG_Tel_FctList_0x25_TimeOut), profile);
writeProfileInt( "BAP TEL", "env_FSG_Tel_FctList_0x26_TimeOut", getValue(env_FSG_Tel_FctList_0x26_TimeOut), profile);
writeProfileInt( "BAP TEL", "env_FSG_Tel_FctList_0x27_TimeOut", getValue(env_FSG_Tel_FctList_0x27_TimeOut), profile);
writeProfileInt( "BAP TEL", "env_FSG_Tel_FctList_0x28_TimeOut", getValue(env_FSG_Tel_FctList_0x28_TimeOut), profile);
writeProfileInt( "BAP TEL", "env_FSG_Tel_FctList_0x29_TimeOut", getValue(env_FSG_Tel_FctList_0x29_TimeOut), profile);
writeProfileInt( "BAP TEL", "env_FSG_Tel_FctList_0x2A_TimeOut", getValue(env_FSG_Tel_FctList_0x2A_TimeOut), profile);
writeProfileInt( "BAP TEL", "env_FSG_Tel_FctList_0x2B_TimeOut", getValue(env_FSG_Tel_FctList_0x2B_TimeOut), profile);
writeProfileInt( "BAP TEL", "env_FSG_Tel_FctList_0x2C_TimeOut", getValue(env_FSG_Tel_FctList_0x2C_TimeOut), profile);
writeProfileInt( "BAP TEL", "env_FSG_Tel_FctList_0x2D_TimeOut", getValue(env_FSG_Tel_FctList_0x2D_TimeOut), profile);
writeProfileInt( "BAP TEL", "env_FSG_Tel_FctList_0x2E_TimeOut", getValue(env_FSG_Tel_FctList_0x2E_TimeOut), profile);
writeProfileInt( "BAP TEL", "env_FSG_Tel_FctList_0x2F_TimeOut", getValue(env_FSG_Tel_FctList_0x2F_TimeOut), profile);
writeProfileInt( "BAP TEL", "env_FSG_Tel_FctList_0x30_TimeOut", getValue(env_FSG_Tel_FctList_0x30_TimeOut), profile);
writeProfileInt( "BAP TEL", "env_FSG_Tel_FctList_0x31_TimeOut", getValue(env_FSG_Tel_FctList_0x31_TimeOut), profile);
writeProfileInt( "BAP TEL", "env_FSG_Tel_FctList_0x32_TimeOut", getValue(env_FSG_Tel_FctList_0x32_TimeOut), profile);
writeProfileInt( "BAP TEL", "env_FSG_Tel_FctList_0x33_TimeOut", getValue(env_FSG_Tel_FctList_0x33_TimeOut), profile);
writeProfileInt( "BAP TEL", "env_FSG_Tel_FctList_0x34_TimeOut", getValue(env_FSG_Tel_FctList_0x34_TimeOut), profile);
writeProfileInt( "BAP TEL", "env_FSG_Tel_FctList_0x35_TimeOut", getValue(env_FSG_Tel_FctList_0x35_TimeOut), profile);
writeProfileInt( "BAP TEL", "env_FSG_Tel_FctList_0x36_TimeOut", getValue(env_FSG_Tel_FctList_0x36_TimeOut), profile);
writeProfileInt( "BAP TEL", "env_FSG_Tel_FctList_0x37_TimeOut", getValue(env_FSG_Tel_FctList_0x37_TimeOut), profile);
writeProfileInt( "BAP TEL", "env_FSG_Tel_FctList_0x38_TimeOut", getValue(env_FSG_Tel_FctList_0x38_TimeOut), profile);
writeProfileInt( "BAP TEL", "env_FSG_Tel_FctList_0x39_TimeOut", getValue(env_FSG_Tel_FctList_0x39_TimeOut), profile);
writeProfileInt( "BAP TEL", "env_FSG_Tel_FctList_0x3A_TimeOut", getValue(env_FSG_Tel_FctList_0x3A_TimeOut), profile);
writeProfileInt( "BAP TEL", "env_FSG_Tel_FctList_0x1A_3min_TO", getValue(env_FSG_Tel_FctList_0x1A_3min_TO), profile);
writeProfileInt( "BAP TEL", "env_FSG_Tel_FctList_0x1E_3min_TO", getValue(env_FSG_Tel_FctList_0x1E_3min_TO), profile);
writeProfileInt( "BAP TEL", "env_FSG_Tel_FctList_0x20_3min_TO", getValue(env_FSG_Tel_FctList_0x20_3min_TO), profile);
writeProfileInt( "BAP TEL", "env_FSG_Tel_FctList_0x1F_3min_TO", getValue(env_FSG_Tel_FctList_0x1F_3min_TO), profile);
writeProfileInt( "BAP TEL", "env_FSG_Tel_FctList_0x1B_3min_TO", getValue(env_FSG_Tel_FctList_0x1B_3min_TO), profile);
writeProfileInt( "BAP TEL", "env_FSG_Tel_FctList_0x1D_3min_TO", getValue(env_FSG_Tel_FctList_0x1D_3min_TO), profile);
writeProfileInt( "BAP TEL", "env_FSG_Tel_FctList_0x23_3min_TO", getValue(env_FSG_Tel_FctList_0x23_3min_TO), profile);
writeProfileInt( "BAP TEL", "env_FSG_Tel_FctList_0x24_3min_TO", getValue(env_FSG_Tel_FctList_0x24_3min_TO), profile);
writeProfileInt( "BAP TEL", "env_FSG_Tel_FctList_0x25_3min_TO", getValue(env_FSG_Tel_FctList_0x25_3min_TO), profile);
writeProfileInt( "BAP TEL", "env_FSG_Tel_FctList_0x35_3min_TO", getValue(env_FSG_Tel_FctList_0x35_3min_TO), profile);
writeProfileInt( "BAP TEL", "env_FSG_Tel_FctList_0x1C_3min_TO", getValue(env_FSG_Tel_FctList_0x1C_3min_TO), profile);
writeProfileInt( "BAP TEL", "env_FSG_Tel_FctList_0x28_3min_TO", getValue(env_FSG_Tel_FctList_0x28_3min_TO), profile);
writeProfileInt( "BAP TEL", "env_FSG_Tel_FctList_0x26_3min_TO", getValue(env_FSG_Tel_FctList_0x26_3min_TO), profile);
writeProfileInt( "BAP TEL", "env_FSG_Tel_FctList_0x27_3min_TO", getValue(env_FSG_Tel_FctList_0x27_3min_TO), profile);
writeProfileInt( "BAP TEL", "env_FSG_Tel_FctList_0x36_3min_TO", getValue(env_FSG_Tel_FctList_0x36_3min_TO), profile);
}

//IssueList #200 -  Addition of SaveAll button
void saveBAP_OtherSettings( char profileFile[] )
{
  saveBAP_audioSettings(profileFile);
  saveBAP_telSettings(profileFile);
  /* 26.08.2014 Update FPK_15S1 Navi
  saveBAP_naviSettings(profileFile);
  */

}

//IssueList #200 -  Addition of SaveAll button
void loadBAP_OtherSettings( char profileFile[] )
{
  loadBAP_audioSettings(profileFile);
  loadBAP_telSettings(profileFile);

  /* 26.08.2014 Update on FPK_15S1 Navi
  loadBAP_naviSettings(profileFile);
  */

}

on key 'a'
{
     EnableControl("Main", "EnvVar:eBAPLoadSettings",1);
     EnableControl("Main", "EnvVar:eBAPSaveSettings",1);
     EnableControl("Main", "EnvVar:eLoadAllSettings",1);
     EnableControl("Main", "EnvVar:eSaveAllSettings",1);
}

on envVar ON_OFF_BAP_LoadSave_INI
{
    if (getValue(this))
    {
        EnableControl("Main", "EnvVar:eBAPLoadSettings",1);
        EnableControl("Main", "EnvVar:eBAPSaveSettings",1);
        EnableControl("Main", "EnvVar:eLoadAllSettings",1);
        EnableControl("Main", "EnvVar:eSaveAllSettings",1);
    }
}

