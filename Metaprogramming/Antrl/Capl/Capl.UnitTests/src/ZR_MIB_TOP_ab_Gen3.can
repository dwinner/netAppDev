/*@!Encoding:1252*/
includes
{
  // Import required CAPL include files
  //--- begin generated part --- Block start #Hdr_Includes#; do not delete this line and do not add application code in this code block!
  /* #ChannelStart# |CAN1| #BusStart# |E3V_ABCANFD| */
  /* #ChannelEnd# |CAN1| #BusEnd# |E3V_ABCANFD| */
  //--- end generated part --- Block end #Hdr_Includes#; do not delete this line! Add application code below this line.
  //--- begin generated part --- Block start #Body_Includes#; do not delete this line and do not add application code in this code block!
  /* #ChannelStart# |CAN1| #BusStart# |E3V_ABCANFD| */
  #include "..\..\CAPL\VAG-IL-KL30-Helper_CAN1.cin"
  #include "..\..\CAPL\VAG-NM-Panel-Helper_CAN1.cin"
  #include "..\..\CAPL\VAG-NM-HIGH-Helper_CAN1.cin"
  /* #ChannelEnd# |CAN1| #BusEnd# |E3V_ABCANFD| */
  //--- end generated part --- Block end #Body_Includes#; do not delete this line! Add application code below this line.
}

variables
{
  // Define global variables for this CAPL file

  /*--- #GenHeader Begin# --- begin generated comment ---
  | Generated on Friday, Januar 17, 2020, 09:38:11
  | By ModelGenerator for VAG 1.4.3.7, ModelGeneratorVAGDLL 1.4.3.46
  | Package VAG 3.1.3.3 Hotfix
  | Target Bus: E3V_ABCANFD; Channel: CAN1; DB Cluster: E3_1_1_MEB_ABCANFD_KMatrix_V100604F_20191202_MB;
  | From Database: E3_1_1_MEB_ABCANFD_KMatrix_V10.06.04F_20191202_MB.dbc
  | CANoe Version 12.0.189.0
    --- #GenHeader End  # --- end generated comment --- */

  char gECU[256] = "ZR_MIB_TOP_ab_Gen3";
  //--- begin generated part --- Block start #Hdr_GlobalVariables#; do not delete this line and do not add application code in this code block!
  /* #ChannelStart# |CAN1| #BusStart# |E3V_ABCANFD| */
  /* #ChannelEnd# |CAN1| #BusEnd# |E3V_ABCANFD| */
  //--- end generated part --- Block end #Hdr_GlobalVariables#; do not delete this line! Add application code below this line.
  //--- begin generated part --- Block start #Body_GlobalVariables#; do not delete this line and do not add application code in this code block!
  /* #ChannelStart# |CAN1| #BusStart# |E3V_ABCANFD| */
  char gCAN1BusName[256] = "AB_CAN";
  int gCAN1Channel = 1; //// The channel the bus is attached to

  long gCAN1DisturbanceMode;
  long gCAN1DisturbanceCount;
  long gCAN1DisturbanceValue;
  long gCAN1DisturbanceContinueMode;
  double gCAN1DisturbancePeriod;
  /* #ChannelEnd# |CAN1| #BusEnd# |E3V_ABCANFD| */
  //--- end generated part --- Block end #Body_GlobalVariables#; do not delete this line! Add application code below this line.
}

on preStart
{
  // Initialize CAPL includes and node's modules/DLLs
  //--- begin generated part --- Block start #Hdr_OnInit#; do not delete this line and do not add application code in this code block!
  /* #ChannelStart# |CAN1| #BusStart# |E3V_ABCANFD| */
  /* #ChannelEnd# |CAN1| #BusEnd# |E3V_ABCANFD| */
  //--- end generated part --- Block end #Hdr_OnInit#; do not delete this line! Add application code below this line.
  //--- begin generated part --- Block start #Body_OnInit#; do not delete this line and do not add application code in this code block!
  /* #ChannelStart# |CAN1| #BusStart# |E3V_ABCANFD| */
  ILCAN1_OnInit();
  NMCAN1_OnInit();
  SetBusContext(gNMCAN1_BusContext);
  NMH_SetInternalParameter( 1000, 1, 0 ); // CancelOrResetSleepTimer on setting bus request
  /* #ChannelEnd# |CAN1| #BusEnd# |E3V_ABCANFD| */
  //--- end generated part --- Block end #Body_OnInit#; do not delete this line! Add application code below this line.
}

on start
{
  // Start CAPL includes and node's modules/DLLs
  //--- begin generated part --- Block start #Hdr_OnStart#; do not delete this line and do not add application code in this code block!
  /* #ChannelStart# |CAN1| #BusStart# |E3V_ABCANFD| */
  /* #ChannelEnd# |CAN1| #BusEnd# |E3V_ABCANFD| */
  //--- end generated part --- Block end #Hdr_OnStart#; do not delete this line! Add application code below this line.
  //--- begin generated part --- Block start #Body_OnStart#; do not delete this line and do not add application code in this code block!
  /* #ChannelStart# |CAN1| #BusStart# |E3V_ABCANFD| */
  ILCAN1_OnStart();
  NMCAN1_OnStart();
  /* #ChannelEnd# |CAN1| #BusEnd# |E3V_ABCANFD| */
  //--- end generated part --- Block end #Body_OnStart#; do not delete this line! Add application code below this line.
}

on preStop
{
  // Prepare stopping
  //--- begin generated part --- Block start #Hdr_OnStopping#; do not delete this line and do not add application code in this code block!
  /* #ChannelStart# |CAN1| #BusStart# |E3V_ABCANFD| */
  /* #ChannelEnd# |CAN1| #BusEnd# |E3V_ABCANFD| */
  //--- end generated part --- Block end #Hdr_OnStopping#; do not delete this line! Add application code below this line.
  //--- begin generated part --- Block start #Body_OnStopping#; do not delete this line and do not add application code in this code block!
  /* #ChannelStart# |CAN1| #BusStart# |E3V_ABCANFD| */
  /* #ChannelEnd# |CAN1| #BusEnd# |E3V_ABCANFD| */
  //--- end generated part --- Block end #Body_OnStopping#; do not delete this line! Add application code below this line.
}

on stopMeasurement
{
  // Stop actions
  //--- begin generated part --- Block start #Hdr_OnStop#; do not delete this line and do not add application code in this code block!
  /* #ChannelStart# |CAN1| #BusStart# |E3V_ABCANFD| */
  /* #ChannelEnd# |CAN1| #BusEnd# |E3V_ABCANFD| */
  //--- end generated part --- Block end #Hdr_OnStop#; do not delete this line! Add application code below this line.
  //--- begin generated part --- Block start #Body_OnStop#; do not delete this line and do not add application code in this code block!
  /* #ChannelStart# |CAN1| #BusStart# |E3V_ABCANFD| */
  /* #ChannelEnd# |CAN1| #BusEnd# |E3V_ABCANFD| */
  //--- end generated part --- Block end #Body_OnStop#; do not delete this line! Add application code below this line.
}

void StartSim(dword busContext, int busActive, int mode)
{
  // Called when ... due to ...
  //   mode == 1: ILControlResume
  //   mode == 2: ILControlStart
  //   mode == 3: ILControlSimulationOn
  //--- begin generated part --- Block start #Hdr_StartSim#; do not delete this line and do not add application code in this code block!
  /* #ChannelStart# |CAN1| #BusStart# |E3V_ABCANFD| */
  /* #ChannelEnd# |CAN1| #BusEnd# |E3V_ABCANFD| */
  //--- end generated part --- Block end #Hdr_StartSim#; do not delete this line! Add application code below this line.
  //write("[%.6f %NODE_NAME%] StartSim(0x%X, %d, %d)", TimeNowNS()/1e9, busContext, busActive, mode);
  //--- begin generated part --- Block start #Body_StartSim#; do not delete this line and do not add application code in this code block!
  /* #ChannelStart# |CAN1| #BusStart# |E3V_ABCANFD| */
  /* #ChannelEnd# |CAN1| #BusEnd# |E3V_ABCANFD| */
  //--- end generated part --- Block end #Body_StartSim#; do not delete this line! Add application code below this line.
}

void StopSim(dword busContext, int busActive, int mode)
{
  // Called when ... due to ...
  //   mode == 1: ILControlWait
  //   mode == 2: ILControlStop
  //   mode == 3: ILControlSimulationOff
  //--- begin generated part --- Block start #Hdr_StopSim#; do not delete this line and do not add application code in this code block!
  /* #ChannelStart# |CAN1| #BusStart# |E3V_ABCANFD| */
  /* #ChannelEnd# |CAN1| #BusEnd# |E3V_ABCANFD| */
  //--- end generated part --- Block end #Hdr_StopSim#; do not delete this line! Add application code below this line.
  //write("[%.6f %NODE_NAME%] StopSim(0x%X, %d, %d)", TimeNowNS()/1e9, busContext, busActive, mode);
  //--- begin generated part --- Block start #Body_StopSim#; do not delete this line and do not add application code in this code block!
  /* #ChannelStart# |CAN1| #BusStart# |E3V_ABCANFD| */
  /* #ChannelEnd# |CAN1| #BusEnd# |E3V_ABCANFD| */
  //--- end generated part --- Block end #Body_StopSim#; do not delete this line! Add application code below this line.
}

on envVar EnvKlemme15
{
  // Handle system state variable
  //--- begin generated part --- Block start #Hdr_KL15_EnvKlemme15#; do not delete this line and do not add application code in this code block!
  /* #ChannelStart# |CAN1| #BusStart# |E3V_ABCANFD| */
  /* #ChannelEnd# |CAN1| #BusEnd# |E3V_ABCANFD| */
  //--- end generated part --- Block end #Hdr_KL15_EnvKlemme15#; do not delete this line! Add application code below this line.
  //--- begin generated part --- Block start #Body_KL15_EnvKlemme15#; do not delete this line and do not add application code in this code block!
  /* #ChannelStart# |CAN1| #BusStart# |E3V_ABCANFD| */
  ILCAN1_OnEnvKlemme15(@this);
  /* #ChannelEnd# |CAN1| #BusEnd# |E3V_ABCANFD| */
  //--- end generated part --- Block end #Body_KL15_EnvKlemme15#; do not delete this line! Add application code below this line.
}

on envVar EnvStartWithoutSending
{
  // Handle system state variable
  //--- begin generated part --- Block start #Hdr_StartManner_EnvStartWithoutSending#; do not delete this line and do not add application code in this code block!
  /* #ChannelStart# |CAN1| #BusStart# |E3V_ABCANFD| */
  /* #ChannelEnd# |CAN1| #BusEnd# |E3V_ABCANFD| */
  //--- end generated part --- Block end #Hdr_StartManner_EnvStartWithoutSending#; do not delete this line! Add application code below this line.
  //--- begin generated part --- Block start #Body_StartManner_EnvStartWithoutSending#; do not delete this line and do not add application code in this code block!
  /* #ChannelStart# |CAN1| #BusStart# |E3V_ABCANFD| */
  ILCAN1_OnEnvStartWithoutSending(@this);
  /* #ChannelEnd# |CAN1| #BusEnd# |E3V_ABCANFD| */
  //--- end generated part --- Block end #Body_StartManner_EnvStartWithoutSending#; do not delete this line! Add application code below this line.
}

dword applILTxPending(long aId, dword aDlc, byte data[])
{
  dword ret = 1;
  //--- begin generated part --- Block start #Hdr_applILTxPending#; do not delete this line and do not add application code in this code block!
  /* #ChannelStart# |CAN1| #BusStart# |E3V_ABCANFD| */
  /* #ChannelEnd# |CAN1| #BusEnd# |E3V_ABCANFD| */
  //--- end generated part --- Block end #Hdr_applILTxPending#; do not delete this line! Add application code below this line.
  //--- begin generated part --- Block start #Body_applILTxPending#; do not delete this line and do not add application code in this code block!
  /* #ChannelStart# |CAN1| #BusStart# |E3V_ABCANFD| */
  /* #ChannelEnd# |CAN1| #BusEnd# |E3V_ABCANFD| */
  //--- end generated part --- Block end #Body_applILTxPending#; do not delete this line! Add application code below this line.
  return ret;
}

void NMIndNetOn()
{
  // Callback of NM-HIGH DLL
  dword lBusContext;
  //--- begin generated part --- Block start #Hdr_NMIndNetOn#; do not delete this line and do not add application code in this code block!
  /* #ChannelStart# |CAN1| #BusStart# |E3V_ABCANFD| */
  /* #ChannelEnd# |CAN1| #BusEnd# |E3V_ABCANFD| */
  //--- end generated part --- Block end #Hdr_NMIndNetOn#; do not delete this line! Add application code below this line.
  lBusContext = GetBusContext();
  //--- begin generated part --- Block start #Body_NMIndNetOn#; do not delete this line and do not add application code in this code block!
  /* #ChannelStart# |CAN1| #BusStart# |E3V_ABCANFD| */
  if (lBusContext == gNMCAN1_BusContext) NMCAN1_IndNetOn();
  /* #ChannelEnd# |CAN1| #BusEnd# |E3V_ABCANFD| */
  //--- end generated part --- Block end #Body_NMIndNetOn#; do not delete this line! Add application code below this line.
  SetBusContext(lBusContext);
}

void NMIndNetOff()
{
  // Callback of NM-HIGH DLL
  dword lBusContext;
  //--- begin generated part --- Block start #Hdr_NMIndNetOff#; do not delete this line and do not add application code in this code block!
  /* #ChannelStart# |CAN1| #BusStart# |E3V_ABCANFD| */
  /* #ChannelEnd# |CAN1| #BusEnd# |E3V_ABCANFD| */
  //--- end generated part --- Block end #Hdr_NMIndNetOff#; do not delete this line! Add application code below this line.
  lBusContext = GetBusContext();
  //--- begin generated part --- Block start #Body_NMIndNetOff#; do not delete this line and do not add application code in this code block!
  /* #ChannelStart# |CAN1| #BusStart# |E3V_ABCANFD| */
  if (lBusContext == gNMCAN1_BusContext) NMCAN1_IndNetOff();
  /* #ChannelEnd# |CAN1| #BusEnd# |E3V_ABCANFD| */
  //--- end generated part --- Block end #Body_NMIndNetOff#; do not delete this line! Add application code below this line.
  SetBusContext(lBusContext);
}

void NMIndNetSDN()
{
  // Callback of NM-HIGH DLL
  dword lBusContext;
  //--- begin generated part --- Block start #Hdr_NMIndNetSDN#; do not delete this line and do not add application code in this code block!
  /* #ChannelStart# |CAN1| #BusStart# |E3V_ABCANFD| */
  /* #ChannelEnd# |CAN1| #BusEnd# |E3V_ABCANFD| */
  //--- end generated part --- Block end #Hdr_NMIndNetSDN#; do not delete this line! Add application code below this line.
  lBusContext = GetBusContext();
  //--- begin generated part --- Block start #Body_NMIndNetSDN#; do not delete this line and do not add application code in this code block!
  /* #ChannelStart# |CAN1| #BusStart# |E3V_ABCANFD| */
  if (lBusContext == gNMCAN1_BusContext) NMCAN1_IndNetSDN();
  /* #ChannelEnd# |CAN1| #BusEnd# |E3V_ABCANFD| */
  //--- end generated part --- Block end #Body_NMIndNetSDN#; do not delete this line! Add application code below this line.
  SetBusContext(lBusContext);
}

void NMIndStateChangeNotification(long previousState, long currentState)
{
  // Callback of NM-HIGH DLL
  dword lBusContext;
  //--- begin generated part --- Block start #Hdr_NMIndStateChangeNotification#; do not delete this line and do not add application code in this code block!
  /* #ChannelStart# |CAN1| #BusStart# |E3V_ABCANFD| */
  /* #ChannelEnd# |CAN1| #BusEnd# |E3V_ABCANFD| */
  //--- end generated part --- Block end #Hdr_NMIndStateChangeNotification#; do not delete this line! Add application code below this line.
  lBusContext = GetBusContext();
  //--- begin generated part --- Block start #Body_NMIndStateChangeNotification#; do not delete this line and do not add application code in this code block!
  /* #ChannelStart# |CAN1| #BusStart# |E3V_ABCANFD| */
  if (lBusContext == gNMCAN1_BusContext) NMCAN1_IndStateChangeNotification(previousState, currentState);
  /* #ChannelEnd# |CAN1| #BusEnd# |E3V_ABCANFD| */
  //--- end generated part --- Block end #Body_NMIndStateChangeNotification#; do not delete this line! Add application code below this line.
  SetBusContext(lBusContext);
}

//--- begin generated part --- Block start <#Helper_Functions#> do not delete this line and do not add application code in this code block!
/* #ChannelStart# |CAN1| #BusStart# |E3V_ABCANFD| */
/* #ChannelEnd# |CAN1| #BusEnd# |E3V_ABCANFD| */
//--- end generated part --- Block end <#Helper_Functions#> do not delete this line! Add application code below this line.

//--- begin generated part --- Block start <#SysVar_Handler#> do not delete this line and do not add application code in this code block!
/* #ChannelStart# |CAN1| #BusStart# |E3V_ABCANFD| */
on sysvar_update sysvar::IL_CAN1::EnableNode::ZR_MIB_TOP_ab_Gen3
{
  ILCAN1_Enable(@this && @sysvar::IL_CAN1::enable_AllNodes);
}

on sysvar_update sysvar::IL_CAN1::enable_AllNodes
{
  ILCAN1_Enable(@this && @sysvar::IL_CAN1::EnableNode::ZR_MIB_TOP_ab_Gen3);
}

on sysvar_update sysvar::NM_CAN1::ZR_MIB_TOP_ab_Gen3::DeactivateNM
{
  if( @this == 1 || @sysvar::NM_CAN1::StateControl::DeactivateNM == 1)
  {
    NMCAN1_Enable(0);
  }
  else
  {
    NMCAN1_Enable(1);
  }
}

on sysvar_update sysvar::NM_CAN1::StateControl::DeactivateNM
{
  if( @this == 1 || @sysvar::NM_CAN1::ZR_MIB_TOP_ab_Gen3::DeactivateNM == 1)
  {
    NMCAN1_Enable(0);
  }
  else
  {
    NMCAN1_Enable(1);
  }
}

on sysvar_update sysvar::IL_CAN1::Message_EnableCyclic::ZR_MIB_TOP_ab_Gen3_KN_Info_El
{
  if (@this == 1)
  {
    SetBusContext(gILCAN1_BusContext);
    ILFaultInjectionEnableMsg  (E3V_ABCANFD::KN_Info_El);
  }
  else
  {
    SetBusContext(gILCAN1_BusContext);
    ILFaultInjectionDisableMsg (E3V_ABCANFD::KN_Info_El);
  }
}

on sysvar_update sysvar::IL_CAN1::Message_SetNormalCycle::ZR_MIB_TOP_ab_Gen3_KN_Info_El
{
  if (@this == 1 && @sysvar::IL_CAN1::Message_EnableCyclic::ZR_MIB_TOP_ab_Gen3_KN_Info_El)
  {
    @sysvar::IL_CAN1::Message_SelectedPeriod::ZR_MIB_TOP_ab_Gen3_KN_Info_El = 0;
  }
}

on sysvar_update sysvar::IL_CAN1::Message_SetNewCycleContinously::ZR_MIB_TOP_ab_Gen3_KN_Info_El
{
  if (@this == 1 && @sysvar::IL_CAN1::Message_EnableCyclic::ZR_MIB_TOP_ab_Gen3_KN_Info_El)
  {
    @sysvar::IL_CAN1::Message_SelectedPeriod::ZR_MIB_TOP_ab_Gen3_KN_Info_El = -1;
  }
}

on sysvar_update sysvar::IL_CAN1::Message_SelectedPeriod::ZR_MIB_TOP_ab_Gen3_KN_Info_El
{
  if (@this == 0 && @sysvar::IL_CAN1::Message_EnableCyclic::ZR_MIB_TOP_ab_Gen3_KN_Info_El)
  {
    SetBusContext(gILCAN1_BusContext);
    gCAN1DisturbancePeriod = @sysvar::IL_CAN1::Message_NormalCyclePeriod::ZR_MIB_TOP_ab_Gen3_KN_Info_El;
    ILFaultInjectionResetMsgCycleTime(E3V_ABCANFD::KN_Info_El);
  }
  else if (@this == 1 && @sysvar::IL_CAN1::Message_EnableCyclic::ZR_MIB_TOP_ab_Gen3_KN_Info_El)
  {
    SetBusContext(gILCAN1_BusContext);
    gCAN1DisturbancePeriod = @sysvar::IL_CAN1::Message_ActiveCyclePeriod::ZR_MIB_TOP_ab_Gen3_KN_Info_El;
    ILFaultInjectionSetMsgCycleTime(E3V_ABCANFD::KN_Info_El, gCAN1DisturbancePeriod);
  }
  else if (@this == -1 && @sysvar::IL_CAN1::Message_EnableCyclic::ZR_MIB_TOP_ab_Gen3_KN_Info_El)
  {
    SetBusContext(gILCAN1_BusContext);
    gCAN1DisturbancePeriod = @sysvar::IL_CAN1::Message_CyclePeriod::ZR_MIB_TOP_ab_Gen3_KN_Info_El;
    ILFaultInjectionSetMsgCycleTime(E3V_ABCANFD::KN_Info_El, gCAN1DisturbancePeriod);
  }
}

on sysvar_update sysvar::IL_CAN1::Message_SendOnce::ZR_MIB_TOP_ab_Gen3_KN_Info_El
{
  if (@this == 1)
  {
    SetBusContext(gILCAN1_BusContext);
    ILSetMsgEvent(E3V_ABCANFD::KN_Info_El);
  }
}

on sysvar_update sysvar::IL_CAN1::Message_EnableCyclic::ZR_MIB_TOP_ab_Gen3_MainUnit_01
{
  if (@this == 1)
  {
    SetBusContext(gILCAN1_BusContext);
    ILFaultInjectionEnableMsg  (E3V_ABCANFD::MainUnit_01);
  }
  else
  {
    SetBusContext(gILCAN1_BusContext);
    ILFaultInjectionDisableMsg (E3V_ABCANFD::MainUnit_01);
  }
}

on sysvar_update sysvar::IL_CAN1::Message_SetNormalCycle::ZR_MIB_TOP_ab_Gen3_MainUnit_01
{
  if (@this == 1 && @sysvar::IL_CAN1::Message_EnableCyclic::ZR_MIB_TOP_ab_Gen3_MainUnit_01)
  {
    @sysvar::IL_CAN1::Message_SelectedPeriod::ZR_MIB_TOP_ab_Gen3_MainUnit_01 = 0;
  }
}

on sysvar_update sysvar::IL_CAN1::Message_SetNewCycleContinously::ZR_MIB_TOP_ab_Gen3_MainUnit_01
{
  if (@this == 1 && @sysvar::IL_CAN1::Message_EnableCyclic::ZR_MIB_TOP_ab_Gen3_MainUnit_01)
  {
    @sysvar::IL_CAN1::Message_SelectedPeriod::ZR_MIB_TOP_ab_Gen3_MainUnit_01 = -1;
  }
}

on sysvar_update sysvar::IL_CAN1::Message_SelectedPeriod::ZR_MIB_TOP_ab_Gen3_MainUnit_01
{
  if (@this == 0 && @sysvar::IL_CAN1::Message_EnableCyclic::ZR_MIB_TOP_ab_Gen3_MainUnit_01)
  {
    SetBusContext(gILCAN1_BusContext);
    gCAN1DisturbancePeriod = @sysvar::IL_CAN1::Message_NormalCyclePeriod::ZR_MIB_TOP_ab_Gen3_MainUnit_01;
    ILFaultInjectionResetMsgCycleTime(E3V_ABCANFD::MainUnit_01);
  }
  else if (@this == 1 && @sysvar::IL_CAN1::Message_EnableCyclic::ZR_MIB_TOP_ab_Gen3_MainUnit_01)
  {
    SetBusContext(gILCAN1_BusContext);
    gCAN1DisturbancePeriod = @sysvar::IL_CAN1::Message_ActiveCyclePeriod::ZR_MIB_TOP_ab_Gen3_MainUnit_01;
    ILFaultInjectionSetMsgCycleTime(E3V_ABCANFD::MainUnit_01, gCAN1DisturbancePeriod);
  }
  else if (@this == -1 && @sysvar::IL_CAN1::Message_EnableCyclic::ZR_MIB_TOP_ab_Gen3_MainUnit_01)
  {
    SetBusContext(gILCAN1_BusContext);
    gCAN1DisturbancePeriod = @sysvar::IL_CAN1::Message_CyclePeriod::ZR_MIB_TOP_ab_Gen3_MainUnit_01;
    ILFaultInjectionSetMsgCycleTime(E3V_ABCANFD::MainUnit_01, gCAN1DisturbancePeriod);
  }
}

on sysvar_update sysvar::IL_CAN1::Message_SendOnce::ZR_MIB_TOP_ab_Gen3_MainUnit_01
{
  if (@this == 1)
  {
    SetBusContext(gILCAN1_BusContext);
    ILSetMsgEvent(E3V_ABCANFD::MainUnit_01);
  }
}

on sysvar_update sysvar::IL_CAN1::Message_EnableCyclic::ZR_MIB_TOP_ab_Gen3_NavData_01
{
  if (@this == 1)
  {
    SetBusContext(gILCAN1_BusContext);
    ILFaultInjectionEnableMsg  (E3V_ABCANFD::NavData_01);
  }
  else
  {
    SetBusContext(gILCAN1_BusContext);
    ILFaultInjectionDisableMsg (E3V_ABCANFD::NavData_01);
  }
}

on sysvar_update sysvar::IL_CAN1::Message_SetNormalCycle::ZR_MIB_TOP_ab_Gen3_NavData_01
{
  if (@this == 1 && @sysvar::IL_CAN1::Message_EnableCyclic::ZR_MIB_TOP_ab_Gen3_NavData_01)
  {
    @sysvar::IL_CAN1::Message_SelectedPeriod::ZR_MIB_TOP_ab_Gen3_NavData_01 = 0;
  }
}

on sysvar_update sysvar::IL_CAN1::Message_SetNewCycleContinously::ZR_MIB_TOP_ab_Gen3_NavData_01
{
  if (@this == 1 && @sysvar::IL_CAN1::Message_EnableCyclic::ZR_MIB_TOP_ab_Gen3_NavData_01)
  {
    @sysvar::IL_CAN1::Message_SelectedPeriod::ZR_MIB_TOP_ab_Gen3_NavData_01 = -1;
  }
}

on sysvar_update sysvar::IL_CAN1::Message_SelectedPeriod::ZR_MIB_TOP_ab_Gen3_NavData_01
{
  if (@this == 0 && @sysvar::IL_CAN1::Message_EnableCyclic::ZR_MIB_TOP_ab_Gen3_NavData_01)
  {
    SetBusContext(gILCAN1_BusContext);
    gCAN1DisturbancePeriod = @sysvar::IL_CAN1::Message_NormalCyclePeriod::ZR_MIB_TOP_ab_Gen3_NavData_01;
    ILFaultInjectionResetMsgCycleTime(E3V_ABCANFD::NavData_01);
  }
  else if (@this == 1 && @sysvar::IL_CAN1::Message_EnableCyclic::ZR_MIB_TOP_ab_Gen3_NavData_01)
  {
    SetBusContext(gILCAN1_BusContext);
    gCAN1DisturbancePeriod = @sysvar::IL_CAN1::Message_ActiveCyclePeriod::ZR_MIB_TOP_ab_Gen3_NavData_01;
    ILFaultInjectionSetMsgCycleTime(E3V_ABCANFD::NavData_01, gCAN1DisturbancePeriod);
  }
  else if (@this == -1 && @sysvar::IL_CAN1::Message_EnableCyclic::ZR_MIB_TOP_ab_Gen3_NavData_01)
  {
    SetBusContext(gILCAN1_BusContext);
    gCAN1DisturbancePeriod = @sysvar::IL_CAN1::Message_CyclePeriod::ZR_MIB_TOP_ab_Gen3_NavData_01;
    ILFaultInjectionSetMsgCycleTime(E3V_ABCANFD::NavData_01, gCAN1DisturbancePeriod);
  }
}

on sysvar_update sysvar::IL_CAN1::Message_SendOnce::ZR_MIB_TOP_ab_Gen3_NavData_01
{
  if (@this == 1)
  {
    SetBusContext(gILCAN1_BusContext);
    ILSetMsgEvent(E3V_ABCANFD::NavData_01);
  }
}

on sysvar_update sysvar::IL_CAN1::Message_EnableCyclic::ZR_MIB_TOP_ab_Gen3_NavData_02
{
  if (@this == 1)
  {
    SetBusContext(gILCAN1_BusContext);
    ILFaultInjectionEnableMsg  (E3V_ABCANFD::NavData_02);
  }
  else
  {
    SetBusContext(gILCAN1_BusContext);
    ILFaultInjectionDisableMsg (E3V_ABCANFD::NavData_02);
  }
}

on sysvar_update sysvar::IL_CAN1::Message_SetNormalCycle::ZR_MIB_TOP_ab_Gen3_NavData_02
{
  if (@this == 1 && @sysvar::IL_CAN1::Message_EnableCyclic::ZR_MIB_TOP_ab_Gen3_NavData_02)
  {
    @sysvar::IL_CAN1::Message_SelectedPeriod::ZR_MIB_TOP_ab_Gen3_NavData_02 = 0;
  }
}

on sysvar_update sysvar::IL_CAN1::Message_SetNewCycleContinously::ZR_MIB_TOP_ab_Gen3_NavData_02
{
  if (@this == 1 && @sysvar::IL_CAN1::Message_EnableCyclic::ZR_MIB_TOP_ab_Gen3_NavData_02)
  {
    @sysvar::IL_CAN1::Message_SelectedPeriod::ZR_MIB_TOP_ab_Gen3_NavData_02 = -1;
  }
}

on sysvar_update sysvar::IL_CAN1::Message_SelectedPeriod::ZR_MIB_TOP_ab_Gen3_NavData_02
{
  if (@this == 0 && @sysvar::IL_CAN1::Message_EnableCyclic::ZR_MIB_TOP_ab_Gen3_NavData_02)
  {
    SetBusContext(gILCAN1_BusContext);
    gCAN1DisturbancePeriod = @sysvar::IL_CAN1::Message_NormalCyclePeriod::ZR_MIB_TOP_ab_Gen3_NavData_02;
    ILFaultInjectionResetMsgCycleTime(E3V_ABCANFD::NavData_02);
  }
  else if (@this == 1 && @sysvar::IL_CAN1::Message_EnableCyclic::ZR_MIB_TOP_ab_Gen3_NavData_02)
  {
    SetBusContext(gILCAN1_BusContext);
    gCAN1DisturbancePeriod = @sysvar::IL_CAN1::Message_ActiveCyclePeriod::ZR_MIB_TOP_ab_Gen3_NavData_02;
    ILFaultInjectionSetMsgCycleTime(E3V_ABCANFD::NavData_02, gCAN1DisturbancePeriod);
  }
  else if (@this == -1 && @sysvar::IL_CAN1::Message_EnableCyclic::ZR_MIB_TOP_ab_Gen3_NavData_02)
  {
    SetBusContext(gILCAN1_BusContext);
    gCAN1DisturbancePeriod = @sysvar::IL_CAN1::Message_CyclePeriod::ZR_MIB_TOP_ab_Gen3_NavData_02;
    ILFaultInjectionSetMsgCycleTime(E3V_ABCANFD::NavData_02, gCAN1DisturbancePeriod);
  }
}

on sysvar_update sysvar::IL_CAN1::Message_SendOnce::ZR_MIB_TOP_ab_Gen3_NavData_02
{
  if (@this == 1)
  {
    SetBusContext(gILCAN1_BusContext);
    ILSetMsgEvent(E3V_ABCANFD::NavData_02);
  }
}

on sysvar_update sysvar::IL_CAN1::Message_EnableCyclic::ZR_MIB_TOP_ab_Gen3_NavData_03
{
  if (@this == 1)
  {
    SetBusContext(gILCAN1_BusContext);
    ILFaultInjectionEnableMsg  (E3V_ABCANFD::NavData_03);
  }
  else
  {
    SetBusContext(gILCAN1_BusContext);
    ILFaultInjectionDisableMsg (E3V_ABCANFD::NavData_03);
  }
}

on sysvar_update sysvar::IL_CAN1::Message_SetNormalCycle::ZR_MIB_TOP_ab_Gen3_NavData_03
{
  if (@this == 1 && @sysvar::IL_CAN1::Message_EnableCyclic::ZR_MIB_TOP_ab_Gen3_NavData_03)
  {
    @sysvar::IL_CAN1::Message_SelectedPeriod::ZR_MIB_TOP_ab_Gen3_NavData_03 = 0;
  }
}

on sysvar_update sysvar::IL_CAN1::Message_SetNewCycleContinously::ZR_MIB_TOP_ab_Gen3_NavData_03
{
  if (@this == 1 && @sysvar::IL_CAN1::Message_EnableCyclic::ZR_MIB_TOP_ab_Gen3_NavData_03)
  {
    @sysvar::IL_CAN1::Message_SelectedPeriod::ZR_MIB_TOP_ab_Gen3_NavData_03 = -1;
  }
}

on sysvar_update sysvar::IL_CAN1::Message_SelectedPeriod::ZR_MIB_TOP_ab_Gen3_NavData_03
{
  if (@this == 0 && @sysvar::IL_CAN1::Message_EnableCyclic::ZR_MIB_TOP_ab_Gen3_NavData_03)
  {
    SetBusContext(gILCAN1_BusContext);
    gCAN1DisturbancePeriod = @sysvar::IL_CAN1::Message_NormalCyclePeriod::ZR_MIB_TOP_ab_Gen3_NavData_03;
    ILFaultInjectionResetMsgCycleTime(E3V_ABCANFD::NavData_03);
  }
  else if (@this == 1 && @sysvar::IL_CAN1::Message_EnableCyclic::ZR_MIB_TOP_ab_Gen3_NavData_03)
  {
    SetBusContext(gILCAN1_BusContext);
    gCAN1DisturbancePeriod = @sysvar::IL_CAN1::Message_ActiveCyclePeriod::ZR_MIB_TOP_ab_Gen3_NavData_03;
    ILFaultInjectionSetMsgCycleTime(E3V_ABCANFD::NavData_03, gCAN1DisturbancePeriod);
  }
  else if (@this == -1 && @sysvar::IL_CAN1::Message_EnableCyclic::ZR_MIB_TOP_ab_Gen3_NavData_03)
  {
    SetBusContext(gILCAN1_BusContext);
    gCAN1DisturbancePeriod = @sysvar::IL_CAN1::Message_CyclePeriod::ZR_MIB_TOP_ab_Gen3_NavData_03;
    ILFaultInjectionSetMsgCycleTime(E3V_ABCANFD::NavData_03, gCAN1DisturbancePeriod);
  }
}

on sysvar_update sysvar::IL_CAN1::Message_SendOnce::ZR_MIB_TOP_ab_Gen3_NavData_03
{
  if (@this == 1)
  {
    SetBusContext(gILCAN1_BusContext);
    ILSetMsgEvent(E3V_ABCANFD::NavData_03);
  }
}

on sysvar_update sysvar::IL_CAN1::Message_EnableCyclic::ZR_MIB_TOP_ab_Gen3_NavData_04
{
  if (@this == 1)
  {
    SetBusContext(gILCAN1_BusContext);
    ILFaultInjectionEnableMsg  (E3V_ABCANFD::NavData_04);
  }
  else
  {
    SetBusContext(gILCAN1_BusContext);
    ILFaultInjectionDisableMsg (E3V_ABCANFD::NavData_04);
  }
}

on sysvar_update sysvar::IL_CAN1::Message_SetNormalCycle::ZR_MIB_TOP_ab_Gen3_NavData_04
{
  if (@this == 1 && @sysvar::IL_CAN1::Message_EnableCyclic::ZR_MIB_TOP_ab_Gen3_NavData_04)
  {
    @sysvar::IL_CAN1::Message_SelectedPeriod::ZR_MIB_TOP_ab_Gen3_NavData_04 = 0;
  }
}

on sysvar_update sysvar::IL_CAN1::Message_SetNewCycleContinously::ZR_MIB_TOP_ab_Gen3_NavData_04
{
  if (@this == 1 && @sysvar::IL_CAN1::Message_EnableCyclic::ZR_MIB_TOP_ab_Gen3_NavData_04)
  {
    @sysvar::IL_CAN1::Message_SelectedPeriod::ZR_MIB_TOP_ab_Gen3_NavData_04 = -1;
  }
}

on sysvar_update sysvar::IL_CAN1::Message_SelectedPeriod::ZR_MIB_TOP_ab_Gen3_NavData_04
{
  if (@this == 0 && @sysvar::IL_CAN1::Message_EnableCyclic::ZR_MIB_TOP_ab_Gen3_NavData_04)
  {
    SetBusContext(gILCAN1_BusContext);
    gCAN1DisturbancePeriod = @sysvar::IL_CAN1::Message_NormalCyclePeriod::ZR_MIB_TOP_ab_Gen3_NavData_04;
    ILFaultInjectionResetMsgCycleTime(E3V_ABCANFD::NavData_04);
  }
  else if (@this == 1 && @sysvar::IL_CAN1::Message_EnableCyclic::ZR_MIB_TOP_ab_Gen3_NavData_04)
  {
    SetBusContext(gILCAN1_BusContext);
    gCAN1DisturbancePeriod = @sysvar::IL_CAN1::Message_ActiveCyclePeriod::ZR_MIB_TOP_ab_Gen3_NavData_04;
    ILFaultInjectionSetMsgCycleTime(E3V_ABCANFD::NavData_04, gCAN1DisturbancePeriod);
  }
  else if (@this == -1 && @sysvar::IL_CAN1::Message_EnableCyclic::ZR_MIB_TOP_ab_Gen3_NavData_04)
  {
    SetBusContext(gILCAN1_BusContext);
    gCAN1DisturbancePeriod = @sysvar::IL_CAN1::Message_CyclePeriod::ZR_MIB_TOP_ab_Gen3_NavData_04;
    ILFaultInjectionSetMsgCycleTime(E3V_ABCANFD::NavData_04, gCAN1DisturbancePeriod);
  }
}

on sysvar_update sysvar::IL_CAN1::Message_SendOnce::ZR_MIB_TOP_ab_Gen3_NavData_04
{
  if (@this == 1)
  {
    SetBusContext(gILCAN1_BusContext);
    ILSetMsgEvent(E3V_ABCANFD::NavData_04);
  }
}

on sysvar_update sysvar::IL_CAN1::Message_EnableCyclic::ZR_MIB_TOP_ab_Gen3_NavPos_01
{
  if (@this == 1)
  {
    SetBusContext(gILCAN1_BusContext);
    ILFaultInjectionEnableMsg  (E3V_ABCANFD::NavPos_01);
  }
  else
  {
    SetBusContext(gILCAN1_BusContext);
    ILFaultInjectionDisableMsg (E3V_ABCANFD::NavPos_01);
  }
}

on sysvar_update sysvar::IL_CAN1::Message_SetNormalCycle::ZR_MIB_TOP_ab_Gen3_NavPos_01
{
  if (@this == 1 && @sysvar::IL_CAN1::Message_EnableCyclic::ZR_MIB_TOP_ab_Gen3_NavPos_01)
  {
    @sysvar::IL_CAN1::Message_SelectedPeriod::ZR_MIB_TOP_ab_Gen3_NavPos_01 = 0;
  }
}

on sysvar_update sysvar::IL_CAN1::Message_SetNewCycleContinously::ZR_MIB_TOP_ab_Gen3_NavPos_01
{
  if (@this == 1 && @sysvar::IL_CAN1::Message_EnableCyclic::ZR_MIB_TOP_ab_Gen3_NavPos_01)
  {
    @sysvar::IL_CAN1::Message_SelectedPeriod::ZR_MIB_TOP_ab_Gen3_NavPos_01 = -1;
  }
}

on sysvar_update sysvar::IL_CAN1::Message_SelectedPeriod::ZR_MIB_TOP_ab_Gen3_NavPos_01
{
  if (@this == 0 && @sysvar::IL_CAN1::Message_EnableCyclic::ZR_MIB_TOP_ab_Gen3_NavPos_01)
  {
    SetBusContext(gILCAN1_BusContext);
    gCAN1DisturbancePeriod = @sysvar::IL_CAN1::Message_NormalCyclePeriod::ZR_MIB_TOP_ab_Gen3_NavPos_01;
    ILFaultInjectionResetMsgCycleTime(E3V_ABCANFD::NavPos_01);
  }
  else if (@this == 1 && @sysvar::IL_CAN1::Message_EnableCyclic::ZR_MIB_TOP_ab_Gen3_NavPos_01)
  {
    SetBusContext(gILCAN1_BusContext);
    gCAN1DisturbancePeriod = @sysvar::IL_CAN1::Message_ActiveCyclePeriod::ZR_MIB_TOP_ab_Gen3_NavPos_01;
    ILFaultInjectionSetMsgCycleTime(E3V_ABCANFD::NavPos_01, gCAN1DisturbancePeriod);
  }
  else if (@this == -1 && @sysvar::IL_CAN1::Message_EnableCyclic::ZR_MIB_TOP_ab_Gen3_NavPos_01)
  {
    SetBusContext(gILCAN1_BusContext);
    gCAN1DisturbancePeriod = @sysvar::IL_CAN1::Message_CyclePeriod::ZR_MIB_TOP_ab_Gen3_NavPos_01;
    ILFaultInjectionSetMsgCycleTime(E3V_ABCANFD::NavPos_01, gCAN1DisturbancePeriod);
  }
}

on sysvar_update sysvar::IL_CAN1::Message_SendOnce::ZR_MIB_TOP_ab_Gen3_NavPos_01
{
  if (@this == 1)
  {
    SetBusContext(gILCAN1_BusContext);
    ILSetMsgEvent(E3V_ABCANFD::NavPos_01);
  }
}

on sysvar_update sysvar::IL_CAN1::Message_EnableCyclic::ZR_MIB_TOP_ab_Gen3_NavPos_02_Map_Matched
{
  if (@this == 1)
  {
    SetBusContext(gILCAN1_BusContext);
    ILFaultInjectionEnableMsg  (E3V_ABCANFD::NavPos_02_Map_Matched);
  }
  else
  {
    SetBusContext(gILCAN1_BusContext);
    ILFaultInjectionDisableMsg (E3V_ABCANFD::NavPos_02_Map_Matched);
  }
}

on sysvar_update sysvar::IL_CAN1::Message_SetNormalCycle::ZR_MIB_TOP_ab_Gen3_NavPos_02_Map_Matched
{
  if (@this == 1 && @sysvar::IL_CAN1::Message_EnableCyclic::ZR_MIB_TOP_ab_Gen3_NavPos_02_Map_Matched)
  {
    @sysvar::IL_CAN1::Message_SelectedPeriod::ZR_MIB_TOP_ab_Gen3_NavPos_02_Map_Matched = 0;
  }
}

on sysvar_update sysvar::IL_CAN1::Message_SetNewCycleContinously::ZR_MIB_TOP_ab_Gen3_NavPos_02_Map_Matched
{
  if (@this == 1 && @sysvar::IL_CAN1::Message_EnableCyclic::ZR_MIB_TOP_ab_Gen3_NavPos_02_Map_Matched)
  {
    @sysvar::IL_CAN1::Message_SelectedPeriod::ZR_MIB_TOP_ab_Gen3_NavPos_02_Map_Matched = -1;
  }
}

on sysvar_update sysvar::IL_CAN1::Message_SelectedPeriod::ZR_MIB_TOP_ab_Gen3_NavPos_02_Map_Matched
{
  if (@this == 0 && @sysvar::IL_CAN1::Message_EnableCyclic::ZR_MIB_TOP_ab_Gen3_NavPos_02_Map_Matched)
  {
    SetBusContext(gILCAN1_BusContext);
    gCAN1DisturbancePeriod = @sysvar::IL_CAN1::Message_NormalCyclePeriod::ZR_MIB_TOP_ab_Gen3_NavPos_02_Map_Matched;
    ILFaultInjectionResetMsgCycleTime(E3V_ABCANFD::NavPos_02_Map_Matched);
  }
  else if (@this == 1 && @sysvar::IL_CAN1::Message_EnableCyclic::ZR_MIB_TOP_ab_Gen3_NavPos_02_Map_Matched)
  {
    SetBusContext(gILCAN1_BusContext);
    gCAN1DisturbancePeriod = @sysvar::IL_CAN1::Message_ActiveCyclePeriod::ZR_MIB_TOP_ab_Gen3_NavPos_02_Map_Matched;
    ILFaultInjectionSetMsgCycleTime(E3V_ABCANFD::NavPos_02_Map_Matched, gCAN1DisturbancePeriod);
  }
  else if (@this == -1 && @sysvar::IL_CAN1::Message_EnableCyclic::ZR_MIB_TOP_ab_Gen3_NavPos_02_Map_Matched)
  {
    SetBusContext(gILCAN1_BusContext);
    gCAN1DisturbancePeriod = @sysvar::IL_CAN1::Message_CyclePeriod::ZR_MIB_TOP_ab_Gen3_NavPos_02_Map_Matched;
    ILFaultInjectionSetMsgCycleTime(E3V_ABCANFD::NavPos_02_Map_Matched, gCAN1DisturbancePeriod);
  }
}

on sysvar_update sysvar::IL_CAN1::Message_SendOnce::ZR_MIB_TOP_ab_Gen3_NavPos_02_Map_Matched
{
  if (@this == 1)
  {
    SetBusContext(gILCAN1_BusContext);
    ILSetMsgEvent(E3V_ABCANFD::NavPos_02_Map_Matched);
  }
}

on sysvar_update sysvar::IL_CAN1::Message_EnableCyclic::ZR_MIB_TOP_ab_Gen3_PSD_04
{
  if (@this == 1)
  {
    SetBusContext(gILCAN1_BusContext);
    ILFaultInjectionEnableMsg  (E3V_ABCANFD::PSD_04);
  }
  else
  {
    SetBusContext(gILCAN1_BusContext);
    ILFaultInjectionDisableMsg (E3V_ABCANFD::PSD_04);
  }
}

on sysvar_update sysvar::IL_CAN1::Message_SetNormalCycle::ZR_MIB_TOP_ab_Gen3_PSD_04
{
  if (@this == 1 && @sysvar::IL_CAN1::Message_EnableCyclic::ZR_MIB_TOP_ab_Gen3_PSD_04)
  {
    @sysvar::IL_CAN1::Message_SelectedPeriod::ZR_MIB_TOP_ab_Gen3_PSD_04 = 0;
  }
}

on sysvar_update sysvar::IL_CAN1::Message_SetNewCycleContinously::ZR_MIB_TOP_ab_Gen3_PSD_04
{
  if (@this == 1 && @sysvar::IL_CAN1::Message_EnableCyclic::ZR_MIB_TOP_ab_Gen3_PSD_04)
  {
    @sysvar::IL_CAN1::Message_SelectedPeriod::ZR_MIB_TOP_ab_Gen3_PSD_04 = -1;
  }
}

on sysvar_update sysvar::IL_CAN1::Message_SelectedPeriod::ZR_MIB_TOP_ab_Gen3_PSD_04
{
  if (@this == 0 && @sysvar::IL_CAN1::Message_EnableCyclic::ZR_MIB_TOP_ab_Gen3_PSD_04)
  {
    SetBusContext(gILCAN1_BusContext);
    gCAN1DisturbancePeriod = @sysvar::IL_CAN1::Message_NormalCyclePeriod::ZR_MIB_TOP_ab_Gen3_PSD_04;
    ILFaultInjectionResetMsgCycleTime(E3V_ABCANFD::PSD_04);
  }
  else if (@this == 1 && @sysvar::IL_CAN1::Message_EnableCyclic::ZR_MIB_TOP_ab_Gen3_PSD_04)
  {
    SetBusContext(gILCAN1_BusContext);
    gCAN1DisturbancePeriod = @sysvar::IL_CAN1::Message_ActiveCyclePeriod::ZR_MIB_TOP_ab_Gen3_PSD_04;
    ILFaultInjectionSetMsgCycleTime(E3V_ABCANFD::PSD_04, gCAN1DisturbancePeriod);
  }
  else if (@this == -1 && @sysvar::IL_CAN1::Message_EnableCyclic::ZR_MIB_TOP_ab_Gen3_PSD_04)
  {
    SetBusContext(gILCAN1_BusContext);
    gCAN1DisturbancePeriod = @sysvar::IL_CAN1::Message_CyclePeriod::ZR_MIB_TOP_ab_Gen3_PSD_04;
    ILFaultInjectionSetMsgCycleTime(E3V_ABCANFD::PSD_04, gCAN1DisturbancePeriod);
  }
}

on sysvar_update sysvar::IL_CAN1::Message_SendOnce::ZR_MIB_TOP_ab_Gen3_PSD_04
{
  if (@this == 1)
  {
    SetBusContext(gILCAN1_BusContext);
    ILSetMsgEvent(E3V_ABCANFD::PSD_04);
  }
}

on sysvar_update sysvar::IL_CAN1::Message_EnableCyclic::ZR_MIB_TOP_ab_Gen3_PSD_05
{
  if (@this == 1)
  {
    SetBusContext(gILCAN1_BusContext);
    ILFaultInjectionEnableMsg  (E3V_ABCANFD::PSD_05);
  }
  else
  {
    SetBusContext(gILCAN1_BusContext);
    ILFaultInjectionDisableMsg (E3V_ABCANFD::PSD_05);
  }
}

on sysvar_update sysvar::IL_CAN1::Message_SetNormalCycle::ZR_MIB_TOP_ab_Gen3_PSD_05
{
  if (@this == 1 && @sysvar::IL_CAN1::Message_EnableCyclic::ZR_MIB_TOP_ab_Gen3_PSD_05)
  {
    @sysvar::IL_CAN1::Message_SelectedPeriod::ZR_MIB_TOP_ab_Gen3_PSD_05 = 0;
  }
}

on sysvar_update sysvar::IL_CAN1::Message_SetNewCycleContinously::ZR_MIB_TOP_ab_Gen3_PSD_05
{
  if (@this == 1 && @sysvar::IL_CAN1::Message_EnableCyclic::ZR_MIB_TOP_ab_Gen3_PSD_05)
  {
    @sysvar::IL_CAN1::Message_SelectedPeriod::ZR_MIB_TOP_ab_Gen3_PSD_05 = -1;
  }
}

on sysvar_update sysvar::IL_CAN1::Message_SelectedPeriod::ZR_MIB_TOP_ab_Gen3_PSD_05
{
  if (@this == 0 && @sysvar::IL_CAN1::Message_EnableCyclic::ZR_MIB_TOP_ab_Gen3_PSD_05)
  {
    SetBusContext(gILCAN1_BusContext);
    gCAN1DisturbancePeriod = @sysvar::IL_CAN1::Message_NormalCyclePeriod::ZR_MIB_TOP_ab_Gen3_PSD_05;
    ILFaultInjectionResetMsgCycleTime(E3V_ABCANFD::PSD_05);
  }
  else if (@this == 1 && @sysvar::IL_CAN1::Message_EnableCyclic::ZR_MIB_TOP_ab_Gen3_PSD_05)
  {
    SetBusContext(gILCAN1_BusContext);
    gCAN1DisturbancePeriod = @sysvar::IL_CAN1::Message_ActiveCyclePeriod::ZR_MIB_TOP_ab_Gen3_PSD_05;
    ILFaultInjectionSetMsgCycleTime(E3V_ABCANFD::PSD_05, gCAN1DisturbancePeriod);
  }
  else if (@this == -1 && @sysvar::IL_CAN1::Message_EnableCyclic::ZR_MIB_TOP_ab_Gen3_PSD_05)
  {
    SetBusContext(gILCAN1_BusContext);
    gCAN1DisturbancePeriod = @sysvar::IL_CAN1::Message_CyclePeriod::ZR_MIB_TOP_ab_Gen3_PSD_05;
    ILFaultInjectionSetMsgCycleTime(E3V_ABCANFD::PSD_05, gCAN1DisturbancePeriod);
  }
}

on sysvar_update sysvar::IL_CAN1::Message_SendOnce::ZR_MIB_TOP_ab_Gen3_PSD_05
{
  if (@this == 1)
  {
    SetBusContext(gILCAN1_BusContext);
    ILSetMsgEvent(E3V_ABCANFD::PSD_05);
  }
}

on sysvar_update sysvar::IL_CAN1::Message_EnableCyclic::ZR_MIB_TOP_ab_Gen3_PSD_06
{
  if (@this == 1)
  {
    SetBusContext(gILCAN1_BusContext);
    ILFaultInjectionEnableMsg  (E3V_ABCANFD::PSD_06);
  }
  else
  {
    SetBusContext(gILCAN1_BusContext);
    ILFaultInjectionDisableMsg (E3V_ABCANFD::PSD_06);
  }
}

on sysvar_update sysvar::IL_CAN1::Message_SetNormalCycle::ZR_MIB_TOP_ab_Gen3_PSD_06
{
  if (@this == 1 && @sysvar::IL_CAN1::Message_EnableCyclic::ZR_MIB_TOP_ab_Gen3_PSD_06)
  {
    @sysvar::IL_CAN1::Message_SelectedPeriod::ZR_MIB_TOP_ab_Gen3_PSD_06 = 0;
  }
}

on sysvar_update sysvar::IL_CAN1::Message_SetNewCycleContinously::ZR_MIB_TOP_ab_Gen3_PSD_06
{
  if (@this == 1 && @sysvar::IL_CAN1::Message_EnableCyclic::ZR_MIB_TOP_ab_Gen3_PSD_06)
  {
    @sysvar::IL_CAN1::Message_SelectedPeriod::ZR_MIB_TOP_ab_Gen3_PSD_06 = -1;
  }
}

on sysvar_update sysvar::IL_CAN1::Message_SelectedPeriod::ZR_MIB_TOP_ab_Gen3_PSD_06
{
  if (@this == 0 && @sysvar::IL_CAN1::Message_EnableCyclic::ZR_MIB_TOP_ab_Gen3_PSD_06)
  {
    SetBusContext(gILCAN1_BusContext);
    gCAN1DisturbancePeriod = @sysvar::IL_CAN1::Message_NormalCyclePeriod::ZR_MIB_TOP_ab_Gen3_PSD_06;
    ILFaultInjectionResetMsgCycleTime(E3V_ABCANFD::PSD_06);
  }
  else if (@this == 1 && @sysvar::IL_CAN1::Message_EnableCyclic::ZR_MIB_TOP_ab_Gen3_PSD_06)
  {
    SetBusContext(gILCAN1_BusContext);
    gCAN1DisturbancePeriod = @sysvar::IL_CAN1::Message_ActiveCyclePeriod::ZR_MIB_TOP_ab_Gen3_PSD_06;
    ILFaultInjectionSetMsgCycleTime(E3V_ABCANFD::PSD_06, gCAN1DisturbancePeriod);
  }
  else if (@this == -1 && @sysvar::IL_CAN1::Message_EnableCyclic::ZR_MIB_TOP_ab_Gen3_PSD_06)
  {
    SetBusContext(gILCAN1_BusContext);
    gCAN1DisturbancePeriod = @sysvar::IL_CAN1::Message_CyclePeriod::ZR_MIB_TOP_ab_Gen3_PSD_06;
    ILFaultInjectionSetMsgCycleTime(E3V_ABCANFD::PSD_06, gCAN1DisturbancePeriod);
  }
}

on sysvar_update sysvar::IL_CAN1::Message_SendOnce::ZR_MIB_TOP_ab_Gen3_PSD_06
{
  if (@this == 1)
  {
    SetBusContext(gILCAN1_BusContext);
    ILSetMsgEvent(E3V_ABCANFD::PSD_06);
  }
}

on sysvar_update sysvar::IL_CAN1::Message_EnableCyclic::ZR_MIB_TOP_ab_Gen3_PSD_LR_01
{
  if (@this == 1)
  {
    SetBusContext(gILCAN1_BusContext);
    ILFaultInjectionEnableMsg  (E3V_ABCANFD::PSD_LR_01);
  }
  else
  {
    SetBusContext(gILCAN1_BusContext);
    ILFaultInjectionDisableMsg (E3V_ABCANFD::PSD_LR_01);
  }
}

on sysvar_update sysvar::IL_CAN1::Message_SetNormalCycle::ZR_MIB_TOP_ab_Gen3_PSD_LR_01
{
  if (@this == 1 && @sysvar::IL_CAN1::Message_EnableCyclic::ZR_MIB_TOP_ab_Gen3_PSD_LR_01)
  {
    @sysvar::IL_CAN1::Message_SelectedPeriod::ZR_MIB_TOP_ab_Gen3_PSD_LR_01 = 0;
  }
}

on sysvar_update sysvar::IL_CAN1::Message_SetNewCycleContinously::ZR_MIB_TOP_ab_Gen3_PSD_LR_01
{
  if (@this == 1 && @sysvar::IL_CAN1::Message_EnableCyclic::ZR_MIB_TOP_ab_Gen3_PSD_LR_01)
  {
    @sysvar::IL_CAN1::Message_SelectedPeriod::ZR_MIB_TOP_ab_Gen3_PSD_LR_01 = -1;
  }
}

on sysvar_update sysvar::IL_CAN1::Message_SelectedPeriod::ZR_MIB_TOP_ab_Gen3_PSD_LR_01
{
  if (@this == 0 && @sysvar::IL_CAN1::Message_EnableCyclic::ZR_MIB_TOP_ab_Gen3_PSD_LR_01)
  {
    SetBusContext(gILCAN1_BusContext);
    gCAN1DisturbancePeriod = @sysvar::IL_CAN1::Message_NormalCyclePeriod::ZR_MIB_TOP_ab_Gen3_PSD_LR_01;
    ILFaultInjectionResetMsgCycleTime(E3V_ABCANFD::PSD_LR_01);
  }
  else if (@this == 1 && @sysvar::IL_CAN1::Message_EnableCyclic::ZR_MIB_TOP_ab_Gen3_PSD_LR_01)
  {
    SetBusContext(gILCAN1_BusContext);
    gCAN1DisturbancePeriod = @sysvar::IL_CAN1::Message_ActiveCyclePeriod::ZR_MIB_TOP_ab_Gen3_PSD_LR_01;
    ILFaultInjectionSetMsgCycleTime(E3V_ABCANFD::PSD_LR_01, gCAN1DisturbancePeriod);
  }
  else if (@this == -1 && @sysvar::IL_CAN1::Message_EnableCyclic::ZR_MIB_TOP_ab_Gen3_PSD_LR_01)
  {
    SetBusContext(gILCAN1_BusContext);
    gCAN1DisturbancePeriod = @sysvar::IL_CAN1::Message_CyclePeriod::ZR_MIB_TOP_ab_Gen3_PSD_LR_01;
    ILFaultInjectionSetMsgCycleTime(E3V_ABCANFD::PSD_LR_01, gCAN1DisturbancePeriod);
  }
}

on sysvar_update sysvar::IL_CAN1::Message_SendOnce::ZR_MIB_TOP_ab_Gen3_PSD_LR_01
{
  if (@this == 1)
  {
    SetBusContext(gILCAN1_BusContext);
    ILSetMsgEvent(E3V_ABCANFD::PSD_LR_01);
  }
}

on sysvar_update sysvar::IL_CAN1::Message_EnableCyclic::ZR_MIB_TOP_ab_Gen3_Radio_01
{
  if (@this == 1)
  {
    SetBusContext(gILCAN1_BusContext);
    ILFaultInjectionEnableMsg  (E3V_ABCANFD::Radio_01);
  }
  else
  {
    SetBusContext(gILCAN1_BusContext);
    ILFaultInjectionDisableMsg (E3V_ABCANFD::Radio_01);
  }
}

on sysvar_update sysvar::IL_CAN1::Message_SetNormalCycle::ZR_MIB_TOP_ab_Gen3_Radio_01
{
  if (@this == 1 && @sysvar::IL_CAN1::Message_EnableCyclic::ZR_MIB_TOP_ab_Gen3_Radio_01)
  {
    @sysvar::IL_CAN1::Message_SelectedPeriod::ZR_MIB_TOP_ab_Gen3_Radio_01 = 0;
  }
}

on sysvar_update sysvar::IL_CAN1::Message_SetNewCycleContinously::ZR_MIB_TOP_ab_Gen3_Radio_01
{
  if (@this == 1 && @sysvar::IL_CAN1::Message_EnableCyclic::ZR_MIB_TOP_ab_Gen3_Radio_01)
  {
    @sysvar::IL_CAN1::Message_SelectedPeriod::ZR_MIB_TOP_ab_Gen3_Radio_01 = -1;
  }
}

on sysvar_update sysvar::IL_CAN1::Message_SelectedPeriod::ZR_MIB_TOP_ab_Gen3_Radio_01
{
  if (@this == 0 && @sysvar::IL_CAN1::Message_EnableCyclic::ZR_MIB_TOP_ab_Gen3_Radio_01)
  {
    SetBusContext(gILCAN1_BusContext);
    gCAN1DisturbancePeriod = @sysvar::IL_CAN1::Message_NormalCyclePeriod::ZR_MIB_TOP_ab_Gen3_Radio_01;
    ILFaultInjectionResetMsgCycleTime(E3V_ABCANFD::Radio_01);
  }
  else if (@this == 1 && @sysvar::IL_CAN1::Message_EnableCyclic::ZR_MIB_TOP_ab_Gen3_Radio_01)
  {
    SetBusContext(gILCAN1_BusContext);
    gCAN1DisturbancePeriod = @sysvar::IL_CAN1::Message_ActiveCyclePeriod::ZR_MIB_TOP_ab_Gen3_Radio_01;
    ILFaultInjectionSetMsgCycleTime(E3V_ABCANFD::Radio_01, gCAN1DisturbancePeriod);
  }
  else if (@this == -1 && @sysvar::IL_CAN1::Message_EnableCyclic::ZR_MIB_TOP_ab_Gen3_Radio_01)
  {
    SetBusContext(gILCAN1_BusContext);
    gCAN1DisturbancePeriod = @sysvar::IL_CAN1::Message_CyclePeriod::ZR_MIB_TOP_ab_Gen3_Radio_01;
    ILFaultInjectionSetMsgCycleTime(E3V_ABCANFD::Radio_01, gCAN1DisturbancePeriod);
  }
}

on sysvar_update sysvar::IL_CAN1::Message_SendOnce::ZR_MIB_TOP_ab_Gen3_Radio_01
{
  if (@this == 1)
  {
    SetBusContext(gILCAN1_BusContext);
    ILSetMsgEvent(E3V_ABCANFD::Radio_01);
  }
}

on sysvar_update sysvar::IL_CAN1::Message_EnableCyclic::ZR_MIB_TOP_ab_Gen3_WLC1_01
{
  if (@this == 1)
  {
    SetBusContext(gILCAN1_BusContext);
    ILFaultInjectionEnableMsg  (E3V_ABCANFD::WLC1_01);
  }
  else
  {
    SetBusContext(gILCAN1_BusContext);
    ILFaultInjectionDisableMsg (E3V_ABCANFD::WLC1_01);
  }
}

on sysvar_update sysvar::IL_CAN1::Message_SetNormalCycle::ZR_MIB_TOP_ab_Gen3_WLC1_01
{
  if (@this == 1 && @sysvar::IL_CAN1::Message_EnableCyclic::ZR_MIB_TOP_ab_Gen3_WLC1_01)
  {
    @sysvar::IL_CAN1::Message_SelectedPeriod::ZR_MIB_TOP_ab_Gen3_WLC1_01 = 0;
  }
}

on sysvar_update sysvar::IL_CAN1::Message_SetNewCycleContinously::ZR_MIB_TOP_ab_Gen3_WLC1_01
{
  if (@this == 1 && @sysvar::IL_CAN1::Message_EnableCyclic::ZR_MIB_TOP_ab_Gen3_WLC1_01)
  {
    @sysvar::IL_CAN1::Message_SelectedPeriod::ZR_MIB_TOP_ab_Gen3_WLC1_01 = -1;
  }
}

on sysvar_update sysvar::IL_CAN1::Message_SelectedPeriod::ZR_MIB_TOP_ab_Gen3_WLC1_01
{
  if (@this == 0 && @sysvar::IL_CAN1::Message_EnableCyclic::ZR_MIB_TOP_ab_Gen3_WLC1_01)
  {
    SetBusContext(gILCAN1_BusContext);
    gCAN1DisturbancePeriod = @sysvar::IL_CAN1::Message_NormalCyclePeriod::ZR_MIB_TOP_ab_Gen3_WLC1_01;
    ILFaultInjectionResetMsgCycleTime(E3V_ABCANFD::WLC1_01);
  }
  else if (@this == 1 && @sysvar::IL_CAN1::Message_EnableCyclic::ZR_MIB_TOP_ab_Gen3_WLC1_01)
  {
    SetBusContext(gILCAN1_BusContext);
    gCAN1DisturbancePeriod = @sysvar::IL_CAN1::Message_ActiveCyclePeriod::ZR_MIB_TOP_ab_Gen3_WLC1_01;
    ILFaultInjectionSetMsgCycleTime(E3V_ABCANFD::WLC1_01, gCAN1DisturbancePeriod);
  }
  else if (@this == -1 && @sysvar::IL_CAN1::Message_EnableCyclic::ZR_MIB_TOP_ab_Gen3_WLC1_01)
  {
    SetBusContext(gILCAN1_BusContext);
    gCAN1DisturbancePeriod = @sysvar::IL_CAN1::Message_CyclePeriod::ZR_MIB_TOP_ab_Gen3_WLC1_01;
    ILFaultInjectionSetMsgCycleTime(E3V_ABCANFD::WLC1_01, gCAN1DisturbancePeriod);
  }
}

on sysvar_update sysvar::IL_CAN1::Message_SendOnce::ZR_MIB_TOP_ab_Gen3_WLC1_01
{
  if (@this == 1)
  {
    SetBusContext(gILCAN1_BusContext);
    ILSetMsgEvent(E3V_ABCANFD::WLC1_01);
  }
}

on sysvar_update sysvar::IL_CAN1::Message_EnableCyclic::ZR_MIB_TOP_ab_Gen3_Zentralrechner_01
{
  if (@this == 1)
  {
    SetBusContext(gILCAN1_BusContext);
    ILFaultInjectionEnableMsg  (E3V_ABCANFD::Zentralrechner_01);
  }
  else
  {
    SetBusContext(gILCAN1_BusContext);
    ILFaultInjectionDisableMsg (E3V_ABCANFD::Zentralrechner_01);
  }
}

on sysvar_update sysvar::IL_CAN1::Message_SetNormalCycle::ZR_MIB_TOP_ab_Gen3_Zentralrechner_01
{
  if (@this == 1 && @sysvar::IL_CAN1::Message_EnableCyclic::ZR_MIB_TOP_ab_Gen3_Zentralrechner_01)
  {
    @sysvar::IL_CAN1::Message_SelectedPeriod::ZR_MIB_TOP_ab_Gen3_Zentralrechner_01 = 0;
  }
}

on sysvar_update sysvar::IL_CAN1::Message_SetNewCycleContinously::ZR_MIB_TOP_ab_Gen3_Zentralrechner_01
{
  if (@this == 1 && @sysvar::IL_CAN1::Message_EnableCyclic::ZR_MIB_TOP_ab_Gen3_Zentralrechner_01)
  {
    @sysvar::IL_CAN1::Message_SelectedPeriod::ZR_MIB_TOP_ab_Gen3_Zentralrechner_01 = -1;
  }
}

on sysvar_update sysvar::IL_CAN1::Message_SelectedPeriod::ZR_MIB_TOP_ab_Gen3_Zentralrechner_01
{
  if (@this == 0 && @sysvar::IL_CAN1::Message_EnableCyclic::ZR_MIB_TOP_ab_Gen3_Zentralrechner_01)
  {
    SetBusContext(gILCAN1_BusContext);
    gCAN1DisturbancePeriod = @sysvar::IL_CAN1::Message_NormalCyclePeriod::ZR_MIB_TOP_ab_Gen3_Zentralrechner_01;
    ILFaultInjectionResetMsgCycleTime(E3V_ABCANFD::Zentralrechner_01);
  }
  else if (@this == 1 && @sysvar::IL_CAN1::Message_EnableCyclic::ZR_MIB_TOP_ab_Gen3_Zentralrechner_01)
  {
    SetBusContext(gILCAN1_BusContext);
    gCAN1DisturbancePeriod = @sysvar::IL_CAN1::Message_ActiveCyclePeriod::ZR_MIB_TOP_ab_Gen3_Zentralrechner_01;
    ILFaultInjectionSetMsgCycleTime(E3V_ABCANFD::Zentralrechner_01, gCAN1DisturbancePeriod);
  }
  else if (@this == -1 && @sysvar::IL_CAN1::Message_EnableCyclic::ZR_MIB_TOP_ab_Gen3_Zentralrechner_01)
  {
    SetBusContext(gILCAN1_BusContext);
    gCAN1DisturbancePeriod = @sysvar::IL_CAN1::Message_CyclePeriod::ZR_MIB_TOP_ab_Gen3_Zentralrechner_01;
    ILFaultInjectionSetMsgCycleTime(E3V_ABCANFD::Zentralrechner_01, gCAN1DisturbancePeriod);
  }
}

on sysvar_update sysvar::IL_CAN1::Message_SendOnce::ZR_MIB_TOP_ab_Gen3_Zentralrechner_01
{
  if (@this == 1)
  {
    SetBusContext(gILCAN1_BusContext);
    ILSetMsgEvent(E3V_ABCANFD::Zentralrechner_01);
  }
}

on sysvar_update sysvar::NM_CAN1::ZR_MIB_TOP_ab_Gen3::OpenNodePanel
{
  OpenNodePanel("E3V_ABCANFD::ZR_MIB_TOP_ab_Gen3", 1);
}

on sysvar_update sysvar::NM_CAN1::StateControl::CloseNodePanels
{
  OpenNodePanel("E3V_ABCANFD::ZR_MIB_TOP_ab_Gen3", 0);
}

on sysvar_update sysvar::NM_CAN1::StateControl::Set_CABS_ForNodeId
{
  long i, lCABS[3];
  SysGetVariableLongArray(sysvar::NM_CAN1::StateControl::TNB_CABS, lCABS, 3);
  NMCAN1_SetCABS(@this, lCABS);
}

on sysvar_update sysvar::NM_CAN1::StateControl::Set_Filter_ForNodeId
{
  long i, lCABS[3];
  SysGetVariableLongArray(sysvar::NM_CAN1::StateControl::TNB_CABS, lCABS, 3);
  NMCAN1_SetFilter(@this, lCABS);
}

/* #ChannelEnd# |CAN1| #BusEnd# |E3V_ABCANFD| */
//--- end generated part --- Block end <#SysVar_Handler#> do not delete this line! Add application code below this line.

//--- begin generated part --- Block start <#MsgUpdateFcns#> do not delete this line and do not add application code in this code block!
/* #ChannelStart# |CAN1| #BusStart# |E3V_ABCANFD| */
/* #ChannelEnd# |CAN1| #BusEnd# |E3V_ABCANFD| */
//--- end generated part --- Block end <#MsgUpdateFcns#> do not delete this line! Add application code below this line.

