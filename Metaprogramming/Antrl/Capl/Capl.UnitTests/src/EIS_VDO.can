/*@!Encoding:1252*/
/*
Copyright ( C ) Continental AG 2012

Date of creation :  14.04.2011

Created by :                 Hans J�rgen Hipp


Version info

1.00	   10.2013	Inital versioning introduced
1.1	04.11.2013	HMI_2013_42a database

*/


variables
{

	const TRUE_disp =    0xAA;
    const FALSE_disp =   0x00;
  
    //for Cruise Control Panel
    byte Remember_Speed_Low;
    byte Remember_Speed_High;
    byte Remember_Type_select;
    byte Remember_Now_active;
    //-------------------------------------------------
    msTimer _tIgnSwitchOff_duration_msec;        // 0 - 60000 msec
    byte IgnSwitchOff_duration_minute;
    word IgnSwitchOff_delay = 0;                    // delay calcuated from CAN-timing
    msTimer _tIgnSwitchLock_duration_msec;      // 0 - 60000 msec
    word IgnSwitchLock_duration_msec;
    byte IgnSwitchLock_duration_minute;
    word IgnSwitchLock_delay = 0;                    // delay calcuated from CAN-timing
    msTimer _tIgnSwitchOn_duration_msec;        // 0 - 60000 msec
    byte IgnSwitchOn_duration_minute;
    word IgnSwitchOn_delay = 0;                    // delay calcuated from CAN-timing
    msTimer _t_Power_CheckCommActive;        // 0 - 60000 msec
    word _c_Power_CheckCommActive = 1000;                    // delay calcuated from CAN-timing
    msTimer _tNM_COM_StayActiveTimer;
    word _cNM_COM_StayActiveTimer = 9700;
    msTimer _tPowerTst_Sample_Meas03;
    word _cPowerTst_Sample_Meas03 = 5000;
    msTimer _tPowerOnToLogDelay;
    word _cPowerOnToLogDelay = 3000;
    msTimer _tWemStatusRead_Trigger;
    word _cWemStatusRead_Trigger = 3000;

    msTimer tPC_Time_read;

// for WakeUp/GoToSleep-Measurement
    const int True  = 1;
    const int False = 0;

    int First;
    dword StartTime;
    dword FirstNMTime;
    dword StopTime;
    dword LastNMTime;
    long diff; 

    const int _c_Powertest_InitialReactionTime_msec = 5000;  // 5 sec
    int boWaitForIC_Sleep = False;
    word wtemp;

// ----  Wake-up display on touchscreen buttons -----------------

	msTimer t_NM_Transmit;
    long  NM_Transmit_Cycle;
    msTimer t_NM_Wait_Bus_Sleep_Time;
    const c_NM_Wait_Bus_Sleep_Time = 1500;
    const c_NM_Remote_Sleep_Ind_Time = 5000;
    msTimer t_NM_Repeat_Message_Time;
    const c_NM_Repeat_Message_Time = 6000;
    msTimer t_NM_Timeout_Time;
    const c_NM_Timeout_Time = 5000;

	byte NM_Mode = 0;
    const byte cNM_Mode_Init = 0;
    const byte cNM_Mode_Sleep = 1;
    const byte cNM_Mode_Prepare_Bus_Sleep = 2;
    const byte cNM_Mode_Ready_Sleep = 3;
    const byte cNM_Mode_Normal_Operation_State = 4;
    const byte cNM_Mode_RepeatMsg = 5;
	
	byte boCanNM_Rx_Indication = 0;
    byte boCanNM_Tx_Confirmation = 0;
    byte boCanNM_WaitBusSleep_Timer_Expired = 0;
    byte boCanNM_RepeatMessage_Timer_Expired = 0;
    byte boCanNM_NM_Timeout_Timer_Expired = 0;
    byte boCanNM_RepeatMessage_Requested = 0;
	
	const word cStWhlButtonNMRequest =  0x0020;
	const word cStWhlButtonNMRequest_temp =  0x0020;
	Timer t_StWhlButtonNMCancelTimer;
	const byte c_NMCancelTimer_05sec = 5;
	const byte c_NMCancelTimer_30sec = 30;

	  msTimer t_DBKomTimer_20ms;      // Timer zum zyklischen Aufruf der DBKom-Task
    int c_tDBKomTimer_20ms = 20;    // msec
    msTimer t_DBKomTimer_5ms;       // Timer zum zyklischen Aufruf der DBKom-Task
    int c_tDBKomTimer_5ms = 5;      // msec
	




// ----  Switches with Keyboard -----------------

    msTimer tReleaseKeyCursorUp;
    msTimer tReleaseKeyCursorDown;
    msTimer tReleaseKeyCursorRight;
    msTimer tReleaseKeyCursorLeft;
    msTimer tReleaseKeyB;
    msTimer tReleaseKeyM;
    const dword cReleaseKeyTime = 100;

    msTimer _tSwIllLvl_Raw_ButtonPress_msec;        // Time buttons are pressed down
    const byte cSwIllLvl_Raw_ButtonPress_Duration = 95; // 100ms cycle time; 50 ms spontanous wait

    const byte cSWIllLvl_Raw_Default_old = 0;
    const byte cSWIllLvl_Raw_Default_new = 100;
    byte SWIllLvl_Raw_Default = cSWIllLvl_Raw_Default_new;

    byte bEnterGarageLevel_actual_step = 0;
    msTimer _tEnterGarageLevel;        // Timeing for buttons "OK" and "Back"
  
// ----  SLA-Variablen --------------------------
    byte AnzSchleifen = 0;
    byte SLA_Framecounter = 1;


    int WheelValue;               // f�r SBC Raddrehzahlen
    int WheelValueHilf;           // f�r SBC Raddrehzahlen

    msTimer _tTurnIndTimerOn;         // Timer for automated turn signals
    msTimer _tTurnIndTimerReload;     // Timer for automated turn signals

    long readPara1;
    long readPara2;
    long defVal = -1;

    // Timers for calculating a new value
    mstimer _t_Stress_ChangeCoolTemp;
    mstimer _t_Stress_ChangeDisCar;
    mstimer _t_Stress_ChangeOutTemp;
    mstimer _t_Stress_ChangeParking;
    mstimer _t_Stress_ChangeRev;
    mstimer _t_Stress_ChangePnhv;
	//mstimer _t_Stress_PnhvRev;
    mstimer _t_Stress_ChangeSegBegin;
    mstimer _t_Stress_ChangeSegEnd;
    mstimer _t_Stress_ChangeSpeed;
    mstimer _t_Stress_ChangeTank;
    mstimer _t_Stress_ToggleNightView;
    mstimer _t_Stress_ToggleDayNight;
    mstimer _t_Stress_Change_ECO_Score_Total;
    mstimer _t_Stress_Change_ECO_Score_Accel;
    mstimer _t_Stress_Change_ECO_Score_Const;
    mstimer _t_Stress_Change_ECO_Score_FreeWhl;
    mstimer _t_Stress_Change_ECO_Trend;
    mstimer _t_Stress_ChangeGearBox;
    mstimer _t_Stress_Style;

//    msTimer _t_Dimm_Increment_Cancel;
    const long cDimm_Increment_Cancel_Preset = 100;

// Variables for sweep directions: 1 = positiv, -1 = negativ
    int iDirectionCoolTemp    = 1;
    int iDirectionDisCar      = 1;
    int iDirectionOutTemp     = 1;
    int iDirectionParking     = 1;
    int iDirectionRev         = 1;
    int iDirectionSegBegin    = 1;
    int iDirectionSegEnd      = 1;
    int iDirectionSpeed       = 1;
    int iDirectionTank        = 1;
    int iDirectionECO_Score_Total = 1;
    int iDirectionECO_Score_Accel = 1;
    int iDirectionECO_Score_Const = 1;
    int iDirectionECO_Score_FreeWhl = 1;
    int iDirectionECO_Trend = 1;
    int iDirectionGearBoxPos  = 1;
    int iDirectionGearBoxProg = 1;
    int iDirectionStyle = 1;

    // Additional parameter for function "CalcNextPointerVal"
    // has to be declared here, because more than one should be returned
    long lCurrentVal;
    float fCurrentValue;

// Variables for ini-file read/write

//    char buffer[256];
    char func[20];
    long lTemp;
    long lWriteError = 1; // 0 = Error while writing ini-file

    // Default values for pointer coolant temp
    const long defCoolTempSweepActiv   =   1;
    const long defCoolTempMin          = -40;
    const long defCoolTempMax          = 140;
    const long defCoolTempStepWidth    =  10;
    const long defCoolTempTimeInterval = 500;

    // Default values for Distronic Car
    const long defDisCarSweepActiv     =   1;
    const long defDisCarMin            =   0;
    const long defDisCarMax            = 150;
    const long defDisCarStepWidth      =  10;
    const long defDisCarTimeInterval   = 100;

    // Default values for pointer ECO_Score_Total
    const long defECO_Score_Total_SweepActiv   =    1;
    const long defECO_Score_Total_Min          =    0;
    const long defECO_Score_Total_Max          =  100;
    const long defECO_Score_Total_StepWidth    =    5;
    const long defECO_Score_Total_TimeInterval =  100;

    // Default values for pointer ECO_Score_Accel
    const long defECO_Score_Accel_SweepActiv   =    1;
    const long defECO_Score_Accel_Min          =    0;
    const long defECO_Score_Accel_Max          =  100;
    const long defECO_Score_Accel_StepWidth    =    5;
    const long defECO_Score_Accel_TimeInterval =  100;

    // Default values for pointer ECO_Score_Const
    const long defECO_Score_Const_SweepActiv   =    1;
    const long defECO_Score_Const_Min          =    0;
    const long defECO_Score_Const_Max          =  100;
    const long defECO_Score_Const_StepWidth    =    5;
    const long defECO_Score_Const_TimeInterval =  100;

    // Default values for pointer ECO_Score_FrWhl
    const long defECO_Score_FreeWhl_SweepActiv   =    1;
    const long defECO_Score_FreeWhl_Min          =    0;
    const long defECO_Score_FreeWhl_Max          =  100;
    const long defECO_Score_FreeWhl_StepWidth    =    5;
    const long defECO_Score_FreeWhl_TimeInterval =  100;

    // Default values for ECO_Trend_ sweep
    const long defECO_Trend_SweepActiv   =   1;
    const long defECO_Trend_Random       =   1;
    const long defECO_Trend_TimeInterval =  25;
    const int iTrendArray_indexMax = 0x08;
    byte abAccelTrendArray[iTrendArray_indexMax+1] = {0x0,0x1,0x0,0x0,0x1,0x0,0x1,0x1,0x0 };
    byte abConstTrendArray[iTrendArray_indexMax+1] = {0x0,0x0,0x1,0x0,0x1,0x1,0x0,0x1,0x0 };
    byte abFrWhlTrendArray[iTrendArray_indexMax+1] = {0x0,0x0,0x0,0x1,0x0,0x1,0x1,0x1,0x0 };
    int iTrendArray_index = 0;

    // Default values for gearbox sweep
    const long defGearBoxSweepActiv   =   1;
    const long defGearBoxRandom       =   1;
    const long defGearBoxTimeInterval =  25;
    const int iPosArray_indexMax  = 0x18;
    const int iProgArray_indexMax = 0x08;
    byte abPosArray[iPosArray_indexMax+1]   = { 0x20,0x50,0x52,0x4E,0x44,0x41,0x39,0x38,0x37,0x36,0x35,0x34,0x33,0x32,0x31,0x46,0x09,0x08,0x07,0x06,0x05,0x04,0x03,0x02,0x01 };
    byte abProgArray[iProgArray_indexMax+1] = { 0x20,0x57,0x53,0x4D,0x41,0x43,0x46,0x45,0x54 };
    int iPosArray_index = 0;
    int iProgArray_index = 0;

    // Default values for NightView
    const long defNightViewToggleActiv = 0;
    const long defNightViewTimeInterval = 30000;

    // Default values for DayNight
    const long defDayNightToggleActiv = 0;
    const long defDayNightTimeInterval = 2000;

    // Default values for outside airtemp sweep
    const long defOutTempSweepActiv   =     1;
    const long defOutTempMin          =   -10;
    const long defOutTempMax          =    10;
    const long defOutTempStepWidth    =     1;
    const long defOutTempTimeInterval =  1000;

    // Default values for Parking (left & right)
    const long defParkingSweepActiv   =   1;
    const long defParkingMin          =   0;
    const long defParkingMax          =  15;
    const long defParkingStepWidth    =   1;
    const long defParkingTimeInterval = 500;

    // Default values for pointer revolution
    const long defRevSweepActiv   =    1;
    const long defRevMin          =    0;
    const long defRevMax          = 6000;
    const long defRevStepWidth    = 6000;
    const long defRevTimeInterval = 1000;
	
	// Default values for powermeterElecMode
	const long defPnhvSweepActiv= 1;
	const long defPnhvMin= -100;
	const long defPnhvMax= 104;
	const long defPnhvStepWidth= 100;
	const long defPnhvTimeInterval = 100;

    // Default values for Segmentring Begin
    const long defSegBeginSweepActiv   =   1;
    const long defSegBeginMin          =   0;
    const long defSegBeginMax          = 100;
    const long defSegBeginStepWidth    =   1;
    const long defSegBeginTimeInterval =  25;

    // Default values for Segmentring End
    const long defSegEndSweepActiv     =   1;
    const long defSegEndMin            = 101;
    const long defSegEndMax            = 252;
    const long defSegEndStepWidth      =   1;
    const long defSegEndTimeInterval   =  25;

    // Default values for pointer speed
    const long defSpeedSweepActiv   =   1;
    const long defSpeedMin          =   0;
    const long defSpeedMax          = 260;
    const long defSpeedStepWidth    =  10;
    const long defSpeedTimeInterval =  25;

    // Default values for pointer tank
    const long defTankSweepActiv   =   1;
    const long defTankMin          =   0;
    const long defTankMax          = 100;
    const long defTankStepWidth    =  10;
    const long defTankTimeInterval = 100;

    // Variable and constants for own tab in "Write"-window
    dword dwWriteSinkSimu;  // Sink identifier Stresstest-tab

    // write window sink-IDs (tabulators on write window)
    const long dwWriteSinkTrace  = -3;
    const long dwWriteSinkLog    = -2;
    const long dwWriteSinkDebug  = -1;
    const long dwWriteSinkSystem =  0;
    const long dwWriteSinkCapl   =  1;

    // write window severities (for writing at sinks)
    const dword dwWriteSeveritySuccess = 0;
    const dword dwWriteSeverityInfo    = 1;
    const dword dwWriteSeverityWarning = 2;
    const dword dwWriteSeverityError   = 3;

// Powermode 

    const long defPower_On_Min = 0;
    const long defPower_On_Msec = 10000;
    const long defPower_On_IncDec = 0;
    const long defPower_On_Msec_Step = 1;
    const long defPower_Off_Min = 0;
    const long defPower_Off_Msec = 5000;
    const long defPower_Off_IncDec = 0;
    const long defPower_Off_Msec_Step = 1;
    const long defPower_Lock_Min = 1;
    const long defPower_Lock_Msec = 0;
    const long defPower_Lock_IncDec = 1;
    const long defPower_Lock_Msec_Step = 1;
    const long defPower__PowertestMainActiv = 0;
    msTimer t_ForceDisplayOffTimer;	    // event dration timer


// Configuration
   
    const byte CONFIG_MIN        = 0x00;      // everything ! is switched OFF
    const byte CONFIG_MAX               = 0x01;      // everything ! is switched ON
    const byte CONFIG_TYPICAL           = 0x02;      // medium equippement configuration, cannot be modified by user !!!
    const byte CONFIG_1            = 0x03;      // Free for own entries

    const byte CONFIG_2            = 0x04;      // Free for own entries
    const byte CONFIG_3            = 0x05;      // Free for own entries
    const byte CONFIG_4            = 0x06;      // Free for own entries
    const byte CONFIG_5            = 0x07;      // Free for own entries

    const byte CONFIG_6            = 0x08;      // Free for own entries
    const byte CONFIG_7            = 0x09;      // Free for own entries
    const byte CONFIG_8            = 0x0A;      // Free for own entries
    const byte CONFIG_9            = 0x0B;      // Free for own entries

    const byte CONFIG_10        = 0x0C;      // Free for own entries
    const byte CONFIG_11        = 0x0D;      // Free for own entries
    const byte CONFIG_12        = 0x0E;      // Free for own entries
    const byte CONFIG_13        = 0x0F;      // Free for own entries
    
    char cConfig_CFGiniSection[100];
    char cConfig_iniSection[100];                      // contains the current selected section string
    
    char cConfig_outtxt[15] ;                         // out text for the IND settings panel    

    dword KeyIdByte1;              // F�r Ident.Schl�ssel
    dword KeyIdByte2;              // F�r Ident.Schl�ssel
    dword KeyIdByte3;              // F�r Ident.Schl�ssel
    dword KeyIdByte4;              // F�r Ident.Schl�ssel

    msTimer t_Auto_Project_SelectorTimer;	    // event duration timer

    byte OFN_Play_ActPos = 0;
    byte OFN_Play_Length = 0;
    int OFN_Play_x[16];
    int OFN_Play_y[16];
    byte OFN_Play_t[16];

    byte OFN_Temp_Length = 0;
    int OFN_Temp_x[16];
    int OFN_Temp_y[16];
    byte OFN_Temp_t[16];
    char OFN_Temp_txt[100];

    byte OFN_Up_1_Length = 0;
    int OFN_Up_1_x[16];
    int OFN_Up_1_y[16];
    byte OFN_Up_1_t[16];
    byte OFN_Up_2_Length = 0;
    int OFN_Up_2_x[16];
    int OFN_Up_2_y[16];
    byte OFN_Up_2_t[16];

    byte OFN_Left_1_Length = 0;
    int OFN_Left_1_x[16];
    int OFN_Left_1_y[16];
    byte OFN_Left_1_t[16];
    byte OFN_Left_2_Length = 0;
    int OFN_Left_2_x[16];
    int OFN_Left_2_y[16];
    byte OFN_Left_2_t[16];

    byte OFN_Down_1_Length = 0;
    int OFN_Down_1_x[16];
    int OFN_Down_1_y[16];
    byte OFN_Down_1_t[16];
    byte OFN_Down_2_Length = 0;
    int OFN_Down_2_x[16];
    int OFN_Down_2_y[16];
    byte OFN_Down_2_t[16];

    byte OFN_Right_1_Length = 0;
    int OFN_Right_1_x[16];
    int OFN_Right_1_y[16];
    byte OFN_Right_1_t[16];
    byte OFN_Right_2_Length = 0;
    int OFN_Right_2_x[16];
    int OFN_Right_2_y[16];
    byte OFN_Right_2_t[16];

    byte OFN_Free_1_Length = 0;
    int OFN_Free_1_x[16];
    int OFN_Free_1_y[16];
    byte OFN_Free_1_t[16];
    char OFN_Temp_1_txt[100];

    byte OFN_Free_2_Length = 0;
    int OFN_Free_2_x[16];
    int OFN_Free_2_y[16];
    byte OFN_Free_2_t[16];
    char OFN_Temp_2_txt[100];

    byte OFN_Free_3_Length = 0;
    int OFN_Free_3_x[16];
    int OFN_Free_3_y[16];
    byte OFN_Free_3_t[16];
    char OFN_Temp_3_txt[100];

    byte OFN_Free_4_Length = 0;
    int OFN_Free_4_x[16];
    int OFN_Free_4_y[16];
    byte OFN_Free_4_t[16];
    char OFN_Temp_4_txt[100];

    const NmAsrCanMsgReducedTime_EIS =        1070;
    const NmAsrCanMsgCycleOffset_EIS =          70;
    const NmAsrCanMsgStandardCycle =          2000;
    
    word NmAsrCanMsgReducedTime = NmAsrCanMsgReducedTime_EIS;
    word NmAsrCanMsgCycleOffset = NmAsrCanMsgCycleOffset_EIS;
	
	//  message   NM_xxx_AR --- Sendeart cyclicX --- 
    message NM_EIS_AR _mNM_xxx_AR;
    byte _mNM_xxx_Transmit_Allowed = 1;
    
    const CanNmNodeId_EIS =           7; // =   07h
    byte CanNmNodeId =            CanNmNodeId_EIS;
}

//WAKE UP DISPLAY ON TOUCH 
_NM_Switch_NM_Mode()
{
    byte bOld_NM_Mode;
    word NM_Request_State;

    bOld_NM_Mode = NM_Mode;
    NM_Request_State = getValue( HMI__NM_EIS_NM_Request );
    switch( NM_Mode )
    {
        case cNM_Mode_Init:                   _NM_Init();
                                              NM_Mode = cNM_Mode_Sleep;
                                              break;
        case cNM_Mode_Sleep:                  if( boCanNM_Rx_Indication == TRUE_disp )
                                              {
                                                  // _NM_NetworkStartIndication();   nothing to do
                                                  // _NM_PassiveStartUp();    is content of _NM_NetworkMode();
                                                  setTimer( t_NM_Transmit, NmAsrCanMsgCycleOffset );    // send NM-Frame delayed
                                                  boCanNM_Rx_Indication = FALSE_disp;
                                                  cancelTimer( t_NM_Timeout_Time );
                                                  setTimer( t_NM_Timeout_Time, c_NM_Timeout_Time );
                                                  setTimer( t_NM_Repeat_Message_Time, c_NM_Repeat_Message_Time );
                                                  NM_Transmit_Cycle = NmAsrCanMsgStandardCycle;
                                                  _NM_NetworkMode();
                                                  NM_Mode = cNM_Mode_RepeatMsg;
                                              }
                                              if( NM_Request_State )
                                              {
                                                  setTimer( t_NM_Transmit, 1 );    //send NM-Franme immediately
                                                  NM_Transmit_Cycle = NmAsrCanMsgStandardCycle;
                                                  cancelTimer( t_NM_Timeout_Time );
                                                  setTimer( t_NM_Timeout_Time, c_NM_Timeout_Time );
                                                  setTimer( t_NM_Repeat_Message_Time, c_NM_Repeat_Message_Time );
                                                  NM_Transmit_Cycle = NmAsrCanMsgStandardCycle;
                                                  _NM_NetworkMode();
                                                  NM_Mode = cNM_Mode_RepeatMsg;
                                              }
                                              break;
        case cNM_Mode_Prepare_Bus_Sleep:      if( boCanNM_WaitBusSleep_Timer_Expired == TRUE_disp )
                                              {
                                                  _NM_BusSleepModeInd();   // set message startup delay
                                                  NM_Mode = cNM_Mode_Sleep;
                                                  boCanNM_WaitBusSleep_Timer_Expired = FALSE_disp;
                                              }
                                              if( boCanNM_NM_Timeout_Timer_Expired == TRUE_disp )
                                                  boCanNM_NM_Timeout_Timer_Expired = FALSE_disp;
                                              if( ( boCanNM_Rx_Indication == TRUE_disp ) ||  NM_Request_State )
                                              {
                                                  boCanNM_Rx_Indication = FALSE_disp;
                                                  if( NM_Request_State )
                                                  {
                                                      setTimer( t_NM_Transmit, 1 );    //send NM-Franme immediately
                                                  }
                                                  cancelTimer( t_NM_Timeout_Time );
                                                  setTimer( t_NM_Timeout_Time, c_NM_Timeout_Time );
                                                  setTimer( t_NM_Repeat_Message_Time, c_NM_Repeat_Message_Time );
                                                  _NM_NetworkMode();
                                                  NM_Transmit_Cycle = NmAsrCanMsgStandardCycle;
                                                  NM_Mode = cNM_Mode_RepeatMsg;
                                              }
                                              break;
        case cNM_Mode_Ready_Sleep:            if( boCanNM_Rx_Indication == TRUE_disp )
                                              {
                                                  cancelTimer( t_NM_Timeout_Time );
                                                  setTimer( t_NM_Timeout_Time, c_NM_Timeout_Time );
                                                  boCanNM_Rx_Indication = FALSE_disp;
                                              }
                                              if( boCanNM_Tx_Confirmation == TRUE_disp )
                                              {
                                                  cancelTimer( t_NM_Timeout_Time );
                                                  setTimer( t_NM_Timeout_Time, c_NM_Timeout_Time );
                                                  boCanNM_Tx_Confirmation = FALSE_disp;
                                              }
                                              if( NM_Request_State )
                                              {
                                                  setTimer( t_NM_Transmit, 1 );    //send NM-Franme immediately
                                                  cancelTimer( t_NM_Timeout_Time );
                                                  setTimer( t_NM_Timeout_Time, c_NM_Timeout_Time );
                                                  NM_Transmit_Cycle = NmAsrCanMsgReducedTime;
                                                  NM_Mode = cNM_Mode_Normal_Operation_State;
                                              }
                                              if( boCanNM_RepeatMessage_Requested == TRUE_disp )
                                              {
                                                  setTimer( t_NM_Transmit, NmAsrCanMsgCycleOffset );    // send NM-Frame delayed
                                                  cancelTimer( t_NM_Timeout_Time );
                                                  setTimer( t_NM_Timeout_Time, c_NM_Timeout_Time );
                                                  setTimer( t_NM_Repeat_Message_Time, c_NM_Repeat_Message_Time );
                                                  NM_Transmit_Cycle = NmAsrCanMsgStandardCycle;
                                                  boCanNM_RepeatMessage_Requested = FALSE_disp;
                                                  NM_Mode = cNM_Mode_RepeatMsg;
                                              }
                                              if( boCanNM_NM_Timeout_Timer_Expired == TRUE_disp )
                                              {
                                                  setTimer( t_NM_Wait_Bus_Sleep_Time, c_NM_Wait_Bus_Sleep_Time );
                                                  _NM_PrepareBusSleepModeInd();    // here t_DBKonTimer is stopped
                                                  NM_Mode = cNM_Mode_Prepare_Bus_Sleep;
                                                  boCanNM_NM_Timeout_Timer_Expired = FALSE_disp;
                                              }
                                              break;
        case cNM_Mode_Normal_Operation_State: if( boCanNM_NM_Timeout_Timer_Expired == TRUE_disp )
                                              {
                                                  setTimer( t_NM_Timeout_Time, c_NM_Timeout_Time );
                                                  // _NM_TimeoutExeption();    // no action to be done
                                                  boCanNM_NM_Timeout_Timer_Expired = FALSE_disp;
                                              }
                                              if( boCanNM_Rx_Indication == TRUE_disp )
                                              {
                                                  cancelTimer( t_NM_Timeout_Time );
                                                  setTimer( t_NM_Timeout_Time, c_NM_Timeout_Time );
                                                  cancelTimer( t_NM_Transmit );
                                                  setTimer( t_NM_Transmit, NmAsrCanMsgReducedTime );
                                                  boCanNM_Rx_Indication = FALSE_disp;
                                              }
                                              if( boCanNM_Tx_Confirmation == TRUE_disp )
                                              {
                                                  cancelTimer( t_NM_Timeout_Time );
                                                  setTimer( t_NM_Timeout_Time, c_NM_Timeout_Time );
                                                  cancelTimer( t_NM_Transmit );
                                                  setTimer( t_NM_Transmit, NmAsrCanMsgStandardCycle );
                                                  boCanNM_Tx_Confirmation = FALSE_disp;
                                              }
                                              if( NM_Request_State == 0 )    //no network requested
                                              {
                                                  cancelTimer( t_NM_Transmit );    // stop NM-Franme immediately
                                                  NM_Mode = cNM_Mode_Ready_Sleep;
                                              }
                                              if( boCanNM_RepeatMessage_Requested == TRUE_disp )
                                              {
                                                  setTimer( t_NM_Transmit, NmAsrCanMsgCycleOffset );    // send NM-Frame delayed
                                                  cancelTimer( t_NM_Timeout_Time );
                                                  setTimer( t_NM_Timeout_Time, c_NM_Timeout_Time );
                                                  setTimer( t_NM_Repeat_Message_Time, c_NM_Repeat_Message_Time );
                                                  boCanNM_RepeatMessage_Requested = FALSE_disp;
                                                  NM_Transmit_Cycle = NmAsrCanMsgStandardCycle;
                                                  NM_Mode = cNM_Mode_RepeatMsg;
                                              }
                                              break;
        case cNM_Mode_RepeatMsg:              if( boCanNM_NM_Timeout_Timer_Expired == TRUE_disp )
                                              {
                                                  setTimer( t_NM_Timeout_Time, c_NM_Timeout_Time );
                                                  boCanNM_NM_Timeout_Timer_Expired = FALSE_disp;
                                              }
                                              if( boCanNM_Rx_Indication == TRUE_disp )
                                              {
                                                  cancelTimer( t_NM_Timeout_Time );
                                                  setTimer( t_NM_Timeout_Time, c_NM_Timeout_Time );
                                                  boCanNM_Rx_Indication = FALSE_disp;
                                              }
                                              if( boCanNM_Tx_Confirmation == TRUE_disp )
                                              {
                                                  cancelTimer( t_NM_Timeout_Time );
                                                  setTimer( t_NM_Timeout_Time, c_NM_Timeout_Time );
                                                  boCanNM_Tx_Confirmation = FALSE_disp;
                                              }
                                              if( boCanNM_RepeatMessage_Timer_Expired == TRUE_disp )
                                              {
                                                  boCanNM_RepeatMessage_Timer_Expired = FALSE_disp;
                                                  if( NM_Request_State )
                                                  {
                                                      NM_Mode = cNM_Mode_Normal_Operation_State;
                                                      NM_Transmit_Cycle = NmAsrCanMsgReducedTime;
                                                  }
                                                  else
                                                  {
                                                      cancelTimer( t_NM_Transmit );    // stop NM-Franme immediately
                                                      NM_Mode = cNM_Mode_Ready_Sleep;
                                                  }
                                              }
                                              break;
    }
    if( bOld_NM_Mode != NM_Mode )
    {
        _Nm_StateChangeNotification( bOld_NM_Mode, NM_Mode );    // does the Trace
        putValue( HMI__NM_EIS_ActualState, NM_Mode );
    }
}

_NM_Init()
{
    NM_Transmit_Cycle = NmAsrCanMsgStandardCycle;
}

_NM_NetworkMode()
{
    setTimer( t_DBKomTimer_5ms, 1 ); //  ms     start CAN-communication immediately
    setTimer( t_DBKomTimer_20ms, 2 ); //  ms     start CAN-communication immediately
    putValue( HMI__NM_EIS_CommActive, 1 );
}

_Nm_BusSleepModeInd()
{
    putValue( Env_ODO_Takeover_For_TCO, 1 );   // used in EIS_VDO to synchronize ODO's
//    write( "_Nm_BusSleepModeInd: Sleep Mode active");
    //__Startup_Delay();
    //__Reset_E2E_SQC();
}

void _Nm_PrepareBusSleepModeInd()
{
//    _Trace( "Nm_PrepareBusSleepModeInd", "Prepare Sleep Mode active");
    putValue( HMI__NM_EIS_CommActive, 0 );
    cancelTimer( t_DBKomTimer_5ms );
    cancelTimer( t_DBKomTimer_20ms );
}

_Nm_StateChangeNotification( byte previousState, byte currentState )
{
/*
    char line[50];

    snprintf( line, elcount(line ), "Transition from %d to %d", previousState, currentState );
    _Trace( "Nm_StateChangeNotification", "", line );
*/
}



_ReleaseCommRequest( word RequestID )
{
    word temp; // actual NM request status

    temp = getValue( HMI__NM_EIS_NM_Request );
    temp &= ~RequestID; // reset NM request 
    putValue( HMI__NM_EIS_NM_Request, temp );
    _NM_Switch_NM_Mode();
}

_SetCommRequest( word RequestID )
{
    word temp; // actual NM request status

    temp = getValue( HMI__NM_EIS_NM_Request );
    temp |= RequestID; // set NM request 
    putValue( HMI__NM_EIS_NM_Request, temp );
    _NM_Switch_NM_Mode();
}

on Timer t_DBKomTimer_5ms
{
// *** DBKom-Sendefunktion ***
    // timer aufziehen f?r n?chsten Zyklus
    if( getValue( HMI__NM_EIS_CommActive ) )
    {
        setTimer( t_DBKomTimer_5ms, c_tDBKomTimer_5ms );
    }
}

on Timer t_DBKomTimer_20ms
{
// *** DBKom-Sendefunktion ***
    // timer aufziehen f?r n?chsten Zyklus
    if( getValue( HMI__NM_EIS_CommActive    ) )
    {
        setTimer( t_DBKomTimer_20ms, c_tDBKomTimer_20ms );
    }
}

on timer t_NM_Repeat_Message_Time
{
    boCanNM_RepeatMessage_Timer_Expired = TRUE_disp;
    _NM_Switch_NM_Mode();     // inform the state-mashine
}

on timer t_NM_Timeout_Time
{
    boCanNM_NM_Timeout_Timer_Expired = TRUE_disp;
    _NM_Switch_NM_Mode();     // inform the state-mashine
}

on timer t_NM_Transmit
{
    setTimer( t_NM_Transmit, NM_Transmit_Cycle );
    _mNM_xxx_AR.byte( 1 ) = CanNmNodeId;
    if( _mNM_xxx_Transmit_Allowed )
        output( _mNM_xxx_AR );
}

on timer t_NM_Wait_Bus_Sleep_Time
{
    boCanNM_WaitBusSleep_Timer_Expired = TRUE_disp;
    _NM_Switch_NM_Mode();     // inform the state-mashine
}

CalcRaddrehzahl()
{
//-------------------------------------Hauptpanel aktiv------------------------------------
if( getvalue( Env_Hauptpanel_V_Aktiv ) )
    {
        WheelValueHilf = getvalue(Env_BS_Raddrehzahlen);
        WheelValue = WheelValueHilf * getvalue(Env_KZahl) / 1440;

        if( WheelValue > 0x3FFF )
        {     
             write("Eingabe Geschwindigkeit au�erhalb erlaubten Bereich !!!");
             write("Raddrehzahl (Geschwindigkeit) ist K-Zahl abh�ngig !!!");
             WheelValue = 0x3FFF;
             WheelValueHilf = WheelValue * 1440 / getvalue( Env_KZahl );
             putvalue( Env_BS_Raddrehzahlen, WheelValueHilf );
             putvalue( Env_KZahl, 22182 );
        }

        putValue( Env_WhlRPM_FL, WheelValue*0.5 );         //Raddrehzahl vorne links
        putValue( Env_WhlRPM_FR, WheelValue*0.5 );         //Raddrehzahl vorne rechts
        putValue( Env_WhlRPM_RL, WheelValue*0.5 );         //Raddrehzahl hinten rechts
        putValue( Env_WhlRPM_RR, WheelValue*0.5 );         //Raddrehzahl hinten links

    }
//    if( getvalue( Env_Hauptpanel_V_Aktiv ) )
//    {
//        WheelValueHilf = getvalue(Env_BS_Raddrehzahlen);
//        WheelValue = WheelValueHilf * getvalue(Env_KZahl) / 2880;
//
//        if( WheelValue > 0x3FFF )
//        {     
//             write("Eingabe Geschwindigkeit au�erhalb erlaubten Bereich !!!");
//             write("Raddrehzahl (Geschwindigkeit) ist K-Zahl abh�ngig !!!");
//             WheelValue = 0x3FFF;
//             WheelValueHilf = WheelValue * 2880 / getvalue( Env_KZahl );
//             putvalue( Env_BS_Raddrehzahlen, WheelValueHilf );
//             putvalue( Env_KZahl, 24481 );
//        }
//
//        putValue( Env_WhlRPM_FL, WheelValue );         //Raddrehzahl vorne links
//        putValue( Env_WhlRPM_FR, WheelValue );         //Raddrehzahl vorne rechts
//        putValue( Env_WhlRPM_RL, WheelValue );         //Raddrehzahl hinten rechts
//        putValue( Env_WhlRPM_RR, WheelValue );         //Raddrehzahl hinten links
//
//    }
//---------------------------Ende Hauptpanel aktiv-----------------------------------------
    else
//--------------------------- ESP Panel aktiv----------------------------------------------

    {
        if( getvalue( Env_WhlRPM_FL_Fehler ) == 0)
        {
            putValue( HMI_WhlRPM_FL, getvalue( Env_WhlRPM_FL ) );         //Raddrehzahl vorne links
        }
        else
        {
            putValue( HMI_WhlRPM_FL, 0x3FFF );                               //Raddrehzahl vorne links
        }

        if( getvalue( Env_WhlRPM_FR_Fehler ) == 0)
        {
            putValue( HMI_WhlRPM_FR, getvalue( Env_WhlRPM_FR ) );         //Raddrehzahl vorne rechts
        }
        else
        {
            putValue( HMI_WhlRPM_FR, 0x3FFF );                               //Raddrehzahl vorne links
        }

        if( getvalue( Env_WhlRPM_RL_Fehler) == 0)
        {
            putValue( HMI_WhlRPM_RR, getvalue( Env_WhlRPM_RL ) );         //Raddrehzahl hinten rechts
        }
        else
        {
            putValue( HMI_WhlRPM_RR, 0x3FFF );                               //Raddrehzahl vorne links
        }

        if( getvalue( Env_WhlRPM_RR_Fehler) == 0)
        {
            putValue( HMI_WhlRPM_RL, getvalue( Env_WhlRPM_RR ) );          //Raddrehzahl hinten links
        }
        else
        {
            putValue( HMI_WhlRPM_RL, 0x3FFF );                               //Raddrehzahl vorne links
        }
    }
//-------------------------------------Ende ESP Panel aktiv--------------------------------
}

on envVar Env_Uebernehmen
{
	//_m_C_BC_F_Stat1_AR.AirTemp_Outsd  =  getvalue( C_AirTemp_Outsd);

    if( (getvalue(Env_Uebernehmen)) && (getvalue(Env_Modus_Manuell)))
    {
//        AllMessages_Copy();

/*    _m_C_TCM_DISP_RQ.TxDrvPosn_Disp_Rq_TCM  =  getvalue( C_TxDrvPosn_Disp_Rq_TCM);
    _m_C_TCM_DISP_RQ.TxDrvProg_Disp_Rq_TCM   =  getvalue( C_TxDrvProg_Disp_Rq_TCM);
    _m_C_TCM_DISP_RQ.SBW_Msg_Disp_Rq_TCM   =  getvalue( C_SBW_Msg_Disp_Rq_TCM);
    _m_C_TCM_DISP_RQ.TxShiftRcmmnd_Disp_Rq_TCM   =  getvalue( C_TxShiftRcmmnd_Disp_Rq_TCM);
    _m_C_TCM_DISP_RQ.SBW_Beep_Rq_TCM   =  getvalue( C_SBW_Beep_Rq_TCM);
    _m_C_TCM_DISP_RQ.TSL_MtnLk1_Disp_Rq_TCM  = getvalue( C_TSL_MtnLk1_Disp_Rq_TCM);
    _m_C_TCM_DISP_RQ.TSL_MtnLk2_Disp_Rq_TCM  = getvalue( C_TSL_MtnLk2_Disp_Rq_TCM);
    _m_C_TCM_DISP_RQ.TSL_MtnLk3_Disp_Rq_TCM  = getvalue( C_TSL_MtnLk3_Disp_Rq_TCM);
    _m_C_TCM_DISP_RQ.TSL_MtnLk4_Disp_Rq_TCM  = getvalue( C_TSL_MtnLk4_Disp_Rq_TCM);
    _m_C_TCM_DISP_RQ.Gr_Target_Disp_Rq  = getvalue( C_Gr_Target_Disp_Rq);  
    _m_C_TCM_DISP_RQ.RaceStMd_Disp_Rq_AMG  = getvalue( C_RaceStMd_Disp_Rq_AMG);
*/
	

/* //   if( busActive == 1)
    {
 //     if( (getvalue( C_ID_TCM_DISP_RQ) == 1) && (_TCM_DISP_RQDelayTimeOk(0)))
      {
 //       output(_m_C_TCM_DISP_RQ);
      }
    }


  //  if( getvalue( C_TxOilTemp_Fehler) == 0)      
    {  
  //    _m_C_TCM_A1.TxOilTemp = getvalue( C_TxOilTemp);
    }
  //  else
    {
  //    _m_C_TCM_A1.TxOilTemp = 0xFF;
    }
*/
 /*   _m_C_TCM_A1.VehDrvProg_TCM_V2 = getvalue( C_VehDrvProg_TCM_V2);
    _m_C_TCM_A1.TSL_Posn_TCM = getvalue( C_TSL_Posn_TCM);


    _m_C_ISM_DISP_RQ.TxDrvPosn_Disp_Rq_ISM   =  getvalue( C_TxDrvPosn_Disp_Rq_ISM);
    _m_C_ISM_DISP_RQ.SBW_Msg_Disp_Rq_ISM    =  getvalue( C_SBW_Msg_Disp_Rq_ISM);
    _m_C_ISM_DISP_RQ.SBW_Beep_Rq_ISM    =  getvalue( C_SBW_Beep_Rq_ISM);
    _m_C_ISM_DISP_RQ.TSL_MtnLk1_Disp_Rq_ISM    =  getvalue( C_TSL_MtnLk1_Disp_Rq_ISM );
    _m_C_ISM_DISP_RQ.TSL_MtnLk2_Disp_Rq_ISM    =  getvalue( C_TSL_MtnLk2_Disp_Rq_ISM );
    _m_C_ISM_DISP_RQ.TSL_MtnLk3_Disp_Rq_ISM    =  getvalue( C_TSL_MtnLk3_Disp_Rq_ISM );
    _m_C_ISM_DISP_RQ.TSL_MtnLk4_Disp_Rq_ISM    =  getvalue( C_TSL_MtnLk4_Disp_Rq_ISM );  
*/
  //  if( busActive == 1)
 /*   {
      if( (getvalue( C_ID_ISM_DISP_RQ) == 1) && (_ISM_DISP_RQDelayTimeOk(0)))
      {
 //       output(_m_C_ISM_DISP_RQ);
      }
    }

    if( getvalue( C_EngRPM_Fehler) == 0)      
    {  
       _m_C_ENG_RS3.EngRPM = getvalue( C_EngRPM);
    }
    else
    {
 //      _m_C_ENG_RS3.EngRPM = 0x3FFF;
    }

    if( getvalue( C_AccelPdlPosn_Fehler) == 0)      
    {  
 //      _m_C_ENG_RS3.AccelPdlPosn = getvalue( C_AccelPdlPosn);
    }
    else
    {
 //      _m_C_ENG_RS3.AccelPdlPosn = 0xFF;
    }
*/
 /*   _m_C_ENG_RS3.Term61_Actv = getvalue( C_Term61_Actv);
    _m_C_ENG_RS3.EngRun_Stat = getvalue( C_EngRun_Stat);

    _m_C_ENG_RQ2_TCM.TxShiftStyle = getvalue( C_TxShiftStyle);
    _m_C_ENG_RQ2_TCM.TxMechStyle = getvalue( C_TxMechStyle);
    _m_C_ENG_RQ2_TCM.TxStyle = getvalue( C_TxStyle);*/
/*
    _m_C_ENG_RQ3_TCM.DrvAccelMax_Stat = getvalue( C_DrvAccelMax_Stat);
*/
  /*  _m_C_ECM_DISP_RQ.WtrFuelIndLmp_On_Rq =   getvalue( C_WtrFuelIndLmp_On_Rq );
    _m_C_ECM_DISP_RQ.FuelFltrIndLmp_On_Rq =  getvalue( C_FuelFltrIndLmp_On_Rq);
    _m_C_ECM_DISP_RQ.TankCapIndLmp_On_Rq  =  getvalue( C_TankCapIndLmp_On_Rq);
    _m_C_ECM_DISP_RQ.MIL_On_Rq  =            getvalue( C_MIL_On_Rq);
    _m_C_ECM_DISP_RQ.EngOilIndLmp_On_Rq  =   getvalue( C_EngOilIndLmp_On_Rq);
    _m_C_ECM_DISP_RQ.PreHtIndLmp_On_Rq =     getvalue( C_PreHtIndLmp_On_Rq);
    _m_C_ECM_DISP_RQ.AirStrIndLmp_On_Rq  =   getvalue( C_AirStrIndLmp_On_Rq);
    _m_C_ECM_DISP_RQ.FanMtrIndLmp_On_Rq  =   getvalue( C_FanMtrIndLmp_On_Rq);
    _m_C_ECM_DISP_RQ.EngOilTemp_Above_Max  = getvalue( C_EngOilTemp_Above_Max);
    _m_C_ECM_DISP_RQ.ParticleFltrWarn  =     getvalue( C_ParticleFltrWarn);
    _m_C_ECM_DISP_RQ.OvrRPM_Actv  =          getvalue( C_OvrRPM_Actv);
    _m_C_ECM_DISP_RQ.DAC_StErr  =            getvalue( C_DAC_StErr);
    _m_C_ECM_DISP_RQ.SSA_Msg_Disp_Rq  =      getvalue( C_SSA_Msg_Disp_Rq);
    _m_C_ECM_DISP_RQ.SSA_WarnDisp_Rq  =      getvalue( C_SSA_WarnDisp_Rq);
    _m_C_ECM_DISP_RQ.Gr_Target_Disp_Rq_ECM  = getvalue( C_Gr_Target_Disp_Rq_ECM);
    _m_C_ECM_DISP_RQ.TxShiftRcmmnd_Disp_Rq_ECM  = getvalue( C_TxShiftRcmmnd_Disp_Rq_ECM);
    _m_C_ECM_DISP_RQ.SSA_ECO_Md_Actv_Disp_Rq  = getvalue( C_SSA_ECO_Md_Actv_Disp_Rq);
    _m_C_ECM_DISP_RQ.SSA_ECO_Md_DispCol_Rq  = getvalue( C_SSA_ECO_Md_DispCol_Rq);
    _m_C_ECM_DISP_RQ.SSA_ECO_Sw_LED_On_Rq  = getvalue( C_SSA_ECO_Sw_LED_On_Rq);
    _m_C_ECM_DISP_RQ.IndLmpChk_Off_Rq  =     getvalue( C_IndLmpChk_Off_Rq);
*/
 /*   if( getvalue( C_EngIdleRPM_Dsr_Fehler) == 0)      
    {  
 //      _m_C_ECM_A2.EngIdleRPM_Dsr = getvalue( C_EngIdleRPM_Dsr);
    }
    else
    {
//       _m_C_ECM_A2.EngIdleRPM_Dsr = 0x3FFF;
    }

    if( getvalue( C_EngCoolTemp_Fehler) == 0)
    {  
 //     _m_C_ECM_A1.EngCoolTemp = getvalue( C_EngCoolTemp);
    }
    else
    {
      _m_C_ECM_A1.EngCoolTemp = 0xFF;
    }

    if( getvalue( C_EngOilTemp_Fehler) == 0)
    {  
      _m_C_ECM_A1.EngOilTemp = getvalue( C_EngOilTemp);
    }
    else
    {
 //     _m_C_ECM_A1.EngOilTemp = 0xFF;
    }

    if( getvalue( C_EngOilLvl_Fehler) == 0)
    {  
 //     _m_C_ECM_A1.EngOilLvl = getvalue( C_EngOilLvl);
    }
    else
    {
//      _m_C_ECM_A1.EngOilLvl = 0xFF;
    }

    if( getvalue( C_EngOilQual_Fehler) == 0)
    {  
//      _m_C_ECM_A1.EngOilQual = getvalue( C_EngOilQual);
    }
    else
    {
 //     _m_C_ECM_A1.EngOilQual = 0xFF;
    }*/
/*
    if( getvalue( C_FuelCons_Fehler) == 0)               // Verbrauch
    {  
      _m_C_ECM_A1.FuelCons = getvalue( C_FuelCons);
    }
    else
    {
      _m_C_ECM_A1.FuelCons = 0xFFFF;
    }

    if( getvalue( C_EngTrqStatic_Fehler) == 0)
    {  
      _m_C_ENG_RS2.EngTrqStatic = getvalue( C_EngTrqStatic);
    }
    else
    {
      _m_C_ENG_RS2.EngTrqStatic = 0x1FFF;
    }

    if( getvalue( C_EngTrqMax_Fehler) == 0)
    {  
      _m_C_ENG_RS2.EngTrqMax = getvalue( C_EngTrqMax);
    }
    else
    {
      _m_C_ENG_RS2.EngTrqMax = 0x1FFF;
    }

    if( getvalue( C_EngTrqMin_Fehler) == 0)
    {  
      _m_C_ENG_RS2.EngTrqMin = getvalue( C_EngTrqMin);
    }
    else
    {
      _m_C_ENG_RS2.EngTrqMin = 0x1FFF;
    }
*/

    if( getvalue(Env_Adblue_RemainDist_Fehler) == 0)
    {  
      putValue( HMI_Adblue_RemainDist, getvalue(Env_Adblue_RemainDist) );
    }
    else
    {
      putValue( HMI_Adblue_RemainDist, 0xFFFF );
    }

    putValue( HMI_Adblue_WarnLvl1, getvalue(Env_Adblue_WarnLvl1) );
    putValue( HMI_Adblue_WarnLvl2, getvalue(Env_Adblue_WarnLvl2) );
    putValue( HMI_Adblue_WarnLvl3, getvalue(Env_Adblue_WarnLvl3) );
    putValue( HMI_EngSt_Remain, getvalue(Env_EngSt_Remain) );
    putValue( HMI_AdblueEU6_RemainDist, getvalue(Env_AdblueEU6_RemainDist) );
    putValue( HMI_AdblueEU6_ChkMsg_Disp_Rq, getvalue(Env_AdblueEU6_ChkMsg_Disp_Rq) );
    putValue( HMI_AdblueEU6_Msg_Disp_TrgrRq, getvalue(Env_AdblueEU6_Msg_Disp_TrgrRq) );
    putValue( HMI_AdblueEU6_RefillMsg_Disp_Rq, getvalue(Env_AdblueEU6_RefillMsg_Disp_Rq) );

/*
    if( getvalue( C_CNG_TankLvl_Fehler) == 0)
    {  
      _m_C_CNG_DISP_RQ.CNG_TankLvl  = getvalue( C_CNG_TankLvl);
      }
    else
    {
      _m_C_CNG_DISP_RQ.CNG_TankLvl  = 0xFF;
    }

    _m_C_CNG_DISP_RQ.CNG_TankLvl_Min  = getvalue( C_CNG_TankLvl_Min);
    _m_C_CNG_DISP_RQ.CNG_TankCapIndLmp_On_Rq  = getvalue( C_CNG_TankCapIndLmp_On_Rq);
    _m_C_CNG_DISP_RQ.CNG_FuelMd_Stat  = getvalue( C_CNG_FuelMd_Stat);
    _m_C_CNG_DISP_RQ.CNG_FuelMdChg_Actv  = getvalue( C_CNG_FuelMdChg_Actv);
    _m_C_CNG_DISP_RQ.CNG_FuelMd_Disp_Rq  = getvalue( C_CNG_FuelMd_Disp_Rq);
    _m_C_CNG_DISP_RQ.CNG_Msg1_Disp_Rq  = getvalue( C_CNG_Msg1_Disp_Rq);
    _m_C_CNG_DISP_RQ.CNG_Msg2_Disp_Rq  = getvalue( C_CNG_Msg2_Disp_Rq);
    _m_C_CNG_DISP_RQ.CNG_Msg3_Disp_Rq  = getvalue( C_CNG_Msg3_Disp_Rq);
    _m_C_CNG_DISP_RQ.CNG_Msg4_Disp_Rq  = getvalue( C_CNG_Msg4_Disp_Rq);
    _m_C_CNG_DISP_RQ.CNG_Msg5_Disp_Rq  = getvalue( C_CNG_Msg5_Disp_Rq);
    _m_C_CNG_DISP_RQ.CNG_Msg6_Disp_Rq  = getvalue( C_CNG_Msg6_Disp_Rq);
    _m_C_CNG_DISP_RQ.CNG_Msg7_Disp_Rq  = getvalue( C_CNG_Msg7_Disp_Rq);
    _m_C_CNG_DISP_RQ.CNG_Msg8_Disp_Rq  = getvalue( C_CNG_Msg8_Disp_Rq);


    if( getvalue( C_CNG_FuelPress_Fehler) == 0)
    {  
      _m_C_CNG_DISP_RQ.CNG_FuelPress  = getvalue( C_CNG_FuelPress);
        }
    else
    {
      _m_C_CNG_DISP_RQ.CNG_FuelPress  = 0xFF;
        }

*/
/* ist ja jetzt �ber AllMessages_Copy() gleich am Anfang eingebunden

      if( getvalue( C_TC_GasFuelCons_Start_Fehler) == 0)      
    {  
       _m_C_TC_DISP_RQ.TC_GasFuelCons_Start = getvalue( C_TC_GasFuelCons_Start);
    }
    else
    {
       _m_C_TC_DISP_RQ.TC_GasFuelCons_Start = 0x3FF;
    }


    if( getvalue( C_TC_GasFuelCons_Reset_Fehler) == 0)      
    {  
       _m_C_TC_DISP_RQ.TC_GasFuelCons_Reset = getvalue( C_TC_GasFuelCons_Reset);
    }
    else
    {
       _m_C_TC_DISP_RQ.TC_GasFuelCons_Reset = 0x3FF;
    }


    if( getvalue( C_TC_GasFuelCons_Fehler) == 0)      
    {  
       _m_C_TC_DISP_RQ.TC_GasFuelCons = getvalue( C_TC_GasFuelCons);
    }
    else
    {
       _m_C_TC_DISP_RQ.TC_GasFuelCons = 0x3FF;
    }


    if( getvalue( C_TC_GasFuelTankRng_Fehler) == 0)      
    {  
       _m_C_TC_DISP_RQ.TC_GasFuelTankRng = getvalue( C_TC_GasFuelTankRng);
    }
    else
    {
       _m_C_TC_DISP_RQ.TC_GasFuelTankRng = 0x7FF;
    }

     _m_C_TC_DISP_RQ.TC_GasFuelTankLvl_Min_50 = getvalue( C_TC_GasFuelTankLvl_Min_50 );
*/
/*
      if( getvalue( C_MC_ECM_DISP_RQ2_Auto))
        {
      IncMC_ECM_DISP_RQ2();
        }
    _m_C_ECM_DISP_RQ2.MC_ECM_DISP_RQ2 = getvalue( C_MC_ECM_DISP_RQ2);

    if( getvalue( C_PNHV_SupBat_SOC_Disp_Rq_Fehler))
        {
      _m_C_ECM_DISP_RQ2.PNHV_SupBat_SOC_Disp_Rq = 0xFF;
    }
        else
        {
        _m_C_ECM_DISP_RQ2.PNHV_SupBat_SOC_Disp_Rq = getvalue( C_PNHV_SupBat_SOC_Disp_Rq);
          putvalue(C_PNHV_SupBat_SOC_Disp_Rq_Phys,   _m_C_ECM_DISP_RQ2.PNHV_SupBat_SOC_Disp_Rq.Phys);
        }

    if( getvalue( C_PNHV_SupBat_VoltMax_Disp_Rq_Fe))
        {
      _m_C_ECM_DISP_RQ2.PNHV_SupBat_VoltMax_Disp_Rq = 0xFF;
    }
        else
        {
        _m_C_ECM_DISP_RQ2.PNHV_SupBat_VoltMax_Disp_Rq = getvalue( C_PNHV_SupBat_VoltMax_Disp_Rq);
          putvalue(C_PNHV_SupBat_VoltMax_Disp_Rq_Ph, _m_C_ECM_DISP_RQ2.PNHV_SupBat_VoltMax_Disp_Rq.Phys);
        }

    if( getvalue( C_PNHV_SupBat_Curr_Disp_Rq_Fehl))
        {
      _m_C_ECM_DISP_RQ2.PNHV_SupBat_Curr_Disp_Rq = 0xFF;
    }
        else
        {
        _m_C_ECM_DISP_RQ2.PNHV_SupBat_Curr_Disp_Rq = getvalue( C_PNHV_SupBat_Curr_Disp_Rq);
          putvalue(C_PNHV_SupBat_Curr_Disp_Rq_Phys,  _m_C_ECM_DISP_RQ2.PNHV_SupBat_Curr_Disp_Rq.Phys);
        }


    CalcPrtyVoltDown();
    CalcPrtyVoltMax();

    _m_C_ECM_DISP_RQ2.ArrBatDisp_Rq =   getvalue( C_ArrBatDisp_Rq);
    _m_C_ECM_DISP_RQ2.Hyb_Msg_Disp_Rq = getvalue( C_Hyb_Msg_Disp_Rq);
    _m_C_ECM_DISP_RQ2.Hyb_WarnDisp_Rq = getvalue( C_Hyb_WarnDisp_Rq);
    _m_C_ECM_DISP_RQ2.PNHV_VoltDn_Disp_Rq              =   getvalue( C_PNHV_VoltDn_Disp_Rq);
    _m_C_ECM_DISP_RQ2.Prty_PNHV_SupBat_VoltMax_Disp_Rq =   getvalue( C_Prty_PNHV_SupBat_VoltMax_Disp_);
    _m_C_ECM_DISP_RQ2.Prty_PNHV_VoltDn_Disp_Rq         =   getvalue( C_Prty_PNHV_VoltDn_Disp_Rq);
    _m_C_ECM_DISP_RQ2.PT_Rdy_IndLmp_On_Rq              =   getvalue( C_PT_Rdy_IndLmp_On_Rq);


    _m_C_EPKB_DISP_RQ.EPKB_Msg_Disp_Rq = getvalue( C_EPKB_Msg_Disp_Rq);
    _m_C_EPKB_DISP_RQ.PkBrkIndLmp_On_Rq = getvalue( C_PkBrkIndLmp_On_Rq);
    _m_C_EPKB_DISP_RQ.EPKB_Msg_Disp_TrgrRq = getvalue( C_EPKB_Msg_Disp_TrgrRq);
    _m_C_EPKB_DISP_RQ.BrkIndLmp_On_Rq_EPkB = getvalue( C_BrkIndLmp_On_Rq_EPkB);*/
  }
}

on envVar Env_Ign_Switch
{
   if( getvalue(Env_Modus_Manuell ) == 0 )
   {
        if( getValue( this ) > 0 )
      {
//              putValue( Env___start_Stop_DBKom_Timer, 1 );    // start all DBKom timers
      }
      switch( getValue(this) )
      {
        case 0: putValue( HMI_ISw_Stat, 0 );    // Lock
                break;
        case 1: putValue( HMI_ISw_Stat, 1 );    // Off
                break;
        case 2: putValue( HMI_ISw_Stat, 2 );
                break;
        case 3: putValue( HMI_ISw_Stat, 4 );    // Run
                break;
        case 4: putValue( HMI_ISw_Stat, 5 );    // Crank
                break;
      }
   }
}

on envVar HMI_ISw_Stat
{
    if( getvalue( Env_Modus_Manuell ) == 0 )
    {
        switch( getValue(this) )
        {
            case 0: putValue( Env_Ign_Switch, 0 );
                    break;
            case 1: putValue( Env_Ign_Switch, 1 );
                    break;
            case 2: putValue( Env_Ign_Switch, 2 );
                    break;
            case 4: putValue( Env_Ign_Switch, 3 );
                    break;
            case 5: putValue( Env_Ign_Switch, 4 );
                    break;
        }
    }

// function  	: When the Function detects a clamp change to LOCK and automatically ForceDisplMode will activated
//                A timer is started and the timer function "t_ForceDisplayTimer" hadels the HMI_CLkS_Ext_Rq activities
// author    	: Daniel Warnicki 01.11.2012

    // klemp status was changed
    if( getvalue( Env_Power_ForceDisplOffAtKlLock_Auto ) )
    {
        // automatically ForceDisplMode is active
        if( !getvalue( HMI_ISw_Stat ) )
        {
            // klemp switched to lock
			settimer( t_ForceDisplayOffTimer, 500 );
    		write( "KeyRecorder->automatically ForceDisplMode is active start timer CLkS_Ext_Rq activities");
        }
    }
}

on envVar Env_Modus_Manuell
{

    if( getvalue(Env_Modus_Manuell ) == 0 )
    {
    
    }
}

on envVar Env_BS_Raddrehzahlen
{
    putvalue( Env_Hauptpanel_V_Aktiv, 1 );

    if( !getvalue( Env_Modus_Manuell ) )
    {
        CalcRaddrehzahl();
    }
}

on envVar Env_EngRPM
{
    if( getValue( Env_EngRPM_Fehler ) )
    {
        putValue( HMI_EngRPM, 16383 );
    }
    else
    {
        putValue( HMI_EngRPM, getValue(this) );
    }
}

on envVar Env_EngRPM_Fehler
{
    if( getValue( this ) )
    {
        putValue( HMI_EngRPM, 16383 );
    }
    else
    {
        putValue( HMI_EngRPM, getValue( Env_EngRPM ) );
    }
}

on envVar Env_WhlPlsCnt_FL
{
   if( getValue(Env_WhlPlsCnt_FL_Fehler) )
   {
      putValue( HMI_WhlPlsCnt_FL, 255 );
   }
   else
   {
      putValue( HMI_WhlPlsCnt_FL, getValue(this) );
   }
}

on envVar Env_WhlPlsCnt_FL_Fehler
{
    if( getValue(this) )
    {
        putValue( HMI_WhlPlsCnt_FL, 255 );
    }
    else
    {
        putValue( HMI_WhlPlsCnt_FL, getValue( Env_WhlPlsCnt_FL ) );
    }
}

on envVar Env_WhlPlsCnt_FR
{
    if( getValue(Env_WhlPlsCnt_FR_Fehler) )
    {
        putValue( HMI_WhlPlsCnt_FR, 255 );
    }
    else
    {
        putValue( HMI_WhlPlsCnt_FR, getValue(this) );
    }
}

on envVar Env_WhlPlsCnt_FR_Fehler
{
    if( getValue(this) )
    {
        putValue( HMI_WhlPlsCnt_FR, 255 );
    }
    else
    {
        putValue( HMI_WhlPlsCnt_FR, getValue( Env_WhlPlsCnt_FR ) );
    }
}

on envVar Env_WhlPlsCnt_RL
{
    if( getValue(Env_WhlPlsCnt_RL_Fehler) )
    {
        putValue( HMI_WhlPlsCnt_RL, 255 );
    }
    else
    {
        putValue( HMI_WhlPlsCnt_RL, getValue(this) );
    }
}

on envVar Env_WhlPlsCnt_RL_Fehler
{
   if( getValue(this) )
   {
      putValue( HMI_WhlPlsCnt_RL, 255 );
   }
   else
   {
      putValue( HMI_WhlPlsCnt_RL, getValue( Env_WhlPlsCnt_RL ) );
   }
}

on envVar Env_WhlPlsCnt_RR
{
   if( getValue(Env_WhlPlsCnt_RR_Fehler) )
   {
      putValue( HMI_WhlPlsCnt_RR, 255 );
   }
   else
   {
      putValue( HMI_WhlPlsCnt_RR, getValue(this) );
   }
}

on envVar Env_WhlPlsCnt_RR_Fehler
{
   if( getValue(this) )
   {
      putValue( HMI_WhlPlsCnt_RR, 255 );
   }
   else
   {
      putValue( HMI_WhlPlsCnt_RR, getValue( Env_WhlPlsCnt_RR ) );
   }
}

on envVar Env_WhlRPM_FL
{
   if( getValue(Env_WhlRPM_FL_Fehler) )
   {
      putValue( HMI_WhlRPM_FL, 8191.5 );
   }
   else
   {
      putValue( HMI_WhlRPM_FL, getValue(this) );
   }
}

on envVar Env_WhlRPM_FL_Fehler
{
   if( getValue(this) )
   {
      putValue( HMI_WhlRPM_FL, 16383.5 );
   }
   else
   {
      putValue( HMI_WhlRPM_FL, getValue( Env_WhlRPM_FL ) );
   }
}

on envVar Env_WhlRPM_FR
{
   if( getValue(Env_WhlRPM_FR_Fehler) )
   {
      putValue( HMI_WhlRPM_FR, 16383.5 );
   }
   else
   {
      putValue( HMI_WhlRPM_FR, getValue(this) );
   }
}

on envVar Env_WhlRPM_FR_Fehler
{
   if( getValue(this) )
   {
      putValue( HMI_WhlRPM_FR, 16383.5 );
   }
   else
   {
      putValue( HMI_WhlRPM_FR, getValue( Env_WhlRPM_FR ) );
   }
}

on envVar Env_WhlRPM_RL
{
   if( getValue(Env_WhlRPM_RL_Fehler) )
   {
      putValue( HMI_WhlRPM_RL, 16383.5 );
   }
   else
   {
      putValue( HMI_WhlRPM_RL, getValue(this) );
   }
}

on envVar Env_WhlRPM_RL_Fehler
{
   if( getValue(this) )
   {
      putValue( HMI_WhlRPM_RL, 16383.5 );
   }
   else
   {
      putValue( HMI_WhlRPM_RL, getValue( Env_WhlRPM_RL ) );
   }
}

on envVar Env_WhlRPM_RR
{
   if( getValue(Env_WhlRPM_RR_Fehler) )
   {
      putValue( HMI_WhlRPM_RR, 16383.5 );
   }
   else
   {
      putValue( HMI_WhlRPM_RR, getValue(this) );
   }
}

on envVar Env_WhlRPM_RR_Fehler
{
   if( getValue(this) )
   {
      putValue( HMI_WhlRPM_RR, 16383.5 );
   }
   else
   {
      putValue( HMI_WhlRPM_RR, getValue( Env_WhlRPM_RR ) );
   }
}

on envVar Env_EngCoolTemp
{
   if( getValue( Env_EngCoolTemp_Fehler ) )
   {
      putValue( HMI_EngCoolTemp, 215 );
   }
   else
   {
      putValue( HMI_EngCoolTemp, getValue(this) );
   }
}

on envVar Env_EngCoolTemp_Fehler
{
   if( getValue(this) )
   {
      putValue( HMI_EngCoolTemp, 215 );
   }
   else
   {
      putValue( HMI_EngCoolTemp, getValue( Env_EngCoolTemp ) );
   }
}

on preStart
{
    //Create a new tab at the write window
    dwWriteSinkSimu= writeCreate("Stresstest");

    //Clear content of CAPL tab on write window
    writeclear(dwWriteSinkCapl);

    writeLineEx(dwWriteSinkSimu, dwWriteSeveritySuccess, "");
    writeLineEx(dwWriteSinkSimu, dwWriteSeveritySuccess, "     +------------+");
    writeLineEx(dwWriteSinkSimu, dwWriteSeveritySuccess, "     | Stresstest |");
    writeLineEx(dwWriteSinkSimu, dwWriteSeveritySuccess, "     +------------+");
    writeLineEx(dwWriteSinkSimu, dwWriteSeveritySuccess, "");

    Stress__WriteSinkAll();

    if( getvalue( Env_Stress__StresstestMainActiv ))
    {
        writeLineEx(dwWriteSinkSimu, dwWriteSeveritySuccess, "\n        started\n");
    }
}

on start
{
    putValue( Env_Power__PowertestMainActiv, 0 );
    putValue( HMI_WhlDir_FL_Stat, 1 );
    putValue( HMI_WhlDir_RL_Stat, 1 );
    putValue( HMI_WhlDir_FR_Stat, 1 );
    putValue( HMI_WhlDir_RR_Stat, 1 );
    putValue( HMI_WhlRPM_FL_Qual, 1 );
    putValue( HMI_WhlRPM_RL_Qual, 1 );
    putValue( HMI_WhlRPM_FR_Qual, 1 );
    putValue( HMI_WhlRPM_RR_Qual, 1 );
    putValue( Env_EngCoolTemp_Disp_Rq, 50 );
    putValue( Env_EngCoolTemp_Disp_Rq_Fehler, 0 );
	  putValue( HMI_EngRPM_Dyn_Disp_Rq, 0 );
	  putValue( HMI_PNHV_Perf_Total_Disp_Rq, 0 );
    putValue( Env_EngRPM, 0 );
    putValue( Env_PnhvRPM, 0 );
    putValue( Env_EngRPM_Fehler, 0 );
    putValue( Env_PnhvRPM_Fehler, 0 );
    putValue( HMI_TurnLmpOnDur, 0x3C /* 60 dez */ );
    putValue( Env_TurnLmpOnDur, 0x3C /* 60 dez */ );
    putValue( HMI_Teleaid_RD_A, 1 );
    putValue( Env_Ign_Switch, 0 );
    putValue( HMI_ISw_Stat, 0 );
    cancelTimer( t_ForceDisplayOffTimer ); // stop running timer
	  putValue( Env_Power_ForceDisplOffAtKlLock_Auto, 0 );// turn automatically ForceDisplAtKlLock off

//    putValue( Env_KeyId_EIS_V2_Byte2, 255 );
    KeyIdByte1 = getvalue( Env_KeyId_EIS_V2_Byte1 );
    KeyIdByte2 = getvalue( Env_KeyId_EIS_V2_Byte2 ) * 0x100;
    KeyIdByte3 = getvalue( Env_KeyId_EIS_V2_Byte3 ) * 0x10000;
    KeyIdByte4 = getvalue( Env_KeyId_EIS_V2_Byte4 ) * 0x1000000;
  
    putValue( HMI_KeyId_EIS_V2, ( KeyIdByte4 + KeyIdByte3 + KeyIdByte2 + KeyIdByte1 ) );
/*    putValue( ,  );
    putValue( ,  );*/


//    putValue( Env___start_Stop_DBKom_Timer, 1 );    // start all DBKom timers

//    writeLineEx(dwWriteSinkSimu, dwWriteSeverityInfo, "      read Stress Test INI-file");
    Stress__iniReadAll("ini_data\\Stresstest.ini");
    Stress__CheckAll();

//    writeLineEx(dwWriteSinkSimu, dwWriteSeverityInfo, "      read Power Test INI-file");
    Power__iniReadAll("ini_data\\Powertest.ini");

//    writeLineEx(dwWriteSinkSimu, dwWriteSeverityInfo, "      read OFN data INI-file");
    OFN__iniReadAll("ini_data\\OFN_Gesture_Data.ini");

//    writeLineEx(dwWriteSinkSimu, dwWriteSeverityInfo, "      read Config data INI-file");
    Config__iniReadAll("ini_data\\Config_Data.ini");

    setTimer( tPC_Time_read, 100 );

    setTimer( t_Auto_Project_SelectorTimer, 10 );

    closePanel("ADC_Simulation_Main");
  
    putValue(HMI_LDC_SPEEDO_SegRing_Disp_Rq, 0);
    putValue(HMI_LDC_IconDisp_Rq_ESP, 0);
    putValue(HMI_LDC_Spd_Add, 0);
    putValue(HMI_LDC_Spd_Dsr, 0);
    putValue(Env_Type_Select, 0);
  
    putValue(Env_Speed_Low, 0);
    putValue(Env_Speed_High, 0);
  
    Remember_Speed_Low = 0;
    Remember_Speed_High = 0;
    Remember_Type_select = 0;
    Remember_Now_active = 0;
}

on timer _tTurnIndTimerOn
{
    putValue( Env_Panel_TurnInd_Right_On, 0 );
    putValue( Env_Panel_TurnInd_Left_On, 0 );
    // shut off indicators on Panel !!!
}

on envVar Env_TurnLmpOnDur
{
    putValue( HMI_TurnLmpOnDur, getValue(this)*10 );
    if( getValue( Env_TurnInd_Lt_On ) || getValue( Env_TurnInd_Rt_On ) )
    {
        putValue( HMI__STMSP_EL_TurnInd_Rq_AR, 1);
        if( getValue( this ) > 0 )
        {
            setTimer( _tTurnIndTimerOn, getValue( this )*10 );  //  set ON-time
            setTimer( _tTurnIndTimerReload, getValue( this )*20 );  //  set Peride
        }
        else
        {
            Write(" !!! Turn idicator timer not started !!!  ( time = %d )", getValue(this) );
        }
    }
}

on timer _tTurnIndTimerReload
{
    word temp;

    wtemp = getValue( Env_TurnLmpOnDur );
    if( getValue( HMI_TurnLmpOnDur ) > 0 )
    {
        setTimer( _tTurnIndTimerOn, wtemp*10 );  //  set ON-time
        setTimer( _tTurnIndTimerReload, wtemp*20 );  //  set Peride
    }
    if( getValue( Env_TurnInd_Lt_On ) )
    {
        putValue( Env_Panel_TurnInd_Left_On, 1);
        putValue( HMI_TurnInd_FL_On_Rq, 1 );
    }
    if( getValue( Env_TurnInd_Rt_On ) )
    {
        putValue( Env_Panel_TurnInd_Right_On, 1);
        putValue( HMI_TurnInd_FR_On_Rq, 1 );
    }
    putValue( HMI__STMSP_EL_TurnInd_Rq_AR, 1);
}

on envVar Env_TurnInd_Rt_On
{
    if( getValue( this ) )
    {
        if( getValue( HMI_TurnLmpOnDur ) > 0 )
        {
            setTimer( _tTurnIndTimerOn, getValue( Env_TurnLmpOnDur )*10 );  //  set ON-time
            setTimer( _tTurnIndTimerReload, getValue( Env_TurnLmpOnDur )*20 );  //  set Periode
        }
        putValue( HMI_TurnLmpOnDur, getValue( Env_TurnLmpOnDur ) * 10 );
        putValue( Env_Panel_TurnInd_Right_On, 1 );
    }
    else
    {
        putValue( Env_Panel_TurnInd_Right_On, 0 );
        if( getValue( Env_TurnInd_Lt_On ) == 0 )//turn off ind and stop timer if all off
        {
            cancelTimer( _tTurnIndTimerOn );  //  reset ON-time
            cancelTimer( _tTurnIndTimerReload );  //  reset Periode
        }
    }
    putValue( HMI_TurnInd_FR_On_Rq, getValue(this) );
    putValue( HMI__STMSP_EL_TurnInd_Rq_AR, 1);
}

on envVar Env_TurnInd_Lt_On
{
    if( getValue( this ) )
    {
        if( getValue( HMI_TurnLmpOnDur ) > 0 )
        {
            setTimer( _tTurnIndTimerOn, getValue( Env_TurnLmpOnDur )*10 );  //  set ON-time
            setTimer( _tTurnIndTimerReload, getValue( Env_TurnLmpOnDur )*20 );  //  set Periode
        }
        putValue( HMI_TurnLmpOnDur, getValue( Env_TurnLmpOnDur ) * 10 );
        putValue( Env_Panel_TurnInd_Left_On, 1 );
    }
    else
    {
        putValue( Env_Panel_TurnInd_Left_On, 0 );
        if( getValue( Env_TurnInd_Rt_On ) == 0 )//turn off ind and stop timer if all off
        {
            cancelTimer( _tTurnIndTimerOn );  //  reset ON-time
            cancelTimer( _tTurnIndTimerReload );  //  reset Periode
        }
    }
    putValue( HMI_TurnInd_FL_On_Rq, getValue(this) );
    putValue( HMI__STMSP_EL_TurnInd_Rq_AR, 1);
}

on timer _tIgnSwitchOff_duration_msec
{
    word temp, temp_msec, temp_min;
    dword AbsStart_Time;
    dword AbsStop_Time;
    dword Actual_Time;

    AbsStart_Time = getValue( Env_Power_Off_Min_Start ) * 60000 + getValue( Env_Power_Off_Msec_Start );
    AbsStop_Time = getValue( Env_Power_Off_Min_Stop ) * 60000 + getValue( Env_Power_Off_Msec_Stop );
    if( IgnSwitchOff_delay > 0 )                    // still some minutes missing
    {
        if( getValue( Env_Power__PowertestMainActiv ) )
            setTimer( _tIgnSwitchOff_duration_msec, IgnSwitchOff_delay );      // delay periode
        IgnSwitchOff_delay = 0;
        return;
    }
    if( IgnSwitchOff_duration_minute > 0 )                    // still some minutes missing?
    {
        IgnSwitchOff_duration_minute--;
        cancelTimer( _tIgnSwitchOff_duration_msec );
        if( getValue( Env_Power__PowertestMainActiv ) )
            setTimer( _tIgnSwitchOff_duration_msec, 60000 );      // 1 minute periode
    }
    else                                                    // timer elapsed, prepare next phase
    {
        StopTime = timeNow();
    Trace("IgnSwitch  Off --> Lock ", "");
        putValue( Env_Ign_Switch, 0 );        // switch PowerMode to RUN       
        if( getValue( DIAG_LOG_OneShotLogLinkedToIgnSwitch ) )
        {
            putValue( DIAG_LOG_SessionActiv, 0 );
        }                                    // switch Ign_Switch to next value
        boWaitForIC_Sleep = True;

        if( getValue( Env_Power_Off_IncDec ) > 0 )
        {
            temp_min = getValue( Env_Power_Off_Min );
            temp_msec = getValue( Env_Power_Off_Msec );
            Actual_Time = temp_min *60000 + temp_msec;
//          wtemp = getValue( Env_Power_Off_Msec_Step );
            // Inc / Dec Handling has to be done
            if( getValue( Env_Power_Off_IncDec ) == 1 )
            {    // Inc
                Actual_Time = Actual_Time + getValue( Env_Power_Off_Msec_Step );
                // Begrenzung auf Stop-Zeit
                if( Actual_Time > AbsStop_Time )
                {
                    Actual_Time = Actual_Time - AbsStop_Time + AbsStart_Time;
                }
            }
            else
            {    // Dec
                Actual_Time = Actual_Time - getValue( Env_Power_Off_Msec_Step );
                // Begrenzung auf Stop-Zeit
                if( Actual_Time < AbsStart_Time )
                {
                    Actual_Time = Actual_Time + AbsStop_Time - AbsStart_Time;
                }
            }
            putValue( Env_Power_Off_Min, ( Actual_Time / 60000 ) );
            putValue( Env_Power_Off_Msec, ( Actual_Time - ( getValue( Env_Power_Off_Min ) * 60000 )));
        }                                       // switch Ign_Switch to next value
        IgnSwitchLock_duration_minute = getValue( Env_Power_Lock_Min ); //restore orig value
//        IgnSwitchLock_duration_msec = getValue( Env_Power_Lock_Msec ); //restore orig value
        wtemp = getValue( Env_Power_Lock_Msec );                        // get msec value from Panel
        if( wtemp == 0 )                                                // if zero, chek Minute-value
        {
            wtemp = getValue( Env_Power_Lock_Min );
            if( wtemp == 0 )                                            // check minute-value of Timer
            {
                wtemp = 1;                                            // .. is also zero : set 1msec
            }
            else
            {
                wtemp = 60000;                                        // .. is not zero: so enter 1 minute
                IgnSwitchLock_duration_minute--;                        // and adjust counter
            }
        }
    if( getValue( Env_Power__PowertestMainActiv ) )
        setTimer( _tIgnSwitchLock_duration_msec, wtemp );    // set Timer for next phase "Off"
    }
}

on envVar HMI__NM_EIS_ActualState
{
  if( boWaitForIC_Sleep)
  {
    if( getvalue(this) == 1)
    {
      LastNMTime = timeNow();
      diff = (LastNMTime - StopTime) / 100;
      putValue(Env_NMGoToSleepTime, diff);
      write("Ign        NM needs to go to Sleep %ld ms", diff);


      IgnSwitchLock_duration_minute = getValue( Env_Power_Lock_Min ); //restore orig value
      wtemp = getValue( Env_Power_Lock_Msec );                        // get msec value from Panel
      if( wtemp == 0 )                                                // if zero, chek Minute-value
      {
        wtemp = getValue( Env_Power_Lock_Min );
        if( wtemp == 0 )                                            // check minute-value of Timer
        {
          wtemp = 1;                                            // .. is also zero : set 1msec
        }
        else
        {
          wtemp = 60000;                                        // .. is not zero: so enter 1 minute
          IgnSwitchLock_duration_minute--;                        // and adjust counter
        }
      }
      if( getValue( Env_Power__PowertestMainActiv ) )
          setTimer( _tIgnSwitchLock_duration_msec, wtemp );    // set Timer for next phase "Off"
      boWaitForIC_Sleep = False;
      Trace("Ign        IC NM sleeps - Lock time starts", "");
    }
  }
}

on timer _tIgnSwitchOn_duration_msec
{
    word temp, temp_msec, temp_min;
    dword AbsStart_Time;
    dword AbsStop_Time;
    dword Actual_Time;

    AbsStart_Time = getValue( Env_Power_On_Min_Start ) * 60000 + getValue( Env_Power_On_Msec_Start );
    AbsStop_Time = getValue( Env_Power_On_Min_Stop ) * 60000 + getValue( Env_Power_On_Msec_Stop );
    if( IgnSwitchOn_delay > 0 )                    // still some minutes missing
    {
        if( getValue( Env_Power__PowertestMainActiv ) )
            setTimer( _tIgnSwitchOn_duration_msec, IgnSwitchOn_delay );      // delay periode
        IgnSwitchOn_delay = 0;
        return;
    }
    if( IgnSwitchOn_duration_minute > 0 )                    // still some minutes missing?
    {
        IgnSwitchOn_duration_minute--;
        cancelTimer( _tIgnSwitchOn_duration_msec );
        if( getValue( Env_Power__PowertestMainActiv ) )
            setTimer( _tIgnSwitchOn_duration_msec, 60000 );      // 1 minute periode
    }
    else                                                    // timer elapsed, prepare next phase
    {
        Trace("IgnSwitch  On --> Off ", "" );
        putValue( Env_Ign_Switch, 1 );        // switch PowerMode to RUN                                       // switch Ign_Switch to next value
        putValue( DIAG_WEM_ReadStatus_Trigger, 0 );
        if( getValue( Env_Power_On_IncDec ) > 0 )
        {
            temp_min = getValue( Env_Power_On_Min );
            temp_msec = getValue( Env_Power_On_Msec );
            Actual_Time = temp_min *60000 + temp_msec;
//          wtemp = getValue( Env_Power_On_Msec_Step );
            // Inc / Dec Handling has to be done
            if( getValue( Env_Power_On_IncDec ) == 1 )
            {    // Inc
                Actual_Time = Actual_Time + getValue( Env_Power_On_Msec_Step );
                // Begrenzung auf Stop-Zeit
                if( Actual_Time > AbsStop_Time )
                {
                    Actual_Time = Actual_Time - AbsStop_Time + AbsStart_Time;
                }
            }
            else
            {    // Dec
                Actual_Time = Actual_Time - getValue( Env_Power_On_Msec_Step );
                // Begrenzung auf Stop-Zeit
                if( Actual_Time < AbsStart_Time )
                {
                    Actual_Time = Actual_Time + AbsStop_Time - AbsStart_Time;
                }
            }
            putValue( Env_Power_On_Min, ( Actual_Time / 60000 ) );
            putValue( Env_Power_On_Msec, ( Actual_Time - ( getValue( Env_Power_On_Min ) * 60000 )));
        }                                       // switch Ign_Switch to next value
        IgnSwitchOff_duration_minute = getValue( Env_Power_Off_Min ); //restore orig value
//        IgnSwitchOff_duration_msec = getValue( Env_Power_Off_Msec ); //restore orig value
        wtemp = getValue( Env_Power_Off_Msec );                        // get msec value from Panel
        if( wtemp == 0 )                                                // if zero, chek Minute-value
        {
            wtemp = getValue( Env_Power_Off_Min );
            if( wtemp == 0 )                                            // check minute-value of Timer
            {
                wtemp = 1;                                            // .. is also zero : set 1msec
            }
            else
            {
                wtemp = 60000;                                        // .. is not zero: so enter 1 minute
                IgnSwitchOff_duration_minute--;                        // and adjust counter
            }
        }
        if( getValue( Env_Power__PowertestMainActiv ) )
            setTimer( _tIgnSwitchOff_duration_msec, wtemp );    // set Timer for next phase "Off"
    }
}

on timer _tIgnSwitchLock_duration_msec
{
    word temp, temp_msec, temp_min;
    dword AbsStart_Time;
    dword AbsStop_Time;
    dword Actual_Time;

    AbsStart_Time = getValue( Env_Power_Lock_Min_Start ) * 60000 + getValue( Env_Power_Lock_Msec_Start );
    AbsStop_Time = getValue( Env_Power_Lock_Min_Stop ) * 60000 + getValue( Env_Power_Lock_Msec_Stop );
    if( IgnSwitchLock_delay > 0 )                    // still some minutes missing
    {
        if( getValue( Env_Power__PowertestMainActiv ) )
            setTimer( _tIgnSwitchLock_duration_msec, IgnSwitchLock_delay );      // delay periode
        IgnSwitchLock_delay = 0;
        return;
    }
    if( IgnSwitchLock_duration_minute > 0 )                    // still some minutes missing?
    {
        IgnSwitchLock_duration_minute--;
        if( getValue( Env_Power__PowertestMainActiv ) )
            setTimer( _tIgnSwitchLock_duration_msec, 60000 );      // 1 minute periode
    }
    else                                                    // timer elapsed, prepare next phase
    {
        Trace("IgnSwitch  Lock --> On ", "");
        putValue( Env_Ign_Switch, 3 );        // switch PowerMode to RUN
        putValue( HMI_ISw_Stat, 3 );        // switch PowerMode to RUN
        if( getValue( DIAG_WEM_ReadStatus_AutomaticRequest ) > 0 )
        {
            setTimer( _tWemStatusRead_Trigger, getValue( DIAG_WEM_ReadStatus_Timer ) );
            write("WEM ReadTimer set with %d msec: ", getValue( DIAG_WEM_ReadStatus_Timer ) );
        }
        First = 1;             // Status f�r WakeUp-Messung setzen
        StartTime = timeNow(); // Zeit festhalten, f�r WakeUp-Messung
        if( getValue( Env_Power__PowertestMainActiv ) )
        {
            setTimer( _tPowerOnToLogDelay, _cPowerOnToLogDelay );
            setTimer( _t_Power_CheckCommActive, _c_Power_CheckCommActive ); // arm timer for checking if IC is answering
//        setTimer( _tPowerTst_Sample_Meas03, _cPowerTst_Sample_Meas03 ); // arm timer for checking display content
        }
        if( getValue( Env_Power_Lock_IncDec ) > 0 )
        {
            temp_min = getValue( Env_Power_Lock_Min );
            temp_msec = getValue( Env_Power_Lock_Msec );
            Actual_Time = temp_min *60000 + temp_msec;
//          wtemp = getValue( Env_Power_Lock_Msec_Step );
            // Inc / Dec Handling has to be done
            if( getValue( Env_Power_Lock_IncDec ) == 1 )
            {    // Inc
                Actual_Time = Actual_Time + getValue( Env_Power_Lock_Msec_Step );
                // Begrenzung auf Stop-Zeit
                if( Actual_Time > AbsStop_Time )
                {
                    Actual_Time = Actual_Time - AbsStop_Time + AbsStart_Time;
                }
            }
            else
            {    // Dec
                Actual_Time = Actual_Time - getValue( Env_Power_Lock_Msec_Step );
                // Begrenzung auf Stop-Zeit
                if( Actual_Time < AbsStart_Time )
                {
                    Actual_Time = Actual_Time + AbsStop_Time - AbsStart_Time;
                }
            }
            putValue( Env_Power_Lock_Min, ( Actual_Time / 60000 ) );
            putValue( Env_Power_Lock_Msec, ( Actual_Time - ( getValue( Env_Power_Lock_Min ) * 60000 )));
        }                                       // switch Ign_Switch to next value
        IgnSwitchOn_duration_minute = getValue( Env_Power_On_Min ); //restore orig value
//        IgnSwitchOn_duration_msec = getValue( Env_Power_On_Msec ); //restore orig value
        wtemp = getValue( Env_Power_On_Msec );                        // get msec value from Panel
        if( wtemp == 0 )                                                // if zero, chek Minute-value
        {
            wtemp = getValue( Env_Power_On_Min );
            if( wtemp == 0 )                                            // check minute-value of Timer
            {
                wtemp = 1;                                            // .. is also zero : set 1msec
            }
            else
            {
                wtemp = 60000;                                        // .. is not zero: so enter 1 minute
                IgnSwitchOn_duration_minute--;                        // and adjust counter
            }
        } 
        if( getValue( Env_Power__PowertestMainActiv ) )
            setTimer( _tIgnSwitchOn_duration_msec, wtemp );    // set Timer for next phase "Off"
    }
}

on envVar Env_Power__PowertestMainActiv
{
    word temp;
    if(  getValue(this) )
    {

        switch(getValue( HMI_ISw_Stat ))
          {
          case 0:       // Lock
            setTimer( _tIgnSwitchLock_duration_msec, _c_Powertest_InitialReactionTime_msec );      
            IgnSwitchLock_duration_minute = 0;
            break;
          case 1:       // Off
            setTimer( _tIgnSwitchOff_duration_msec, _c_Powertest_InitialReactionTime_msec );
            IgnSwitchOff_duration_minute = 0;
                    break;
          case 2:       // Acc
            setTimer( _tIgnSwitchOn_duration_msec, _c_Powertest_InitialReactionTime_msec );      
            IgnSwitchOn_duration_minute = 0;
                    break;
          case 4:       // Run
            setTimer( _tIgnSwitchOn_duration_msec, _c_Powertest_InitialReactionTime_msec );      
            IgnSwitchOn_duration_minute = 0;
                    break;
          case 5:       // Crank
            setTimer( _tIgnSwitchOn_duration_msec, _c_Powertest_InitialReactionTime_msec );      
            IgnSwitchOn_duration_minute = 0;
                    break;
        }
            Trace("Stopmode Test started ", "");

    /*    
    IgnSwitchOn_duration_minute = getValue( Env_Power_Lock_Min );
    
        wtemp  = getValue( Env_Power_Lock_Msec );
        if( wtemp > 0 )                    // still some minutes missing?
        {
            setTimer( _tIgnSwitchOn_duration_msec, wtemp );      
        }
        else
        {
            IgnSwitchOn_duration_minute--;
            setTimer( _tIgnSwitchOn_duration_msec, 60000 );      // 1 minute periode
        }
    */
    }
    else
    {
        cancelTimer( _tIgnSwitchOn_duration_msec );
        cancelTimer( _tIgnSwitchOff_duration_msec );
        cancelTimer( _tIgnSwitchLock_duration_msec );
        cancelTimer( _t_Power_CheckCommActive );
        cancelTimer( _tPowerTst_Sample_Meas03 );
    }
}    

on envVar Env_Power__SaveParameters
{
    if( getvalue( this ))
    {
        Power__iniWriteAll("ini_data\\Powertest.ini");
    }    
}

Power__iniWriteAll (char iniFilename[])
{
      char buffer [256];
   
      // Schreibe zwei INT-Paramter und einen String in die 
      // INI-Datei "Test.Ini".
      //  "WritePara1",
      //  "WritePara2", 
      //  "WriteMessage"   (Sektion "Output") 

      //
      // Wird der Pfad fuer die Schreiboperation nicht explizit 
      // gesetzt, so wird der Pfad der Konfigurationsdatei heran-
      // gezogen.
      // 
      snprintf (buffer,elcount(buffer),"%d",readPara1);
      writeProfileString ( "Output","WritePara1", buffer, iniFilename );

      snprintf (buffer,elcount(buffer),"%d",readPara2);
      writeProfileString ( "Output","WritePara2", buffer, iniFilename );

      writeProfileInt    ( "Output","WriteInt1", readPara1, iniFilename );
      writeProfileInt    ( "Output","WriteInt2", readPara2, iniFilename );
      writeProfileString ( "Output","WriteMessage", "TestString", iniFilename );

    lWriteError = 1; // 0 = Error while writing ini-file

    strncpy( func, "Power", 20 );    // Name of functionality

    if( lWriteError != 0)    lWriteError = writeProfileInt( func, "Power_On_Min",                 getValue( Env_Power_On_Min ),               iniFilename );
    if( lWriteError != 0)    lWriteError = writeProfileInt( func, "Power_On_Msec",                getValue( Env_Power_On_Msec ),              iniFilename );
    if( lWriteError != 0)    lWriteError = writeProfileInt( func, "Power_On_IncDec",              getValue( Env_Power_On_IncDec ),            iniFilename );
    if( lWriteError != 0)    lWriteError = writeProfileInt( func, "Power_On_Msec_Step",           getValue( Env_Power_On_Msec_Step ),         iniFilename );
    if( lWriteError != 0)    lWriteError = writeProfileInt( func, "Power_Off_Min",                getValue( Env_Power_Off_Min ),              iniFilename );
    if( lWriteError != 0)    lWriteError = writeProfileInt( func, "Power_Off_Msec",               getValue( Env_Power_Off_Msec ),             iniFilename );
    if( lWriteError != 0)    lWriteError = writeProfileInt( func, "Power_Off_IncDec",             getValue( Env_Power_Off_IncDec ),           iniFilename );
    if( lWriteError != 0)    lWriteError = writeProfileInt( func, "Power_Off_Msec_Step",          getValue( Env_Power_Off_Msec_Step ),        iniFilename );
    if( lWriteError != 0)    lWriteError = writeProfileInt( func, "Power_Lock_Min",               getValue( Env_Power_Lock_Min ),             iniFilename );
    if( lWriteError != 0)    lWriteError = writeProfileInt( func, "Power_Lock_Msec",              getValue( Env_Power_Lock_Msec ),            iniFilename );
    if( lWriteError != 0)    lWriteError = writeProfileInt( func, "Power_Lock_IncDec",            getValue( Env_Power_Lock_IncDec ),          iniFilename );
    if( lWriteError != 0)    lWriteError = writeProfileInt( func, "Power_Lock_Msec_Step",         getValue( Env_Power_Lock_Msec_Step ),       iniFilename );
    if( lWriteError != 0)    lWriteError = writeProfileInt( func, "Power__PowertestMainActiv",    getValue( Env_Power__PowertestMainActiv ),  iniFilename );
    if( lWriteError != 0)    lWriteError = writeProfileInt( func, "Power_On_Min_Start",           getValue( Env_Power_On_Min_Start ),         iniFilename );
    if( lWriteError != 0)    lWriteError = writeProfileInt( func, "Power_On_Msec_Start",          getValue( Env_Power_On_Msec_Start ),        iniFilename );
    if( lWriteError != 0)    lWriteError = writeProfileInt( func, "Power_On_Min_Stop",            getValue( Env_Power_On_Min_Stop ),          iniFilename );
    if( lWriteError != 0)    lWriteError = writeProfileInt( func, "Power_On_Msec_Stop",           getValue( Env_Power_On_Msec_Stop ),         iniFilename );
    if( lWriteError != 0)    lWriteError = writeProfileInt( func, "Power_Off_Min_Start",          getValue( Env_Power_Off_Min_Start ),        iniFilename );
    if( lWriteError != 0)    lWriteError = writeProfileInt( func, "Power_Off_Msec_Start",         getValue( Env_Power_Off_Msec_Start ),       iniFilename );
    if( lWriteError != 0)    lWriteError = writeProfileInt( func, "Power_Off_Min_Stop",           getValue( Env_Power_Off_Min_Stop ),         iniFilename );
    if( lWriteError != 0)    lWriteError = writeProfileInt( func, "Power_Off_Msec_Stop",          getValue( Env_Power_Off_Msec_Stop ),        iniFilename );
    if( lWriteError != 0)    lWriteError = writeProfileInt( func, "Power_Lock_Min_Start",         getValue( Env_Power_Lock_Min_Start ),       iniFilename );
    if( lWriteError != 0)    lWriteError = writeProfileInt( func, "Power_Lock_Msec_Start",        getValue( Env_Power_Lock_Msec_Start ),      iniFilename );
    if( lWriteError != 0)    lWriteError = writeProfileInt( func, "Power_Lock_Min_Stop",          getValue( Env_Power_Lock_Min_Stop ),        iniFilename );
    if( lWriteError != 0)    lWriteError = writeProfileInt( func, "Power_Lock_Msec_Stop",         getValue( Env_Power_Lock_Msec_Stop ),       iniFilename );



    if( lWriteError == 0 )    write( "!! Error while writing INI-file !!" );
}

on message NM_IC_AR
{
    if( getValue( Env_Ign_Switch ) == 0 )
    {
        cancelTimer( _tNM_COM_StayActiveTimer );
        setTimer( _tNM_COM_StayActiveTimer, _cNM_COM_StayActiveTimer );
    }
    cancelTimer( _t_Power_CheckCommActive );

    if(First) // first NM message after wakeup
    {
        FirstNMTime = timeNow();
        diff = (FirstNMTime - StartTime) / 100;
        putValue(Env_WakeupTime, diff);
        // WriteParametersToLog();
        write("Ign        WakeUp took %ld ms", diff);
        First = 0;
    }
}

on timer _t_Power_CheckCommActive
{
    cancelTimer( _tIgnSwitchOn_duration_msec );
    cancelTimer( _tIgnSwitchOff_duration_msec );
    cancelTimer( _tIgnSwitchLock_duration_msec );
    Trace("ERROR !!!    IC doesn't wake up     !!!", "");
    Trace("Stopmode Test halted ", "");
}

on timer _tNM_COM_StayActiveTimer
{
//    putValue( Env___start_Stop_DBKom_Timer, 0 );
}

on errorPassive
{
}

on message IC_DriveAssistSys_AR
{
    if( getValue( Env_Ign_Switch ) == 0 )
    {
        cancelTimer( _tNM_COM_StayActiveTimer );
        setTimer( _tNM_COM_StayActiveTimer, _cNM_COM_StayActiveTimer );
    }
    cancelTimer( _t_Power_CheckCommActive );
}

Power__iniReadAll (char iniFilename[])
{
      // Lese zwei INT-Parameter aus der INI Datei "Test.Ini" :
      //  "ReadPara1",
      //  "ReadPara2".     (Sektion "Input")
      // 
      readPara1 = getProfileInt("Input","ReadPara1",defVal,iniFilename );
      readPara2 = getProfileInt("Input","ReadPara2",defVal,iniFilename );
      //
      // Wird der Pfad fuer die Schreiboperation nicht explizit 
      // gesetzt, so wird der Pfad der Konfigurationsdatei heran-
      // gezogen.
      // 
//    writeLineEx(dwWriteSinkSimu, dwWriteSeverityInfo, "      read Power Test INI-file in fkt");

    strncpy(func, "Power", 20 );    // Name of functionality
//    writeLineEx(dwWriteSinkSimu, 1 /*Info*/, "read ini file '%s'",iniFilename );

//    putvalue( Env_Power_Lock_Min, getProfileInt( func, "Power_Lock_Min", defPower_Lock_Min, iniFilename));
    putvalue( Env_Power_On_Min,              getProfileInt( func, "Power_On_Min",               defPower_On_Min,              iniFilename));
    putvalue( Env_Power_On_Msec,             getProfileInt( func, "Power_On_Msec",              defPower_On_Msec,             iniFilename));
    putvalue( Env_Power_On_IncDec,           getProfileInt( func, "Power_On_IncDec",            defPower_On_IncDec,           iniFilename));
    putvalue( Env_Power_On_Msec_Step,        getProfileInt( func, "Power_On_Msec_Step",         defPower_On_Msec_Step,        iniFilename));
    putvalue( Env_Power_Off_Min,             getProfileInt( func, "Power_Off_Min",              defPower_Off_Min,             iniFilename));
    putvalue( Env_Power_Off_Msec,            getProfileInt( func, "Power_Off_Msec",             defPower_Off_Msec,            iniFilename));
    putvalue( Env_Power_Off_IncDec,          getProfileInt( func, "Power_Off_IncDec",           defPower_Off_IncDec,          iniFilename));
    putvalue( Env_Power_Off_Msec_Step,       getProfileInt( func, "Power_Off_Msec_Step",        defPower_Off_Msec_Step,       iniFilename));
    putvalue( Env_Power_Lock_Min,            getProfileInt( func, "Power_Lock_Min",             defPower_Lock_Min,            iniFilename));
    putvalue( Env_Power_Lock_Msec,           getProfileInt( func, "Power_Lock_Msec",            defPower_Lock_Msec,           iniFilename));
    putvalue( Env_Power_Lock_IncDec,         getProfileInt( func, "Power_Lock_IncDec",          defPower_Lock_IncDec,         iniFilename));
    putvalue( Env_Power_Lock_Msec_Step,      getProfileInt( func, "Power_Lock_Msec_Step",       defPower_Lock_Msec_Step,      iniFilename));
    putvalue( Env_Power__PowertestMainActiv, getProfileInt( func, "Power__PowertestMainActiv",  defPower__PowertestMainActiv, iniFilename));
    putvalue( Env_Power_On_Min_Start,        getProfileInt( func, "Power_On_Min_Start",         defPower_On_Min,              iniFilename));
    putvalue( Env_Power_On_Msec_Start,       getProfileInt( func, "Power_On_Msec_Start",        defPower_On_Msec,             iniFilename));
    putvalue( Env_Power_On_Min_Stop,         getProfileInt( func, "Power_On_Min_Stop",          defPower_On_Min,              iniFilename));
    putvalue( Env_Power_On_Msec_Stop,        getProfileInt( func, "Power_On_Msec_Stop",         defPower_On_Msec,             iniFilename));
    putvalue( Env_Power_Off_Min_Start,       getProfileInt( func, "Power_Off_Min_Start",        defPower_Off_Min,             iniFilename));
    putvalue( Env_Power_Off_Msec_Start,      getProfileInt( func, "Power_Off_Msec_Start",       defPower_Off_Msec,            iniFilename));
    putvalue( Env_Power_Off_Min_Stop,        getProfileInt( func, "Power_Off_Min_Stop",         defPower_Off_Min,             iniFilename));
    putvalue( Env_Power_Off_Msec_Stop,       getProfileInt( func, "Power_Off_Msec_Stop",        defPower_Off_Msec,            iniFilename));
    putvalue( Env_Power_Lock_Min_Start,      getProfileInt( func, "Power_Lock_Min_Start",       defPower_Lock_Min,            iniFilename));
    putvalue( Env_Power_Lock_Msec_Start,     getProfileInt( func, "Power_Lock_Msec_Start",      defPower_Lock_Msec,           iniFilename));
    putvalue( Env_Power_Lock_Min_Stop,       getProfileInt( func, "Power_Lock_Min_Stop",        defPower_Lock_Min,            iniFilename));
    putvalue( Env_Power_Lock_Msec_Stop,      getProfileInt( func, "Power_Lock_Msec_Stop",       defPower_Lock_Msec,           iniFilename));
}

Config__iniReadAll (char iniFilename[])
{
      // Lese zwei INT-Parameter aus der INI Datei "Test.Ini" :
      //  "ReadPara1",
      //  "ReadPara2".     (Sektion "Input")
      // 
      readPara1 = getProfileInt("Input","ReadPara1",defVal,iniFilename );
      readPara2 = getProfileInt("Input","ReadPara2",defVal,iniFilename );
      //
      // Wird der Pfad fuer die Schreiboperation nicht explizit 
      // gesetzt, so wird der Pfad der Konfigurationsdatei heran-
      // gezogen.
      // 

    strncpy(func, "Power", 20 );    // Name of functionality

//    putvalue( Env_Power_Lock_Min, getProfileInt( func, "Power_Lock_Min", defPower_Lock_Min, iniFilename));
/*    putvalue( Env_Power_On_Min,                 getProfileInt( func, "Power_On_Min",                 defPower_On_Min,                 iniFilename));
    putvalue( Env_Power_On_Msec,             getProfileInt( func, "Power_On_Msec",                 defPower_On_Msec,                 iniFilename));
    putvalue( Env_Power_On_IncDec,             getProfileInt( func, "Power_On_IncDec",             defPower_On_IncDec,             iniFilename));
    putvalue( Env_Power_On_Msec_Step,          getProfileInt( func, "Power_On_Msec_Step",             defPower_On_Msec_Step,             iniFilename));
    putvalue( Env_Power_Off_Min,              getProfileInt( func, "Power_Off_Min",                 defPower_Off_Min,                 iniFilename));
    putvalue( Env_Power_Off_Msec,              getProfileInt( func, "Power_Off_Msec",                 defPower_Off_Msec,                 iniFilename));
    putvalue( Env_Power_Off_IncDec,          getProfileInt( func, "Power_Off_IncDec",             defPower_Off_IncDec,             iniFilename));
    putvalue( Env_Power_Off_Msec_Step,          getProfileInt( func, "Power_Off_Msec_Step",         defPower_Off_Msec_Step,            iniFilename));
    putvalue( Env_Power_Lock_Min,              getProfileInt( func, "Power_Lock_Min",                 defPower_Lock_Min,                 iniFilename));
    putvalue( Env_Power_Lock_Msec,              getProfileInt( func, "Power_Lock_Msec",             defPower_Lock_Msec,             iniFilename));
    putvalue( Env_Power_Lock_IncDec,          getProfileInt( func, "Power_Lock_IncDec",             defPower_Lock_IncDec,             iniFilename));
    putvalue( Env_Power_Lock_Msec_Step,      getProfileInt( func, "Power_Lock_Msec_Step",         defPower_Lock_Msec_Step,         iniFilename));
    putvalue( Env_Power__PowertestMainActiv, getProfileInt( func, "Power__PowertestMainActiv",     defPower__PowertestMainActiv,     iniFilename));


*/
}

void Config_vFindCurrentSelectedSection()
{
 char cConfig_TMPiniSection[100];
  write("Config_eSelConfiguration=[%x]",getValue(Env_Config__Config_Variant));
 switch(getValue(Env_Config__Config_Variant))
    {
        case CONFIG_MIN:      // CONFIG_MAX
            strncpy(cConfig_iniSection, "CONFIG_MIN", 16);
        break;
        case CONFIG_MAX:      // CONFIG_MAX
            strncpy(cConfig_iniSection, "CONFIG_MAX", 16);
        break;
        case CONFIG_TYPICAL:      // CONFIG_TYPICAL
            strncpy(cConfig_iniSection, "CONFIG_TYPICAL", 16);
        break;
        case CONFIG_1:      // CONFIG_1
            strncpy(cConfig_iniSection, "CONFIG_1", 16);
        break;
        case CONFIG_2:      // CONFIG_2
            strncpy(cConfig_iniSection, "CONFIG_2", 16);
        break;
        case CONFIG_3:      // CONFIG_3
            strncpy(cConfig_iniSection, "CONFIG_3", 16);
        break;
        case CONFIG_4:      // CONFIG_4
            strncpy(cConfig_iniSection, "CONFIG_4", 16);
        break;
        case CONFIG_5:      // CONFIG_5
            strncpy(cConfig_iniSection, "CONFIG_5", 16);
        break;
        case CONFIG_6:      // CONFIG_6
            strncpy(cConfig_iniSection, "CONFIG_6", 16);
        break;
        case CONFIG_7:      // CONFIG_7
            strncpy(cConfig_iniSection, "CONFIG_7", 16);
        break;
        case CONFIG_8:      // CONFIG_8
            strncpy(cConfig_iniSection, "CONFIG_8", 16);
        break;
        case CONFIG_9:      // CONFIG_9
            strncpy(cConfig_iniSection, "CONFIG_9", 16);
        break;
        case CONFIG_10:      // CONFIG_10
            strncpy(cConfig_iniSection, "CONFIG_10", 16);
        break;
        case CONFIG_11:      // CONFIG_11
            strncpy(cConfig_iniSection, "CONFIG_11", 16);
        break;
        case CONFIG_12:      // CONFIG_12
            strncpy(cConfig_iniSection, "CONFIG_12", 16);
        break;
        case CONFIG_13:      // CONFIG_13
            strncpy(cConfig_iniSection, "CONFIG_13", 16);
        break;
        default:
            strncpy(cConfig_iniSection, "DEFAULT", 16);
        break;
     }   

   
}

void Config__vInitializeEnvVar()
{
    
    char cConfig_iniFile[100] = "\\Config\\Config.ini";
    char cConfig_iniDefaultVal[100]="Not in *.ini file";
    char cConfig_iniDefaultCfgVal[100]="n.a.";
    
    char cReadBuffer[100];

       Config_vFindCurrentSelectedSection();

    getProfileString(cConfig_iniSection, "Config_eDataSectiontxt",  "Not Defined", cReadBuffer, elcount(cReadBuffer), cConfig_iniFile);putValue(Env_Config_eDataSectiontxt,cReadBuffer);


    putValue( HMI_EVC_01_Ver_USA_Avl           , getProfileInt( cConfig_iniSection, "EVC_01_Ver_USA_Avl",            0, cConfig_iniFile ));
    putValue( HMI_EVC_02_Ver_Mexico_Avl        , getProfileInt( cConfig_iniSection, "EVC_02_Ver_Mexico_Avl",         0, cConfig_iniFile ));
    putValue( HMI_EVC_03_Ver_Japan_Avl         , getProfileInt( cConfig_iniSection, "EVC_03_Ver_Japan_Avl",          0, cConfig_iniFile ));
    putValue( HMI_EVC_04_Ver_GulfStates_Avl    , getProfileInt( cConfig_iniSection, "EVC_04_Ver_GulfStates_Avl",     0, cConfig_iniFile ));
    putValue( HMI_EVC_05_Ver_Australia_Avl     , getProfileInt( cConfig_iniSection, "EVC_05_Ver_Australia_Avl",      0, cConfig_iniFile ));
    putValue( HMI_EVC_06_Ver_China_Avl         , getProfileInt( cConfig_iniSection, "EVC_06_Ver_China_Avl",          0, cConfig_iniFile ));
    putValue( HMI_EVC_07_Ver_S_Korea_Avl       , getProfileInt( cConfig_iniSection, "EVC_07_Ver_S_Korea_Avl",        0, cConfig_iniFile ));
    putValue( HMI_EVC_08_Ver_Canada_Avl        , getProfileInt( cConfig_iniSection, "EVC_08_Ver_Canada_Avl",         0, cConfig_iniFile ));
    putValue( HMI_EVC_09_FullHyb_Avl           , getProfileInt( cConfig_iniSection, "EVC_09_FullHyb_Avl",            0, cConfig_iniFile ));
    putValue( HMI_EVC_0A_Hyb_20kW_Avl          , getProfileInt( cConfig_iniSection, "EVC_0A_Hyb_20kW_Avl",           0, cConfig_iniFile ));
    putValue( HMI_EVC_0B_PlugInHyb_80kW_Avl    , getProfileInt( cConfig_iniSection, "EVC_0B_PlugInHyb_80kW_Avl",     0, cConfig_iniFile ));
    putValue( HMI_EVC_0C_AllWheelDr_Avl        , getProfileInt( cConfig_iniSection, "EVC_0C_AllWheelDr_Avl",         0, cConfig_iniFile ));
    putValue( HMI_EVC_0D_4x2Drive_Avl          , getProfileInt( cConfig_iniSection, "EVC_0D_4x2Drive_Avl",           0, cConfig_iniFile ));
    putValue( HMI_EVC_0E_Presf_Avl             , getProfileInt( cConfig_iniSection, "EVC_0E_Presf_Avl",              0, cConfig_iniFile ));
    putValue( HMI_EVC_0F_TrlrHtch_Avl          , getProfileInt( cConfig_iniSection, "EVC_0F_TrlrHtch_Avl",           0, cConfig_iniFile ));
    putValue( HMI_EVC_10_KG_Avl                , getProfileInt( cConfig_iniSection, "EVC_10_KG_Avl",                 0, cConfig_iniFile ));
    putValue( HMI_EVC_11_AutTrunkLid_Avl       , getProfileInt( cConfig_iniSection, "EVC_11_AutTrunkLid_Avl",        0, cConfig_iniFile ));
    putValue( HMI_EVC_12_AutRearDr_Avl         , getProfileInt( cConfig_iniSection, "EVC_12_AutRearDr_Avl",          0, cConfig_iniFile ));
    putValue( HMI_EVC_13_PwrCls_Avl            , getProfileInt( cConfig_iniSection, "EVC_13_PwrCls_Avl",             0, cConfig_iniFile ));
    putValue( HMI_EVC_14_RainSens_Avl          , getProfileInt( cConfig_iniSection, "EVC_14_RainSens_Avl",           0, cConfig_iniFile ));
    putValue( HMI_EVC_15_DRLt_Avl              , getProfileInt( cConfig_iniSection, "EVC_15_DRLt_Avl",               0, cConfig_iniFile ));
    putValue( HMI_EVC_16_FogLmp_Avl            , getProfileInt( cConfig_iniSection, "EVC_16_FogLmp_Avl",             0, cConfig_iniFile ));
    putValue( HMI_EVC_17_IL_Pk_Avl             , getProfileInt( cConfig_iniSection, "EVC_17_IL_Pk_Avl",              0, cConfig_iniFile ));
    putValue( HMI_EVC_18_AmbLgt_Avl            , getProfileInt( cConfig_iniSection, "EVC_18_AmbLgt_Avl",             0, cConfig_iniFile ));
    putValue( HMI_EVC_19_ElDrPosnSel_Avl       , getProfileInt( cConfig_iniSection, "EVC_19_ElDrPosnSel_Avl",        0, cConfig_iniFile ));
    putValue( HMI_EVC_1A_IntSfProt_Avl         , getProfileInt( cConfig_iniSection, "EVC_1A_IntSfProt_Avl",          0, cConfig_iniFile ));
    putValue( HMI_EVC_1B_VTA_Avl               , getProfileInt( cConfig_iniSection, "EVC_1B_VTA_Avl",                0, cConfig_iniFile ));
    putValue( HMI_EVC_1C_HghVTP_Avl            , getProfileInt( cConfig_iniSection, "EVC_1C_HghVTP_Avl",             0, cConfig_iniFile ));
    putValue( HMI_EVC_1D_SecurityVer_Avl       , getProfileInt( cConfig_iniSection, "EVC_1D_SecurityVer_Avl",        0, cConfig_iniFile ));
    putValue( HMI_EVC_1E_GuardLvl_B4_Avl       , getProfileInt( cConfig_iniSection, "EVC_1E_GuardLvl_B4_Avl",        0, cConfig_iniFile ));
    putValue( HMI_EVC_1F_GuardLvl_B6_Avl       , getProfileInt( cConfig_iniSection, "EVC_1F_GuardLvl_B6_Avl",        0, cConfig_iniFile ));
    putValue( HMI_EVC_20_GuardLvl_B7_Avl       , getProfileInt( cConfig_iniSection, "EVC_20_GuardLvl_B7_Avl",        0, cConfig_iniFile ));
    putValue( HMI_EVC_21_Pullman_Avl           , getProfileInt( cConfig_iniSection, "EVC_21_Pullman_Avl",            0, cConfig_iniFile ));
    putValue( HMI_EVC_22_SpecClos_Avl          , getProfileInt( cConfig_iniSection, "EVC_22_SpecClos_Avl",           0, cConfig_iniFile ));
    putValue( HMI_EVC_23_PASS_Avl              , getProfileInt( cConfig_iniSection, "EVC_23_PASS_Avl",               0, cConfig_iniFile ));
    putValue( HMI_EVC_24_ICH_Avl               , getProfileInt( cConfig_iniSection, "EVC_24_ICH_Avl",                0, cConfig_iniFile ));
    putValue( HMI_EVC_25_HVAC_R_Avl            , getProfileInt( cConfig_iniSection, "EVC_25_HVAC_R_Avl",             0, cConfig_iniFile ));
    putValue( HMI_EVC_26_SSA_Avl               , getProfileInt( cConfig_iniSection, "EVC_26_SSA_Avl",                0, cConfig_iniFile ));
    putValue( HMI_EVC_27_HandsFreeAcc_Avl      , getProfileInt( cConfig_iniSection, "EVC_27_HandsFreeAcc_Avl",       0, cConfig_iniFile ));
    putValue( HMI_EVC_28_PlugInHyb_50kW_Avl    , getProfileInt( cConfig_iniSection, "EVC_28_PlugInHyb_50kW_Avl",     0, cConfig_iniFile ));
    putValue( HMI_EVC_29_Hyb_30kW_Avl          , getProfileInt( cConfig_iniSection, "EVC_29_Hyb_30kW_Avl",           0, cConfig_iniFile ));
    putValue( HMI_EVC_2A_SeatElAdj_F_OprtnR_Avl, getProfileInt( cConfig_iniSection, "EVC_2A_SeatElAdj_F_OprtnR_Avl", 0, cConfig_iniFile ));
    putValue( HMI_EVC_2B_DSI_Sel_Avl           , getProfileInt( cConfig_iniSection, "EVC_2B_DSI_Sel_Avl",            0, cConfig_iniFile ));
    putValue( HMI_EVC_2C_WC_VEDA_Avl           , getProfileInt( cConfig_iniSection, "EVC_2C_WC_VEDA_Avl",            0, cConfig_iniFile ));
    putValue( HMI_EVC_2D_AutoSpdCtrl_Avl       , getProfileInt( cConfig_iniSection, "EVC_2D_AutoSpdCtrl_Avl",        0, cConfig_iniFile ));
    putValue( HMI_EVC_2E_AddEquipBlock_Avl     , getProfileInt( cConfig_iniSection, "EVC_2E_AddEquipBlock_Avl",      0, cConfig_iniFile ));
    putValue( HMI_EVC_2F_RetrofitFuelcell_Avl  , getProfileInt( cConfig_iniSection, "EVC_2F_RetrofitFuelcell_Avl",   0, cConfig_iniFile ));
    putValue( HMI_EVC_30_RearStWhl_Avl         , getProfileInt( cConfig_iniSection, "EVC_30_RearStWhl_Avl",           0, cConfig_iniFile ));
    putValue( HMI_EVC_31_AddEquip_Avl          , getProfileInt( cConfig_iniSection, "EVC_31_AddEquip_Avl",           0, cConfig_iniFile ));
    putValue( HMI_EVC_32_Hyb_ME10_Avl          , getProfileInt( cConfig_iniSection, "EVC_32_Hyb_ME10_Avl",           0, cConfig_iniFile ));
    putValue( HMI_EVC_33_EmgOpn_F_Avl          , getProfileInt( cConfig_iniSection, "EVC_33_AddEquip_Avl",           0, cConfig_iniFile ));
    putValue( HMI_EVC_34_Curtain_F_Avl         , getProfileInt( cConfig_iniSection, "EVC_34_Curtain_F_Avl",          0, cConfig_iniFile ));
    putValue( HMI_EVC_35_EmgOpn_Inact          , getProfileInt( cConfig_iniSection, "EVC_35_EmgOpn_Inact",           0, cConfig_iniFile ));
    putValue( HMI_EVC_36_SpecVehPW_FL_Avl      , getProfileInt( cConfig_iniSection, "EVC_36_SpecVehPW_FL_Avl",       0, cConfig_iniFile ));
    putValue( HMI_EVC_37_SpecVehPW_FR_Avl      , getProfileInt( cConfig_iniSection, "EVC_37_SpecVehPW_FR_Avl",       0, cConfig_iniFile ));
    putValue( HMI_EVC_38_SpecVehPW_RL_Avl      , getProfileInt( cConfig_iniSection, "EVC_38_SpecVehPW_RL_Avl",       0, cConfig_iniFile ));
    putValue( HMI_EVC_39_SpecVehPW_RR_Avl      , getProfileInt( cConfig_iniSection, "EVC_39_SpecVehPW_RR_Avl",       0, cConfig_iniFile ));
    putValue( HMI_EVC_3A_RB_F_Avl              , getProfileInt( cConfig_iniSection, "EVC_3A_RB_F_Avl",               0, cConfig_iniFile ));
    putValue( HMI_EVC_3B_RB_R_Avl              , getProfileInt( cConfig_iniSection, "EVC_3B_RB_R_Avl",               0, cConfig_iniFile ));
    putValue( HMI_EVC_3C_SeatDrvDyn_Ft_Avl     , getProfileInt( cConfig_iniSection, "EVC_3C_SeatDrvDyn_Ft_Avl",      0, cConfig_iniFile ));
    putValue( HMI_EVC_3D_ComfHdRst_Ft_Avl      , getProfileInt( cConfig_iniSection, "EVC_3D_ComfHdRst_Ft_Avl",       0, cConfig_iniFile ));
    putValue( HMI_EVC_3E_SeatMultiCont_Ft_Avl  , getProfileInt( cConfig_iniSection, "EVC_3E_SeatMultiCont_Ft_Avl",   0, cConfig_iniFile ));
    putValue( HMI_EVC_3F_SeatHt_Ft_Avl         , getProfileInt( cConfig_iniSection, "EVC_3F_SeatHt_Ft_Avl",          0, cConfig_iniFile ));
    putValue( HMI_EVC_40_SeatClim_Ft_Avl       , getProfileInt( cConfig_iniSection, "EVC_40_SeatClim_Ft_Avl",        0, cConfig_iniFile ));
    putValue( HMI_EVC_41_SeatMem_LHD_Avl       , getProfileInt( cConfig_iniSection, "EVC_41_SeatMem_LHD_Avl",        0, cConfig_iniFile ));
    putValue( HMI_EVC_42_SeatMem_RHD_Avl       , getProfileInt( cConfig_iniSection, "EVC_42_SeatMem_RHD_Avl",        0, cConfig_iniFile ));
    putValue( HMI_EVC_43_SeatMemPk_Avl         , getProfileInt( cConfig_iniSection, "EVC_43_SeatMemPk_Avl",          0, cConfig_iniFile ));
    putValue( HMI_EVC_44_ReclSeat_Avl          , getProfileInt( cConfig_iniSection, "EVC_44_ReclSeat_Avl",           0, cConfig_iniFile ));
    putValue( HMI_EVC_45_SeatMultiCont_R_Avl   , getProfileInt( cConfig_iniSection, "EVC_45_SeatMultiCont_R_Avl",    0, cConfig_iniFile ));
    putValue( HMI_EVC_46_SeatBkRstAdj_R_Avl    , getProfileInt( cConfig_iniSection, "EVC_46_SeatBkRstAdj_R_Avl",     0, cConfig_iniFile ));
    putValue( HMI_EVC_47_SeatHt_R_Avl          , getProfileInt( cConfig_iniSection, "EVC_47_SeatHt_R_Avl",           0, cConfig_iniFile ));
    putValue( HMI_EVC_48_SeatClim_R_Avl        , getProfileInt( cConfig_iniSection, "EVC_48_SeatClim_R_Avl",         0, cConfig_iniFile ));
    putValue( HMI_EVC_49_WShWashHt_Avl         , getProfileInt( cConfig_iniSection, "EVC_49_WShWashHt_Avl",          0, cConfig_iniFile ));
    putValue( HMI_EVC_4A_TaxiPwrSup_Avl        , getProfileInt( cConfig_iniSection, "EVC_4A_TaxiPwrSup_Avl",         0, cConfig_iniFile ));
    putValue( HMI_EVC_4B_TaxiRoofLmpCon_Avl    , getProfileInt( cConfig_iniSection, "EVC_4B_TaxiRoofLmpCon_Avl",     0, cConfig_iniFile ));
    putValue( HMI_EVC_4C_TaxiEmgAlm_Avl        , getProfileInt( cConfig_iniSection, "EVC_4C_TaxiEmgAlm_Avl",         0, cConfig_iniFile ));
    putValue( HMI_EVC_4D_RadioHdFree_Avl       , getProfileInt( cConfig_iniSection, "EVC_4D_RadioHdFree_Avl",        0, cConfig_iniFile ));
    putValue( HMI_EVC_4E_GAS_Avl               , getProfileInt( cConfig_iniSection, "EVC_4E_GAS_Avl",                0, cConfig_iniFile ));
    putValue( HMI_EVC_4F_CtrlU_MultiFunc_Avl   , getProfileInt( cConfig_iniSection, "EVC_4F_CtrlU_MultiFunc_Avl",    0, cConfig_iniFile ));
    putValue( HMI_EVC_50_TaxInMirr_Avl         , getProfileInt( cConfig_iniSection, "EVC_50_TaxInMirr_Avl",          0, cConfig_iniFile ));
    putValue( HMI_EVC_51_DistRecInMirr_Avl     , getProfileInt( cConfig_iniSection, "EVC_51_DistRecInMirr_Avl",      0, cConfig_iniFile ));
    putValue( HMI_EVC_52_PreInstRad_Avl        , getProfileInt( cConfig_iniSection, "EVC_52_PreInstRad_Avl",         0, cConfig_iniFile ));
    putValue( HMI_EVC_53_VehHandi_Avl          , getProfileInt( cConfig_iniSection, "EVC_53_VehHandi_Avl",           0, cConfig_iniFile ));
    putValue( HMI_EVC_54_PanelHt_Ft_Avl        , getProfileInt( cConfig_iniSection, "EVC_54_PanelHt_Avl",            0, cConfig_iniFile ));
    putValue( HMI_EVC_55_SeatComfHt_Ft_Avl     , getProfileInt( cConfig_iniSection, "EVC_55_SeatComfHt_Ft_Avl",      0, cConfig_iniFile ));
    putValue( HMI_EVC_56_SeatComfHt_R_Avl      , getProfileInt( cConfig_iniSection, "EVC_56_SeatComfHt_R_Avl",       0, cConfig_iniFile ));
    putValue( HMI_EVC_57_IntFoldHdRst_Ft_Avl   , getProfileInt( cConfig_iniSection, "EVC_57_IntFoldHdRst_Ft_Avl",    0, cConfig_iniFile ));
    putValue( HMI_EVC_58_SeatInd_R_Avl         , getProfileInt( cConfig_iniSection, "EVC_58_SeatInd_R_Avl",          0, cConfig_iniFile ));
    putValue( HMI_EVC_59_SeatChauffPos_P_Avl   , getProfileInt( cConfig_iniSection, "EVC_59_SeatChauffPos_P_Avl",    0, cConfig_iniFile ));
    putValue( HMI_EVC_5A_SeatMContMass_Ft_Avl  , getProfileInt( cConfig_iniSection, "EVC_5A_SeatMContMass_Ft_Avl",   0, cConfig_iniFile ));
    putValue( HMI_EVC_5B_PanelHt_R_Avl         , getProfileInt( cConfig_iniSection, "EVC_5B_AddEquip_Avl",           0, cConfig_iniFile ));
    putValue( HMI_EVC_5C_Airscarf_Ft_Avl       , getProfileInt( cConfig_iniSection, "EVC_5C_Airscarf_Ft_Avl",        0, cConfig_iniFile ));
    putValue( HMI_EVC_5D_SeatLimit_P_Avl       , getProfileInt( cConfig_iniSection, "EVC_5D_SeatLimit_P_Avl",        0, cConfig_iniFile ));
    putValue( HMI_EVC_5E_TaxiRoofLmp_Avl       , getProfileInt( cConfig_iniSection, "EVC_5E_TaxiRoofLmp_Avl",        0, cConfig_iniFile ));
    putValue( HMI_EVC_5F_SeatElAdj_LHD_Avl     , getProfileInt( cConfig_iniSection, "EVC_5F_SeatElAdj_LHD_Avl",      0, cConfig_iniFile ));
    putValue( HMI_EVC_60_SeatElAdj_RHD_Avl     , getProfileInt( cConfig_iniSection, "EVC_60_SeatElAdj_RHD_Avl",      0, cConfig_iniFile ));
    putValue( HMI_EVC_61_AMGPerfSusp_Avl       , getProfileInt( cConfig_iniSection, "EVC_61_AMGPerfSusp_Avl",        0, cConfig_iniFile ));
    putValue( HMI_EVC_62_ShiftExhstSys_Avl     , getProfileInt( cConfig_iniSection, "EVC_62_ShiftExhstSys_Avl",      0, cConfig_iniFile ));
    putValue( HMI_EVC_63_ActvLDA_MPC_Avl       , getProfileInt( cConfig_iniSection, "EVC_63_ActvLDA_MPC_Avl",        0, cConfig_iniFile ));
    putValue( HMI_EVC_64_EAS_Avl               , getProfileInt( cConfig_iniSection, "EVC_64_EAS_Avl",                0, cConfig_iniFile ));
    putValue( HMI_EVC_65_CruiseCtrl_Avl        , getProfileInt( cConfig_iniSection, "EVC_65_CruiseCtrl_Avl",         0, cConfig_iniFile ));
    putValue( HMI_EVC_66_OffRoadPk_Avl         , getProfileInt( cConfig_iniSection, "EVC_66_OffRoadPk_Avl",          0, cConfig_iniFile ));
    putValue( HMI_EVC_67_CMS_Avl               , getProfileInt( cConfig_iniSection, "EVC_67_CMS_Avl",                0, cConfig_iniFile ));
    putValue( HMI_EVC_68_CMS_R_Avl             , getProfileInt( cConfig_iniSection, "EVC_68_CMS_R_Avl",              0, cConfig_iniFile ));
    putValue( HMI_EVC_69_BrkEngg_PP_Avl        , getProfileInt( cConfig_iniSection, "EVC_69_BrkEngg_PP_Avl",         0, cConfig_iniFile ));
    putValue( HMI_EVC_6A_BasExtd_Avl           , getProfileInt( cConfig_iniSection, "EVC_6A_BasExtd_Avl",            0, cConfig_iniFile ));
    putValue( HMI_EVC_6B_MirrFld_Avl           , getProfileInt( cConfig_iniSection, "EVC_6B_MirrFld_Avl",            0, cConfig_iniFile ));
    putValue( HMI_EVC_6C_BSM_Avl               , getProfileInt( cConfig_iniSection, "EVC_6C_BSM_Avl",                0, cConfig_iniFile ));
    putValue( HMI_EVC_6D_ActvBSM_Avl           , getProfileInt( cConfig_iniSection, "EVC_6D_ActvBSM_Avl",            0, cConfig_iniFile ));
    putValue( HMI_EVC_6E_TurnAss_Avl           , getProfileInt( cConfig_iniSection, "EVC_6E_TurnAss_Avl",            0, cConfig_iniFile ));
    putValue( HMI_EVC_6F_ADTR_Avl              , getProfileInt( cConfig_iniSection, "EVC_6F_ADTR_Avl",               0, cConfig_iniFile ));
    putValue( HMI_EVC_70_DTR_Pro_Avl           , getProfileInt( cConfig_iniSection, "EVC_70_DTR_Pro_Avl",            0, cConfig_iniFile ));
    putValue( HMI_EVC_71_ALS_Avl               , getProfileInt( cConfig_iniSection, "EVC_71_ALS_Avl",                0, cConfig_iniFile ));
    putValue( HMI_EVC_72_ActvLDA_Avl           , getProfileInt( cConfig_iniSection, "EVC_72_ActvLDA_Avl",            0, cConfig_iniFile ));
    putValue( HMI_EVC_73_FCW_Avl               , getProfileInt( cConfig_iniSection, "EVC_73_FCW_Avl",                0, cConfig_iniFile ));
    putValue( HMI_EVC_74_LaneRec_Avl           , getProfileInt( cConfig_iniSection, "EVC_74_LaneRec_Avl",            0, cConfig_iniFile ));
    putValue( HMI_EVC_75_NV_Avl                , getProfileInt( cConfig_iniSection, "EVC_75_NV_Avl",                 0, cConfig_iniFile ));
    putValue( HMI_EVC_76_RoadSignDtct_Avl      , getProfileInt( cConfig_iniSection, "EVC_76_RoadSignDtct_Avl",       0, cConfig_iniFile ));
    putValue( HMI_EVC_77_RVC_Avl               , getProfileInt( cConfig_iniSection, "EVC_77_RVC_Avl",                0, cConfig_iniFile ));
    putValue( HMI_EVC_78_SurrView_Avl          , getProfileInt( cConfig_iniSection, "EVC_78_SurrView_Avl",           0, cConfig_iniFile ));
    putValue( HMI_EVC_79_PTS_Avl               , getProfileInt( cConfig_iniSection, "EVC_79_PTS_Avl",                0, cConfig_iniFile ));
    putValue( HMI_EVC_7A_APG_Avl               , getProfileInt( cConfig_iniSection, "EVC_7A_APG_Avl",                0, cConfig_iniFile ));
    putValue( HMI_EVC_7B_ActPKAS_Avl           , getProfileInt( cConfig_iniSection, "EVC_7B_ActPKAS_Avl",            0, cConfig_iniFile ));
    putValue( HMI_EVC_7C_IHC_Avl               , getProfileInt( cConfig_iniSection, "EVC_7C_IHC_Avl",                0, cConfig_iniFile ));
    putValue( HMI_EVC_7D_IHC_Plus_Avl          , getProfileInt( cConfig_iniSection, "EVC_7D_IHC_Plus_Avl",           0, cConfig_iniFile ));
    putValue( HMI_EVC_7E_BasPlusQ_Avl          , getProfileInt( cConfig_iniSection, "EVC_7E_BasPlusQ_Avl",           0, cConfig_iniFile ));
    putValue( HMI_EVC_7F_ECO_St_Avl            , getProfileInt( cConfig_iniSection, "EVC_7F_ECO_St_Avl",             0, cConfig_iniFile ));
    putValue( HMI_EVC_80_PSTS_Avl              , getProfileInt( cConfig_iniSection, "EVC_80_PSTS_Avl",               0, cConfig_iniFile ));
    putValue( HMI_EVC_81_ABC_Avl               , getProfileInt( cConfig_iniSection, "EVC_81_ABC_Avl",                0, cConfig_iniFile ));
    putValue( HMI_EVC_82_SteelAirSusp_Avl      , getProfileInt( cConfig_iniSection, "EVC_82_SteelAirSusp_Avl",       0, cConfig_iniFile ));
    putValue( HMI_EVC_83_AirSemiActv_Susp_Avl  , getProfileInt( cConfig_iniSection, "EVC_83_AirSemiActv_Susp_Avl",   0, cConfig_iniFile ));
    putValue( HMI_EVC_84_SportSusp_Avl         , getProfileInt( cConfig_iniSection, "EVC_84_SportSusp_Avl",          0, cConfig_iniFile ));
    putValue( HMI_EVC_85_SportPk_AMG_Avl       , getProfileInt( cConfig_iniSection, "EVC_85_SportPk_AMG_Avl",        0, cConfig_iniFile ));
    putValue( HMI_EVC_86_SportPk_Avl           , getProfileInt( cConfig_iniSection, "EVC_86_SportPk_Avl",            0, cConfig_iniFile ));
    putValue( HMI_EVC_87_SportPk_Ext_Avl       , getProfileInt( cConfig_iniSection, "EVC_87_SportPk_Ext_Avl",        0, cConfig_iniFile ));
    putValue( HMI_EVC_88_DualView_Avl          , getProfileInt( cConfig_iniSection, "EVC_88_DualView_Avl",           0, cConfig_iniFile ));
    putValue( HMI_EVC_89_Entertain_R_Avl       , getProfileInt( cConfig_iniSection, "EVC_89_Entertain_R_Avl",        0, cConfig_iniFile ));
    putValue( HMI_EVC_8A_DigTV_Avl             , getProfileInt( cConfig_iniSection, "EVC_8A_DigTV_Avl",              0, cConfig_iniFile ));
    putValue( HMI_EVC_8B_DAB_Tun_Avl           , getProfileInt( cConfig_iniSection, "EVC_8B_DAB_Tun_Avl",            0, cConfig_iniFile ));
    putValue( HMI_EVC_8C_MTUS_Avl              , getProfileInt( cConfig_iniSection, "EVC_8C_MTUS_Avl",               0, cConfig_iniFile ));
    putValue( HMI_EVC_8D_UCI_Avl               , getProfileInt( cConfig_iniSection, "EVC_8D_UCI_Avl",                0, cConfig_iniFile ));
    putValue( HMI_EVC_8E_SndSys_Avl            , getProfileInt( cConfig_iniSection, "EVC_8E_SndSys_Avl",             0, cConfig_iniFile ));
    putValue( HMI_EVC_8F_WShViewWin_Avl        , getProfileInt( cConfig_iniSection, "EVC_8F_WShViewWin_Avl",         0, cConfig_iniFile ));
    putValue( HMI_EVC_90_WSh_Clr_Avl           , getProfileInt( cConfig_iniSection, "EVC_90_WSh_Clr_Avl",            0, cConfig_iniFile ));
    putValue( HMI_EVC_91_WSh_Ht_Avl            , getProfileInt( cConfig_iniSection, "EVC_91_WSh_Ht_Avl",             0, cConfig_iniFile ));
    putValue( HMI_EVC_92_WShBL_Prot_Avl        , getProfileInt( cConfig_iniSection, "EVC_92_WShBL_Prot_Avl",         0, cConfig_iniFile ));
    putValue( HMI_EVC_93_WSh_Ht_Lcut_Avl       , getProfileInt( cConfig_iniSection, "EVC_93_WSh_Ht_Lcut_Avl",        0, cConfig_iniFile ));
    putValue( HMI_EVC_94_OptPack_Clas_Avl      , getProfileInt( cConfig_iniSection, "EVC_94_OptPack_Clas_Avl",       0, cConfig_iniFile ));
    putValue( HMI_EVC_95_OptPack_Avan_Avl      , getProfileInt( cConfig_iniSection, "EVC_95_OptPack_Avan_Avl",       0, cConfig_iniFile ));
    putValue( HMI_EVC_96_OptPack_Eleg_Avl      , getProfileInt( cConfig_iniSection, "EVC_96_OptPack_Eleg_Avl",       0, cConfig_iniFile ));


}

byte Config__vInitEnvVarCfgToNumber(char cIND_intxt[])
{
    byte u8RetVal = 0; // default:  n.a.
   
    if(!strncmp(cIND_intxt,"0",strlen(cIND_intxt)))  u8RetVal = 0x0;
    else if(!strncmp(cIND_intxt,"1",strlen(cIND_intxt))) u8RetVal = 0x1;
    else  u8RetVal = 0;

    return u8RetVal;

}

void Config_vDataSave()
{
       // load the confog fields with the corresponding data from ini file
    byte u8chekcode= 1;
    char cIND_iniFile[100] = "\\Config\\IND.ini";
    char cIND_iniSection[100];
    char cIND_iniTagBase[100]="IND_eIndData";
    char cIND_iniTag0[100],cIND_iniTag1[100],cIND_iniTag2[100],cIND_iniTag3[100],cIND_iniTag4[100],cIND_iniTag5[100],cIND_iniTag6[100],cIND_iniTag7[100];
    char cWriteBuffer[100];
    char cNum[4];

       Config_vFindCurrentSelectedCFGSection();
    
    // create the TAGs  e.G. "IND_eIndData0_0_txt", when Data set 0 is selected
//    ltoa( getValue( IND_eIndDataX_X_Selector ), cNum, 10 );
    
    //write the descriptions
    u8chekcode*= writeProfileInt(cConfig_CFGiniSection, "EVC_01_Ver_USA_Avl",            getValue( HMI_EVC_01_Ver_USA_Avl            ), cIND_iniFile);
    u8chekcode*= writeProfileInt(cConfig_CFGiniSection, "EVC_02_Ver_Mexico_Avl",         getValue( HMI_EVC_02_Ver_Mexico_Avl         ), cIND_iniFile);
    u8chekcode*= writeProfileInt(cConfig_CFGiniSection, "EVC_03_Ver_Japan_Avl",          getValue( HMI_EVC_03_Ver_Japan_Avl          ), cIND_iniFile);
    u8chekcode*= writeProfileInt(cConfig_CFGiniSection, "EVC_04_Ver_GulfStates_Avl",     getValue( HMI_EVC_04_Ver_GulfStates_Avl     ), cIND_iniFile);
    u8chekcode*= writeProfileInt(cConfig_CFGiniSection, "EVC_05_Ver_Australia_Avl",      getValue( HMI_EVC_05_Ver_Australia_Avl      ), cIND_iniFile);
    u8chekcode*= writeProfileInt(cConfig_CFGiniSection, "EVC_06_Ver_China_Avl",          getValue( HMI_EVC_06_Ver_China_Avl          ), cIND_iniFile);
    u8chekcode*= writeProfileInt(cConfig_CFGiniSection, "EVC_07_Ver_S_Korea_Avl",        getValue( HMI_EVC_07_Ver_S_Korea_Avl        ), cIND_iniFile);
    u8chekcode*= writeProfileInt(cConfig_CFGiniSection, "EVC_08_Ver_Canada_Avl",         getValue( HMI_EVC_08_Ver_Canada_Avl         ), cIND_iniFile);
    u8chekcode*= writeProfileInt(cConfig_CFGiniSection, "EVC_09_FullHyb_Avl",            getValue( HMI_EVC_09_FullHyb_Avl            ), cIND_iniFile);
    u8chekcode*= writeProfileInt(cConfig_CFGiniSection, "EVC_0A_Hyb_20kW_Avl",           getValue( HMI_EVC_0A_Hyb_20kW_Avl           ), cIND_iniFile);
    u8chekcode*= writeProfileInt(cConfig_CFGiniSection, "EVC_0B_PlugInHyb_80kW_Avl",     getValue( HMI_EVC_0B_PlugInHyb_80kW_Avl     ), cIND_iniFile);
    u8chekcode*= writeProfileInt(cConfig_CFGiniSection, "EVC_0C_AllWheelDr_Avl",         getValue( HMI_EVC_0C_AllWheelDr_Avl         ), cIND_iniFile);
    u8chekcode*= writeProfileInt(cConfig_CFGiniSection, "EVC_0D_4x2Drive_Avl",           getValue( HMI_EVC_0D_4x2Drive_Avl           ), cIND_iniFile);
    u8chekcode*= writeProfileInt(cConfig_CFGiniSection, "EVC_0E_Presf_Avl",              getValue( HMI_EVC_0E_Presf_Avl              ), cIND_iniFile);
    u8chekcode*= writeProfileInt(cConfig_CFGiniSection, "EVC_0F_TrlrHtch_Avl",           getValue( HMI_EVC_0F_TrlrHtch_Avl           ), cIND_iniFile);
    u8chekcode*= writeProfileInt(cConfig_CFGiniSection, "EVC_10_KG_Avl",                 getValue( HMI_EVC_10_KG_Avl                 ), cIND_iniFile);
    u8chekcode*= writeProfileInt(cConfig_CFGiniSection, "EVC_11_AutTrunkLid_Avl",        getValue( HMI_EVC_11_AutTrunkLid_Avl        ), cIND_iniFile);
    u8chekcode*= writeProfileInt(cConfig_CFGiniSection, "EVC_12_AutRearDr_Avl",          getValue( HMI_EVC_12_AutRearDr_Avl          ), cIND_iniFile);
    u8chekcode*= writeProfileInt(cConfig_CFGiniSection, "EVC_13_PwrCls_Avl",             getValue( HMI_EVC_13_PwrCls_Avl             ), cIND_iniFile);
    u8chekcode*= writeProfileInt(cConfig_CFGiniSection, "EVC_14_RainSens_Avl",           getValue( HMI_EVC_14_RainSens_Avl           ), cIND_iniFile);
    u8chekcode*= writeProfileInt(cConfig_CFGiniSection, "EVC_15_DRLt_Avl",               getValue( HMI_EVC_15_DRLt_Avl               ), cIND_iniFile);
    u8chekcode*= writeProfileInt(cConfig_CFGiniSection, "EVC_16_FogLmp_Avl",             getValue( HMI_EVC_16_FogLmp_Avl             ), cIND_iniFile);
    u8chekcode*= writeProfileInt(cConfig_CFGiniSection, "EVC_17_IL_Pk_Avl",              getValue( HMI_EVC_17_IL_Pk_Avl              ), cIND_iniFile);
    u8chekcode*= writeProfileInt(cConfig_CFGiniSection, "EVC_18_AmbLgt_Avl",             getValue( HMI_EVC_18_AmbLgt_Avl             ), cIND_iniFile);
    u8chekcode*= writeProfileInt(cConfig_CFGiniSection, "EVC_19_ElDrPosnSel_Avl",        getValue( HMI_EVC_19_ElDrPosnSel_Avl        ), cIND_iniFile);
    u8chekcode*= writeProfileInt(cConfig_CFGiniSection, "EVC_1A_IntSfProt_Avl",          getValue( HMI_EVC_1A_IntSfProt_Avl          ), cIND_iniFile);
    u8chekcode*= writeProfileInt(cConfig_CFGiniSection, "EVC_1B_VTA_Avl",                getValue( HMI_EVC_1B_VTA_Avl                ), cIND_iniFile);
    u8chekcode*= writeProfileInt(cConfig_CFGiniSection, "EVC_1C_HghVTP_Avl",             getValue( HMI_EVC_1C_HghVTP_Avl             ), cIND_iniFile);
    u8chekcode*= writeProfileInt(cConfig_CFGiniSection, "EVC_1D_SecurityVer_Avl",        getValue( HMI_EVC_1D_SecurityVer_Avl        ), cIND_iniFile);
    u8chekcode*= writeProfileInt(cConfig_CFGiniSection, "EVC_1E_GuardLvl_B4_Avl",        getValue( HMI_EVC_1E_GuardLvl_B4_Avl        ), cIND_iniFile);
    u8chekcode*= writeProfileInt(cConfig_CFGiniSection, "EVC_1F_GuardLvl_B6_Avl",        getValue( HMI_EVC_1F_GuardLvl_B6_Avl        ), cIND_iniFile);
    u8chekcode*= writeProfileInt(cConfig_CFGiniSection, "EVC_20_GuardLvl_B7_Avl",        getValue( HMI_EVC_20_GuardLvl_B7_Avl        ), cIND_iniFile);
    u8chekcode*= writeProfileInt(cConfig_CFGiniSection, "EVC_21_Pullman_Avl",            getValue( HMI_EVC_21_Pullman_Avl            ), cIND_iniFile);
    u8chekcode*= writeProfileInt(cConfig_CFGiniSection, "EVC_22_SpecClos_Avl",           getValue( HMI_EVC_22_SpecClos_Avl           ), cIND_iniFile);
    u8chekcode*= writeProfileInt(cConfig_CFGiniSection, "EVC_23_PASS_Avl",               getValue( HMI_EVC_23_PASS_Avl               ), cIND_iniFile);
    u8chekcode*= writeProfileInt(cConfig_CFGiniSection, "EVC_24_ICH_Avl",                getValue( HMI_EVC_24_ICH_Avl                ), cIND_iniFile);
    u8chekcode*= writeProfileInt(cConfig_CFGiniSection, "EVC_25_HVAC_R_Avl",             getValue( HMI_EVC_25_HVAC_R_Avl             ), cIND_iniFile);
    u8chekcode*= writeProfileInt(cConfig_CFGiniSection, "EVC_26_SSA_Avl",                getValue( HMI_EVC_26_SSA_Avl                ), cIND_iniFile);
    u8chekcode*= writeProfileInt(cConfig_CFGiniSection, "EVC_27_HandsFreeAcc_Avl",       getValue( HMI_EVC_27_HandsFreeAcc_Avl       ), cIND_iniFile);
    u8chekcode*= writeProfileInt(cConfig_CFGiniSection, "EVC_28_PlugInHyb_50kW_Avl",     getValue( HMI_EVC_28_PlugInHyb_50kW_Avl     ), cIND_iniFile);
    u8chekcode*= writeProfileInt(cConfig_CFGiniSection, "EVC_29_Hyb_30kW_Avl",           getValue( HMI_EVC_29_Hyb_30kW_Avl           ), cIND_iniFile);
    u8chekcode*= writeProfileInt(cConfig_CFGiniSection, "EVC_2A_SeatElAdj_F_OprtnR_Avl", getValue( HMI_EVC_2A_SeatElAdj_F_OprtnR_Avl ), cIND_iniFile);
    u8chekcode*= writeProfileInt(cConfig_CFGiniSection, "EVC_2B_DSI_Sel_Avl",            getValue( HMI_EVC_2B_DSI_Sel_Avl            ), cIND_iniFile);
    u8chekcode*= writeProfileInt(cConfig_CFGiniSection, "EVC_2C_WC_VEDA_Avl",            getValue( HMI_EVC_2C_WC_VEDA_Avl            ), cIND_iniFile);
    u8chekcode*= writeProfileInt(cConfig_CFGiniSection, "EVC_2D_AutoSpdCtrl_Avl",        getValue( HMI_EVC_2D_AutoSpdCtrl_Avl        ), cIND_iniFile);
    u8chekcode*= writeProfileInt(cConfig_CFGiniSection, "EVC_2E_AddEquipBlock_Avl",      getValue( HMI_EVC_2E_AddEquipBlock_Avl      ), cIND_iniFile);
    u8chekcode*= writeProfileInt(cConfig_CFGiniSection, "EVC_2F_RetrofitFuelcell_Avl",   getValue( HMI_EVC_2F_RetrofitFuelcell_Avl           ), cIND_iniFile);
    u8chekcode*= writeProfileInt(cConfig_CFGiniSection, "EVC_30_RearStWhl_Avl",           getValue( HMI_EVC_30_RearStWhl_Avl           ), cIND_iniFile);
    u8chekcode*= writeProfileInt(cConfig_CFGiniSection, "EVC_31_AddEquip_Avl",           getValue( HMI_EVC_31_AddEquip_Avl           ), cIND_iniFile);
    u8chekcode*= writeProfileInt(cConfig_CFGiniSection, "EVC_32_Hyb_ME10_Avl",           getValue( HMI_EVC_32_Hyb_ME10_Avl           ), cIND_iniFile);
    u8chekcode*= writeProfileInt(cConfig_CFGiniSection, "EVC_33_EmgOpn_F_Avl",           getValue( HMI_EVC_33_EmgOpn_F_Avl           ), cIND_iniFile);
    u8chekcode*= writeProfileInt(cConfig_CFGiniSection, "EVC_34_Curtain_F_Avl",          getValue( HMI_EVC_34_Curtain_F_Avl          ), cIND_iniFile);
    u8chekcode*= writeProfileInt(cConfig_CFGiniSection, "EVC_35_EmgOpn_Inact",           getValue( HMI_EVC_35_EmgOpn_Inact           ), cIND_iniFile);
    u8chekcode*= writeProfileInt(cConfig_CFGiniSection, "EVC_36_SpecVehPW_FL_Avl",       getValue( HMI_EVC_36_SpecVehPW_FL_Avl       ), cIND_iniFile);
    u8chekcode*= writeProfileInt(cConfig_CFGiniSection, "EVC_37_SpecVehPW_FR_Avl",       getValue( HMI_EVC_37_SpecVehPW_FR_Avl       ), cIND_iniFile);
    u8chekcode*= writeProfileInt(cConfig_CFGiniSection, "EVC_38_SpecVehPW_RL_Avl",       getValue( HMI_EVC_38_SpecVehPW_RL_Avl       ), cIND_iniFile);
    u8chekcode*= writeProfileInt(cConfig_CFGiniSection, "EVC_39_SpecVehPW_RR_Avl",       getValue( HMI_EVC_39_SpecVehPW_RR_Avl       ), cIND_iniFile);
    u8chekcode*= writeProfileInt(cConfig_CFGiniSection, "EVC_3A_RB_F_Avl",               getValue( HMI_EVC_3A_RB_F_Avl               ), cIND_iniFile);
    u8chekcode*= writeProfileInt(cConfig_CFGiniSection, "EVC_3B_RB_R_Avl",               getValue( HMI_EVC_3B_RB_R_Avl               ), cIND_iniFile);
    u8chekcode*= writeProfileInt(cConfig_CFGiniSection, "EVC_3C_SeatDrvDyn_Ft_Avl",      getValue( HMI_EVC_3C_SeatDrvDyn_Ft_Avl      ), cIND_iniFile);
    u8chekcode*= writeProfileInt(cConfig_CFGiniSection, "EVC_3D_ComfHdRst_Ft_Avl",       getValue( HMI_EVC_3D_ComfHdRst_Ft_Avl       ), cIND_iniFile);
    u8chekcode*= writeProfileInt(cConfig_CFGiniSection, "EVC_3E_SeatMultiCont_Ft_Avl",   getValue( HMI_EVC_3E_SeatMultiCont_Ft_Avl   ), cIND_iniFile);
    u8chekcode*= writeProfileInt(cConfig_CFGiniSection, "EVC_3F_SeatHt_Ft_Avl",          getValue( HMI_EVC_3F_SeatHt_Ft_Avl          ), cIND_iniFile);
    u8chekcode*= writeProfileInt(cConfig_CFGiniSection, "EVC_40_SeatClim_Ft_Avl",        getValue( HMI_EVC_40_SeatClim_Ft_Avl        ), cIND_iniFile);
    u8chekcode*= writeProfileInt(cConfig_CFGiniSection, "EVC_41_SeatMem_LHD_Avl",        getValue( HMI_EVC_41_SeatMem_LHD_Avl        ), cIND_iniFile);
    u8chekcode*= writeProfileInt(cConfig_CFGiniSection, "EVC_42_SeatMem_RHD_Avl",        getValue( HMI_EVC_42_SeatMem_RHD_Avl        ), cIND_iniFile);
    u8chekcode*= writeProfileInt(cConfig_CFGiniSection, "EVC_43_SeatMemPk_Avl",          getValue( HMI_EVC_43_SeatMemPk_Avl          ), cIND_iniFile);
    u8chekcode*= writeProfileInt(cConfig_CFGiniSection, "EVC_44_ReclSeat_Avl",           getValue( HMI_EVC_44_ReclSeat_Avl           ), cIND_iniFile);
    u8chekcode*= writeProfileInt(cConfig_CFGiniSection, "EVC_45_SeatMultiCont_R_Avl",    getValue( HMI_EVC_45_SeatMultiCont_R_Avl    ), cIND_iniFile);
    u8chekcode*= writeProfileInt(cConfig_CFGiniSection, "EVC_46_SeatBkRstAdj_R_Avl",     getValue( HMI_EVC_46_SeatBkRstAdj_R_Avl     ), cIND_iniFile);
    u8chekcode*= writeProfileInt(cConfig_CFGiniSection, "EVC_47_SeatHt_R_Avl",           getValue( HMI_EVC_47_SeatHt_R_Avl           ), cIND_iniFile);
    u8chekcode*= writeProfileInt(cConfig_CFGiniSection, "EVC_48_SeatClim_R_Avl",         getValue( HMI_EVC_48_SeatClim_R_Avl         ), cIND_iniFile);
    u8chekcode*= writeProfileInt(cConfig_CFGiniSection, "EVC_49_WShWashHt_Avl",          getValue( HMI_EVC_49_WShWashHt_Avl          ), cIND_iniFile);
    u8chekcode*= writeProfileInt(cConfig_CFGiniSection, "EVC_4A_TaxiPwrSup_Avl",         getValue( HMI_EVC_4A_TaxiPwrSup_Avl         ), cIND_iniFile);
    u8chekcode*= writeProfileInt(cConfig_CFGiniSection, "EVC_4B_TaxiRoofLmpCon_Avl",     getValue( HMI_EVC_4B_TaxiRoofLmpCon_Avl     ), cIND_iniFile);
    u8chekcode*= writeProfileInt(cConfig_CFGiniSection, "EVC_4C_TaxiEmgAlm_Avl",         getValue( HMI_EVC_4C_TaxiEmgAlm_Avl         ), cIND_iniFile);
    u8chekcode*= writeProfileInt(cConfig_CFGiniSection, "EVC_4D_RadioHdFree_Avl",        getValue( HMI_EVC_4D_RadioHdFree_Avl        ), cIND_iniFile);
    u8chekcode*= writeProfileInt(cConfig_CFGiniSection, "EVC_4E_GAS_Avl",                getValue( HMI_EVC_4E_GAS_Avl                ), cIND_iniFile);
    u8chekcode*= writeProfileInt(cConfig_CFGiniSection, "EVC_4F_CtrlU_MultiFunc_Avl",    getValue( HMI_EVC_4F_CtrlU_MultiFunc_Avl    ), cIND_iniFile);
    u8chekcode*= writeProfileInt(cConfig_CFGiniSection, "EVC_50_TaxInMirr_Avl",          getValue( HMI_EVC_50_TaxInMirr_Avl          ), cIND_iniFile);
    u8chekcode*= writeProfileInt(cConfig_CFGiniSection, "EVC_51_DistRecInMirr_Avl",      getValue( HMI_EVC_51_DistRecInMirr_Avl      ), cIND_iniFile);
    u8chekcode*= writeProfileInt(cConfig_CFGiniSection, "EVC_52_PreInstRad_Avl",         getValue( HMI_EVC_52_PreInstRad_Avl         ), cIND_iniFile);
    u8chekcode*= writeProfileInt(cConfig_CFGiniSection, "EVC_53_VehHandi_Avl",           getValue( HMI_EVC_53_VehHandi_Avl           ), cIND_iniFile);
    u8chekcode*= writeProfileInt(cConfig_CFGiniSection, "EVC_54_PanelHt_Avl",            getValue( HMI_EVC_54_PanelHt_Ft_Avl         ), cIND_iniFile);
    u8chekcode*= writeProfileInt(cConfig_CFGiniSection, "EVC_55_SeatComfHt_Ft_Avl",      getValue( HMI_EVC_55_SeatComfHt_Ft_Avl      ), cIND_iniFile);
    u8chekcode*= writeProfileInt(cConfig_CFGiniSection, "EVC_56_SeatComfHt_R_Avl",       getValue( HMI_EVC_56_SeatComfHt_R_Avl       ), cIND_iniFile);
    u8chekcode*= writeProfileInt(cConfig_CFGiniSection, "EVC_57_IntFoldHdRst_Ft_Avl",    getValue( HMI_EVC_57_IntFoldHdRst_Ft_Avl    ), cIND_iniFile);
    u8chekcode*= writeProfileInt(cConfig_CFGiniSection, "EVC_58_SeatInd_R_Avl",          getValue( HMI_EVC_58_SeatInd_R_Avl          ), cIND_iniFile);
    u8chekcode*= writeProfileInt(cConfig_CFGiniSection, "EVC_59_SeatChauffPos_P_Avl",    getValue( HMI_EVC_59_SeatChauffPos_P_Avl    ), cIND_iniFile);
    u8chekcode*= writeProfileInt(cConfig_CFGiniSection, "EVC_5A_SeatMContMass_Ft_Avl",   getValue( HMI_EVC_5A_SeatMContMass_Ft_Avl   ), cIND_iniFile);
    u8chekcode*= writeProfileInt(cConfig_CFGiniSection, "EVC_5B_AddEquip_Avl",           getValue( HMI_EVC_5B_PanelHt_R_Avl          ), cIND_iniFile);
    u8chekcode*= writeProfileInt(cConfig_CFGiniSection, "EVC_5C_Airscarf_Ft_Avl",        getValue( HMI_EVC_5C_Airscarf_Ft_Avl        ), cIND_iniFile);
    u8chekcode*= writeProfileInt(cConfig_CFGiniSection, "EVC_5D_SeatLimit_P_Avl",        getValue( HMI_EVC_5D_SeatLimit_P_Avl        ), cIND_iniFile);
    u8chekcode*= writeProfileInt(cConfig_CFGiniSection, "EVC_5E_TaxiRoofLmp_Avl",        getValue( HMI_EVC_5E_TaxiRoofLmp_Avl        ), cIND_iniFile);
    u8chekcode*= writeProfileInt(cConfig_CFGiniSection, "EVC_5F_SeatElAdj_LHD_Avl",      getValue( HMI_EVC_5F_SeatElAdj_LHD_Avl      ), cIND_iniFile);
    u8chekcode*= writeProfileInt(cConfig_CFGiniSection, "EVC_60_SeatElAdj_RHD_Avl",      getValue( HMI_EVC_60_SeatElAdj_RHD_Avl      ), cIND_iniFile);
    u8chekcode*= writeProfileInt(cConfig_CFGiniSection, "EVC_61_AMGPerfSusp_Avl",        getValue( HMI_EVC_61_AMGPerfSusp_Avl        ), cIND_iniFile);
    u8chekcode*= writeProfileInt(cConfig_CFGiniSection, "EVC_62_ShiftExhstSys_Avl",      getValue( HMI_EVC_62_ShiftExhstSys_Avl      ), cIND_iniFile);
    u8chekcode*= writeProfileInt(cConfig_CFGiniSection, "EVC_63_ActvLDA_MPC_Avl",        getValue( HMI_EVC_63_ActvLDA_MPC_Avl        ), cIND_iniFile);
    u8chekcode*= writeProfileInt(cConfig_CFGiniSection, "EVC_64_EAS_Avl",                getValue( HMI_EVC_64_EAS_Avl                ), cIND_iniFile);
    u8chekcode*= writeProfileInt(cConfig_CFGiniSection, "EVC_65_CruiseCtrl_Avl",         getValue( HMI_EVC_65_CruiseCtrl_Avl         ), cIND_iniFile);
    u8chekcode*= writeProfileInt(cConfig_CFGiniSection, "EVC_66_OffRoadPk_Avl",          getValue( HMI_EVC_66_OffRoadPk_Avl          ), cIND_iniFile);
    u8chekcode*= writeProfileInt(cConfig_CFGiniSection, "EVC_67_CMS_Avl",                getValue( HMI_EVC_67_CMS_Avl                ), cIND_iniFile);
    u8chekcode*= writeProfileInt(cConfig_CFGiniSection, "EVC_68_CMS_R_Avl",              getValue( HMI_EVC_68_CMS_R_Avl              ), cIND_iniFile);
    u8chekcode*= writeProfileInt(cConfig_CFGiniSection, "EVC_69_BrkEngg_PP_Avl",         getValue( HMI_EVC_69_BrkEngg_PP_Avl         ), cIND_iniFile);
    u8chekcode*= writeProfileInt(cConfig_CFGiniSection, "EVC_6A_BasExtd_Avl",            getValue( HMI_EVC_6A_BasExtd_Avl            ), cIND_iniFile);
    u8chekcode*= writeProfileInt(cConfig_CFGiniSection, "EVC_6B_MirrFld_Avl",            getValue( HMI_EVC_6B_MirrFld_Avl            ), cIND_iniFile);
    u8chekcode*= writeProfileInt(cConfig_CFGiniSection, "EVC_6C_BSM_Avl",                getValue( HMI_EVC_6C_BSM_Avl                ), cIND_iniFile);
    u8chekcode*= writeProfileInt(cConfig_CFGiniSection, "EVC_6D_ActvBSM_Avl",            getValue( HMI_EVC_6D_ActvBSM_Avl            ), cIND_iniFile);
    u8chekcode*= writeProfileInt(cConfig_CFGiniSection, "EVC_6E_TurnAss_Avl",            getValue( HMI_EVC_6E_TurnAss_Avl            ), cIND_iniFile);
    u8chekcode*= writeProfileInt(cConfig_CFGiniSection, "EVC_6F_ADTR_Avl",               getValue( HMI_EVC_6F_ADTR_Avl               ), cIND_iniFile);
    u8chekcode*= writeProfileInt(cConfig_CFGiniSection, "EVC_70_DTR_Pro_Avl",            getValue( HMI_EVC_70_DTR_Pro_Avl            ), cIND_iniFile);
    u8chekcode*= writeProfileInt(cConfig_CFGiniSection, "EVC_71_ALS_Avl",                getValue( HMI_EVC_71_ALS_Avl                ), cIND_iniFile);
    u8chekcode*= writeProfileInt(cConfig_CFGiniSection, "EVC_72_ActvLDA_Avl",            getValue( HMI_EVC_72_ActvLDA_Avl            ), cIND_iniFile);
    u8chekcode*= writeProfileInt(cConfig_CFGiniSection, "EVC_73_FCW_Avl",                getValue( HMI_EVC_73_FCW_Avl                ), cIND_iniFile);
    u8chekcode*= writeProfileInt(cConfig_CFGiniSection, "EVC_74_LaneRec_Avl",            getValue( HMI_EVC_74_LaneRec_Avl            ), cIND_iniFile);
    u8chekcode*= writeProfileInt(cConfig_CFGiniSection, "EVC_75_NV_Avl",                 getValue( HMI_EVC_75_NV_Avl                 ), cIND_iniFile);
    u8chekcode*= writeProfileInt(cConfig_CFGiniSection, "EVC_76_RoadSignDtct_Avl",       getValue( HMI_EVC_76_RoadSignDtct_Avl       ), cIND_iniFile);
    u8chekcode*= writeProfileInt(cConfig_CFGiniSection, "EVC_77_RVC_Avl",                getValue( HMI_EVC_77_RVC_Avl                ), cIND_iniFile);
    u8chekcode*= writeProfileInt(cConfig_CFGiniSection, "EVC_78_SurrView_Avl",           getValue( HMI_EVC_78_SurrView_Avl           ), cIND_iniFile);
    u8chekcode*= writeProfileInt(cConfig_CFGiniSection, "EVC_79_PTS_Avl",                getValue( HMI_EVC_79_PTS_Avl                ), cIND_iniFile);
    u8chekcode*= writeProfileInt(cConfig_CFGiniSection, "EVC_7A_APG_Avl",                getValue( HMI_EVC_7A_APG_Avl                ), cIND_iniFile);
    u8chekcode*= writeProfileInt(cConfig_CFGiniSection, "EVC_7B_ActPKAS_Avl",            getValue( HMI_EVC_7B_ActPKAS_Avl            ), cIND_iniFile);
    u8chekcode*= writeProfileInt(cConfig_CFGiniSection, "EVC_7C_IHC_Avl",                getValue( HMI_EVC_7C_IHC_Avl                ), cIND_iniFile);
    u8chekcode*= writeProfileInt(cConfig_CFGiniSection, "EVC_7D_IHC_Plus_Avl",           getValue( HMI_EVC_7D_IHC_Plus_Avl           ), cIND_iniFile);
    u8chekcode*= writeProfileInt(cConfig_CFGiniSection, "EVC_7E_BasPlusQ_Avl",           getValue( HMI_EVC_7E_BasPlusQ_Avl           ), cIND_iniFile);
    u8chekcode*= writeProfileInt(cConfig_CFGiniSection, "EVC_7F_ECO_St_Avl",             getValue( HMI_EVC_7F_ECO_St_Avl             ), cIND_iniFile);
    u8chekcode*= writeProfileInt(cConfig_CFGiniSection, "EVC_80_PSTS_Avl",               getValue( HMI_EVC_80_PSTS_Avl               ), cIND_iniFile);
    u8chekcode*= writeProfileInt(cConfig_CFGiniSection, "EVC_81_ABC_Avl",                getValue( HMI_EVC_81_ABC_Avl                ), cIND_iniFile);
    u8chekcode*= writeProfileInt(cConfig_CFGiniSection, "EVC_82_SteelAirSusp_Avl",       getValue( HMI_EVC_82_SteelAirSusp_Avl       ), cIND_iniFile);
    u8chekcode*= writeProfileInt(cConfig_CFGiniSection, "EVC_83_AirSemiActv_Susp_Avl",   getValue( HMI_EVC_83_AirSemiActv_Susp_Avl   ), cIND_iniFile);
    u8chekcode*= writeProfileInt(cConfig_CFGiniSection, "EVC_84_SportSusp_Avl",          getValue( HMI_EVC_84_SportSusp_Avl          ), cIND_iniFile);
    u8chekcode*= writeProfileInt(cConfig_CFGiniSection, "EVC_85_SportPk_AMG_Avl",        getValue( HMI_EVC_85_SportPk_AMG_Avl        ), cIND_iniFile);
    u8chekcode*= writeProfileInt(cConfig_CFGiniSection, "EVC_86_SportPk_Avl",            getValue( HMI_EVC_86_SportPk_Avl            ), cIND_iniFile);
    u8chekcode*= writeProfileInt(cConfig_CFGiniSection, "EVC_87_SportPk_Ext_Avl",        getValue( HMI_EVC_87_SportPk_Ext_Avl        ), cIND_iniFile);
    u8chekcode*= writeProfileInt(cConfig_CFGiniSection, "EVC_88_DualView_Avl",           getValue( HMI_EVC_88_DualView_Avl           ), cIND_iniFile);
    u8chekcode*= writeProfileInt(cConfig_CFGiniSection, "EVC_89_Entertain_R_Avl",        getValue( HMI_EVC_89_Entertain_R_Avl        ), cIND_iniFile);
    u8chekcode*= writeProfileInt(cConfig_CFGiniSection, "EVC_8A_DigTV_Avl",              getValue( HMI_EVC_8A_DigTV_Avl              ), cIND_iniFile);
    u8chekcode*= writeProfileInt(cConfig_CFGiniSection, "EVC_8B_DAB_Tun_Avl",            getValue( HMI_EVC_8B_DAB_Tun_Avl            ), cIND_iniFile);
    u8chekcode*= writeProfileInt(cConfig_CFGiniSection, "EVC_8C_MTUS_Avl",               getValue( HMI_EVC_8C_MTUS_Avl               ), cIND_iniFile);
    u8chekcode*= writeProfileInt(cConfig_CFGiniSection, "EVC_8D_UCI_Avl",                getValue( HMI_EVC_8D_UCI_Avl                ), cIND_iniFile);
    u8chekcode*= writeProfileInt(cConfig_CFGiniSection, "EVC_8E_SndSys_Avl",             getValue( HMI_EVC_8E_SndSys_Avl             ), cIND_iniFile);
    u8chekcode*= writeProfileInt(cConfig_CFGiniSection, "EVC_8F_WShViewWin_Avl",         getValue( HMI_EVC_8F_WShViewWin_Avl         ), cIND_iniFile);
    u8chekcode*= writeProfileInt(cConfig_CFGiniSection, "EVC_90_WSh_Clr_Avl",            getValue( HMI_EVC_90_WSh_Clr_Avl            ), cIND_iniFile);
    u8chekcode*= writeProfileInt(cConfig_CFGiniSection, "EVC_91_WSh_Ht_Avl",             getValue( HMI_EVC_91_WSh_Ht_Avl             ), cIND_iniFile);
    u8chekcode*= writeProfileInt(cConfig_CFGiniSection, "EVC_92_WShBL_Prot_Avl",         getValue( HMI_EVC_92_WShBL_Prot_Avl         ), cIND_iniFile);
    u8chekcode*= writeProfileInt(cConfig_CFGiniSection, "EVC_93_WSh_Ht_Lcut_Avl",        getValue( HMI_EVC_93_WSh_Ht_Lcut_Avl        ), cIND_iniFile);
    u8chekcode*= writeProfileInt(cConfig_CFGiniSection, "EVC_94_OptPack_Clas_Avl",       getValue( HMI_EVC_94_OptPack_Clas_Avl       ), cIND_iniFile);
    u8chekcode*= writeProfileInt(cConfig_CFGiniSection, "EVC_95_OptPack_Avan_Avl",       getValue( HMI_EVC_95_OptPack_Avan_Avl       ), cIND_iniFile);
    u8chekcode*= writeProfileInt(cConfig_CFGiniSection, "EVC_96_OptPack_Eleg_Avl",       getValue( HMI_EVC_96_OptPack_Eleg_Avl       ), cIND_iniFile);
} 

void Config_vFindCurrentSelectedCFGSection()
{
    switch(getValue(Env_Config_eSelConfigSetup))
    {
        case CONFIG_MIN:      // CONFIG_MAX
            strncpy(cConfig_iniSection, "CONFIG_MIN", 16);
        break;
        case CONFIG_MAX:      // CONFIG_MAX
            strncpy(cConfig_iniSection, "CONFIG_MAX", 16);
        break;
        case CONFIG_TYPICAL:      // CONFIG_TYPICAL
            strncpy(cConfig_iniSection, "CONFIG_TYPICAL", 16);
        break;
        case CONFIG_1:      // CONFIG_1
            strncpy(cConfig_iniSection, "CONFIG_1", 16);
        break;
        case CONFIG_2:      // CONFIG_2
            strncpy(cConfig_iniSection, "CONFIG_2", 16);
        break;
        case CONFIG_3:      // CONFIG_3
            strncpy(cConfig_iniSection, "CONFIG_3", 16);
        break;
        case CONFIG_4:      // CONFIG_4
            strncpy(cConfig_iniSection, "CONFIG_4", 16);
        break;
        case CONFIG_5:      // CONFIG_5
            strncpy(cConfig_iniSection, "CONFIG_5", 16);
        break;
        case CONFIG_6:      // CONFIG_6
            strncpy(cConfig_iniSection, "CONFIG_6", 16);
        break;
        case CONFIG_7:      // CONFIG_7
            strncpy(cConfig_iniSection, "CONFIG_7", 16);
        break;
        case CONFIG_8:      // CONFIG_8
            strncpy(cConfig_iniSection, "CONFIG_8", 16);
        break;
        case CONFIG_9:      // CONFIG_9
            strncpy(cConfig_iniSection, "CONFIG_9", 16);
        break;
        case CONFIG_10:      // CONFIG_10
            strncpy(cConfig_iniSection, "CONFIG_10", 16);
        break;
        case CONFIG_11:      // CONFIG_11
            strncpy(cConfig_iniSection, "CONFIG_11", 16);
        break;
        case CONFIG_12:      // CONFIG_12
            strncpy(cConfig_iniSection, "CONFIG_12", 16);
        break;
        case CONFIG_13:      // CONFIG_13
            strncpy(cConfig_iniSection, "CONFIG_13", 16);
        break;
        default:
            strncpy(cConfig_iniSection, "DEFAULT", 16);
        break;
     }   
}

on envVar Env_Dimm_Plus50_Button
{
    word temp;
    if( getValue( this ) )
    {
        temp = getValue( HMI_SwIllLvl_Raw ) + 50;
        temp = temp & 0x00FF;
        putValue ( HMI_SwIllLvl_Raw, temp );
    }
}

on envVar Env_Dimm_Plus25_Button
{
    word temp;
    if( getValue( this ) )
    {
        temp = getValue( HMI_SwIllLvl_Raw ) + 25;
        temp = temp & 0x00FF;
        putValue ( HMI_SwIllLvl_Raw, temp );
    }
}

on envVar Env_Dimm_Plus10_Button
{
    word temp;
    if( getValue( this ) )
    {
        temp = getValue( HMI_SwIllLvl_Raw ) + 10;
        temp = temp & 0x00FF;
        putValue ( HMI_SwIllLvl_Raw, temp );
    }
}

on envVar Env_Dimm_Plus05_Button
{
    word temp;
    if( getValue( this ) )
    {
        temp = getValue( HMI_SwIllLvl_Raw ) + 5;
        temp = temp & 0x00FF;
        putValue ( HMI_SwIllLvl_Raw, temp );
    }
}

on envVar Env_Dimm_Plus01_Button
{
    word temp;
    if( getValue( this ) )
    {
        temp = getValue( HMI_SwIllLvl_Raw ) + 1;
        temp = temp & 0x00FF;
        putValue ( HMI_SwIllLvl_Raw, temp );
    }
}

on envVar Env_Dimm_Minus01_Button
{
    word temp;
    if( getValue( this ) )
    {
        temp = getValue( HMI_SwIllLvl_Raw ) - 1;
        temp = temp & 0x00FF;
        putValue ( HMI_SwIllLvl_Raw, temp );
    }
}

on envVar Env_Dimm_Minus50_Button
{
    word temp;
    if( getValue( this ) )
    {
        temp = getValue( HMI_SwIllLvl_Raw ) - 50;
        temp = temp & 0x00FF;
        putValue ( HMI_SwIllLvl_Raw, temp );
    }
}

on envVar Env_Dimm_Minus25_Button
{
    word temp;
    if( getValue( this ) )
    {
        temp = getValue( HMI_SwIllLvl_Raw ) - 25;
        temp = temp & 0x00FF;
        putValue ( HMI_SwIllLvl_Raw, temp );
    }
}

on envVar Env_Dimm_Minus10_Button
{
    word temp;
    if( getValue( this ) )
    {
        temp = getValue( HMI_SwIllLvl_Raw ) - 10;
        temp = temp & 0x00FF;
        putValue ( HMI_SwIllLvl_Raw, temp );
    }
}

on envVar Env_Dimm_Minus05_Button
{
    word temp;
    if( getValue( this ) )
    {
        temp = getValue( HMI_SwIllLvl_Raw ) - 5;
        temp = temp & 0x00FF;
        putValue ( HMI_SwIllLvl_Raw, temp );
    }
}

on envVar HMI_SwIllLvl_Ctrl_Style
{
    // at switch to "IncrementalEncoder" set SwIllLvl_Raw to current defautl
    if( getValue( this ) == 1 )
        putValue( HMI_SwIllLvl_Raw, SWIllLvl_Raw_Default );
}

on envVar Env_Dimm_Minus01_Button_Delta
{
    word temp;
    if( getValue( this ) )
    {
        if( getValue( HMI_SwIllLvl_Raw ) == SWIllLvl_Raw_Default )
        {   
            temp = (SWIllLvl_Raw_Default - 1) & 0xFF;
            putValue( HMI_SwIllLvl_Raw, temp );
            setTimer (_tSwIllLvl_Raw_ButtonPress_msec, cSwIllLvl_Raw_ButtonPress_Duration);
        }
    }
/*    else
    {
        putValue( HMI_SwIllLvl_Raw, 0 );
    }*/
}

on envVar Env_Dimm_Minus02_Button_Delta
{
    word temp;
    if( getValue( this ) )
    {
        if( getValue( HMI_SwIllLvl_Raw ) == SWIllLvl_Raw_Default )
        {
            temp = (SWIllLvl_Raw_Default - 2) & 0xFF;
            putValue( HMI_SwIllLvl_Raw, temp );
            setTimer (_tSwIllLvl_Raw_ButtonPress_msec, cSwIllLvl_Raw_ButtonPress_Duration);
        }
    }
/*    else
    {
        putValue( HMI_SwIllLvl_Raw, 0 );
    }*/
}

on envVar Env_Dimm_Minus03_Button_Delta
{
    word temp;
    if( getValue( this ) )
    {
        if( getValue( HMI_SwIllLvl_Raw ) == SWIllLvl_Raw_Default )
        {
            temp = (SWIllLvl_Raw_Default - 3) & 0xFF;
            putValue( HMI_SwIllLvl_Raw, temp );
            setTimer (_tSwIllLvl_Raw_ButtonPress_msec, cSwIllLvl_Raw_ButtonPress_Duration);
        }
    }
/*    else
    {
        putValue( HMI_SwIllLvl_Raw, 0 );
    }*/
}

on envVar Env_Dimm_Minus05_Button_Delta
{
    word temp;
    if( getValue( this ) )
    {
        if( getValue( HMI_SwIllLvl_Raw ) == SWIllLvl_Raw_Default )
        {
            temp = (SWIllLvl_Raw_Default - 5) & 0xFF;
            putValue( HMI_SwIllLvl_Raw, temp );
            setTimer (_tSwIllLvl_Raw_ButtonPress_msec, cSwIllLvl_Raw_ButtonPress_Duration);
        }
    }
/*    else
    {
        putValue( HMI_SwIllLvl_Raw, 0 );
    }*/
}

on envVar Env_Dimm_Minus10_Button_Delta
{
    word temp;
    if( getValue( this ) )
    {
        if( getValue( HMI_SwIllLvl_Raw ) == SWIllLvl_Raw_Default )
        {
            temp = (SWIllLvl_Raw_Default - 10) & 0xFF;
            putValue( HMI_SwIllLvl_Raw, temp );
            setTimer (_tSwIllLvl_Raw_ButtonPress_msec, cSwIllLvl_Raw_ButtonPress_Duration);
        }
    }
/*    else
    {
        putValue( HMI_SwIllLvl_Raw, 0 );
    }*/
}

on envVar Env_Dimm_Plus01_Button_Delta
{
    word temp;
    if( getValue( this ) )
    {
        if( getValue( HMI_SwIllLvl_Raw ) == SWIllLvl_Raw_Default )
        {
            temp = (SWIllLvl_Raw_Default + 1) & 0xFF;
            putValue( HMI_SwIllLvl_Raw, temp );
            setTimer (_tSwIllLvl_Raw_ButtonPress_msec, cSwIllLvl_Raw_ButtonPress_Duration);
        }
    }
/*    else
    {
        putValue( HMI_SwIllLvl_Raw, 0 );
    }*/
}

on envVar Env_Dimm_Plus02_Button_Delta
{
    word temp;
    if( getValue( this ) )
    {
        if( getValue( HMI_SwIllLvl_Raw ) == SWIllLvl_Raw_Default )
        {
            temp = (SWIllLvl_Raw_Default + 2) & 0xFF;
            putValue( HMI_SwIllLvl_Raw, temp );
            setTimer (_tSwIllLvl_Raw_ButtonPress_msec, cSwIllLvl_Raw_ButtonPress_Duration);
        }
    }
/*    else
    {
        putValue( HMI_SwIllLvl_Raw, 0 );
    }*/
}

on envVar Env_Dimm_Plus03_Button_Delta
{
    word temp;
    if( getValue( this ) )
    {
        if(  getValue( HMI_SwIllLvl_Raw ) == SWIllLvl_Raw_Default)
        {
            temp = (SWIllLvl_Raw_Default + 3) & 0xFF;
            putValue( HMI_SwIllLvl_Raw, temp );
            setTimer (_tSwIllLvl_Raw_ButtonPress_msec, cSwIllLvl_Raw_ButtonPress_Duration);
        }
    }
/*    else
    {
        putValue( HMI_SwIllLvl_Raw, 0 );
    }*/
}

on envVar Env_Dimm_Plus05_Button_Delta
{
    word temp;
    if( getValue( this ) )
    {
        if(  getValue( HMI_SwIllLvl_Raw ) == SWIllLvl_Raw_Default)
        {
            temp = (SWIllLvl_Raw_Default + 5) & 0xFF;
            putValue( HMI_SwIllLvl_Raw, temp );
            setTimer (_tSwIllLvl_Raw_ButtonPress_msec, cSwIllLvl_Raw_ButtonPress_Duration);
        }
    }
/*    else
    {
        putValue( HMI_SwIllLvl_Raw, 0 );
    }*/
}

on envVar Env_Dimm_Plus10_Button_Delta
{
    word temp;
    if( getValue( this ) )
    {
        if(  getValue( HMI_SwIllLvl_Raw ) == SWIllLvl_Raw_Default)
        {
            temp = (SWIllLvl_Raw_Default + 10) & 0xFF;
            putValue( HMI_SwIllLvl_Raw, temp );
            setTimer (_tSwIllLvl_Raw_ButtonPress_msec, cSwIllLvl_Raw_ButtonPress_Duration);
        }
    }
/*    else
    {
        putValue( HMI_SwIllLvl_Raw, 0 );
    }*/
}

on envVar Env_Dimm_Incremental_Type
{
    if( getValue( this ) == 0 )
        putValue( HMI_SwIllLvl_Raw, SWIllLvl_Raw_Default );

}

on envVar Env_Dimm_SWIllLvl_Raw_behave
{
    switch (getvalue(this))
    {
        case 0: 
        {
        SWIllLvl_Raw_Default = cSWIllLvl_Raw_Default_old;
        if (getValue(Env_Stress__StresstestMainActiv_EMC) == 1)    
          SWIllLvl_Raw_Default = 101;
        else 
          SWIllLvl_Raw_Default = cSWIllLvl_Raw_Default_old;
        }
        break;
        case 1: 
        {
        SWIllLvl_Raw_Default = cSWIllLvl_Raw_Default_new;
        if (getValue(Env_Stress__StresstestMainActiv_EMC) == 1)    
          SWIllLvl_Raw_Default = 101;
        else 
          SWIllLvl_Raw_Default = cSWIllLvl_Raw_Default_new;
        }
        break;
    }

    putValue ( HMI_SwIllLvl_Raw, SWIllLvl_Raw_Default );
}

on envVar Env_EngIdleRPM_Dsr
{
   if( getValue(Env_EngIdleRPM_Dsr_Fehler) )
   {
      putValue( HMI_EngIdleRPM_Dsr, 16383 );
   }
   else
   {
      putValue( HMI_EngIdleRPM_Dsr, getValue(this) );
   }
}

on envVar Env_EngIdleRPM_Dsr_Fehler
{
   if( getValue(this) )
   {
      putValue( HMI_EngIdleRPM_Dsr, 16383 );
   }
   else
   {
      putValue( HMI_EngIdleRPM_Dsr, getValue( Env_EngIdleRPM_Dsr ) );
   }
}

on envVar Env_KeyId_EIS_V2_Byte1
{
    KeyIdByte1 = getvalue( Env_KeyId_EIS_V2_Byte1 );
    KeyIdByte2 = getvalue( Env_KeyId_EIS_V2_Byte2 ) * 0x100;
    KeyIdByte3 = getvalue( Env_KeyId_EIS_V2_Byte3 ) * 0x10000;
    KeyIdByte4 = getvalue( Env_KeyId_EIS_V2_Byte4 ) * 0x1000000;
  
    putValue( HMI_KeyId_EIS_V2, ( KeyIdByte4 + KeyIdByte3 + KeyIdByte2 + KeyIdByte1 ) );

}

on envVar Env_KeyId_EIS_V2_Byte2
{
    KeyIdByte1 = getvalue( Env_KeyId_EIS_V2_Byte1 );
    KeyIdByte2 = getvalue( Env_KeyId_EIS_V2_Byte2 ) * 0x100;
    KeyIdByte3 = getvalue( Env_KeyId_EIS_V2_Byte3 ) * 0x10000;
    KeyIdByte4 = getvalue( Env_KeyId_EIS_V2_Byte4 ) * 0x1000000;
  
    putValue( HMI_KeyId_EIS_V2, ( KeyIdByte4 + KeyIdByte3 + KeyIdByte2 + KeyIdByte1 ) );

}

on envVar Env_KeyId_EIS_V2_Byte3
{
    KeyIdByte1 = getvalue( Env_KeyId_EIS_V2_Byte1 );
    KeyIdByte2 = getvalue( Env_KeyId_EIS_V2_Byte2 ) * 0x100;
    KeyIdByte3 = getvalue( Env_KeyId_EIS_V2_Byte3 ) * 0x10000;
    KeyIdByte4 = getvalue( Env_KeyId_EIS_V2_Byte4 ) * 0x1000000;
  
    putValue( HMI_KeyId_EIS_V2, ( KeyIdByte4 + KeyIdByte3 + KeyIdByte2 + KeyIdByte1 ) );

}

on envVar Env_KeyId_EIS_V2_Byte4
{
    KeyIdByte1 = getvalue( Env_KeyId_EIS_V2_Byte1 );
    KeyIdByte2 = getvalue( Env_KeyId_EIS_V2_Byte2 ) * 0x100;
    KeyIdByte3 = getvalue( Env_KeyId_EIS_V2_Byte3 ) * 0x10000;
    KeyIdByte4 = getvalue( Env_KeyId_EIS_V2_Byte4 ) * 0x1000000;
  
    putValue( HMI_KeyId_EIS_V2, ( KeyIdByte4 + KeyIdByte3 + KeyIdByte2 + KeyIdByte1 ) );

}

on envVar Env_Odo_EIS
{
float temp;
    temp = getValue( this );
    if( getValue( Env_Odo_EIS_Invalid ) )
    {
        putValue( HMI_Odo_EIS, ( 1677721.4 ));
    }
    else
    {
        putValue( HMI_Odo_EIS, temp );
    }
}

on envVar Env_Odo_EIS_Invalid
{
    if( getValue( this ) )
    {
        putValue( HMI_Odo_EIS, ( 1677721.4 ) );
    }
    else
    {
        putValue( HMI_Odo_EIS, getValue( Env_Odo_EIS ) );
    }
}

on key CursorUp
{
    putValue( Env_OFN_Up_1_Play, 1 );
    setTimer( tReleaseKeyCursorUp, cReleaseKeyTime );
}

on key '8'
{
    if( !getValue( Env_StWhl_Buttons_not_numeric ) )
    {
        putValue( Env_OFN_Up_1_Play, 1 );
        setTimer( tReleaseKeyCursorUp, cReleaseKeyTime );
    }
}

on timer tReleaseKeyCursorUp
{
    putValue( Env_OFN_Up_1_Play, 0 );
}

on key CursorDown
{
    putValue( Env_OFN_Down_1_Play, 1 );
    setTimer( tReleaseKeyCursorDown, cReleaseKeyTime );
}

on key '2'
{
    if( !getValue( Env_StWhl_Buttons_not_numeric ) )
    {
        putValue( Env_OFN_Down_1_Play, 1 );
        setTimer( tReleaseKeyCursorDown, cReleaseKeyTime );
    }
}

on timer tReleaseKeyCursorDown
{
    putValue( Env_OFN_Down_1_Play, 0 );
}

on key CursorRight
{
    putValue( Env_OFN_Right_1_Play, 1 );
    setTimer( tReleaseKeyCursorRight, cReleaseKeyTime );
}

on key '6'
{
    if( !getValue( Env_StWhl_Buttons_not_numeric ) )
    {
        putValue( Env_OFN_Right_1_Play, 1 );
        setTimer( tReleaseKeyCursorRight, cReleaseKeyTime );
    }
}

on timer tReleaseKeyCursorRight
{
    putValue( Env_OFN_Right_1_Play, 0 );
}

on key CursorLeft
{
    putValue( Env_OFN_Left_1_Play, 1 );
    setTimer( tReleaseKeyCursorLeft, cReleaseKeyTime );
}

on key '4'
{
    if( !getValue( Env_StWhl_Buttons_not_numeric ) )
    {
        putValue( Env_OFN_Left_1_Play, 1 );
        setTimer( tReleaseKeyCursorLeft, cReleaseKeyTime );
    }
}

on timer tReleaseKeyCursorLeft
{
    putValue( Env_OFN_Left_1_Play, 0 );
}

on key 'm'
{
    putValue( HMI_StWhl_Sw_Ok1_Psd, 1 );
    setTimer( tReleaseKeyM, cReleaseKeyTime );
}

on key 'M'
{
    putValue( HMI_StWhl_Sw_Ok1_Psd, 1 );
    setTimer( tReleaseKeyM, cReleaseKeyTime );
}

on key '5'
{
    if( !getValue( Env_StWhl_Buttons_not_numeric ) )
    {
        putValue( HMI_StWhl_Sw_Ok1_Psd, 1 );
        setTimer( tReleaseKeyM, cReleaseKeyTime );
    }
}

on timer tReleaseKeyM
{
    putValue( HMI_StWhl_Sw_Ok1_Psd, 0 );
}

on timer _tSwIllLvl_Raw_ButtonPress_msec
{
    putValue( HMI_SwIllLvl_Raw, SWIllLvl_Raw_Default );
}

on timer tReleaseKeyB
{
    putValue( HMI_StWhl_Sw_Back1_Psd, 0 );
}

on key '0'
{
    if( !getValue( Env_StWhl_Buttons_not_numeric ) )
    {
        putValue( HMI_StWhl_Sw_Back1_Psd, 1 );
        setTimer( tReleaseKeyB, cReleaseKeyTime );
    }
}

on key 'B'
{
    putValue( HMI_StWhl_Sw_Back1_Psd, 1 );
    setTimer( tReleaseKeyB, cReleaseKeyTime );
}

on key 'b'
{
    putValue( HMI_StWhl_Sw_Back1_Psd, 1 );
    setTimer( tReleaseKeyB, cReleaseKeyTime );
}

on envVar Env_OFN_Reload_File
{
    OFN__iniReadAll("ini_data\\OFN_Gesture_Data.ini");
}

/*on envVar DIAG_CTRL_IC_Type_Selector
{
    if( getValue( this ) == 4 )     // W222
    {
        putValue( HMI_EVC_List0C_VehLine, 4 );  //W222
        putValue( Env_KZahl, 22203 );
    }
    if( getValue( this ) == 6 ) 
    {
        putValue( HMI_EVC_List0C_VehLine, 6 );  //W205
        putValue( Env_KZahl, 23632 );
    }
    if( getValue( this ) == 11 ) 
    {
        putValue( HMI_EVC_List0C_VehLine, 11 );  //W217
        putValue( Env_KZahl, 21748 );
    }
    if( getValue( this ) == 13 ) 
    {
        putValue( HMI_EVC_List0C_VehLine, 13 );  //W213
        putValue( Env_KZahl, 23005 );  // RaHi 08.05.2014
    }
    if( getValue( this ) == 38 ) 
    {
        putValue( HMI_EVC_List0C_VehLine, 38 );  //W447
        putValue( Env_KZahl, 23005 );
    }
    if( getValue( this ) == 39 ) 
    {
        putValue( HMI_EVC_List0C_VehLine, 39 );  //W253
        putValue( Env_KZahl, 21122 );
    }
}*/

on timer _tPowerTst_Sample_Meas03
{
    if( getValue( Env_HIL_MainMenu          ) == 0 && 
        getValue( Env_HIL_Submenu_Msg_Byte1 ) == 0 && 
        getValue( Env_HIL_Submenu_Msg_Byte2 ) == 0 &&
        getValue( HMI_ISw_Stat ) >= 4 /* RUN */       )
    {
        Trace( "Shutdown off Test",  "" );
        Write( "                    SysPowMod : %X", getValue( HMI_ISw_Stat ) );
        cancelTimer( _tIgnSwitchOn_duration_msec );
        cancelTimer( _tIgnSwitchOff_duration_msec );
        cancelTimer( _tIgnSwitchLock_duration_msec );
        cancelTimer( _t_Power_CheckCommActive );
        putValue( Env_Power__PowertestMainActiv, 0 );
        if( getValue( Env_Power_Replay_Test_Enabled ) )
        {
            ReplayStop("StopModeTest");
            if( getValue( Env_Power_KeepAlive_Enabled ) )
            {
                ReplayStart("StopModeTest_keepAlive");
                Write( "Keep-Alive started, we are send >Ignition on< to keep IC alive");
            }
            putValue( Env_GOTIT, 1 );
        }
    }
}

on message Ign_Veh_Stat_AR
{
    if( getValue( HMI_ISw_Stat ) == 0 )
    {
        if( this.ISw_Stat > 0 )
        {
   //         setTimer( _tPowerTst_Sample_Meas03, 5000 );
            write("-----Timer for check started------- ISw_Stat is %X", this.ISw_Stat );
        }
    }
//    putValue( HMI_ISw_Stat, this.ISw_Stat );  deleted due to unwanted feedback when ISw_Stat is altered during supply-power off 
}

on envVar Env_EngOilLvl_Fehler
{
   if( getValue(this) )
   {
//      putValue( HMI_EngOilLvl, 80.315 );
   }
   else
   {
//      putValue( HMI_EngOilLvl, getValue( Env_EngOilLvl ) );
   }
}

on envVar Env_EngOilLvl
{
   if( getValue(Env_EngOilLvl_Fehler) )
   {
//      putValue( HMI_EngOilLvl, 80.315 );
   }
   else
   {
//      putValue( HMI_EngOilLvl, getValue(this) );
   }
}

on envVar Env_VehAccel_Y_V2
{
   if( getValue(Env_VehAccel_Y_V2_Fehler) )
   {
      putValue( HMI_VehAccel_Y_V2, 10.17 );
   }
   else
   {
      putValue( HMI_VehAccel_Y_V2, getValue(this) );
   }
}

on envVar Env_VehAccel_Y_V2_Fehler
{
   if( getValue(this) )
   {
      putValue( HMI_VehAccel_Y_V2, 10.17 );
   }
   else
   {
      putValue( HMI_VehAccel_Y_V2, getValue( Env_VehAccel_Y_V2 ) );
   }
}

on envVar Env_WIA_EngTrqMax
{
   if( getValue( Env_WIA_EngTrqMax_Fehler ) )
   {
      putValue( HMI_WIA_EngTrqMax, 1547.75 );
   }
   else
   {
      putValue( HMI_WIA_EngTrqMax, getValue(this) );
   }
}

on envVar Env_WIA_EngTrqMin
{
   if( getValue( Env_WIA_EngTrqMin_Fehler ) )
   {
      putValue( HMI_WIA_EngTrqMin, 1547.75 );
   }
   else
   {
      putValue( HMI_WIA_EngTrqMin, getValue(this) );
   }
}

on envVar Env_WIA_EngTrqStatic
{
   if( getValue( Env_WIA_EngTrqStatic_Fehler ) )
   {
      putValue( HMI_WIA_EngTrqStatic, 1547.75 );
   }
   else
   {
      putValue( HMI_WIA_EngTrqStatic, getValue(this) );
   }
}

on envVar Env_EngTrqStatic
{
   if( getValue( Env_EngTrqStatic_Fehler ) )
   {
      putValue( HMI_EngTrqStatic, 1547.75 );
   }
   else
   {
      putValue( HMI_EngTrqStatic, getValue(this) );
   }
}

on envVar Env_EngTrqMin
{
   if( getValue( Env_EngTrqMin_Fehler ) )
   {
      putValue( HMI_EngTrqMin, 1547.75 );
   }
   else
   {
      putValue( HMI_EngTrqMin, getValue(this) );
   }
}

on envVar Env_EngTrqMax
{
   if( getValue( Env_EngTrqMax_Fehler ) )
   {
      putValue( HMI_EngTrqMax, 1547.75 );
   }
   else
   {
      putValue( HMI_EngTrqMax, getValue(this) );
   }
}

on envVar Env_EngTrqMax_Fehler
{
   if( getValue(this) )
   {
      putValue( HMI_EngTrqMax, 1547.75 );
   }
   else
   {
      putValue( HMI_EngTrqMax, getValue( Env_EngTrqMax ) );
   }
}

on envVar Env_EngTrqMin_Fehler
{
   if( getValue(this) )
   {
      putValue( HMI_EngTrqMin, 1547.75 );
   }
   else
   {
      putValue( HMI_EngTrqMin, getValue( Env_EngTrqMin ) );
   }
}

on envVar Env_EngTrqStatic_Fehler
{
   if( getValue(this) )
   {
      putValue( HMI_EngTrqStatic, 1547.75 );
   }
   else
   {
      putValue( HMI_EngTrqStatic, getValue( Env_EngTrqStatic ) );
   }
}

on envVar Env_WIA_EngTrqStatic_Fehler
{
   if( getValue(this) )
   {
      putValue( HMI_WIA_EngTrqStatic, 1547.75 );
   }
   else
   {
      putValue( HMI_WIA_EngTrqStatic, getValue( Env_WIA_EngTrqStatic ) );
   }
}

on envVar Env_WIA_EngTrqMax_Fehler
{
   if( getValue(this) )
   {
      putValue( HMI_WIA_EngTrqMax, 1547.75 );
   }
   else
   {
      putValue( HMI_WIA_EngTrqMax, getValue( Env_WIA_EngTrqMax ) );
   }
}

on envVar Env_WIA_EngTrqMin_Fehler
{
   if( getValue(this) )
   {
      putValue( HMI_WIA_EngTrqMin, 1547.75 );
   }
   else
   {
      putValue( HMI_WIA_EngTrqMin, getValue( Env_WIA_EngTrqMin ) );
   }
}

on envVar Env_AmbBrt_Disp1_SNA
{
   if( getValue(this) )
   {
      putValue( HMI_AmbBrt_Disp1, 102.3 );
   }
   else
   {
      putValue( HMI_AmbBrt_Disp1, getValue( Env_AmbBrt_Disp1 ) );
   }
}

on envVar Env_AmbBrt_Disp1
{
   if( getValue(Env_AmbBrt_Disp1_SNA ) )
   {
      putValue( HMI_AmbBrt_Disp1, 102.3 );
   }
   else
   {
      putValue( HMI_AmbBrt_Disp1, getValue(this) );
   }
}

on envVar Env_AmbBrt_Disp2_SNA
{
   if( getValue(this) )
   {
      putValue( HMI_AmbBrt_Disp2, 102.3 );
   }
   else
   {
      putValue( HMI_AmbBrt_Disp2, getValue( Env_AmbBrt_Disp2 ) );
   }
}

on envVar Env_AmbBrt_Disp3_SNA
{
   if( getValue(this) )
   {
      putValue( HMI_AmbBrt_Disp3, 102.3 );
   }
   else
   {
      putValue( HMI_AmbBrt_Disp3, getValue( Env_AmbBrt_Disp3 ) );
   }
}

on envVar Env_AmbBrt_Disp2
{
   if( getValue(Env_AmbBrt_Disp2_SNA ) )
   {
      putValue( HMI_AmbBrt_Disp2, 102.3 );
   }
   else
   {
      putValue( HMI_AmbBrt_Disp2, getValue(this) );
   }
}

on envVar Env_AmbBrt_Disp3
{
   if( getValue(Env_AmbBrt_Disp3_SNA ) )
   {
      putValue( HMI_AmbBrt_Disp3, 102.3 );
   }
   else
   {
      putValue( HMI_AmbBrt_Disp3, getValue(this) );
   }
}

on envVar Env_DrHdl_Brt_F
{
   if( getValue(Env_DrHdl_Brt_F_SNA ) )
   {
      putValue( HMI_DrHdl_Brt_F, 102.3 );
   }
   else
   {
      putValue( HMI_DrHdl_Brt_F, getValue(this) );
   }
}

on envVar Env_DrHdl_Brt_R
{
   if( getValue(Env_DrHdl_Brt_R_SNA ) )
   {
      putValue( HMI_DrHdl_Brt_R, 102.3 );
   }
   else
   {
      putValue( HMI_DrHdl_Brt_R, getValue(this) );
   }
}

on envVar Env_DrHdl_Brt_F_SNA
{
   if( getValue(this) )
   {
      putValue( HMI_DrHdl_Brt_F, 102.3 );
   }
   else
   {
      putValue( HMI_DrHdl_Brt_F, getValue( Env_DrHdl_Brt_F ) );
   }
}

on envVar Env_DrHdl_Brt_R_SNA
{
   if( getValue(this) )
   {
      putValue( HMI_DrHdl_Brt_R, 102.3 );
   }
   else
   {
      putValue( HMI_DrHdl_Brt_R, getValue( Env_DrHdl_Brt_R ) );
   }
}

on envVar Env_TankLvl_Disp_V2_Fehler
{
   if( getValue(this) )
   {
      putValue( HMI_TankLvl_Disp_V2, 204.7 );
   }
   else
   {
      putValue( HMI_TankLvl_Disp_V2, getValue( Env_TankLvl_Disp_V2 ) );
   }
}

on envVar Env_TankLvl_Disp_V2
{
   if( getValue( Env_TankLvl_Disp_V2_Fehler ) )
   {
      putValue( HMI_TankLvl_Disp_V2, 204.7 );
   }
   else
   {
      putValue( HMI_TankLvl_Disp_V2, getValue(this) );
   }
}

void Trace( char functionName[], char info[])
{
  Trace( functionName, info, "");
}

void Trace( char functionName[], char info[], char verbose[])
{
  char sep[2] = "/";
  sep[0] = functionName[0] ? '/' : 0;
  if( verbose[0])
  {
    write( "[%.3f] HGW_VDO %s%s: %s", timeNow()/100000.0
           , sep
           , functionName
           , verbose
           );
  } else
  {
    write( "[%.3f] HGW_VDO %s%s: %s", timeNow()/100000.0
           , sep
           , functionName
           , info
           );
  }
}

void Trace( char functionName[], char info[], char verbose[], long argument)
{
  char line[100];
  snprintf( line, elcount(line ), verbose, argument);
  Trace( functionName, info, line );
}

void TraceCall( char functionName[], long callResult)
{
  char line[100];
  if( callResult == 1 )
    snprintf( line, elcount(line ), "calling %s", functionName );
  else
    snprintf( line, elcount(line ), "call to %s failed - wrong state?", functionName );
  Trace( "", "", line );
}

on timer _tPowerOnToLogDelay
{
    if( getValue( DIAG_LOG_OneShotLogLinkedToIgnSwitch ) )
    {
        putValue( DIAG_LOG_SessionActiv, 1 );
    }
}

on envVar Env_PNHV_AC_Curr_Max_Fehler
{
   if( getValue(this) )
   {
      putValue( HMI_PNHV_AC_Curr_Max, 77.5 );
   }
   else
   {
      putValue( HMI_PNHV_AC_Curr_Max, getValue( Env_PNHV_AC_Curr_Max ) );
   }
}

on envVar Env_PNHV_AC_Curr_Max
{
   if( getValue(Env_PNHV_AC_Curr_Max_Fehler) )
   {
      putValue( HMI_PNHV_AC_Curr_Max, 77.5 );
   }
   else
   {
      putValue( HMI_PNHV_AC_Curr_Max, getValue(this) );
   }
}

on stopMeasurement
{
	cancelTimer( t_ForceDisplayOffTimer ); // stop running timer
}

// function  	: When the Timer is called and automatically ForceDisplMode is activated
//                HMI_CLkS_Ext_Rq is set to 1. The timer is restartet and when the timer is called during HMI_CLkS_Ext_Rq=1
//                then HMI_CLkS_Ext_Rq is set to 0
// author    	: Daniel Warnicki 01.11.2012
on timer t_ForceDisplayOffTimer
{
    // klemp status was changed
    if( getvalue( Env_Power_ForceDisplOffAtKlLock_Auto ) )
    {
        // automatically ForceDisplMode is active
        if(!getvalue( HMI_ISw_Stat ) )
        {
            // klemp is lock
            if( getvalue( HMI_CLkS_Ext_Rq ) == 0 )
            {
                // CLkS_Ext_Rq=IDLE
        		putValue( HMI_CLkS_Ext_Rq,  1);// set CLkS_Ext_Rq=LK
  //  			settimer( t_ForceDisplayOffTimer, 500 ); signal automatically switches off after 200msec
        		write( "KeyRecorder-> automatically ForceDisplMode is active set CLkS_Ext_Rq=LK");
            }
        }
    }
}

Time_GetPC_Time()
{
    int i;
    char temp[64];
    byte bLength;
    byte bResult;
    byte acLineData[40];

    long tm[9];
    getLocalTime(tm);
// now tm contains the following entries:
// tm[0] = 3; (seconds)
// tm[1] = 51; (minutes)
// tm[2] = 16; (hours)
// tm[3] = 21; (day of month)
// tm[4] = 7; (month stating with 0)
// tm[5] = 98; (year)
// tm[6] = 5; (weekday)
// tm[7] = 232;(day of year)
// tm[8] = 1; (Summer time)
    putValue( Env_PC_Time_Second, tm[0] );
    putValue( Env_PC_Time_Minute, tm[1] );
    putValue( Env_PC_Time_Hour,   tm[2] );
    putValue( Env_PC_Time_Day,    tm[3] );
    putValue( Env_PC_Time_Month,  tm[4] + 1 );
    putValue( Env_PC_Time_Year,   tm[5] + 1900 );
//    putValue( Env_PC_Time_Update_IPC, 1 );
    //putValue( Env_PC_Time_Update_IPC, 0 );
}

on timer tPC_Time_read
{
    Time_GetPC_Time();
    setTimer( tPC_Time_read, 100 );
}

on envVar Env_PC_Time_Update_IPC
{
    if( getValue( this ) )
    {
        putvalue( HMI_DateTmSecond_Rq, getValue( Env_PC_Time_Second ));
        putvalue( HMI_DateTmMinute_Rq, getValue( Env_PC_Time_Minute ));
        putvalue( HMI_DateTmHour_Rq, getValue( Env_PC_Time_Hour ));
        putvalue( HMI_DateTmDay_Rq, getValue( Env_PC_Time_Day ));
        putvalue( HMI_DateTmMonth_Rq, getValue( Env_PC_Time_Month ));
        putvalue( HMI_DateTmYear_Rq, getValue( Env_PC_Time_Year ) );
        putValue( HMI_DateTmStat_Rq, 3 );
    }
    else
        putValue( HMI_DateTmStat_Rq, 2 );
}

on timer _tWemStatusRead_Trigger
{
    putValue( DIAG_WEM_ReadStatus_Trigger, 1 );
}

on envVar Env_Stress__SaveParameters
// **************************************************************************************************
// ******************************************************* Stresstest *******************************
// **************************************************************************************************

{
    if( getvalue(this))
    {
        Stress__iniWriteAll("ini_data\\Stresstest.ini");
    }    
}

on envVar Env_Stress__StresstestMainActiv
{
    if( getvalue(this))
    {
//        writeLineEx(dwWriteSinkSimu, dwWriteSeveritySuccess, "\n        started\n");
        putvalue(Env_Modus_Manuell, 0 ); // Data automatically sended
    }
    else
    {
//        writeLineEx(dwWriteSinkSimu, dwWriteSeveritySuccess, "\n        stopped\n");
    }

    Stress__CheckAll();
    Stress__WriteSinkAll();
}

on envVar Env_Stress__StresstestMainActiv_EMC
{
    if( getvalue(this))
    {
      putValue(Env_Stress__StresstestMainActiv, 1);  
      putValue(Env_EMC, 1);
      putValue(Env_Stress_GearBoxSweepActiv, 0);
    }
    else
    {
      putValue(Env_Stress__StresstestMainActiv, 0);  
      putValue(Env_EMC, 0);
    }
}

int Stress__CalcNext_Index(int iDirection, int iIndexMax)
{
    
    if( ((lCurrentVal >= iIndexMax) && (iDirection == 1)) || ((lCurrentVal <= 0) && (iDirection == -1)))
    {
        iDirection *= -1;
    }
    
    lCurrentVal += iDirection;

    return (iDirection);
}

int Stress__CalcNext_PointerVal (long lStepWidth,    int iDirection,    long lMinVal,    long lMaxVal)
{
    // additional (global) function changeable parameter is: lCurrentVal
    // returning new direction

    if( ((lCurrentVal >= lMaxVal) && (iDirection == 1)) || ((lCurrentVal <= lMinVal) && (iDirection == -1)))
    {
        iDirection *= -1;
    }

    lCurrentVal += (iDirection * lStepWidth);

    if( lCurrentVal >= lMaxVal)
    {
        lCurrentVal = lMaxVal;
    }

    if( lCurrentVal <= lMinVal)
    {
        lCurrentVal = lMinVal;
    }

    return(iDirection);
}

Stress__CheckAll()
{
    if( Stress_CoolantTemp_CheckActiv())    putvalue(Env_EngCoolTemp_Disp_Rq_Fehler, 0 ); // always take stresstest cooling temp values
    Stress_DisCar_CheckActiv();
    Stress_GearBox_CheckActiv();
    Stress_OutsideAirtemp_CheckActiv();
    Stress_Parking_CheckActiv();
    if( Stress_Revolution_CheckActiv())    putvalue(Env_EngRPM_Fehler, 0 ); // always take stresstest revolution values
	if( Stress_Pnhv_CheckActiv())    putvalue(Env_PnhvRPM_Fehler, 0 ); // always take stresstest revolution values
    Stress_SegBegin_CheckActiv();
    Stress_SegEnd_CheckActiv();
    Stress_DayNight_CheckActiv();
    if( Stress_Speed_CheckActiv())
    {
        putvalue(Env_WhlRPM_FL_Fehler, 0 );
        putvalue(Env_WhlRPM_FR_Fehler, 0 );
        putvalue(Env_WhlRPM_RL_Fehler, 0 );
        putvalue(Env_WhlRPM_RR_Fehler, 0 );
    }
    Stress_Tank_CheckActiv();
    Stress_ECO_Score_Total_CheckActiv();
    Stress_ECO_Score_Accel_CheckActiv();
    Stress_ECO_Score_Const_CheckActiv();
    Stress_ECO_Score_FreeWhl_CheckActiv();
    Stress_ECO_Trend_CheckActiv();
    Stress_Style_CheckActiv();
}

//on envVar Env_Type_Select
//{
//    if(getValue(this))
//    {
//        putValue(HMI_LDC_SPEEDO_SegRing_Disp_Rq, 1);                /*Segment ring ON*/
//        putValue(HMI_LDC_Master, 0);                                /*Set LDC master to ESP*/
//        putValue(HMI_LDC_SpdUnit_Rs, getValue(HMI_IC_DistUnit_Rq)); /*Sync speed unit in LDC_Disp_Rq_ESP_AR with Config_HU3_AR*/
//    }
//    else
//    {
//        putValue(HMI_LDC_SPEEDO_SegRing_Disp_Rq, 3);                /*Segment ring SNA*/
//        putValue(HMI_LDC_Master, 7);                                /*Set LDC master to SNA*/
//        putValue(HMI_LDC_SpdUnit_Rs, getValue(HMI_IC_DistUnit_Rq)); /*Sync speed unit in LDC_Disp_Rq_ESP_AR with Config_HU3_AR*/      
//    }
//}


on envVar Env_Cruise_Control
{
  
      putValue(HMI_LDC_IconDisp_Rq_ESP, 2); /*CC_ON*/
      putValue(HMI_LDC_SPEEDO_SegRing_Disp_Rq, 1); /*Segment ring ON*/
      putValue(Env_Type_Select, 1);
      putValue(Env_Speed_Low, 0);
      putValue(Env_Speed_High, getValue(Env_VehSpd_X));
      putValue(HMI_LDC_Spd_Dsr, getValue(Env_VehSpd_X)); /*get current speed*/
      putValue(HMI_LDC_Master, 0);/*ESP*/
      
}

on envVar Env_Limiter
{  
  putValue(HMI_LDC_IconDisp_Rq_ESP, 4); /*VSL_ON*/
  putValue(HMI_LDC_SPEEDO_SegRing_Disp_Rq, 1); /*Segment ring ON*/
  putValue(Env_Type_Select, 2);
  putValue(Env_Speed_Low, 0);
  putValue(Env_Speed_High, getValue(Env_VehSpd_X)); /*get current speed*/
  putValue(HMI_LDC_Master, 0);/*ESP*/
}

on EnvVar Env_Cancel
{
  if(getValue(this))
  {
    if(getValue(Env_Type_Select) == 0)
    {
      putValue(Env_Speed_Low, 0);
      putValue(Env_Speed_High, 0);
      putValue(Env_Type_Select, 0);
      
      putValue(HMI_LDC_SPEEDO_SegRing_Disp_Rq, 0);
      putValue(HMI_LDC_IconDisp_Rq_ESP, 0);
    }
    else
    {
      Remember_Speed_Low    = getValue(Env_Speed_Low);
      Remember_Speed_High   = getValue(Env_Speed_High);
      Remember_Type_select  = getValue(Env_Type_Select);
      Remember_Now_active   = getValue(HMI_LDC_IconDisp_Rq_ESP);
    
      putValue(Env_Speed_Low, 0);
      putValue(Env_Speed_High, 0);
      putValue(Env_Type_Select, 0);
      
      putValue(HMI_LDC_SPEEDO_SegRing_Disp_Rq, 0);
      putValue(HMI_LDC_IconDisp_Rq_ESP, 0);
    }
  }
}

on EnvVar Env_Resume
{
  if(getValue(this))
  {
      putValue(Env_Speed_Low, Remember_Speed_Low);
      putValue(Env_Speed_High, Remember_Speed_High);
      putValue(Env_Type_Select, Remember_Type_select);
    
      putValue(HMI_LDC_SPEEDO_SegRing_Disp_Rq, 1);
      putValue(HMI_LDC_IconDisp_Rq_ESP, Remember_Now_active);
  }
}

on EnvVar Env_Speed_Low
{
  putValue(HMI_LDC_Spd_Add, getValue(this));
}
  
on EnvVar Env_Speed_High
{
  putValue(HMI_LDC_Spd_Dsr, getValue(this));
}  

on envVar Env_Set_5_plus
{
  if(getValue(this))
  {
    switch(getValue(Env_Speed_Selector))
    {
      case 0: /*set the Low limit*/
      {
        putValue(Env_Speed_Low, getValue(Env_Speed_Low)+5);
      }
      break;
      case 1: /*set the High limit*/
      {
        putValue(Env_Speed_High, getValue(Env_Speed_High)+5);
      }
      break;    
      default: break;    
    }
  }
}

on envVar Env_Set_1_plus
{
  if(getValue(this))
  {
    switch(getValue(Env_Speed_Selector))
    {
      case 0: /*set the Low limit*/
      {
        putValue(Env_Speed_Low, getValue(Env_Speed_Low)+1);
      }
      break;
      case 1: /*set the High limit*/
      {
        putValue(Env_Speed_High, getValue(Env_Speed_High)+1);
      }
      break;    
      default: break;    
    }
  }
}

on envVar Env_Set_5_minus
{
  if(getValue(this))
  {  
    switch(getValue(Env_Speed_Selector))
    {
      case 0: /*set the Low limit*/
      {
        if ((getValue(Env_Speed_Low)-5) <= 0)
        {
          putValue(Env_Speed_Low, 0);
        }
        else
        {
          putValue(Env_Speed_Low, getValue(Env_Speed_Low)-5);
        }
      }
      break;
      case 1: /*set the High limit*/
      {
        if ((getValue(Env_Speed_High)-5) <= 0)
        {
          putValue(Env_Speed_High, 0);
        }
        else
        {
          putValue(Env_Speed_High, getValue(Env_Speed_High)-5);
        }
      }
      break;    
      default: break;    
    }
  }
}

on envVar Env_Set_1_minus
{
  if(getValue(this))
  {  
    switch(getValue(Env_Speed_Selector))
    {
      case 0: /*set the Low limit*/
      {
        if ((getValue(Env_Speed_Low)-1) <= 0)
        {
          putValue(Env_Speed_Low, 0);
        }
        else
        {
          putValue(Env_Speed_Low, getValue(Env_Speed_Low)-1);
        }
      }
      break;
      case 1: /*set the High limit*/
      {
        if ((getValue(Env_Speed_High)-5) <= 0)
        {
          putValue(Env_Speed_High, 0);
        }
        else
        {
          putValue(Env_Speed_High, getValue(Env_Speed_High)-1);
        }
      }
      break;    
      default: break;    
    }
  }
}

Stress__WriteSinkAll()
{
    Stress_CoolantTemp_WriteSink();
    Stress_DisCar_WriteSink();
    Stress_GearBox_WriteSink();
    Stress_OutsideAirtemp_WriteSink();
    Stress_Parking_WriteSink();
    Stress_Revolution_WriteSink();
    Stress_Pnhv_WriteSink();
    Stress_SegBegin_WriteSink();
    Stress_SegEnd_WriteSink();
    Stress_DayNight_WriteSink();
    Stress_Speed_WriteSink();
    Stress_Tank_WriteSink();
    Stress_ECO_Score_Total_WriteSink();
    Stress_ECO_Score_Accel_WriteSink();
    Stress_ECO_Score_Const_WriteSink();
    Stress_ECO_Score_FreeWhl_WriteSink();
    Stress_ECO_Trend_WriteSink();
    Stress_Style_WriteSink();
}

Stress__iniReadAll (char iniFilename[])
{
      // Lese zwei INT-Parameter aus der INI Datei "Test.Ini" :
      //  "ReadPara1",
      //  "ReadPara2".     (Sektion "Input")
      // 
      readPara1 = getProfileInt("Input","ReadPara1",defVal,iniFilename );
      readPara2 = getProfileInt("Input","ReadPara2",defVal,iniFilename );
      //
      // Wird der Pfad fuer die Schreiboperation nicht explizit 
      // gesetzt, so wird der Pfad der Konfigurationsdatei heran-
      // gezogen.
      // 

    Stress_CoolantTemp_IniRead( iniFilename );
    Stress_DisCar_IniRead( iniFilename );
    Stress_GearBox_IniRead( iniFilename );
    Stress_NightView_IniRead( iniFilename );
    Stress_DayNight_IniRead( iniFilename );
    Stress_OutsideAirtemp_IniRead( iniFilename );
    Stress_Parking_IniRead( iniFilename );
    Stress_Revolution_IniRead( iniFilename );
    Stress_Pnhv_IniRead( iniFilename );
    Stress_SegBegin_IniRead( iniFilename );
    Stress_SegEnd_IniRead( iniFilename );
    Stress_Speed_IniRead( iniFilename );
    Stress_Tank_IniRead( iniFilename );
    Stress_ECO_Score_Total_IniRead( iniFilename );
    Stress_ECO_Score_Accel_IniRead( iniFilename );
    Stress_ECO_Score_Const_IniRead( iniFilename );
    Stress_ECO_Score_FreeWhl_IniRead( iniFilename );
    Stress_ECO_Trend_IniRead( iniFilename );

}

Stress__iniWriteAll (char iniFilename[])
{
      char buffer [256];
   
      // Schreibe zwei INT-Paramter und einen String in die 
      // INI-Datei "Test.Ini".
      //  "WritePara1",
      //  "WritePara2", 
      //  "WriteMessage"   (Sektion "Output") 

      //
      // Wird der Pfad fuer die Schreiboperation nicht explizit 
      // gesetzt, so wird der Pfad der Konfigurationsdatei heran-
      // gezogen.
      // 
      snprintf (buffer,elcount(buffer),"%d",readPara1);
      writeProfileString ("Output","WritePara1",buffer,iniFilename );

      snprintf (buffer,elcount(buffer),"%d",readPara2);
      writeProfileString ("Output","WritePara2",buffer,iniFilename );

      writeProfileInt    ("Output","WriteInt1",readPara1,iniFilename );
      writeProfileInt    ("Output","WriteInt2",readPara2,iniFilename );
      writeProfileString ("Output","WriteMessage","TestString",iniFilename );

    lWriteError = 1; // 0 = Error while writing ini-file

    if( lWriteError != 0)    Stress_CoolantTemp_IniWrite( iniFilename );
    if( lWriteError != 0)    Stress_DisCar_IniWrite( iniFilename );
    if( lWriteError != 0)    Stress_GearBox_IniWrite( iniFilename );
    if( lWriteError != 0)    Stress_NightView_IniWrite( iniFilename );
    if( lWriteError != 0)    Stress_DayNight_IniWrite( iniFilename );
    if( lWriteError != 0)    Stress_OutsideAirtemp_IniWrite( iniFilename );
    if( lWriteError != 0)    Stress_Parking_IniWrite( iniFilename );
    if( lWriteError != 0)    Stress_Revolution_IniWrite( iniFilename );
    if( lWriteError != 0)    Stress_Pnhv_IniWrite( iniFilename );
    if( lWriteError != 0)    Stress_SegBegin_IniWrite( iniFilename );
    if( lWriteError != 0)    Stress_SegEnd_IniWrite( iniFilename );
    if( lWriteError != 0)    Stress_Speed_IniWrite( iniFilename );
    if( lWriteError != 0)    Stress_Tank_IniWrite( iniFilename );
    if( lWriteError != 0)    Stress_ECO_Score_Total_IniWrite( iniFilename );
    if( lWriteError != 0)    Stress_ECO_Score_Accel_IniWrite( iniFilename );
    if( lWriteError != 0)    Stress_ECO_Score_Const_IniWrite( iniFilename );
    if( lWriteError != 0)    Stress_ECO_Score_FreeWhl_IniWrite( iniFilename );
    if( lWriteError != 0)    Stress_ECO_Trend_IniWrite( iniFilename );

    if( lWriteError == 0)    write("!! Error while writing INI-file !!");
}

on envVar Env_Stress_CoolantTemp_SweepActiv
{
    Stress_CoolantTemp_WriteSink();
    if( Stress_CoolantTemp_CheckActiv() )    
	{
	putvalue( Env_EngRPM_Fehler, 0 ); // always take stresstest cooling temp values
	putvalue( Env_PnhvRPM_Fehler, 0 ); // always take stresstest cooling temp values
	}
}

on envVar Env_Stress_CoolantTemp_TimeInterval
{
    Stress_CoolantTemp_CheckActiv();
}

on timer _t_Stress_ChangeCoolTemp
{
    if( Stress_CoolantTemp_CheckActiv())
    {
        Stress_CoolantTemp_CalcNext();
    }
}

Stress_CoolantTemp_CalcNext()
{
    lCurrentVal = getvalue( Env_Stress_CoolantTemp_CurrentVal ); // aditional changeable parameter
    iDirectionCoolTemp = Stress__CalcNext_PointerVal(getvalue( Env_Stress_CoolantTemp_StepWidth ), iDirectionCoolTemp, getvalue( Env_Stress_CoolantTemp_Min ), getvalue( Env_Stress_CoolantTemp_Max ));
    putvalue( Env_Stress_CoolantTemp_CurrentVal, lCurrentVal );
    putvalue( Env_EngCoolTemp_Disp_Rq, lCurrentVal );
}

int Stress_CoolantTemp_CheckActiv()
{
    int iTemp;

    canceltimer(_t_Stress_ChangeCoolTemp);
    iTemp = getvalue( Env_Stress_CoolantTemp_SweepActiv ) && getvalue( Env_Stress__StresstestMainActiv);
//    write("CoolTempActiv = %d und _StresstestMainActiv = %d, verUNDed = %d",getvalue( CoolTempSweepActiv), getvalue(_StresstestMainActiv), iTemp);
    if( iTemp)
    {
        settimer(_t_Stress_ChangeCoolTemp, getvalue( Env_Stress_CoolantTemp_TimeInterval ));
    }

    return(iTemp);
}

Stress_CoolantTemp_IniRead (char iniFilename[])
{
    strncpy(func, "CoolantTemp", 20 );    // Name of functionality

    putvalue( Env_Stress_CoolantTemp_SweepActiv,   getProfileInt( func, "CoolTempSweepActiv", defCoolTempSweepActiv, iniFilename));
    putvalue( Env_Stress_CoolantTemp_Min,          getProfileInt( func, "CoolTempMin", defCoolTempMin, iniFilename));
    putvalue( Env_Stress_CoolantTemp_Max,          getProfileInt( func, "CoolTempMax", defCoolTempMax, iniFilename));
    putvalue( Env_Stress_CoolantTemp_StepWidth,    getProfileInt( func, "CoolTempStepWidth", defCoolTempStepWidth, iniFilename));
    putvalue( Env_Stress_CoolantTemp_TimeInterval, getProfileInt( func, "CoolTempTimeInterval", defCoolTempTimeInterval, iniFilename));
}

Stress_CoolantTemp_IniWrite (char iniFilename[])
{
    strncpy(func, "CoolantTemp", 20 );    // Name of functionality

    if( lWriteError != 0)    lWriteError = writeProfileInt( func, "CoolTempSweepActiv",   getValue( Env_Stress_CoolantTemp_SweepActiv ), iniFilename );
    if( lWriteError != 0)    lWriteError = writeProfileInt( func, "CoolTempMin",          getValue( Env_Stress_CoolantTemp_Min), iniFilename );
    if( lWriteError != 0)    lWriteError = writeProfileInt( func, "CoolTempMax",          getValue( Env_Stress_CoolantTemp_Max), iniFilename );
    if( lWriteError != 0)    lWriteError = writeProfileInt( func, "CoolTempStepWidth",    getValue( Env_Stress_CoolantTemp_StepWidth ), iniFilename );
    if( lWriteError != 0)    lWriteError = writeProfileInt( func, "CoolTempTimeInterval", getValue( Env_Stress_CoolantTemp_TimeInterval ), iniFilename );
}

Stress_CoolantTemp_WriteSink()
{
    if( getvalue( Env_Stress_CoolantTemp_SweepActiv ) && getvalue( Env_Stress__StresstestMainActiv ))
    {
        writeLineEx(dwWriteSinkSimu, dwWriteSeverityInfo, "  Activ   Sweep CoolantTemp");
    }
    else
    {
        writeLineEx(dwWriteSinkSimu, dwWriteSeverityInfo, "  Inactiv Sweep CoolantTemp");
    }
}

on envVar Env_Stress_DayNightToggleActiv
{
    if( getValue ( HMI_LgtSens_Night) != 1 ) // if not SLOW_ON
    {
        putValue ( HMI_LgtSens_Night, 0 );   // set SLOW_OFF
    }
    Stress_DayNight_WriteSink();
    Stress_DayNight_CheckActiv();
}

on envVar Env_Stress_DayNightTimeInterval
{
    Stress_DayNight_CheckActiv();
}

on timer _t_Stress_ToggleDayNight
{
    if( Stress_DayNight_CheckActiv())
    {
        Stress_DayNight_CalcNext();
    }
}

Stress_DayNight_CalcNext()
{
    if( getvalue( HMI_LgtSens_Night ) == 1 )
    {
        putvalue( HMI_LgtSens_Night, 0 );
        return;
    }

    if( getvalue( HMI_LgtSens_Night ) == 0 )
    {
        putvalue( HMI_LgtSens_Night, 1 );
    }
}

int Stress_DayNight_CheckActiv()
{
    int iTemp;

    canceltimer(_t_Stress_ToggleDayNight );
    iTemp = getvalue( Env_Stress_DayNightToggleActiv ) && getvalue( Env_Stress__StresstestMainActiv );
//    write("GearBoxActiv = %d und _StresstestMainActiv = %d, verUNDed = %d",getvalue(GearBoxSweepActiv), getvalue(_StresstestMainActiv), iTemp);
    if( iTemp )
    {
        settimer( _t_Stress_ToggleDayNight, getvalue( Env_Stress_DayNightTimeInterval ) );
    }

    return( iTemp );
}

Stress_DayNight_IniRead (char iniFilename[])
{
    strncpy(func, "NightView", 20 );    // Name of functionality

    putvalue( Env_Stress_DayNightToggleActiv, getProfileInt( func, "DayNightToggleActiv", defDayNightToggleActiv, iniFilename));
    putvalue( Env_Stress_DayNightTimeInterval, getProfileInt( func, "DayNightTimeInterval", defDayNightTimeInterval, iniFilename));
}

Stress_DayNight_IniWrite (char iniFilename[])
{
    strncpy(func, "DayNight", 20 );    // Name of functionality

    if( lWriteError != 0)    lWriteError = writeProfileInt( func, "DayNightToggleActiv", getValue( Env_Stress_DayNightToggleActiv ), iniFilename );
    if( lWriteError != 0)    lWriteError = writeProfileInt( func, "DayNightTimeInterval", getValue( Env_Stress_DayNightTimeInterval ), iniFilename );
}

Stress_DayNight_WriteSink()
{
    if( getvalue( Env_Stress_DayNightToggleActiv ) && getvalue( Env_Stress__StresstestMainActiv ))
    {
        writeLineEx( dwWriteSinkSimu, dwWriteSeverityInfo, "  Activ   Toggle DayNight");
    }
    else
    {
        writeLineEx( dwWriteSinkSimu, dwWriteSeverityInfo, "  Inactiv Toggle DayNight");
    }
}

on envVar Env_Stress_DisCarSweepActiv
{
    Stress_DisCar_WriteSink();
    Stress_DisCar_CheckActiv();
}

on envVar Env_Stress_DisCarTimeInterval
{
    Stress_DisCar_CheckActiv();
}

on timer _t_Stress_ChangeDisCar
{
    if( Stress_DisCar_CheckActiv())
    {
        Stress_DisCar_CalcNext();
    }
}

Stress_DisCar_CalcNext()
{
    lCurrentVal = getvalue( Env_Stress_DisCarCurrentVal ); // aditional changeable parameter
    iDirectionDisCar = Stress__CalcNext_PointerVal(getvalue( Env_Stress_DisCarStepWidth ), iDirectionDisCar, getvalue(Env_Stress_DisCarMin ), getvalue(Env_Stress_DisCarMax ));
    putvalue( Env_Stress_DisCarCurrentVal, lCurrentVal );
    putvalue( pDemo_DistronicCar, lCurrentVal );
    putvalue( pDemo_DistronicRadar, lCurrentVal );
}

int Stress_DisCar_CheckActiv()
{
    int iTemp;

    canceltimer(_t_Stress_ChangeDisCar);
    iTemp = getvalue( Env_Stress_DisCarSweepActiv ) && getvalue( Env_Stress__StresstestMainActiv );
    if( iTemp )
    {
        settimer(_t_Stress_ChangeDisCar, getvalue( Env_Stress_DisCarTimeInterval ));
    }

    return(iTemp);
}

Stress_DisCar_IniRead (char iniFilename[])
{
    strncpy(func, "DisCar", 20 );    // Name of functionality

    putvalue( Env_Stress_DisCarSweepActiv, getProfileInt( func, "DisCarSweepActiv", defDisCarSweepActiv, iniFilename));
    putvalue( Env_Stress_DisCarMin, getProfileInt( func, "DisCarMin", defDisCarMin, iniFilename));
    putvalue( Env_Stress_DisCarMax, getProfileInt( func, "DisCarMax", defDisCarMax, iniFilename));
    putvalue( Env_Stress_DisCarStepWidth, getProfileInt( func, "DisCarStepWidth", defDisCarStepWidth, iniFilename));
    putvalue( Env_Stress_DisCarTimeInterval, getProfileInt( func, "DisCarTimeInterval", defDisCarTimeInterval, iniFilename));
}

Stress_DisCar_IniWrite (char iniFilename[])
{
    strncpy(func, "DisCar", 20 );    // Name of functionality

    if( lWriteError != 0)    lWriteError = writeProfileInt( func, "DisCarSweepActiv", getValue( Env_Stress_DisCarSweepActiv), iniFilename );
    if( lWriteError != 0)    lWriteError = writeProfileInt( func, "DisCarMin", getValue( Env_Stress_DisCarMin), iniFilename );
    if( lWriteError != 0)    lWriteError = writeProfileInt( func, "DisCarMax", getValue( Env_Stress_DisCarMax), iniFilename );
    if( lWriteError != 0)    lWriteError = writeProfileInt( func, "DisCarStepWidth", getValue( Env_Stress_DisCarStepWidth), iniFilename );
    if( lWriteError != 0)    lWriteError = writeProfileInt( func, "DisCarTimeInterval", getValue( Env_Stress_DisCarTimeInterval), iniFilename );
}

Stress_DisCar_WriteSink()
{
    if( getvalue( Env_Stress_DisCarSweepActiv ) && getvalue( Env_Stress__StresstestMainActiv ))
    {
        writeLineEx(dwWriteSinkSimu, dwWriteSeverityInfo, "  Activ   Sweep DistronicCar");
    }
    else
    {
        writeLineEx(dwWriteSinkSimu, dwWriteSeverityInfo, "  Inactiv Sweep DistronicCar");
    }
}

on envVar Env_Stress_ECO_Score_Total_SweepActiv
{
    Stress_ECO_Score_Total_WriteSink();
    Stress_ECO_Score_Total_CheckActiv();
}

on envVar Env_Stress_ECO_Score_Total_TimeInterval
{
    Stress_ECO_Score_Total_CheckActiv();
}

on timer _t_Stress_Change_ECO_Score_Total
{
    if( Stress_ECO_Score_Total_CheckActiv())
    {
        Stress_ECO_Score_Total_CalcNext();
    }
}

Stress_ECO_Score_Total_CalcNext()
{
    lCurrentVal = getvalue( Env_Stress_ECO_Score_Total_CurrentVal ); // aditional changeable parameter
    iDirectionECO_Score_Total = Stress__CalcNext_PointerVal(getvalue( Env_Stress_ECO_Score_Total_StepWidth ), iDirectionECO_Score_Total, getvalue( Env_Stress_ECO_Score_Total_Min ), getvalue( Env_Stress_ECO_Score_Total_Max ));
    putvalue( Env_Stress_ECO_Score_Total_CurrentVal, lCurrentVal );
    putValue( HMI_ECO_Score_Total_Disp_Rq, lCurrentVal );
}

int Stress_ECO_Score_Total_CheckActiv()
{
    int iTemp;

    canceltimer( _t_Stress_Change_ECO_Score_Total );
    iTemp = getvalue( Env_Stress_ECO_Score_Total_SweepActiv ) && getvalue( Env_Stress__StresstestMainActiv );
//    write("RevActiv = %d und _StresstestMainActiv = %d, verUNDed = %d",getvalue( ECO_Score_Accel_SweepActiv), getvalue(_StresstestMainActiv), iTemp);
    if( iTemp)
    {
        settimer(_t_Stress_Change_ECO_Score_Total, getvalue(Env_Stress_ECO_Score_Total_TimeInterval ));
    }

    return(iTemp);
}

Stress_ECO_Score_Total_IniRead (char iniFilename[])
{
    strncpy(func, "ECO_Score_Total", 20 );    // Name of functionality

    putvalue( Env_Stress_ECO_Score_Total_SweepActiv,   getProfileInt( func, "ECO_Score_Total_SweepActiv",   defECO_Score_Total_SweepActiv,   iniFilename));
    putvalue( Env_Stress_ECO_Score_Total_Min,          getProfileInt( func, "ECO_Score_Total_Min",          defECO_Score_Total_Min,          iniFilename));
    putvalue( Env_Stress_ECO_Score_Total_Max,          getProfileInt( func, "ECO_Score_Total_Max",          defECO_Score_Total_Max,          iniFilename));
    putvalue( Env_Stress_ECO_Score_Total_StepWidth,    getProfileInt( func, "ECO_Score_Total_StepWidth",    defECO_Score_Total_StepWidth,    iniFilename));
    putvalue( Env_Stress_ECO_Score_Total_TimeInterval, getProfileInt( func, "ECO_Score_Total_TimeInterval", defECO_Score_Total_TimeInterval, iniFilename));
}

Stress_ECO_Score_Total_IniWrite (char iniFilename[])
{
    strncpy(func, "ECO_Score_Total", 20 );    // Name of functionality

    if( lWriteError != 0)    lWriteError = writeProfileInt( func, "ECO_Score_Total_SweepActiv",   getValue( Env_Stress_ECO_Score_Total_SweepActiv),   iniFilename );
    if( lWriteError != 0)    lWriteError = writeProfileInt( func, "ECO_Score_Total_Min",          getValue( Env_Stress_ECO_Score_Total_Min),          iniFilename );
    if( lWriteError != 0)    lWriteError = writeProfileInt( func, "ECO_Score_Total_Max",          getValue( Env_Stress_ECO_Score_Total_Max),          iniFilename );
    if( lWriteError != 0)    lWriteError = writeProfileInt( func, "ECO_Score_Total_StepWidth",    getValue( Env_Stress_ECO_Score_Total_StepWidth),    iniFilename );
    if( lWriteError != 0)    lWriteError = writeProfileInt( func, "ECO_Score_Total_TimeInterval", getValue( Env_Stress_ECO_Score_Total_TimeInterval), iniFilename );
}

Stress_ECO_Score_Total_WriteSink()
{
    if( getvalue( Env_Stress_ECO_Score_Total_SweepActiv ) && getvalue( Env_Stress__StresstestMainActiv ))
    {
        writeLineEx(dwWriteSinkSimu, dwWriteSeverityInfo, "  Activ   Sweep ECO_Score_Total");
    }
    else
    {
        writeLineEx(dwWriteSinkSimu, dwWriteSeverityInfo, "  Inactiv Sweep ECO_Score_Total");
    }
}

on envVar Env_Stress_ECO_Score_Accel_SweepActiv
{
    Stress_ECO_Score_Accel_WriteSink();
    Stress_ECO_Score_Accel_CheckActiv();
}

on envVar Env_Stress_ECO_Score_Accel_TimeInterval
{
    Stress_ECO_Score_Accel_CheckActiv();
}

on timer _t_Stress_Change_ECO_Score_Accel
{
    if( Stress_ECO_Score_Accel_CheckActiv())
    {
        Stress_ECO_Score_Accel_CalcNext();
    }
}

Stress_ECO_Score_Accel_CalcNext()
{
    lCurrentVal = getvalue( Env_Stress_ECO_Score_Accel_CurrentVal ); // aditional changeable parameter
    iDirectionECO_Score_Accel = Stress__CalcNext_PointerVal(getvalue( Env_Stress_ECO_Score_Accel_StepWidth ), iDirectionECO_Score_Accel, getvalue( Env_Stress_ECO_Score_Accel_Min ), getvalue( Env_Stress_ECO_Score_Accel_Max ));
    putvalue( Env_Stress_ECO_Score_Accel_CurrentVal, lCurrentVal );
    putValue( HMI_ECO_Score_Accel_Disp_Rq, lCurrentVal );
}

int Stress_ECO_Score_Accel_CheckActiv()
{
    int iTemp;

    canceltimer( _t_Stress_Change_ECO_Score_Accel );
    iTemp = getvalue( Env_Stress_ECO_Score_Accel_SweepActiv ) && getvalue( Env_Stress__StresstestMainActiv );
//    write("RevActiv = %d und _StresstestMainActiv = %d, verUNDed = %d",getvalue( ECO_Score_Accel_SweepActiv), getvalue(_StresstestMainActiv), iTemp);
    if( iTemp)
    {
        settimer(_t_Stress_Change_ECO_Score_Accel, getvalue(Env_Stress_ECO_Score_Accel_TimeInterval ));
    }

    return(iTemp);
}

Stress_ECO_Score_Accel_IniRead (char iniFilename[])
{
    strncpy(func, "ECO_Score_Accel", 20 );    // Name of functionality

    putvalue( Env_Stress_ECO_Score_Accel_SweepActiv,   getProfileInt( func, "ECO_Score_Accel_SweepActiv",   defECO_Score_Accel_SweepActiv,   iniFilename));
    putvalue( Env_Stress_ECO_Score_Accel_Min,          getProfileInt( func, "ECO_Score_Accel_Min",          defECO_Score_Accel_Min,          iniFilename));
    putvalue( Env_Stress_ECO_Score_Accel_Max,          getProfileInt( func, "ECO_Score_Accel_Max",          defECO_Score_Accel_Max,          iniFilename));
    putvalue( Env_Stress_ECO_Score_Accel_StepWidth,    getProfileInt( func, "ECO_Score_Accel_StepWidth",    defECO_Score_Accel_StepWidth,    iniFilename));
    putvalue( Env_Stress_ECO_Score_Accel_TimeInterval, getProfileInt( func, "ECO_Score_Accel_TimeInterval", defECO_Score_Accel_TimeInterval, iniFilename));
}

Stress_ECO_Score_Accel_IniWrite (char iniFilename[])
{
    strncpy(func, "ECO_Score_Accel", 20 );    // Name of functionality

    if( lWriteError != 0)    lWriteError = writeProfileInt( func, "ECO_Score_Accel_SweepActiv",   getValue( Env_Stress_ECO_Score_Accel_SweepActiv),   iniFilename );
    if( lWriteError != 0)    lWriteError = writeProfileInt( func, "ECO_Score_Accel_Min",          getValue( Env_Stress_ECO_Score_Accel_Min),          iniFilename );
    if( lWriteError != 0)    lWriteError = writeProfileInt( func, "ECO_Score_Accel_Max",          getValue( Env_Stress_ECO_Score_Accel_Max),          iniFilename );
    if( lWriteError != 0)    lWriteError = writeProfileInt( func, "ECO_Score_Accel_StepWidth",    getValue( Env_Stress_ECO_Score_Accel_StepWidth),    iniFilename );
    if( lWriteError != 0)    lWriteError = writeProfileInt( func, "ECO_Score_Accel_TimeInterval", getValue( Env_Stress_ECO_Score_Accel_TimeInterval), iniFilename );
}

Stress_ECO_Score_Accel_WriteSink()
{
    if( getvalue( Env_Stress_ECO_Score_Accel_SweepActiv ) && getvalue( Env_Stress__StresstestMainActiv ))
    {
        writeLineEx(dwWriteSinkSimu, dwWriteSeverityInfo, "  Activ   Sweep Revolution");
    }
    else
    {
        writeLineEx(dwWriteSinkSimu, dwWriteSeverityInfo, "  Inactiv Sweep Revolution");
    }
}

on envVar Env_Stress_ECO_Score_Const_SweepActiv
{
    Stress_ECO_Score_Const_WriteSink();
    Stress_ECO_Score_Const_CheckActiv();
}

on envVar Env_Stress_ECO_Score_Const_TimeInterval
{
    Stress_ECO_Score_Const_CheckActiv();
}

on timer _t_Stress_Change_ECO_Score_Const
{
    if( Stress_ECO_Score_Const_CheckActiv())
    {
        Stress_ECO_Score_Const_CalcNext();
    }
}

Stress_ECO_Score_Const_CalcNext()
{
    lCurrentVal = getvalue( Env_Stress_ECO_Score_Const_CurrentVal ); // aditional changeable parameter
    iDirectionECO_Score_Const = Stress__CalcNext_PointerVal(getvalue( Env_Stress_ECO_Score_Const_StepWidth ), iDirectionECO_Score_Const, getvalue( Env_Stress_ECO_Score_Const_Min ), getvalue( Env_Stress_ECO_Score_Const_Max ));
    putvalue( Env_Stress_ECO_Score_Const_CurrentVal, lCurrentVal );
    putValue( HMI_ECO_Score_Const_Disp_Rq, lCurrentVal );
}

int Stress_ECO_Score_Const_CheckActiv()
{
    int iTemp;

    canceltimer( _t_Stress_Change_ECO_Score_Const );
    iTemp = getvalue( Env_Stress_ECO_Score_Const_SweepActiv ) && getvalue( Env_Stress__StresstestMainActiv );
//    write("RevActiv = %d und _StresstestMainActiv = %d, verUNDed = %d",getvalue( ECO_Score_Const_SweepActiv), getvalue( _StresstestMainActiv), iTemp);
    if( iTemp)
    {
        settimer(_t_Stress_Change_ECO_Score_Const, getvalue(Env_Stress_ECO_Score_Const_TimeInterval ));
    }

    return(iTemp);
}

Stress_ECO_Score_Const_IniRead (char iniFilename[])
{
    strncpy(func, "ECO_Score_Const", 20 );    // Name of functionality

    putvalue( Env_Stress_ECO_Score_Const_SweepActiv,   getProfileInt( func, "ECO_Score_Const_SweepActiv",   defECO_Score_Const_SweepActiv,   iniFilename));
    putvalue( Env_Stress_ECO_Score_Const_Min,          getProfileInt( func, "ECO_Score_Const_Min",          defECO_Score_Const_Min,          iniFilename));
    putvalue( Env_Stress_ECO_Score_Const_Max,          getProfileInt( func, "ECO_Score_Const_Max",          defECO_Score_Const_Max,          iniFilename));
    putvalue( Env_Stress_ECO_Score_Const_StepWidth,    getProfileInt( func, "ECO_Score_Const_StepWidth",    defECO_Score_Const_StepWidth,    iniFilename));
    putvalue( Env_Stress_ECO_Score_Const_TimeInterval, getProfileInt( func, "ECO_Score_Const_TimeInterval", defECO_Score_Const_TimeInterval, iniFilename));
}

Stress_ECO_Score_Const_IniWrite (char iniFilename[])
{
    strncpy(func, "ECO_Score_Const", 20 );    // Name of functionality

    if( lWriteError != 0)    lWriteError = writeProfileInt( func, "ECO_Score_Const_SweepActiv",   getValue( Env_Stress_ECO_Score_Const_SweepActiv),   iniFilename );
    if( lWriteError != 0)    lWriteError = writeProfileInt( func, "ECO_Score_Const_Min",          getValue( Env_Stress_ECO_Score_Const_Min),          iniFilename );
    if( lWriteError != 0)    lWriteError = writeProfileInt( func, "ECO_Score_Const_Max",          getValue( Env_Stress_ECO_Score_Const_Max),          iniFilename );
    if( lWriteError != 0)    lWriteError = writeProfileInt( func, "ECO_Score_Const_StepWidth",    getValue( Env_Stress_ECO_Score_Const_StepWidth),    iniFilename );
    if( lWriteError != 0)    lWriteError = writeProfileInt( func, "ECO_Score_Const_TimeInterval", getValue( Env_Stress_ECO_Score_Const_TimeInterval), iniFilename );
}

Stress_ECO_Score_Const_WriteSink()
{
    if( getvalue( Env_Stress_ECO_Score_Const_SweepActiv ) && getvalue( Env_Stress__StresstestMainActiv ))
    {
        writeLineEx(dwWriteSinkSimu, dwWriteSeverityInfo, "  Activ   Sweep Revolution");
    }
    else
    {
        writeLineEx(dwWriteSinkSimu, dwWriteSeverityInfo, "  Inactiv Sweep Revolution");
    }
}

on envVar Env_Stress_ECO_Score_FreeWhl_SweepActiv
{
    Stress_ECO_Score_FreeWhl_WriteSink();
    Stress_ECO_Score_FreeWhl_CheckActiv();
}

on envVar Env_Stress_ECO_Score_FreeWhl_TimeInterval
{
    Stress_ECO_Score_FreeWhl_CheckActiv();
}

on timer _t_Stress_Change_ECO_Score_FreeWhl
{
    if( Stress_ECO_Score_FreeWhl_CheckActiv())
    {
        Stress_ECO_Score_FreeWhl_CalcNext();
    }
}

Stress_ECO_Score_FreeWhl_CalcNext()
{
    lCurrentVal = getvalue( Env_Stress_ECO_Score_FreeWhl_CurrentVal ); // aditional changeable parameter
    iDirectionECO_Score_FreeWhl = Stress__CalcNext_PointerVal(getvalue( Env_Stress_ECO_Score_FreeWhl_StepWidth ), iDirectionECO_Score_FreeWhl, getvalue( Env_Stress_ECO_Score_FreeWhl_Min ), getvalue( Env_Stress_ECO_Score_FreeWhl_Max ));
    putvalue( Env_Stress_ECO_Score_FreeWhl_CurrentVal, lCurrentVal );
    putValue( HMI_ECO_Score_FreeWhl_Disp_Rq, lCurrentVal );
}

int Stress_ECO_Score_FreeWhl_CheckActiv()
{
    int iTemp;

    canceltimer( _t_Stress_Change_ECO_Score_FreeWhl );
    iTemp = getvalue( Env_Stress_ECO_Score_FreeWhl_SweepActiv ) && getvalue( Env_Stress__StresstestMainActiv );
//    write("RevActiv = %d und _StresstestMainActiv = %d, verUNDed = %d",getvalue( ECO_Score_FreeWhl_SweepActiv), getvalue(_StresstestMainActiv), iTemp);
    if( iTemp)
    {
        settimer(_t_Stress_Change_ECO_Score_FreeWhl, getvalue(Env_Stress_ECO_Score_FreeWhl_TimeInterval ));
    }

    return(iTemp);
}

Stress_ECO_Score_FreeWhl_IniRead (char iniFilename[])
{
    strncpy(func, "ECO_Score_FreeWhl", 20 );    // Name of functionality

    putvalue( Env_Stress_ECO_Score_FreeWhl_SweepActiv,   getProfileInt( func, "ECO_Score_FreeWhl_SweepActiv",   defECO_Score_FreeWhl_SweepActiv,   iniFilename));
    putvalue( Env_Stress_ECO_Score_FreeWhl_Min,          getProfileInt( func, "ECO_Score_FreeWhl_Min",          defECO_Score_FreeWhl_Min,          iniFilename));
    putvalue( Env_Stress_ECO_Score_FreeWhl_Max,          getProfileInt( func, "ECO_Score_FreeWhl_Max",          defECO_Score_FreeWhl_Max,          iniFilename));
    putvalue( Env_Stress_ECO_Score_FreeWhl_StepWidth,    getProfileInt( func, "ECO_Score_FreeWhl_StepWidth",    defECO_Score_FreeWhl_StepWidth,    iniFilename));
    putvalue( Env_Stress_ECO_Score_FreeWhl_TimeInterval, getProfileInt( func, "ECO_Score_FreeWhl_TimeInterval", defECO_Score_FreeWhl_TimeInterval, iniFilename));
}

Stress_ECO_Score_FreeWhl_IniWrite (char iniFilename[])
{
    strncpy(func, "ECO_Score_FreeWhl", 20 );    // Name of functionality

    if( lWriteError != 0)    lWriteError = writeProfileInt( func, "ECO_Score_FreeWhl_SweepActiv",   getValue( Env_Stress_ECO_Score_FreeWhl_SweepActiv),   iniFilename );
    if( lWriteError != 0)    lWriteError = writeProfileInt( func, "ECO_Score_FreeWhl_Min",          getValue( Env_Stress_ECO_Score_FreeWhl_Min),          iniFilename );
    if( lWriteError != 0)    lWriteError = writeProfileInt( func, "ECO_Score_FreeWhl_Max",          getValue( Env_Stress_ECO_Score_FreeWhl_Max),          iniFilename );
    if( lWriteError != 0)    lWriteError = writeProfileInt( func, "ECO_Score_FreeWhl_StepWidth",    getValue( Env_Stress_ECO_Score_FreeWhl_StepWidth),    iniFilename );
    if( lWriteError != 0)    lWriteError = writeProfileInt( func, "ECO_Score_FreeWhl_TimeInterval", getValue( Env_Stress_ECO_Score_FreeWhl_TimeInterval), iniFilename );
}

Stress_ECO_Score_FreeWhl_WriteSink()
{
    if( getvalue( Env_Stress_ECO_Score_FreeWhl_SweepActiv ) && getvalue( Env_Stress__StresstestMainActiv ))
    {
        writeLineEx(dwWriteSinkSimu, dwWriteSeverityInfo, "  Activ   Sweep ECO_Score_FreeWhl");
    }
    else
    {
        writeLineEx(dwWriteSinkSimu, dwWriteSeverityInfo, "  Inactiv Sweep ECO_Score_FreeWhl");
    }
}

on envVar Env_Stress_ECO_Trend_SweepActiv
{
    Stress_ECO_Trend_WriteSink();
    Stress_ECO_Trend_CheckActiv();
}

on envVar Env_Stress_ECO_Trend_TimeInterval
{
    Stress_ECO_Trend_CheckActiv();
}

on timer _t_Stress_Change_ECO_Trend
{
    if( Stress_ECO_Trend_CheckActiv())
    {
        Stress_ECO_Trend_CalcNext();
    }
}

Stress_ECO_Trend_CalcNext()
{
    if( getvalue( Env_Stress_ECO_Trend_Random ))
    {
        iTrendArray_index  = random(iTrendArray_indexMax);
    }
    else
    {
        lCurrentVal = iTrendArray_index; // aditional changeable parameter
        iDirectionECO_Trend = Stress__CalcNext_Index( iDirectionECO_Trend, iTrendArray_indexMax );
        iTrendArray_index = lCurrentVal;
    }

    putvalue( Env_Stress_ECO_Trend_CurrentVal,     abAccelTrendArray[ iTrendArray_index ] );
    putvalue( HMI_ECO_Score_Accel_Trnd_Disp_Rq,    abAccelTrendArray[ iTrendArray_index ] );
    putvalue( HMI_ECO_Score_Const_Trnd_Disp_Rq,    abConstTrendArray[ iTrendArray_index ] );
    putvalue( HMI_ECO_Score_FreeWhl_Trnd_Disp_Rq,  abFrWhlTrendArray[ iTrendArray_index ] );
}

int Stress_ECO_Trend_CheckActiv()
{
    int iTemp;

    canceltimer(_t_Stress_Change_ECO_Trend);
    iTemp = getvalue( Env_Stress_ECO_Trend_SweepActiv ) && getvalue( Env_Stress__StresstestMainActiv );
//    write("GearBoxActiv = %d und _StresstestMainActiv = %d, verUNDed = %d",getvalue( ECO_Trend_SweepActiv), getvalue(_StresstestMainActiv), iTemp);
    if( iTemp)
    {
        settimer(_t_Stress_Change_ECO_Trend, getvalue( Env_Stress_ECO_Trend_TimeInterval ));
    }

    return( iTemp );
}

Stress_ECO_Trend_IniRead (char iniFilename[])
{
    strncpy(func, "ECO_Trend", 20 );    // Name of functionality

    putvalue( Env_Stress_ECO_Trend_SweepActiv,   getProfileInt( func,  "ECO_Trend_SweepActiv",    defECO_Trend_SweepActiv,    iniFilename) );
    putvalue( Env_Stress_ECO_Trend_Random,       getProfileInt( func,  "ECO_Trend_Random",        defECO_Trend_Random,        iniFilename) );
    putvalue( Env_Stress_ECO_Trend_TimeInterval, getProfileInt( func,  "ECO_Trend_TimeInterval",  defECO_Trend_TimeInterval,  iniFilename) );
}

Stress_ECO_Trend_IniWrite (char iniFilename[])
{
    strncpy(func, "ECO_Trend", 20 );    // Name of functionality

    if( lWriteError != 0 )    lWriteError = writeProfileInt( func, "ECO_Trend_SweepActiv",   getValue( Env_Stress_ECO_Trend_SweepActiv ),   iniFilename );
    if( lWriteError != 0 )    lWriteError = writeProfileInt( func, "ECO_Trend_Random",       getValue( Env_Stress_ECO_Trend_Random ),       iniFilename );
    if( lWriteError != 0 )    lWriteError = writeProfileInt( func, "ECO_Trend_TimeInterval", getValue( Env_Stress_ECO_Trend_TimeInterval ), iniFilename );
}

Stress_ECO_Trend_WriteSink()
{
    if( getvalue( Env_Stress_ECO_Trend_SweepActiv ) && getvalue( Env_Stress__StresstestMainActiv ))
    {
        writeLineEx(dwWriteSinkSimu, dwWriteSeverityInfo, "  Activ   Sweep ECO_Trend");
    }
    else
    {
        writeLineEx(dwWriteSinkSimu, dwWriteSeverityInfo, "  Inactiv Sweep ECO_Trend");
    }
}

on envVar Env_Stress_GearBoxSweepActiv
{
    Stress_GearBox_WriteSink();
    Stress_GearBox_CheckActiv();
}

on envVar Env_Stress_GearBoxTimeInterval
{
    Stress_GearBox_CheckActiv();
}

on timer _t_Stress_ChangeGearBox
{
    if( Stress_GearBox_CheckActiv())
    {
        Stress_GearBox_CalcNext();
    }
}

Stress_GearBox_CalcNext()
{
    if( getvalue( Env_Stress_GearBoxRandom ))
    {
        iPosArray_index  = random(iPosArray_indexMax);
        iProgArray_index = random(iProgArray_indexMax);
    }
    else
    {
        lCurrentVal = iPosArray_index; // aditional changeable parameter
        iDirectionGearBoxPos = Stress__CalcNext_Index(iDirectionGearBoxPos, iPosArray_indexMax);
        iPosArray_index = lCurrentVal;

        lCurrentVal = iProgArray_index; // aditional changeable parameter
        iDirectionGearBoxProg = Stress__CalcNext_Index(iDirectionGearBoxProg, iProgArray_indexMax);
        iProgArray_index = lCurrentVal;
    }

    putvalue( Env_Stress_GearBoxPosCurrentVal,  abPosArray[iPosArray_index] );
    putvalue( Env_Stress_GearBoxProgCurrentVal, abProgArray[iProgArray_index] );
    putvalue( HMI_TxDrvPosn_Disp_Rq_TCM,  abPosArray[iPosArray_index] );
    putvalue( HMI_TxDrvProg_Disp_Rq_TCM, abProgArray[iProgArray_index] );
}

int Stress_GearBox_CheckActiv()
{
    int iTemp;

    canceltimer(_t_Stress_ChangeGearBox);
    iTemp = getvalue( Env_Stress_GearBoxSweepActiv ) && getvalue( Env_Stress__StresstestMainActiv );
//    write("GearBoxActiv = %d und _StresstestMainActiv = %d, verUNDed = %d",getvalue(GearBoxSweepActiv), getvalue(_StresstestMainActiv), iTemp);
    if( iTemp)
    {
        settimer(_t_Stress_ChangeGearBox, getvalue( Env_Stress_GearBoxTimeInterval ));
    }
    return(iTemp);
}

Stress_GearBox_IniRead (char iniFilename[])
{
    strncpy(func, "GearBox", 20 );    // Name of functionality

    putvalue( Env_Stress_GearBoxSweepActiv,   getProfileInt( func, "GearBoxSweepActiv",   defGearBoxSweepActiv,   iniFilename ) );
    putvalue( Env_Stress_GearBoxRandom,       getProfileInt( func, "GearBoxRandom",       defGearBoxRandom,       iniFilename ) );
    putvalue( Env_Stress_GearBoxTimeInterval, getProfileInt( func, "GearBoxTimeInterval", defGearBoxTimeInterval, iniFilename ) );
}

Stress_GearBox_IniWrite (char iniFilename[])
{
    strncpy(func, "GearBox", 20 );    // Name of functionality

    if( lWriteError != 0)    lWriteError = writeProfileInt( func, "GearBoxSweepActiv",   getValue( Env_Stress_GearBoxSweepActiv ),   iniFilename );
    if( lWriteError != 0)    lWriteError = writeProfileInt( func, "GearBoxRandom",       getValue( Env_Stress_GearBoxRandom ),       iniFilename );
    if( lWriteError != 0)    lWriteError = writeProfileInt( func, "GearBoxTimeInterval", getValue( Env_Stress_GearBoxTimeInterval ), iniFilename );
}

Stress_GearBox_WriteSink()
{
    if( getvalue( Env_Stress_GearBoxSweepActiv ) && getvalue( Env_Stress__StresstestMainActiv ))
    {
        writeLineEx(dwWriteSinkSimu, dwWriteSeverityInfo, "  Activ   Sweep GearBox");
    }
    else
    {
        writeLineEx(dwWriteSinkSimu, dwWriteSeverityInfo, "  Inactiv Sweep GearBox");
    }
}

on envVar Env_Stress_NightViewToggleActiv
{
    if( getValue ( this ))
    {
        putValue(  HMI_EVC_75_NV_Avl, 1 );
    }
    if( getValue (HMI_NVP_Disp_Rq) != 4) // if not SLOW_ON
    {
        putValue (HMI_NVP_Disp_Rq, 3);   // set SLOW_OFF
    }
    Stress_NightView_WriteSink();
    Stress_NightView_CheckActiv();
}

on envVar Env_Stress_NightViewTimeInterval
{
    Stress_NightView_CheckActiv();
}

on timer _t_Stress_ToggleNightView
{
    if( Stress_NightView_CheckActiv())
    {
        Stress_NightView_CalcNext();
    }
}

Stress_NightView_CalcNext()
{
    if( getvalue( HMI_NVP_Disp_Rq ) <= 3 )
    {
        putvalue( HMI_NVP_Disp_Rq, 4 );
        return;
    }

    if( getvalue( HMI_NVP_Disp_Rq ) >= 4 )
    {
        putvalue( HMI_NVP_Disp_Rq, 3 );
    }
}

int Stress_NightView_CheckActiv()
{
    int iTemp;

    canceltimer(_t_Stress_ToggleNightView);
    iTemp = getvalue( Env_Stress_NightViewToggleActiv ) && getvalue( Env_Stress__StresstestMainActiv );
//    write("GearBoxActiv = %d und _StresstestMainActiv = %d, verUNDed = %d",getvalue(GearBoxSweepActiv), getvalue(_StresstestMainActiv), iTemp);
    if( iTemp)
    {
        settimer(_t_Stress_ToggleNightView, getvalue( Env_Stress_NightViewTimeInterval ));
    }

    return(iTemp);
}

Stress_NightView_IniRead (char iniFilename[])
{
    strncpy(func, "NightView", 20 );    // Name of functionality

    putvalue( Env_Stress_NightViewToggleActiv, getProfileInt( func, "NightViewToggleActiv", defNightViewToggleActiv, iniFilename));
    putvalue( Env_Stress_NightViewTimeInterval, getProfileInt( func, "NightViewTimeInterval", defNightViewTimeInterval, iniFilename));
}

Stress_NightView_IniWrite (char iniFilename[])
{
    strncpy(func, "NightView", 20 );    // Name of functionality

    if( lWriteError != 0)    lWriteError = writeProfileInt( func, "NightViewToggleActiv", getValue( Env_Stress_NightViewToggleActiv ), iniFilename );
    if( lWriteError != 0)    lWriteError = writeProfileInt( func, "NightViewTimeInterval", getValue( Env_Stress_NightViewTimeInterval ), iniFilename );
}

Stress_NightView_WriteSink()
{
    if( getvalue( Env_Stress_NightViewToggleActiv ) && getvalue( Env_Stress__StresstestMainActiv ))
    {
        writeLineEx(dwWriteSinkSimu, dwWriteSeverityInfo, "  Activ   Toggle NightView");
    }
    else
    {
        writeLineEx(dwWriteSinkSimu, dwWriteSeverityInfo, "  Inactiv Toggle NightView");
    }
}

on envVar Env_Stress_OutsideAirtemp_SweepActiv
{
    Stress_OutsideAirtemp_WriteSink();
    Stress_OutsideAirtemp_CheckActiv();
}

on envVar Env_Stress_OutsideAirtemp_TimeInterval
{
    Stress_OutsideAirtemp_CheckActiv();
}

on timer _t_Stress_ChangeOutTemp
{
    if( Stress_OutsideAirtemp_CheckActiv())
    {
        Stress_OutsideAirtemp_CalcNext();
    }
}

int Stress_OutsideAirtemp_CheckActiv()
{
    int iTemp;

    canceltimer(_t_Stress_ChangeOutTemp);
    iTemp = getvalue( Env_Stress_OutsideAirtemp_SweepActiv ) && getvalue( Env_Stress__StresstestMainActiv );
//    write("OutTempActiv = %d und _StresstestMainActiv = %d, verUNDed = %d",getvalue(OutTempSweepActiv), getvalue(_StresstestMainActiv), iTemp);
    if( iTemp)
    {
        settimer(_t_Stress_ChangeOutTemp, getvalue( Env_Stress_OutsideAirtemp_TimeInterval ));
    }

    return(iTemp);
}

Stress_OutsideAirtemp_CalcNext()
{
    lCurrentVal = getvalue( Env_Stress_OutsideAirtemp_CurrentVal ); // aditional changeable parameter
    iDirectionOutTemp = Stress__CalcNext_PointerVal( getvalue( Env_Stress_OutsideAirtemp_StepWidth ), iDirectionOutTemp, getvalue( Env_Stress_OutsideAirtemp_Min ), getvalue( Env_Stress_OutsideAirtemp_Max ));
    putvalue( Env_Stress_OutsideAirtemp_CurrentVal, lCurrentVal );
    putvalue( HMI_AirTemp_Outsd, lCurrentVal );
}

Stress_OutsideAirtemp_IniRead (char iniFilename[])
{
    strncpy(func, "OutsideAirtemp", 20 );    // Name of functionality

    putvalue( Env_Stress_OutsideAirtemp_SweepActiv,   getProfileInt( func, "OutTempSweepActiv",   defOutTempSweepActiv,   iniFilename ));
    putvalue( Env_Stress_OutsideAirtemp_Min,          getProfileInt( func, "OutTempMin",          defOutTempMin,          iniFilename ));
    putvalue( Env_Stress_OutsideAirtemp_Max,          getProfileInt( func, "OutTempMax",          defOutTempMax,          iniFilename ));
    putvalue( Env_Stress_OutsideAirtemp_StepWidth,    getProfileInt( func, "OutTempStepWidth",    defOutTempStepWidth,    iniFilename ));
    putvalue( Env_Stress_OutsideAirtemp_TimeInterval, getProfileInt( func, "OutTempTimeInterval", defOutTempTimeInterval, iniFilename ));
}

Stress_OutsideAirtemp_IniWrite (char iniFilename[])
{
    strncpy(func, "OutsideAirtemp", 20 );    // Name of functionality

    if( lWriteError != 0)    lWriteError = writeProfileInt( func, "OutTempSweepActiv",   getValue( Env_Stress_OutsideAirtemp_SweepActiv ),   iniFilename );
    if( lWriteError != 0)    lWriteError = writeProfileInt( func, "OutTempMin",          getValue( Env_Stress_OutsideAirtemp_Min ),          iniFilename );
    if( lWriteError != 0)    lWriteError = writeProfileInt( func, "OutTempMax",          getValue( Env_Stress_OutsideAirtemp_Max ),          iniFilename );
    if( lWriteError != 0)    lWriteError = writeProfileInt( func, "OutTempStepWidth",    getValue( Env_Stress_OutsideAirtemp_StepWidth ),    iniFilename );
    if( lWriteError != 0)    lWriteError = writeProfileInt( func, "OutTempTimeInterval", getValue( Env_Stress_OutsideAirtemp_TimeInterval ), iniFilename );
}

Stress_OutsideAirtemp_WriteSink()
{
    if( getvalue( Env_Stress_OutsideAirtemp_SweepActiv ) && getvalue( Env_Stress__StresstestMainActiv ))
    {
        writeLineEx(dwWriteSinkSimu, dwWriteSeverityInfo, "  Activ   Sweep OutsideAirtemp");
    }
    else
    {
        writeLineEx(dwWriteSinkSimu, dwWriteSeverityInfo, "  Inactiv Sweep OutsideAirtemp");
    }
}

on envVar Env_Stress_ParkingSweepActiv
{
    Stress_Parking_WriteSink();
    Stress_Parking_CheckActiv();
}

on envVar Env_Stress_ParkingTimeInterval
{
    Stress_Parking_CheckActiv();
}

on timer _t_Stress_ChangeParking
{
    if( Stress_Parking_CheckActiv())
    {
        Stress_Parking_CalcNext();
    }
}

int Stress_Parking_CheckActiv()
{
    int iTemp;

    canceltimer(_t_Stress_ChangeParking);
    iTemp = getvalue( Env_Stress_ParkingSweepActiv ) && getvalue( Env_Stress__StresstestMainActiv );
    if( iTemp)
    {
        settimer(_t_Stress_ChangeParking, getvalue( Env_Stress_ParkingTimeInterval ));
    }

    return(iTemp);
}

Stress_Parking_CalcNext()
{
    lCurrentVal = getvalue( Env_Stress_ParkingCurrentVal ); // aditional changeable parameter
    iDirectionParking = Stress__CalcNext_PointerVal(getvalue( Env_Stress_ParkingStepWidth ), iDirectionParking, getvalue(Env_Stress_ParkingMin ), getvalue(Env_Stress_ParkingMax ));
    putvalue( Env_Stress_ParkingCurrentVal, lCurrentVal );
    putvalue( pDemo_ParkLeft, lCurrentVal );

    // inverted behaviour of ParkLeft and ParkRight 
    lTemp = getvalue(Env_Stress_ParkingMax ) - lCurrentVal;
    putvalue( pDemo_ParkRight, lTemp );
}

Stress_Parking_IniRead (char iniFilename[])
{
    strncpy(func, "Parking", 20 );    // Name of functionality

    putvalue( Env_Stress_ParkingSweepActiv,   getProfileInt( func, "ParkingSweepActiv",   defParkingSweepActiv,   iniFilename));
    putvalue( Env_Stress_ParkingMin,          getProfileInt( func, "ParkingMin",          defParkingMin,          iniFilename));
    putvalue( Env_Stress_ParkingMax,          getProfileInt( func, "ParkingMax",          defParkingMax,          iniFilename));
    putvalue( Env_Stress_ParkingStepWidth,    getProfileInt( func, "ParkingStepWidth",    defParkingStepWidth,    iniFilename));
    putvalue( Env_Stress_ParkingTimeInterval, getProfileInt( func, "ParkingTimeInterval", defParkingTimeInterval, iniFilename));
}

Stress_Parking_IniWrite (char iniFilename[])
{
    strncpy(func, "Parking", 20 );    // Name of functionality

    if( lWriteError != 0)    lWriteError = writeProfileInt( func, "ParkingSweepActiv",   getValue( Env_Stress_ParkingSweepActiv),   iniFilename );
    if( lWriteError != 0)    lWriteError = writeProfileInt( func, "ParkingMin",          getValue( Env_Stress_ParkingMin),          iniFilename );
    if( lWriteError != 0)    lWriteError = writeProfileInt( func, "ParkingMax",          getValue( Env_Stress_ParkingMax),          iniFilename );
    if( lWriteError != 0)    lWriteError = writeProfileInt( func, "ParkingStepWidth",    getValue( Env_Stress_ParkingStepWidth),    iniFilename );
    if( lWriteError != 0)    lWriteError = writeProfileInt( func, "ParkingTimeInterval", getValue( Env_Stress_ParkingTimeInterval), iniFilename );
}

Stress_Parking_WriteSink()
{
    if( getvalue( Env_Stress_ParkingSweepActiv ) && getvalue( Env_Stress__StresstestMainActiv ))
    {
        writeLineEx(dwWriteSinkSimu, dwWriteSeverityInfo, "  Activ   Sweep Parking");
    }
    else
    {
        writeLineEx(dwWriteSinkSimu, dwWriteSeverityInfo, "  Inactiv Sweep Parking");
    }
}

on envVar Env_Stress_RevSweepActiv
{
    Stress_Revolution_WriteSink();
    if( Stress_Revolution_CheckActiv() )    putvalue(Env_EngRPM_Fehler, 0 ); // always take stresstest revolution values
}

on envVar Env_Stress_RevTimeInterval
{
    Stress_Revolution_CheckActiv();
}

on timer _t_Stress_ChangeRev
{
    if( Stress_Revolution_CheckActiv())
    {
        Stress_Revolution_CalcNext();
    }
}

Stress_Revolution_CalcNext()
{
    lCurrentVal = getvalue( Env_Stress_RevCurrentVal ); // aditional changeable parameter
    iDirectionRev = Stress__CalcNext_PointerVal(getvalue( Env_Stress_RevStepWidth ), iDirectionRev, getvalue( Env_Stress_RevMin ), getvalue( Env_Stress_RevMax ));
    putvalue( Env_Stress_RevCurrentVal, lCurrentVal );
    putValue( HMI_EngRPM_Dyn_Disp_Rq, lCurrentVal );
}

int Stress_Revolution_CheckActiv()
{
    int iTemp;

    canceltimer(_t_Stress_ChangeRev);
    iTemp = getvalue( Env_Stress_RevSweepActiv ) && getvalue( Env_Stress__StresstestMainActiv );
//    write("RevActiv = %d und _StresstestMainActiv = %d, verUNDed = %d",getvalue(RevSweepActiv), getvalue(_StresstestMainActiv), iTemp);
    if( iTemp)
    {
        settimer(_t_Stress_ChangeRev, getvalue(Env_Stress_RevTimeInterval ));
    }

    return(iTemp);
}

Stress_Revolution_IniRead (char iniFilename[])
{
    strncpy(func, "Revolution", 20 );    // Name of functionality

    putvalue( Env_Stress_RevSweepActiv,   getProfileInt( func, "RevSweepActiv",   defRevSweepActiv,   iniFilename));
    putvalue( Env_Stress_RevMin,          getProfileInt( func, "RevMin",          defRevMin,          iniFilename));
    putvalue( Env_Stress_RevMax,          getProfileInt( func, "RevMax",          defRevMax,          iniFilename));
    putvalue( Env_Stress_RevStepWidth,    getProfileInt( func, "RevStepWidth",    defRevStepWidth,    iniFilename));
    putvalue( Env_Stress_RevTimeInterval, getProfileInt( func, "RevTimeInterval", defRevTimeInterval, iniFilename));
}

Stress_Revolution_IniWrite (char iniFilename[])
{
    strncpy(func, "Revolution", 20 );    // Name of functionality

    if( lWriteError != 0)    lWriteError = writeProfileInt( func, "RevSweepActiv",   getValue( Env_Stress_RevSweepActiv),   iniFilename );
    if( lWriteError != 0)    lWriteError = writeProfileInt( func, "RevMin",          getValue( Env_Stress_RevMin),          iniFilename );
    if( lWriteError != 0)    lWriteError = writeProfileInt( func, "RevMax",          getValue( Env_Stress_RevMax),          iniFilename );
    if( lWriteError != 0)    lWriteError = writeProfileInt( func, "RevStepWidth",    getValue( Env_Stress_RevStepWidth),    iniFilename );
    if( lWriteError != 0)    lWriteError = writeProfileInt( func, "RevTimeInterval", getValue( Env_Stress_RevTimeInterval), iniFilename );
}

Stress_Revolution_WriteSink()
{
    if( getvalue( Env_Stress_RevSweepActiv ) && getvalue( Env_Stress__StresstestMainActiv ))
    {
        writeLineEx(dwWriteSinkSimu, dwWriteSeverityInfo, "  Activ   Sweep Revolution");
    }
    else
    {
        writeLineEx(dwWriteSinkSimu, dwWriteSeverityInfo, "  Inactiv Sweep Revolution");
    }
}

on envVar Env_Stress_SegBeginSweepActiv
{
    Stress_SegBegin_WriteSink();
    Stress_SegBegin_CheckActiv();
}

on envVar Env_Stress_SegBeginTimeInterval
{
    Stress_SegBegin_CheckActiv();
}

on timer _t_Stress_ChangeSegBegin
{
    if( Stress_SegBegin_CheckActiv())
    {
        Stress_SegBegin_CalcNext();
    }
}

Stress_SegBegin_CalcNext()
{
    lCurrentVal = getvalue( Env_Stress_SegBeginCurrentVal ); // aditional changeable parameter
    iDirectionSegBegin = Stress__CalcNext_PointerVal(getvalue( Env_Stress_SegBeginStepWidth ), iDirectionSegBegin, getvalue(Env_Stress_SegBeginMin ), getvalue(Env_Stress_SegBeginMax ));
    putvalue( Env_Stress_SegBeginCurrentVal, lCurrentVal );
    putvalue( pDemo_DistronicBegin, lCurrentVal );
}

int Stress_SegBegin_CheckActiv()
{
    int iTemp;

    canceltimer(_t_Stress_ChangeSegBegin);
    iTemp = getvalue( Env_Stress_SegBeginSweepActiv ) && getvalue( Env_Stress__StresstestMainActiv );
    if( iTemp)
    {
        settimer(_t_Stress_ChangeSegBegin, getvalue( Env_Stress_SegBeginTimeInterval ));
    }

    return(iTemp);
}

Stress_SegBegin_IniRead (char iniFilename[])
{
    strncpy(func, "SegBegin", 20 );    // Name of functionality

    putvalue( Env_Stress_SegBeginSweepActiv,   getProfileInt( func, "SegBeginSweepActiv",   defSegBeginSweepActiv,   iniFilename));
    putvalue( Env_Stress_SegBeginMin,          getProfileInt( func, "SegBeginMin",          defSegBeginMin,          iniFilename));
    putvalue( Env_Stress_SegBeginMax,          getProfileInt( func, "SegBeginMax",          defSegBeginMax,          iniFilename));
    putvalue( Env_Stress_SegBeginStepWidth,    getProfileInt( func, "SegBeginStepWidth",    defSegBeginStepWidth,    iniFilename));
    putvalue( Env_Stress_SegBeginTimeInterval, getProfileInt( func, "SegBeginTimeInterval", defSegBeginTimeInterval, iniFilename));
}

Stress_SegBegin_IniWrite (char iniFilename[])
{
    strncpy(func, "SegBegin", 20 );    // Name of functionality

    if( lWriteError != 0)    lWriteError = writeProfileInt( func, "SegBeginSweepActiv",   getValue( Env_Stress_SegBeginSweepActiv),   iniFilename );
    if( lWriteError != 0)    lWriteError = writeProfileInt( func, "SegBeginMin",          getValue( Env_Stress_SegBeginMin),          iniFilename );
    if( lWriteError != 0)    lWriteError = writeProfileInt( func, "SegBeginMax",          getValue( Env_Stress_SegBeginMax),          iniFilename );
    if( lWriteError != 0)    lWriteError = writeProfileInt( func, "SegBeginStepWidth",    getValue( Env_Stress_SegBeginStepWidth),    iniFilename );
    if( lWriteError != 0)    lWriteError = writeProfileInt( func, "SegBeginTimeInterval", getValue( Env_Stress_SegBeginTimeInterval), iniFilename );
}

Stress_SegBegin_WriteSink()
{
    if( getvalue( Env_Stress_SegBeginSweepActiv ) && getvalue( Env_Stress__StresstestMainActiv ))
    {
        writeLineEx(dwWriteSinkSimu, dwWriteSeverityInfo, "  Activ   Sweep SegmentringBegin");
    }
    else
    {
        writeLineEx(dwWriteSinkSimu, dwWriteSeverityInfo, "  Inactiv Sweep SegmentringBegin");
    }
}

on envVar Env_Stress_SegEndSweepActiv
{
    Stress_SegEnd_WriteSink();
    Stress_SegEnd_CheckActiv();
}

on envVar Env_Stress_SegEndTimeInterval
{
    Stress_SegEnd_CheckActiv();
}

on timer _t_Stress_ChangeSegEnd
{
    if( Stress_SegEnd_CheckActiv())
    {
        Stress_SegEnd_CalcNext();
    }
}

Stress_SegEnd_CalcNext()
{
    lCurrentVal = getvalue( Env_Stress_SegEndCurrentVal ); // aditional changeable parameter
    iDirectionSegEnd = Stress__CalcNext_PointerVal(getvalue( Env_Stress_SegEndStepWidth ), iDirectionSegEnd, getvalue(Env_Stress_SegEndMin ), getvalue(Env_Stress_SegEndMax ));
    putvalue( Env_Stress_SegEndCurrentVal, lCurrentVal );
    putvalue( pDemo_DistronicEnd, lCurrentVal );
}

int Stress_SegEnd_CheckActiv()
{
    int iTemp;

    canceltimer(_t_Stress_ChangeSegEnd);
    iTemp = getvalue( Env_Stress_SegEndSweepActiv ) && getvalue( Env_Stress__StresstestMainActiv );
    if( iTemp)
    {
        settimer(_t_Stress_ChangeSegEnd, getvalue( Env_Stress_SegEndTimeInterval ));
    }

    return(iTemp);
}

Stress_SegEnd_IniRead (char iniFilename[])
{
    strncpy(func, "SegEnd", 20 );    // Name of functionality

    putvalue( Env_Stress_SegEndSweepActiv,   getProfileInt( func, "SegEndSweepActiv",   defSegEndSweepActiv,   iniFilename));
    putvalue( Env_Stress_SegEndMin,          getProfileInt( func, "SegEndMin",          defSegEndMin,          iniFilename));
    putvalue( Env_Stress_SegEndMax,          getProfileInt( func, "SegEndMax",          defSegEndMax,          iniFilename));
    putvalue( Env_Stress_SegEndStepWidth,    getProfileInt( func, "SegEndStepWidth",    defSegEndStepWidth,    iniFilename));
    putvalue( Env_Stress_SegEndTimeInterval, getProfileInt( func, "SegEndTimeInterval", defSegEndTimeInterval, iniFilename));
}

Stress_SegEnd_IniWrite (char iniFilename[])
{
    strncpy(func, "SegEnd", 20 );    // Name of functionality

    if( lWriteError != 0)    lWriteError = writeProfileInt( func, "SegEndSweepActiv",   getValue( Env_Stress_SegEndSweepActiv),   iniFilename );
    if( lWriteError != 0)    lWriteError = writeProfileInt( func, "SegEndMin",          getValue( Env_Stress_SegEndMin),          iniFilename );
    if( lWriteError != 0)    lWriteError = writeProfileInt( func, "SegEndMax",          getValue( Env_Stress_SegEndMax),          iniFilename );
    if( lWriteError != 0)    lWriteError = writeProfileInt( func, "SegEndStepWidth",    getValue( Env_Stress_SegEndStepWidth),    iniFilename );
    if( lWriteError != 0)    lWriteError = writeProfileInt( func, "SegEndTimeInterval", getValue( Env_Stress_SegEndTimeInterval), iniFilename );
}

Stress_SegEnd_WriteSink()
{
    if( getvalue( Env_Stress_SegEndSweepActiv ) && getvalue( Env_Stress__StresstestMainActiv ))
    {
        writeLineEx(dwWriteSinkSimu, dwWriteSeverityInfo, "  Activ   Sweep SegmentringEnd");
    }
    else
    {
        writeLineEx(dwWriteSinkSimu, dwWriteSeverityInfo, "  Inactiv Sweep SegmentringEnd");
    }
}

on envVar Env_Stress_SpeedSweepActiv
{
    Stress_Speed_WriteSink();
    if( Stress_Speed_CheckActiv())
    {
        putvalue(Env_WhlRPM_FL_Fehler, 0 );
        putvalue(Env_WhlRPM_FR_Fehler, 0 );
        putvalue(Env_WhlRPM_RL_Fehler, 0 );
        putvalue(Env_WhlRPM_RR_Fehler, 0 );
    }
}

on envVar Env_Stress_SpeedTimeInterval
{
    Stress_Speed_CheckActiv();
}

on timer _t_Stress_ChangeSpeed
{
    if( Stress_Speed_CheckActiv())
    {
        Stress_Speed_CalcNext();
    }
}

Stress_Speed_CalcNext()
{
    fCurrentValue = getvalue( Env_Stress_SpeedCurrentVal ); // aditional changeable parameter
    iDirectionSpeed = Stress__CalcNext_PointerVal_float(getvalue( Env_Stress_SpeedStepWidth ), iDirectionSpeed, getvalue( Env_Stress_SpeedMin ), getvalue(Env_Stress_SpeedMax ));
    putvalue( Env_Stress_SpeedCurrentVal, fCurrentValue );
//    putValue( Env_BS_Raddrehzahlen, (long)fCurrentValue );
    putValue( Env_VehSpd_X, fCurrentValue );
}

int Stress_Speed_CheckActiv()
{
    int iTemp;

    canceltimer(_t_Stress_ChangeSpeed);
    iTemp = getvalue( Env_Stress_SpeedSweepActiv ) && getvalue( Env_Stress__StresstestMainActiv );
    if( iTemp)
    {
        settimer(_t_Stress_ChangeSpeed, getvalue( Env_Stress_SpeedTimeInterval ));
    }

    return(iTemp);
}

Stress_Speed_IniRead (char iniFilename[])
{
    strncpy(func, "Speedometer", 20 );    // Name of functionality

    putvalue( Env_Stress_SpeedSweepActiv,   getProfileInt(   func, "SpeedSweepActiv",   defSpeedSweepActiv,   iniFilename));
    putvalue( Env_Stress_SpeedMin,          getProfileFloat( func, "SpeedMin",          defSpeedMin,          iniFilename));
    putvalue( Env_Stress_SpeedMax,          getProfileFloat( func, "SpeedMax",          defSpeedMax,          iniFilename));
    putvalue( Env_Stress_SpeedStepWidth,    getProfileFloat( func, "SpeedStepWidth",    defSpeedStepWidth,    iniFilename));
    putvalue( Env_Stress_SpeedTimeInterval, getProfileInt(   func, "SpeedTimeInterval", defSpeedTimeInterval, iniFilename));
}

Stress_Speed_IniWrite (char iniFilename[])
{
    strncpy(func, "Speedometer", 20 );    // Name of functionality

    if( lWriteError != 0)    lWriteError = writeProfileInt(   func, "SpeedSweepActiv",   getValue( Env_Stress_SpeedSweepActiv),   iniFilename );
    if( lWriteError != 0)    lWriteError = writeProfileFloat( func, "SpeedMin",          getValue( Env_Stress_SpeedMin),          iniFilename );
    if( lWriteError != 0)    lWriteError = writeProfileFloat( func, "SpeedMax",          getValue( Env_Stress_SpeedMax),          iniFilename );
    if( lWriteError != 0)    lWriteError = writeProfileFloat( func, "SpeedStepWidth",    getValue( Env_Stress_SpeedStepWidth),    iniFilename );
    if( lWriteError != 0)    lWriteError = writeProfileInt(   func, "SpeedTimeInterval", getValue( Env_Stress_SpeedTimeInterval), iniFilename );
}

Stress_Speed_WriteSink()
{
    if( getvalue( Env_Stress_SpeedSweepActiv ) && getvalue( Env_Stress__StresstestMainActiv ))
    {
        writeLineEx(dwWriteSinkSimu, dwWriteSeverityInfo, "  Activ   Sweep Speed");
    }
    else
    {
        writeLineEx(dwWriteSinkSimu, dwWriteSeverityInfo, "  Inactiv Sweep Speed");
    }
}

on envVar Env_Stress_Tank_SweepActiv
{
    Stress_Tank_WriteSink();
    Stress_Tank_CheckActiv();
}

on envVar Env_Stress_Tank_TimeInterval
{
    Stress_Tank_CheckActiv();
}

on timer _t_Stress_ChangeTank
{
    if( Stress_Tank_CheckActiv())
    {
        Stress_Tank_CalcNext();
    }
}

Stress_Tank_CalcNext()
{
    lCurrentVal = getvalue( Env_Stress_Tank_CurrentVal ); // aditional changeable parameter
    iDirectionTank = Stress__CalcNext_PointerVal(getvalue( Env_Stress_Tank_StepWidth ), iDirectionTank, getvalue(Env_Stress_Tank_Min ), getvalue(Env_Stress_Tank_Max ));
    putvalue( Env_Stress_Tank_CurrentVal, lCurrentVal );
    putvalue( HMI_TankLvl, lCurrentVal );
}

int Stress_Tank_CheckActiv()
{
    int iTemp;

    canceltimer(_t_Stress_ChangeTank);
    iTemp = getvalue( Env_Stress_Tank_SweepActiv ) && getvalue( Env_Stress__StresstestMainActiv );
    if( iTemp)
    {
        settimer(_t_Stress_ChangeTank, getvalue( Env_Stress_Tank_TimeInterval ));
    }

    return(iTemp);
}

Stress_Tank_IniRead (char iniFilename[])
{
    strncpy(func, "Tank", 20 );    // Name of functionality

    putvalue( Env_Stress_Tank_SweepActiv,   getProfileInt( func, "TankSweepActiv",   defTankSweepActiv,   iniFilename));
    putvalue( Env_Stress_Tank_Min,          getProfileInt( func, "TankMin",          defTankMin,          iniFilename));
    putvalue( Env_Stress_Tank_Max,          getProfileInt( func, "TankMax",          defTankMax,          iniFilename));
    putvalue( Env_Stress_Tank_StepWidth,    getProfileInt( func, "TankStepWidth",    defTankStepWidth,    iniFilename));
    putvalue( Env_Stress_Tank_TimeInterval, getProfileInt( func, "TankTimeInterval", defTankTimeInterval, iniFilename));
}

Stress_Tank_IniWrite (char iniFilename[])
{
    strncpy(func, "Tank", 20 );    // Name of functionality

    if( lWriteError != 0)    lWriteError = writeProfileInt( func, "TankSweepActiv",   getValue( Env_Stress_Tank_SweepActiv),   iniFilename );
    if( lWriteError != 0)    lWriteError = writeProfileInt( func, "TankMin",          getValue( Env_Stress_Tank_Min),          iniFilename );
    if( lWriteError != 0)    lWriteError = writeProfileInt( func, "TankMax",          getValue( Env_Stress_Tank_Max),          iniFilename );
    if( lWriteError != 0)    lWriteError = writeProfileInt( func, "TankStepWidth",    getValue( Env_Stress_Tank_StepWidth),    iniFilename );
    if( lWriteError != 0)    lWriteError = writeProfileInt( func, "TankTimeInterval", getValue( Env_Stress_Tank_TimeInterval), iniFilename );
}

Stress_Tank_WriteSink()
{
    if( getvalue( Env_Stress_Tank_SweepActiv ) && getvalue( Env_Stress__StresstestMainActiv ))
    {
        writeLineEx(dwWriteSinkSimu, dwWriteSeverityInfo, "  Activ   Sweep Tank");
    }
    else
    {
        writeLineEx(dwWriteSinkSimu, dwWriteSeverityInfo, "  Inactiv Sweep Tank");
    }
}

on envVar Env_PNHV_ChrgPwr_Disp_Rq
{
    if( getValue(Env_PNHV_ChrgPwr_Disp_Rq_Fehler) )
    {
        putValue( HMI_PNHV_ChrgPwr_Disp_Rq, 63.75 );
    }
    else
    {
        putValue( HMI_PNHV_ChrgPwr_Disp_Rq, getValue(this) );
    }
}

on envVar Env_PNHV_ChrgPwr_Disp_Rq_Fehler
{
    if( getValue(this) )
    {
        putValue( HMI_PNHV_ChrgPwr_Disp_Rq, 63.75 );
    }
    else
    {
        putValue( HMI_PNHV_ChrgPwr_Disp_Rq, getValue( Env_PNHV_ChrgPwr_Disp_Rq ) );
    }
}

int Stress__CalcNext_PointerVal_float (float fStepWidth,    int iDirection,    float fMinVal,    float fMaxVal)
{
    // additional (global) function changeable parameter is: lCurrentVal
    // returning new direction

    if( ((fCurrentValue >= fMaxVal) && (iDirection == 1)) || ((fCurrentValue <= fMinVal) && (iDirection == -1)))
    {
        iDirection *= -1;
    }

    fCurrentValue += (iDirection * fStepWidth);

    if( fCurrentValue >= fMaxVal)
    {
        fCurrentValue = fMaxVal;
    }

    if( fCurrentValue <= fMinVal)
    {
        fCurrentValue = fMinVal;
    }

    return(iDirection);
}

on envVar Env_VehSpd_X
{
   if( getValue(Env_VehSpd_X_Error) )
   {
      putValue( HMI_VehSpd_X, 409.5 );
   }
   else
   {
      putValue( HMI_VehSpd_X, getValue(this) );
   }
   if( getValue( Env_VehSpd_X_Link_to_Raddrehzahl ) )
   {
       putValue( Env_BS_Raddrehzahlen, (long)getValue(this) );
   }
}

on envVar Env_VehSpd_X_Error
{
   if( getValue(this) )
   {
      putValue( HMI_VehSpd_X, 409.5 );
   }
   else
   {
      putValue( HMI_VehSpd_X, getValue( Env_VehSpd_X ) );
   }
}

on timer t_Auto_Project_SelectorTimer
{
    putValue( DIAG_CTRL_IC_Type_Selector, 0x2c ); // VS30
}

OFN__iniReadAll(char iniFilename[])
{
      // Lese zwei INT-Parameter aus der INI Datei "Test.Ini" :
      //  "ReadPara1",
      //  "ReadPara2".     (Sektion "Input")
      // 
      readPara1 = getProfileInt("Input","ReadPara1",defVal,iniFilename );
      readPara2 = getProfileInt("Input","ReadPara2",defVal,iniFilename );
      //
      // Wird der Pfad fuer die Schreiboperation nicht explizit 
      // gesetzt, so wird der Pfad der Konfigurationsdatei heran-
      // gezogen.
      // 
//    writeLineEx(dwWriteSinkSimu, dwWriteSeverityInfo, "      read Power Test INI-file in fkt");

    write("read OFN ini file '%s'",iniFilename );

//    putvalue( Env_Power_Lock_Min, getProfileInt( func, "Power_Lock_Min", defPower_Lock_Min, iniFilename));
    // -------------------------- UP ----------------------------------------------------------
    strncpy(func, "Up_1", 20 );    // Name of functionality
    OFN__iniReadCurve( func, iniFilename );
    OFN__CopyCurve_Up_1();
    // -------------------------- RIGHT ----------------------------------------------------------
    strncpy(func, "Right_1", 20 );    // Name of functionality
    OFN__iniReadCurve( func, iniFilename );
    OFN__CopyCurve_Right_1();
    // -------------------------- DOWN ----------------------------------------------------------
    strncpy(func, "Down_1", 20 );    // Name of functionality
    OFN__iniReadCurve( func, iniFilename );
    OFN__CopyCurve_Down_1();
    // -------------------------- LEFT ----------------------------------------------------------
    strncpy(func, "Left_1", 20 );    // Name of functionality
    OFN__iniReadCurve( func, iniFilename );
    OFN__CopyCurve_Left_1();
    // -------------------------- UP 2 ----------------------------------------------------------
    strncpy(func, "Up_2", 20 );    // Name of functionality
    OFN__iniReadCurve( func, iniFilename );
    OFN__CopyCurve_Up_2();
    // -------------------------- RIGHT 2 ----------------------------------------------------------
    strncpy(func, "Right_2", 20 );    // Name of functionality
    OFN__iniReadCurve( func, iniFilename );
    OFN__CopyCurve_Right_2();
    // -------------------------- DOWN 2 ----------------------------------------------------------
    strncpy(func, "Down_2", 20 );    // Name of functionality
    OFN__iniReadCurve( func, iniFilename );
    OFN__CopyCurve_Down_2();
    // -------------------------- LEFT 2 ----------------------------------------------------------
    strncpy(func, "Left_2", 20 );    // Name of functionality
    OFN__iniReadCurve( func, iniFilename );
    OFN__CopyCurve_Left_2();
    // -------------------------- FREE 1 ----------------------------------------------------------
    strncpy(func, "FREE_1", 20 );    // Name of functionality
    OFN__iniReadCurve( func, iniFilename );
    OFN__iniReadText( func, iniFilename );
    OFN__CopyCurve_Free_1();
    // -------------------------- FREE 2 ----------------------------------------------------------
    strncpy(func, "FREE_2", 20 );    // Name of functionality
    OFN__iniReadCurve( func, iniFilename );
    OFN__iniReadText( func, iniFilename );
    OFN__CopyCurve_Free_2();
    // -------------------------- FREE 3 ----------------------------------------------------------
    strncpy(func, "FREE_3", 20 );    // Name of functionality
    OFN__iniReadCurve( func, iniFilename );
    OFN__iniReadText( func, iniFilename );
    OFN__CopyCurve_Free_3();
    // -------------------------- FREE 4 ----------------------------------------------------------
    strncpy(func, "FREE_4", 20 );    // Name of functionality
    OFN__iniReadCurve( func, iniFilename );
    OFN__iniReadText( func, iniFilename );
    OFN__CopyCurve_Free_4();
}

OFN__iniReadCurve(char CurveSection[], char iniFilename[])
{
    OFN_Temp_Length =  getProfileInt( CurveSection, "Gesture__Length",                0,             iniFilename);
    
    OFN_Temp_x[0] =    getProfileInt( CurveSection, "Gesture__Data_X1",               0,             iniFilename);
    OFN_Temp_y[0] =    getProfileInt( CurveSection, "Gesture__Data_Y1",               0,             iniFilename);
    OFN_Temp_t[0] =    getProfileInt( CurveSection, "Gesture__Data_T1",               0,             iniFilename);

    OFN_Temp_x[1] =    getProfileInt( CurveSection, "Gesture__Data_X2",               0,             iniFilename);
    OFN_Temp_y[1] =    getProfileInt( CurveSection, "Gesture__Data_Y2",               0,             iniFilename);
    OFN_Temp_t[1] =    getProfileInt( CurveSection, "Gesture__Data_T2",               0,             iniFilename);

    OFN_Temp_x[2] =    getProfileInt( CurveSection, "Gesture__Data_X3",               0,             iniFilename);
    OFN_Temp_y[2] =    getProfileInt( CurveSection, "Gesture__Data_Y3",               0,             iniFilename);
    OFN_Temp_t[2] =    getProfileInt( CurveSection, "Gesture__Data_T3",               0,             iniFilename);

    OFN_Temp_x[3] =    getProfileInt( CurveSection, "Gesture__Data_X4",               0,             iniFilename);
    OFN_Temp_y[3] =    getProfileInt( CurveSection, "Gesture__Data_Y4",               0,             iniFilename);
    OFN_Temp_t[3] =    getProfileInt( CurveSection, "Gesture__Data_T4",               0,             iniFilename);

    OFN_Temp_x[4] =    getProfileInt( CurveSection, "Gesture__Data_X5",               0,             iniFilename);
    OFN_Temp_y[4] =    getProfileInt( CurveSection, "Gesture__Data_Y5",               0,             iniFilename);
    OFN_Temp_t[4] =    getProfileInt( CurveSection, "Gesture__Data_T5",               0,             iniFilename);

    OFN_Temp_x[5] =    getProfileInt( CurveSection, "Gesture__Data_X6",               0,             iniFilename);
    OFN_Temp_y[5] =    getProfileInt( CurveSection, "Gesture__Data_Y6",               0,             iniFilename);
    OFN_Temp_t[5] =    getProfileInt( CurveSection, "Gesture__Data_T6",               0,             iniFilename);

    OFN_Temp_x[6] =    getProfileInt( CurveSection, "Gesture__Data_X7",               0,             iniFilename);
    OFN_Temp_y[6] =    getProfileInt( CurveSection, "Gesture__Data_Y7",               0,             iniFilename);
    OFN_Temp_t[6] =    getProfileInt( CurveSection, "Gesture__Data_T7",               0,             iniFilename);

    OFN_Temp_x[7] =    getProfileInt( CurveSection, "Gesture__Data_X8",               0,             iniFilename);
    OFN_Temp_y[7] =    getProfileInt( CurveSection, "Gesture__Data_Y8",               0,             iniFilename);
    OFN_Temp_t[7] =    getProfileInt( CurveSection, "Gesture__Data_T8",               0,             iniFilename);

    OFN_Temp_x[8] =    getProfileInt( CurveSection, "Gesture__Data_X9",               0,             iniFilename);
    OFN_Temp_y[8] =    getProfileInt( CurveSection, "Gesture__Data_Y9",               0,             iniFilename);
    OFN_Temp_t[8] =    getProfileInt( CurveSection, "Gesture__Data_T9",               0,             iniFilename);

    OFN_Temp_x[9] =    getProfileInt( CurveSection, "Gesture__Data_X10",               0,             iniFilename);
    OFN_Temp_y[9] =    getProfileInt( CurveSection, "Gesture__Data_Y10",               0,             iniFilename);
    OFN_Temp_t[9] =    getProfileInt( CurveSection, "Gesture__Data_T10",               0,             iniFilename);

    OFN_Temp_x[10] =    getProfileInt( CurveSection, "Gesture__Data_X11",               0,             iniFilename);
    OFN_Temp_y[10] =    getProfileInt( CurveSection, "Gesture__Data_Y11",               0,             iniFilename);
    OFN_Temp_t[10] =    getProfileInt( CurveSection, "Gesture__Data_T11",               0,             iniFilename);

    OFN_Temp_x[11] =    getProfileInt( CurveSection, "Gesture__Data_X12",               0,             iniFilename);
    OFN_Temp_y[11] =    getProfileInt( CurveSection, "Gesture__Data_Y12",               0,             iniFilename);
    OFN_Temp_t[11] =    getProfileInt( CurveSection, "Gesture__Data_T12",               0,             iniFilename);

    OFN_Temp_x[12] =    getProfileInt( CurveSection, "Gesture__Data_X13",               0,             iniFilename);
    OFN_Temp_y[12] =    getProfileInt( CurveSection, "Gesture__Data_Y13",               0,             iniFilename);
    OFN_Temp_t[12] =    getProfileInt( CurveSection, "Gesture__Data_T13",               0,             iniFilename);

    OFN_Temp_x[13] =    getProfileInt( CurveSection, "Gesture__Data_X14",               0,             iniFilename);
    OFN_Temp_y[13] =    getProfileInt( CurveSection, "Gesture__Data_Y14",               0,             iniFilename);
    OFN_Temp_t[13] =    getProfileInt( CurveSection, "Gesture__Data_T14",               0,             iniFilename);

    OFN_Temp_x[14] =    getProfileInt( CurveSection, "Gesture__Data_X15",               0,             iniFilename);
    OFN_Temp_y[14] =    getProfileInt( CurveSection, "Gesture__Data_Y15",               0,             iniFilename);
    OFN_Temp_t[14] =    getProfileInt( CurveSection, "Gesture__Data_T15",               0,             iniFilename);

    OFN_Temp_x[15] =    getProfileInt( CurveSection, "Gesture__Data_X16",               0,             iniFilename);
    OFN_Temp_y[15] =    getProfileInt( CurveSection, "Gesture__Data_Y16",               0,             iniFilename);
    OFN_Temp_t[15] =    getProfileInt( CurveSection, "Gesture__Data_T16",               0,             iniFilename);
}

OFN__CopyCurve_Up_1()
{
    byte i = 0;

    OFN_Up_1_Length = OFN_Temp_Length;
    for( i = 0; i < 16; i++ )
    {
        OFN_Up_1_x[i] = OFN_Temp_x[i];
        OFN_Up_1_y[i] = OFN_Temp_y[i];
        OFN_Up_1_t[i] = OFN_Temp_t[i];
    }
}

OFN__CopyCurve_Right_1()
{
    byte i = 0;

    OFN_Right_1_Length = OFN_Temp_Length;
        for( i = 0; i < 16; i++ )
        {
            OFN_Right_1_x[i] = OFN_Temp_x[i];
            OFN_Right_1_y[i] = OFN_Temp_y[i];
            OFN_Right_1_t[i] = OFN_Temp_t[i];
    }
}

OFN__CopyCurve_Down_1()
{
    byte i = 0;

    OFN_Down_1_Length = OFN_Temp_Length;
        for( i = 0; i < 16; i++ )
        {
            OFN_Down_1_x[i] = OFN_Temp_x[i];
            OFN_Down_1_y[i] = OFN_Temp_y[i];
            OFN_Down_1_t[i] = OFN_Temp_t[i];
    }
}

OFN__CopyCurve_Left_1()
{
    byte i = 0;

    OFN_Left_1_Length = OFN_Temp_Length;
        for( i = 0; i < 16; i++ )
        {
            OFN_Left_1_x[i] = OFN_Temp_x[i];
            OFN_Left_1_y[i] = OFN_Temp_y[i];
            OFN_Left_1_t[i] = OFN_Temp_t[i];
    }
}

OFN__CopyCurve_Up_2()
{
    byte i = 0;

    OFN_Up_2_Length = OFN_Temp_Length;
        for( i = 0; i < 16; i++ )
        {
            OFN_Up_2_x[i] = OFN_Temp_x[i];
            OFN_Up_2_y[i] = OFN_Temp_y[i];
            OFN_Up_2_t[i] = OFN_Temp_t[i];
    }
}

OFN__CopyCurve_Right_2()
{
    byte i = 0;

    OFN_Right_2_Length = OFN_Temp_Length;
        for( i = 0; i < 16; i++ )
        {
            OFN_Right_2_x[i] = OFN_Temp_x[i];
            OFN_Right_2_y[i] = OFN_Temp_y[i];
            OFN_Right_2_t[i] = OFN_Temp_t[i];
    }
}

OFN__CopyCurve_Down_2()
{
    byte i = 0;

    OFN_Down_2_Length = OFN_Temp_Length;
        for( i = 0; i < 16; i++ )
        {
            OFN_Down_2_x[i] = OFN_Temp_x[i];
            OFN_Down_2_y[i] = OFN_Temp_y[i];
            OFN_Down_2_t[i] = OFN_Temp_t[i];
    }
}

OFN__CopyCurve_Left_2()
{
    byte i = 0;

    OFN_Left_2_Length = OFN_Temp_Length;
        for( i = 0; i < 16; i++ )
        {
            OFN_Left_2_x[i] = OFN_Temp_x[i];
            OFN_Left_2_y[i] = OFN_Temp_y[i];
            OFN_Left_2_t[i] = OFN_Temp_t[i];
    }
}

on envVar Env_OFN_Up_1_Play
{
    byte i = 0; 
	
	//write("\nWe activated Env_OFN_Up_1_Play:  Env_OFN_Up_1_Play is %d", getValue( Env_OFN_Up_1_Play )); 
	//write("Env_OFN_Play_Active is %d", getValue( Env_OFN_Play_Active ));
	
    if( getValue( Env_OFN_Play_Active )) 			
	{
		
		return;
	}
	else 											//first the program enters in the above if, then jumps in the below else (the on envVar is executed twice for whatever reason)
	{
		if( getValue( this ) )						//UP button is clicked
		{
			
			OFN_Play_Length = OFN_Up_1_Length;
			for( i = 0; i < OFN_Play_Length; i++ )
			{
				OFN_Play_x[i] = OFN_Up_1_x[i];
				OFN_Play_y[i] = OFN_Up_1_y[i];
				OFN_Play_t[i] = OFN_Up_1_t[i];
			}
			for( i = OFN_Play_Length; i < 16; i++ )
			{
				OFN_Play_x[i] = 0;
				OFN_Play_y[i] = 0;
				OFN_Play_t[i] = 0;
			}
			
			if( (getValue(Env_OFN_Play_Active) == 0)  && (getValue( HMI__NM_EIS_AutomaticModeActive ) == 1) ) 		//has any meaning only here, before changing value of Env_OFN_Play_Active
			{
				_ReleaseCommRequest( cStWhlButtonNMRequest_temp );
				
			}
			
			putValue( Env_OFN_Play_Active, 1 );			//set Env_OFN_Play_Active on 1 (for future if's in this else branch)
						
			
			
			if( (getValue(Env_OFN_Play_Active) == 1)  && (getValue( HMI__NM_EIS_AutomaticModeActive ) == 1) ) 		//we changed Env_OFN_Play_Active to 1, now we can wake up cluster
			{
				_SetCommRequest( cStWhlButtonNMRequest_temp );
				setTimer( t_StWhlButtonNMCancelTimer, c_NMCancelTimer_30sec ); // 5 seconds for auto-shut-off	
				
			}
			
		}
	}
}

on timer t_StWhlButtonNMCancelTimer
{
    if( getValue( HMI__NM_EIS_AutomaticModeActive ) == 1 )
    {
        _ReleaseCommRequest( cStWhlButtonNMRequest );  // all keys reset their requests
    }
}

on envVar Env_OFN_Up_2_Play
{
    byte i = 0;

    if( getValue( Env_OFN_Play_Active ) ) return;
    if( getValue( this ) )
    {
        OFN_Play_Length = OFN_Up_2_Length;
        for( i = 0; i < OFN_Play_Length; i++ )
        {
            OFN_Play_x[i] = OFN_Up_2_x[i];
            OFN_Play_y[i] = OFN_Up_2_y[i];
            OFN_Play_t[i] = OFN_Up_2_t[i];
        }
        for( i = OFN_Play_Length; i < 16; i++ )
        {
            OFN_Play_x[i] = 0;
            OFN_Play_y[i] = 0;
            OFN_Play_t[i] = 0;
        }
        putValue( Env_OFN_Play_Active, 1 );
    }
}

on envVar Env_OFN_Play_Active
{
    if( getValue( this ) )
    {
        if( OFN_Play_Length > 0 )
        {
            putValue( HMI_StWhl_OFN1_Mtn_X_Comp, 126 + OFN_Play_x[0] );
            putValue( HMI_StWhl_OFN1_Mtn_Y_Comp, 126 + OFN_Play_y[0] );
            putValue( HMI_StWhl_OFN1_Stat, OFN_Play_t[0] );
            if( getValue( HMI_StWhl_OFN1_TmStmp ) == 15 )
                putValue( HMI_StWhl_OFN1_TmStmp, 0 );
            else
                putValue( HMI_StWhl_OFN1_TmStmp, getValue( HMI_StWhl_OFN1_TmStmp ) + 1 );
            OFN_Play_ActPos = 1;
            putValue( HMI__TRIGMSG_StWhl_OFN_Stat_AR, 1 );  // Start transmission cycle, Env_OFN_Play_Active will stay "1" until transmission is stopped.
                                                            // HMI__TRIGMSG_StWhl_OFN_Stat_AR is self-resetting
        }
    }
}

on message StWhl_OFN_Stat_AR
{
    if( getValue( Env_OFN_Play_Active ) > 0 )
    {
        if( OFN_Play_ActPos < OFN_Play_Length )
        {
            if( getValue( HMI_EVC_List01_StStyle ) == 2 )
            {
                putValue( HMI_StWhl_OFN2_Mtn_X_Comp, 126 + OFN_Play_x[OFN_Play_ActPos] );
                putValue( HMI_StWhl_OFN2_Mtn_Y_Comp, 126 + OFN_Play_y[OFN_Play_ActPos] );
                putValue( HMI_StWhl_OFN2_Stat, OFN_Play_t[OFN_Play_ActPos] );
                if( OFN_Play_t[OFN_Play_ActPos] != 0 )
                {
                    if( getValue( HMI_StWhl_OFN2_TmStmp ) == 15 )
                        putValue( HMI_StWhl_OFN2_TmStmp, 1 );
                    else
                        putValue( HMI_StWhl_OFN2_TmStmp, getValue( HMI_StWhl_OFN2_TmStmp ) + 1 );
                }
                else
                    putValue( HMI_StWhl_OFN2_TmStmp, 0 );
            }
            else
            {
                putValue( HMI_StWhl_OFN1_Mtn_X_Comp, 126 + OFN_Play_x[OFN_Play_ActPos] );
                putValue( HMI_StWhl_OFN1_Mtn_Y_Comp, 126 + OFN_Play_y[OFN_Play_ActPos] );
                putValue( HMI_StWhl_OFN1_Stat, OFN_Play_t[OFN_Play_ActPos] );
                if( OFN_Play_t[OFN_Play_ActPos] != 0 )
                {
                    if( getValue( HMI_StWhl_OFN1_TmStmp ) == 15 )
                        putValue( HMI_StWhl_OFN1_TmStmp, 1 );
                    else
                        putValue( HMI_StWhl_OFN1_TmStmp, getValue( HMI_StWhl_OFN1_TmStmp ) + 1 );
                }
                else
                    putValue( HMI_StWhl_OFN1_TmStmp, 0 );
            }
            OFN_Play_ActPos += 1;
            putValue( HMI__TRIGMSG_StWhl_OFN_Stat_AR, 1 );  // Start transmission cycle, Env_OFN_Play_Active will stay "1" until transmission is stopped.
                                                            // HMI__TRIGMSG_StWhl_OFN_Stat_AR is self-resetting
        }
        else
        { // letzten Frame "0" schicken
            if( getValue( HMI_EVC_List01_StStyle ) == 2 )
            {
                putValue( HMI_StWhl_OFN2_Mtn_X_Comp, 126 );
                putValue( HMI_StWhl_OFN2_Mtn_Y_Comp, 126 );
                putValue( HMI_StWhl_OFN2_Stat, 0 );
                putValue( HMI_StWhl_OFN2_TmStmp, 0 );
                putValue( HMI_StWhl_OFN1_TmStmp, 0 );
            }
            else
            {
                putValue( HMI_StWhl_OFN1_Mtn_X_Comp, 126 );
                putValue( HMI_StWhl_OFN1_Mtn_Y_Comp, 126  );
                putValue( HMI_StWhl_OFN1_Stat, 0 );
                putValue( HMI_StWhl_OFN1_TmStmp, 0 );
            }
            OFN_Play_ActPos = 0;
            putValue( HMI__TRIGMSG_StWhl_OFN_Stat_AR, 1 );  // Start transmission cycle, Env_OFN_Play_Active will stay "1" until transmission is stopped.
                                                            // HMI__TRIGMSG_StWhl_OFN_Stat_AR is self-resetting
            putValue( Env_OFN_Play_Active, 0 );
        }
    }
}

on envVar Env_OFN_Down_1_Play
{
    byte i = 0;
	if( ( getValue( Env_Stress__StresstestMainActiv ) == 0 )   && ( getValue( HMI__NM_EIS_AutomaticNM_Switching ) == 0 )    )
	{
		_SetCommRequest( cStWhlButtonNMRequest );
		setTimer( t_StWhlButtonNMCancelTimer, c_NMCancelTimer_05sec ); // 5 seconds for auto-shut-off
	}
    if( getValue( Env_OFN_Play_Active ) ) return;
    if( getValue( this ) )
    {
        OFN_Play_Length = OFN_Down_1_Length;
        for( i = 0; i < OFN_Play_Length; i++ )
        {
            OFN_Play_x[i] = OFN_Down_1_x[i];
            OFN_Play_y[i] = OFN_Down_1_y[i];
            OFN_Play_t[i] = OFN_Down_1_t[i];
        }
        for( i = OFN_Play_Length; i < 16; i++ )
        {
            OFN_Play_x[i] = 0;
            OFN_Play_y[i] = 0;
            OFN_Play_t[i] = 0;
        }
        putValue( Env_OFN_Play_Active, 1 );
    }
}

on envVar Env_OFN_Left_1_Play
{
    byte i = 0;
	if( ( getValue( Env_Stress__StresstestMainActiv ) == 0 )   && ( getValue( HMI__NM_EIS_AutomaticNM_Switching ) == 0 )    )
	{
		_SetCommRequest( cStWhlButtonNMRequest );
		setTimer( t_StWhlButtonNMCancelTimer, c_NMCancelTimer_05sec ); // 5 seconds for auto-shut-off
	}
    if( getValue( Env_OFN_Play_Active ) ) return;
    if( getValue( this ) )
    {
        OFN_Play_Length = OFN_Left_1_Length;
        for( i = 0; i < OFN_Play_Length; i++ )
        {
            OFN_Play_x[i] = OFN_Left_1_x[i];
            OFN_Play_y[i] = OFN_Left_1_y[i];
            OFN_Play_t[i] = OFN_Left_1_t[i];
        }
        for( i = OFN_Play_Length; i < 16; i++ )
        {
            OFN_Play_x[i] = 0;
            OFN_Play_y[i] = 0;
            OFN_Play_t[i] = 0;
        }
        putValue( Env_OFN_Play_Active, 1 );
    }
}

on envVar Env_OFN_Right_1_Play
{
    byte i = 0;
	/*
	if( ( getValue( Env_Stress__StresstestMainActiv ) == 0 )   && ( getValue( HMI__NM_EIS_AutomaticNM_Switching ) == 0 )    )
	{
		_SetCommRequest( cStWhlButtonNMRequest );
		setTimer( t_StWhlButtonNMCancelTimer, c_NMCancelTimer_05sec ); // 5 seconds for auto-shut-off
	}
	*/
    if( getValue( Env_OFN_Play_Active ) ) return;
    if( getValue( this ) )
    {
        OFN_Play_Length = OFN_Right_1_Length;
        for( i = 0; i < OFN_Play_Length; i++ )
        {
            OFN_Play_x[i] = OFN_Right_1_x[i];
            OFN_Play_y[i] = OFN_Right_1_y[i];
            OFN_Play_t[i] = OFN_Right_1_t[i];
        }
        for( i = OFN_Play_Length; i < 16; i++ )
        {
            OFN_Play_x[i] = 0;
            OFN_Play_y[i] = 0;
            OFN_Play_t[i] = 0;
        }
        putValue( Env_OFN_Play_Active, 1 );
		
		if( (getValue(Env_OFN_Play_Active) == 1)  && (getValue( HMI__NM_EIS_AutomaticModeActive ) == 1) )
			{
				_SetCommRequest( cStWhlButtonNMRequest );
				//setTimer( t_StWhlButtonNMCancelTimer, c_NMCancelTimer_05sec ); // 5 seconds for auto-shut-off	
			}
			else
			{
				if( (getValue(Env_OFN_Play_Active) == 0)  && (getValue( HMI__NM_EIS_AutomaticModeActive ) == 1) )
				{
					_ReleaseCommRequest( cStWhlButtonNMRequest );
				}
			}
    }
}

on envVar Env_OFN_Left_2_Play
{
    byte i = 0;

    if( getValue( Env_OFN_Play_Active ) ) return;
    if( getValue( this ) )
    {
        OFN_Play_Length = OFN_Left_2_Length;
        for( i = 0; i < OFN_Play_Length; i++ )
        {
            OFN_Play_x[i] = OFN_Left_2_x[i];
            OFN_Play_y[i] = OFN_Left_2_y[i];
            OFN_Play_t[i] = OFN_Left_2_t[i];
        }
        for( i = OFN_Play_Length; i < 16; i++ )
        {
            OFN_Play_x[i] = 0;
            OFN_Play_y[i] = 0;
            OFN_Play_t[i] = 0;
        }
        putValue( Env_OFN_Play_Active, 1 );
    }
}

on envVar Env_OFN_Right_2_Play
{
    byte i = 0;

    if( getValue( Env_OFN_Play_Active ) ) return;
    if( getValue( this ) )
    {
        OFN_Play_Length = OFN_Right_2_Length;
        for( i = 0; i < OFN_Play_Length; i++ )
        {
            OFN_Play_x[i] = OFN_Right_2_x[i];
            OFN_Play_y[i] = OFN_Right_2_y[i];
            OFN_Play_t[i] = OFN_Right_2_t[i];
        }
        for( i = OFN_Play_Length; i < 16; i++ )
        {
            OFN_Play_x[i] = 0;
            OFN_Play_y[i] = 0;
            OFN_Play_t[i] = 0;
        }
        putValue( Env_OFN_Play_Active, 1 );
    }
}

on envVar Env_OFN_Down_2_Play
{
    byte i = 0;

    if( getValue( Env_OFN_Play_Active ) ) return;
    if( getValue( this ) )
    {
        OFN_Play_Length = OFN_Down_2_Length;
        for( i = 0; i < OFN_Play_Length; i++ )
        {
            OFN_Play_x[i] = OFN_Down_2_x[i];
            OFN_Play_y[i] = OFN_Down_2_y[i];
            OFN_Play_t[i] = OFN_Down_2_t[i];
        }
        for( i = OFN_Play_Length; i < 16; i++ )
        {
            OFN_Play_x[i] = 0;
            OFN_Play_y[i] = 0;
            OFN_Play_t[i] = 0;
        }
        putValue( Env_OFN_Play_Active, 1 );
    }
}

OFN__CopyCurve_Free_1()
{
    byte i = 0;

    OFN_Free_1_Length = OFN_Temp_Length;
    for( i = 0; i < 16; i++ )
    {
        OFN_Free_1_x[i] = OFN_Temp_x[i];
        OFN_Free_1_y[i] = OFN_Temp_y[i];
        OFN_Free_1_t[i] = OFN_Temp_t[i];
    }
    putValue( Env_OFN_Free_1_Title, OFN_Temp_txt );
}

OFN__iniReadText(char CurveSection[], char iniFilename[])
{
    getProfileString( CurveSection, "Gesture__Text",                "<empty>", OFN_Temp_txt,100,            iniFilename);
}

OFN__CopyCurve_Free_2()
{
    byte i = 0;

    OFN_Free_2_Length = OFN_Temp_Length;
    for( i = 0; i < 16; i++ )
    {
        OFN_Free_2_x[i] = OFN_Temp_x[i];
        OFN_Free_2_y[i] = OFN_Temp_y[i];
        OFN_Free_2_t[i] = OFN_Temp_t[i];
    }
    putValue( Env_OFN_Free_2_Title, OFN_Temp_txt );
}

OFN__CopyCurve_Free_3()
{
    byte i = 0;

    OFN_Free_3_Length = OFN_Temp_Length;
    for( i = 0; i < 16; i++ )
    {
        OFN_Free_3_x[i] = OFN_Temp_x[i];
        OFN_Free_3_y[i] = OFN_Temp_y[i];
        OFN_Free_3_t[i] = OFN_Temp_t[i];
    }
    putValue( Env_OFN_Free_3_Title, OFN_Temp_txt );
}

OFN__CopyCurve_Free_4()
{
    byte i = 0;

    OFN_Free_4_Length = OFN_Temp_Length;
    for( i = 0; i < 16; i++ )
    {
        OFN_Free_4_x[i] = OFN_Temp_x[i];
        OFN_Free_4_y[i] = OFN_Temp_y[i];
        OFN_Free_4_t[i] = OFN_Temp_t[i];
    }
    putValue( Env_OFN_Free_4_Title, OFN_Temp_txt );
}

on envVar Env_OFN_Free_1_Play
{
    byte i = 0;

    if( getValue( Env_OFN_Play_Active ) ) return;
    if( getValue( this ) )
    {
        OFN_Play_Length = OFN_Free_1_Length;
        for( i = 0; i < OFN_Play_Length; i++ )
        {
            OFN_Play_x[i] = OFN_Free_1_x[i];
            OFN_Play_y[i] = OFN_Free_1_y[i];
            OFN_Play_t[i] = OFN_Free_1_t[i];
        }
        for( i = OFN_Play_Length; i < 16; i++ )
        {
            OFN_Play_x[i] = 0;
            OFN_Play_y[i] = 0;
            OFN_Play_t[i] = 0;
        }
        putValue( Env_OFN_Play_Active, 1 );
    }
}

on envVar Env_OFN_Free_2_Play
{
    byte i = 0;

    if( getValue( Env_OFN_Play_Active ) ) return;
    if( getValue( this ) )
    {
        OFN_Play_Length = OFN_Free_2_Length;
        for( i = 0; i < OFN_Play_Length; i++ )
        {
            OFN_Play_x[i] = OFN_Free_2_x[i];
            OFN_Play_y[i] = OFN_Free_2_y[i];
            OFN_Play_t[i] = OFN_Free_2_t[i];
        }
        for( i = OFN_Play_Length; i < 16; i++ )
        {
            OFN_Play_x[i] = 0;
            OFN_Play_y[i] = 0;
            OFN_Play_t[i] = 0;
        }
        putValue( Env_OFN_Play_Active, 1 );
    }
}

on envVar Env_OFN_Free_3_Play
{
    byte i = 0;

    if( getValue( Env_OFN_Play_Active ) ) return;
    if( getValue( this ) )
    {
        OFN_Play_Length = OFN_Free_3_Length;
        for( i = 0; i < OFN_Play_Length; i++ )
        {
            OFN_Play_x[i] = OFN_Free_3_x[i];
            OFN_Play_y[i] = OFN_Free_3_y[i];
            OFN_Play_t[i] = OFN_Free_3_t[i];
        }
        for( i = OFN_Play_Length; i < 16; i++ )
        {
            OFN_Play_x[i] = 0;
            OFN_Play_y[i] = 0;
            OFN_Play_t[i] = 0;
        }
        putValue( Env_OFN_Play_Active, 1 );
    }
}

on envVar Env_OFN_Free_4_Play
{
    byte i = 0;

    if( getValue( Env_OFN_Play_Active ) ) return;
    if( getValue( this ) )
    {
        OFN_Play_Length = OFN_Free_4_Length;
        for( i = 0; i < OFN_Play_Length; i++ )
        {
            OFN_Play_x[i] = OFN_Free_4_x[i];
            OFN_Play_y[i] = OFN_Free_4_y[i];
            OFN_Play_t[i] = OFN_Free_4_t[i];
        }
        for( i = OFN_Play_Length; i < 16; i++ )
        {
            OFN_Play_x[i] = 0;
            OFN_Play_y[i] = 0;
            OFN_Play_t[i] = 0;
        }
        putValue( Env_OFN_Play_Active, 1 );
    }
}

on envVar Env_Hazard_On
{
    if( getValue( this ) )
    {
        putValue( Env_TurnInd_Lt_On, 1 );
        putValue( Env_TurnInd_Rt_On, 1 );
    }
    else
    {
        putValue( Env_TurnInd_Lt_On, 0 );
        putValue( Env_TurnInd_Rt_On, 0 );
    }
}

on timer _tEnterGarageLevel
{
    if( bEnterGarageLevel_actual_step == 1 )
    {
        putValue( HMI_StWhl_Sw_Back1_Psd, 0);
        putValue( HMI_StWhl_Sw_Ok1_Psd, 0 );
        setTimer( _tEnterGarageLevel, 100 );
    }
    if( bEnterGarageLevel_actual_step == 2 )
    {
        putValue( HMI_StWhl_Sw_Back1_Psd, 1);
        setTimer( _tEnterGarageLevel, 2000 );
    }
    if( bEnterGarageLevel_actual_step == 3 )
    {
        putValue( HMI_StWhl_Sw_Ok1_Psd, 1 );
        setTimer( _tEnterGarageLevel, 500 );
    }
    if( bEnterGarageLevel_actual_step == 4 )
    {
        putValue( HMI_StWhl_Sw_Back1_Psd, 0);
        putValue( HMI_StWhl_Sw_Ok1_Psd, 0 );
        setTimer( _tEnterGarageLevel, 500 );
    }
    bEnterGarageLevel_actual_step++;
}

on envVar Env_EnterGarageLevel_AutoEnter
{
    if( getValue( this ) )
    {
        bEnterGarageLevel_actual_step = 1;
        setTimer( _tEnterGarageLevel, 100 );
    }
}

Stress_Style_WriteSink()
{
    if( getvalue( Env_Stress_StyleSweepActiv ) && getvalue( Env_Stress__StresstestMainActiv ))
    {
        writeLineEx(dwWriteSinkSimu, dwWriteSeverityInfo, "  Activ   Style Speed");
    }
    else
    {
        writeLineEx(dwWriteSinkSimu, dwWriteSeverityInfo, "  Inactiv Style Speed");
    }
}

Stress_Style_CalcNext()
{
    lCurrentVal = getvalue( Env_Stress_Style_CurrentVal ); // aditional changeable parameter
    iDirectionStyle = Stress__CalcNext_PointerVal(1, iDirectionStyle, 0, 2);
    putvalue( Env_Stress_Style_CurrentVal, lCurrentVal );
    putvalue( HMI_IC_DesignVar_Rq, lCurrentVal );
}

on timer _t_Stress_Style
{
    if( Stress_Style_CheckActiv())
    {
        Stress_Style_CalcNext();
    }
}

int Stress_Style_CheckActiv()
{
    int iTemp;

    canceltimer(_t_Stress_Style);
    iTemp = getvalue( Env_Stress_StyleSweepActiv ) && getvalue( Env_Stress__StresstestMainActiv );
//    write("GearBoxActiv = %d und _StresstestMainActiv = %d, verUNDed = %d",getvalue(GearBoxSweepActiv), getvalue(_StresstestMainActiv), iTemp);
    if( iTemp)
    {
        settimer(_t_Stress_Style, getvalue( Env_Stress_StyleTimeInterval ));
    }

    return(iTemp);
}

on envVar Env_Stress_StyleSweepActiv
{
    Stress_Style_WriteSink();
    Stress_Style_CheckActiv();
}

on envVar Env_Stress_StyleTimeInterval
{
    Stress_Style_CheckActiv();
}

on envVar Env_EngCoolTemp_Disp_Rq
{
   if( getValue( Env_EngCoolTemp_Disp_Rq_Fehler ) )
   {
      putValue( HMI_EngCoolTemp_Disp_Rq, 215 );
   }
   else
   {
      putValue( HMI_EngCoolTemp_Disp_Rq, getValue(this) );
   }
}

on envVar Env_EngCoolTemp_Disp_Rq_Fehler
{
   if( getValue(this) )
   {
      putValue( HMI_EngCoolTemp_Disp_Rq, 215 );
   }
   else
   {
      putValue( HMI_EngCoolTemp_Disp_Rq, getValue( Env_EngCoolTemp_Disp_Rq ) );
   }
}

on envVar Env_Open_ADC_Panel
{
    if( getValue( this ) )
    {
        openPanel("ADC_Simulation_Main");
        putValue( Env_StWhl_Buttons_not_numeric, 1 );
    }
}

on envVar Env_EMC
{
  if (getvalue(this)==0x01)
  {
    putValue(Env_Hazard_On, 1);
    putValue(HMI_LoBm_IndLmp_On_Rq, 1);
    putValue(HMI_HiBm_IndLmp_On_Rq, 1);
    putValue(HMI_LgtSens_Night, 1);
    putValue(HMI_LgtSens_Night2, 1);
    putValue(Env_Dimm_SWIllLvl_Raw_behave, 0);
    putValue(HMI_ESP_Off_IndLmp_On_Rq, 1);
    putValue(HMI_TankLvl, 50);
    putValue(Env_Stress_Tank_SweepActiv, 0);
    putValue(Env_Stress_OutsideAirtemp_SweepActiv, 0);
    putValue(HMI_SwIllLvl_Raw, 101);
  }
  else
  {
    putValue(Env_Hazard_On, 0);
    putValue(HMI_LoBm_IndLmp_On_Rq, 0);
    putValue(HMI_HiBm_IndLmp_On_Rq, 0);
    putValue(HMI_LgtSens_Night, 0);
    putValue(HMI_LgtSens_Night2, 0);
    putValue(Env_Dimm_SWIllLvl_Raw_behave, 1);
    putValue(HMI_SwIllLvl_Raw, 0);
    putValue(HMI_ESP_Off_IndLmp_On_Rq, 0);
  }
}

on envVar Env_Stress_PnhvSweepActiv
{
    Stress_Pnhv_WriteSink();
    if( Stress_Pnhv_CheckActiv() )    putvalue(Env_PnhvRPM_Fehler, 0 ); // always take stresstest revolution values
}

on envVar Env_Stress_PnhvTimeInterval
{
    Stress_Pnhv_CheckActiv();
}

on timer _t_Stress_ChangePnhv
{
    if( Stress_Pnhv_CheckActiv())
    {
        Stress_Pnhv_CalcNext();
    }
}

Stress_Pnhv_CalcNext()
{
    lCurrentVal = getvalue( Env_Stress_PnhvCurrentVal ); // aditional changeable parameter
    iDirectionRev = Stress__CalcNext_PointerVal(getvalue( Env_Stress_PnhvStepWidth ), iDirectionRev, getvalue( Env_Stress_PnhvMin ), getvalue( Env_Stress_PnhvMax ));
    putvalue( Env_Stress_PnhvCurrentVal, lCurrentVal );
    putValue( HMI_PNHV_Perf_Total_Disp_Rq, lCurrentVal );
}

int Stress_Pnhv_CheckActiv()
{
    int iTemp;

    canceltimer(_t_Stress_ChangePnhv);
    iTemp = getvalue( Env_Stress_PnhvSweepActiv ) && getvalue( Env_Stress__StresstestMainActiv );
//    write("PnhvActiv = %d und _StresstestMainActiv = %d, verUNDed = %d",getvalue(PnhvSweepActiv), getvalue(_StresstestMainActiv), iTemp);
    if( iTemp)
    {
        settimer(_t_Stress_ChangePnhv, getvalue(Env_Stress_PnhvTimeInterval ));
    }

    return(iTemp);
}

Stress_Pnhv_IniRead (char iniFilename[])
{
    strncpy(func, "Pnhv", 20 );    // Name of functionality

    putvalue( Env_Stress_PnhvSweepActiv,   getProfileInt( func, "PnhvSweepActiv",   defPnhvSweepActiv,   iniFilename));
    putvalue( Env_Stress_PnhvMin,          getProfileInt( func, "PnhvMin",          defPnhvMin,          iniFilename));
    putvalue( Env_Stress_PnhvMax,          getProfileInt( func, "PnhvMax",          defPnhvMax,          iniFilename));
    putvalue( Env_Stress_PnhvStepWidth,    getProfileInt( func, "PnhvStepWidth",    defPnhvStepWidth,    iniFilename));
    putvalue( Env_Stress_PnhvTimeInterval, getProfileInt( func, "PnhvTimeInterval", defPnhvTimeInterval, iniFilename));
}

Stress_Pnhv_IniWrite (char iniFilename[])
{
    strncpy(func, "Pnhv", 20 );    // Name of functionality

    if( lWriteError != 0)    lWriteError = writeProfileInt( func, "PnhvSweepActiv",   getValue( Env_Stress_PnhvSweepActiv),   iniFilename );
    if( lWriteError != 0)    lWriteError = writeProfileInt( func, "PnhvMin",          getValue( Env_Stress_PnhvMin),          iniFilename );
    if( lWriteError != 0)    lWriteError = writeProfileInt( func, "PnhvMax",          getValue( Env_Stress_PnhvMax),          iniFilename );
    if( lWriteError != 0)    lWriteError = writeProfileInt( func, "PnhvStepWidth",    getValue( Env_Stress_PnhvStepWidth),    iniFilename );
    if( lWriteError != 0)    lWriteError = writeProfileInt( func, "PnhvTimeInterval", getValue( Env_Stress_PnhvTimeInterval), iniFilename );
}

Stress_Pnhv_WriteSink()
{
    if( getvalue( Env_Stress_PnhvSweepActiv ) && getvalue( Env_Stress__StresstestMainActiv ))
    {
        writeLineEx(dwWriteSinkSimu, dwWriteSeverityInfo, "  Activ   Sweep Pnhv");
    }
    else
    {
        writeLineEx(dwWriteSinkSimu, dwWriteSeverityInfo, "  Inactiv Sweep Pnhv");
    }
}

on envVar Env_PnhvRPM
{
    if( getValue( Env_PnhvRPM_Fehler ) )
    {
        putValue( HMI_EngRPM, 104 );
    }
    else
    {
        putValue( HMI_PNHV_Perf_Total_Disp_Rq, getValue(this) );
    }
}

on envVar Env_PnhvRPM_Fehler
{
    if( getValue( this ) )
    {
        putValue( HMI_PNHV_Perf_Total_Disp_Rq, 104 );
    }
    else
    {
        putValue( HMI_PNHV_Perf_Total_Disp_Rq, getValue( Env_PnhvRPM ) );
    }
}