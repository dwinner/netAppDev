enum OPTION_1
{
    ACTIVATED   = 1,
    DEACTIVATED = 0
};

enum OPTION_2
{
    IGN_ON  = 1,
    IGN_OFF = 0
};

variables
{
    enum OPTION_1 opt1;
    enum OPTION_2 opt2;

    opt1 = OPTION_1.ACTIVATED;
    opt2 = OPTION_2.IGN_OFF;
}
