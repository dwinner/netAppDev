/*@!Encoding:1252*/
variables
{
    char file[1024];   
    int status;    
}

on start
{ 
     strncpy (file,"RBS.ini",elcount(file));    

     /*putValue( eStartup_AAG, getProfileInt( "Settings", "eStartup_AAG", 1, file ));
     putValue( eStartup_ACC, getProfileInt( "Settings", "eStartup_ACC", 1, file ));
     putValue( eStartup_Airbag, getProfileInt( "Settings", "eStartup_Airbag", 1, file ));
     putValue( eStartup_BCM1, getProfileInt( "Settings", "eStartup_BCM1", 1, file ));
     putValue( eStartup_BFS, getProfileInt( "Settings", "eStartup_BFS", 1, file ));
     putValue( eStartup_Bremse, getProfileInt( "Settings", "eStartup_Bremse", 1, file ));
     putValue( eStartup_Daempfer, getProfileInt( "Settings", "eStartup_Daempfer", 1, file ));
     putValue( eStartup_ELV, getProfileInt( "Settings", "eStartup_ELV", 1, file ));
     putValue( eStartup_EPB, getProfileInt( "Settings", "eStartup_EPB", 1, file ));
     putValue( eStartup_EPS, getProfileInt( "Settings", "eStartup_EPS", 1, file ));
     putValue( eStartup_FS, getProfileInt( "Settings", "eStartup_FS", 1, file ));
     putValue( eStartup_Gateway, getProfileInt( "Settings", "eStartup_Gateway", 1, file ));
     putValue( eStartup_Kessy, getProfileInt( "Settings", "eStartup_Kessy", 1, file ));
     putValue( eStartup_LDW, getProfileInt( "Settings", "eStartup_LDW", 1, file ));
     putValue( eStartup_LWR_AFS, getProfileInt( "Settings", "eStartup_LWR_AFS", 1, file ));
     putValue( eStartup_MFG, getProfileInt( "Settings", "eStartup_MFG", 1, file ));
     putValue( eStartup_Motor, getProfileInt( "Settings", "eStartup_Motor", 1, file ));
     putValue( eStartup_PLA, getProfileInt( "Settings", "eStartup_PLA", 1, file ));
     putValue( eStartup_RDK, getProfileInt( "Settings", "eStartup_RDK", 1, file ));
     putValue( eStartup_RKA, getProfileInt( "Settings", "eStartup_RKA", 1, file ));
     putValue( eStartup_SMLS, getProfileInt( "Settings", "eStartup_SMLS", 1, file ));
     putValue( eStartup_STS, getProfileInt( "Settings", "eStartup_STS", 1, file ));
     putValue( eStartup_SWA, getProfileInt( "Settings", "eStartup_SWA", 1, file ));
     putValue( eStartup_TCO, getProfileInt( "Settings", "eStartup_TCO", 1, file ));
     putValue( eStartup_TSG_FT, getProfileInt( "Settings", "eStartup_TSG_FT", 1, file ));
     putValue( eStartup_WBA, getProfileInt( "Settings", "eStartup_WBA", 1, file ));
     putValue( eStartup_HVEM, getProfileInt( "Settings", "eStartup_HVEM", 1, file ));
     putValue( eStartup_HVLM, getProfileInt( "Settings", "eStartup_HVLM", 1, file ));
     putValue( eStartup_Kombi, getProfileInt( "Settings", "eStartup_Kombi", 1, file ));
     putValue( eStartup_Reichweite, getProfileInt( "Settings", "eStartup_Reichweite", 1, file ));


     putValue( eFunctionAAG, getProfileInt( "Settings", "eFunctionAAG", 1, file ));
     putValue( eFunctionACC, getProfileInt( "Settings", "eFunctionACC", 1, file ));
     putValue( eFunctionAirbag, getProfileInt( "Settings", "eFunctionAirbag", 1, file ));
     putValue( eFunctionBCM1, getProfileInt( "Settings", "eFunctionBCM1", 1, file ));
     putValue( eFunctionBFS, getProfileInt( "Settings", "eFunctionBFS", 1, file ));
     putValue( eFunctionBremse, getProfileInt( "Settings", "eFunctionBremse", 1, file ));
     putValue( eFunctionDaempfer, getProfileInt( "Settings", "eFunctionDaempfer", 1, file ));
     putValue( eFunctionELV, getProfileInt( "Settings", "eFunctionELV", 1, file ));
     putValue( eFunctionEPB, getProfileInt( "Settings", "eFunctionEPB", 1, file ));
     putValue( eFunctionEPS, getProfileInt( "Settings", "eFunctionEPS", 1, file ));
     putValue( eFunctionFS, getProfileInt( "Settings", "eFunctionFS", 1, file ));
     putValue( eFunctionGateway, getProfileInt( "Settings", "eFunctionGateway", 1, file ));
     putValue( eFunctionKessy, getProfileInt( "Settings", "eFunctionKessy", 1, file ));
     putValue( eFunctionLDW, getProfileInt( "Settings", "eFunctionLDW", 1, file ));
     putValue( eFunctionLWR_AFS, getProfileInt( "Settings", "eFunctionLWR_AFS", 1, file ));
     putValue( eFunctionMFG, getProfileInt( "Settings", "eFunctionMFG", 1, file ));
     putValue( eFunctionMotor, getProfileInt( "Settings", "eFunctionMotor", 1, file ));
     putValue( eFunctionPLA, getProfileInt( "Settings", "eFunctionPLA", 1, file ));
     putValue( eFunctionRDK, getProfileInt( "Settings", "eFunctionRDK", 1, file ));
     putValue( eFunctionRKA, getProfileInt( "Settings", "eFunctionRKA", 1, file ));
     putValue( eFunctionSMLS, getProfileInt( "Settings", "eFunctionSMLS", 1, file ));
     putValue( eFunctionSTS, getProfileInt( "Settings", "eFunctionSTS", 1, file ));
     putValue( eFunctionSWA, getProfileInt( "Settings", "eFunctionSWA", 1, file ));
     putValue( eFunctionTCO, getProfileInt( "Settings", "eFunctionTCO", 1, file ));
     putValue( eFunctionTSG_FT, getProfileInt( "Settings", "eFunctionTSG_FT", 1, file ));
     putValue( eFunctionWBA, getProfileInt( "Settings", "eFunctionWBA", 1, file ));*/

    }


on envVar eStartup_WBA
{
    if( getValue(this))
    {        
        putValue(eSendWBA_03, 0x1); 
    }
    else
    {     
        putValue(eSendWBA_03, 0x0); 
    }

//    writeProfileInt("Settings", "eStartup_WBA", getValue(eStartup_WBA), file);        
}

on envVar eStartup_RKA
{
    if( getValue(this))
    {       
        putValue(eSendRKA_01, 0x1);                      
    }
    else
    {
        putValue(eSendRKA_01, 0x0);
    }

//    writeProfileInt("Settings", "eStartup_RKA", getValue(eStartup_RKA), file);
}

on envVar eStartup_PLA
{
    if( getValue(this))
    {        
        putValue(eSendPLA_Status_02, 0x1);
    }
    else
    {     
        putValue(eSendPLA_Status_02, 0x0);
    }

//    writeProfileInt("Settings", "eStartup_PLA", getValue(eStartup_PLA), file);
}

on envVar eStartup_MFG
{
    if( getValue(this))
    {      
        putValue(eSendMFG_01, 0x1);    
    }
    else
    {     
        putValue(eSendMFG_01, 0x0);
    }
//    writeProfileInt("Settings", "eStartup_MFG", getValue(eStartup_MFG), file);
}

on envVar eStartup_Motor
{
    if( getValue(this))
    {       
        putValue(eSendMotor_04, 0x1);
        putValue(eSendMotor_07, 0x1);
        putValue(eSendMotor_09, 0x1);
        putValue(eSendMotor_14, 0x1);
        putValue(eSendMotor_18, 0x1);
        putValue(eSendMotor_26, 0x1);
        putValue(eSendMotor_Code_01, 0x1);
        putValue(eSendTSK_07, 0x1);
        putValue(eSendWIV_01, 0x1);
        putValue(eSendMainUnit_01, 0x1);
		putValue(eSendMotor_31, 0x1);
    }
    else
    {        
        putValue(eSendMotor_04, 0x0);
        putValue(eSendMotor_07, 0x0);
        putValue(eSendMotor_09, 0x0);
        putValue(eSendMotor_14, 0x0);
        putValue(eSendMotor_18, 0x0);
        putValue(eSendMotor_26, 0x0);
        putValue(eSendMotor_Code_01, 0x0);
        putValue(eSendTSK_07, 0x0);
        putValue(eSendWIV_01, 0x0);  
        putValue(eSendMainUnit_01, 0x0); 
		putValue(eSendMotor_31, 0x0);		
    }

//    writeProfileInt("Settings", "eStartup_Motor", getValue(eStartup_Motor), file);   
}

on envVar eStartup_Kessy
{
    if( getValue(this))
    {     
        putValue(eSendKessy_04, 0x1);
    }
    else
    {     
        putValue(eSendKessy_04, 0x0);
    }
//    writeProfileInt("Settings", "eStartup_Kessy", getValue(eStartup_Kessy), file);
}

on envVar eStartup_Gateway
{
    if( getValue(this))
    {       
       putValue(eSendGateway_73, 0x1);      
       putValue(eSendGateway_78, 0x1);      
       putValue(eSendCharisma_03, 0x1);
       putValue(eSendDiagnose_01, 0x1);
       putValue(eSendSysteminfo_01, 0x1);      
    }
    else
    {
       putValue(eSendGateway_73, 0x0);      
       putValue(eSendGateway_78, 0x0);      
       putValue(eSendCharisma_03, 0x0);                   
       putValue(eSendDiagnose_01, 0x0);
       putValue(eSendSysteminfo_01, 0x0);      
    }

//    writeProfileInt("Settings", "eStartup_Gateway", getValue(eStartup_Gateway), file);             
}

on envVar eStartup_EPB
{
    if( getValue(this))
    {        
        putValue( eSendEPB_03, 0x1 );
    }
    else
    {
        putValue( eSendEPB_03, 0x0 );
    }
//    writeProfileInt("Settings", "eStartup_EPS", getValue(eStartup_EPS), file);
}

on envVar eStartup_EPS
{
    if( getValue(this))
    {        
        putValue(eSendLH_EPS_01, 0x1);
    }
    else
    {
        putValue(eSendLH_EPS_01, 0x0);
    }
//    writeProfileInt("Settings", "eStartup_EPS", getValue(eStartup_EPS), file);
}

on envVar eStartup_ELV
{
    if( getValue(this))
    {        
        putValue(eSendELV_01, 0x1);
    }
    else
    {     
        putValue(eSendELV_01, 0x0);
    }
//    writeProfileInt("Settings", "eStartup_ELV", getValue(eStartup_ELV), file);
}

on envVar eStartup_Daempfer
{
    if( getValue(this))
    {      
        putValue(eSendDaempfer_01, 0x1);
    }
    else
    {
        putValue(eSendDaempfer_01, 0x0);
    }
//    writeProfileInt("Settings", "eStartup_Daempfer", getValue(eStartup_Daempfer), file);
}

on envVar eStartup_Bremse
{
    if( getValue(this))
    {                
        putValue(eSendESP_02, 0x1);
        putValue(eSendESP_20, 0x1);
        putValue(eSendESP_24, 0x1); 
    }
    else
    {        
        putValue(eSendESP_02, 0x0);
        putValue(eSendESP_20, 0x0);
        putValue(eSendESP_24, 0x0); 
    }

//    writeProfileInt("Settings", "eStartup_Bremse", getValue(eStartup_Bremse), file);                        
}

on envVar eStartup_BCM1
{
    if( getValue(this))
    {             
        putValue(eSendBCM_01, 0x1);
        putValue(eSendBCM_03, 0x1);
        putValue(eSendBlinkmodi_02, 0x1);
        putValue(eSendDimmung_01, 0x1);
        putValue(eSendKlima_Sensor_02, 0x1);
        putValue(eSendLicht_hinten_01, 0x1);
        putValue(eSendLicht_vorne_01, 0x1);
        putValue(eSendZV_02, 0x1);
        putValue(eSendRLS_01, 0x1);
        putValue(eSendWischer_01, 0x1);
        putValue(eSendLicht_Anf_01, 0x1);              
        putValue(eSendHSP_01, 0x1);              
    }
    else
    {     
        putValue(eSendBCM_01, 0x0);
		putValue(eSendBCM_03, 0x0);
        putValue(eSendBlinkmodi_02, 0x0);
        putValue(eSendDimmung_01, 0x0);
        putValue(eSendKlima_Sensor_02, 0x0);
        putValue(eSendLicht_hinten_01, 0x0);
        putValue(eSendLicht_vorne_01, 0x0);
        putValue(eSendZV_02, 0x0);
        putValue(eSendRLS_01, 0x0);
        putValue(eSendWischer_01, 0x0);
        putValue(eSendLicht_Anf_01, 0x0);
        putValue(eSendHSP_01, 0x0);              
    }    
//    writeProfileInt("Settings", "eStartup_BCM1", getValue(eStartup_BCM1), file);                  
}

on envVar eStartup_LWR_AFS
{
    if( getValue(this))
    {
        putValue(eSendLWR_AFS_01, 0x1);                                 
    }
    else
    {     
        putValue(eSendLWR_AFS_01, 0x0);                   
    }    

//    writeProfileInt("Settings", "eStartup_LWR_AFS", getValue(eStartup_LWR_AFS), file);            
}

on envVar eStartup_AAG
{
    if( getValue(this))
    {       
        putValue(eSendAnhaenger_01, 0x1);  
        putValue(eSendASTA_Sensor_01, 0x1);   
    }
    else
    {
        putValue(eSendAnhaenger_01, 0x0);
		putValue(eSendASTA_Sensor_01, 0x0);   
    }
//    writeProfileInt("Settings", "eStartup_AAG", getValue(eStartup_AAG), file);
}

on envVar eStartup_ACC
{
    if( getValue(this))
    {       
        putValue( eSendACC_12, 0x1 );
        putValue( eSendACC_13, 0x1 );
        putValue( eSendACC_14, 0x1 );
        putValue( eSendACC_20, 0x1 );
        putValue( eSendACC_21, 0x1 );
    }
    else
    {
        putValue( eSendACC_12, 0x0 );
        putValue( eSendACC_13, 0x0 );
        putValue( eSendACC_14, 0x0 );
        putValue( eSendACC_20, 0x0 );
        putValue( eSendACC_21, 0x0 );
    }
//    writeProfileInt( "Settings", "eStartup_ACC", getValue( eStartup_ACC ), file );
}

on envVar eStartup_Airbag
{
    if( getValue(this))
    {                
        putValue(eSendAirbag_01, 0x1);                    
        putValue(eSendAirbag_02, 0x1);
    }
    else
    {        
        putValue(eSendAirbag_02, 0x0);
        putValue(eSendAirbag_01, 0x0);                    
    }

//    writeProfileInt("Settings", "eStartup_Airbag", getValue(eStartup_Airbag), file);               
}

on envVar eStartup_TCO
{
    if( getValue(this))
    {               
        putValue(eSendTCO_01, 0x1);
        putValue(eSendTimeDate, 0x1);
        putValue(eSendVehiDist, 0x1);      
    }
    else
    {
        putValue(eSendTCO_01, 0x0);
        putValue(eSendTimeDate, 0x0);
        putValue(eSendVehiDist, 0x0);      
    }
   
//    writeProfileInt("Settings", "eStartup_TCO", getValue(eStartup_TCO), file);  
}

on envVar eStartup_TSG_FT
{
    if( getValue(this))
    {        
        putValue (eSendTSG_FT_01, 0x1);
    }
    else
    {
        putValue (eSendTSG_FT_01, 0x0);        
    }
//    writeProfileInt("Settings", "eStartup_TSG_FT", getValue(eStartup_TSG_FT), file);
}

on envVar eStartup_SWA
{
    if( getValue(this))
    {      
        putValue(eSendSWA_01, 0x1);
    }
    else
    {     
        putValue(eSendSWA_01, 0x0);
    }
//    writeProfileInt("Settings", "eStartup_SWA", getValue(eStartup_SWA), file);
}

on envVar eStartup_LDW
{
    if( getValue(this))
    {        
        putValue(eSendLDW_02, 0x1);     
    }
    else
    {       
        putValue(eSendLDW_02, 0x0);
    }
//    writeProfileInt("Settings", "eStartup_LDW", getValue(eStartup_LDW), file);
}

on envVar eStartup_SMLS
{
    if( getValue(this))
    {        
        putValue(eSendSMLS_01, 0x1);
    }
    else
    {
        putValue(eSendSMLS_01, 0x0);
    }
//    writeProfileInt("Settings", "eStartup_SMLS", getValue(eStartup_SMLS), file);
}

on envVar eStartup_FS
{
    if( getValue(this))
    {       
        putValue(eSendMem_FS_01, 0x1);
    }
    else
    {
        putValue(eSendMem_FS_01, 0x0);
    }

//    writeProfileInt("Settings", "eStartup_FS", getValue(eStartup_FS), file);
}

on envVar eStartup_BFS
{
    if( getValue(this))
    {        
        putValue(eSendMem_BFS_01, 0x1);
    }
    else
    {
        putValue(eSendMem_BFS_01, 0x0);
    }
//    writeProfileInt("Settings", "eStartup_BFS", getValue(eStartup_BFS), file);
}

on envVar eFunctionACC
{
    if( getValue(this))
    {
        putValue(eACC_Status_AnzeigeS, 0x3);        
        putValue(eACC_TachokranzS, 0x1);
        putValue(eACC_Texte_PrimaeranzS, 10);
        putValue(eACC_Texte_ZusatzanzS, 0x2);                      
    }
    else
    {
        putValue(eACC_Status_AnzeigeS, 0x0);        
        putValue(eACC_TachokranzS, 0x0);
        putValue(eACC_Texte_PrimaeranzS, 0);
        putValue(eACC_Texte_ZusatzanzS, 0x0);
    }

//    writeProfileInt("Settings", "eFunctionACC", getValue(eFunctionACC), file);
}

on envVar eFunctionAAG
{
    if( getValue(this))
    {
        putValue(eAAG_Blinker_H_aktivS, 0x1);
        putValue(eAAG_AVS_Fehler_02S, 0x0);
        putValue(eAAG_Blinker_HL_defS, 0x0);       
        putValue(eAAG_Blinker_HR_defS, 0x0);        
        putValue(eAAG_Bremslicht_H_defS, 0x0);
        putValue(eAAG_Schlusslicht_HL_defS, 0x0);
        putValue(eAAG_Schlusslicht_HR_defS, 0x0);        
    }
    else
    {
        putValue(eAAG_Blinker_H_aktivS, 0x0);
    }
   
//     writeProfileInt("Settings", "eFunctionAAG", getValue(eFunctionAAG), file);
}

on envVar eFunctionAirbag
{
    if( getValue(this))
    {        
        putValue(eAB_Erh_Auf_VBS, 0x2);      
        putValue(eAB_DeaktiviertS, 0x0);       
        putValue(eAB_Gurtschloss_Reihe2_FAS, 0x3);       
        putValue(eAB_Gurtschloss_Reihe2_MIS, 0x3);       
        putValue(eAB_Gurtschloss_Reihe2_BFS, 0x3);       
        putValue(eAB_Gurtschloss_Reihe3_FAS, 0x3);       
        putValue(eAB_Gurtschloss_Reihe3_MIS, 0x3);       
        putValue(eAB_Gurtschloss_Reihe3_BFS, 0x3);         
    }
    else
    {
        putValue(eAB_Erh_Auf_VBS, 0x0);                   
        putValue(eAB_Gurtschloss_Reihe2_FAS, 0x0);       
        putValue(eAB_Gurtschloss_Reihe2_MIS, 0x0);       
        putValue(eAB_Gurtschloss_Reihe2_BFS, 0x0);       
        putValue(eAB_Gurtschloss_Reihe3_FAS, 0x0);       
        putValue(eAB_Gurtschloss_Reihe3_MIS, 0x0);       
        putValue(eAB_Gurtschloss_Reihe3_BFS, 0x0);                
    }

//    writeProfileInt("Settings", "eFunctionAirbag", getValue(eFunctionAirbag), file);       
}

on envVar eFunctionBCM1
{
    if( getValue(this))
    {                        
        putValue(eKY_ID_Geber_1S, 0x1);
        putValue(eKY_ID_Geber_2S, 0x1);
        putValue(eKY_ID_Geber_3S, 0x1);
        putValue(eKY_ID_Geber_4S, 0x1);        
        putValue(eZV_SafeFunktion_aktivS, 0x1);                      
    }
    else
    {
        putValue(eKY_ID_Geber_1S, 0x0);
        putValue(eKY_ID_Geber_2S, 0x0);
        putValue(eKY_ID_Geber_3S, 0x0);
        putValue(eKY_ID_Geber_4S, 0x0);        
        putValue(eZV_SafeFunktion_aktivS, 0x0);                      
    }
   
//    writeProfileInt("Settings", "eFunctionBCM1", getValue(eFunctionBCM1), file); 
}

on envVar eFunctionBFS
{
    if( getValue(this))
    {
        putValue(eBFS_MMB_storage_beepS, 0x1);        
    }
    else
    {
        putValue(eBFS_MMB_storage_beepS, 0x0);        
    }
    
//    writeProfileInt("Settings", "eFunctionBFS", getValue(eFunctionBFS), file);
}

on envVar eFunctionBremse
{
    if( getValue(this))
    {               
        putValue(eBR_SystemartS, 0x2);
    }
    else
    {
        putValue(eBR_SystemartS, 0x0);
    }    

//    writeProfileInt("Settings", "eFunctionBremse", getValue(eFunctionBremse), file);       
}

on envVar eFunctionDaempfer
{
    if( getValue(this))
    {
        putValue(eDR_Gelbe_WarnlampeS, 0x0);        
    }
    
//    writeProfileInt("Settings", "eFunctionDaempfer", getValue(eFunctionDaempfer), file);
}

on envVar eFunctionELV
{
    if( getValue(this))
    {
        putValue(eELV_EntriegeltS, 0x1);        
    }
    else
    {
        putValue(eELV_EntriegeltS, 0x0);        
    }
//    writeProfileInt("Settings", "eFunctionELV", getValue(eFunctionELV), file);
}

on envVar eFunctionEPB
{
    if( getValue(this))
    {
        putValue(eEPB_FunktionslampeS, 0x1);           
    }
    else
    {
        putValue(eEPB_FunktionslampeS, 0x0);                       
    }

//    writeProfileInt("Settings", "eFunctionEPB", getValue(eFunctionEPB), file);
}

on envVar eFunctionEPS
{
    if( getValue(this))
    {
        putValue(eEPS_WarnungenS, 0x0);    
    }
    
//    writeProfileInt("Settings", "eFunctionEPS", getValue(eFunctionEPS), file);
}

on envVar eFunctionFS
{
    if( getValue(this))
    {
        putValue(eFS_MMB_storage_beepS, 0x1);
    }
    else
    {
        putValue(eFS_MMB_storage_beepS, 0x0);
    }

//    writeProfileInt("Settings", "eFunctionFS", getValue(eFunctionFS), file);
}

on envVar eFunctionGateway
{
    if( getValue(this))
    {
       putValue(eSI_BUS_01S, 0x0);
       putValue(eSI_BUS_04S, 0x0);
       putValue(eSI_BUS_06S, 0x0);
    }

//    writeProfileInt("Settings", "eFunctionGateway", getValue(eFunctionGateway), file);        
}

on envVar eFunctionKessy
{
    if( getValue(this))
    {
        putValue(eKY_MeldungenS, 0x3);       
    }
    else
    {
        putValue(eKY_MeldungenS, 0x0);       
    }
//    writeProfileInt("Settings", "eFunctionKessy", getValue(eFunctionKessy), file);
}

on envVar eFunctionLDW
{
    if( getValue(this))
    {
        putValue(eLDW_TexteS, 0x4);
        putValue(eLDW_Status_LED_gelbS, 0x1);
        putValue(eLDW_Status_LED_gruenS, 0x1);      
    }
    else
    {
        putValue(eLDW_TexteS, 0x0);
        putValue(eLDW_Status_LED_gelbS, 0x0);
        putValue(eLDW_Status_LED_gruenS, 0x0);      
    }

//    writeProfileInt("Settings", "eFunctionLDW", getValue(eFunctionLDW), file);
}

on envVar eFunctionLWR_AFS
{
    if( getValue(this))
    {
        putValue(eAFS_LampeS, 0x1);
        putValue(eLWR_LampeS, 0x0);
    }
    else
    {
        putValue(eAFS_LampeS, 0x0);       
    }

//   writeProfileInt("Settings", "eFunctionLWR_AFS", getValue(eFunctionLWR_AFS), file);            
}

on envVar eFunctionMFG
{
    if( getValue(this))
    {
        putValue(eMF_Schluessel_scanS, 0x1); 
        putValue(eMF_SummerS, 0x1);       
    }
    else
    {
        putValue(eMF_Schluessel_scanS, 0x0);
        putValue(eMF_SummerS, 0x0);
    }

//    writeProfileInt("Settings", "eFunctionMFG", getValue(eFunctionMFG), file);
}

on envVar eFunctionMotor
{
    if( getValue(this))
    {
        putValue(eTSK_Status_AnzeigeS, 0x3);        
        putValue(eWIV_Anzeige_aktivS, 0x1);      
        putValue(eWIV_Oelsystem_aktivS, 0x1);   
    }
    else
    {
        putValue(eTSK_Status_AnzeigeS, 0x0);
        putValue(eWIV_Anzeige_aktivS, 0x0);      
        putValue(eWIV_Oelsystem_aktivS, 0x0);   
    }
    
//    writeProfileInt("Settings", "eFunctionMotor", getValue(eFunctionMotor), file);   
}

on envVar eFunctionPLA
{
    if( getValue(this))
    {
        putValue(ePLS_Lenk_Aktiv_HinweisS, 0x1);
        putValue(ePLS_Pos_OKS ,0x1);
        putValue(ePLS_Mehrzg_AktivS, 0x1);       
    }
    else
    {
        putValue(ePLS_Lenk_Aktiv_HinweisS, 0x0);
        putValue(ePLS_Pos_OKS ,0x0);
        putValue(ePLS_Mehrzg_AktivS, 0x0);        
    }

//    writeProfileInt("Settings", "eFunctionPLA", getValue(eFunctionPLA), file);
}

on envVar eFunctionRDK
{
   if( getValue(this))
   {
        putValue(eRDK_FMVSS138_LampeS, 0x1);
        putValue(eRDK_Warnungen_02s, 19);   
   }
   else
   {
        putValue(eRDK_FMVSS138_LampeS, 0x0);
        putValue(eRDK_Warnungen_02s, 0);        
   }
//   writeProfileInt("Settings", "eFunctionRDK", getValue(eFunctionRDK), file);
}

on envVar eFunctionRKA
{
    if( getValue(this))
    {
        putValue(eRKA_Warnungen_02S, 0x1);                      
    }
    else
    {
        putValue(eRKA_Warnungen_02S, 0x0);                      
    }

//    writeProfileInt("Settings", "eFunctionRKA", getValue(eFunctionRKA), file);
}

on envVar eFunctionSMLS
{
    if( getValue(this))
    {
        putValue(eFAS_TasterS, 0x1);
    }
    else
    {
        putValue(eFAS_TasterS, 0x0);
    }
        
//    writeProfileInt("Settings", "eFunctionSMLS", getValue(eFunctionSMLS), file);
}

on envVar eFunctionSTS
{
    if( getValue(this))
    {        
        putValue(eSTS_TexteS, 0); 
        putValue(eSTS_AnlassersperreS, 0x1);       
    }
    else
    {        
        putValue(eSTS_TexteS, 14);     
        putValue(eSTS_AnlassersperreS, 0x0);        
    }

//    writeProfileInt("Settings", "eFunctionSTS", getValue(eFunctionSTS), file);           
}

on envVar eFunctionSWA
{
    if( getValue(this))
    {
        putValue(eSWA_Sta_aktivS, 0x1);        
    }
    else
    {
        putValue(eSWA_Sta_aktivS, 0x0);       
    }
//    writeProfileInt("Settings", "eFunctionSWA", getValue(eFunctionSWA), file);
}

on envVar eFunctionTCO
{  
    if( getValue(this))
    {
        putValue(eTCO_FahrerkennS, 0x0);
        putValue(eTCO_Vehicle_SpeedS, 0x0);
    }

//    writeProfileInt("Settings", "eFunctionTCO", getValue(eFunctionTCO), file);  
}

on envVar eFunctionTSG_FT
{
    if( getValue(this))
    {
        putValue(eFT_Kisi_FehlerS, 0);
    }
        
//    writeProfileInt("Settings", "eFunctionTSG_FT", getValue(eFunctionTSG_FT), file);
}

on envVar eFunctionWBA
{
    if( getValue(this))
    {
        putValue(eWBA_Segeln_aktivS, 0x1);                
    }
    else
    {
        putValue(eWBA_Segeln_aktivS, 0x0);        
    }

//    writeProfileInt("Settings", "eFunctionWBA", getValue(eFunctionWBA), file);        
}


on envVar eStartup_HVLM
{
   if( getValue(this))
   {     
        putValue(eSendHVLM_05, 0x1);
   }
   else
   {    
        putValue(eSendHVLM_05, 0x0);
   }
//   writeProfileInt("Settings", "eStartup_HVLM", getValue(eStartup_HVLM), file);
}


on envVar eStartup_Reichweite
{
   if( getValue(this))
   {     
        putValue(eSendReichweite_01, 0x1);
        putValue(eSendReichweite_02, 0x1);
   }
   else
   {    
        putValue(eSendReichweite_01, 0x0);
        putValue(eSendReichweite_02, 0x0);
   }
//   writeProfileInt("Settings", "eStartup_Reichweite", getValue(eStartup_Reichweite), file);
}
