on message ExampleMessage
{
    int value; 
    value & 0x0FFF; // clears all unnecessary bits    
}