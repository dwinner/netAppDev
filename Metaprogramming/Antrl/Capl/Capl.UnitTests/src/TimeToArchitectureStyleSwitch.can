/*@@var:*/
variables
{
    const int   iNumArchStyles = 3;
    
    int   i, k;

    int   iMeasureState = 0;//0 = Wait for panel change, 1 = wait for CAN change
    int   iOldState;
    int   iCurState;

    float fSwitchTime;
    float fSwitchTimeSum[iNumArchStyles][iNumArchStyles];
    float fSwitchTimeMin[iNumArchStyles][iNumArchStyles];
    float fSwitchTimeMax[iNumArchStyles][iNumArchStyles];
    float fSwitchTimeCnt[iNumArchStyles][iNumArchStyles];  
    float fSwitchTimeAvg[iNumArchStyles][iNumArchStyles];   

    dword ttwStartTime;// measurement start time
    dword ttwEndTime;  // measurement end time
    
    msTimer tPanelChkTimer;
}
/*@@end*/

/*@@key:'t':*/
on key 't'
{
    write("Initialize measurement");

    // Initialize measurement arrays
    for(i=0; i<iNumArchStyles; i++)
    {
        for(k=0; k<iNumArchStyles; k++)
        {
            fSwitchTimeSum[i][k] = 0.0;
            fSwitchTimeCnt[i][k] = 0.0;
            fSwitchTimeAvg[i][k] = 0.0;
            fSwitchTimeMin[i][k] = 10000000.0;
            fSwitchTimeMax[i][k] = 0.0;
        } 
    }

    // IngitionState = RUN, Speed and RPM non-zero
    putValue(Env_Ign_Switch, 3);
    putValue(Env_VehSpd_X, 150);
    putValue(Env_EngRPM, 2000);

    // Select TRADITIONAL-CLASSIC
    while(getValue(HMI_IC_DesignVar_Rq) != 0)
    {
        putValue(HMI_IC_DesignVar_Rq, 0); // Set to TRADITIONAL-CLASSIC
        putValue(Env_HU_Config_AutoSync_Trigger, 1);
        putValue(Env_HU_Config_AutoSync_Trigger, 0);      
    }

    // Set old arch.-style TRADITIONAL-CLASSIC
    iOldState= 0;

    // Start 10ms timer
    setTimer(tPanelChkTimer, 10);


}
/*@@end*/

/*@@startStart:Start:*/
on start
{
    putValue(Env_Ign_Switch, 3);
    putValue(Env_VehSpd_X, 150);
    putValue(Env_EngRPM, 2000);
    putValue(HMI_IC_DesignVar_Rq, 0); // Set to TRADITIONAL-CLASSIC
}
/*@@end*/

/*@@timer:tPanelChkTimer:*/
on timer tPanelChkTimer
{
    iCurState = getValue(HMI_IC_DesignVar_Rq);


    if(iCurState != iOldState && iMeasureState == 0)
    {// Panel setting changed and mode was "check panel entry"
        iMeasureState = 1; // mode is "check CAN state" 
        ttwStartTime = timeNow();
        write("Arch.-Style changed -> waiting for CAN Signal");
    }
    else
    {// No change, restart timer
        setTimer(tPanelChkTimer, 10);
    }

}
/*@@end*/

/*@@changeSignal:HIL_IC_Style:*/
on signal HIL_IC_Style
{
    write("Change in HIL_IC_Style detected");

    if(iMeasureState == 1) // mode is "check CAN state" 
    {
        write("Measure switching time");

        ttwEndTime  = timeNow();
        fSwitchTime = (float) ( ttwEndTime - ttwStartTime ) / 100.0;
        
        iCurState = getValue(HMI_IC_DesignVar_Rq);
        if(fSwitchTime < fSwitchTimeMin[iOldState][iCurState]) fSwitchTimeMin[iOldState][iCurState] = fSwitchTime;
        if(fSwitchTime > fSwitchTimeMax[iOldState][iCurState]) fSwitchTimeMax[iOldState][iCurState] = fSwitchTime;
        fSwitchTimeSum[iOldState][iCurState] += fSwitchTime;
        fSwitchTimeCnt[iOldState][iCurState] += 1.0;
        fSwitchTimeAvg[iOldState][iCurState] = fSwitchTimeSum[iOldState][iCurState] / fSwitchTimeCnt[iOldState][iCurState];

        write("Switch time %2d -> %2d is Cur %6.2f Min %6.2f Avg %6.2f Max %6.2f", iOldState, 
                                                                                   iCurState, 
                                                                                   fSwitchTime, 
                                                                                   fSwitchTimeMin[iOldState][iCurState], 
                                                                                   fSwitchTimeAvg[iOldState][iCurState], 
                                                                                   fSwitchTimeMax[iOldState][iCurState]);

        iOldState = iCurState;
        iMeasureState = 0; // mode is "check panel entry"
        setTimer(tPanelChkTimer, 10); // restart 10ms timer
    }

}
/*@@end*/

/*@@key:'p':*/
on key 'p'
{
    // Print measurement arrays
    write("Print Results\n\n");

    for(i=0; i<iNumArchStyles; i++)
    {
        for(k=0; k<iNumArchStyles; k++)
        {
            if(i == k) continue;

            write("Switch time %2d -> %2d is Cnt %4.0f / Min %6.2f ms / Max %6.2f ms / Avg %6.2f ms", i, 
                                                                                                      k, 
                                                                                                      fSwitchTimeCnt[i][k], 
                                                                                                      fSwitchTimeMin[i][k], 
                                                                                                      fSwitchTimeMax[i][k], 
                                                                                                      fSwitchTimeAvg[i][k]);
        } 
    }
}
/*@@end*/

/*@@changeSignal:Meas_IC_5F:*/
on signal Meas_IC_5F
{
    write("Change in Meas_IC_5F detected--->");
    
    if(iMeasureState == 1) // mode is "check CAN state" 
    {
        write("Measure switching time");

        ttwEndTime  = timeNow();
        fSwitchTime = (float) ( ttwEndTime - ttwStartTime ) / 100.0;
        
        iCurState = getValue(HMI_IC_DesignVar_Rq);
        if(fSwitchTime < fSwitchTimeMin[iOldState][iCurState]) fSwitchTimeMin[iOldState][iCurState] = fSwitchTime;
        if(fSwitchTime > fSwitchTimeMax[iOldState][iCurState]) fSwitchTimeMax[iOldState][iCurState] = fSwitchTime;
        fSwitchTimeSum[iOldState][iCurState] += fSwitchTime;
        fSwitchTimeCnt[iOldState][iCurState] += 1.0;
        fSwitchTimeAvg[iOldState][iCurState] = fSwitchTimeSum[iOldState][iCurState] / fSwitchTimeCnt[iOldState][iCurState];

        write("Switch time %2d -> %2d is Cur %6.2f Min %6.2f Avg %6.2f Max %6.2f", iOldState, 
                                                                                   iCurState, 
                                                                                   fSwitchTime, 
                                                                                   fSwitchTimeMin[iOldState][iCurState], 
                                                                                   fSwitchTimeAvg[iOldState][iCurState], 
                                                                                   fSwitchTimeMax[iOldState][iCurState]);

        iOldState = iCurState;
        iMeasureState = 0; // mode is "check panel entry"
        setTimer(tPanelChkTimer, 10); // restart 10ms timer
    }

}
/*@@end*/

/*@@changeSignal:Meas_IC_5G:*/
on signal Meas_IC_5G
{            
    write("Change in Meas_IC_5G detected--->");

    if(iMeasureState == 1) // mode is "check CAN state" 
    {
        write("Measure switching time");

        ttwEndTime  = timeNow();
        fSwitchTime = (float) ( ttwEndTime - ttwStartTime ) / 100.0;
        
        iCurState = getValue(HMI_IC_DesignVar_Rq);
        if(fSwitchTime < fSwitchTimeMin[iOldState][iCurState]) fSwitchTimeMin[iOldState][iCurState] = fSwitchTime;
        if(fSwitchTime > fSwitchTimeMax[iOldState][iCurState]) fSwitchTimeMax[iOldState][iCurState] = fSwitchTime;
        fSwitchTimeSum[iOldState][iCurState] += fSwitchTime;
        fSwitchTimeCnt[iOldState][iCurState] += 1.0;
        fSwitchTimeAvg[iOldState][iCurState] = fSwitchTimeSum[iOldState][iCurState] / fSwitchTimeCnt[iOldState][iCurState];

        write("Switch time %2d -> %2d is Cur %6.2f Min %6.2f Avg %6.2f Max %6.2f", iOldState, 
                                                                                   iCurState, 
                                                                                   fSwitchTime, 
                                                                                   fSwitchTimeMin[iOldState][iCurState], 
                                                                                   fSwitchTimeAvg[iOldState][iCurState], 
                                                                                   fSwitchTimeMax[iOldState][iCurState]);

        iOldState = iCurState;
        iMeasureState = 0; // mode is "check panel entry"
        setTimer(tPanelChkTimer, 10); // restart 10ms timer
    }

}
/*@@end*/

