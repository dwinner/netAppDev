/*@!Encoding:1252*/
variables
{
  float Umdrehung           = 0;
  float Umdrehungen_1s      = 0;
  float Umdrehungen_tUpdate = 0;
  float Strecke_tUpdate     = 0;
  float Strecke_ges         = 0;
  float Wegimpuls_einzeln   = 0;
  float Wegimpuls_ges       = 0;
}

on message ESP_24
{
  if (@Timeout_Wegimpuls == 0)
  {
    if ($ESP_Zaehnezahl != 0 && $ESP_m_Raddrehz.raw <= 32639)
    {    
      // Anzahl der Umdrehungen in 1s (Frequenz)
      Umdrehungen_1s = $ESP_m_Raddrehz;
      
      // Anzahl der Umdrehungen pro Updatezyklus
      Umdrehungen_tUpdate = Umdrehungen_1s / 1000 * @IL_CAN1::Message_NormalCyclePeriod::ICAS1_Gateway_ESP_24;
      
      // Berechnung der einzelnen Wegimpulse
      Wegimpuls_einzeln= Umdrehungen_tUpdate * $ESP_Zaehnezahl *2;
      
      // Aufsummierung der Wegimpulse
      Wegimpuls_ges = Wegimpuls_ges + Wegimpuls_einzeln;
          
      // Überlaufbit setzen & Wert ruecksetzen (Rest behalten)
      if (Wegimpuls_ges > 2048)
      {
        $ESP_Wegimp_Ueberlauf = 1;
        Wegimpuls_ges = Wegimpuls_ges - 2048;
      }
      //writelineex(4,0,"Wegimpuls_ges: %f",Wegimpuls_ges);
      $ESP_Wegimp_VA = Wegimpuls_ges;
   }
  }
}