/*@!Encoding:1252*/
includes
{
  
}

variables
{
  int SB_Led, SB_Led_PrewState = 0, SB_LED_State,SB_Led_Start = 0;
  int LED_transitions, ResetValues;
  int Phase = 0, WarningLevel, Enable_Phase1Time;
  int WarningLevel1, WarningLevel2, SoundRqTime = 0;
  int BeepCounter = 0, DetectPhase1Time = 0, SBWarningOn = 0;
  int SBWarnPh[7], PhaseIndex;
  
  float TimeSinceChange, ChangeStart;
  ////////////////////////////////////////////////////////////////////////////
  // SB_Warning_Phase_Time first index:                                     //
  //   - 0 - not used                                                       //
  //   - 1-4 for Phase 1-4                                                  //
  //   - 5 - for Legal warning                                              //
  //   - 6 - used temporary, until the Seatbelt warning phase is detected   //
  // SB_Warning_Phase_Time second index:                                    //
  //   - 0 - used for Seatbelt warning phase duration                       //
  //   - 1 - counter for sound events                                       //
  //   - 2 - sum of silence time between sounds and Average cycle time      //
  ////////////////////////////////////////////////////////////////////////////
  float SB_Warning_Phase_Time [7][3];
  float Sound_Period, Sound_Start, Sound_Off, Sound_Off_Start;
  float SoundTime = -1, SoundTimeOld;
    
  msTimer Phase1Timer, LED_On_timer, SoundOffTimer, SoundOnTimer;
}

on message Meas_IC_4
{
  int AcoustSeatBeltWarningWIMRq;


    switch( this.HIL_LayoutNumber)
    {

        case 0x16:
                    /* MESS_IC4 (LV 0x16) - Acoustics */
 
                    WarningLevel1 = this.HIL_AcoustSeatBeltWarniLvl1.phys;
                    WarningLevel2 = this.HIL_AcoustSeatBeltWarniLvl2.phys;
        
                    AcoustSeatBeltWarningWIMRq = this.HIL_AcoustSeatBeltWarniLvl1WIMRq.phys;
                    if (!AcoustSeatBeltWarningWIMRq)
                    {
                      AcoustSeatBeltWarningWIMRq = this.HIL_AcoustSeatBeltWarniLvl2WIMRq.phys;
                    }

                    if(!SoundRqTime)
                    {
                      if (AcoustSeatBeltWarningWIMRq)
                      {
                        SoundRqTime = 1;
                        SoundTime = timeNowFloat();
                        //write("Time: %f",SoundTime);
                        setTimer(SoundOnTimer,120);
                      } 
                    }
                          
                    if (SoundRqTime && (WarningLevel1 || WarningLevel2)&& AcoustSeatBeltWarningWIMRq) /*WarningLevel1 || WarningLevel2*/
                    {
                      GetSeatBeltWarningPhase();
                      SoundRqTime = 0;
                    }
                    
                    if(!AcoustSeatBeltWarningWIMRq && !WarningLevel1 && !WarningLevel2 && SBWarningOn) /*!WarningLevel1 && !WarningLevel2*/
                    {
                      SBWarningOn = 0;
                      
                      //write("WarningLevel1 && WarningLevel2 are OFF");
                      if(timeToElapse(SoundOffTimer) == -1)
                      {
                        //write("Start SoundOffTimer");
                        setTimer(SoundOffTimer,2100);
                      }
                     }
                   
                    if (!SBWarningOn && (WarningLevel > 1))
                    {
                      Sound_Off = (timeNowFloat() - SoundTimeOld)/100;
                      //write("SB acustics off!");
                      BeepCounter = 0;
                      Sound_Period = 0;
                      DetectPhase1Time = 0;
                      if (SB_LED_State < 2)
                        WarningLevel = 0;
                      CalculateWarningPhaseTime();
                    }
                    
                    putValue(env_SeatBeltWarning_Phase, WarningLevel);
                    putValue(env_Sound_Off_Time, Sound_Off);
                    break;
     }
}

on envVar env_GetTime
{
  float silence = 999999;
  
  if(getValue(this))
  {
      putValue(env_Time_from_last_Sound, silence);
      if (SoundTime != -1)
        {
        silence = (timeNowFloat() - SoundTime)/100;
        if (silence > 999999) silence = 999999;
        putValue(env_Time_from_last_Sound, silence);
        }
  }  
}

void CalculateWarningPhaseTime()
{
    //write("calculate the warning phase time");
    for(PhaseIndex=0;PhaseIndex<6;PhaseIndex++)
    {
      //write("Index %d; current Warning level %d; Phase Status %d", PhaseIndex, WarningLevel, SBWarnPh[PhaseIndex]);
      if((WarningLevel != PhaseIndex) && (SBWarnPh[PhaseIndex] == 1))                                 //Seatbelt Warning Phase ended
      {
        SB_Warning_Phase_Time[PhaseIndex][0] = (SoundTimeOld - Sound_Start)/100;
        //write("Phase %d ended! Time (%f / %f)", PhaseIndex, SB_Warning_Phase_Time[PhaseIndex][2], SB_Warning_Phase_Time[PhaseIndex][1]);
        
        if(SB_Warning_Phase_Time[PhaseIndex][1]>0) SB_Warning_Phase_Time[PhaseIndex][2] = SB_Warning_Phase_Time[PhaseIndex][2]/SB_Warning_Phase_Time[PhaseIndex][1];
        //write("Phase %d ended! Time %f (%f - %f)", PhaseIndex, SB_Warning_Phase_Time[PhaseIndex][0], SoundTimeOld, Sound_Start);
        Sound_Start = SoundTimeOld;
        SBWarnPh[PhaseIndex] = 2;
      }
    }
    //set env variable

    if(SBWarnPh[5] != 1)                                                            //Seatbelt Warning Legal
    {
      putValue(env_Legal_Time,  SB_Warning_Phase_Time[5][0]);
      putValue(env_Legal_NoOfBeeps,  SB_Warning_Phase_Time[5][1]);
      putValue(env_Legal_AvgCycleTime,  SB_Warning_Phase_Time[5][2]);
    }
    else
    {
      putValue(env_Legal_NoOfBeeps,  SB_Warning_Phase_Time[5][1]);
      putValue(env_Legal_Time,  SB_Warning_Phase_Time[5][2]);
    }
    if(SBWarnPh[1] != 1)                                                            //Seatbelt Warning Phase1
    {
      putValue(env_Phase1_Time, SB_Warning_Phase_Time[1][0]);
      putValue(env_Phase1_NoOfBeeps,  SB_Warning_Phase_Time[1][1]);
      putValue(env_Phase1_AvgCycleTime,  SB_Warning_Phase_Time[1][2]);
    }
    else
    {
      putValue(env_Phase1_NoOfBeeps,  SB_Warning_Phase_Time[1][1]);
      putValue(env_Phase1_Time,  SB_Warning_Phase_Time[1][2]);
    }
    if(SBWarnPh[2] != 1)                                                            //Seatbelt Warning Phase2
    {
      putValue(env_Phase2_Time, SB_Warning_Phase_Time[2][0]);
      putValue(env_Phase2_NoOfBeeps,  SB_Warning_Phase_Time[2][1]);
      putValue(env_Phase2_AvgCycleTime,  SB_Warning_Phase_Time[2][2]);
    }
    else
    {
      putValue(env_Phase2_NoOfBeeps,  SB_Warning_Phase_Time[2][1]);
      putValue(env_Phase2_Time,  SB_Warning_Phase_Time[2][2]);
    }
    if(SBWarnPh[3] != 1)                                                            //Seatbelt Warning Phase3
    {
      putValue(env_Phase3_Time, SB_Warning_Phase_Time[3][0]);
      putValue(env_Phase3_NoOfBeeps,  SB_Warning_Phase_Time[3][1]);
      putValue(env_Phase3_AvgCycleTime,  SB_Warning_Phase_Time[3][2]);
    }
    else
    {
      putValue(env_Phase3_NoOfBeeps,  SB_Warning_Phase_Time[3][1]);
      putValue(env_Phase3_Time,  SB_Warning_Phase_Time[3][2]);
    }
    if(SBWarnPh[4] != 1)                                                            //Seatbelt Warning Phase4  
    {
      putValue(env_Phase4_Time, SB_Warning_Phase_Time[4][0]);
      putValue(env_Phase4_NoOfBeeps,  SB_Warning_Phase_Time[4][1]);
      putValue(env_Phase4_AvgCycleTime,  SB_Warning_Phase_Time[4][2]);
    }
    else
    {
      putValue(env_Phase4_NoOfBeeps,  SB_Warning_Phase_Time[4][1]);
      putValue(env_Phase4_Time,  SB_Warning_Phase_Time[4][2]);    
    }

}

on message Meas_IC_1
{
  SB_Led = this.HIL_ControlLampSeatbelts;
  
  DetectLEDBehavior();
}

void DetectLEDBehavior()
{
  float time, timeOld;
  float SeatBeltLED_OnPhase, SeatBeltLED_OffPhase;
  float DutyCycle, Frequency, SumDC, SumFreq;
  float SB_Led_AvgDC, SB_Led_AvgFreq, SB_LED_AvgSamplels;
  int SB_LED_OldState;
  
  if(SB_Led - SB_Led_PrewState != 0)
  {
    setTimer(LED_On_timer, 1500);             //at signal transition start the detection timer
    LED_transitions++;
    SB_LED_State = 3;
  
    if((timeToElapse(LED_On_timer) != -1) &&(LED_transitions > 2))           
    {
     SB_LED_State = 2;          //Seat belt LED is asumed BLINKING if a transition occurs during the 2000ms timer 
    }
    //write(" A SB LED transition is detected; SB_LED_State is %d; LED signal transitions: %d",SB_LED_State, LED_transitions);
    //write(" A SB LED transition is detected; SB_Led_Start is %d",SB_Led_Start);
    SB_Led_PrewState = SB_Led;
    time = timeNowFloat();
    if(SB_Led_Start)
    {
      if (SB_Led)
      {
        SeatBeltLED_OffPhase = (time - timeOld)/100;
        if (SeatBeltLED_OffPhase > 999999) SeatBeltLED_OffPhase = 999999;     //to limit the value to maximum
      }
      else
      {
        SeatBeltLED_OnPhase = (time - timeOld)/100;
        if (SeatBeltLED_OnPhase > 999999) SeatBeltLED_OnPhase = 999999;     //to limit the value to maximum
      }
      timeOld = time;
    }
    else
    {
      SB_Led_Start=1;
      timeOld = time;
    } 
  } 
  
  if((SB_LED_State - SB_LED_OldState != 0) && (SB_LED_OldState != 3))                  // Check LED behavior change
  {
    ChangeStart = time;
    TimeSinceChange = 0;
    if((SB_LED_State == 3) && (SB_LED_OldState == 0) && (ResetValues == 1))  //LED change from OFF and SoundOffTimer expired => warning ended
    {
      Reset_SB_WarningParameters();
    }

    //write("LED state transition detected (%f)",ChangeStart);
  }
  
  TimeSinceChange = (timeNowFloat() - ChangeStart)/100;
  if(TimeSinceChange > 999999) TimeSinceChange = 999999;                    //Limit the value 
  
  //write("TimeSinceChange: %f", TimeSinceChange);
  SB_LED_OldState = SB_LED_State;
  
  if(SB_LED_State == 2)
  {
    //Seat belt LED is BLINKING
    DutyCycle = SeatBeltLED_OnPhase*100/(SeatBeltLED_OnPhase + SeatBeltLED_OffPhase);
    Frequency = 1000/(SeatBeltLED_OnPhase + SeatBeltLED_OffPhase);
    SB_LED_AvgSamplels++;
    SumDC = SumDC + DutyCycle;
    SumFreq = SumFreq + Frequency;
    if(SB_LED_AvgSamplels>0)
    {
      SB_Led_AvgDC = SumDC / SB_LED_AvgSamplels;
      SB_Led_AvgFreq = SumFreq / SB_LED_AvgSamplels;
      
    }
    //write("SB Led is blinking, f=%f DC: %f", Frequency, DutyCycle);
  }
  else
  {
    DutyCycle = 0;
    Frequency = 0;
    SumDC = 0;
    SumFreq = 0;
    SB_LED_AvgSamplels = 0;
  }
  putValue(env_LampSeatbelts, SB_LED_State);
  putValue(env_DutyCycle, DutyCycle);
  putValue(env_Frecquency,Frequency);
  putValue(env_AvgDutyCycle, SB_Led_AvgDC);
  putValue(env_AvgFrecquency,SB_Led_AvgFreq);
  putValue(env_Lamp_Time, TimeSinceChange);
  putValue(env_ON_time, SeatBeltLED_OnPhase);
  putValue(env_OFF_time, SeatBeltLED_OffPhase);
}

void GetSeatBeltWarningPhase()
{
  SBWarningOn = 1;
  BeepCounter++;
  cancelTimer(SoundOffTimer);
  
  //write("Warning check-------------------- beep counter %d", BeepCounter);    
 
  if(BeepCounter > 1)
  {
    Sound_Period = (SoundTime - SoundTimeOld)/100;
    
    if (SB_LED_State == 2)
    {
      if (Sound_Period < 5800)
      {
        if (Sound_Period < 2600)
        {
          if (Sound_Period < 1400)
          {
            if (Sound_Period < 750) WarningLevel = 4;                      //SB warning Phase 4
            else WarningLevel = 3;                                         //SB warning Phase 3
          }
          else WarningLevel = 2;                                           //SB warning Phase 2
        }
        else WarningLevel = 1;                                             //SB warning Phase 1
      }
      else WarningLevel = 4;                                               //SB warning Phase 4
    }
    else
    {
      if ((SB_LED_State == 1) && !WarningLevel2)                      //Legal warning state {if ((SBWarningOn == 1) && (SB_LED_State == 1))}
      {
        WarningLevel = 5;
      }
    }
  }
  else
  {
    if((Enable_Phase1Time == 0) && (WarningLevel == 0 ))
    {
      //write("====== start Phase1 timer ===========");
      Enable_Phase1Time = 1;
      //WarningLevel = 6;
      WarningLevel = 0;
      Sound_Start = SoundTime;                                           //no warning phase is active => set sound start time
      setTimer(Phase1Timer, 2600);
    }
  }
  
  //Set flag for current warning level
  if(SBWarnPh[WarningLevel] == 0) SBWarnPh[WarningLevel] = 1;
  
  if(Sound_Period > 0)
  {
    SB_Warning_Phase_Time[WarningLevel][1]++;
    SB_Warning_Phase_Time[WarningLevel][2] += Sound_Period;
    if(WarningLevel != 6)
    {
      SB_Warning_Phase_Time[WarningLevel][1] += SB_Warning_Phase_Time[6][1];
      SB_Warning_Phase_Time[WarningLevel][2] += SB_Warning_Phase_Time[6][2];
      SB_Warning_Phase_Time[6][1] = 0;
      SB_Warning_Phase_Time[6][2] = 0;
    }
  }
  else
  {
    if (WarningLevel == 4) SB_Warning_Phase_Time[4][2] += Sound_Off;
  }
  
  CalculateWarningPhaseTime();
  
  SoundTimeOld = SoundTime;
  if((WarningLevel > 0) && (WarningLevel < 6)) 
  {
    putValue(env_Sound_Period, Sound_Period);
  }

    
  //write("Acustic perod: %f ",Sound_Period);
  //write("Seatbelt Warning Phase %d; no of beeps: %f sum of periods %f",WarningLevel, SB_Warning_Phase_Time[WarningLevel][1], SB_Warning_Phase_Time[WarningLevel][2]);
}

on envVar StartMeasurement
{
float time_now, deltaTime;
  if(getValue(this))
  {   
    time_now = timeNowFloat();
    deltaTime = SB_Warning_Phase_Time[WarningLevel][2] + (time_now - SoundTimeOld)/100;
    
    TimeSinceChange = (time_now - ChangeStart)/100;
    if(TimeSinceChange > 999999) TimeSinceChange = 999999;                    //Limit the value 
    
    switch (WarningLevel)
    {
      case 1: putValue(env_Phase1_Time,  deltaTime);
        break;
      case 2: putValue(env_Phase2_Time,  deltaTime);
        break;
      case 3: putValue(env_Phase3_Time,  deltaTime);
        break;
      case 4: putValue(env_Phase4_Time,  deltaTime);
        break;
      case 5: putValue(env_Legal_Time,  deltaTime);
    }
    putValue(env_Lamp_Time, TimeSinceChange);

  }
}

on timer Phase1Timer
{
  Enable_Phase1Time = 0;
  
  if(BeepCounter < 2)
  {
    WarningLevel = 1;
    //write("  ===   SB Warning Phase1 detected!!!!   ===");
  }
  //write("------------------------------------------   Phase1 timer ended!");
}

on timer SoundOnTimer
{
  SoundRqTime = 0;
}

on timer LED_On_timer
{
  SB_LED_State = SB_Led;
  LED_transitions = 0;
}

on timer SoundOffTimer
{
  //write("Sound Off timer");
  SB_Warning_Phase_Time[WarningLevel][1]--;
  WarningLevel = 0;
  CalculateWarningPhaseTime();
  BeepCounter = 0;
  Sound_Period = 0;
  DetectPhase1Time = 0;
  for(PhaseIndex=0;PhaseIndex<6;PhaseIndex++)
  {
    SBWarnPh[PhaseIndex] = 0;
  }
  ResetValues = 1;
}

void Reset_SB_WarningParameters()
{
  //write("Reset parameters");
  for(PhaseIndex=0;PhaseIndex<6;PhaseIndex++)
  {
    SB_Warning_Phase_Time[PhaseIndex][0] = 0;
    SB_Warning_Phase_Time[PhaseIndex][1] = 0;
    SB_Warning_Phase_Time[PhaseIndex][2] = 0;
  }
  ResetValues=0;

    putValue(env_Sound_Period, 0);
    putValue(env_DutyCycle, 0);
    putValue(env_Frecquency,0);
    putValue(env_AvgDutyCycle, 0);
    putValue(env_AvgFrecquency,0);
    putValue(env_Phase1_Time, 0);
    putValue(env_Phase1_NoOfBeeps, 0);
    putValue(env_Phase1_AvgCycleTime, 0);
    putValue(env_Phase2_Time, 0);
    putValue(env_Phase2_NoOfBeeps, 0);
    putValue(env_Phase2_AvgCycleTime, 0);
    putValue(env_Phase3_Time, 0);
    putValue(env_Phase3_NoOfBeeps, 0);
    putValue(env_Phase3_AvgCycleTime, 0);
    putValue(env_Phase4_Time, 0);
    putValue(env_Phase4_NoOfBeeps, 0);
    putValue(env_Phase4_AvgCycleTime, 0);
    putValue(env_Legal_Time, 0);
    putValue(env_Legal_NoOfBeeps, 0);
    putValue(env_Legal_AvgCycleTime, 0);
    putValue(env_Sound_Off_Time, 0);
}

on envVar env_Sound_Off_Time
{
  if(getValue(this) == 0)
    Sound_Off = 0;
}

