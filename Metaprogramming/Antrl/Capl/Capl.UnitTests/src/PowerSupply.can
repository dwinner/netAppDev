/*@!Encoding:1252*/
includes
{
  
}

/*
Command	Reply	Description	Comments for Voltcraft PPS-11810
GMOD\r	3204\rOK\r	Query model	Four-digit model code, e.g. 3202 for the HCS-3202.
GETD\r	VVVVCCCCS\rOK\r	Query displayed voltage, current and mode.	Four-digit voltage, e.g. 12.34; four-digit current, e.g. 12.34; status 0=constant voltage, 1=constant current.
SOUTn\r	OK\r	Disable output	Output on=0 (power-on default), off=1
SESS\r	OK\r	Disable keyboard	Seems to time out after about 5 seconds.
ENDS\r	OK\r	Enable keyboard	When disabled with SESS.
VOLTnnn\r	OK\r	Set voltage to nn.n.	
CURRnnn\r	OK\r	Set current to nn.n or n.nn (model-dependent!).	
*/

variables
{
  //defines
  //Comport that should be used (1 = COM1)
  int comport = 5;
  //Voltcraft Commands
  byte PowerSupply_On[5] = {'S','O','U','T','0'};
  int  PowerSupply_OnLength = 5;
  byte PowerSupply_Off[5] = {'S','O','U','T','1'};
  int  PowerSupply_OffLength = 5;
  byte PowerSupply_Voltage[7] = {'V','O','L','T','1','2','0'};//12.0V
  int  PowerSupply_VoltageLength = 7;
  byte byVoltage[3] = {'1','2','0'};//12.0V
  char copyVoltage[5] ="12.0";
  char chVoltage[4]="120";
  char buffer[100];
  byte PowerSupply_Value[4] = {'G','E','T','D'};
  int  PowerSupply_ValueLength = 4;
  msTimer PowerSupplyUpdateTimer ;
  byte mybuffer[20];
  int mybuffersize=20;
  byte receivebuffer[20];
  int receivesize=20;
  int PowerSupply_ValueRel = 0; 
  int index=0; 
  dword Time2E=0;
}

on start
{
  rs232Open(comport);
  rs232Configure(comport,9600,8,1,0);
  if ( 1==RS232Receive(5,receivebuffer,receivesize) )
  //write("Com 1 Receive configured");
  PowerSupply_setOff();
  PowerSupply_setVoltage();
  setTimer(PowerSupplyUpdateTimer,500);
  
}

on stopMeasurement
{
  Rs232Close(comport);
}
  
void PowerSupply_setOn()
{
  rs232WriteBlock(comport,PowerSupply_On,PowerSupply_OnLength);
  rs232WriteByte(comport,13); 
  Time2E =timenow();
  Time2E = Time2E*0.01;
  write("Power Supply state - ON - %ld ",Time2E);
  //RS232Send(comport,PowerSupply_On,PowerSupply_OnLength);

}
  
void PowerSupply_setOff()
{
   rs232WriteBlock(comport,PowerSupply_Off,PowerSupply_OffLength);
   rs232WriteByte(comport,13); 
   write("Power Supply state - OFF");
   //RS232Send(comport,PowerSupply_Off,PowerSupply_OffLength);
}

  
void PowerSupply_setVoltage()
{

  double  uiVoltage = 120;
 
  uiVoltage =@sysvar::PowerSupply::PowerSupply_voltage;
  //write("Power Supply Voltage - %f " ,uiVoltage);
  snprintf (copyVoltage,elcount(copyVoltage),"%f", uiVoltage);
  if (uiVoltage >=10)
    {
      chVoltage[0]= copyVoltage[0];
      chVoltage[1]= copyVoltage[1];
      PowerSupply_Voltage[4] = copyVoltage[0];
      chVoltage[2]= copyVoltage[3];
      PowerSupply_Voltage[5] = copyVoltage[1];
      chVoltage[3]= copyVoltage[4];
      PowerSupply_Voltage[6] = copyVoltage[3];
    }
  if (uiVoltage <10 && uiVoltage >= 1)
    {
      chVoltage[0]= copyVoltage[0];
      chVoltage[1]= copyVoltage[1];
      PowerSupply_Voltage[4] = (byte) ('0');
      chVoltage[2]= copyVoltage[3];
      PowerSupply_Voltage[5] = copyVoltage[0];
      chVoltage[3]= copyVoltage[4];
      PowerSupply_Voltage[6] = copyVoltage[2];
    }
  if(uiVoltage < 1)
   {
      chVoltage[0]= copyVoltage[0];
      chVoltage[1]= copyVoltage[1];
      PowerSupply_Voltage[4] = (byte) ('0');
      chVoltage[2]= copyVoltage[3];
      PowerSupply_Voltage[5] = (byte) ('0');
      chVoltage[3]= copyVoltage[4];
      PowerSupply_Voltage[6] = copyVoltage[2];
     
   }
    
  // write("Power Supply Voltage - %s " ,chVoltage);
  //write ("PowerSupply_Voltage Buffer:%c%c%c%c%c%c%c" , PowerSupply_Voltage[0], PowerSupply_Voltage[1], PowerSupply_Voltage[2], PowerSupply_Voltage[3], PowerSupply_Voltage[4], PowerSupply_Voltage[5], PowerSupply_Voltage[6]);
  //RS232Send(comport,PowerSupply_Voltage,PowerSupply_VoltageLength);
   rs232WriteBlock(comport,PowerSupply_Voltage,PowerSupply_VoltageLength);
   rs232WriteByte(comport,13); 
   //write("Power Supply Voltage - %s " ,chVoltage);
   
}

void PowerSupply_getCurrent()
{
   int x;
       
  RS232Send(comport,PowerSupply_Value,PowerSupply_ValueLength);
    rs232WriteByte(comport,13); 
   // write("getCurrent - Request Send");
    if ( 1==RS232Receive(comport,receivebuffer,receivesize) )
    {   
      //write("Request Send IO");
    }
    
    for(x = 0; x < 20; x++)
    {
      mybuffer[x] = ' ';
      //write("Ereas  mybuffer[%d]",x);
    }
    RS232OnReceive(comport,receivebuffer,receivesize);
    PowerSupply_ValueRel = 1;
    index=0;
}

RS232OnReceive(dword port, byte receivebuffer[], dword receivesize)
{
   int x;
   char pmybuffer[8];
   char pmyvoltagebuffer[5]; 
   char pmycurrentbuffer[5];
   double voltage=0;
   double current=0;
   char test[5]="123";
  
  if (5 == port && receivesize < 20 && index<8 )
  { 
    //write ("myBuffer before:%c%c%c%c%c%c%c%c%c" ,mybuffer[0],mybuffer[1],mybuffer[2],mybuffer[3],mybuffer[4],mybuffer[5],mybuffer[6],mybuffer[7],mybuffer[8]);   
    for(x = 0; x < receivesize; x++)
    {
      mybuffer[x+index] = receivebuffer[x];
    // write ("receivebuffer: %d",receivebuffer[x]);
    }
    
    index=index+receivesize;
    //write ("Receivesize: %d",receivesize);
    //write("Index:%d", index);
    
    if (index>=8)
    { 
     // write ("PowerSupply Status:%c%c.%c%c [V]    %c%c.%c%c [A]" ,mybuffer[0],mybuffer[1],mybuffer[2],mybuffer[3],mybuffer[4],mybuffer[5],mybuffer[6],mybuffer[7],mybuffer[8]);
      pmyvoltagebuffer[0]= mybuffer[0];
      pmyvoltagebuffer[1]= mybuffer[1];
      pmyvoltagebuffer[2]= '.';
      pmyvoltagebuffer[3]= mybuffer[2];
      pmyvoltagebuffer[4]= mybuffer[3];
      pmycurrentbuffer[0]= mybuffer[4];
      pmycurrentbuffer[1]= mybuffer[5];
      pmycurrentbuffer[2]= '.';
      pmycurrentbuffer[3]= mybuffer[6];
      pmycurrentbuffer[4]= mybuffer[7]; 
      //write ("Pmyvoltagebuffer:%c%c%c%c [V]    %c%c%c%c [A]" , pmyvoltagebuffer[0], pmyvoltagebuffer[1], pmyvoltagebuffer[2], pmyvoltagebuffer[3],mybuffer[4],mybuffer[5],mybuffer[6],mybuffer[7],mybuffer[8]);
      voltage = atodbl(pmyvoltagebuffer);
      @sysvar::PowerSupply::PowerSupply_voltage_get = voltage;
     // voltage = voltage*10;
      //write("Voltage new: %.2f\n" ,voltage); //Truncated to 2 decimals after point
      current = atodbl(pmycurrentbuffer);
      @sysvar::PowerSupply::PowerSupply_current_get = current;
      //current = current * 10;
      //write("Current new: %.2f" ,current);//mA
    }
    }
  
}

on timer PowerSupplyUpdateTimer
 {
  PowerSupply_getCurrent();
   setTimer(PowerSupplyUpdateTimer,50);
 }

on sysvar_update PowerSupply::PowerSupply_state
{
  int state;
  state = @sysvar::PowerSupply::PowerSupply_state;
  
  if(state == 0)
    PowerSupply_setOff();
  else
    PowerSupply_setOn();
}

on sysvar_update PowerSupply::PowerSupply_voltage
 {
  PowerSupply_setVoltage();
 }
  

on key 'a'
{
  PowerSupply_setOn();
}
 
on key 'y'
{
  PowerSupply_setOff();
}
