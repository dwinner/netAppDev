/*@!Encoding:1252*/
variables
{
  //
  // Constants
  //
  const dword  IPV6_STR_SIZE         = 40;
  
  //
  // Global variables
  //  
  byte    gActiveStream = 0;  // Flag to indicate that a stream is active
  
  char    kPanelName[15] = "VideoStreaming";
  char    gIPv6TargetAddrStr[IPV6_STR_SIZE];
  
  dword   gTargetPort;
}

on sysvar EthVideoStreaming::BtnStartMpegTs
{
    if (@this == 0)
    return; 
    
    if (gActiveStream)
    {
      StreamingLog("Streaming: An active stream is already running.");
      return; 
    }
    else
    {
      gActiveStream = 1; 
      STREAM_lUploadTransportStream();
    }
   
}

on sysvar EthVideoStreaming::BtnStopStreaming
{
    
    long lRet;
    
    if (@this == 0)
    return;  
    
    if(!gActiveStream)
    {
      StreamingLog("Streaming: No active stream found.");
      return;
    }
    else
    {      
      lRet = sysExec("taskkill", "/f /im conhost.exe");
      if(lRet == 0)
        StreamingLog("Streaming: Failed to kill gst-launch-1.0.exe");      
      else  
      {
        gActiveStream = 0;
        StreamingLog("Streaming cancelled. Video will stop playing after one video loop."); 
      }
    }
  
}

// Return 1 - Success
//        0 - Failure
long STREAM_lUploadTransportStream(void)
{
  char sFile[255];      // file name
  char sPath[255];      // full path to video input file
  char sRootDir[255];   
  char sWorkDir[255];
  char sParam[512];     // parameter for calling gst-launch
  long lStat;
  long lRet;
  
  /* Get video file path from panel */    
  sysGetVariableString(sysvar::EthVideoStreaming::TSFilePath, sFile, elcount(sFile));
  
  /* get target IP and port */
  gTargetPort = @sysvar::EthVideoStreaming::TargetPort;
  sysgetVariableString( sysvar::EthVideoStreaming::TargetIP, gIPv6TargetAddrStr, elcount(gIPv6TargetAddrStr) );
  
  if (gTargetPort == 0)
  {
    lRet = 0;
    return lRet;
  }  
  
  /* Prepare parameters */ 
  getAbsFilePath("", sRootDir, 256);
  getAbsFilePath("Ethernet\\tool\\gstreamer\\1.0\\x86_64\\bin", sWorkDir, 256);

  snprintf(sPath, elcount(sPath),"\"%sEthernet\\Media\\%s\"", sRootDir, sFile);
  //StreamingLog("Attempt to stream from the following path:");
  //StreamingLog(sPath);
  
  snprintf(sParam, elcount(sParam), "%s %s %d", sPath, gIPv6TargetAddrStr, gTargetPort);
  StreamingLog(sParam);

  /* check if file is available */
  setFilePath("Ethernet\\Media\\", 0);  
  lStat = STREAM_lIsFileExist(sFile);
  if (lStat == 1)
  {
    lStat = sysExecCmd("VideoStream.bat", sParam, sWorkDir);
    lRet = 1;
    StreamingLog("Streaming started...");
  }
  else
  {
    StreamingLog("Streaming: File not exist");
    write("%FILE_NAME%: VideoStreaming(): Could not found file in the specified path");
    lRet = 0;
  }  
  
  return lRet;
}

// Return 1 - if file exist
//        0 - if file not exist
long STREAM_lIsFileExist(char sPath[])
{
  long lRet;
  dword fileHandle;

  fileHandle = openFileRead(sPath, 1);
  if (fileHandle == 0)
  {
    lRet = 0;
  }
  else
  {
    lRet = 1;
    fileClose(fileHandle);
  }
  return lRet;
}



// Function to log messages in output view of panel
void StreamingLog(char buf[])
{
  long tm[9];
  dword d;
  word ms, us, ns;
  char tempBuf[256];
  byte h, m, s;
  char str[256];

  /* Get date and time */
  getLocalTime(tm);
  convertTimestampNS(timeNowNS(), d, h, m, s, ms, us, ns);
  /* Prepare string */
  snprintf(tempBuf, elcount(tempBuf),
    "%.2d:%.2d:%.2d:%.3d - %s\n",
    tm[2], tm[1], tm[0], ms, buf);
  putValueToControl(kPanelName, "VidStreamOutput", tempBuf);
}

