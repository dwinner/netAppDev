/*@@var:*/
variables
{
    const byte NMH_StatePowerOn = 0;
    const byte NMH_StateStart = 1;
    const byte NMH_StateReadyToSleep = 2;
    const byte NMH_StateNormal = 3;
    const byte NMH_StatePrepareToSleep = 4;
    const byte NMH_StateSleep = 5;

    float HL_StartTime=0;
    float HL_StopTime=0;
    float HL_StopTimeActiveDisplay=0;
    float HL_MsgTime;

    const long HL_MAX_TIME=200000;
    byte TestActive=0;
    long ICOM_Msg_Received=0;

}
/*@@end*/

/*@@testcase:TestWakeupKL30():*/
testcase TestWakeupKL30 ()
{
  long Testresult=0;
    TestCaseTitle("TC 1.00", "Test: Measure of the Starttime after KL30 Reset");
    TestCaseDescription("Test case is used to measure the time between KL30 on and the first receiption from msg NMH_Kombi");

    TestStep("1.0", "Switch KL30 off, wait 2sec and switch KL30 to on ; Expected Result: KI starts and the receipt Time from the NMH_Kombi is <200ms "); // create neutral entry in report file
    
    SwitchKL30(0);
    write("Power Off wait 5sec");
    TestWaitForTimeout(5000); // 2sec warten   
    
    TestActive=1;      
    SwitchKL30(1);   
    HL_StartTime = timeNow(); //current time in useconds
    write("Power On -> Wait for Message");
    Testresult=TestWaitForMessage(Kombi_01, 5000);//warten auf Botschaft Timeout 2sec    
    
    switch(Testresult)
     {
      case 0:  TestStepFail("1.0", "Timeout no Msg received"); break;
      case -1: TestStepFail("1.0", "General error, for example, functionality is not available"); break;
      case -2: TestStepFail("1.0", " Resume due to constraint violation"); break;
      case 1:  /* Msg received!*/
               HL_MsgTime=((HL_StopTime-HL_StartTime)*10);
               if(HL_MsgTime > HL_MAX_TIME)
                  TestStepWarning ("1.0", "Measured Time is to long > %f us! NMH-Msg received Time %f",HL_MAX_TIME,HL_MsgTime); // reporting of passed action  
               else             
                  TestStepPass("1.0", "Kombi_01-Msg received Time %f us",HL_MsgTime); // reporting of passed action  
               write ("t-Start: %f t-Stop %f t-Start-Stop-Msg: %f us",HL_StartTime,HL_StopTime,HL_MsgTime);
               break;
      default: break;
  }

}
/*@@end*/

/*@@testcase:TestWakeUpCan():*/
testcase TestWakeUpCan ()

{
  long Testresult=0;

   TestCaseTitle("TC 2.00", "Test: Measure of the Starttime after CanWakup");
   TestCaseDescription("Test case is used to measure the time between KI is in Sleepmode and the first receiption from msg NMH_Kombi");
   TestStep("2.0", "Set KI in Sleep and awake the KI over Can Frame ; Expected Result: KI starts and the receipt Time from the NMH_Kombi is <200ms "); // create neutral entry in report file
    
    SwitchKL30(1);
    @eDI_KL_58xtS=0;
    @eZAS_Kl_15S=0; //KL15 off
    @eNMHControllerNodeAwake=0; //NMH off

    write("Power On NMH=off -> Wait for KI sleep");
    TestWaitForSignalInRange (evNGSM_ActualCurrentDisplay,0.0001,0.020,80000);//wait for KI Sleep Timeout > 65 sec 

    TestActive=1;
    
    @eNMHControllerNodeAwake=1;

    
    write("NMH On -> Wait for Message");
    HL_StartTime = timeNow(); //current time in us  
    Testresult=TestWaitForMessage(Kombi_01, 5000);//warten auf Botschaft Timeout 2sec    

    switch(Testresult)
     {
      case 0:  TestStepFail("1.0", "Timeout no Msg received"); break;
      case -1: TestStepFail("1.0", "General error, for example, functionality is not available"); break;
      case -2: TestStepFail("1.0", " Resume due to constraint violation"); break;
      case 1:  /* Msg received!*/
               HL_MsgTime=((HL_StopTime-HL_StartTime)*10);
               if(HL_MsgTime > HL_MAX_TIME)
                  TestStepWarning ("2.0", "Measured Time is to long! NMH-Msg received Time %f",HL_MsgTime); // reporting of passed action  
               else             
                  TestStepPass("2.0", "Kombi_01-Msg received Time %f us",HL_MsgTime); // reporting of passed action  
               write ("t-Start: %f t-Stop %f t-Start-Stop-Msg: %f us",HL_StartTime,HL_StopTime,HL_MsgTime);

               break;
      default: break;
      }

}
/*@@end*/

/*@@msg:CAN1.MQB_KCAN_KMatrix::Kombi_01 (0x30B):*/
on message Kombi_01
{
  
  if(TestActive==1)
  {
    HL_StopTime = timeNow(); 
    TestActive=0;
    write("Kombi-Msg received Time: %f");
    }
}
/*@@end*/

/*@@caplFunc:SwitchKL30(byte):*/
SwitchKL30 (byte val)
{
  //set Power
  if(val==1)
    {
      if(@evNGSM_OutputState == 0)
       {
         @evNGSM_OutputControl=1; 
         write("Set NGSM Power on");
         TestWaitForTimeout(10); // 10msec warten   
         @evNGSM_OutputControl=0;
       }
      else
        write("NGSM Power is on");
    }
  else
    {
      if(@evNGSM_OutputState == 1)
       {
         @evNGSM_OutputControl=1; 
         write("Set NGSM Power off");
         TestWaitForTimeout(10); // 10msec warten   
         @evNGSM_OutputControl=0;
         TestWaitForTimeout(2000); // 2sec warten   
       }
      else
        write("NGSM Power is off");
    }

  //NMH activ
  @eNMHControllerNodeAwake=1;
}
/*@@end*/

/*@@caplFunc:NGSM_Init():*/
NGSM_Init ()
{
  //Activate NGSM
  if(@evNGSM_PowerSwitch==0)
  {
     @evNGSM_PowerSwitch=1;
     write("switch NGSM On!");
     TestWaitForTimeout(500); // 500msec warten   
  }
  SwitchKL30(1);
  TestWaitForTimeout(2000); // 2sec warten   

}
/*@@end*/

/*@@mainTest:MainTest():*/
void MainTest()
{
  byte TestCounter=0;
  long Result;
  



  NGSM_Init();
  TestWakeupKL30();
//  TestWakeUpCan();
}
/*@@end*/

