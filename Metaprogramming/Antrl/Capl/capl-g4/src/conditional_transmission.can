variables
{    
    msTimer timerA;
    int conditionA = 0;
}

on timer timerA
{
    if(conditionA == 1) // if condition is still true
    {
        setTimer(timerA,200); // then continue timer
    }    
}