/*@@includes:*/
includes
{
    #include "Konstanten.h"
}
/*@@end*/

/*@@var:*/
variables
{
dword gBAP_Trace, gError_Trace;
dword gBAP_Trace_phonebook, gError_Trace_phonebook;

byte gKl15=0;
byte gKlS=0;

//***********************************BAP-Buffer****************************
const Requestbuffer_lines=100;
const BAP_buffer_size=4100;

int gBAP_Requestbufffer_status [Requestbuffer_lines];		//datalength
int gBAP_Requestbufffer_BAPDataTyp [Requestbuffer_lines];	//data type

dword gBAP_Indication[BAP_buffer_size];								//Bap-Indication-buffer
dword gBAP_Request [Requestbuffer_lines] [BAP_buffer_size];			//ringbuffer for BAP-Request

    char dbc_path[255]  ="BAP\\BAP-SIM-Telephone_BAPv1.5_v1.06_MIB\\DBs\\BAP_only_MQB_v0.95.dbc";	        //relative path for dbc-file	
    
    										     
    //char xml_path[255]  ="XML\\BAP_SW15_KI_MQB_v1_10_mod.xml";      //relative path for xml-file
    char xml_path[255]  ="BAP\\BAP-SIM-Telephone_BAPv1.5_v1.06_MIB\\XML\\BAP_SW15_KI_MQB_v1_13_F.xml";
    /////////////char xml_path[255]  ="XML\\BAP_SW15_KI_MQB_v1_10_mod.xml";

mstimer TaskTimer;					//real communication timer
mstimer test;

//byte Unrockbar=0;

int gwrite_requestbuffer_line=0;	//next free position
int gstatus_requestbuffer=0;		//next position to send

const gBAP_datalength_error=0x41;	//error-code for datalength-error


//BAP Data Type 
    const Bap_Void			    =0;
    const Bap_UInt8			    =1;
    const Bap_UInt16		    =2;
    const Bap_UInt32		    =3;
    const Bap_ByteSequence	    =4;
    const Bap_Error			    =5;
    const Bap_Acknowledge       =6;

    //BAP request types (ASG)
    const DataSetGet_REQ	=0x00;
    const DataSet_REQ		=0x01;
    const DataGet_REQ		=0x02;
    const Start_REQ			=0x05;
    const StartResult_REQ	=0x06;
    const Abort_REQ	        =0x07;
    const Ack_REQ           =0x0B;    
    const Invalid_REQ    	=0x1F;  // Interne Kennzeichnung fuer einen ungueltigen Request

    //eigene Error-Definition
    const Error_REQ=0x55;


    //BAP indication types (ASG)
    const Data_IND			=0x00;
    const Reset_IND         =0x01;
    const DataAck_IND       =0x02;
    const Result_IND		=0x03;
    const Processing_IND	=0x04;  
    const Changed_IND		=0x05;
    const Invalid_IND		=0x1F;  // Interne Kennzeichnung fuer eine ungueltige Indication

    //eigene Error-Definition
    const Error_IND =0x55;
    const BAP_ERR_OK =0x00;

// Debug 
const DEBUG_ID=0x444;
const DEBUG_CAN_CHANNEL=2;
const DEBUG_SWITCH_ON=1;
const DEBUG_SWITCH_OFF=0;

//BAP-DLL Node-Index
dword NODE_INDEX = 0;
//*************************************************************************


//*************************general*****************************************
//Power on/off
byte gRNS_PowerOnOff=0;
byte gBAP_Init=0;

byte gASG_Schalter_OnOff = 0;
char gASG_Schalter_OnOff_string[2][30]={"ASG Power off",
                                        "ASG Power on"};


mstimer Powerontimer;

const Power_off = 0x00;
const Power_on	= 0x01;
char gstring_RNS_PowerOnOff [2][4]={"Off",
									"On"};
const OFF=0x00;
const _ON=0x01;

//Bap-Phone
byte gBAP_Phone_available=0;
const noBAPPhone=0x00;
const BAPPhone=0x01;

//CallInfo Lengths
const CALL_INFO_NAME_LENGTH =99;
const CALL_INFO_NUMBER_LENGTH =40;

//CallStacks and SMSStacks
const general=0x01;
const mobile=0x02;
const office=0x03;
const chome=0x04;

char gunknown [15] = "unknown number";
char greserved [15] = "reserved";
char ginvalid [15] = "invalid value";
char gempty_string [3]   ={0,0,0};
char empty_string [3]   ={0,0,0};

const CALLSTACK=40;
const SMSSTACK=100;
char gnumbertype [15][15]= { "unknown",
							"General",
							"Mobile",
							"Office",
							"Home", 
							"Fax",
							"Pager",
							"Car",
							"SIM",
                            "Main office",
                            "Main home",
                            "Cell office",
                            "Cell home",
                            "Fax office",
                            "Fax home"};
//************************

const FALSE=0;
const TRUE=1;

const INSERT_ID=0xF0;
const DELETE_ID=0xFF;

const FORWARD=0;
const BACKWARD=1;

//RGB-Values
dword gRGB_red;
dword gRGB_yellow;
dword gRGB_green;
dword gRGB_grey;
dword gRGB_white;

//LSG-IDs
const LSG_KLIMA		=0x01;
const LSG_KLIMA2	=0x02;
const LSG_KLIMA3	=0x16;
const LSG_OPS		=0x0A;
const LSG_RVC		=0x0B;
const LSG_TELEPHONE	=0x28;
const LSG_PHONEBOOK	=0x29;
const LSG_DVBT		=0x2C;
const LSG_RSE		=0x2E;
const LSG_MDI		=0x2F;
//*************************************************************************

//*************************error codes*************************************
char gerror_codes_BCL [16][30] = {  0,
									"Media not accesible",
									"illegal sequence",
									"Sequenzfehler Segmentierung",
									"Timeout Segmentierung",
									"BCL not running",
									0,
									0,
									0,
									0,
									0,
									0,
									0,
									0,
									0,
									0};

char gerror_codes_BPL [16][30] = {  0,
									"Heartbeat Timeout",
									"Retry Timeout",
									0,
									0,
									0,
									0,
									0,
									0,
									0,
									0,
									0,
									0,
									0,
									0,
									0};

char gerror_codes_BAL [16][40] = {  0,
									"Falsche Adressierung",
									"Inkompatible Protokollversion",
									"Inkompatible Version Datenfestlegung",
									"Daten ungültig",
									0,
									0,
									0,
									0,
									0,
									0,
									0,
									0,
									0,
									0,
									0};
//Telephone
const Terror_unknownapllicationerror						=0x80;
const Terror_notsuccessful									=0x81;
const Terror_outofmemory									=0x82;
const Terror_datainvalid									=0x83;
const Terror_nouseractive									=0x88;
const Terror_nonetwork										=0x89;
const Terror_notsupportedbynetwork							=0x8A;
const Terror_notregisteredemergencycallonly					=0x8B;
const Terror_currentcodeinvalid								=0x8C;
const Terror_newcodeinvalid									=0x8D;
const Terror_nocoderequired									=0x8E;
const Terror_noredialnumber									=0x8F;
const Terror_activecallpresentdialing						=0x90;
const Terror_heldcallpresent								=0x91;
const Terror_activeandheldcallpresent						=0x92;
const Terror_nocall											=0x93;
const Terror_nocallrelatedtoCallID							=0x94;
const Terror_noactivecall									=0x95;
const Terror_nocallonhold									=0x96;
const Terror_noincomingwaitingcall							=0x97;
const Terror_noconference									=0x9A;
const Terror_nomemberofconference							=0x9B;
const Terror_maximumnumberformembersofconferencereached		=0x9C;
const Terror_functionnotsupportedforconferencecalls			=0x9D;
const Terror_phonebookdownloadinprogress					=0x9E;
const Terror_notsupportedbymobilephone						=0xA0;
const Terror_noheadsetconnected								=0xA1;
const Terror_nopairedheadset								=0xA2;
char gerror_codes_telephone[35][50] = { "unknown apllication error",
										"not successful",
										"out of memory",
										"data invalid",
										0,
										0,
										0,
										0,
										"no user active",
										"no network",
										"not supported by network",
										"not registered / emergency call only",
										"current code invalid",
										"new code invalid",
										"no code required",
										"no redialnumber",
										"active call present / dialing",
										"held call present",
										"active and held call present",
										"no call",
										"no call related to CallID",
										"no active call",
										"no call on hold",
										"no incoming / waiting call",
										0,
										0,
										"no conference",
										"no member of conference",
										"maximum number for members of conference reached",
										"function not supported for conference calls",
										"phonebook download in progress",
										0,
										"not supported by mobile phone",
										"no headset connected",
										"no paired headset"};
//*************************************************************************

//********************************************Function-ID's**************************************************************************
const FctID_GetAll=0x01;
const FctID_BAP_Config=0x02;
const FctID_FunctionList=0x03;
const FctID_HeartBeat=0x04;
const FctID_FSG_Setup=0x0E;
const FctID_FSG_OperationState=0x0F;
const FctID_MobileServiceSupport=0x10;
//***********************************************************************************************************************************

//***********************************************************************************************************************************
//************************************************TELEPHONE**************************************************************************
//***********************************************************************************************************************************
//LSG-ID
const LSGID_Telephone=0x28;
//********************************************Function-ID's**************************************************************************

const FctID_ActiveUser			=0x11;
const FctID_RegisterState		=0x12;
const FctID_LockState			=0x13;
const FctID_NetworkProvider		=0x14;
const FctID_SignalQuality		=0x15;
const FctID_CallState			=0x16;
const FctID_CallInfo			=0x17;
const FctID_CallDurationSync	=0x18;
const FctID_DisconnectReason	=0x19;
const FctID_DialNumber			=0x1A;
const FctID_DialService			=0x1B;
const FctID_ConfirmEmergencyCall=0x1C;
const FctID_HangupCall			=0x1D;
const FctID_AcceptCall			=0x1E;
const FctID_CallHold			=0x1F;
const FctID_ResumeCall			=0x20;
const FctID_HandsFreeOnOff		=0x21;
const FctID_MicroMuteOnOff		=0x22;
const FctID_MPReleaseActiveCallAcceptWaitingCall	=0x23;
const FctID_MPSwap									=0x24;
const FctID_MPCallHoldAcceptWaitingCall				=0x25;
const FctID_MPReleaseAllCallsAcceptWaitingCall		=0x26;
const FctID_MPSetWaitingCallOnHold      			=0x27;
const FctID_CCJoin									=0x28;
const FctID_CCSplit									=0x29;
const FctID_Keypad									=0x2A;
const FctID_MobileBatteryLevel			            =0x2B;
const FctID_DataConnectionIndication			    =0x2C;
const FctID_MissedCallIndication        			=0x2D;
const FctID_MissedCalls        			            =0x2E;
const FctID_ReceivedCalls        			        =0x2F;
const FctID_DialedNumbers        			        =0x30;
const FctID_CombinedNumbers        			        =0x31;
const FctID_CallStackDeleteAll        			    =0x32;
const FctID_PbState                        			=0x33;
const FctID_Phonebook                   			=0x34;
const FctID_PbSpeller                   			=0x35;
const FctID_GetNextListPos              			=0x36;
const FctID_SMSState                    			=0x37;
const FctID_RingToneMuteOnOff                       =0x38;
const FctID_AutomaticRedial                         =0x39;
//***********************************************************************************************************************************

//************************************************properties*************************************************************************
//***********************************************************************************************************************************

//**************property FSG-Setup*****************************************
byte gPhoneCharacteristics=0;
byte gSIMCardReader=0;
byte gCableConnection=0;
byte gHFPConnection=0;
byte gRSAPConnection=0;

byte gMobileConnectionType=0;

byte gNumberofUserProfiles=0;
byte gPhoneType=0;

const UHV_Premium	=0x01;
const UHV_High		=0x02;

char gstring_SIMCardReader [2][40]= {"No internal SIMcard reader",
									"Internal SIMcard reader"};

char gstring_CableConnection[2][40]= {"No cable connection to Mobile possible",
									"cable connection to Mobile possible"};

char gstring_HFPConnection[2][40]= {"No HFP connection to Mobile possible",
									"HFP connection to Mobile possible"};

char gstring_RSAPConnection[2][40]= {"No RSAP connection to Mobile possible",
									"RSAP connection to Mobile possible"};

char gstring_MobileConnectionType [5][30]= {"No connection",
											"Internal SIMcard reader",
											"Cable connection",
											"Hands free profile",
											"Remote SIM access profile"};

char gstring_PhoneType [3][15]= {"unknown",
								"UHV-Premium",
								"UHV-High"};
//*************************************************************************

//**************property FSG-OperationState*****************************************
byte gFSG_OperationState_OP_State=0;

const UHV_Init					=0x00;
const UHV_defect				=0x01;
const PhoneModuleOff			=0x02;
const PhoneModuleSwitchingOn	=0x03;
const PhoneModuleOn				=0x04;
const PhoneModuleSwitchingOff	=0x05;
const PhoneModuleOffHighTemp	=0x06;
const MobileOff					=0x07;
const MobileSwitchingOn			=0x08;
const MobileOn					=0x09;
const MobileSwitchingOff		=0x0a;
const MobileOffNoSwitchOn		=0x0b;
const MobileNotAttached			=0x0c;
const MobileAttachedNotReady	=0x0d;
const MobilAttachedNotFunctional=0x0e;

char gstring_FSG_OperationState_OP_State [4][40] = {"normal operation",
											"OFF/Standby",
											"reserved",
											"initializing"};
char gstring_reserved[10] = "reserved";
char gstring_defect[10] = "defect";

byte gFSG_OperationState_Tel_State =0;
char gFSG_OperationState_Tel_State_string [21][40] ={   "PhoneInitialization",
                                                    "Phone defect",
                                                    "Phone connecting",
                                                    "Phone disconnecting",
                                                    "Phone automatic reconnect",
                                                    "Phnoe module off",
                                                    "Phone module switching on",
                                                    "Phone module on",
                                                    "Phone module switching off",
                                                    "Phone module off high temp",
                                                    "Mobile connecting",
                                                    "Mobile disconnecting",
                                                    "Mobile automatic reconnect",
                                                    "Mobile off",
                                                    "Mobile switching on",
                                                    "Mobile on",
                                                    "Mobile switching off",
                                                    "Mobile off no switch on",
                                                    "Mobile not attached",
                                                    "Mobile attached not ready",
                                                    "Mobile attached not functional"};
                                                        
byte gFSG_OperationState_PrivacyMode =0;
byte gFSG_OperationState_PrivacyMode_PM =0;
byte gFSG_OperationState_PrivacyMode_EPM =0;

char gFSG_OperationState_PrivacyMode_string[2][10] ={ "inactive",
                                                "active"};

//***************************MobileServiceSupport**************************
byte gMobileServiceSupport[8];

//***************************active user***********************************
char gActiveUserName [50];
//*************************************************************************

//************Property registerstate***************************************
byte gRegisterState =0;

char gstring_registerstate [6] [40] = {"not registered and not searching",
										"registered",
										"not registerd and searching",
										"registration denied",
										"registered and roaming",
										"registered and roaming alternative"};
byte gNetworkType =0;
char gNetworkType_string [4] [20] = {"unknown",
									 "GSM",
									 "UMTS",
									 "CDMA"};

byte gPacketDataNetworkType =0;
char gPacketDataNetworkType_string [5] [30] = {"no data service",
									 "GSM-GPRS",
									 "GSM-EDGE",
									 "HSDPA",
                                     "HSUPA"};
//*************************************************************************

//***************************lock state************************************
byte gLockState=0;
char gstring_LockState [16] [30] = {"no lock",
									"require PIN",
									"require PIN2",
									"PIN blocked, require PUK",
									"PIN2 blocked, require PUK2",
									"PUK blocked",
									"PUK2 blocked",
									"keypad blocked",
									"SIM not available",
									"PIN invalid",
									"PIN2 invalid",
									"SIM not functional",
									"SIM not ready",
									"require lock code",
                                    "require security code",
                                    "security code blocked"};
//*************************************************************************

//************property networkprovider*************************************
byte gNetworkProvider_state =0;
char gNetworkProvider_state_string[2][20] ={"provider unknown",
                                            "NetName available"};

const NETWORKPROVIDERNAME_LENGTH =40;
char gNetworkProvider_name [NETWORKPROVIDERNAME_LENGTH];

byte gServiceProvider_state =0;
char gServiceProvider_state_string[2][20] ={"provider unknown",
                                            "NetName available"};

const SERVICEPROVIDERNAME_LENGTH =40;
char gServiceProvider_name [SERVICEPROVIDERNAME_LENGTH];
//*************************************************************************

//************property signal quality**************************************
byte gSignalQuality=0;
//*************************************************************************

//************property net info**************************************
byte gNetInfoCallDivert=0;
byte gNetInfoCiphering=0;

char gstring_NetInfoCallDivert [2][11] = {"not active",
										"active"};

char gstring_NetInfoCiphering [2][4] = {"On",
										"Off"};
//*************************************************************************

//*********property LineState**********************************************
byte gLineState=0;
//LineStates
const linefree=0x00;
const noline=0x01;
const connectedline_busy=0x02;
const systembusy=0x03;
const linebusy=0x04;
const numbernotassigned=0x05;
const numbernotrechable=0x06;
const networkfailure=0x07;
const callbarringactive=0x08;
const usernotresponding=0x09;
const callreject=0x0a;
const numberchangend=0x0b;
const numberinvalidincomplete=0x0c;
const servicenotavaillable=0x0d;
const noinfoavailable=0x0e; 

char gstring_linestate [15] [30]= {"line free",
									"no line",
									"connected line busy",
									"system busy",
									"line busy",
									"number not assigned",
									"number not rechable",
									"network failure",
									"callbarring active",
									"user not responding",
									"call reject",
									"number changed",
									"number invalid/incomplete",
									"service not availlable",
									"no info available"};
//*************************************************************************

//*******property CallState************************************************
byte gCallState [7] = {0,0,0,0,0,0,0};
byte gCallType [7] = {0,0,0,0,0,0,0};
byte gCallOptions [7] = {0,0,0,0,0,0,0};
byte gCallInDivert= 0;
byte gCallOutDivert= 0;

//Call-States
const CALLSTATES=9;
const idle=0x00;
const ringing_waiting=0x01;
const active=0x02;
const dialing=0x03;
const disconnecting=0x04;
const onhold=0x05;
const connected_CIB=0x06;
const remoteSideBusy =0x7;
const AutomaticRedialActive =0x8;
const INCOMINGOnHold =0x9;

//Call-Types
const CALLTYPES=8;
const unknowncalltype=0x00;
const regularvoicecall=0x01;
const datacall=0x02;
const faxcall=0x03;
const emergencycall=0x04;
const conference=0x05;
const infocall=0x06;
const servicecall=0x07;

char gstring_callstate [9] [30] = {"idle",
									"ringing waiting",
									"active",
									"dialing",
									"disconnecting",
									"onhold",
									"connected CIB",
                                    "remote side busy",
                                    "Incoming OnHold"};

char gstring_calltype [8] [20] = {	"unknown call type",
									"single voice call",
									"data call",
									"fax call",
									"emergency call",
									"conference",
									"info call",
									"service call"};

//*************************************************************************

//*******************propertycallinfo****************************************
//CALL_INFO_NAME_LENGTH & CALL_INFO_NUMBER_LENGTH already defined upon
char gcallinfo_name [7] [CALL_INFO_NAME_LENGTH];
char gcallinfo_number [7] [CALL_INFO_NUMBER_LENGTH];

byte gcallinfo_category [7];
char gcallinfo_category_string[15][20] ={"unknown NumberType",
                                    "General",
                                    "Mobile",
                                    "Office",
                                    "Home",
                                    "Fax",
                                    "Pager",
                                    "Car",
                                    "SIM",
                                    "Main office",
                                    "Main home",
                                    "Cell office",
                                    "Cell home",
                                    "Fax office",
                                    "Fax home"};
//*************************************************************************

//*********property CallDurationSync***************************************
word gTimeStampCall[7];
//*************************************************************************
//*********property DisconnectReason***************************************
byte gDisconnectReason =0;

char gDisconnectReason_string[15][30] ={"regular disconnecting",
                                        "no line",
                                        "connect line /busy",
                                        "system busy",
                                        "line busy /number busy",
                                        "number not assigned",
                                        "number not reachable",
                                        "network failure",
                                        "call barring active",
                                        "user not responding",
                                        "call reject",
                                        "number changed",
                                        "number invalid complete",
                                        "service not available",
                                        "no info available"
                                        };
//*************************************************************************
//*********property HandsFreeOnOff*****************************************
byte gHandsFree=1;
byte gderTag=0;
char gstring_HandsFree [2][4] ={"0ff",
								"On"};
//*************************************************************************

//*********property MicroMuteOnOff*****************************************
byte gMicroMute=0;
byte gdieNacht=0;
char gstring_MicroMute [2][4] ={"0ff",
								"On"};
//*************************************************************************

//*********property Keypad*****************************************
byte gKeyStatus=0;
char gstring_KeyStatus_Bit0 [30] ="Inforuf pressed too short";
char gstring_KeyStatus_Bit1 [30] ="Inforuf long pressed";
char gstring_KeyStatus_Bit2 [30] ="Pannenruf pressed too short";
char gstring_KeyStatus_Bit3 [30] ="Pannenruf long pressed";
char gstring_KeyStatus_Bit4 [30] ="eCall pressed too short";
char gstring_KeyStatus_Bit5 [30] ="eCall long pressed";								
//*************************************************************************
//*********property MobileBatteryLevel*************************************
byte gChargeLevelMobile_1 =0;
byte gChargeLevelMobile_2 =0;
byte gChargeLevelHandset_1 =0;								
byte gChargeLevelHandset_2 =0;
byte gWarningLevel         =0;

char gWarningLevel_Bit0[2][40] ={"mobile_1 charge level not critical",
                                 "mobile_1 charge level critical"};

char gWarningLevel_Bit1[2][40] ={"mobile_2 charge level not critical",
                                 "mobile_2 charge level critical"};

char gWarningLevel_Bit2[2][40] ={"handset_1 charge level not critical",
                                 "handset_1 charge level critical"};

char gWarningLevel_Bit3[2][40] ={"handset_2 charge level not critical",
                                 "handset_2 charge level critical"};
//*************************************************************************
//*********property DataConnectionIndication*******************************
byte gConnectionIndication =0;
char gConnectionIndication_string[2][30] ={"no data connection",
                                    "data connection active"};
long gDataVolumeUplink =0;
long gDataVolumeDownlink =0;
//*************************************************************************
//*********property MissedCallIndication*******************************
word gMissedCalls =0;
word gMissedNumbers =0;
//*************************************************************************

//*********property RingToneMuteOnOff**************************************
byte gRingToneMute=0;
byte gRingToneMute_noDataSetGet = 0;
char gstring_RingToneMute [2][4] ={"0ff",
								   "On"};
//*************************************************************************

//********************property AutomaticRedial*****************************
byte gAutomaticRedialState = 0;
char gAutomaticRedialState_String[2][40] = {"not active",
									        "active"};
//*************************************************************************


//*********property PBState**************************************
byte gDownloadState=0;
char gDownloadState_string[5][50] ={"no phonebook available",
                                    "currently being loaded",
                                    "completely loaded",
                                    "incompletely loaded, downloaded entries available",
                                    "download aborted"};
word gPbEntriesUHV =0;
//*************************************************************************

//************property SMSState********************************************
byte gSMSStateSIMReady=0;
byte gSMSStateStorageState=0;
word gSMSStateNumberOfNewSMS=0;

char gstring_SMSStateSIMReady [2][30] = {"SIM data not available",
										"SIM data available"};

char gstring_SMSStateStorageState [4][30] = {"SMS storage available",
											"SMS storage full",
											"SMS storage full, SMS pending",
											"SMS storage full, SMS pending"};
//*************************************************************************


//************************************************methods****************************************************************************
//***********************************************************************************************************************************

//***************************phone enable**********************************
byte gCodeType=0;
const undefined=		0x00;
const PIN=				0x01;
const PIN2=				0x02;
const PUK=				0x03;
const PUK2=				0x03;
const LockCode=			0x05;
const KeypadLockCode=	0x06;
const BaringPassword=	0x07;

char gPINCode [20];
//*************************************************************************

//**************method dialnumber******************************************
const DIAL_NUMBER_NAME_LENGTH=CALL_INFO_NAME_LENGTH;      //correct value: 150;
byte gcallID;
char gDialNumber [CALL_INFO_NUMBER_LENGTH];
char gdialnumber_name [DIAL_NUMBER_NAME_LENGTH];	//PbName of dialed Number
byte gDialNumber_result =0;
char gDialNumber_result_s[13][60] ={    "successful",
                                        "not successful",
                                        "abort successful",
                                        "abort not successful",
                                        "not successful - number invalid",
                                        "not successful - no network",
                                        "not successful - not supported by network",
                                        "not successful - not supported by mobile",
                                        "not successful - active call present",
                                        "not successful - already dialing",
                                        "not successful - confirm emergency call",
                                        "not successful - not registered emergency call only",
                                        "not successful - automatic redial active"};
//*************************************************************************

//**************method dialservice******************************************
byte gDialService_Result = 0;
char gDialService_Result_s[13][60] ={ "successful",
                                      "not successful",
                                      "abort successful",
                                      "abort not successful",
                                      "not successful - service not available",
                                      "not successful - no network",
                                      "not successful - not supported by network",
                                      "not successful - not supported by mobile",
                                      "(reserved)",
                                      "(reserved)",
                                      "not successful - confirm emergency call",
                                      "(reserved)",
                                      "not successful - automatic redial active"};
//*************************************************************************

//********************* method ConfirmEmergencyCall ***********************
byte gConfirmEmergencyCall_pending = 0; // waiting for confirmation? (0: no, 1: yes)
byte gConfirmEmergencyCall_result = 0; 
char gConfirmEmergencyCall_result_s[5][60] = {"successful", "not successful", "abort successful", "abort not successful", "not successful - no emergency call pending"};
const ECALL_CONTROL_CONFIRM = 0x00;
const ECALL_CONTROL_CANCEL = 0x01;

//*************************************************************************

//**************method hangupcall******************************************
const ALLACTIVECALLS		=0xFC;
const ALLHELDCALLS			=0xFD;
const ALLACTIVEANDHELDCALLS	=0xFE;
const ALLCALLS				=0xFF;

byte gHangupCall_Result =0;
char gHangupCall_Result_s[5][50] ={ "successful",
                                    "not successful",
                                    "abort successful",
                                    "abort not successful",
                                    "not successful - no call related to CallID"};
//*************************************************************************
//**************method AcceptCall******************************************
byte gAcceptCall_Result =0;
char gAcceptCall_Result_s[5][50] ={ "successful",
                                    "not successful",
                                    "abort successful",
                                    "abort not successful",
                                    "not successful - no incoming waiting call"};
//**************method SendDTMF********************************************
char gDTMF_Character [40];
//*************************************************************************

//**************method CCSplit*********************************************
byte gCCSplitCallID=0;
//*************************************************************************

//**************method PhoneOnOff******************************************
byte gPhoneOnOff=0;
//*************************************************************************


//************************************************arrays*****************************************************************************
//***********************************************************************************************************************************

//*******************array UserList****************************************
char gUserList_IMSI [5] [40];
char gUserList_IMEI [5] [40];
char gUserList_UserName [5] [50];

byte gUserList_available=1;
//*************************************************************************


//*************************************************************************

//***********************************************************************************************************************************
//************************************************PHONEBOOK**************************************************************************
//***********************************************************************************************************************************
//LSG-ID
const LSGID_Phonebook=0x29;
//********************************************Function-ID's**************************************************************************
const FctID_VoiceMailboxNumber		=0x19;
const FctID_PbStartDownload			=0x1A;
const FctID_SMSFlash				=0x1C;
const FctID_SMSReceived				=0x1D;
const FctID_SMSTemplate				=0x1E;
const FctID_SMSStoreTemplate		=0x1F;
const FctID_SMSSend					=0x20;
const FctID_SMSCopyToMobile			=0x21;
const FctID_SMSDeleteAll			=0x22;
const FctID_vCard					=0x23;
const FctID_vCardSend				=0x24;
const FctID_vCardCopyToMobile		=0x25;
const FctID_vCardStore				=0x26;
const FctID_vCalendar				=0x27;
const FctID_vCalendarSend			=0x28;
const FctID_vCalendarCopyToMobile	=0x29;
//************************************************************************************************************************************

//************************************************properties*************************************************************************
//***********************************************************************************************************************************

//**************property FSG-Setup*****************************************
byte gPhoneBookStructure=0;

const unknown			=0x00;
const entries1250notMN	=0x01;
const entries1000MN		=0x02;

char gstring_PhoneBookStructure [3][80]= {  "unknown",
											"max. 1250 entries per profile, one number per name entry",
											"max. 1000 entries per profile, up to 5 multiple numbers per name entry"};
//*************************************************************************

//**************property FSG-OperationState*****************************************
byte gFSG_OperationState_Phonebook=0;

const NormalOperation			=0x00;
const TemporarilyNotAvailable	=0x01;

const Defect=0x0f;

char gstring_FSG_OperationState_Phonebook [16][30] = {"normal operation",
											"invalid",
											"invalid",
											"invalid",
											"invalid",
											"temporarily not available",
											"invalid",
											"invalid",
											"invalid",
											"invalid",
											"invalid",
											"invalid",
											"invalid",
											"invalid",
											"invalid",
											"defect"};
//*************************************************************************

//************property voicemailboxnumber**********************************
char gmailboxnumber_rns_cache [CALL_INFO_NUMBER_LENGTH]="01722557377";	//Feld für im RNS-Applikationscache abgelegte Mailboxnummer
char gmailboxnumber_new [CALL_INFO_NUMBER_LENGTH];						//array for new mailboxnumber
//*************************************************************************


//************property SMSFlash********************************************
const SMSFLASH_LENGTH=480;
char gSMSFlashText [SMSFLASH_LENGTH];
//*************************************************************************


//************************************************methods****************************************************************************
//***********************************************************************************************************************************

//************method CallStackDeleteAll************************************
byte gCallStackDeleteAllStorage=0;
//*************************************************************************

//************method PbSpeller*********************************************
const PbNameLength = 100;
byte gSearchMode = 0;
char gSearchString[50];
byte gPbSpeller_Result = 0x00;
char gPbSpeller_Result_s[6][50] = {"successful",
                                   "not successful",
                                   "abort successful", 
                                   "abort not successful",
                                   "first character reached",
                                   "last character reached"};
//byte gPbSpeller_intiate_pbr = 0;
//byte gPBSpeller_phonebook_TAID = 0;
word gMatchingEntries = 0xffff;
word gFoundPos = 0xffff;
//*************************************************************************

//************method GetNextListPos****************************************
word gGetNextListPos_currentPos = 0;
word gGetNextListPos_nextPos = 0;
word gGetNextListPos_absoluteListPos = 0;
int gGetNextListPos_Offset = 0; 
byte gGetNextListPos_ListType = 0x00; // 0x00: phone book, 0x01..0xff: reserved
byte gGetNextListPos_Result = 0x00; 
char gGetNextListPos_Result_s[4][50] = {"successful",
                                   "not successful",
                                   "abort successful", 
                                   "abort not successful"};
byte gGetNextListPos_waiting_for_result = 0x00;
//*************************************************************************

//************method SMSStoreTemplate**************************************
const SMSStoreTemplate_TEXT_LENGTH=480;
char gSMSStoreTemplate_Text [SMSStoreTemplate_TEXT_LENGTH];
//*************************************************************************

//************method SMSSend***********************************************
const SMSSEND_TELNUMBER_LENGHT=40;
const SMSSEND_TEXT_LENGTH=800;
char gSMSSend_TelNumber [SMSSEND_TELNUMBER_LENGHT];
char gSMSSend_Text [SMSSEND_TEXT_LENGTH];
byte gSMSSend_Code=0;	
//*************************************************************************

//************method SMSDeleteAll******************************************
byte gSMSDeleteAllStorage=0;
//*************************************************************************

//************************************************array******************************************************************************
//***********************************************************************************************************************************

//***************array CallStack MissedCalls*******************************
//*****to check validity of statusarray*******
byte gmissedcalls_ASG_ID;
byte gmissedcalls_TAID;
word gmissedcalls_start=0xffff;
word gmissedcalls_elements=0xffff;
byte gmissedcalls_mode=0xff;
byte gmissedcalls_shift=0xff;
byte gmissedcalls_direction=0xff;
//********************************************

byte gmissedcalls_TotalNumListElements;
word gmissedcalls_pos [SLW_ENTRIES];
char gmissedcalls_pbname [SLW_ENTRIES][CALL_INFO_NAME_LENGTH];
byte gmissedcalls_numbertype [SLW_ENTRIES];
char gmissedcalls_telnumber [SLW_ENTRIES][CALL_INFO_NUMBER_LENGTH];
char gmissedcalls_date [SLW_ENTRIES][7];
char gmissedcalls_time [SLW_ENTRIES][7];

byte gmissedcalls_FullRangeUpdate;
byte gmissedcalls_insert_fullblocks;
byte gmissedcalls_insert_active;
//*************************************************************************

//***************array CallStack ReceivedCalls*******************************
char greceivedcalls_pbname [CALLSTACK][50];
char greceivedcalls_telnumber [CALLSTACK][CALL_INFO_NUMBER_LENGTH];
char greceivedcalls_date [CALLSTACK][7];
char greceivedcalls_time [CALLSTACK][7];
byte greceivedcalls_numbertype [CALLSTACK];
//*************************************************************************

//**************array CallStack DialedNumbers******************************
char gdialednumbers_pbname [CALLSTACK][50];
char gdialednumbers_telnumber [CALLSTACK][CALL_INFO_NUMBER_LENGTH];
char gdialednumbers_date [CALLSTACK][7];
char gdialednumbers_time [CALLSTACK][7];
byte gdialednumbers_numbertype [CALLSTACK];
//*************************************************************************

//**************array Phonebook********************************************
const DL_BLOCKSIZE=10;
word gPhonebookMemoryPosition=0;
word gPhonebookChangedEntries=0;
word gPhonebookDowloadedEntries=0;
word gPhonebookDownloadLastReceivedEntryPos=0;
byte gPhonebookDownload_UHV_ASG=0;

byte gPhonebook_FullRangeUpdate;

byte gPhonebook_AutoOnOff=OFF;
char gPhonebook_AutoOnOff_s [2][30]= {"Off / manual StatusArray",
									"On / automatic StatusArray"};
const PHONEBOOK_ENTRIES=1000;
const PHONEBOOK_PBNAME_LENGTH       =CALL_INFO_NAME_LENGTH;
const PHONEBOOK_TELNUMBER_LENGTH    =CALL_INFO_NUMBER_LENGTH;

//*****to check validity of statusarray*******
byte gPhonebook_ASG_ID;
byte gPhonebook_TAID;
word gPhonebook_start=0xffff;
word gPhonebook_elements=0xffff;
byte gPhonebook_mode=0xff;
byte gPhonebook_shift=0xff;
byte gPhonebook_direction=0xff;
//********************************************
word gPhonebook_TotalNumListElements;

word gPhonebook_Pos [PHONEBOOK_ENTRIES];						//ID des Phonebook-Eintrages
char gPhonebook_PbName [PHONEBOOK_ENTRIES][PHONEBOOK_PBNAME_LENGTH];
byte gPhonebook_Storage [PHONEBOOK_ENTRIES];
byte gPhonebook_AnyVoiceTag [PHONEBOOK_ENTRIES];				//array for a variable, which indicates, if there is an voice tag for any phone number of this phonebook entry available
byte gPhonebook_TelNumberQuantity [PHONEBOOK_ENTRIES];		//array for quantity of telnumbers of an entry in phonebook

char gPhonebook_TelNumber1 [PHONEBOOK_ENTRIES][PHONEBOOK_TELNUMBER_LENGTH];			//array for telnumber 1 of an entry in phonebook
char gPhonebook_TelNumber2 [PHONEBOOK_ENTRIES][PHONEBOOK_TELNUMBER_LENGTH];			//array for telnumber 2 of an entry in phonebook
char gPhonebook_TelNumber3 [PHONEBOOK_ENTRIES][PHONEBOOK_TELNUMBER_LENGTH];			//array for telnumber 3 of an entry in phonebook
char gPhonebook_TelNumber4 [PHONEBOOK_ENTRIES][PHONEBOOK_TELNUMBER_LENGTH];			//array for telnumber 4 of an entry in phonebook
char gPhonebook_TelNumber5 [PHONEBOOK_ENTRIES][PHONEBOOK_TELNUMBER_LENGTH];			//array for telnumber 5 of an entry in phonebook
char gPhonebook_TelNumber6 [PHONEBOOK_ENTRIES][PHONEBOOK_TELNUMBER_LENGTH];			//array for telnumber 6 of an entry in phonebook
char gPhonebook_TelNumber7 [PHONEBOOK_ENTRIES][PHONEBOOK_TELNUMBER_LENGTH];			//array for telnumber 7 of an entry in phonebook
char gPhonebook_TelNumber8 [PHONEBOOK_ENTRIES][PHONEBOOK_TELNUMBER_LENGTH];			//array for telnumber 8 of an entry in phonebook
char gPhonebook_TelNumber9 [PHONEBOOK_ENTRIES][PHONEBOOK_TELNUMBER_LENGTH];			//array for telnumber 9 of an entry in phonebook
char gPhonebook_TelNumber10 [PHONEBOOK_ENTRIES][PHONEBOOK_TELNUMBER_LENGTH];			//array for telnumber 10 of an entry in phonebook

byte gPhonebook_VoiceTag1 [PHONEBOOK_ENTRIES];				//array for availabe voice tag of telnumber 1 of an entry in phonebook
byte gPhonebook_VoiceTag2 [PHONEBOOK_ENTRIES];				//array for availabe voice tag of telnumber 2 of an entry in phonebook
byte gPhonebook_VoiceTag3 [PHONEBOOK_ENTRIES];				//array for availabe voice tag of telnumber 3 of an entry in phonebook
byte gPhonebook_VoiceTag4 [PHONEBOOK_ENTRIES];				//array for availabe voice tag of telnumber 4 of an entry in phonebook
byte gPhonebook_VoiceTag5 [PHONEBOOK_ENTRIES];				//array for availabe voice tag of telnumber 5 of an entry in phonebook
byte gPhonebook_VoiceTag6 [PHONEBOOK_ENTRIES];				//array for availabe voice tag of telnumber 6 of an entry in phonebook
byte gPhonebook_VoiceTag7 [PHONEBOOK_ENTRIES];				//array for availabe voice tag of telnumber 7 of an entry in phonebook
byte gPhonebook_VoiceTag8 [PHONEBOOK_ENTRIES];				//array for availabe voice tag of telnumber 8 of an entry in phonebook
byte gPhonebook_VoiceTag9 [PHONEBOOK_ENTRIES];				//array for availabe voice tag of telnumber 9 of an entry in phonebook
byte gPhonebook_VoiceTag10 [PHONEBOOK_ENTRIES];				//array for availabe voice tag of telnumber 10 of an entry in phonebook

byte gPhonebook_NumberType1 [PHONEBOOK_ENTRIES];				//array for numbertype of telnumber 1 of an entry in phonebook
byte gPhonebook_NumberType2 [PHONEBOOK_ENTRIES];				//array for numbertype of telnumber 2 of an entry in phonebook
byte gPhonebook_NumberType3 [PHONEBOOK_ENTRIES];				//array for numbertype of telnumber 3 of an entry in phonebook
byte gPhonebook_NumberType4 [PHONEBOOK_ENTRIES];				//array for numbertype of telnumber 4 of an entry in phonebook
byte gPhonebook_NumberType5 [PHONEBOOK_ENTRIES];				//array for numbertype of telnumber 5 of an entry in phonebook
byte gPhonebook_NumberType6 [PHONEBOOK_ENTRIES];				//array for numbertype of telnumber 6 of an entry in phonebook
byte gPhonebook_NumberType7 [PHONEBOOK_ENTRIES];				//array for numbertype of telnumber 7 of an entry in phonebook
byte gPhonebook_NumberType8 [PHONEBOOK_ENTRIES];				//array for numbertype of telnumber 8 of an entry in phonebook
byte gPhonebook_NumberType9 [PHONEBOOK_ENTRIES];				//array for numbertype of telnumber 9 of an entry in phonebook
byte gPhonebook_NumberType10 [PHONEBOOK_ENTRIES];				//array for numbertype of telnumber 10 of an entry in phonebook

byte gPhonebook_AddressIndication[PHONEBOOK_ENTRIES];
//*************************************************************************

//****************Sliding Window*****************
char gstring_SlW_Mode [2] [30]={"sliding window mode off",
										"sliding window mode on"};
//const for SlW_Download_status
const NO_SLW_DOWNLOAD=0;
const WINDOW=2;
const VORHALT_UP=1;
const VORHALT_DOWN=3;

const SCROLL_UP=0x22;
const SCROLL_DOWN=0x23;

word gLongKeyPressTime=2000;
word gLongKeyPressAgainTime=500;
//***********************************************

//**************array Phonebook-SlidingWindow******************************

byte gPhonebook_SlW_Mode=OFF;

byte gPhonebook_VorhaltUpStatus=0;
byte gPhonebook_VorhaltDownStatus=0;
byte gPhonebook_SlW_DownloadVorhaltUp=FALSE;
byte gPhonebook_SlW_DownloadVorhaltDown=FALSE;

byte gPhonebook_SlW_Download_status=0;

byte gPhonebook_SlW_Detail=0;

mstimer Phonebook_LongKeyPress_timer;

byte gPhonebook_KeyPressCode=0;

byte gPhonebook_ScrollingEntries=5;

word gPhonebook_SlW_ID [SLW_ENTRIES];						//ID des Phonebook-Eintrages

word gPhonebook_SlW_Pos [SLW_ENTRIES];
char gPhonebook_SlW_PbName [SLW_ENTRIES][PHONEBOOK_PBNAME_LENGTH];				//array for name in phonebook
byte gPhonebook_SlW_Storage [SLW_ENTRIES];
byte gPhonebook_SlW_AnyVoiceTag[SLW_ENTRIES];
byte gPhonebook_SlW_TelNumberQuantity[SLW_ENTRIES];
byte gPhonebook_SlW_AddressIndication[SLW_ENTRIES];

word gPhonebook_Detail_Pos;
char gPhonebook_Detail_PbName[PHONEBOOK_PBNAME_LENGTH];				//array for name in phonebook
byte gPhonebook_Detail_Storage;
byte gPhonebook_Detail_AnyVoiceTag;
byte gPhonebook_Detail_TelNumberQuantity;

char gPhonebook_Detail_TelNumber1 [PHONEBOOK_TELNUMBER_LENGTH];
char gPhonebook_Detail_TelNumber2 [PHONEBOOK_TELNUMBER_LENGTH];
char gPhonebook_Detail_TelNumber3 [PHONEBOOK_TELNUMBER_LENGTH];
char gPhonebook_Detail_TelNumber4 [PHONEBOOK_TELNUMBER_LENGTH];
char gPhonebook_Detail_TelNumber5 [PHONEBOOK_TELNUMBER_LENGTH];
char gPhonebook_Detail_TelNumber6 [PHONEBOOK_TELNUMBER_LENGTH];
char gPhonebook_Detail_TelNumber7 [PHONEBOOK_TELNUMBER_LENGTH];
char gPhonebook_Detail_TelNumber8 [PHONEBOOK_TELNUMBER_LENGTH];
char gPhonebook_Detail_TelNumber9 [PHONEBOOK_TELNUMBER_LENGTH];
char gPhonebook_Detail_TelNumber10 [PHONEBOOK_TELNUMBER_LENGTH];
byte gPhonebook_Detail_VoiceTag1;
byte gPhonebook_Detail_VoiceTag2;
byte gPhonebook_Detail_VoiceTag3;
byte gPhonebook_Detail_VoiceTag4;
byte gPhonebook_Detail_VoiceTag5;
byte gPhonebook_Detail_VoiceTag6;
byte gPhonebook_Detail_VoiceTag7;
byte gPhonebook_Detail_VoiceTag8;
byte gPhonebook_Detail_VoiceTag9;
byte gPhonebook_Detail_VoiceTag10;
byte gPhonebook_Detail_NumberType1;
byte gPhonebook_Detail_NumberType2;
byte gPhonebook_Detail_NumberType3;
byte gPhonebook_Detail_NumberType4;
byte gPhonebook_Detail_NumberType5;
byte gPhonebook_Detail_NumberType6;
byte gPhonebook_Detail_NumberType7;
byte gPhonebook_Detail_NumberType8;
byte gPhonebook_Detail_NumberType9;
byte gPhonebook_Detail_NumberType10;

byte gPhonebook_Detail_AddressIndication;


//**************array MissedCalls-SlidingWindow******************************

byte gSlidingWindowMode=OFF;

byte gVorhaltUpStatus=0;
byte gVorhaltDownStatus=0;
byte gSlW_DownloadVorhaltUp=FALSE;
byte gSlW_DownloadVorhaltDown=FALSE;

byte gSlW_Download_status=0;

byte gSlW_Detail=0;

mstimer LongKeyPress_timer;

byte gKeyPressCode=0;

byte gScrollingEntries=5;

word gSlidingWindow_ID [SLW_ENTRIES];						//ID des Phonebook-Eintrages

char gSlidingWindow_pbname [SLW_ENTRIES][CALL_INFO_NAME_LENGTH];				//array for name in phonebook
word gSlidingWindow_pos [SLW_ENTRIES];				//array for a variable, which indicates, if there is an voice tag for any phone number of this phonebook entry available
byte gSlidingWindow_numbertype [SLW_ENTRIES];		//array for quantity of telnumbers of an entry in phonebook

char gDetail_pbname [CALL_INFO_NAME_LENGTH];
word gDetail_pos=0;
byte gDetail_numbertype=0;
char gDetail_telnumber[CALL_INFO_NUMBER_LENGTH];
char gDetail_date [7];
char gDetail_time [7];


byte gDetail_anyvoicetag;
byte gDetail_telnumberquantity;
char gDetail_telnumber1 [PHONEBOOK_TELNUMBER_LENGTH];
char gDetail_telnumber2 [PHONEBOOK_TELNUMBER_LENGTH];
char gDetail_telnumber3 [PHONEBOOK_TELNUMBER_LENGTH];
char gDetail_telnumber4 [PHONEBOOK_TELNUMBER_LENGTH];
char gDetail_telnumber5 [PHONEBOOK_TELNUMBER_LENGTH];
byte gDetail_voicetag1;
byte gDetail_voicetag2;
byte gDetail_voicetag3;
byte gDetail_voicetag4;
byte gDetail_voicetag5;
byte gDetail_numbertype1;
byte gDetail_numbertype2;
byte gDetail_numbertype3;
byte gDetail_numbertype4;
byte gDetail_numbertype5;

char gstring_SlWSlider [26] [2]={"Z",
								 "Y",
								 "X",
								 "W",
								 "V",
								 "U",
								 "T",
								 "S",
								 "R",
								 "Q",
								 "P",
								 "O",
								 "N",
								 "M",
								 "L",
								 "K",
								 "J",
								 "I",
								 "H",
								 "G",
								 "F",
								 "E",
								 "D",
								 "C",
								 "B",
								 "A"};
//*************************************************************************

//**************array SMSReceived******************************************
const SMSPBNAMELENGTH=100;
const SMSTELNUMBERLENGTH=40;
const SMSTEXTLENGTH=480;

word gSMSReceived_ID [SMSSTACK];										//ID of received SMS

char gSMSReceived_pbname [SMSSTACK][SMSPBNAMELENGTH];
byte gSMSReceived_smsattrib [SMSSTACK];
char gSMSReceived_telnumber [SMSSTACK][SMSTELNUMBERLENGTH];
byte gSMSReceived_day [SMSSTACK];
byte gSMSReceived_month [SMSSTACK];
byte gSMSReceived_year [SMSSTACK];
byte gSMSReceived_hour [SMSSTACK];
byte gSMSReceived_minute [SMSSTACK];
byte gSMSReceived_second [SMSSTACK];
char gSMSReceived_text [SMSSTACK][SMSTEXTLENGTH];

byte gSMSReceived_DL_State=0;
//*************************************************************************

//**************array SMSTemplate******************************************
const SMSTITLELENGTH=20;

word gSMSTemplate_ID [SMSSTACK];										//ID of received SMS

char gSMSTemplate_title [SMSSTACK][SMSPBNAMELENGTH];
char gSMSTemplate_text [SMSSTACK][SMSTEXTLENGTH];

byte gSMSTemplate_DL_State=0;
//*************************************************************************

//**************array CombinedNumbers**************************************
    byte gCombinedNumbers_ASGID    =0;
    byte gCombinedNumbers_TAID     =0;
    word gCombinedNumbers_TotalNumListElements =0;

    const TEL_COMBINEDNUMBERS_ASGCACHE_MAX_SIZE =9;

    word gCombinedNumbers_Pos [TEL_COMBINEDNUMBERS_ASGCACHE_MAX_SIZE];

    const TEL_COMBINEDNUMBERS_PBNAME_LENGTH =100;
    char gCombinedNumbers_PbName [TEL_COMBINEDNUMBERS_ASGCACHE_MAX_SIZE][TEL_COMBINEDNUMBERS_PBNAME_LENGTH];

    byte gCombinedNumbers_CallMode [TEL_COMBINEDNUMBERS_ASGCACHE_MAX_SIZE];
    char gCombinedNumbers_CallMode_s[4][30] ={  "unknown call mode",
                                                "missed call",
                                                "received call",
                                                "dialed number"};
    
    const TEL_COMBINEDNUMBERS_TELNUMBER_LENGTH =41;
    char gCombinedNumbers_TelNumber [TEL_COMBINEDNUMBERS_ASGCACHE_MAX_SIZE][TEL_COMBINEDNUMBERS_TELNUMBER_LENGTH];
    
    byte gCombinedNumbers_day [TEL_COMBINEDNUMBERS_ASGCACHE_MAX_SIZE];
    byte gCombinedNumbers_month [TEL_COMBINEDNUMBERS_ASGCACHE_MAX_SIZE];
    byte gCombinedNumbers_year [TEL_COMBINEDNUMBERS_ASGCACHE_MAX_SIZE];
    byte gCombinedNumbers_hour [TEL_COMBINEDNUMBERS_ASGCACHE_MAX_SIZE];
    byte gCombinedNumbers_minute [TEL_COMBINEDNUMBERS_ASGCACHE_MAX_SIZE];
    byte gCombinedNumbers_second [TEL_COMBINEDNUMBERS_ASGCACHE_MAX_SIZE];
    
    byte gCombinedNumbers_ListEntryReceptionInformation[TEL_COMBINEDNUMBERS_ASGCACHE_MAX_SIZE]; //indicates the reception of an "array element" 

    //CombinedNumbers ->'sliding window' specific   
    const TEL_COMBINEDNUMBERS_SLIDINGWINDOW_NOTACTIVE   =0;
    const TEL_COMBINEDNUMBERS_SLIDINGWINDOW_ACTIVE      =1;
    byte gCombinedNumbers_SlidingWindow_State           =TEL_COMBINEDNUMBERS_SLIDINGWINDOW_NOTACTIVE;
      
    const TEL_COMBINEDNUMBERS_NOCACHE              =0;
    const TEL_COMBINEDNUMBERS_BUILDUPCACHE         =1;
    const TEL_COMBINEDNUMBERS_DOWN_CACHE           =2;
    const TEL_COMBINEDNUMBERS_UP_CACHE             =3;
    const TEL_COMBINEDNUMBERS_UP                   =4;
    const TEL_COMBINEDNUMBERS_DOWN                 =5;
    byte gCombinedNumbers_ListHandlingType           =TEL_COMBINEDNUMBERS_NOCACHE; 
    
    const TEL_COMBINEDNUMBERS_BUILDUPCACHENOCACHE              =0;
    const TEL_COMBINEDNUMBERS_BUILDUPCACHECACHE_UP             =1;
    const TEL_COMBINEDNUMBERS_BUILDUPCACHECACHE_WINDOW         =2;
    const TEL_COMBINEDNUMBERS_BUILDUPCACHECACHE_DOWN           =3; 
    byte gCombinedNumbers_cacheBuildUp                           =TEL_COMBINEDNUMBERS_BUILDUPCACHENOCACHE;

    const TEL_COMBINEDNUMBERS_CALLBACKREASON_NOCALLBACK        =0;
    const TEL_COMBINEDNUMBERS_CALLBACKREASON_CACHENEXT         =1;
    const TEL_COMBINEDNUMBERS_CALLBACKREASON_CHECKCACHE        =2;
    const TEL_COMBINEDNUMBERS_CALLBACKREASON_DISPLAYLIST       =3;
    byte gCombinedNumbers_CallBackReason                         =TEL_COMBINEDNUMBERS_CALLBACKREASON_NOCALLBACK;

    byte gCombinedNumbers_cacheDown                            =FALSE;
    byte gCombinedNumbers_cacheUp                              =FALSE;
    byte gCombinedNumbers_LastFirstElement                     =0;
    const TEL_COMBINEDNUMBERS_NO_NEXT_POSITION                  =99;

    //display array
    byte gCombinedNumbers_recordaddress            =0; 
    byte gCombinedNumbers_transmitpos              =0;

    const TEL_COMBINEDNUMBERS_CURSORACTION_NOTHING             =0;  
    const TEL_COMBINEDNUMBERS_CURSORACTION_DOWN                =1;
    const TEL_COMBINEDNUMBERS_CURSORACTION_UP                  =2;
    byte gCombinedNumbers_CursorAction                         =TEL_COMBINEDNUMBERS_CURSORACTION_NOTHING;

    const TEL_COMBINEDNUMBERS_DISPLAYLIST_REFRESH              =0;
    const TEL_COMBINEDNUMBERS_DISPLAYLIST_FIRST_ELEMENTS       =1;
    const TEL_COMBINEDNUMBERS_DISPLAYLIST_SEARCH_ELEMENTS      =2;
    byte gCombinedNumbers_DisplayStatus                        =TEL_COMBINEDNUMBERS_DISPLAYLIST_FIRST_ELEMENTS;                                      

    const TEL_COMBINEDNUMBERS_DISPLAYLIST_FIND_NEXT_ELEMENT        =0;
    const TEL_COMBINEDNUMBERS_DISPLAYLIST_FIND_PREVIUOS_ELEMENT    =1;


    byte gCombinedNumbers_LastElement           =0;
    byte gCombinedNumbers_FirstElement          =0;
    byte gCombinedNumbers_DownCaching_required  =FALSE;
    byte gCombinedNumbers_UpCaching_required    =FALSE;
    byte gCombinedNumbers_MoveList_down_allowed =FALSE;
    byte gCombinedNumbers_MoveList_up_allowed   =FALSE;

//**************array ReceivedCalls**************************************
    byte gReceivedCalls_ASGID    =0;
    byte gReceivedCalls_TAID     =0;
    word gReceivedCalls_TotalNumListElements =0;

    const TEL_RECEIVEDCALLS_ASGCACHE_MAX_SIZE =9;

    word gReceivedCalls_Pos [TEL_RECEIVEDCALLS_ASGCACHE_MAX_SIZE];

    const TEL_RECEIVEDCALLS_PBNAME_LENGTH =100;
    char gReceivedCalls_PbName [TEL_RECEIVEDCALLS_ASGCACHE_MAX_SIZE][TEL_RECEIVEDCALLS_PBNAME_LENGTH];

    byte gReceivedCalls_NumberType [TEL_RECEIVEDCALLS_ASGCACHE_MAX_SIZE];
    char gReceivedCalls_NumberType_s[15][30] ={ "unknown NumberType",
                                                "General",
                                                "Mobile",
                                                "Office",
                                                "Home",
                                                "Fax",
                                                "Pager",
                                                "Car",
                                                "SIM",
                                                "Main office",
                                                "Main home",
                                                "Cell office",
                                                "Cell home",
                                                "Fax office",
                                                "Fax home"};
    
    const TEL_RECEIVEDCALLS_TELNUMBER_LENGTH =41;
    char gReceivedCalls_TelNumber [TEL_RECEIVEDCALLS_ASGCACHE_MAX_SIZE][TEL_RECEIVEDCALLS_TELNUMBER_LENGTH];
    
    byte gReceivedCalls_day [TEL_RECEIVEDCALLS_ASGCACHE_MAX_SIZE];
    byte gReceivedCalls_month [TEL_RECEIVEDCALLS_ASGCACHE_MAX_SIZE];
    byte gReceivedCalls_year [TEL_RECEIVEDCALLS_ASGCACHE_MAX_SIZE];
    byte gReceivedCalls_hour [TEL_RECEIVEDCALLS_ASGCACHE_MAX_SIZE];
    byte gReceivedCalls_minute [TEL_RECEIVEDCALLS_ASGCACHE_MAX_SIZE];
    byte gReceivedCalls_second [TEL_RECEIVEDCALLS_ASGCACHE_MAX_SIZE];
    
    byte gReceivedCalls_ListEntryReceptionInformation[TEL_RECEIVEDCALLS_ASGCACHE_MAX_SIZE]; //indicates the reception of an "array element" 

    //ReceivedCalls ->'sliding window' specific   
    const TEL_RECEIVEDCALLS_SLIDINGWINDOW_NOTACTIVE   =0;
    const TEL_RECEIVEDCALLS_SLIDINGWINDOW_ACTIVE      =1;
    byte gReceivedCalls_SlidingWindow_State           =TEL_RECEIVEDCALLS_SLIDINGWINDOW_NOTACTIVE;
      
    const TEL_RECEIVEDCALLS_NOCACHE              =0;
    const TEL_RECEIVEDCALLS_BUILDUPCACHE         =1;
    const TEL_RECEIVEDCALLS_DOWN_CACHE           =2;
    const TEL_RECEIVEDCALLS_UP_CACHE             =3;
    const TEL_RECEIVEDCALLS_UP                   =4;
    const TEL_RECEIVEDCALLS_DOWN                 =5;
    byte gReceivedCalls_ListHandlingType           =TEL_RECEIVEDCALLS_NOCACHE; 
    
    const TEL_RECEIVEDCALLS_BUILDUPCACHENOCACHE              =0;
    const TEL_RECEIVEDCALLS_BUILDUPCACHECACHE_UP             =1;
    const TEL_RECEIVEDCALLS_BUILDUPCACHECACHE_WINDOW         =2;
    const TEL_RECEIVEDCALLS_BUILDUPCACHECACHE_DOWN           =3; 
    byte gReceivedCalls_cacheBuildUp                           =TEL_RECEIVEDCALLS_BUILDUPCACHENOCACHE;

    const TEL_RECEIVEDCALLS_CALLBACKREASON_NOCALLBACK        =0;
    const TEL_RECEIVEDCALLS_CALLBACKREASON_CACHENEXT         =1;
    const TEL_RECEIVEDCALLS_CALLBACKREASON_CHECKCACHE        =2;
    const TEL_RECEIVEDCALLS_CALLBACKREASON_DISPLAYLIST       =3;
    byte gReceivedCalls_CallBackReason                         =TEL_RECEIVEDCALLS_CALLBACKREASON_NOCALLBACK;

    byte gReceivedCalls_cacheDown                            =FALSE;
    byte gReceivedCalls_cacheUp                              =FALSE;
    byte gReceivedCalls_LastFirstElement                     =0;
    const TEL_RECEIVEDCALLS_NO_NEXT_POSITION                  =99;

    //display array
    byte gReceivedCalls_recordaddress            =0; 
    byte gReceivedCalls_transmitpos              =0;

    const TEL_RECEIVEDCALLS_CURSORACTION_NOTHING             =0;  
    const TEL_RECEIVEDCALLS_CURSORACTION_DOWN                =1;
    const TEL_RECEIVEDCALLS_CURSORACTION_UP                  =2;
    byte gReceivedCalls_CursorAction                         =TEL_RECEIVEDCALLS_CURSORACTION_NOTHING;

    const TEL_RECEIVEDCALLS_DISPLAYLIST_REFRESH              =0;
    const TEL_RECEIVEDCALLS_DISPLAYLIST_FIRST_ELEMENTS       =1;
    const TEL_RECEIVEDCALLS_DISPLAYLIST_SEARCH_ELEMENTS      =2;
    byte gReceivedCalls_DisplayStatus                        =TEL_RECEIVEDCALLS_DISPLAYLIST_FIRST_ELEMENTS;                                      

    const TEL_RECEIVEDCALLS_DISPLAYLIST_FIND_NEXT_ELEMENT        =0;
    const TEL_RECEIVEDCALLS_DISPLAYLIST_FIND_PREVIUOS_ELEMENT    =1;


    byte gReceivedCalls_LastElement           =0;
    byte gReceivedCalls_FirstElement          =0;
    byte gReceivedCalls_DownCaching_required  =FALSE;
    byte gReceivedCalls_UpCaching_required    =FALSE;
    byte gReceivedCalls_MoveList_down_allowed =FALSE;
    byte gReceivedCalls_MoveList_up_allowed   =FALSE;

    //**************array ReceivedCalls**************************************
    byte gDialedNumbers_ASGID    =0;
    byte gDialedNumbers_TAID     =0;
    word gDialedNumbers_TotalNumListElements =0;

    const TEL_DIALEDNUMBERS_ASGCACHE_MAX_SIZE =9;

    word gDialedNumbers_Pos [TEL_DIALEDNUMBERS_ASGCACHE_MAX_SIZE];

    const TEL_DIALEDNUMBERS_PBNAME_LENGTH =100;
    char gDialedNumbers_PbName [TEL_DIALEDNUMBERS_ASGCACHE_MAX_SIZE][TEL_DIALEDNUMBERS_PBNAME_LENGTH];

    byte gDialedNumbers_NumberType [TEL_DIALEDNUMBERS_ASGCACHE_MAX_SIZE];
    char gDialedNumbers_NumberType_s[15][30] ={ "unknown NumberType",
                                                "General",
                                                "Mobile",
                                                "Office",
                                                "Home",
                                                "Fax",
                                                "Pager",
                                                "Car",
                                                "SIM",
                                                "Main office",
                                                "Main home",
                                                "Cell office",
                                                "Cell home",
                                                "Fax office",
                                                "Fax home"};
    
    const TEL_DIALEDNUMBERS_TELNUMBER_LENGTH =41;
    char gDialedNumbers_TelNumber [TEL_DIALEDNUMBERS_ASGCACHE_MAX_SIZE][TEL_DIALEDNUMBERS_TELNUMBER_LENGTH];
    
    byte gDialedNumbers_day [TEL_DIALEDNUMBERS_ASGCACHE_MAX_SIZE];
    byte gDialedNumbers_month [TEL_DIALEDNUMBERS_ASGCACHE_MAX_SIZE];
    byte gDialedNumbers_year [TEL_DIALEDNUMBERS_ASGCACHE_MAX_SIZE];
    byte gDialedNumbers_hour [TEL_DIALEDNUMBERS_ASGCACHE_MAX_SIZE];
    byte gDialedNumbers_minute [TEL_DIALEDNUMBERS_ASGCACHE_MAX_SIZE];
    byte gDialedNumbers_second [TEL_DIALEDNUMBERS_ASGCACHE_MAX_SIZE];
    
    byte gDialedNumbers_ListEntryReceptionInformation[TEL_DIALEDNUMBERS_ASGCACHE_MAX_SIZE]; //indicates the reception of an "array element" 

    //DialedNumbers ->'sliding window' specific   
    const TEL_DIALEDNUMBERS_SLIDINGWINDOW_NOTACTIVE   =0;
    const TEL_DIALEDNUMBERS_SLIDINGWINDOW_ACTIVE      =1;
    byte gDialedNumbers_SlidingWindow_State           =TEL_DIALEDNUMBERS_SLIDINGWINDOW_NOTACTIVE;
      
    const TEL_DIALEDNUMBERS_NOCACHE              =0;
    const TEL_DIALEDNUMBERS_BUILDUPCACHE         =1;
    const TEL_DIALEDNUMBERS_DOWN_CACHE           =2;
    const TEL_DIALEDNUMBERS_UP_CACHE             =3;
    const TEL_DIALEDNUMBERS_UP                   =4;
    const TEL_DIALEDNUMBERS_DOWN                 =5;
    byte gDialedNumbers_ListHandlingType           =TEL_DIALEDNUMBERS_NOCACHE; 
    
    const TEL_DIALEDNUMBERS_BUILDUPCACHENOCACHE              =0;
    const TEL_DIALEDNUMBERS_BUILDUPCACHECACHE_UP             =1;
    const TEL_DIALEDNUMBERS_BUILDUPCACHECACHE_WINDOW         =2;
    const TEL_DIALEDNUMBERS_BUILDUPCACHECACHE_DOWN           =3; 
    byte gDialedNumbers_cacheBuildUp                           =TEL_DIALEDNUMBERS_BUILDUPCACHENOCACHE;

    const TEL_DIALEDNUMBERS_CALLBACKREASON_NOCALLBACK        =0;
    const TEL_DIALEDNUMBERS_CALLBACKREASON_CACHENEXT         =1;
    const TEL_DIALEDNUMBERS_CALLBACKREASON_CHECKCACHE        =2;
    const TEL_DIALEDNUMBERS_CALLBACKREASON_DISPLAYLIST       =3;
    byte gDialedNumbers_CallBackReason                         =TEL_DIALEDNUMBERS_CALLBACKREASON_NOCALLBACK;

    byte gDialedNumbers_cacheDown                            =FALSE;
    byte gDialedNumbers_cacheUp                              =FALSE;
    byte gDialedNumbers_LastFirstElement                     =0;
    const TEL_DIALEDNUMBERS_NO_NEXT_POSITION                  =99;

    //display array
    byte gDialedNumbers_recordaddress            =0; 
    byte gDialedNumbers_transmitpos              =0;

    const TEL_DIALEDNUMBERS_CURSORACTION_NOTHING             =0;  
    const TEL_DIALEDNUMBERS_CURSORACTION_DOWN                =1;
    const TEL_DIALEDNUMBERS_CURSORACTION_UP                  =2;
    byte gDialedNumbers_CursorAction                         =TEL_DIALEDNUMBERS_CURSORACTION_NOTHING;

    const TEL_DIALEDNUMBERS_DISPLAYLIST_REFRESH              =0;
    const TEL_DIALEDNUMBERS_DISPLAYLIST_FIRST_ELEMENTS       =1;
    const TEL_DIALEDNUMBERS_DISPLAYLIST_SEARCH_ELEMENTS      =2;
    byte gDialedNumbers_DisplayStatus                        =TEL_DIALEDNUMBERS_DISPLAYLIST_FIRST_ELEMENTS;                                      

    const TEL_DIALEDNUMBERS_DISPLAYLIST_FIND_NEXT_ELEMENT        =0;
    const TEL_DIALEDNUMBERS_DISPLAYLIST_FIND_PREVIUOS_ELEMENT    =1;


    byte gDialedNumbers_LastElement           =0;
    byte gDialedNumbers_FirstElement          =0;
    byte gDialedNumbers_DownCaching_required  =FALSE;
    byte gDialedNumbers_UpCaching_required    =FALSE;
    byte gDialedNumbers_MoveList_down_allowed =FALSE;
    byte gDialedNumbers_MoveList_up_allowed   =FALSE;
}
/*@@end*/

/*@@startStart:Start:*/
on start
{
	//Power on/off
	gBAP_Init=0;
	gRNS_PowerOnOff=0;
	putvalue(env_RNS_string_Power_on_off, gstring_RNS_PowerOnOff[gRNS_PowerOnOff]);
	//EnableControl("JagAelskarSverige","ExtendedArrayHeader", 0);
	EnableControl("ASG-SlindingWindow","ASG_SlW", 0);

	//delte of single entries in call stacks disabled
	EnableControl("","DeleteSingleCallStackEntry", 0);

    putvalue(env_ASG_Schalter_OnOff_string, gASG_Schalter_OnOff_string[gASG_Schalter_OnOff]);
    OpenPanel("ASG-Telephone_Schalter");
}
/*@@end*/

/*@@caplFunc:init_variables_Telephone():*/
init_variables_Telephone ()
{

int i=0, j=0;
char empty_string [3];

//init lokal variables
	for(i=0;i<3;i++)
		empty_string[i]=0;
//********************


//*************************************************************************
//******************************properties*********************************
//*************************************************************************
	
	//FSG-Setup
	//property FSG-Setup
	gSIMCardReader=0;
	gCableConnection=0;
	gHFPConnection=0;
	gRSAPConnection=0;
	gPhoneCharacteristics=gSIMCardReader+2*gCableConnection+4*gHFPConnection+8*gRSAPConnection;
	gMobileConnectionType=0;
	gNumberofUserProfiles=0;
	gPhoneType=0;
	gNumberofUserProfiles=0;
	putvalue(env_RNS_SIMCardReader, empty_string);
	putvalue(env_RNS_CableConnection, empty_string);
	putvalue(env_RNS_HFPConnection, empty_string);
	putvalue(env_RNS_RSAPConnection, empty_string);
	putvalue(env_RNS_MobileConnectionType, empty_string);
	putvalue(env_RNS_Telephone_UserProfiles, 0);
	putvalue(env_RNS_Telephone_PhoneType, empty_string);	

	//FSG-OperationState
	gFSG_OperationState_OP_State=0;
	putvalue(env_RNS_Telephone_FSG_opstate, empty_string);

	//MobileServiceSupport
    putvalue(env_ASG_MobileServSupp_Bit1,0);
    putvalue(env_ASG_MobileServSupp_Bit2,0);
    putvalue(env_ASG_MobileServSupp_Bit3,0);
    putvalue(env_ASG_MobileServSupp_Bit4,0);
    putvalue(env_ASG_MobileServSupp_Bit14,0);
    putvalue(env_ASG_MobileServSupp_Bit15,0);
    putvalue(env_ASG_MobileServSupp_Bit16,0);
    putvalue(env_ASG_MobileServSupp_Bit17,0);
    putvalue(env_ASG_MobileServSupp_Bit18,0);
    putvalue(env_ASG_MobileServSupp_Bit19,0);
    putvalue(env_ASG_MobileServSupp_Bit20,0);
    putvalue(env_ASG_MobileServSupp_Bit21,0);
    putvalue(env_ASG_MobileServSupp_Bit22,0);
    putvalue(env_ASG_MobileServSupp_Bit23,0);
    putvalue(env_ASG_MobileServSupp_Bit24,0);
    putvalue(env_ASG_MobileServSupp_Bit25,0);
    putvalue(env_ASG_MobileServSupp_Bit26,0);
    putvalue(env_ASG_MobileServSupp_Bit27,0);
    putvalue(env_ASG_MobileServSupp_Bit28,0);
    putvalue(env_ASG_MobileServSupp_Bit29,0);
    putvalue(env_ASG_MobileServSupp_Bit30,0);
    putvalue(env_ASG_MobileServSupp_Bit31,0);
    putvalue(env_ASG_MobileServSupp_Bit32,0);
    putvalue(env_ASG_MobileServSupp_Bit33,0);
    putvalue(env_ASG_MobileServSupp_Bit34,0);
    putvalue(env_ASG_MobileServSupp_Bit35,0);
    putvalue(env_ASG_MobileServSupp_Bit36,0);
    putvalue(env_ASG_MobileServSupp_Bit37,0);
    putvalue(env_ASG_MobileServSupp_Bit38,0);
    putvalue(env_ASG_MobileServSupp_Bit39,0);
    putvalue(env_ASG_MobileServSupp_Bit40,0);
    putvalue(env_ASG_MobileServSupp_Bit41,0);
    putvalue(env_ASG_MobileServSupp_Bit42,0);
    putvalue(env_ASG_MobileServSupp_Bit43,0);
    putvalue(env_ASG_MobileServSupp_Bit44,0);
    putvalue(env_ASG_MobileServSupp_Bit45,0);
    putvalue(env_ASG_MobileServSupp_Bit46,0);
    putvalue(env_ASG_MobileServSupp_Bit47,0);
    putvalue(env_ASG_MobileServSupp_Bit48,0);
    putvalue(env_ASG_MobileServSupp_Bit49,0);
    putvalue(env_ASG_MobileServSupp_Bit50,0);
    putvalue(env_ASG_MobileServSupp_Bit51,0);
    putvalue(env_ASG_MobileServSupp_Bit52,0);
    putvalue(env_ASG_MobileServSupp_Bit53,0);
    putvalue(env_ASG_MobileServSupp_Bit54,0);
    putvalue(env_ASG_MobileServSupp_Bit55,0);

    //active user

	for(i=0;i<50;i++)
		gActiveUserName[i]=0;
	putvalue(env_RNS_SIMSerial, empty_string);
	putvalue(env_RNS_SerialNumber, empty_string);
	putvalue(env_RNS_ActiveUserName, empty_string);

	//register state
	gRegisterState=0;
	putvalue(env_RNS_RegisterState, empty_string);

	//lock state
	gLockState=0;
	putvalue(env_RNS_LockState, empty_string);

	//network provider name
	for (i=0;i<20;i++)
		gNetworkProvider_name [i]=0;
	putvalue(env_RNS_networkprovider_name,empty_string);

	//signal quality
	enablecontrol("ASG-Telephone", "signalqualityslider", 0);
	gSignalQuality=0;
	putvalue(env_RNS_SignalQuality, gSignalQuality);

	//net info
	gNetInfoCallDivert=0;
	gNetInfoCiphering=0;
	putvalue(env_RNS_NetInfoCalldivert, empty_string);
	putvalue(env_RNS_NetInfoCiphering, empty_string);
	
	//disconnect reason
	gDisconnectReason=0;
	putvalue(env_RNS_DisconReason_DR, empty_string);	
	
	//call state
	for(i=0;i<7;i++)
		gCallState[i]=0;
	putvalue(env_RNS_CallState_CallID_0,empty_string);
	putvalue(env_RNS_CallState_CallID_1,empty_string);
	putvalue(env_RNS_CallState_CallID_2,empty_string);
	putvalue(env_RNS_CallState_CallID_3,empty_string);
	putvalue(env_RNS_CallState_CallID_4,empty_string);
	putvalue(env_RNS_CallState_CallID_5,empty_string);
	putvalue(env_RNS_CallState_CallID_6,empty_string);
	for(i=0;i<7;i++)
		gCallType[i]=0;
	putvalue(env_RNS_CallType_CallID_0,empty_string);
	putvalue(env_RNS_CallType_CallID_1,empty_string);
	putvalue(env_RNS_CallType_CallID_2,empty_string);
	putvalue(env_RNS_CallType_CallID_3,empty_string);
	putvalue(env_RNS_CallType_CallID_4,empty_string);
	putvalue(env_RNS_CallType_CallID_5,empty_string);
	putvalue(env_RNS_CallType_CallID_6,empty_string);
	
    //CallInDivert
	gCallInDivert=0;
	putvalue(env_RNS_CallState_CallInDivert_0, 0);
	putvalue(env_RNS_CallState_CallInDivert_1, 0);
	putvalue(env_RNS_CallState_CallInDivert_2, 0);
	putvalue(env_RNS_CallState_CallInDivert_3, 0);
	putvalue(env_RNS_CallState_CallInDivert_4, 0);
	putvalue(env_RNS_CallState_CallInDivert_5, 0);
	putvalue(env_RNS_CallState_CallInDivert_6, 0);

    //CallOutDivert
	gCallOutDivert=0;
	putvalue(env_RNS_CallState_CallOuDivert_0, 0);
	putvalue(env_RNS_CallState_CallOuDivert_1, 0);
	putvalue(env_RNS_CallState_CallOuDivert_2, 0);
	putvalue(env_RNS_CallState_CallOuDivert_3, 0);
	putvalue(env_RNS_CallState_CallOuDivert_4, 0);
	putvalue(env_RNS_CallState_CallOuDivert_5, 0);
	putvalue(env_RNS_CallState_CallOuDivert_6, 0);


    //CallDurationSync
    for (i=0;i<7;i++)
        gTimeStampCall[i] =0;
   
    putvalue(env_RNS_CallDuration_Sync_TS_0, 0);
    putvalue(env_RNS_CallDuration_Sync_TS_1, 0);
    putvalue(env_RNS_CallDuration_Sync_TS_2, 0);
    putvalue(env_RNS_CallDuration_Sync_TS_3, 0);
    putvalue(env_RNS_CallDuration_Sync_TS_4, 0);
    putvalue(env_RNS_CallDuration_Sync_TS_5, 0);
    putvalue(env_RNS_CallDuration_Sync_TS_6, 0);	

	//HandsFree
	gHandsFree=1;
	putvalue(env_RNS_HandsFreeOnOff, gHandsFree);
	putvalue(env_RNS_HandsFree_string, empty_string);

	//MicroMute
	gMicroMute=0;
	putvalue(env_RNS_MicroMuteOnOff, gMicroMute);
	putvalue(env_RNS_MicroMute_string, empty_string);

    //MPCallHold
	//RingToneMuteOnOff
	gRingToneMute=0;
	putvalue(env_RNS_RingToneMuteOnOff, gRingToneMute);
	putvalue(env_RNS_string_RingToneMuteOnOff, gstring_RingToneMute[gRingToneMute]);

    // AutomaticRedial
    gAutomaticRedialState = 0;
    putvalue(env_ASG_AutomaticRedial_State, gAutomaticRedialState);
    putvalue(env_ASG_AutomaticRedial_StateS, gAutomaticRedialState_String[gAutomaticRedialState]);

    //Keypad
    gKeyStatus=0;
    putvalue(env_RNS_Keypad_Bit0, empty_string);
    putvalue(env_RNS_Keypad_Bit1, empty_string);
    putvalue(env_RNS_Keypad_Bit2, empty_string);
    putvalue(env_RNS_Keypad_Bit3, empty_string);
    putvalue(env_RNS_Keypad_Bit4, empty_string);
    putvalue(env_RNS_Keypad_Bit5, empty_string);
    
    //MobileBatteryLevel    
    gChargeLevelMobile_1 =0;
    gChargeLevelMobile_2 =0;
    gChargeLevelHandset_1 =0;								
    gChargeLevelHandset_2 =0;
    gWarningLevel         =0;

    putvalue(env_RNS_MobileBatLevel_CL_Mob1, 0);
    putvalue(env_RNS_MobileBatLevel_CL_Mob2, 0);
    putvalue(env_RNS_MobileBatLevel_CL_Hand1, 0);
    putvalue(env_RNS_MobileBatLevel_CL_Hand2, 0);

    putvalue(env_RNS_MobileBatLevel_CL_Bit0, empty_string);
    putvalue(env_RNS_MobileBatLevel_CL_Bit1, empty_string);
    putvalue(env_RNS_MobileBatLevel_CL_Bit2, empty_string);
    putvalue(env_RNS_MobileBatLevel_CL_Bit3, empty_string);

    //DataConnectionIndication
    putvalue(env_RNS_DataConInd_CI, empty_string);
    putvalue(env_RNS_DataConInd_DVUplink,0);
    putvalue(env_RNS_DataConInd_DVDownlink,0);

    //MissedCallIndication
    gMissedCalls =0;
    gMissedNumbers =0;
    
    putvalue(env_RNS_MissedCallInd_Calls, 0);
    putvalue(env_RNS_MissedCallInd_Numbers, 0);

    //CallInfo
    gDownloadState =0;
    gPbEntriesUHV =0;

    putvalue(env_RNS_PbState_DownloadState, empty_string);
    putvalue(env_RNS_PbState_PbEntriesUHV, 0);

    //property SMSState
	gSMSStateSIMReady=0;
	gSMSStateStorageState=0;
	gSMSStateNumberOfNewSMS=0;
	putvalue(env_ASG_UHV_SMSStateSIMReady, empty_string);
	putvalue(env_ASG_UHV_SMSStateStorage, empty_string);
	putvalue(env_ASG_UHV_SMSStateNewSMS, gSMSStateNumberOfNewSMS);
    
    //property RingToneMute
    gRingToneMute=0;
	putvalue(env_RNS_RingToneMuteOnOff, gRingToneMute);
	putvalue(env_RNS_RingToneMute_string, gstring_RingToneMute[gRingToneMute]);

    // property AutomaticRedialState
    gAutomaticRedialState = 0;
    putvalue(env_ASG_AutomaticRedial_State, gAutomaticRedialState);
    putvalue(env_ASG_AutomaticRedial_StateS, gAutomaticRedialState_String[gAutomaticRedialState]);

    //property PbState
    gDownloadState=0;
    gPbEntriesUHV =0;
	putvalue(env_RNS_Pb_DownloadState, empty_string);
	putvalue(env_RNS_PbEntriesUHV, gPbEntriesUHV);
//*************************************************************************
//******************************methods************************************
//*************************************************************************

	//phone enable
	gCodeType=0;
	for(i=0;i<20;i++)
		gPINCode[i]=0;
	putvalue(env_RNS_PINcode, empty_string);
	
	//dialnumber
	gcallID=0;
	for(i=0;i<CALL_INFO_NUMBER_LENGTH;i++)
		gDialNumber[i]=0;
	for(i=0;i<40;i++)
		gdialnumber_name[i]=0;

	//SendDTMF
	for(i=0;i<40;i++)
		gDTMF_Character[i]=0;
	
	//CCSplit
	gCCSplitCallID=0;

	//PhoneOnOff
	putvalue(env_ASG_UHV_PhoneOnOff, 2);

//*************************************************************************
//******************************arrays*************************************
//*************************************************************************
	
//CallStacks
    //Missedcalls
    gmissedcalls_ASG_ID=0;
    gmissedcalls_TAID=0;
    gmissedcalls_FullRangeUpdate=0;
    gmissedcalls_insert_fullblocks=0;
    gmissedcalls_insert_active=FALSE;

	//CallInfo
	for(j=0;j<7;j++){
		for(i=0;i<CALL_INFO_NAME_LENGTH;i++)			
			gcallinfo_name[j][i]=0;
		
        for(i=0;i<CALL_INFO_NUMBER_LENGTH;i++)				
			gcallinfo_number[j][i]=0;
        
        gcallinfo_category[j]=0;
	}
	//PbName
	putvalue(env_RNS_CallInfo_PbName_0, gcallinfo_name[0]);
	putvalue(env_RNS_CallInfo_PbName_1, gcallinfo_name[1]);
	putvalue(env_RNS_CallInfo_PbName_2, gcallinfo_name[2]);
	putvalue(env_RNS_CallInfo_PbName_3, gcallinfo_name[3]);
	putvalue(env_RNS_CallInfo_PbName_4, gcallinfo_name[4]);
	putvalue(env_RNS_CallInfo_PbName_5, gcallinfo_name[5]);
	putvalue(env_RNS_CallInfo_PbName_6, gcallinfo_name[6]);
	//TelNumber
	putvalue(env_RNS_CallInfo_TelNumber_0, gcallinfo_number[0]);
	putvalue(env_RNS_CallInfo_TelNumber_1, gcallinfo_number[1]);
	putvalue(env_RNS_CallInfo_TelNumber_2, gcallinfo_number[2]);
	putvalue(env_RNS_CallInfo_TelNumber_3, gcallinfo_number[3]);
	putvalue(env_RNS_CallInfo_TelNumber_4, gcallinfo_number[4]);
	putvalue(env_RNS_CallInfo_TelNumber_5, gcallinfo_number[5]);
	putvalue(env_RNS_CallInfo_TelNumber_6, gcallinfo_number[6]);
    //Category
	putvalue(env_RNS_CallInfo_Category_0, empty_string);
    putvalue(env_RNS_CallInfo_Category_1, empty_string);
    putvalue(env_RNS_CallInfo_Category_2, empty_string);
    putvalue(env_RNS_CallInfo_Category_3, empty_string);
    putvalue(env_RNS_CallInfo_Category_4, empty_string);
    putvalue(env_RNS_CallInfo_Category_5, empty_string);
    putvalue(env_RNS_CallInfo_Category_6, empty_string);

    
    //CombinedNumbers
    gCombinedNumbers_ASGID                =0;
    gCombinedNumbers_TAID                 =0;
    gCombinedNumbers_TotalNumListElements =0;
    
    for(j=0; j<TEL_COMBINEDNUMBERS_ASGCACHE_MAX_SIZE; j++)
    {     
        gCombinedNumbers_Pos[j]                               =0;
        gCombinedNumbers_ListEntryReceptionInformation[j]     =0;
        gCombinedNumbers_CallMode[j]                          =0;
        gCombinedNumbers_day[j]                               =0;
        gCombinedNumbers_month[j]                             =0;
        gCombinedNumbers_year[j]                              =0;
        gCombinedNumbers_hour[j]                              =0;
        gCombinedNumbers_minute[j]                            =0;
        gCombinedNumbers_second[j]                            =0;

        for(i=0;i<TEL_COMBINEDNUMBERS_PBNAME_LENGTH;i++)
			gCombinedNumbers_PbName[j][i] =0;

        for(i=0;i<TEL_COMBINEDNUMBERS_TELNUMBER_LENGTH;i++)
			gCombinedNumbers_TelNumber[j][i] =0;
    }
    gCombinedNumbers_SlidingWindow_State   =TEL_COMBINEDNUMBERS_SLIDINGWINDOW_NOTACTIVE;
    gCombinedNumbers_ListHandlingType      =TEL_COMBINEDNUMBERS_NOCACHE;
    gCombinedNumbers_cacheBuildUp          =TEL_COMBINEDNUMBERS_BUILDUPCACHENOCACHE;
    gCombinedNumbers_CallBackReason        =TEL_COMBINEDNUMBERS_CALLBACKREASON_NOCALLBACK;

    gCombinedNumbers_cacheDown             =FALSE;
    gCombinedNumbers_cacheUp               =FALSE;
    gCombinedNumbers_LastFirstElement      =0;

    gCombinedNumbers_recordaddress         =0;
    gCombinedNumbers_transmitpos           =FALSE;
    gCombinedNumbers_CursorAction          =TEL_COMBINEDNUMBERS_CURSORACTION_NOTHING;
    gCombinedNumbers_DisplayStatus         =TEL_COMBINEDNUMBERS_DISPLAYLIST_FIRST_ELEMENTS;
    gCombinedNumbers_LastElement           =0;
    gCombinedNumbers_FirstElement          =0;
    gCombinedNumbers_DownCaching_required  =FALSE;
    gCombinedNumbers_UpCaching_required    =FALSE; 
    gCombinedNumbers_MoveList_down_allowed =FALSE; 
    gCombinedNumbers_MoveList_up_allowed   =FALSE; 

    putvalue(env_ASG_CN_ASGID, gCombinedNumbers_ASGID);
    putvalue(env_ASG_CN_TAID, gCombinedNumbers_TAID);
    putvalue(env_ASG_CN_TotalNumLE, gCombinedNumbers_TotalNumListElements);
    putvalue(env_ASG_CN_AH_shift, 0);
    putvalue(env_ASG_CN_AH_dir, FORWARD);
    putvalue(env_ASG_CN_AH_IS, FALSE);
    putvalue(env_ASG_CN_AH_PosTrans, gCombinedNumbers_transmitpos);
    putvalue(env_ASG_CN_AH_RA, gCombinedNumbers_recordaddress);
    putvalue(env_ASG_CN_AH_start, 0);
    putvalue(env_ASG_CN_AH_elements, 3);
    putvalue(env_ASG_CN_ListOpState, empty_string);

    putvalue(env_ASG_CN_pos_0, 0);
    putvalue(env_ASG_CN_pos_1, 0);
    putvalue(env_ASG_CN_pos_2, 0);
    
    putvalue(env_ASG_CN_CallMode_0, 0);
    putvalue(env_ASG_CN_CallMode_1, 0);
    putvalue(env_ASG_CN_CallMode_2, 0);

    putvalue(env_ASG_CN_CallMode_s_0,empty_string);
    putvalue(env_ASG_CN_CallMode_s_1,empty_string);
    putvalue(env_ASG_CN_CallMode_s_2,empty_string);

    putvalue(env_ASG_CN_day_0, 0);
    putvalue(env_ASG_CN_day_1, 0);
    putvalue(env_ASG_CN_day_2, 0);

    putvalue(env_ASG_CN_month_0, 0);
    putvalue(env_ASG_CN_month_1, 0);
    putvalue(env_ASG_CN_month_2, 0);

    putvalue(env_ASG_CN_year_0, 0);
    putvalue(env_ASG_CN_year_1, 0);
    putvalue(env_ASG_CN_year_2, 0);

    putvalue(env_ASG_CN_hour_0, 0);
    putvalue(env_ASG_CN_hour_1, 0);
    putvalue(env_ASG_CN_hour_2, 0);

    putvalue(env_ASG_CN_minute_0, 0);
    putvalue(env_ASG_CN_minute_1, 0);
    putvalue(env_ASG_CN_minute_2, 0);

    putvalue(env_ASG_CN_second_0, 0);
    putvalue(env_ASG_CN_second_1, 0);
    putvalue(env_ASG_CN_second_2, 0);

    putvalue(env_ASG_CN_OnOff, FALSE);
    
    putvalue(env_ASG_CN_ListInfo_up,empty_string);
    putvalue(env_ASG_CN_ListInfo_down,empty_string);
    putvalue(env_ASG_CN_ListInfo_Cursor,empty_string);

    enableControl("ASG_Telephone_0x31 - CombinedNumbers_EditCache", "env_ASG_CN_pos_01", 0);
    enableControl("ASG_Telephone_0x31 - CombinedNumbers_EditCache", "env_ASG_CN_PbName_s_01", 0);
    enableControl("ASG_Telephone_0x31 - CombinedNumbers_EditCache", "env_ASG_CN_TelNum_s_01", 0);
    enableControl("ASG_Telephone_0x31 - CombinedNumbers_EditCache", "env_ASG_CN_CallMode_01", 0);
    enableControl("ASG_Telephone_0x31 - CombinedNumbers_EditCache", "env_ASG_CN_day_01", 0);
    enableControl("ASG_Telephone_0x31 - CombinedNumbers_EditCache", "env_ASG_CN_month_01", 0);
    enableControl("ASG_Telephone_0x31 - CombinedNumbers_EditCache", "env_ASG_CN_year_01", 0);
    enableControl("ASG_Telephone_0x31 - CombinedNumbers_EditCache", "env_ASG_CN_hour_01", 0);
    enableControl("ASG_Telephone_0x31 - CombinedNumbers_EditCache", "env_ASG_CN_minute_01", 0);
    enableControl("ASG_Telephone_0x31 - CombinedNumbers_EditCache", "env_ASG_CN_second_01", 0);


    enableControl("ASG_Telephone_0x31 - CombinedNumbers_EditCache", "env_ASG_CN_pos_02", 0);
    enableControl("ASG_Telephone_0x31 - CombinedNumbers_EditCache", "env_ASG_CN_PbName_s_02", 0);
    enableControl("ASG_Telephone_0x31 - CombinedNumbers_EditCache", "env_ASG_CN_TelNum_s_02", 0);
    enableControl("ASG_Telephone_0x31 - CombinedNumbers_EditCache", "env_ASG_CN_CallMode_02", 0);
    enableControl("ASG_Telephone_0x31 - CombinedNumbers_EditCache", "env_ASG_CN_day_02", 0);
    enableControl("ASG_Telephone_0x31 - CombinedNumbers_EditCache", "env_ASG_CN_month_02", 0);
    enableControl("ASG_Telephone_0x31 - CombinedNumbers_EditCache", "env_ASG_CN_year_02", 0);
    enableControl("ASG_Telephone_0x31 - CombinedNumbers_EditCache", "env_ASG_CN_hour_02", 0);
    enableControl("ASG_Telephone_0x31 - CombinedNumbers_EditCache", "env_ASG_CN_minute_02", 0);
    enableControl("ASG_Telephone_0x31 - CombinedNumbers_EditCache", "env_ASG_CN_second_02", 0);


    enableControl("ASG_Telephone_0x31 - CombinedNumbers_EditCache", "env_ASG_CN_pos_03", 0);
    enableControl("ASG_Telephone_0x31 - CombinedNumbers_EditCache", "env_ASG_CN_PbName_s_03", 0);
    enableControl("ASG_Telephone_0x31 - CombinedNumbers_EditCache", "env_ASG_CN_TelNum_s_03", 0);
    enableControl("ASG_Telephone_0x31 - CombinedNumbers_EditCache", "env_ASG_CN_CallMode_03", 0);
    enableControl("ASG_Telephone_0x31 - CombinedNumbers_EditCache", "env_ASG_CN_day_03", 0);
    enableControl("ASG_Telephone_0x31 - CombinedNumbers_EditCache", "env_ASG_CN_month_03", 0);
    enableControl("ASG_Telephone_0x31 - CombinedNumbers_EditCache", "env_ASG_CN_year_03", 0);
    enableControl("ASG_Telephone_0x31 - CombinedNumbers_EditCache", "env_ASG_CN_hour_03", 0);
    enableControl("ASG_Telephone_0x31 - CombinedNumbers_EditCache", "env_ASG_CN_minute_03", 0);
    enableControl("ASG_Telephone_0x31 - CombinedNumbers_EditCache", "env_ASG_CN_second_03", 0);


    enableControl("ASG_Telephone_0x31 - CombinedNumbers_EditCache", "env_ASG_CN_pos_11", 0);
    enableControl("ASG_Telephone_0x31 - CombinedNumbers_EditCache", "env_ASG_CN_PbName_s_11", 0);
    enableControl("ASG_Telephone_0x31 - CombinedNumbers_EditCache", "env_ASG_CN_TelNum_s_11", 0);
    enableControl("ASG_Telephone_0x31 - CombinedNumbers_EditCache", "env_ASG_CN_CallMode_11", 0);
    enableControl("ASG_Telephone_0x31 - CombinedNumbers_EditCache", "env_ASG_CN_day_11", 0);
    enableControl("ASG_Telephone_0x31 - CombinedNumbers_EditCache", "env_ASG_CN_month_11", 0);
    enableControl("ASG_Telephone_0x31 - CombinedNumbers_EditCache", "env_ASG_CN_year_11", 0);
    enableControl("ASG_Telephone_0x31 - CombinedNumbers_EditCache", "env_ASG_CN_hour_11", 0);
    enableControl("ASG_Telephone_0x31 - CombinedNumbers_EditCache", "env_ASG_CN_minute_11", 0);
    enableControl("ASG_Telephone_0x31 - CombinedNumbers_EditCache", "env_ASG_CN_second_11", 0);


    enableControl("ASG_Telephone_0x31 - CombinedNumbers_EditCache", "env_ASG_CN_pos_12", 0);
    enableControl("ASG_Telephone_0x31 - CombinedNumbers_EditCache", "env_ASG_CN_PbName_s_12", 0);
    enableControl("ASG_Telephone_0x31 - CombinedNumbers_EditCache", "env_ASG_CN_TelNum_s_12", 0);
    enableControl("ASG_Telephone_0x31 - CombinedNumbers_EditCache", "env_ASG_CN_CallMode_12", 0);
    enableControl("ASG_Telephone_0x31 - CombinedNumbers_EditCache", "env_ASG_CN_day_12", 0);
    enableControl("ASG_Telephone_0x31 - CombinedNumbers_EditCache", "env_ASG_CN_month_12", 0);
    enableControl("ASG_Telephone_0x31 - CombinedNumbers_EditCache", "env_ASG_CN_year_12", 0);
    enableControl("ASG_Telephone_0x31 - CombinedNumbers_EditCache", "env_ASG_CN_hour_12", 0);
    enableControl("ASG_Telephone_0x31 - CombinedNumbers_EditCache", "env_ASG_CN_minute_12", 0);
    enableControl("ASG_Telephone_0x31 - CombinedNumbers_EditCache", "env_ASG_CN_second_12", 0);


    enableControl("ASG_Telephone_0x31 - CombinedNumbers_EditCache", "env_ASG_CN_pos_13", 0);
    enableControl("ASG_Telephone_0x31 - CombinedNumbers_EditCache", "env_ASG_CN_PbName_s_13", 0);
    enableControl("ASG_Telephone_0x31 - CombinedNumbers_EditCache", "env_ASG_CN_TelNum_s_13", 0);
    enableControl("ASG_Telephone_0x31 - CombinedNumbers_EditCache", "env_ASG_CN_CallMode_13", 0);
    enableControl("ASG_Telephone_0x31 - CombinedNumbers_EditCache", "env_ASG_CN_day_13", 0);
    enableControl("ASG_Telephone_0x31 - CombinedNumbers_EditCache", "env_ASG_CN_month_13", 0);
    enableControl("ASG_Telephone_0x31 - CombinedNumbers_EditCache", "env_ASG_CN_year_13", 0);
    enableControl("ASG_Telephone_0x31 - CombinedNumbers_EditCache", "env_ASG_CN_hour_13", 0);
    enableControl("ASG_Telephone_0x31 - CombinedNumbers_EditCache", "env_ASG_CN_minute_13", 0);
    enableControl("ASG_Telephone_0x31 - CombinedNumbers_EditCache", "env_ASG_CN_second_13", 0);
       

    enableControl("ASG_Telephone_0x31 - CombinedNumbers_EditCache", "env_ASG_CN_pos_21", 0);
    enableControl("ASG_Telephone_0x31 - CombinedNumbers_EditCache", "env_ASG_CN_PbName_s_21", 0);
    enableControl("ASG_Telephone_0x31 - CombinedNumbers_EditCache", "env_ASG_CN_TelNum_s_21", 0);
    enableControl("ASG_Telephone_0x31 - CombinedNumbers_EditCache", "env_ASG_CN_CallMode_21", 0);
    enableControl("ASG_Telephone_0x31 - CombinedNumbers_EditCache", "env_ASG_CN_day_21", 0);
    enableControl("ASG_Telephone_0x31 - CombinedNumbers_EditCache", "env_ASG_CN_month_21", 0);
    enableControl("ASG_Telephone_0x31 - CombinedNumbers_EditCache", "env_ASG_CN_year_21", 0);
    enableControl("ASG_Telephone_0x31 - CombinedNumbers_EditCache", "env_ASG_CN_hour_21", 0);
    enableControl("ASG_Telephone_0x31 - CombinedNumbers_EditCache", "env_ASG_CN_minute_21", 0);
    enableControl("ASG_Telephone_0x31 - CombinedNumbers_EditCache", "env_ASG_CN_second_21", 0);


    enableControl("ASG_Telephone_0x31 - CombinedNumbers_EditCache", "env_ASG_CN_pos_22", 0);
    enableControl("ASG_Telephone_0x31 - CombinedNumbers_EditCache", "env_ASG_CN_PbName_s_22", 0);
    enableControl("ASG_Telephone_0x31 - CombinedNumbers_EditCache", "env_ASG_CN_TelNum_s_22", 0);
    enableControl("ASG_Telephone_0x31 - CombinedNumbers_EditCache", "env_ASG_CN_CallMode_22", 0);
    enableControl("ASG_Telephone_0x31 - CombinedNumbers_EditCache", "env_ASG_CN_day_22", 0);
    enableControl("ASG_Telephone_0x31 - CombinedNumbers_EditCache", "env_ASG_CN_month_22", 0);
    enableControl("ASG_Telephone_0x31 - CombinedNumbers_EditCache", "env_ASG_CN_year_22", 0);
    enableControl("ASG_Telephone_0x31 - CombinedNumbers_EditCache", "env_ASG_CN_hour_22", 0);
    enableControl("ASG_Telephone_0x31 - CombinedNumbers_EditCache", "env_ASG_CN_minute_22", 0);
    enableControl("ASG_Telephone_0x31 - CombinedNumbers_EditCache", "env_ASG_CN_second_22", 0);


    enableControl("ASG_Telephone_0x31 - CombinedNumbers_EditCache", "env_ASG_CN_pos_23", 0);
    enableControl("ASG_Telephone_0x31 - CombinedNumbers_EditCache", "env_ASG_CN_PbName_s_23", 0);
    enableControl("ASG_Telephone_0x31 - CombinedNumbers_EditCache", "env_ASG_CN_TelNum_s_23", 0);
    enableControl("ASG_Telephone_0x31 - CombinedNumbers_EditCache", "env_ASG_CN_CallMode_23", 0);
    enableControl("ASG_Telephone_0x31 - CombinedNumbers_EditCache", "env_ASG_CN_day_23", 0);
    enableControl("ASG_Telephone_0x31 - CombinedNumbers_EditCache", "env_ASG_CN_month_23", 0);
    enableControl("ASG_Telephone_0x31 - CombinedNumbers_EditCache", "env_ASG_CN_year_23", 0);
    enableControl("ASG_Telephone_0x31 - CombinedNumbers_EditCache", "env_ASG_CN_hour_23", 0);
    enableControl("ASG_Telephone_0x31 - CombinedNumbers_EditCache", "env_ASG_CN_minute_23", 0);
    enableControl("ASG_Telephone_0x31 - CombinedNumbers_EditCache", "env_ASG_CN_second_23", 0);

    
    //ReceivedCalls
    gReceivedCalls_ASGID                =0;
    gReceivedCalls_TAID                 =0;
    gReceivedCalls_TotalNumListElements =0;
    
    for(j=0; j<TEL_RECEIVEDCALLS_ASGCACHE_MAX_SIZE; j++)
    {     
        gReceivedCalls_Pos[j]                               =0;
        gReceivedCalls_ListEntryReceptionInformation[j]     =0;
        gReceivedCalls_NumberType[j]                          =0;
        gReceivedCalls_day[j]                               =0;
        gReceivedCalls_month[j]                             =0;
        gReceivedCalls_year[j]                              =0;
        gReceivedCalls_hour[j]                              =0;
        gReceivedCalls_minute[j]                            =0;
        gReceivedCalls_second[j]                            =0;

        for(i=0;i<TEL_RECEIVEDCALLS_PBNAME_LENGTH;i++)
			gReceivedCalls_PbName[j][i] =0;

        for(i=0;i<TEL_RECEIVEDCALLS_TELNUMBER_LENGTH;i++)
			gReceivedCalls_TelNumber[j][i] =0;
    }
    gReceivedCalls_SlidingWindow_State   =TEL_RECEIVEDCALLS_SLIDINGWINDOW_NOTACTIVE;
    gReceivedCalls_ListHandlingType      =TEL_RECEIVEDCALLS_NOCACHE;
    gReceivedCalls_cacheBuildUp          =TEL_RECEIVEDCALLS_BUILDUPCACHENOCACHE;
    gReceivedCalls_CallBackReason        =TEL_RECEIVEDCALLS_CALLBACKREASON_NOCALLBACK;

    gReceivedCalls_cacheDown             =FALSE;
    gReceivedCalls_cacheUp               =FALSE;
    gReceivedCalls_LastFirstElement      =0;

    gReceivedCalls_recordaddress         =0;
    gReceivedCalls_transmitpos           =FALSE;
    gReceivedCalls_CursorAction          =TEL_RECEIVEDCALLS_CURSORACTION_NOTHING;
    gReceivedCalls_DisplayStatus         =TEL_RECEIVEDCALLS_DISPLAYLIST_FIRST_ELEMENTS;
    gReceivedCalls_LastElement           =0;
    gReceivedCalls_FirstElement          =0;
    gReceivedCalls_DownCaching_required  =FALSE;
    gReceivedCalls_UpCaching_required    =FALSE; 
    gReceivedCalls_MoveList_down_allowed =FALSE; 
    gReceivedCalls_MoveList_up_allowed   =FALSE; 

    putvalue(env_ASG_RC_ASGID, gReceivedCalls_ASGID);
    putvalue(env_ASG_RC_TAID, gReceivedCalls_TAID);
    putvalue(env_ASG_RC_TotalNumLE, gReceivedCalls_TotalNumListElements);
    putvalue(env_ASG_RC_AH_shift, 0);
    putvalue(env_ASG_RC_AH_dir, FORWARD);
    putvalue(env_ASG_RC_AH_IS, FALSE);
    putvalue(env_ASG_RC_AH_PosTrans, gReceivedCalls_transmitpos);
    putvalue(env_ASG_RC_AH_RA, gReceivedCalls_recordaddress);
    putvalue(env_ASG_RC_AH_start, 0);
    putvalue(env_ASG_RC_AH_elements, 3);
    putvalue(env_ASG_RC_ListOpState, empty_string);

    putvalue(env_ASG_RC_pos_0, 0);
    putvalue(env_ASG_RC_pos_1, 0);
    putvalue(env_ASG_RC_pos_2, 0);
    
    putvalue(env_ASG_RC_NumType_0, 0);
    putvalue(env_ASG_RC_NumType_1, 0);
    putvalue(env_ASG_RC_NumType_2, 0);

    putvalue(env_ASG_RC_NumType_s_0,empty_string);
    putvalue(env_ASG_RC_NumType_s_1,empty_string);
    putvalue(env_ASG_RC_NumType_s_2,empty_string);

    putvalue(env_ASG_RC_day_0, 0);
    putvalue(env_ASG_RC_day_1, 0);
    putvalue(env_ASG_RC_day_2, 0);

    putvalue(env_ASG_RC_month_0, 0);
    putvalue(env_ASG_RC_month_1, 0);
    putvalue(env_ASG_RC_month_2, 0);

    putvalue(env_ASG_RC_year_0, 0);
    putvalue(env_ASG_RC_year_1, 0);
    putvalue(env_ASG_RC_year_2, 0);

    putvalue(env_ASG_RC_hour_0, 0);
    putvalue(env_ASG_RC_hour_1, 0);
    putvalue(env_ASG_RC_hour_2, 0);

    putvalue(env_ASG_RC_minute_0, 0);
    putvalue(env_ASG_RC_minute_1, 0);
    putvalue(env_ASG_RC_minute_2, 0);

    putvalue(env_ASG_RC_second_0, 0);
    putvalue(env_ASG_RC_second_1, 0);
    putvalue(env_ASG_RC_second_2, 0);

    putvalue(env_ASG_RC_OnOff, FALSE);
    
    putvalue(env_ASG_RC_ListInfo_up,empty_string);
    putvalue(env_ASG_RC_ListInfo_down,empty_string);
    putvalue(env_ASG_RC_ListInfo_Cursor,empty_string);

    enableControl("ASG_Telephone_0x2F - ReceivedCalls_EditCache", "env_ASG_RC_pos_01", 0);
    enableControl("ASG_Telephone_0x2F - ReceivedCalls_EditCache", "env_ASG_RC_PbName_s_01", 0);
    enableControl("ASG_Telephone_0x2F - ReceivedCalls_EditCache", "env_ASG_RC_TelNum_s_01", 0);
    enableControl("ASG_Telephone_0x2F - ReceivedCalls_EditCache", "env_ASG_RC_NumberType_01", 0);
    enableControl("ASG_Telephone_0x2F - ReceivedCalls_EditCache", "env_ASG_RC_day_01", 0);
    enableControl("ASG_Telephone_0x2F - ReceivedCalls_EditCache", "env_ASG_RC_month_01", 0);
    enableControl("ASG_Telephone_0x2F - ReceivedCalls_EditCache", "env_ASG_RC_year_01", 0);
    enableControl("ASG_Telephone_0x2F - ReceivedCalls_EditCache", "env_ASG_RC_hour_01", 0);
    enableControl("ASG_Telephone_0x2F - ReceivedCalls_EditCache", "env_ASG_RC_minute_01", 0);
    enableControl("ASG_Telephone_0x2F - ReceivedCalls_EditCache", "env_ASG_RC_second_01", 0);


    enableControl("ASG_Telephone_0x2F - ReceivedCalls_EditCache", "env_ASG_RC_pos_02", 0);
    enableControl("ASG_Telephone_0x2F - ReceivedCalls_EditCache", "env_ASG_RC_PbName_s_02", 0);
    enableControl("ASG_Telephone_0x2F - ReceivedCalls_EditCache", "env_ASG_RC_TelNum_s_02", 0);
    enableControl("ASG_Telephone_0x2F - ReceivedCalls_EditCache", "env_ASG_RC_NumberType_02", 0);
    enableControl("ASG_Telephone_0x2F - ReceivedCalls_EditCache", "env_ASG_RC_day_02", 0);
    enableControl("ASG_Telephone_0x2F - ReceivedCalls_EditCache", "env_ASG_RC_month_02", 0);
    enableControl("ASG_Telephone_0x2F - ReceivedCalls_EditCache", "env_ASG_RC_year_02", 0);
    enableControl("ASG_Telephone_0x2F - ReceivedCalls_EditCache", "env_ASG_RC_hour_02", 0);
    enableControl("ASG_Telephone_0x2F - ReceivedCalls_EditCache", "env_ASG_RC_minute_02", 0);
    enableControl("ASG_Telephone_0x2F - ReceivedCalls_EditCache", "env_ASG_RC_second_02", 0);


    enableControl("ASG_Telephone_0x2F - ReceivedCalls_EditCache", "env_ASG_RC_pos_03", 0);
    enableControl("ASG_Telephone_0x2F - ReceivedCalls_EditCache", "env_ASG_RC_PbName_s_03", 0);
    enableControl("ASG_Telephone_0x2F - ReceivedCalls_EditCache", "env_ASG_RC_TelNum_s_03", 0);
    enableControl("ASG_Telephone_0x2F - ReceivedCalls_EditCache", "env_ASG_RC_NumberType_03", 0);
    enableControl("ASG_Telephone_0x2F - ReceivedCalls_EditCache", "env_ASG_RC_day_03", 0);
    enableControl("ASG_Telephone_0x2F - ReceivedCalls_EditCache", "env_ASG_RC_month_03", 0);
    enableControl("ASG_Telephone_0x2F - ReceivedCalls_EditCache", "env_ASG_RC_year_03", 0);
    enableControl("ASG_Telephone_0x2F - ReceivedCalls_EditCache", "env_ASG_RC_hour_03", 0);
    enableControl("ASG_Telephone_0x2F - ReceivedCalls_EditCache", "env_ASG_RC_minute_03", 0);
    enableControl("ASG_Telephone_0x2F - ReceivedCalls_EditCache", "env_ASG_RC_second_03", 0);


    enableControl("ASG_Telephone_0x2F - ReceivedCalls_EditCache", "env_ASG_RC_pos_11", 0);
    enableControl("ASG_Telephone_0x2F - ReceivedCalls_EditCache", "env_ASG_RC_PbName_s_11", 0);
    enableControl("ASG_Telephone_0x2F - ReceivedCalls_EditCache", "env_ASG_RC_TelNum_s_11", 0);
    enableControl("ASG_Telephone_0x2F - ReceivedCalls_EditCache", "env_ASG_RC_NumberType_11", 0);
    enableControl("ASG_Telephone_0x2F - ReceivedCalls_EditCache", "env_ASG_RC_day_11", 0);
    enableControl("ASG_Telephone_0x2F - ReceivedCalls_EditCache", "env_ASG_RC_month_11", 0);
    enableControl("ASG_Telephone_0x2F - ReceivedCalls_EditCache", "env_ASG_RC_year_11", 0);
    enableControl("ASG_Telephone_0x2F - ReceivedCalls_EditCache", "env_ASG_RC_hour_11", 0);
    enableControl("ASG_Telephone_0x2F - ReceivedCalls_EditCache", "env_ASG_RC_minute_11", 0);
    enableControl("ASG_Telephone_0x2F - ReceivedCalls_EditCache", "env_ASG_RC_second_11", 0);


    enableControl("ASG_Telephone_0x2F - ReceivedCalls_EditCache", "env_ASG_RC_pos_12", 0);
    enableControl("ASG_Telephone_0x2F - ReceivedCalls_EditCache", "env_ASG_RC_PbName_s_12", 0);
    enableControl("ASG_Telephone_0x2F - ReceivedCalls_EditCache", "env_ASG_RC_TelNum_s_12", 0);
    enableControl("ASG_Telephone_0x2F - ReceivedCalls_EditCache", "env_ASG_RC_NumberType_12", 0);
    enableControl("ASG_Telephone_0x2F - ReceivedCalls_EditCache", "env_ASG_RC_day_12", 0);
    enableControl("ASG_Telephone_0x2F - ReceivedCalls_EditCache", "env_ASG_RC_month_12", 0);
    enableControl("ASG_Telephone_0x2F - ReceivedCalls_EditCache", "env_ASG_RC_year_12", 0);
    enableControl("ASG_Telephone_0x2F - ReceivedCalls_EditCache", "env_ASG_RC_hour_12", 0);
    enableControl("ASG_Telephone_0x2F - ReceivedCalls_EditCache", "env_ASG_RC_minute_12", 0);
    enableControl("ASG_Telephone_0x2F - ReceivedCalls_EditCache", "env_ASG_RC_second_12", 0);


    enableControl("ASG_Telephone_0x2F - ReceivedCalls_EditCache", "env_ASG_RC_pos_13", 0);
    enableControl("ASG_Telephone_0x2F - ReceivedCalls_EditCache", "env_ASG_RC_PbName_s_13", 0);
    enableControl("ASG_Telephone_0x2F - ReceivedCalls_EditCache", "env_ASG_RC_TelNum_s_13", 0);
    enableControl("ASG_Telephone_0x2F - ReceivedCalls_EditCache", "env_ASG_RC_NumberType_13", 0);
    enableControl("ASG_Telephone_0x2F - ReceivedCalls_EditCache", "env_ASG_RC_day_13", 0);
    enableControl("ASG_Telephone_0x2F - ReceivedCalls_EditCache", "env_ASG_RC_month_13", 0);
    enableControl("ASG_Telephone_0x2F - ReceivedCalls_EditCache", "env_ASG_RC_year_13", 0);
    enableControl("ASG_Telephone_0x2F - ReceivedCalls_EditCache", "env_ASG_RC_hour_13", 0);
    enableControl("ASG_Telephone_0x2F - ReceivedCalls_EditCache", "env_ASG_RC_minute_13", 0);
    enableControl("ASG_Telephone_0x2F - ReceivedCalls_EditCache", "env_ASG_RC_second_13", 0);
       

    enableControl("ASG_Telephone_0x2F - ReceivedCalls_EditCache", "env_ASG_RC_pos_21", 0);
    enableControl("ASG_Telephone_0x2F - ReceivedCalls_EditCache", "env_ASG_RC_PbName_s_21", 0);
    enableControl("ASG_Telephone_0x2F - ReceivedCalls_EditCache", "env_ASG_RC_TelNum_s_21", 0);
    enableControl("ASG_Telephone_0x2F - ReceivedCalls_EditCache", "env_ASG_RC_NumberType_21", 0);
    enableControl("ASG_Telephone_0x2F - ReceivedCalls_EditCache", "env_ASG_RC_day_21", 0);
    enableControl("ASG_Telephone_0x2F - ReceivedCalls_EditCache", "env_ASG_RC_month_21", 0);
    enableControl("ASG_Telephone_0x2F - ReceivedCalls_EditCache", "env_ASG_RC_year_21", 0);
    enableControl("ASG_Telephone_0x2F - ReceivedCalls_EditCache", "env_ASG_RC_hour_21", 0);
    enableControl("ASG_Telephone_0x2F - ReceivedCalls_EditCache", "env_ASG_RC_minute_21", 0);
    enableControl("ASG_Telephone_0x2F - ReceivedCalls_EditCache", "env_ASG_RC_second_21", 0);


    enableControl("ASG_Telephone_0x2F - ReceivedCalls_EditCache", "env_ASG_RC_pos_22", 0);
    enableControl("ASG_Telephone_0x2F - ReceivedCalls_EditCache", "env_ASG_RC_PbName_s_22", 0);
    enableControl("ASG_Telephone_0x2F - ReceivedCalls_EditCache", "env_ASG_RC_TelNum_s_22", 0);
    enableControl("ASG_Telephone_0x2F - ReceivedCalls_EditCache", "env_ASG_RC_NumberType_22", 0);
    enableControl("ASG_Telephone_0x2F - ReceivedCalls_EditCache", "env_ASG_RC_day_22", 0);
    enableControl("ASG_Telephone_0x2F - ReceivedCalls_EditCache", "env_ASG_RC_month_22", 0);
    enableControl("ASG_Telephone_0x2F - ReceivedCalls_EditCache", "env_ASG_RC_year_22", 0);
    enableControl("ASG_Telephone_0x2F - ReceivedCalls_EditCache", "env_ASG_RC_hour_22", 0);
    enableControl("ASG_Telephone_0x2F - ReceivedCalls_EditCache", "env_ASG_RC_minute_22", 0);
    enableControl("ASG_Telephone_0x2F - ReceivedCalls_EditCache", "env_ASG_RC_second_22", 0);


    enableControl("ASG_Telephone_0x2F - ReceivedCalls_EditCache", "env_ASG_RC_pos_23", 0);
    enableControl("ASG_Telephone_0x2F - ReceivedCalls_EditCache", "env_ASG_RC_PbName_s_23", 0);
    enableControl("ASG_Telephone_0x2F - ReceivedCalls_EditCache", "env_ASG_RC_TelNum_s_23", 0);
    enableControl("ASG_Telephone_0x2F - ReceivedCalls_EditCache", "env_ASG_RC_NumberType_23", 0);
    enableControl("ASG_Telephone_0x2F - ReceivedCalls_EditCache", "env_ASG_RC_day_23", 0);
    enableControl("ASG_Telephone_0x2F - ReceivedCalls_EditCache", "env_ASG_RC_month_23", 0);
    enableControl("ASG_Telephone_0x2F - ReceivedCalls_EditCache", "env_ASG_RC_year_23", 0);
    enableControl("ASG_Telephone_0x2F - ReceivedCalls_EditCache", "env_ASG_RC_hour_23", 0);
    enableControl("ASG_Telephone_0x2F - ReceivedCalls_EditCache", "env_ASG_RC_minute_23", 0);
    enableControl("ASG_Telephone_0x2F - ReceivedCalls_EditCache", "env_ASG_RC_second_23", 0);


    //DialedNumbers
    gDialedNumbers_ASGID                =0;
    gDialedNumbers_TAID                 =0;
    gDialedNumbers_TotalNumListElements =0;
    
    for(j=0; j<TEL_DIALEDNUMBERS_ASGCACHE_MAX_SIZE; j++)
    {     
        gDialedNumbers_Pos[j]                               =0;
        gDialedNumbers_ListEntryReceptionInformation[j]     =0;
        gDialedNumbers_NumberType[j]                          =0;
        gDialedNumbers_day[j]                               =0;
        gDialedNumbers_month[j]                             =0;
        gDialedNumbers_year[j]                              =0;
        gDialedNumbers_hour[j]                              =0;
        gDialedNumbers_minute[j]                            =0;
        gDialedNumbers_second[j]                            =0;

        for(i=0;i<TEL_DIALEDNUMBERS_PBNAME_LENGTH;i++)
			gDialedNumbers_PbName[j][i] =0;

        for(i=0;i<TEL_DIALEDNUMBERS_TELNUMBER_LENGTH;i++)
			gDialedNumbers_TelNumber[j][i] =0;
    }
    gDialedNumbers_SlidingWindow_State   =TEL_DIALEDNUMBERS_SLIDINGWINDOW_NOTACTIVE;
    gDialedNumbers_ListHandlingType      =TEL_DIALEDNUMBERS_NOCACHE;
    gDialedNumbers_cacheBuildUp          =TEL_DIALEDNUMBERS_BUILDUPCACHENOCACHE;
    gDialedNumbers_CallBackReason        =TEL_DIALEDNUMBERS_CALLBACKREASON_NOCALLBACK;

    gDialedNumbers_cacheDown             =FALSE;
    gDialedNumbers_cacheUp               =FALSE;
    gDialedNumbers_LastFirstElement      =0;

    gDialedNumbers_recordaddress         =0;
    gDialedNumbers_transmitpos           =FALSE;
    gDialedNumbers_CursorAction          =TEL_DIALEDNUMBERS_CURSORACTION_NOTHING;
    gDialedNumbers_DisplayStatus         =TEL_DIALEDNUMBERS_DISPLAYLIST_FIRST_ELEMENTS;
    gDialedNumbers_LastElement           =0;
    gDialedNumbers_FirstElement          =0;
    gDialedNumbers_DownCaching_required  =FALSE;
    gDialedNumbers_UpCaching_required    =FALSE; 
    gDialedNumbers_MoveList_down_allowed =FALSE; 
    gDialedNumbers_MoveList_up_allowed   =FALSE; 

    putvalue(env_ASG_DN_ASGID, gDialedNumbers_ASGID);
    putvalue(env_ASG_DN_TAID, gDialedNumbers_TAID);
    putvalue(env_ASG_DN_TotalNumLE, gDialedNumbers_TotalNumListElements);
    putvalue(env_ASG_DN_AH_shift, 0);
    putvalue(env_ASG_DN_AH_dir, FORWARD);
    putvalue(env_ASG_DN_AH_IS, FALSE);
    putvalue(env_ASG_DN_AH_PosTrans, gDialedNumbers_transmitpos);
    putvalue(env_ASG_DN_AH_RA, gDialedNumbers_recordaddress);
    putvalue(env_ASG_DN_AH_start, 0);
    putvalue(env_ASG_DN_AH_elements, 3);
    putvalue(env_ASG_DN_ListOpState, empty_string);

    putvalue(env_ASG_DN_pos_0, 0);
    putvalue(env_ASG_DN_pos_1, 0);
    putvalue(env_ASG_DN_pos_2, 0);
    
    putvalue(env_ASG_DN_NumType_0, 0);
    putvalue(env_ASG_DN_NumType_1, 0);
    putvalue(env_ASG_DN_NumType_2, 0);

    putvalue(env_ASG_DN_NumType_s_0,empty_string);
    putvalue(env_ASG_DN_NumType_s_1,empty_string);
    putvalue(env_ASG_DN_NumType_s_2,empty_string);

    putvalue(env_ASG_DN_day_0, 0);
    putvalue(env_ASG_DN_day_1, 0);
    putvalue(env_ASG_DN_day_2, 0);

    putvalue(env_ASG_DN_month_0, 0);
    putvalue(env_ASG_DN_month_1, 0);
    putvalue(env_ASG_DN_month_2, 0);

    putvalue(env_ASG_DN_year_0, 0);
    putvalue(env_ASG_DN_year_1, 0);
    putvalue(env_ASG_DN_year_2, 0);

    putvalue(env_ASG_DN_hour_0, 0);
    putvalue(env_ASG_DN_hour_1, 0);
    putvalue(env_ASG_DN_hour_2, 0);

    putvalue(env_ASG_DN_minute_0, 0);
    putvalue(env_ASG_DN_minute_1, 0);
    putvalue(env_ASG_DN_minute_2, 0);

    putvalue(env_ASG_DN_second_0, 0);
    putvalue(env_ASG_DN_second_1, 0);
    putvalue(env_ASG_DN_second_2, 0);

    putvalue(env_ASG_DN_OnOff, FALSE);
    
    putvalue(env_ASG_DN_ListInfo_up,empty_string);
    putvalue(env_ASG_DN_ListInfo_down,empty_string);
    putvalue(env_ASG_DN_ListInfo_Cursor,empty_string);

    enableControl("ASG_Telephone_0x2F - DialedNumbers_EditCache", "env_ASG_DN_pos_01", 0);
    enableControl("ASG_Telephone_0x2F - DialedNumbers_EditCache", "env_ASG_DN_PbName_s_01", 0);
    enableControl("ASG_Telephone_0x2F - DialedNumbers_EditCache", "env_ASG_DN_TelNum_s_01", 0);
    enableControl("ASG_Telephone_0x2F - DialedNumbers_EditCache", "env_ASG_DN_NumberType_01", 0);
    enableControl("ASG_Telephone_0x2F - DialedNumbers_EditCache", "env_ASG_DN_day_01", 0);
    enableControl("ASG_Telephone_0x2F - DialedNumbers_EditCache", "env_ASG_DN_month_01", 0);
    enableControl("ASG_Telephone_0x2F - DialedNumbers_EditCache", "env_ASG_DN_year_01", 0);
    enableControl("ASG_Telephone_0x2F - DialedNumbers_EditCache", "env_ASG_DN_hour_01", 0);
    enableControl("ASG_Telephone_0x2F - DialedNumbers_EditCache", "env_ASG_DN_minute_01", 0);
    enableControl("ASG_Telephone_0x2F - DialedNumbers_EditCache", "env_ASG_DN_second_01", 0);


    enableControl("ASG_Telephone_0x2F - DialedNumbers_EditCache", "env_ASG_DN_pos_02", 0);
    enableControl("ASG_Telephone_0x2F - DialedNumbers_EditCache", "env_ASG_DN_PbName_s_02", 0);
    enableControl("ASG_Telephone_0x2F - DialedNumbers_EditCache", "env_ASG_DN_TelNum_s_02", 0);
    enableControl("ASG_Telephone_0x2F - DialedNumbers_EditCache", "env_ASG_DN_NumberType_02", 0);
    enableControl("ASG_Telephone_0x2F - DialedNumbers_EditCache", "env_ASG_DN_day_02", 0);
    enableControl("ASG_Telephone_0x2F - DialedNumbers_EditCache", "env_ASG_DN_month_02", 0);
    enableControl("ASG_Telephone_0x2F - DialedNumbers_EditCache", "env_ASG_DN_year_02", 0);
    enableControl("ASG_Telephone_0x2F - DialedNumbers_EditCache", "env_ASG_DN_hour_02", 0);
    enableControl("ASG_Telephone_0x2F - DialedNumbers_EditCache", "env_ASG_DN_minute_02", 0);
    enableControl("ASG_Telephone_0x2F - DialedNumbers_EditCache", "env_ASG_DN_second_02", 0);


    enableControl("ASG_Telephone_0x2F - DialedNumbers_EditCache", "env_ASG_DN_pos_03", 0);
    enableControl("ASG_Telephone_0x2F - DialedNumbers_EditCache", "env_ASG_DN_PbName_s_03", 0);
    enableControl("ASG_Telephone_0x2F - DialedNumbers_EditCache", "env_ASG_DN_TelNum_s_03", 0);
    enableControl("ASG_Telephone_0x2F - DialedNumbers_EditCache", "env_ASG_DN_NumberType_03", 0);
    enableControl("ASG_Telephone_0x2F - DialedNumbers_EditCache", "env_ASG_DN_day_03", 0);
    enableControl("ASG_Telephone_0x2F - DialedNumbers_EditCache", "env_ASG_DN_month_03", 0);
    enableControl("ASG_Telephone_0x2F - DialedNumbers_EditCache", "env_ASG_DN_year_03", 0);
    enableControl("ASG_Telephone_0x2F - DialedNumbers_EditCache", "env_ASG_DN_hour_03", 0);
    enableControl("ASG_Telephone_0x2F - DialedNumbers_EditCache", "env_ASG_DN_minute_03", 0);
    enableControl("ASG_Telephone_0x2F - DialedNumbers_EditCache", "env_ASG_DN_second_03", 0);


    enableControl("ASG_Telephone_0x2F - DialedNumbers_EditCache", "env_ASG_DN_pos_11", 0);
    enableControl("ASG_Telephone_0x2F - DialedNumbers_EditCache", "env_ASG_DN_PbName_s_11", 0);
    enableControl("ASG_Telephone_0x2F - DialedNumbers_EditCache", "env_ASG_DN_TelNum_s_11", 0);
    enableControl("ASG_Telephone_0x2F - DialedNumbers_EditCache", "env_ASG_DN_NumberType_11", 0);
    enableControl("ASG_Telephone_0x2F - DialedNumbers_EditCache", "env_ASG_DN_day_11", 0);
    enableControl("ASG_Telephone_0x2F - DialedNumbers_EditCache", "env_ASG_DN_month_11", 0);
    enableControl("ASG_Telephone_0x2F - DialedNumbers_EditCache", "env_ASG_DN_year_11", 0);
    enableControl("ASG_Telephone_0x2F - DialedNumbers_EditCache", "env_ASG_DN_hour_11", 0);
    enableControl("ASG_Telephone_0x2F - DialedNumbers_EditCache", "env_ASG_DN_minute_11", 0);
    enableControl("ASG_Telephone_0x2F - DialedNumbers_EditCache", "env_ASG_DN_second_11", 0);


    enableControl("ASG_Telephone_0x2F - DialedNumbers_EditCache", "env_ASG_DN_pos_12", 0);
    enableControl("ASG_Telephone_0x2F - DialedNumbers_EditCache", "env_ASG_DN_PbName_s_12", 0);
    enableControl("ASG_Telephone_0x2F - DialedNumbers_EditCache", "env_ASG_DN_TelNum_s_12", 0);
    enableControl("ASG_Telephone_0x2F - DialedNumbers_EditCache", "env_ASG_DN_NumberType_12", 0);
    enableControl("ASG_Telephone_0x2F - DialedNumbers_EditCache", "env_ASG_DN_day_12", 0);
    enableControl("ASG_Telephone_0x2F - DialedNumbers_EditCache", "env_ASG_DN_month_12", 0);
    enableControl("ASG_Telephone_0x2F - DialedNumbers_EditCache", "env_ASG_DN_year_12", 0);
    enableControl("ASG_Telephone_0x2F - DialedNumbers_EditCache", "env_ASG_DN_hour_12", 0);
    enableControl("ASG_Telephone_0x2F - DialedNumbers_EditCache", "env_ASG_DN_minute_12", 0);
    enableControl("ASG_Telephone_0x2F - DialedNumbers_EditCache", "env_ASG_DN_second_12", 0);


    enableControl("ASG_Telephone_0x2F - DialedNumbers_EditCache", "env_ASG_DN_pos_13", 0);
    enableControl("ASG_Telephone_0x2F - DialedNumbers_EditCache", "env_ASG_DN_PbName_s_13", 0);
    enableControl("ASG_Telephone_0x2F - DialedNumbers_EditCache", "env_ASG_DN_TelNum_s_13", 0);
    enableControl("ASG_Telephone_0x2F - DialedNumbers_EditCache", "env_ASG_DN_NumberType_13", 0);
    enableControl("ASG_Telephone_0x2F - DialedNumbers_EditCache", "env_ASG_DN_day_13", 0);
    enableControl("ASG_Telephone_0x2F - DialedNumbers_EditCache", "env_ASG_DN_month_13", 0);
    enableControl("ASG_Telephone_0x2F - DialedNumbers_EditCache", "env_ASG_DN_year_13", 0);
    enableControl("ASG_Telephone_0x2F - DialedNumbers_EditCache", "env_ASG_DN_hour_13", 0);
    enableControl("ASG_Telephone_0x2F - DialedNumbers_EditCache", "env_ASG_DN_minute_13", 0);
    enableControl("ASG_Telephone_0x2F - DialedNumbers_EditCache", "env_ASG_DN_second_13", 0);
       

    enableControl("ASG_Telephone_0x2F - DialedNumbers_EditCache", "env_ASG_DN_pos_21", 0);
    enableControl("ASG_Telephone_0x2F - DialedNumbers_EditCache", "env_ASG_DN_PbName_s_21", 0);
    enableControl("ASG_Telephone_0x2F - DialedNumbers_EditCache", "env_ASG_DN_TelNum_s_21", 0);
    enableControl("ASG_Telephone_0x2F - DialedNumbers_EditCache", "env_ASG_DN_NumberType_21", 0);
    enableControl("ASG_Telephone_0x2F - DialedNumbers_EditCache", "env_ASG_DN_day_21", 0);
    enableControl("ASG_Telephone_0x2F - DialedNumbers_EditCache", "env_ASG_DN_month_21", 0);
    enableControl("ASG_Telephone_0x2F - DialedNumbers_EditCache", "env_ASG_DN_year_21", 0);
    enableControl("ASG_Telephone_0x2F - DialedNumbers_EditCache", "env_ASG_DN_hour_21", 0);
    enableControl("ASG_Telephone_0x2F - DialedNumbers_EditCache", "env_ASG_DN_minute_21", 0);
    enableControl("ASG_Telephone_0x2F - DialedNumbers_EditCache", "env_ASG_DN_second_21", 0);


    enableControl("ASG_Telephone_0x2F - DialedNumbers_EditCache", "env_ASG_DN_pos_22", 0);
    enableControl("ASG_Telephone_0x2F - DialedNumbers_EditCache", "env_ASG_DN_PbName_s_22", 0);
    enableControl("ASG_Telephone_0x2F - DialedNumbers_EditCache", "env_ASG_DN_TelNum_s_22", 0);
    enableControl("ASG_Telephone_0x2F - DialedNumbers_EditCache", "env_ASG_DN_NumberType_22", 0);
    enableControl("ASG_Telephone_0x2F - DialedNumbers_EditCache", "env_ASG_DN_day_22", 0);
    enableControl("ASG_Telephone_0x2F - DialedNumbers_EditCache", "env_ASG_DN_month_22", 0);
    enableControl("ASG_Telephone_0x2F - DialedNumbers_EditCache", "env_ASG_DN_year_22", 0);
    enableControl("ASG_Telephone_0x2F - DialedNumbers_EditCache", "env_ASG_DN_hour_22", 0);
    enableControl("ASG_Telephone_0x2F - DialedNumbers_EditCache", "env_ASG_DN_minute_22", 0);
    enableControl("ASG_Telephone_0x2F - DialedNumbers_EditCache", "env_ASG_DN_second_22", 0);


    enableControl("ASG_Telephone_0x2F - DialedNumbers_EditCache", "env_ASG_DN_pos_23", 0);
    enableControl("ASG_Telephone_0x2F - DialedNumbers_EditCache", "env_ASG_DN_PbName_s_23", 0);
    enableControl("ASG_Telephone_0x2F - DialedNumbers_EditCache", "env_ASG_DN_TelNum_s_23", 0);
    enableControl("ASG_Telephone_0x2F - DialedNumbers_EditCache", "env_ASG_DN_NumberType_23", 0);
    enableControl("ASG_Telephone_0x2F - DialedNumbers_EditCache", "env_ASG_DN_day_23", 0);
    enableControl("ASG_Telephone_0x2F - DialedNumbers_EditCache", "env_ASG_DN_month_23", 0);
    enableControl("ASG_Telephone_0x2F - DialedNumbers_EditCache", "env_ASG_DN_year_23", 0);
    enableControl("ASG_Telephone_0x2F - DialedNumbers_EditCache", "env_ASG_DN_hour_23", 0);
    enableControl("ASG_Telephone_0x2F - DialedNumbers_EditCache", "env_ASG_DN_minute_23", 0);
    enableControl("ASG_Telephone_0x2F - DialedNumbers_EditCache", "env_ASG_DN_second_23", 0);
}
/*@@end*/

/*@@caplFunc:NetworkProvider_Indication(dword[],byte,int):*/
NetworkProvider_Indication (dword Indication_array [], byte indication, int datalength)
{

int i, length, Offset =0;
byte errorcode;

//init lokal variables
	length=0;
	errorcode=0x00;
//********************

	for(i=0;i<20;i++)	//delete network provider name array
		gNetworkProvider_name[i]=0;
				
	switch (indication)
	{
		case Data_IND:
            /*
			if(datalength!=(4+length))	//datalength error
				writelineEx(gError_Trace, 0, "networkprovider_indication: BAP-datalength-error");
			else
			{*/
            for(i=0; i<NETWORKPROVIDERNAME_LENGTH; i++)
                gNetworkProvider_name[i] =0;                

            for(i=0; i<SERVICEPROVIDERNAME_LENGTH; i++)
                gServiceProvider_name[i] =0;

            //NetworkProviderState
            gNetworkProvider_state =Indication_array[3];
            
            if (gNetworkProvider_state<0x02)
                putvalue(env_RNS_networkprovider_state,gNetworkProvider_state_string[gNetworkProvider_state]);
            else
                putvalue(env_RNS_networkprovider_state,gstring_reserved);
            
            //NetworkProviderName
            length =Indication_array[4];
            Offset =5;

				if (length==0)
				{
					//write("ASG: no network");
					putvalue(env_RNS_networkprovider_name,gNetworkProvider_name);
				}
				else
				{
					for (i=0; i<length; i++)
					{
                    	gNetworkProvider_name [i]=Indication_array[Offset];
                        Offset++;
                    }

					putvalue(env_RNS_networkprovider_name,gNetworkProvider_name);
				}
                
                //ServiceProviderState
                gServiceProvider_state =Indication_array[Offset];
                Offset++;

                if (gServiceProvider_state<0x02)
                putvalue(env_RNS_Serviceprovider_state,gServiceProvider_state_string[gServiceProvider_state]);
                else
                putvalue(env_RNS_Serviceprovider_state,gstring_reserved);
                
                //ServiceProviderName
                length =Indication_array[Offset];
                Offset++;

				if (length==0)
				{
					//write("ASG: no Service");
					putvalue(env_RNS_Serviceprovider_name,gServiceProvider_name);
				}
				else
				{
					for (i=0; i<length; i++)
					{
                    	gServiceProvider_name [i]=Indication_array[Offset];
                        Offset++;
                    }

					putvalue(env_RNS_Serviceprovider_name,gServiceProvider_name);
				}

			//}
		break;
		case Error_IND:
			if(datalength!=4)
				writelineEx(gError_Trace, 0, "ASG networkprovider_Indication: BAP-datalength-error");
			else
			{
				errorcode=Indication_array[3];
				if(errorcode<0x20)				//BCL-error
					writelineEx(gError_Trace, 0, "ASG NetworkProvider_Indication: BCL-Error: 0x%x - %s", errorcode, gerror_codes_BCL [errorcode-0x10]);
				else if(errorcode<0x30)			//BPL-error
					writelineEx(gError_Trace, 0, "ASG NetworkProvider_Indication: BPL-Error: 0x%x - %s", errorcode, gerror_codes_BPL [errorcode-0x20]);				
				else if(errorcode<0x40)			//BAL-error
					writelineEx(gError_Trace, 0, "ASG NetworkProvider_Indication: BAL-Error: 0x%x - %s", errorcode, gerror_codes_BAL [errorcode-0x30]);
				else if(errorcode>=0x80 && errorcode<=0xA2)
					writelineEx(gError_Trace, 0, "ASG NetworkProvider_Indication: Telephone-Error: 0x%x - %s", errorcode, gerror_codes_telephone [errorcode-0x80]);
				else
					writelineEx(gError_Trace, 0, "ASG NetworkProvider_Indication: Telephone-Error: 0x%x", errorcode);
			}
		break;
		default:
			writelineEx(gError_Trace, 0, "ASG NetworkProvider_Indication: unknown indication %d", indication);
		break;
	}
}
/*@@end*/

/*@@envVar:env_RNS_Dial_voicemailbox:*/
on envVar env_RNS_Dial_voicemailbox
{
char i, empty_string [3];

//init lokal variables
	for(i=0;i<3;i++)
		empty_string[i]=0;
//********************

	if(gRNS_PowerOnOff==Power_on && gBAP_Phone_available==BAPPhone){
		if(getvalue(env_RNS_Dial_voicemailbox)){
			putvalue(env_RNS_dialnumber_number, gmailboxnumber_rns_cache);
			dialnumber_Request(StartResult_REQ, gmailboxnumber_rns_cache, empty_string, 0);
		}
	}
}
/*@@end*/

/*@@caplFunc:get_requestbuffer_line():*/
byte get_requestbuffer_line ()	//function to reserve memory in request-ring-buffer
{
int line;

//init lokal variables
	line=0;
//********************	
	
	line=gwrite_requestbuffer_line;							//next free element in  ring-buffer

	if(gwrite_requestbuffer_line<(Requestbuffer_lines-1))	//last element of ring-buffer is not reached
		gwrite_requestbuffer_line++;
	else													//last element of ring-buffer is reached
		gwrite_requestbuffer_line=0;
	
	return (line);											//return position of free ring-buffer element
}
/*@@end*/

/*@@caplFunc:set_status_requestbuffer(dword[],int,byte):*/
set_status_requestbuffer (dword Request_array [], int length, byte BAPDataType)	//function to write data in reqest-ring-buffer
{
int bufferline, Offset, i;

//init lokal variables
	Offset=0;
	bufferline=0;
//********************

	bufferline=get_requestbuffer_line();		//get next free position in ring-buffer

	for(i=0;i<length;i++)									//write data in ring-buffer
		gBAP_Request[bufferline][i]=Request_array[i];			

	gBAP_Requestbufffer_status[bufferline]=length;			//datalength
	gBAP_Requestbufffer_BAPDataTyp[bufferline]=BAPDataType;	//BAP-data-type	
}
/*@@end*/

/*@@caplFunc:telephone_functions(byte,int):*/
telephone_functions (byte functionID, int datalength)	
{

	switch (functionID){
		case FctID_GetAll:
			GetAll_Telephone_Indication(gBAP_Indication, gBAP_Indication[2], datalength);
		break;
		case FctID_BAP_Config:
			BAP_Config_Telephone_Indication(gBAP_Indication, gBAP_Indication[2], datalength);
		break;
		case FctID_FunctionList:
			FunctionList_Telephone_Indication(gBAP_Indication, gBAP_Indication[2], datalength);
		break;
		case FctID_HeartBeat:
			HeartBeat_Telephone_Indication(gBAP_Indication, gBAP_Indication[2], datalength);
		break;
		case FctID_FSG_Setup:
			FSG_Setup_Telephone_Indication(gBAP_Indication, gBAP_Indication[2], datalength);
		break;
		case FctID_FSG_OperationState:
			FSG_OperationState_Telephone_Indication(gBAP_Indication, gBAP_Indication[2], datalength);
		break;
		case FctID_MobileServiceSupport:
			MobileServiceSupport_Telephone_Indication(gBAP_Indication, gBAP_Indication[2], datalength);
		break;
		case FctID_ActiveUser:
			ActiveUser_Indication(gBAP_Indication, gBAP_Indication[2], datalength);
		break; 
		case FctID_RegisterState:
			RegisterState_Indication(gBAP_Indication, gBAP_Indication[2], datalength);
		break;
        case FctID_LockState:
			LockState_Indication(gBAP_Indication, gBAP_Indication [2], datalength);
		break;
		case FctID_NetworkProvider:	//networkprovider
			networkprovider_Indication(gBAP_Indication, gBAP_Indication [2], datalength);
		break;
		case FctID_SignalQuality:
			SignalQuality_Indication(gBAP_Indication, gBAP_Indication [2], datalength);
		break;
		case FctID_CallState:	//CallState
			callstate_Indication(gBAP_Indication, gBAP_Indication [2], datalength);
		break;
		case FctID_CallInfo:	//CallInfo
			CallInfo_Indication (gBAP_Indication, gBAP_Indication [2], datalength);
		break;
        case FctID_CallDurationSync:	
			CallDurationSync_Indication (gBAP_Indication, gBAP_Indication [2], datalength);
		break;
        case FctID_DisconnectReason:	//DisconnectReason
			DisconnectReason_Indication (gBAP_Indication, gBAP_Indication [2], datalength);
		break;
		case FctID_DialNumber:	//Dialnumber
			dialnumber_Indication(gBAP_Indication, gBAP_Indication [2], datalength);
        break;
        case FctID_DialService:	//Dialservice
			DialService_Indication(gBAP_Indication, gBAP_Indication [2], datalength);
		break;
        case FctID_ConfirmEmergencyCall:	// ConfirmEmergencyCall
			ConfirmEmergencyCall_Indication(gBAP_Indication, gBAP_Indication [2], datalength);
		break;
		case FctID_HangupCall:	//HangUpCall
			hangupcall_Indication(gBAP_Indication, gBAP_Indication [2], datalength);
		break;
		case FctID_AcceptCall:
			AcceptCall_Indication(gBAP_Indication, gBAP_Indication [2], datalength);
		break;
		case FctID_CallHold:
			CallHold_Indication(gBAP_Indication, gBAP_Indication [2], datalength);
		break;
		case FctID_ResumeCall:
			ResumeCall_Indication(gBAP_Indication, gBAP_Indication [2], datalength);
		break;
		case FctID_HandsFreeOnOff:	//HandsFreeOnOff
			handsfreeonoff_Indication(gBAP_Indication, gBAP_Indication [2], datalength);
		break;
		case FctID_MicroMuteOnOff:	//MicroMuteOnOff
			micromuteonoff_Indication(gBAP_Indication, gBAP_Indication [2], datalength);
		break;
		case FctID_MPReleaseActiveCallAcceptWaitingCall:
			MPRACAWC_Indication(gBAP_Indication, gBAP_Indication [2], datalength);
		break;
		case FctID_MPSwap:
			MPSwap_Indication(gBAP_Indication, gBAP_Indication [2], datalength);
		break;
		case FctID_MPCallHoldAcceptWaitingCall:
			MPCHAWC_Indication(gBAP_Indication, gBAP_Indication [2], datalength);
		break;
		case FctID_MPReleaseAllCallsAcceptWaitingCall:
			MPRAllCAWC_Indication(gBAP_Indication, gBAP_Indication [2], datalength);
		break;
        case FctID_MPSetWaitingCallOnHold:
            MPSWCOH_Indication(gBAP_Indication, gBAP_Indication [2], datalength);
		break;
		case FctID_CCJoin:
			CCJoin_Indication(gBAP_Indication, gBAP_Indication [2], datalength);
		break;
		case FctID_CCSplit:
			CCSplit_Indication(gBAP_Indication, gBAP_Indication [2], datalength);
		break;
		case FctID_Keypad:
			Keypad_Indication(gBAP_Indication, gBAP_Indication [2], datalength);
		break;
        case FctID_MobileBatteryLevel:
			MobileBatteryLevel_Indication(gBAP_Indication, gBAP_Indication [2], datalength);
		break;
        case FctID_DataConnectionIndication:
			DataConnectionIndication_Indication(gBAP_Indication, gBAP_Indication [2], datalength);
		break;
        case FctID_MissedCallIndication:
			MissedCallIndication_Indication(gBAP_Indication, gBAP_Indication [2], datalength);
		break;
		case FctID_MissedCalls:
			//MissedCalls_Indication(gBAP_Indication, gBAP_Indication [2], datalength);
		break;
        case FctID_ReceivedCalls:
			//ReceivedCalls_Indication(gBAP_Indication, gBAP_Indication [2], datalength);
		break;
        case FctID_DialedNumbers:
			//DialedNumbers_Indication(gBAP_Indication, gBAP_Indication [2], datalength);
		break;
        case FctID_CombinedNumbers:
			CombinedNumbers_Indication(gBAP_Indication, gBAP_Indication [2], datalength);
		break;
        case FctID_PbState:
			PbState_Indication(gBAP_Indication, gBAP_Indication [2], datalength);
		break;
        case FctID_Phonebook:
			Phonebook_Indication(gBAP_Indication, gBAP_Indication [2], datalength);
		break;
        case FctID_PbSpeller:
			PbSpeller_Indication(gBAP_Indication, gBAP_Indication [2], datalength);
		break;
        case FctID_GetNextListPos:
			GetNextListPos_Indication(gBAP_Indication, gBAP_Indication [2], datalength);
		break;
        case FctID_SMSState:
			SMSState_Indication(gBAP_Indication, gBAP_Indication [2], datalength);
		break;
        case FctID_RingToneMuteOnOff:
			RingToneMuteOnOff_Indication(gBAP_Indication, gBAP_Indication [2], datalength);
		break;
         case FctID_AutomaticRedial:
			AutomaticRedial_Indication(gBAP_Indication, gBAP_Indication [2], datalength);
		break;
		default:
			writelineEx(gError_Trace, 0, "ASG telephone_functions: unknown funcion-ID %x", functionID);
		break;
	}	

}
/*@@end*/

/*@@caplFunc:CallState_Indication(dword[],byte,int):*/
CallState_Indication(dword Indication_array [], byte indication, int datalength)
{
byte i, temp;
char empty_string [3];


//init lokal variables
	temp=0;
	for(i=0;i<3;i++)
		empty_string[i]=0;
//********************

	switch(indication){
		case Data_IND:
			/*if(datalength!=11){
				writelineEx(gError_Trace, 0, "ASG callstate indication: BAP-datalength-error");
			}
			else*/{
				gCallInDivert   =Indication_array[17];
                gCallOutDivert  =Indication_array[18];
				
                //CallID 0
				gCallState[0]=(Indication_array[3] & 0xf0)/16;
				
                if(gCallState[0]>CALLSTATES)
					putvalue(env_RNS_CallState_CallID_0, greserved);
				else
					putvalue(env_RNS_CallState_CallID_0, gstring_callstate[gCallState[0]]);

				gCallType[0]=Indication_array[3] & 0x0f;
				
                /*if(gCallState[0]==idle)
					putvalue(env_RNS_CallType_CallID_0, empty_string);
				
				else*/
				{
					if(gCallType[0]>CALLTYPES)
						putvalue(env_RNS_CallType_CallID_0, greserved);
					
					else
						putvalue(env_RNS_CallType_CallID_0, gstring_calltype[gCallType[0]]);					
				}

                gCallOptions[0]=Indication_array[4];

                putvalue(env_RNS_CallState_Opt_AcCall_0,gCallOptions[0] &0x01);         //Bit0
                putvalue(env_RNS_CallState_Opt_HoldAc_0,(gCallOptions[0] &0x02)/0x02);  //Bit1
                putvalue(env_RNS_CallState_Opt_CallAc_0,(gCallOptions[0] &0x04)/0x04);  //Bit2
                putvalue(env_RNS_CallState_Opt_CallHold_0,(gCallOptions[0] &0x08)/0x08);//Bit3
                putvalue(env_RNS_CallState_Opt_ResCall_0,(gCallOptions[0] &0x10)/0x10); //Bit4
                putvalue(env_RNS_CallState_Opt_MPSwap_0,(gCallOptions[0] &0x20)/0x20);  //Bit5
                putvalue(env_RNS_CallState_Opt_CCJoin_0,(gCallOptions[0] &0x40)/0x40);  //Bit6
				putvalue(env_RNS_CallState_Opt_CCSplit_0,(gCallOptions[0] &0x80)/0x80); //Bit7
                
                putvalue(env_RNS_CallState_CallInDivert_0,gCallInDivert &0x01);     //Bit0
                putvalue(env_RNS_CallState_CallOuDivert_0,gCallOutDivert &0x01);    //Bit0
                
                //CallID 1
				gCallState[1]=(Indication_array[5] & 0xf0)/16;
				
                if(gCallState[1]>CALLSTATES)
					putvalue(env_RNS_CallState_CallID_1, greserved);
				else
					putvalue(env_RNS_CallState_CallID_1,gstring_callstate[gCallState[1]]);
				gCallType[1]=Indication_array[5] & 0x0f;
				
                /*if(gCallState[1]==idle)
					putvalue(env_RNS_CallType_CallID_1,empty_string);
	
				else*/
				{
					if(gCallType[1]>CALLTYPES)
						putvalue(env_RNS_CallType_CallID_1, greserved);
					
					else	
						putvalue(env_RNS_CallType_CallID_1,gstring_calltype[gCallType[1]]);				
				}
                
                gCallOptions[1]=Indication_array[6];

                putvalue(env_RNS_CallState_Opt_AcCall_1,gCallOptions[1] &0x01);         //Bit0
                putvalue(env_RNS_CallState_Opt_HoldAc_1,(gCallOptions[1] &0x02)/0x02);  //Bit1
                putvalue(env_RNS_CallState_Opt_CallAc_1,(gCallOptions[1] &0x04)/0x04);  //Bit2
                putvalue(env_RNS_CallState_Opt_CallHold_1,(gCallOptions[1] &0x08)/0x08);//Bit3
                putvalue(env_RNS_CallState_Opt_ResCall_1,(gCallOptions[1] &0x10)/0x10); //Bit4
                putvalue(env_RNS_CallState_Opt_MPSwap_1,(gCallOptions[1] &0x20)/0x20);  //Bit5
                putvalue(env_RNS_CallState_Opt_CCJoin_1,(gCallOptions[1] &0x40)/0x40);  //Bit6
				putvalue(env_RNS_CallState_Opt_CCSplit_1,(gCallOptions[1] &0x80)/0x80); //Bit7

                putvalue(env_RNS_CallState_CallInDivert_1,(gCallInDivert &0x02) /0x02);     //Bit1
                putvalue(env_RNS_CallState_CallOuDivert_1,(gCallOutDivert &0x02) /0x02);    //Bit1

				//CallID 2
				gCallState[2]=(Indication_array[7] & 0xf0)/16;
				if(gCallState[2]>CALLSTATES)
					putvalue(env_RNS_CallState_CallID_2, greserved);
				else
					putvalue(env_RNS_CallState_CallID_2,gstring_callstate[gCallState[2]]);
				gCallType[2]=Indication_array[7] & 0x0f;
				/*if(gCallState[2]==idle)
					putvalue(env_RNS_CallType_CallID_2,empty_string);

				else*/
				{
					if(gCallType[2]>CALLTYPES)
						putvalue(env_RNS_CallType_CallID_2, greserved);
					
					else
						putvalue(env_RNS_CallType_CallID_2,gstring_calltype[gCallType[2]]);
					
				}
                
                gCallOptions[2]=Indication_array[8];

                putvalue(env_RNS_CallState_Opt_AcCall_2,gCallOptions[2] &0x01);         //Bit0
                putvalue(env_RNS_CallState_Opt_HoldAc_2,(gCallOptions[2] &0x02)/0x02);  //Bit1
                putvalue(env_RNS_CallState_Opt_CallAc_2,(gCallOptions[2] &0x04)/0x04);  //Bit2
                putvalue(env_RNS_CallState_Opt_CallHold_2,(gCallOptions[2] &0x08)/0x08);//Bit3
                putvalue(env_RNS_CallState_Opt_ResCall_2,(gCallOptions[2] &0x10)/0x10); //Bit4
                putvalue(env_RNS_CallState_Opt_MPSwap_2,(gCallOptions[2] &0x20)/0x20);  //Bit5
                putvalue(env_RNS_CallState_Opt_CCJoin_2,(gCallOptions[2] &0x40)/0x40);  //Bit6
				putvalue(env_RNS_CallState_Opt_CCSplit_2,(gCallOptions[2] &0x80)/0x80); //Bit7

                putvalue(env_RNS_CallState_CallInDivert_2,(gCallInDivert &0x04) /0x04);     //Bit2
                putvalue(env_RNS_CallState_CallOuDivert_2,(gCallOutDivert &0x04) /0x04);    //Bit2

				//CallID 3
				gCallState[3]=(Indication_array[9] & 0xf0)/16;
				
                if(gCallState[3]>CALLSTATES)
					putvalue(env_RNS_CallState_CallID_3, greserved);
				else
					putvalue(env_RNS_CallState_CallID_3,gstring_callstate[gCallState[3]]);
				gCallType[3]=Indication_array[9] & 0x0f;
				
                /*if(gCallState[3]==idle)
					putvalue(env_RNS_CallType_CallID_3,empty_string);
	
				else*/
				{
					if(gCallType[3]>CALLTYPES)
						putvalue(env_RNS_CallType_CallID_3, greserved);
					
					else
						putvalue(env_RNS_CallType_CallID_3,gstring_calltype[gCallType[3]]);
				}
                
                gCallOptions[3]=Indication_array[10];

                putvalue(env_RNS_CallState_Opt_AcCall_3,gCallOptions[3] &0x01);         //Bit0
                putvalue(env_RNS_CallState_Opt_HoldAc_3,(gCallOptions[3] &0x02)/0x02);  //Bit1
                putvalue(env_RNS_CallState_Opt_CallAc_3,(gCallOptions[3] &0x04)/0x04);  //Bit2
                putvalue(env_RNS_CallState_Opt_CallHold_3,(gCallOptions[3] &0x08)/0x08);//Bit3
                putvalue(env_RNS_CallState_Opt_ResCall_3,(gCallOptions[3] &0x10)/0x10); //Bit4
                putvalue(env_RNS_CallState_Opt_MPSwap_3,(gCallOptions[3] &0x20)/0x20);  //Bit5
                putvalue(env_RNS_CallState_Opt_CCJoin_3,(gCallOptions[3] &0x40)/0x40);  //Bit6
				putvalue(env_RNS_CallState_Opt_CCSplit_3,(gCallOptions[3] &0x80)/0x80); //Bit7

                putvalue(env_RNS_CallState_CallInDivert_3,(gCallInDivert &0x08) /0x08);     //Bit3
                putvalue(env_RNS_CallState_CallOuDivert_3,(gCallOutDivert &0x08) /0x08);    //Bit3

				//CallID 4
				gCallState[4]=(Indication_array[11] & 0xf0)/16;
				
                if(gCallState[4]>CALLSTATES)
					putvalue(env_RNS_CallState_CallID_4, greserved);
				else
					putvalue(env_RNS_CallState_CallID_4,gstring_callstate[gCallState[4]]);
				
                gCallType[4]=Indication_array[11] & 0x0f;
				
                /*if(gCallState[4]==idle)
					putvalue(env_RNS_CallType_CallID_4,empty_string);

				else*/
				{
					if(gCallType[4]>CALLTYPES)
						putvalue(env_RNS_CallType_CallID_4, greserved);
					
					else
						putvalue(env_RNS_CallType_CallID_4,gstring_calltype[gCallType[4]]);
				}

                gCallOptions[4]=Indication_array[12];

                putvalue(env_RNS_CallState_Opt_AcCall_4,gCallOptions[4] &0x01);         //Bit0
                putvalue(env_RNS_CallState_Opt_HoldAc_4,(gCallOptions[4] &0x02)/0x02);  //Bit1
                putvalue(env_RNS_CallState_Opt_CallAc_4,(gCallOptions[4] &0x04)/0x04);  //Bit2
                putvalue(env_RNS_CallState_Opt_CallHold_4,(gCallOptions[4] &0x08)/0x08);//Bit3
                putvalue(env_RNS_CallState_Opt_ResCall_4,(gCallOptions[4] &0x10)/0x10); //Bit4
                putvalue(env_RNS_CallState_Opt_MPSwap_4,(gCallOptions[4] &0x20)/0x20);  //Bit5
                putvalue(env_RNS_CallState_Opt_CCJoin_4,(gCallOptions[4] &0x40)/0x40);  //Bit6
				putvalue(env_RNS_CallState_Opt_CCSplit_4,(gCallOptions[4] &0x80)/0x80); //Bit7

                putvalue(env_RNS_CallState_CallInDivert_4,(gCallInDivert &0x10) /0x10);     //Bit4
                putvalue(env_RNS_CallState_CallOuDivert_4,(gCallOutDivert &0x10) /0x10);    //Bit4

				//CallID 5
				gCallState[5]=(Indication_array[13] & 0xf0)/16;
				
                if(gCallState[5]>CALLSTATES)
					putvalue(env_RNS_CallState_CallID_5, greserved);
				else
					putvalue(env_RNS_CallState_CallID_5,gstring_callstate[gCallState[5]]);
				
                gCallType[5]=Indication_array[13] & 0x0f;
				
                /*if(gCallState[5]==idle)
					putvalue(env_RNS_CallType_CallID_5,empty_string);

				else*/
				{
					if(gCallType[5]>CALLTYPES)
						putvalue(env_RNS_CallType_CallID_5, greserved);
					
					else
						putvalue(env_RNS_CallType_CallID_5,gstring_calltype[gCallType[5]]);
				}		

                gCallOptions[5]=Indication_array[14];

                putvalue(env_RNS_CallState_Opt_AcCall_5,gCallOptions[5] &0x01);         //Bit0
                putvalue(env_RNS_CallState_Opt_HoldAc_5,(gCallOptions[5] &0x02)/0x02);  //Bit1
                putvalue(env_RNS_CallState_Opt_CallAc_5,(gCallOptions[5] &0x04)/0x04);  //Bit2
                putvalue(env_RNS_CallState_Opt_CallHold_5,(gCallOptions[5] &0x08)/0x08);//Bit3
                putvalue(env_RNS_CallState_Opt_ResCall_5,(gCallOptions[5] &0x10)/0x10); //Bit4
                putvalue(env_RNS_CallState_Opt_MPSwap_5,(gCallOptions[5] &0x20)/0x20);  //Bit5
                putvalue(env_RNS_CallState_Opt_CCJoin_5,(gCallOptions[5] &0x40)/0x40);  //Bit6
				putvalue(env_RNS_CallState_Opt_CCSplit_5,(gCallOptions[5] &0x80)/0x80); //Bit7

                putvalue(env_RNS_CallState_CallInDivert_5,(gCallInDivert &0x20) /0x20);     //Bit5
                putvalue(env_RNS_CallState_CallOuDivert_5,(gCallOutDivert &0x20) /0x20);    //Bit5

				//CallID 6
				gCallState[6]=(Indication_array[15] & 0xf0)/16;
				
                if(gCallState[6]>CALLSTATES)
					putvalue(env_RNS_CallState_CallID_6, greserved);
				else
					putvalue(env_RNS_CallState_CallID_6,gstring_callstate[gCallState[6]]);
				gCallType[6]=Indication_array[15] & 0x0f;
				
                /*if(gCallState[6]==idle)
					putvalue(env_RNS_CallType_CallID_6,empty_string);
				
				else*/
				{
					if(gCallType[6]>CALLTYPES)
						putvalue(env_RNS_CallType_CallID_6, greserved);
					
					else
						putvalue(env_RNS_CallType_CallID_6,gstring_calltype[gCallType[6]]);			
				}

                gCallOptions[6]=Indication_array[16];

                putvalue(env_RNS_CallState_Opt_AcCall_6,gCallOptions[6] &0x01);         //Bit0
                putvalue(env_RNS_CallState_Opt_HoldAc_6,(gCallOptions[6] &0x02)/0x02);  //Bit1
                putvalue(env_RNS_CallState_Opt_CallAc_6,(gCallOptions[6] &0x04)/0x04);  //Bit2
                putvalue(env_RNS_CallState_Opt_CallHold_6,(gCallOptions[6] &0x08)/0x08);//Bit3
                putvalue(env_RNS_CallState_Opt_ResCall_6,(gCallOptions[6] &0x10)/0x10); //Bit4
                putvalue(env_RNS_CallState_Opt_MPSwap_6,(gCallOptions[6] &0x20)/0x20);  //Bit5
                putvalue(env_RNS_CallState_Opt_CCJoin_6,(gCallOptions[6] &0x40)/0x40);  //Bit6
				putvalue(env_RNS_CallState_Opt_CCSplit_6,(gCallOptions[6] &0x80)/0x80); //Bit7

                putvalue(env_RNS_CallState_CallInDivert_6,(gCallInDivert &0x40) /0x40);     //Bit6
                putvalue(env_RNS_CallState_CallOuDivert_6,(gCallOutDivert &0x40) /0x40);    //Bit6

                putvalue(env_RNS_CallState_ECall_Pending,(gCallOutDivert &0x80) /0x80);    //Bit7

			}
		break;
		default:
			writelineEx(gError_Trace, 0, "ASG callstate indication: unknown indication %d", indication);
		break;

	}
}
/*@@end*/

/*@@envVar:env_RNS_DialNumber:*/
on envVar env_RNS_DialNumber
{
int length;
char i, empty_string [3];

//init lokal variables
	length=0;
	for(i=0;i<3;i++)
		empty_string[i]=0;
//********************

	if(gRNS_PowerOnOff==Power_on && gBAP_Phone_available==BAPPhone  && getvalue(this)){
		getvalue(env_RNS_dialnumber_number, gDialNumber);	
		getvalue(env_RNS_dialnumber_name, gdialnumber_name);	
		length=strlen(gDialNumber);	//mailboxnumber-length
		
        if(length>0)
			dialnumber_Request(StartResult_REQ, gDialNumber, gdialnumber_name, 0);
	}
}
/*@@end*/

/*@@envVar:env_RNS_CallID_0_hangup:*/
on envVar env_RNS_CallID_0_hangup
{
	if(gRNS_PowerOnOff==Power_on && gBAP_Phone_available==BAPPhone && getvalue(this)){
			hangupcall_request (StartResult_REQ, 0, 0);
	}
}
/*@@end*/

/*@@caplFunc:check_hangup(byte):*/
byte check_hangup (byte call_id)	//check, if in this call state hang up is possible (0=impossible, 1=possible)
{
byte hangup=0;

//init lokal variables
	hangup=0;
//********************

	switch(gCallState [call_id]){
				case ringing_waiting:
					hangup=1;
				break;
				case active:
					hangup=1;
				break;
				case dialing:
					hangup=1;
				break;
				case onhold:
					hangup=1;
				break;
				default:	//hangup is impossible in this state 
					hangup=0;
				break;
	}
			
	return(hangup);

}
/*@@end*/

/*@@envVar:env_RNS_CallID_1_hangup:*/
on envVar env_RNS_CallID_1_hangup
{
	if(gRNS_PowerOnOff==Power_on && gBAP_Phone_available==BAPPhone && getvalue(this)){
			hangupcall_request (StartResult_REQ, 1, 0);
	}
}
/*@@end*/

/*@@envVar:env_RNS_CallID_2_hangup:*/
on envVar env_RNS_CallID_2_hangup
{
	if(gRNS_PowerOnOff==Power_on && gBAP_Phone_available==BAPPhone && getvalue(this)){
			hangupcall_request (StartResult_REQ, 2, 0);
	}
}
/*@@end*/

/*@@envVar:env_RNS_CallID_3_hangup:*/
on envVar env_RNS_CallID_3_hangup
{
	if(gRNS_PowerOnOff==Power_on && gBAP_Phone_available==BAPPhone && getvalue(this)){
			hangupcall_request (StartResult_REQ, 3, 0);
	}
}
/*@@end*/

/*@@envVar:env_RNS_CallID_4_hangup:*/
on envVar env_RNS_CallID_4_hangup
{
	if(gRNS_PowerOnOff==Power_on && gBAP_Phone_available==BAPPhone && getvalue(this)){
			hangupcall_request (StartResult_REQ, 4, 0);
	}
}
/*@@end*/

/*@@envVar:env_RNS_CallID_5_hangup:*/
on envVar env_RNS_CallID_5_hangup
{
	if(gRNS_PowerOnOff==Power_on && gBAP_Phone_available==BAPPhone && getvalue(this)){
			hangupcall_request (StartResult_REQ, 5, 0);
	}
}
/*@@end*/

/*@@envVar:env_RNS_CallID_6_hangup:*/
on envVar env_RNS_CallID_6_hangup
{
	if(gRNS_PowerOnOff==Power_on && gBAP_Phone_available==BAPPhone && getvalue(this)){
			hangupcall_request (StartResult_REQ, 6, 0);
	}
}
/*@@end*/

/*@@caplFunc:CallInfo_Indication(dword[],byte,int):*/
CallInfo_Indication (dword Indication_array [], byte indication, int datalength)
{
byte i=0, length =0, Offset =0;

	switch(indication){
		case Data_IND:
                Offset=3;
                
                //CallID 0
				length=Indication_array[Offset];
                Offset++;
                //write("length0: 0x%x", length);      //debug
            
                for(i=0;i<CALL_INFO_NAME_LENGTH;i++)
                    gcallinfo_name[0][i] =0;
                
                for(i=0;i<length;i++)
                {    
                    gcallinfo_name[0][i] =Indication_array[Offset];
                    //write("ind_array 0x%x, offset 0x%x", Indication_array[Offset], Offset);       //debug
                    Offset++;
                }
                
                putvalue(env_RNS_CallInfo_PbName_0 ,gcallinfo_name[0]);

                length=Indication_array[Offset];
                Offset++;

                for(i=0;i<CALL_INFO_NUMBER_LENGTH;i++)
                    gcallinfo_number[0][i] =0;
                
                for(i=0;i<length;i++)
                {    
                    gcallinfo_number[0][i] =Indication_array[Offset];
                    Offset++;
                }
                
                putvalue(env_RNS_CallInfo_TelNumber_0 ,gcallinfo_number[0]);

                gcallinfo_category [0] =Indication_array[Offset];
                Offset++;
                
                if(gcallinfo_category [0]<0x0F)
                    putvalue(env_RNS_CallInfo_Category_0, gcallinfo_category_string[gcallinfo_category [0]]);
                else
                    putvalue(env_RNS_CallInfo_Category_0, greserved);
    
                //CallID 1
				length=Indication_array[Offset];
                Offset++;
            
                for(i=0;i<CALL_INFO_NAME_LENGTH;i++)
                    gcallinfo_name[1][i] =0;
                
                for(i=0;i<length;i++)
                {    
                    gcallinfo_name[1][i] =Indication_array[Offset];
                    Offset++;
                }
                
                putvalue(env_RNS_CallInfo_PbName_1 ,gcallinfo_name[1]);

                length=Indication_array[Offset];
                Offset++;

                for(i=0;i<CALL_INFO_NUMBER_LENGTH;i++)
                    gcallinfo_number[1][i] =0;
                
                for(i=0;i<length;i++)
                {    
                    gcallinfo_number[1][i] =Indication_array[Offset];
                    Offset++;
                }
                
                putvalue(env_RNS_CallInfo_TelNumber_1 ,gcallinfo_number[1]);

                gcallinfo_category [1] =Indication_array[Offset];
                Offset++;
                
                if(gcallinfo_category [1]<0x0F)
                    putvalue(env_RNS_CallInfo_Category_1, gcallinfo_category_string[gcallinfo_category [1]]);
                else
                    putvalue(env_RNS_CallInfo_Category_1, greserved);

                
                //CallID 2
				length=Indication_array[Offset];
                Offset++;
            
                for(i=0;i<CALL_INFO_NAME_LENGTH;i++)
                    gcallinfo_name[2][i] =0;
                
                for(i=0;i<length;i++)
                {    
                    gcallinfo_name[2][i] =Indication_array[Offset];
                    Offset++;
                }
                
                putvalue(env_RNS_CallInfo_PbName_2 ,gcallinfo_name[2]);

                length=Indication_array[Offset];
                Offset++;

                for(i=0;i<CALL_INFO_NUMBER_LENGTH;i++)
                    gcallinfo_number[2][i] =0;
                
                for(i=0;i<length;i++)
                {    
                    gcallinfo_number[2][i] =Indication_array[Offset];
                    Offset++;
                }

                putvalue(env_RNS_CallInfo_TelNumber_2 ,gcallinfo_number[2]);

                gcallinfo_category [2] =Indication_array[Offset];
                Offset++;
                
                if(gcallinfo_category [2]<0x0F)
                    putvalue(env_RNS_CallInfo_Category_2, gcallinfo_category_string[gcallinfo_category [2]]);
                else
                    putvalue(env_RNS_CallInfo_Category_2, greserved);


                //CallID 3
				length=Indication_array[Offset];
                Offset++;
            
                for(i=0;i<CALL_INFO_NAME_LENGTH;i++)
                    gcallinfo_name[3][i] =0;
                
                for(i=0;i<length;i++)
                {    
                    gcallinfo_name[3][i] =Indication_array[Offset];
                    Offset++;
                }
                
                putvalue(env_RNS_CallInfo_PbName_3 ,gcallinfo_name[3]);

                length=Indication_array[Offset];
                Offset++;

                for(i=0;i<CALL_INFO_NUMBER_LENGTH;i++)
                    gcallinfo_number[3][i] =0;
                
                for(i=0;i<length;i++)
                {    
                    gcallinfo_number[3][i] =Indication_array[Offset];
                    Offset++;
                }

                putvalue(env_RNS_CallInfo_TelNumber_3 ,gcallinfo_number[3]);

                gcallinfo_category [3] =Indication_array[Offset];
                Offset++;
                
                if(gcallinfo_category [3]<0x0F)
                    putvalue(env_RNS_CallInfo_Category_3, gcallinfo_category_string[gcallinfo_category [3]]);
                else
                    putvalue(env_RNS_CallInfo_Category_3, greserved);

                
                //CallID 4
				length=Indication_array[Offset];
                Offset++;
            
                for(i=0;i<CALL_INFO_NAME_LENGTH;i++)
                    gcallinfo_name[4][i] =0;
                
                for(i=0;i<length;i++)
                {    
                    gcallinfo_name[4][i] =Indication_array[Offset];
                    Offset++;
                }
                
                putvalue(env_RNS_CallInfo_PbName_4 ,gcallinfo_name[4]);

                length=Indication_array[Offset];
                Offset++;

                for(i=0;i<CALL_INFO_NUMBER_LENGTH;i++)
                    gcallinfo_number[4][i] =0;
                
                for(i=0;i<length;i++)
                {    
                    gcallinfo_number[4][i] =Indication_array[Offset];
                    Offset++;
                }
                
                putvalue(env_RNS_CallInfo_TelNumber_4 ,gcallinfo_number[4]);

                gcallinfo_category [4] =Indication_array[Offset];
                Offset++;
                
                if(gcallinfo_category [4]<0x0F)
                    putvalue(env_RNS_CallInfo_Category_4, gcallinfo_category_string[gcallinfo_category [4]]);
                else
                    putvalue(env_RNS_CallInfo_Category_4, greserved);


                //CallID 5
				length=Indication_array[Offset];
                Offset++;
            
                for(i=0;i<CALL_INFO_NAME_LENGTH;i++)
                    gcallinfo_name[5][i] =0;
                
                for(i=0;i<length;i++)
                {    
                    gcallinfo_name[5][i] =Indication_array[Offset];
                    Offset++;
                }
                
                putvalue(env_RNS_CallInfo_PbName_5 ,gcallinfo_name[5]);

                length=Indication_array[Offset];
                Offset++;

                for(i=0;i<CALL_INFO_NUMBER_LENGTH;i++)
                    gcallinfo_number[5][i] =0;
                
                for(i=0;i<length;i++)
                {    
                    gcallinfo_number[5][i] =Indication_array[Offset];
                    Offset++;
                }

                putvalue(env_RNS_CallInfo_TelNumber_5 ,gcallinfo_number[5]);

                gcallinfo_category [5] =Indication_array[Offset];
                Offset++;
                
                if(gcallinfo_category [5]<0x0F)
                    putvalue(env_RNS_CallInfo_Category_5, gcallinfo_category_string[gcallinfo_category [5]]);
                else
                    putvalue(env_RNS_CallInfo_Category_5, greserved);
                

                //CallID 6
				length=Indication_array[Offset];
                Offset++;
            
                for(i=0;i<CALL_INFO_NAME_LENGTH;i++)
                    gcallinfo_name[6][i] =0;
                
                for(i=0;i<length;i++)
                {    
                    gcallinfo_name[6][i] =Indication_array[Offset];
                    Offset++;
                }
                
                putvalue(env_RNS_CallInfo_PbName_6 ,gcallinfo_name[6]);

                length=Indication_array[Offset];
                Offset++;

                for(i=0;i<CALL_INFO_NUMBER_LENGTH;i++)
                    gcallinfo_number[6][i] =0;
                
                for(i=0;i<length;i++)
                {    
                    gcallinfo_number[6][i] =Indication_array[Offset];
                    Offset++;
                }

                putvalue(env_RNS_CallInfo_TelNumber_6 ,gcallinfo_number[6]);

                gcallinfo_category [6] =Indication_array[Offset];
                Offset++;
                
                if(gcallinfo_category [6]<0x0F)
                    putvalue(env_RNS_CallInfo_Category_6, gcallinfo_category_string[gcallinfo_category [6]]);
                else
                    putvalue(env_RNS_CallInfo_Category_6, greserved);
                
                putvalue(env_RNS_CallInfo_PbName_0,gcallinfo_name[0]);
                putvalue(env_RNS_CallInfo_PbName_1,gcallinfo_name[1]);
                putvalue(env_RNS_CallInfo_PbName_2,gcallinfo_name[2]);
                putvalue(env_RNS_CallInfo_PbName_3,gcallinfo_name[3]);
                putvalue(env_RNS_CallInfo_PbName_4,gcallinfo_name[4]);
                putvalue(env_RNS_CallInfo_PbName_5,gcallinfo_name[5]);
                putvalue(env_RNS_CallInfo_PbName_6,gcallinfo_name[6]);
                putvalue(env_RNS_CallInfo_TelNumber_0,gcallinfo_number[0]);
                putvalue(env_RNS_CallInfo_TelNumber_1,gcallinfo_number[1]);
                putvalue(env_RNS_CallInfo_TelNumber_2,gcallinfo_number[2]);
                putvalue(env_RNS_CallInfo_TelNumber_3,gcallinfo_number[3]);
                putvalue(env_RNS_CallInfo_TelNumber_4,gcallinfo_number[4]);
                putvalue(env_RNS_CallInfo_TelNumber_5,gcallinfo_number[5]);
                putvalue(env_RNS_CallInfo_TelNumber_6,gcallinfo_number[6]);
                
         break;
    }
}
/*@@end*/

/*@@caplFunc:CallInfo_Request(byte,byte):*/
CallInfo_Request (byte request, byte errorcode)
{
int Offset, i;
dword requestarray [BAP_buffer_size];

//init lokal variables
	Offset=0;
	
	for(i=0;i<BAP_buffer_size;i++)
		requestarray [i]=0;
//********************

	switch (request){
		case DataGet_REQ:
			requestarray[0]=LSGID_Telephone;	//LSG-ID
			requestarray[1]=FctID_CallInfo;	    //Fct.-ID
			requestarray[2]=request;
			Offset=3;
			set_status_requestbuffer (requestarray, Offset, Bap_Void);
		break;
		default:
			writelineEx(gError_Trace, 0, "ASG CallInfo_Request: unknown request %d", request);
		break;
	}
}
/*@@end*/

/*@@caplFunc:NetworkProvider_Request(byte,byte):*/
NetworkProvider_Request (byte request, byte errorcode)
{
int i, Offset;
dword requestarray [BAP_buffer_size];

//init lokal variables
	Offset=0;

	for(i=0;i<BAP_buffer_size;i++)
		requestarray [i]=0;
//********************

	
	switch (request){
		case DataGet_REQ:
			requestarray[0]=LSGID_Telephone;	//LSG-ID
			requestarray[1]=FctID_NetworkProvider;	//Fct.-ID
			requestarray[2]=request;
			Offset=3;
			set_status_requestbuffer (requestarray, Offset, Bap_Void);
		break;
		default:	//error
			writelineEx(gError_Trace, 0, "ASG NetworkProvider_Request: unknown request %d", request);
		break;
	}
}
/*@@end*/

/*@@caplFunc:CallState_Request(byte,byte):*/
CallState_Request (byte request, byte errorcode)
{
int Offset, i;
dword requestarray [BAP_buffer_size];

//init lokal variables
	Offset=0;
	
	for(i=0;i<BAP_buffer_size;i++)
		requestarray [i]=0;
//********************

	switch (request){
		case DataGet_REQ:
			requestarray[0]=LSGID_Telephone;	//LSG-ID
			requestarray[1]=FctID_CallState;	//Fct.-ID
			requestarray[2]=request;
			Offset=3;
			set_status_requestbuffer (requestarray, Offset, Bap_Void);
		break;
		default:
			writelineEx(gError_Trace, 0, "ASG callstate_request: unknown request %d", request);
		break;
	}
}
/*@@end*/

/*@@caplFunc:checkcallinfoarray(byte[],int):*/
byte checkcallinfoarray (byte array[], int arraylength)
{
byte valid, mode, indexsize, transmitpos;
word elements;
int i,length, arraypointer;

//init lokal variables
	mode=0;
	indexsize=0;
	transmitpos=0;
	elements=0;
	length=0;
	arraypointer=0;
	valid=1;
//********************


	//***mode***
	mode=array[3];
	indexsize=mode & 0x01;
	//write("ASG checkarray indexsize: %d", indexsize);
	transmitpos=(mode & 0x02)/2;
	//write("ASG checkarray transmitpos: %d", transmitpos);


	switch(array[2]){	//16 Bits for start/elements/pos
		case Changed_IND:
			//********arraylength*******
			if(indexsize){
				elements=array[6]+array[7]*256;
				if(arraylength!=8)	//BAPheader+extendetarrayheader
					return(0xff);
			}
			else{	//8 Bits for start/elements/pos
				elements=array[5];
				if(arraylength!=6)	//BAPheader+extendetarrayheader
					return(0xff);
			}
			//**************************

			//***elements***
			if(elements==0)
				return(0xff);
			//**************
		break;
		case Data_IND:
			//********arraylength*******
			if(indexsize){	//16 Bits for start/elements/pos
				elements=array[6]+array[7]*256;
				length=8+elements/*elements*2*/+2*elements*transmitpos;	//(BAPheader+extendetarrayheader)+elements*(lengthbyte+type/divertbyte)+(elements*transmitpos(word))
				
				if(transmitpos){
					arraypointer=10;
					for(i=0;i<elements;i++){
						length=length+array[arraypointer];
						arraypointer=arraypointer+array[arraypointer]+3;//4;
					}
				}
				else{
					arraypointer=8;
					for(i=0;i<elements;i++){
						length=length+array[arraypointer];
						arraypointer=arraypointer+array[arraypointer]+1;//2;
					}
				}
			}
			else{			//8 Bits for start/elements/pos
				elements=array[5];
				length=6+elements/*elements*2*/+elements*transmitpos;	//(BAPheader+extendetarrayheader)+elements*(lengthbyte+type/divertbyte)+(elements*transmitpos(byte))
				
				if(transmitpos){
					arraypointer=7;
					for(i=0;i<elements;i++){
						length=length+array[arraypointer];
						arraypointer=arraypointer+array[arraypointer]+2;//3;
					}
				}
				else{
					arraypointer=6;
					for(i=0;i<elements;i++){
						length=length+array[arraypointer];
						arraypointer=arraypointer+array[arraypointer]+1;//2;
					}
				}

			}
			
			if(arraylength!=length)
				return(0xff);
			//**************************

			//***elements***
			if(elements==0)
				return(0xff);
			//**************
		break;
		case Error_IND:
			if(arraylength!=4)
				return(0xff);
		break;
		default:	//error
			write("ASG checkcallinfoarray: unknown opcode %d", array[2]);
		break;
		
	}

	return(valid);

}
/*@@end*/

/*@@caplFunc:HandsFreeOnOff_Request(byte,byte):*/
HandsFreeOnOff_Request (byte request, byte errorcode)
{
int Offset, i;
dword requestarray [BAP_buffer_size];


//init lokal variables
	Offset=0;

	for(i=0;i<BAP_buffer_size;i++)
		requestarray [i]=0;
//********************

	
	switch(request){
		case DataSetGet_REQ:
			requestarray[0]=LSGID_Telephone;	//LSG-ID
			requestarray[1]=FctID_HandsFreeOnOff;	//Fct.-ID
			requestarray[2]=request;	
			requestarray[3]=gHandsFree;
			Offset=4;
			set_status_requestbuffer (requestarray, Offset, Bap_UInt8);
		break;
		case DataGet_REQ:
			requestarray[0]=LSGID_Telephone;	//LSG-ID
			requestarray[1]=FctID_HandsFreeOnOff;	//Fct.-ID
			requestarray[2]=request;
			Offset=3;
			set_status_requestbuffer (requestarray, Offset, Bap_Void);
		break;
		default:	//error
			writelineEx(gError_Trace, 0, "ASG HandsFreeOnOff_Request: unknown request %d", request);
		break;
	}
}
/*@@end*/

/*@@caplFunc:MicroMuteOnOff_Request(byte,byte):*/
MicroMuteOnOff_Request (byte request, byte errorcode)
{
int Offset, i;
dword requestarray [BAP_buffer_size];

//init lokal variables
	Offset=0;

	for(i=0;i<BAP_buffer_size;i++)
		requestarray [i]=0;
//********************

	
	switch(request){
		case DataSet_REQ:
			requestarray[0]=LSGID_Telephone;	//LSG-ID
			requestarray[1]=FctID_MicroMuteOnOff;	//Fct.-ID
			requestarray[2]=request;	
			requestarray[3]=gMicroMute;
			Offset=4;
			set_status_requestbuffer (requestarray, Offset, Bap_UInt8);
		break;
		case DataSetGet_REQ:
			requestarray[0]=LSGID_Telephone;	//LSG-ID
			requestarray[1]=FctID_MicroMuteOnOff;	//Fct.-ID
			requestarray[2]=request;	
			requestarray[3]=gMicroMute;
			Offset=4;
			set_status_requestbuffer (requestarray, Offset, Bap_UInt8);
		break;
		case DataGet_REQ:
			requestarray[0]=LSGID_Telephone;	//LSG-ID
			requestarray[1]=FctID_MicroMuteOnOff;	//Fct.-ID
			requestarray[2]=request;
			Offset=3;
			set_status_requestbuffer (requestarray, Offset, Bap_Void);
		break;
		default:	//error
			writelineEx(gError_Trace, 0, "ASG MicroMuteOnOff_Request: unknown request %d", request);
		break;
	}
}
/*@@end*/

/*@@caplFunc:HandsFreeOnOff_Indication(dword[],byte,int):*/
HandsFreeOnOff_Indication (dword Indication_array [], byte indication, int datalength)
{
byte errorcode;

	errorcode=0x00;


	//check array
	if(datalength!=4)	//datalength error
		writelineEx(gError_Trace, 0, "ASG handsfreeonoff_Indication: BAP_datalength_error");	//send error-message
	else{
		switch (indication){
			case Data_IND:
				gHandsFree=Indication_array[3] & 0x01;
				if(gHandsFree!=getvalue(env_RNS_HandsFreeOnOff))
					gderTag=1;
				putvalue(env_RNS_HandsFreeOnOff, gHandsFree);
				putvalue(env_RNS_HandsFree_string, gstring_HandsFree[gHandsFree]);
			break;
			case Error_IND:
				errorcode=Indication_array[3];
				if(errorcode<0x20)				//BCL-error
					writelineEx(gError_Trace, 0, "ASG HandsFreeOnOff_Indication: BCL-Error: 0x%x - %s", errorcode, gerror_codes_BCL [errorcode-0x10]);
				else if(errorcode<0x30)			//BPL-error
					writelineEx(gError_Trace, 0, "ASG HandsFreeOnOff_Indication: BPL-Error: 0x%x - %s", errorcode, gerror_codes_BPL [errorcode-0x20]);				
				else if(errorcode<0x40)			//BAL-error
					writelineEx(gError_Trace, 0, "ASG HandsFreeOnOff_Indication: BAL-Error: 0x%x - %s", errorcode, gerror_codes_BAL [errorcode-0x30]);
				else if(errorcode>=0x80 && errorcode<=0xA2)
					writelineEx(gError_Trace, 0, "ASG HandsFreeOnOff_Indication: Telephone-Error: 0x%x - %s", errorcode, gerror_codes_telephone [errorcode-0x80]);
				else
				writelineEx(gError_Trace, 0, "ASG HandsFreeOnOff_Indication: Telephone-Error: 0x%x", errorcode);

				if(errorcode==Terror_noheadsetconnected){
					gHandsFree=1;
					gderTag=1;
					putvalue(env_RNS_HandsFreeOnOff, gHandsFree);
				}
			break;
			default:
				writelineEx(gError_Trace, 0, "ASG handsfreeonoff_Indication: unknown indication %d", indication);
			break;
		}
	}
}
/*@@end*/

/*@@envVar:env_RNS_HandsFreeOnOff:*/
on envVar env_RNS_HandsFreeOnOff
{
	if(gRNS_PowerOnOff==Power_on && gBAP_Phone_available==BAPPhone){
		if(gderTag==0){
			gHandsFree=getvalue(env_RNS_HandsFreeOnOff);

			handsfreeonoff_Request(DataSetGet_REQ, 0);
		}
		else
			gderTag=0;
	}
}
/*@@end*/

/*@@caplFunc:MicroMuteOnOff_Indication(dword[],byte,int):*/
MicroMuteOnOff_Indication (dword Indication_array [], byte indication, int datalength)
{
byte errorcode;

	errorcode=0x00;
	
	//check array
	if(datalength!=4)	//datalength error
		writelineEx(gError_Trace, 0, "ASG micromuteonoff_Indication BAP-datalength-error");
	else{
		switch (indication){
			case Data_IND:
				gMicroMute=Indication_array[3] & 0x01;;
				if(gMicroMute!=getvalue(env_RNS_MicroMuteOnOff))
					gdieNacht=1;
				putvalue(env_RNS_MicroMuteOnOff, gMicroMute);
				putvalue(env_RNS_MicroMute_string, gstring_MicroMute[gMicroMute]);
			break;
			case Error_IND:
				errorcode=Indication_array[3];
				if(errorcode<0x20)				//BCL-error
					writelineEx(gError_Trace, 0, "ASG MicroMuteOnOff_Indication: BCL-Error: 0x%x - %s", errorcode, gerror_codes_BCL [errorcode-0x10]);
				else if(errorcode<0x30)			//BPL-error
					writelineEx(gError_Trace, 0, "ASG MicroMuteOnOff_Indication: BPL-Error: 0x%x - %s", errorcode, gerror_codes_BPL [errorcode-0x20]);				
				else if(errorcode<0x40)			//BAL-error
					writelineEx(gError_Trace, 0, "ASG MicroMuteOnOff_Indication: BAL-Error: 0x%x - %s", errorcode, gerror_codes_BAL [errorcode-0x30]);
				else if(errorcode>=0x80 && errorcode<=0xA2)
					writelineEx(gError_Trace, 0, "ASG MicroMuteOnOff_Indication: Telephone-Error: 0x%x - %s", errorcode, gerror_codes_telephone [errorcode-0x80]);
				else
					writelineEx(gError_Trace, 0, "ASG MicroMuteOnOff_Indication: Telephone-Error: 0x%x", errorcode);
			break;
			default:
				writelineEx(gError_Trace, 0, "ASG MicroMuteOnOff_Indication: unknown indication %d", indication);
			break;
		}
	}
}
/*@@end*/

/*@@envVar:env_RNS_MicroMuteOnOff:*/
on envVar env_RNS_MicroMuteOnOff
{
	if(gRNS_PowerOnOff==Power_on && gBAP_Phone_available==BAPPhone){
		if(gdieNacht==0){
			gMicroMute=getvalue(env_RNS_MicroMuteOnOff);
			micromuteonoff_Request(DataSetGet_REQ, 0);
		}
		else
			gdieNacht=0;
	}
}
/*@@end*/

/*@@envVar:env_RNS_incomingcall_accept:*/
on envVar env_RNS_incomingcall_accept
{
	
byte i, incomingcallID;

//init lokal variables
	incomingcallID=0xff;
//********************

	if(gRNS_PowerOnOff==Power_on && gBAP_Phone_available==BAPPhone && getvalue(this)){
		/*for(i=0;i<7;i++){	//check call-states for incoming call
			if(gCallState[i]==ringing_waiting)
				incomingcallID=i;
		}*/

		//if(getvalue(env_RNS_incomingcall_accept) && incomingcallID!=0xff){	//only when button ist pressed and one callID-callstate is "ringing/waiting"
			AcceptCall_Request(StartResult_REQ, 0);
		//}
	}
}
/*@@end*/

/*@@caplFunc:AcceptCall_Request(byte,byte):*/
AcceptCall_Request (byte request, byte errorcode)
{
int i, Offset;
dword requestarray [BAP_buffer_size];

//init lokal variables
	Offset=0;

	for(i=0;i<BAP_buffer_size;i++)
		requestarray [i]=0;
//********************

	
	switch(request){
		case StartResult_REQ:
			requestarray[0]=LSGID_Telephone;	//LSG-ID
			requestarray[1]=FctID_AcceptCall;	//Fct.-ID
			requestarray[2]=request;
			Offset=3;
			set_status_requestbuffer (requestarray, Offset, Bap_Void);
		break;
		default://error
			writelineEx(gError_Trace, 0,"ASG AcceptCall_Request: unknown request %d", request);
		break;
	}
}
/*@@end*/

/*@@caplFunc:AcceptCall_Indication(dword[],byte,int):*/
AcceptCall_Indication(dword Indication_array [], byte indication, int datalength)
{
byte errorcode;

	errorcode=0x00;


	switch (indication){
		case Processing_IND:
		break;
		case Result_IND:
			/*if(datalength!=3)	//check array-datalength
				writelineEx(gError_Trace, 0,"ASG AcceptCall_Indication: datalength-error");
			else
				//check BAP-array
				write("ASG AcceptCall_Indication: recieved result");*/
            
                gAcceptCall_Result =Indication_array[3];

                putvalue(env_RNS_incomingcall_result, gAcceptCall_Result_s[gAcceptCall_Result]);
		break;
		case Error_IND:
			if(datalength!=4)
				writelineEx(gError_Trace, 0, "ASG AcceptCall_Indication: BAP-datalength-error");
			else{
				errorcode=Indication_array[3];
				if(errorcode<0x20)				//BCL-error
					writelineEx(gError_Trace, 0, "ASG AcceptCall_Indication: BCL-Error: 0x%x - %s", errorcode, gerror_codes_BCL [errorcode-0x10]);
				else if(errorcode<0x30)			//BPL-error
					writelineEx(gError_Trace, 0, "ASG AcceptCall_Indication: BPL-Error: 0x%x - %s", errorcode, gerror_codes_BPL [errorcode-0x20]);				
				else if(errorcode<0x40)			//BAL-error
					writelineEx(gError_Trace, 0, "ASG AcceptCall_Indication: BAL-Error: 0x%x - %s", errorcode, gerror_codes_BAL [errorcode-0x30]);
				else if(errorcode>=0x80 && errorcode<=0xA2)
					writelineEx(gError_Trace, 0, "ASG AcceptCall_Indication: Telephone-Error: 0x%x - %s", errorcode, gerror_codes_telephone [errorcode-0x80]);
				else
					writelineEx(gError_Trace, 0, "ASG AcceptCall_Indication: Telephone-Error: 0x%x", errorcode);
			}
		break;
		default:
			writelineEx(gError_Trace, 0,"ASG hangupcall indication: unknown indication %d", indication);
		break;
	}
}
/*@@end*/

/*@@caplFunc:dialednumbers_Request_old(byte,word,word,byte,byte):*/
dialednumbers_Request_old (byte request, word startelement, word elements, byte mode, byte errorcode)
{
int i, Offset, indexsize, recordaddress;
dword requestarray [BAP_buffer_size];

//init lokal variables
	Offset=0;
	indexsize=0;
	recordaddress=0;

	for(i=0;i<BAP_buffer_size;i++)
		requestarray [i]=0;	

//********************
	
	recordaddress=mode & 0x0f;
	indexsize=(mode & 0x80)/0x80;

	switch (request){
		case DataSetGet_REQ:
			switch(recordaddress)
			{
				case 1:	//PbName and NumberType only (is only used to delete an entry)	
					//BAP-header
					requestarray[0]=LSGID_Phonebook;	//LSG-ID
					requestarray[1]=FctID_DialedNumbers;	//Fct.-ID
					requestarray[2]=request;	
		
					//extendet array header
					requestarray[3]=mode;				//Mode
					if(indexsize)
					{
						requestarray[4]=startelement & 0x00ff;
						requestarray[5]=(startelement & 0xff00)/0x100;
						requestarray[6]=elements & 0x00ff;
						requestarray[7]=(elements & 0xff00)/0x100;
						Offset=8;
					}
					else
					{
						requestarray[4]=startelement;
						requestarray[5]=elements;
						Offset=6;
					}
					
					//PbName
					requestarray[Offset]=0;
					Offset++;
					//NumberType
					requestarray[Offset]=0;
					Offset++;
					
					set_status_requestbuffer (requestarray, Offset, Bap_ByteSequence);
				break;
				default:
					writelineEx(gError_Trace, 0, "ASG UHV-Phonebook dialednumbers_Request: invalid recordaddress %d", recordaddress);
				break;
			}			
		break;
		case DataGet_REQ:
			//BAP-header
			requestarray[0]=LSGID_Phonebook;	//LSG-ID
			requestarray[1]=FctID_DialedNumbers;	//Fct.-ID
			requestarray[2]=request;	
			
			//extendet array header
			requestarray[3]=mode;	//Mode
			if(indexsize){
				requestarray[4]=startelement & 0x00ff;
				requestarray[5]=(startelement & 0xff00)/256;
				requestarray[6]=elements & 0x00ff;
				requestarray[7]=(elements & 0xff00)/256;
				Offset=8;
			}
			else{
				requestarray[4]=startelement;
				requestarray[5]=elements;
				Offset=6;
			}
		
			set_status_requestbuffer (requestarray, Offset, Bap_ByteSequence);			
		break;
		default:
			writelineEx(gError_Trace, 0, "ASG dialednumbers_Request: unknown request %d", request);
		break;
	}

}
/*@@end*/

/*@@caplFunc:dialednumbers_Indication_old(dword[],byte,int):*/
dialednumbers_Indication_old (dword Indication_array [], byte indication, int datalength)
{/*

int i, length; 
word startelement, leeloo, position, elements, datapointer, callstackline;
byte mode, direction, indexsize, transmitpos, recordaddress, temp;
char sday[3], smonth[3], syear[3], shour[3], smin[3], ssec[3];
byte bday, bmonth, byear, bhour, bmin, bsec;

//init lokal variables
	length=0;
	startelement=0;
	leeloo=0;
	position=0;
	elements=0;
	mode=0;
	direction=0;
	indexsize=0;
	transmitpos=0;
	recordaddress=0;
	datapointer=0;
	callstackline=0;

	for(i=0;i<3;i++){
		sday[i]=0;
		smonth[i]=0;
		syear[i]=0;
		shour[i]=0;
		smin[i]=0;
		ssec[i]=0;
	}

	bday=0;
	bmonth=0;
	byear=0;
	bhour=0;
	bmin=0;
	bsec=0;
//********************
	
	mode=Indication_array [3];
	indexsize=(mode & 0x80)/0x80;
	transmitpos=(mode & 0x40)/0x40;
	direction=(mode & 0x20)/0x20;
	recordaddress=mode & 0x0f;
//	write("ASG dialednumbers_Indication: direction:%d, indexsize: %d, recordaddress: %d", direction, indexsize, recordaddress);		//debug
	
	//indexSize
	if(indexsize){
		startelement=Indication_array[4]+Indication_array[5]*256;
		elements=Indication_array[6]+Indication_array[7]*256;
		datapointer=8;
	}
	else{
		startelement=Indication_array[4];
		elements=Indication_array[5];
		datapointer=6;
	}
	//*********

	//TransmitPos
	if(transmitpos==1){
		if(indexsize){
			position=Indication_array[datapointer]+Indication_array[datapointer+1]*256;
			datapointer=datapointer+2;
		}
		else{
			position=Indication_array[datapointer];
			datapointer++;
		}
	}
	else
		position=startelement;
	//***********

	temp=checkdialedreceivedcallstackarray(Indication_array, datalength);
//	write("ASG checkarray: %d",temp);														//debug
	
	if(temp==0xff){																			//check array-datalength
		writelineEx(gError_Trace, 0, "ASG dialednumbers_Indication: BAP-datalength-error");
	}
	else{
		switch(indication){
			case Changed_IND:
				dialednumbers_Request(DataGet_REQ, 0, 20, 0, 0);
				deletecallstackdialednumbers();												//dialednumbers-array löschen
			break;
			case Data_IND:
				switch(recordaddress){
					case 0:	//complete record
					//	deletecallstackdialednumbers();										//dialednumbers-array löschen
						
						for(leeloo=0;leeloo<elements;leeloo++){
							//PbName
							length=Indication_array[datapointer];
							if(length==0)													//element was deleted
							{
							//	leeloo=elements;											//main loop for recordaddress 1 finished
								/********shift calls in call stack**********************************
								for(callstackline=position;callstackline<(CALLSTACK-2);callstackline++)			//star at the position of deleted entry
								{
									//PbName
									strncpy(gdialednumbers_pbname[callstackline], gdialednumbers_pbname[callstackline+1], 50);
	
									//TelNumber
									strncpy(gdialednumbers_telnumber[callstackline], gdialednumbers_telnumber[callstackline+1], 40);
	
									//Date
									strncpy(gdialednumbers_date[callstackline], gdialednumbers_date[callstackline+1], 7);
	
									//Time
									strncpy(gdialednumbers_time[callstackline], gdialednumbers_time[callstackline+1], 7);
	
									//NumberType
									gdialednumbers_numbertype[callstackline]=gdialednumbers_numbertype[callstackline+1];
								}
								//*******************************************************************

								//delete invalid entry --> create gap
								for(i=0;i<50;i++)
									gdialednumbers_pbname[position][i]=0;									//delete PbName
								for(i=0;i<CALL_INFO_NUMBER_LENGTH;i++)
									gdialednumbers_telnumber[position][i]=0;								//delete TelNumber
								for(i=0;i<7;i++){
									gdialednumbers_date[position][i]=0;									//delete Date
									gdialednumbers_time[position][i]=0;								//delete Time
								}
		
								gdialednumbers_numbertype[position]=0xff;	//delete NumberType
							}
							else																//element was not deleted
							{
								datapointer++;
								for(i=0;i<50;i++)												//delete old name
									gdialednumbers_pbname[position][i]=0;
								for(i=0;i<length;i++)											//save new name
									gdialednumbers_pbname[position][i]=Indication_array[datapointer+i];
						
								datapointer=datapointer+length;

								//NumberType
								if(Indication_array[datapointer]<9)								//known numbertype
									gdialednumbers_numbertype[position]=Indication_array[datapointer];
								else															//unknown numbertype
									gdialednumbers_numbertype[position]=0;						

								datapointer++;

								//TelNumber
								length=Indication_array[datapointer];
								datapointer++;
								for(i=0;i<CALL_INFO_NUMBER_LENGTH;i++)												//delete old number
									gdialednumbers_telnumber[position][i]=0;
								for(i=0;i<length;i++)											//save new number
									gdialednumbers_telnumber[position][i]=Indication_array[datapointer+i];
						
								datapointer=datapointer+length;

								//Date
								bday=Indication_array[datapointer];
								datapointer++;
								bmonth=Indication_array[datapointer];
								datapointer++;
								byear=Indication_array[datapointer];
								datapointer++;
								ltoa(bday, sday, 10);
								ltoa(bmonth, smonth, 10);
								ltoa(byear, syear, 10);
								if(bday==0xff)
								{
									gdialednumbers_date[position][0]=0;
									gdialednumbers_date[position][1]=0;
								}
								else if(bday<10)
								{
									gdialednumbers_date[position][0]='0';
									gdialednumbers_date[position][1]=sday[0];
								}
								else
								{
									gdialednumbers_date[position][0]=sday[0];
									gdialednumbers_date[position][1]=sday[1];
								}
								if(bmonth==0xff)
								{
									gdialednumbers_date[position][2]=0;
									gdialednumbers_date[position][3]=0;
								}
								else if(bmonth<10)
								{
									gdialednumbers_date[position][2]='0';
									gdialednumbers_date[position][3]=smonth[0];
								}
								else
								{
									gdialednumbers_date[position][2]=smonth[0];
									gdialednumbers_date[position][3]=smonth[1];
								}
								if(byear==0xff)
								{
									gdialednumbers_date[position][4]=0;
									gdialednumbers_date[position][5]=0;
								}
								else if(byear<10)
								{
									gdialednumbers_date[position][4]='0';
									gdialednumbers_date[position][5]=syear[0];
								}
								else
								{
									gdialednumbers_date[position][4]=syear[0];
									gdialednumbers_date[position][5]=syear[1];					
								}
					
								//Time
								bhour=Indication_array[datapointer];
								datapointer++;
								bmin=Indication_array[datapointer];
								datapointer++;
								bsec=Indication_array[datapointer];
								datapointer++;
								ltoa(bhour, shour, 10);
								ltoa(bmin, smin, 10);
								ltoa(bsec, ssec, 10);
								if(bhour==0xff)
								{
									gdialednumbers_time[position][0]=0;
									gdialednumbers_time[position][1]=0;
								}
								else if(bhour<10)
								{
									gdialednumbers_time[position][0]='0';
									gdialednumbers_time[position][1]=shour[0];
								}
								else
								{
									gdialednumbers_time[position][0]=shour[0];
									gdialednumbers_time[position][1]=shour[1];
								}
								if(bmin==0xff)
								{
									gdialednumbers_time[position][2]=0;
									gdialednumbers_time[position][3]=0;
								}
								else if(bmin<10)
								{
									gdialednumbers_time[position][2]='0';
									gdialednumbers_time[position][3]=smin[0];
								}
								else
								{
									gdialednumbers_time[position][2]=smin[0];
									gdialednumbers_time[position][3]=smin[1];
								}
								if(bsec==0xff)
								{
									gdialednumbers_time[position][4]=0;
									gdialednumbers_time[position][5]=0;
								}
								else if(bsec<10)
								{
									gdialednumbers_time[position][4]='0';
									gdialednumbers_time[position][5]=ssec[0];
								}
								else
								{
									gdialednumbers_time[position][4]=ssec[0];
									gdialednumbers_time[position][5]=ssec[1];
								}
					
								//transmit position
								if(transmitpos==1){
									if(indexsize){
										position=Indication_array[datapointer]+Indication_array[datapointer+1]*256;
										datapointer=datapointer+2;
									}
									else{
										position=Indication_array[datapointer];
										datapointer++;
									}
								}
								else
									position=position+1-2*direction;
							}
						}
						display_callstack_dialednumbers();
					break;
					case 1:	//PbName and NumberType only
					//	deletecallstackdialednumbers();										//dialednumbers-array löschen

						for(leeloo=0;leeloo<elements;leeloo++){
							//PbName
							length=Indication_array[datapointer];
							datapointer++;
							if(length==0)														//element was deleted
							{
							//	leeloo=elements;												//main loop for recordaddress 1 finished
								/********shift calls in call stack**********************************
								for(callstackline=position;callstackline<(CALLSTACK-2);callstackline++)			//star at the position of deleted entry
								{
									//PbName
									strncpy(gdialednumbers_pbname[callstackline], gdialednumbers_pbname[callstackline+1], 50);
	
									//TelNumber
									strncpy(gdialednumbers_telnumber[callstackline], gdialednumbers_telnumber[callstackline+1], 40);
	
									//Date
									strncpy(gdialednumbers_date[callstackline], gdialednumbers_date[callstackline+1], 7);
	
									//Time
									strncpy(gdialednumbers_time[callstackline], gdialednumbers_time[callstackline+1], 7);
	
									//NumberType
									gdialednumbers_numbertype[callstackline]=gdialednumbers_numbertype[callstackline+1];
								}
								//*******************************************************************

								//delete invalid entry --> create gap
								for(i=0;i<50;i++)
									gdialednumbers_pbname[position][i]=0;									//delete PbName
								for(i=0;i<CALL_INFO_NUMBER_LENGTH;i++)
									gdialednumbers_telnumber[position][i]=0;								//delete TelNumber
								for(i=0;i<7;i++){
									gdialednumbers_date[position][i]=0;									//delete Date
									gdialednumbers_time[position][i]=0;								//delete Time
								}
		
								gdialednumbers_numbertype[position]=0xff;	//delete NumberType
							}
							else
							{
								for(i=0;i<50;i++)												//delete old name
									gdialednumbers_pbname[position][i]=0;
								for(i=0;i<length;i++)											//save new name
									gdialednumbers_pbname[position][i]=Indication_array[datapointer+i];
							
								datapointer=datapointer+length;

								//NumberType
								if(Indication_array[datapointer]<9)								//known numbertype
									gdialednumbers_numbertype[position]=Indication_array[datapointer];
								else															//unknown numbertype
									gdialednumbers_numbertype[position]=0;						


								datapointer++;

								//transmit position
								if(transmitpos==1){
									if(indexsize){
										position=Indication_array[datapointer]+Indication_array[datapointer+1]*256;
										datapointer=datapointer+2;
									}
									else{
										position=Indication_array[datapointer];
										datapointer++;
									}
								}
								else
									position=position+1-2*direction;
							}
						}

						display_callstack_dialednumbers();
					break;
					case 2:	//TelNumber, Date and Time only
					//	deletecallstackdialednumbers();										//dialednumbers-array löschen

						for(leeloo=0;leeloo<elements;leeloo++){
							//TelNumber
							length=Indication_array[datapointer];
							datapointer++;
							for(i=0;i<CALL_INFO_NUMBER_LENGTH;i++)												//delete old number
								gdialednumbers_telnumber[position][i]=0;
							for(i=0;i<length;i++)											//save new number
								gdialednumbers_telnumber[position][i]=Indication_array[datapointer+i];
							
							datapointer=datapointer+length;

							//Date
							bday=Indication_array[datapointer];
							datapointer++;
							bmonth=Indication_array[datapointer];
							datapointer++;
							byear=Indication_array[datapointer];
							datapointer++;
							ltoa(bday, sday, 10);
							ltoa(bmonth, smonth, 10);
							ltoa(byear, syear, 10);
							if(bday==0xff)
							{
								gdialednumbers_date[position][0]=0;
								gdialednumbers_date[position][1]=0;
							}
							else if(bday<10)
							{
								gdialednumbers_date[position][0]='0';
								gdialednumbers_date[position][1]=sday[0];
							}
							else
							{
								gdialednumbers_date[position][0]=sday[0];
								gdialednumbers_date[position][1]=sday[1];
							}
							if(bmonth==0xff)
							{
								gdialednumbers_date[position][2]=0;
								gdialednumbers_date[position][3]=0;
							}
							else if(bmonth<10)
							{
								gdialednumbers_date[position][2]='0';
								gdialednumbers_date[position][3]=smonth[0];
							}
							else
							{
								gdialednumbers_date[position][2]=smonth[0];
								gdialednumbers_date[position][3]=smonth[1];
							}
							if(byear==0xff)
							{
								gdialednumbers_date[position][4]=0;
								gdialednumbers_date[position][5]=0;
							}
							else if(byear<10)
							{
								gdialednumbers_date[position][4]='0';
								gdialednumbers_date[position][5]=syear[0];
							}
							else
							{
								gdialednumbers_date[position][4]=syear[0];
								gdialednumbers_date[position][5]=syear[1];					
							}
				
							//Time
							bhour=Indication_array[datapointer];
							datapointer++;
							bmin=Indication_array[datapointer];
							datapointer++;
							bsec=Indication_array[datapointer];
							datapointer++;
							ltoa(bhour, shour, 10);
							ltoa(bmin, smin, 10);
							ltoa(bsec, ssec, 10);
							if(bhour==0xff)
							{
								gdialednumbers_time[position][0]=0;
								gdialednumbers_time[position][1]=0;
							}
							else if(bhour<10)
							{
								gdialednumbers_time[position][0]='0';
								gdialednumbers_time[position][1]=shour[0];
							}
							else
							{
								gdialednumbers_time[position][0]=shour[0];
								gdialednumbers_time[position][1]=shour[1];
							}
							if(bmin==0xff)
							{
								gdialednumbers_time[position][2]=0;
								gdialednumbers_time[position][3]=0;
							}
							else if(bmin<10)
							{
								gdialednumbers_time[position][2]='0';
								gdialednumbers_time[position][3]=smin[0];
							}
							else
							{
								gdialednumbers_time[position][2]=smin[0];
								gdialednumbers_time[position][3]=smin[1];
							}
							if(bsec==0xff)
							{
								gdialednumbers_time[position][4]=0;
								gdialednumbers_time[position][5]=0;
							}
							else if(bsec<10)
							{
								gdialednumbers_time[position][4]='0';
								gdialednumbers_time[position][5]=ssec[0];
							}
							else
							{
								gdialednumbers_time[position][4]=ssec[0];
								gdialednumbers_time[position][5]=ssec[1];
							}

							//transmit position
							if(transmitpos==1){
								if(indexsize){
									position=Indication_array[datapointer]+Indication_array[datapointer+1]*256;
									datapointer=datapointer+2;
								}
								else{
									position=Indication_array[datapointer];
									datapointer++;
								}
							}
							else
								position=position+1-2*direction;
						}

						display_callstack_dialednumbers();
					break;
					default:
						writelineEx(gError_Trace, 0, "ASG dialednumbers_Indication: invalid recoraddress: %d ", recordaddress);
					break;
				}
			break;
			case Error_IND:
				writelineEx(gError_Trace, 0, "ASG dialednumbers_Indication: recieved error, errorcode:0x%x", Indication_array[3]);
			break;
			default:
				writelineEx(gError_Trace, 0, "ASG dialednumbers_Indication: unknown indication %d", indication);
			break;
		}
	}*/
}
/*@@end*/

/*@@caplFunc:checkdialedreceivedcallstackarray(dword[],int):*/
byte checkdialedreceivedcallstackarray (dword array[], int arraylength)
{
byte valid, mode, indexsize, recordaddress, transmitpos;
word elements;
int i,length, arraypointer;

//init lokal variables
	mode=0;
	indexsize=0;
	recordaddress=0;
	elements=0;
//********************

	valid=1;

/*	//***mode***
	mode=array[3];
	indexsize=(mode & 0x80)/0x80;
	recordaddress=mode & 0x0f;
//	write("ASG  checkarray indexsize: %d recordaddress:%d", indexsize, recordaddress);

	switch(array[2]){
		case Changed_IND:
			//********arraylength*******
			if(indexsize){
				elements=array[6]+array[7]*256;
				if(arraylength!=8)
					return(0xff);
			}
			else{
				elements=array[5];
				if(arraylength!=6)
					return(0xff);
			}
			//**************************

			//***elements***
			if(elements==0){
				write("ASG checkdialedreceivedcallstackarray: elements-error");
				return(0xff);
			}
			//**************
		break;
		case Data_IND:
			switch(recordaddress){
				case 0:		//complete record
					//********arraylength*******
					if(indexsize){														//16 Bits for start/elements/pos
						elements=array[6]+array[7]*256;
						length=8+2*elements+elements*(6+6+1)+2*elements*transmitpos;	//(BAPheader+extendetarrayheader)+elements(lengthbyte PbName and TelNumber)+ elements*(date+time+numbertype)+(elements*transmitpos(word))
				
						if(transmitpos){
							arraypointer=10;
							for(i=0;i<elements;i++){
								//PbName
								length=length+array[arraypointer];
								arraypointer=arraypointer+array[arraypointer]+1;
								//TelNumber
								length=length+array[arraypointer];
								arraypointer=arraypointer+array[arraypointer]+6+6+1+2+1;	
							}
						}
						else{
							arraypointer=8;
							for(i=0;i<elements;i++){
								//PbName
								length=length+array[arraypointer];
								arraypointer=arraypointer+array[arraypointer]+1;
								//TelNumber
								length=length+array[arraypointer];
								arraypointer=arraypointer+array[arraypointer]+6+6+1+1;
							}
						}
					}
					else{																//8 Bits for start/elements/pos
						elements=array[5];
						length=6+2*elements+elements*(6+6+1)+elements*transmitpos;		//(BAPheader+extendetarrayheader)+elements(lengthbyte PbName and TelNumber)+ elements*(date+time+numbertype)+(elements*transmitpos(byte))
				
						if(transmitpos){
							arraypointer=7;
							for(i=0;i<elements;i++){
								//PbName
								length=length+array[arraypointer];
								arraypointer=arraypointer+array[arraypointer]+1;
								//TelNumber
								length=length+array[arraypointer];
								arraypointer=arraypointer+array[arraypointer]+6+6+1+2+1;
							}
						}
						else{
							arraypointer=6;
							for(i=0;i<elements;i++){
								//PbName
								length=length+array[arraypointer];
								arraypointer=arraypointer+array[arraypointer]+1;
								//TelNumber
								length=length+array[arraypointer];
								arraypointer=arraypointer+array[arraypointer]+6+6+1+1;
							}
						}

					}
			
					if(arraylength!=length){
						write("ASG: arraylength: %d, verified lenght: %d", arraylength, length);
						return(0xff);
					}
					//**************************

					//***elements***
					if(elements==0)
						return(0xff);
					//**************
				break;
				case 1:	//PbName, NumberType only
					//********arraylength*******
					if(indexsize){	//16 Bits for start/elements/pos
						elements=array[6]+array[7]*256;
						length=8+elements+elements*+2*elements*transmitpos;	//(BAPheader+extendetarrayheader)+elements(lengthbyte PbName)+ elements*(numbertype)+(elements*transmitpos(word))
				
						if(transmitpos){
							arraypointer=10;
							for(i=0;i<elements;i++){
								//PbName
								length=length+array[arraypointer];
								arraypointer=arraypointer+array[arraypointer]+1+2+1;	
							}
						}
						else{
							arraypointer=8;
							for(i=0;i<elements;i++){
								//PbName
								length=length+array[arraypointer];
								arraypointer=arraypointer+array[arraypointer]+1+1;
							}
						}
					}
					else{			//8 Bits for start/elements/pos
						elements=array[5];
						length=6+elements+elements+elements*transmitpos;	//(BAPheader+extendetarrayheader)+elements(lengthbyte PbName)+ elements*(numbertype)+(elements*transmitpos(byte))
				
						if(transmitpos){
							arraypointer=7;
							for(i=0;i<elements;i++){
								//PbName
								length=length+array[arraypointer];
								arraypointer=arraypointer+array[arraypointer]+1+2+1;
							}
						}
						else{
							arraypointer=6;
							for(i=0;i<elements;i++){
								//PbName
								length=length+array[arraypointer];
								arraypointer=arraypointer+array[arraypointer]+1+1;
							}
						}

					}
			
					if(arraylength!=length){
						write("ASG: arraylength: %d, verified lenght: %d", arraylength, length);
						return(0xff);
					}
					//**************************

					//***elements***
					if(elements==0)
						return(0xff);
					//**************
				break;
				case 2:	//TelNumber, Date, Time only
					//********arraylength*******
					if(indexsize){														//16 Bits for start/elements/pos
						elements=array[6]+array[7]*256;
						length=8+elements+elements*(6+6)+2*elements*transmitpos;	//(BAPheader+extendetarrayheader)+elements(lengthbyte TelNumber)+ elements*(date+time)+(elements*transmitpos(word))
				
						if(transmitpos){
							arraypointer=10;
							for(i=0;i<elements;i++){
								//TelNumber
								length=length+array[arraypointer];
								arraypointer=arraypointer+array[arraypointer]+6+6+2+1;	
							}
						}
						else{
							arraypointer=8;
							for(i=0;i<elements;i++){
								//TelNumber
								length=length+array[arraypointer];
								arraypointer=arraypointer+array[arraypointer]+6+6+1;
							}
						}
					}
					else{																//8 Bits for start/elements/pos
						elements=array[5];
						length=6+elements+elements*(6+6)+elements*transmitpos;		//(BAPheader+extendetarrayheader)+elements(lengthbyte TelNumber)+ elements*(date+time)+(elements*transmitpos(byte))
				
						if(transmitpos){
							arraypointer=7;
							for(i=0;i<elements;i++){
								//TelNumber
								length=length+array[arraypointer];
								arraypointer=arraypointer+array[arraypointer]+6+6+2+1;
							}
						}
						else{
							arraypointer=6;
							for(i=0;i<elements;i++){
								//TelNumber
								length=length+array[arraypointer];
								arraypointer=arraypointer+array[arraypointer]+6+6+1;
							}
						}

					}
			
					if(arraylength!=length){
						write("ASG: arraylength: %d, verified lenght: %d", arraylength, length);
						return(0xff);
					}
					//**************************

					//***elements***
					if(elements==0)
						return(0xff);
					//**************
				break;
				default:
					write("ASG checkdialedreceivedcallstackarray: recordaddress-error");
					return(0xff);
				break;
			}
		break;
		case Error_IND:
			//********arraylength*******
			if(arraylength!=4)
				return(0xff);
			//**************************
		break;
		default:	//error
			write("ASG checkdialedreceivedcallstackarray: unknown indication %d", array[2]);
		break;
		
	}
*/	
	return(valid);


}
/*@@end*/

/*@@caplFunc:display_callstack_dialednumbers():*/
display_callstack_dialednumbers ()
{
int callstackline, i;
char dialdate[CALLSTACK][9];
char dialtime[CALLSTACK][9];
char numbertype[CALLSTACK][10];

char empty_string[3];
	
//init lokal variables
	for(i=0;i<3;i++)
		empty_string[i]=0;
//********************

	//PbName
	putvalue(env_RNS_dialednumber0_PbName, gdialednumbers_pbname [0]);
	putvalue(env_RNS_dialednumber1_PbName, gdialednumbers_pbname [1]);
	putvalue(env_RNS_dialednumber2_PbName, gdialednumbers_pbname [2]);
	putvalue(env_RNS_dialednumber3_PbName, gdialednumbers_pbname [3]);
	putvalue(env_RNS_dialednumber4_PbName, gdialednumbers_pbname [4]);
	putvalue(env_RNS_dialednumber5_PbName, gdialednumbers_pbname [5]);
	putvalue(env_RNS_dialednumber6_PbName, gdialednumbers_pbname [6]);
	putvalue(env_RNS_dialednumber7_PbName, gdialednumbers_pbname [7]);
	putvalue(env_RNS_dialednumber8_PbName, gdialednumbers_pbname [8]);
	putvalue(env_RNS_dialednumber9_PbName, gdialednumbers_pbname [9]);
	putvalue(env_RNS_dialednumber10_PbName, gdialednumbers_pbname [10]);
	putvalue(env_RNS_dialednumber11_PbName, gdialednumbers_pbname [11]);
	putvalue(env_RNS_dialednumber12_PbName, gdialednumbers_pbname [12]);
	putvalue(env_RNS_dialednumber13_PbName, gdialednumbers_pbname [13]);
	putvalue(env_RNS_dialednumber14_PbName, gdialednumbers_pbname [14]);
	putvalue(env_RNS_dialednumber15_PbName, gdialednumbers_pbname [15]);
	putvalue(env_RNS_dialednumber16_PbName, gdialednumbers_pbname [16]);
	putvalue(env_RNS_dialednumber17_PbName, gdialednumbers_pbname [17]);
	putvalue(env_RNS_dialednumber18_PbName, gdialednumbers_pbname [18]);
	putvalue(env_RNS_dialednumber19_PbName, gdialednumbers_pbname [19]);

	//TelNumber
	putvalue(env_RNS_dialednumber0_TelNumber, gdialednumbers_telnumber [0]);
	putvalue(env_RNS_dialednumber1_TelNumber, gdialednumbers_telnumber [1]);
	putvalue(env_RNS_dialednumber2_TelNumber, gdialednumbers_telnumber [2]);
	putvalue(env_RNS_dialednumber3_TelNumber, gdialednumbers_telnumber [3]);
	putvalue(env_RNS_dialednumber4_TelNumber, gdialednumbers_telnumber [4]);
	putvalue(env_RNS_dialednumber5_TelNumber, gdialednumbers_telnumber [5]);
	putvalue(env_RNS_dialednumber6_TelNumber, gdialednumbers_telnumber [6]);
	putvalue(env_RNS_dialednumber7_TelNumber, gdialednumbers_telnumber [7]);
	putvalue(env_RNS_dialednumber8_TelNumber, gdialednumbers_telnumber [8]);
	putvalue(env_RNS_dialednumber9_TelNumber, gdialednumbers_telnumber [9]);
	putvalue(env_RNS_dialednumber10_TelNumber, gdialednumbers_telnumber [10]);
	putvalue(env_RNS_dialednumber11_TelNumber, gdialednumbers_telnumber [11]);
	putvalue(env_RNS_dialednumber12_TelNumber, gdialednumbers_telnumber [12]);
	putvalue(env_RNS_dialednumber13_TelNumber, gdialednumbers_telnumber [13]);
	putvalue(env_RNS_dialednumber14_TelNumber, gdialednumbers_telnumber [14]);
	putvalue(env_RNS_dialednumber15_TelNumber, gdialednumbers_telnumber [15]);
	putvalue(env_RNS_dialednumber16_TelNumber, gdialednumbers_telnumber [16]);
	putvalue(env_RNS_dialednumber17_TelNumber, gdialednumbers_telnumber [17]);
	putvalue(env_RNS_dialednumber18_TelNumber, gdialednumbers_telnumber [18]);
	putvalue(env_RNS_dialednumber19_TelNumber, gdialednumbers_telnumber [19]);
	
	

	//Date
	for(callstackline=0;callstackline<20;callstackline++){
		dialdate[callstackline][0]=gdialednumbers_date[callstackline][0];
		dialdate[callstackline][1]=gdialednumbers_date[callstackline][1];
		dialdate[callstackline][2]='.';
		dialdate[callstackline][3]=gdialednumbers_date[callstackline][2];
		dialdate[callstackline][4]=gdialednumbers_date[callstackline][3];
		dialdate[callstackline][5]='.';
		dialdate[callstackline][6]=gdialednumbers_date[callstackline][4];
		dialdate[callstackline][7]=gdialednumbers_date[callstackline][5];
	}

	putvalue(env_RNS_dialednumber0_date, dialdate [0]);
	putvalue(env_RNS_dialednumber1_date, dialdate [1]);
	putvalue(env_RNS_dialednumber2_date, dialdate [2]);
	putvalue(env_RNS_dialednumber3_date, dialdate [3]);
	putvalue(env_RNS_dialednumber4_date, dialdate [4]);
	putvalue(env_RNS_dialednumber5_date, dialdate [5]);
	putvalue(env_RNS_dialednumber6_date, dialdate [6]);
	putvalue(env_RNS_dialednumber7_date, dialdate [7]);
	putvalue(env_RNS_dialednumber8_date, dialdate [8]);
	putvalue(env_RNS_dialednumber9_date, dialdate [9]);
	putvalue(env_RNS_dialednumber10_date, dialdate [10]);
	putvalue(env_RNS_dialednumber11_date, dialdate [11]);
	putvalue(env_RNS_dialednumber12_date, dialdate [12]);
	putvalue(env_RNS_dialednumber13_date, dialdate [13]);
	putvalue(env_RNS_dialednumber14_date, dialdate [14]);
	putvalue(env_RNS_dialednumber15_date, dialdate [15]);
	putvalue(env_RNS_dialednumber16_date, dialdate [16]);
	putvalue(env_RNS_dialednumber17_date, dialdate [17]);
	putvalue(env_RNS_dialednumber18_date, dialdate [18]);
	putvalue(env_RNS_dialednumber19_date, dialdate [19]);

	//time
	for(callstackline=0;callstackline<20;callstackline++){
		dialtime[callstackline][0]=gdialednumbers_time[callstackline][0];
		dialtime[callstackline][1]=gdialednumbers_time[callstackline][1];
		dialtime[callstackline][2]=':';
		dialtime[callstackline][3]=gdialednumbers_time[callstackline][2];
		dialtime[callstackline][4]=gdialednumbers_time[callstackline][3];
		dialtime[callstackline][5]=':';
		dialtime[callstackline][6]=gdialednumbers_time[callstackline][4];
		dialtime[callstackline][7]=gdialednumbers_time[callstackline][5];
	}
	putvalue(env_RNS_dialednumber0_time, dialtime [0]);
	putvalue(env_RNS_dialednumber1_time, dialtime [1]);
	putvalue(env_RNS_dialednumber2_time, dialtime [2]);
	putvalue(env_RNS_dialednumber3_time, dialtime [3]);
	putvalue(env_RNS_dialednumber4_time, dialtime [4]);
	putvalue(env_RNS_dialednumber5_time, dialtime [5]);
	putvalue(env_RNS_dialednumber6_time, dialtime [6]);
	putvalue(env_RNS_dialednumber7_time, dialtime [7]);
	putvalue(env_RNS_dialednumber8_time, dialtime [8]);
	putvalue(env_RNS_dialednumber9_time, dialtime [9]);
	putvalue(env_RNS_dialednumber10_time, dialtime [10]);
	putvalue(env_RNS_dialednumber11_time, dialtime [11]);
	putvalue(env_RNS_dialednumber12_time, dialtime [12]);
	putvalue(env_RNS_dialednumber13_time, dialtime [13]);
	putvalue(env_RNS_dialednumber14_time, dialtime [14]);
	putvalue(env_RNS_dialednumber15_time, dialtime [15]);
	putvalue(env_RNS_dialednumber16_time, dialtime [16]);
	putvalue(env_RNS_dialednumber17_time, dialtime [17]);
	putvalue(env_RNS_dialednumber18_time, dialtime [18]);
	putvalue(env_RNS_dialednumber19_time, dialtime [19]);

	//numbertype
	for(i=0;i<20;i++){
		if(gdialednumbers_numbertype[i]<0x0F)
			strncpy(numbertype[i], gnumbertype[gdialednumbers_numbertype[i]], 15);
		else
			strncpy(numbertype[i], empty_string, 15);
	}
	putvalue(env_RNS_dialednumber0_numbertype, numbertype [0]);
	putvalue(env_RNS_dialednumber1_numbertype, numbertype [1]);
	putvalue(env_RNS_dialednumber2_numbertype, numbertype [2]);
	putvalue(env_RNS_dialednumber3_numbertype, numbertype [3]);
	putvalue(env_RNS_dialednumber4_numbertype, numbertype [4]);
	putvalue(env_RNS_dialednumber5_numbertype, numbertype [5]);
	putvalue(env_RNS_dialednumber6_numbertype, numbertype [6]);
	putvalue(env_RNS_dialednumber7_numbertype, numbertype [7]);
	putvalue(env_RNS_dialednumber8_numbertype, numbertype [8]);
	putvalue(env_RNS_dialednumber9_numbertype, numbertype [9]);
	putvalue(env_RNS_dialednumber10_numbertyp, numbertype [10]);
	putvalue(env_RNS_dialednumber11_numbertyp, numbertype [11]);
	putvalue(env_RNS_dialednumber12_numbertyp, numbertype [12]);
	putvalue(env_RNS_dialednumber13_numbertyp, numbertype [13]);
	putvalue(env_RNS_dialednumber14_numbertyp, numbertype [14]);
	putvalue(env_RNS_dialednumber15_numbertyp, numbertype [15]);
	putvalue(env_RNS_dialednumber16_numbertyp, numbertype [16]);
	putvalue(env_RNS_dialednumber17_numbertyp, numbertype [17]);
	putvalue(env_RNS_dialednumber18_numbertyp, numbertype [18]);
	putvalue(env_RNS_dialednumber19_numbertyp, numbertype [19]);

}
/*@@end*/

/*@@caplFunc:deletecallstackdialednumbers():*/
deletecallstackdialednumbers ()
{
int i, j;

char empty_string[3];
	
	for(j=0;j<20;j++){
		for(i=0;i<50;i++)
			gdialednumbers_pbname[j][i]=0;									//delete PbName
		for(i=0;i<CALL_INFO_NUMBER_LENGTH;i++)
			gdialednumbers_telnumber[j][i]=0;								//delete TelNumber
		for(i=0;i<7;i++){
			gdialednumbers_date[j][i]=0;									//delete Date
			gdialednumbers_time[j][i]=0;								//delete Time
		}
		
		gdialednumbers_numbertype[j]=0xff;	//delete NumberType
	}
}
/*@@end*/

/*@@timer:TaskTimer:*/
on timer TaskTimer
{
	Bap150_Task(NODE_INDEX);	//DLL-Task

	//Telephone
	BAP_DLL_Indication();	
	
	BAP_DLL_Request();
	
	BAP_CAN_TX_Request();

	
	
	setTimer(TaskTimer, 10);
}
/*@@end*/

/*@@preStart:PreStart:*/
on preStart
{
    char Path[255];
    char BAPVersion [100];
    
	// create write window for BAP communication
    gBAP_Trace  =writecreate("BAP-Trace FSG-UHV");								
	
    // clear BAP trace window
    writeclear(gBAP_Trace);													
	
    // error window for BAP communication
	gError_Trace=writecreate("FSG-UHV Error");									
	writeclear(gError_Trace);												

	//clear CAPL-window in write-window
    writeclear(1);															

	//get version from Stack
	Bap150_GetVersions(BAPVersion, 100);
	write(" ");
	write("***************************************************");
	write(BAPVersion);
	write("***************************************************");
	write(" ");
	
    
    write("***************************************************");
	write("ASG-TelephoneSD function catalog: 'BAP-FC_TEL_P30DF40_v2.02_F.pdf'");
	write("ASG-TelephoneSD MSCs: 'BAP-MSC_TEL_P30DF40_v2.00.pdf'");
	write("***************************************************");
	

	// Create Node
	NODE_INDEX=Bap150_CreateNode();

    // Debug info
	// write("NODE_INDEX = 0x%x", NODE_INDEX); 

    // Load DBC and XML files. 
	write("*********************************************************************************");

    //load dbc-file
    getAbsFilePath(dbc_path, Path, 255);
	write("FSG-UHV: Loading BAP_DBC-File: '%s'", Path);
   
	if(Bap150_LoadDBC(NODE_INDEX, 1, Path) != BAP_ERR_OK)						
		writelineEx(gError_Trace, 0, "FSG-UHV Fehler beim Laden: '%s', Path");

	//load xml-file 
	getAbsFilePath(xml_path, Path, 255);
    write("FSG-UHV: Load BAP-XML-File: '%s'", Path);
	
    if (Bap150_LoadConfig(NODE_INDEX, Path) != BAP_ERR_OK) 
	    writelineEx(gError_Trace, 0, "FSG-UHV: Fehler beim Laden: '%s' !", Path);	   
    write("*********************************************************************************");
    write("");

    // BAP DLL: Add CAN channel: BAP channel 1 is mapped to CAN card channel 1.
	Bap150_AddCanMap(NODE_INDEX, 1, 1);
    
} /* end of method */
/*@@end*/

/*@@stop:StopMeasurement:*/
on stopMeasurement
{
//		if(!Unrockbar)
//			BAP_Shutdown(NODE_INDEX,LSGID_Telephone);
}
/*@@end*/

/*@@caplFunc:BAP_DLL_Request():*/
BAP_DLL_Request ()
{
int i, datalength;
byte temp;
byte Request_data[BAP_buffer_size];	//Request data for DLL
dword Request_header[6];	//Request header for DLL
byte Wammw;					//data-error-flag (Geräusch)

//init lokal variables
	datalength=0;
	temp=0;
	Wammw=1;

	for(i=0;i<6;i++)
		Request_header[i]=0;

	for(i=0;i<BAP_buffer_size;i++)
		Request_data[i]=0;
//********************

   
	if(gBAP_Requestbufffer_status [gstatus_requestbuffer]>0){							//if ready to send
		///writelineEx(gBAP_Trace, 0, "DataTyp: %d", gBAP_Requestbufffer_BAPDataTyp[gstatus_requestbuffer]);
		switch(gBAP_Requestbufffer_BAPDataTyp[gstatus_requestbuffer]){
			case Bap_Void:
				//request-array for BAP-DLL funcion 'BAP_Request'
				Request_header[0]=gBAP_Request [gstatus_requestbuffer][0];					//LSG-ID
				Request_header[1]=gBAP_Request [gstatus_requestbuffer][1];					//Function-ID
				Request_header[2]=gBAP_Request [gstatus_requestbuffer][2];					//request
				Request_header[3]=gBAP_Requestbufffer_BAPDataTyp[gstatus_requestbuffer];	//BAP data type
				Request_header[4]=0;														//not used
				Request_header[5]=0;														//not used
			break;
			case Bap_UInt8:
				//request-array for BAP-DLL funcion 'BAP_Request'
				Request_header[0]=gBAP_Request [gstatus_requestbuffer][0];					//LSG-ID
				Request_header[1]=gBAP_Request [gstatus_requestbuffer][1];					//Function-ID
				Request_header[2]=gBAP_Request [gstatus_requestbuffer][2];					//request
				Request_header[3]=gBAP_Requestbufffer_BAPDataTyp[gstatus_requestbuffer];	//BAP data type
				Request_header[4]=0;														//not used
				Request_header[5]=gBAP_Request [gstatus_requestbuffer][3];					//unit8-value
			break;
			case Bap_UInt16:
				//request-array for BAP-DLL funcion 'BAP_Request'
				Request_header[0]=gBAP_Request [gstatus_requestbuffer][0];					//LSG-ID
				Request_header[1]=gBAP_Request [gstatus_requestbuffer][1];					//Function-ID
				Request_header[2]=gBAP_Request [gstatus_requestbuffer][2];					//request
				Request_header[3]=gBAP_Requestbufffer_BAPDataTyp[gstatus_requestbuffer];	//BAP data type
				Request_header[4]=0;														//not used
				Request_header[5]=gBAP_Request [gstatus_requestbuffer][3];					//unit16-value
			break;
			case Bap_UInt32:
				//request-array for BAP-DLL funcion 'BAP_Request'
				Request_header[0]=gBAP_Request [gstatus_requestbuffer][0];					//LSG-ID
				Request_header[1]=gBAP_Request [gstatus_requestbuffer][1];					//Function-ID
				Request_header[2]=gBAP_Request [gstatus_requestbuffer][2];					//request
				Request_header[3]=gBAP_Requestbufffer_BAPDataTyp[gstatus_requestbuffer];	//BAP data type
				Request_header[4]=0;														//not used
				Request_header[5]=gBAP_Request [gstatus_requestbuffer][3];					//unit32-value
			break;
			case Bap_ByteSequence:					//BAP-data-type is byte sequence
				datalength=gBAP_Requestbufffer_status [gstatus_requestbuffer]-3;

				//request-array for BAP-DLL funcion 'BAP_Request'
				Request_header[0]=gBAP_Request [gstatus_requestbuffer][0];					//LSG-ID
				Request_header[1]=gBAP_Request [gstatus_requestbuffer][1];					//Function-ID
				Request_header[2]=gBAP_Request [gstatus_requestbuffer][2];					//request
				Request_header[3]=Bap_ByteSequence;											//BAP data type
				Request_header[4]=datalength;												//length of date-array

				//data-array for BAP-DLL funcion 'BAP_Request'
				for(i=0;i<datalength;i++)
					Request_data[i]=gBAP_Request[gstatus_requestbuffer] [i+3];


/*				writelineEx(1, 0, "Request_header:");							//debug
				for (i=0;i<6;i++)												//debug
					writeEX(1, 0, " %x",Request_header [i]);					//debug
				
				writelineEx(1, 0, "Request_data:");								//debug
				for (i=0;i<datalength;i++)										//debug
					writeEX(1, 0, " %x",Request_data [i]);						//debug
*/
			break;
			default:
				writelineEx(gError_Trace, 0, "BAP_DLL_Request: invalid BAP-Data-Type: %d", gBAP_Requestbufffer_BAPDataTyp[gstatus_requestbuffer]);
				Wammw=0;
			break;			



		}
		
		if(Wammw){																			//no data-error
			temp=Bap150_Request(NODE_INDEX, Request_header, Request_data);					//send data to BAP-DLL
		
			////if(temp==0){		//BAP-Request succesful											
			////	writelineEx(gBAP_Trace, 0, "ASG-Request:    ");								//BAL-Trace		
			////	for (i=0;i<gBAP_Requestbufffer_status [gstatus_requestbuffer];i++)			//BAL-Trace	
			////		writeEX(gBAP_Trace, 0, " %x",gBAP_Request [gstatus_requestbuffer] [i]);	//BAL-Trace	
				//write("Send buffer-element %d to BAP-DLL", gstatus_requestbuffer); 			//debug
			////}
			////else{				//BAP-Request error
			////	writelineEx(gBAP_Trace, 0, "ASG Error BAP_Request, errorcode: %x. RNS-Request:",temp);				//debug
			////	for (i=0;i<gBAP_Requestbufffer_status [gstatus_requestbuffer];i++)									//debug
			////		writeEX(gBAP_Trace, 0, " %x",gBAP_Request [gstatus_requestbuffer] [i]);							//debug
			////}
		}

		gBAP_Requestbufffer_status [gstatus_requestbuffer]=0;		//reset position status -> free position 
		gBAP_Requestbufffer_BAPDataTyp [gstatus_requestbuffer]=0;	//reset BAP-datatyp of sendet buffer element

		//delete sendet request buffer elements
		for(i=0;i<BAP_buffer_size;i++)
			gBAP_Request [gstatus_requestbuffer] [i]=0;				//delete sended array
		
		if (gstatus_requestbuffer<(Requestbuffer_lines-1))			//last element of buffer is not reached	
			gstatus_requestbuffer++;
		else														//last element of buffer is reached
			gstatus_requestbuffer=0;
	}
}
/*@@end*/

/*@@msg:CAN1.BAP_only_MQB_v095::BAP_Telefon_FSG_02 (0x17332811X):*/
on message BAP_Telefon_FSG_02	//Phonebook BAP-message
{

int i, temp;
byte RX_Data[8];			//received CAN-DATA
dword RX_Header[3];			//received CAN-Header

	if(gRNS_PowerOnOff==Power_on){   
	    RX_Header[0]=this.CAN; 
	    RX_Header[1]=this.ID; 
	    RX_Header[2]=this.DLC; // received length
	
		//write("header: CAN=%d, ID=%x, Länge=%d", RX_Header[0], RX_Header[1], RX_Header[2]);	//debug
		//write("Data:");																		//debug

	    for (i=0; i<this.DLC; i++) {							//CAN-data
		    RX_Data[i]=this.byte(i);
		//	writeEX(1, 0, " %x",RX_Data [i]);													//debug
	    }
	

		temp=Bap150_CAN_SetRxDat(NODE_INDEX,RX_Header,RX_Data);	//send recieved CAN-data with CAN-header to BAP-DLL
		//write("BAP_CAN_SetRxData: %d", temp);
	}
}
/*@@end*/

/*@@caplFunc:BAP_DLL_Indication():*/
BAP_DLL_Indication()
{
int i, length, datalength, temp;
byte Indication_data[BAP_buffer_size];												//indication data from DLL
dword Indication_header[6];															//indication header from DLL
byte BAP_data_type;

//init lokal variables
	length=0;
	datalength=0;
	temp=0;
	BAP_data_type=0;

	for(i=0;i<6;i++)
		Indication_header[i]=0;

	for(i=0;i<BAP_buffer_size;i++)
		Indication_data[i]=0;
//********************

	Indication_header[4]=BAP_buffer_size;											//BAP-Stack needs this information for successful BAP_GetIndication 

	temp=Bap150_GetInd(NODE_INDEX, Indication_header, Indication_data);				//get BAP-Indication data from DLL
	//write("BAP_GetIndication: %d", temp);											//debug
	
	if(temp==0){
		//read header
		gBAP_Indication[0]=Indication_header[0];									//LSG-ID
		gBAP_Indication[1]=Indication_header[1];									//Function-ID
		gBAP_Indication[2]=Indication_header[2];									//indication

		BAP_data_type=Indication_header[3];											//BAP data type
	//	writelineEx(gBAP_Trace, 0, "Data-Type: %d", BAP_data_type);					//debug
		
		switch(BAP_data_type){
			case Bap_Void:
				datalength=3;
				//writelineEx(gBAP_Trace, 0, "ASG-Indication: ");						//BAL-Trace
				//for (i=0;i<datalength;i++)											//BAL-Trace
				//	writeEX(gBAP_Trace, 0, " %x",gBAP_Indication[i]);				//BAL-Trace

				BAP_Indication(datalength);											//evaluate BAP-Indication data
			break;
			case Bap_UInt8:
				gBAP_Indication[3]=Indication_header[5];							//unit8-value
				
				datalength=4;
				
	/*			writelineEx(gBAP_Trace, 0, "Indication_header:");					//debug
				for (i=0;i<6;i++)													//debug
					writeEX(gBAP_Trace, 0, " %x",Indication_header [i]);			//debug
		*/		
				//writelineEx(gBAP_Trace, 0, "ASG-Indication: ");						//BAL-Trace
				//for (i=0;i<datalength;i++)											//BAL-Trace
				//	writeEX(gBAP_Trace, 0, " %x",gBAP_Indication[i]);				//BAL-Trace

				BAP_Indication(datalength);											//evaluate BAP-Indication data
			break;
			case Bap_UInt16:
				gBAP_Indication[3]=Indication_header[5];							//unit16-value
				
				datalength=4;
				
/*				writelineEx(1, 0, "Indication_header:");							//debug
				for (i=0;i<6;i++)													//debug
					writeEX(1, 0, " %x",Indication_header [i]);						//debug
		*/
				//writelineEx(gBAP_Trace, 0, "ASG Indication: ");						//BAL-Trace
				//for (i=0;i<datalength;i++)											//BAL-Trace
				//	writeEX(gBAP_Trace, 0, " %x",gBAP_Indication[i]);				//BAL-Trace

				BAP_Indication(datalength);											//evaluate BAP-Indication data
			break;
			case Bap_UInt32:
				gBAP_Indication[3]=Indication_header[5];							//unit32-value
				
				datalength=4;
				
/*				writelineEx(1, 0, "Indication_header:");							//debug
				for (i=0;i<6;i++)													//debug
					writeEX(1, 0, " %x",Indication_header [i]);						//debug
		*/
				//writelineEx(gBAP_Trace, 0, "ASG Indication: ");						//BAL-Trace
				//for (i=0;i<datalength;i++)											//BAL-Trace
				//	writeEX(gBAP_Trace, 0, " %x",gBAP_Indication[i]);				//BAL-Trace

				BAP_Indication(datalength);											//evaluate BAP-Indication data
			break;
			case Bap_ByteSequence:													//BAP-data-type is byte sequence
				//read datalength
				length=Indication_header[4];										//length of date-array
				datalength=length+3;												//length of indication-array

				//read data-array
				for(i=0;i<length;i++)
					gBAP_Indication[i+3]=Indication_data[i];

/*				writelineEx(gBAP_Trace, 0, "Indication_header:");					//debug
				for (i=0;i<6;i++)													//debug
					writeEX(gBAP_Trace, 0, " %x",Indication_header [i]);			//debug
		
				writelineEx(gBAP_Trace, 0, "Indication_data:");						//debug
				for (i=0;i<length;i++)												//debug
					writeEX(gBAP_Trace, 0, " %x",Indication_data [i]);				//debug
*/				
				//writelineEx(gBAP_Trace, 0, "ASG-Indication: ");						//BAL-Trace
				//for (i=0;i<datalength;i++){											//BAL-Trace
				//	writeEX(gBAP_Trace, 0, " %x",gBAP_Indication[i]);				//BAL-Trace
				//	if(i>20){
				//		i=datalength;
				//		writeEX(gBAP_Trace, 0, "...");
				//	}
				//}

				BAP_Indication(datalength);											//evaluate BAP-Indication data
			break;
			case Bap_Error:
				gBAP_Indication[2]=Error_IND;										//internal indication-value for error
				gBAP_Indication[3]=Indication_header[5];							//error-code
				datalength=4;														//length of indication-array
				writelineEx(gBAP_Trace, 0, "ASG-Error-Indication: ");				//BAL-Trace
				writeEX(gBAP_Trace, 0, "LSG-ID: 0x%x   ",gBAP_Indication[0]);		//BAL-Trace
				writeEX(gBAP_Trace, 0, "Fct-ID: 0x%x   ",gBAP_Indication[1]);		//BAL-Trace
			//	writeEX(gBAP_Trace, 0, "Opcode: 0x%x   ",gBAP_Indication[2]);		//BAL-Trace
				writeEX(gBAP_Trace, 0, "Error-Code: 0x%x   ",gBAP_Indication[3]);	//BAL-Trace

				BAP_Indication(datalength);											//evaluate BAP-Indication data
			break;
            case Bap_Acknowledge:
				gBAP_Indication[3]=Indication_header[5];							//unit32-value
				
				datalength=4;
	/* 			
				//writelineEx(gBAP_Trace, 0, "Indication_header:");					//debug
				//for (i=0;i<6;i++)													//debug
				//	writeEX(gBAP_Trace, 0, " %x",Indication_header [i]);			//debug
				
		*/		
        /////////////////////////////////////////////////////////////////////////////////////////////
                //         writelineEx(gBAP_Trace, 0, "ASG-Telephone Indication-Ack: ");			//BAL-Trace

                //for (i=0;i<datalength;i++)											//BAL-Trace
				//	writeEX(gBAP_Trace, 0, " %x",gBAP_Indication[i]);				//BAL-Trace										//evaluate BAP-Indication data
			break;
			default:
				writelineEx(gError_Trace, 0, "ASG BAP_DLL_Indication: invalid BAP-Data-Type: %d", BAP_data_type);
			break;
		}
	//	temp=Bap150_GetInd(NODE_INDEX, Indication_header, Indication_data);				//get BAP-Indication data from DLL
	}
}
/*@@end*/

/*@@timer:test:*/
on timer test	//test-Timer
{
//	GetAll_Telephone_Request(DataGet_REQ, 0);
//	GetAll_Phonebook_Request(DataGet_REQ, 0);
	//networkprovider_Request(DataGet_REQ, 0);
	//ActiveUser_Request(DataGet_REQ, 0);
//	missedcalls_Request(DataGet_REQ, 0, 20, 0, 0);
}
/*@@end*/

/*@@caplFunc:BAP_Get_Cache():*/
BAP_Get_Cache ()
{
int i, datalength, temp;

dword Cache_Request_Header[6];
byte Cache_Request_Data[6];					


//*********************FZG Setup*************************************
	//header
	Cache_Request_Header[0] = LSGID_Phonebook;           	//LSG-ID
	Cache_Request_Header[1] = FctID_BAP_Config;  	//Fct-ID
	Cache_Request_Header[2] = 0;					//ignored
	Cache_Request_Header[3] = Bap_ByteSequence;		//data-type
	Cache_Request_Header[4] = 6;					//length
	Cache_Request_Header[5] = 0;              		//ignored

	temp=Bap150_CacheGetReq(NODE_INDEX,Cache_Request_Header, Cache_Request_Data);
	//write("ASG BAP_Cache_GET_Request=%d",temp);			//debug
	datalength=Cache_Request_Header[4];

/*	writelineEx(1, 0, "ASG Cache Get Request_header:");				//debug
		for (i=0;i<6;i++)										//debug
			writeEX(1, 0, " %x",Cache_Request_Header [i]);		//debug

	writelineEx(1, 0, "ASG Cache Get Request_data:");				//debug
		for (i=0;i<datalength;i++)								//debug
			writeEX(1, 0, " %x",Cache_Request_Data [i]);		//debug
*/
	//Data
	

	
//*******************************************************************

}
/*@@end*/

/*@@caplFunc:BAP_Indication(int):*/
BAP_Indication(int length)	//evaluate LSG-ID
{
	if(length!=0){
		switch(gBAP_Indication[0]){
			case LSGID_Telephone:
				telephone_functions(gBAP_Indication [1], length);
			break;

			default:
				writelineEx(gError_Trace, 0, "ASG error BAP_Indication: invalid LSG-ID %x", gBAP_Indication[0]);
			break;
		}
	}
}
/*@@end*/

/*@@caplFunc:BAP_CAN_TX_Request():*/
BAP_CAN_TX_Request()
{
   int i;
   byte TX_Data[8];				//CAN-data
   dword TX_Header[3];			//CAN-header
   message 0x100 TX_Message;	//dummy-message
   
   TX_Header[2] = 8; // max-Length of TX_Data

   while (Bap150_CAN_GetTxDat(NODE_INDEX,TX_Header,TX_Data) == 0) {	//get BAP-data in CAN-format from DLL
      TX_Message.CAN = TX_Header[0]; 		//CAN channel
      TX_Message.ID =TX_Header[1]; 			//Can ID
      TX_Message.DLC = TX_Header[2]; 		// received length
      for (i=0; i<TX_Message.DLC; i++) {	//CAN data-bytes
	    TX_Message.byte(i) = TX_Data[i];
      }
      output(TX_Message);					//send CAN message

	  TX_Header[2] = 8; 					// max-Length of TX_Data
   } 
}
/*@@end*/

/*@@caplFunc:BAP_Config_Telephone_Indication(dword[],byte,int):*/
BAP_Config_Telephone_Indication(dword Indication_array [], byte indication, int datalength)
{
byte errorcode;

	errorcode=0x00;

	switch (indication){		//Indication-code
		case Reset_IND:
			init_variables_Telephone();	//reset all variables and states
			gBAP_Phone_available=BAPPhone;
		//	FunctionList_Telephone_Request(DataGet_REQ, 0);
			GetAll_Telephone_Request(DataGet_REQ, 0);
		break;
		case Data_IND:
			gBAP_Phone_available=BAPPhone;
		//	FunctionList_Telephone_Request(DataGet_REQ, 0);
			GetAll_Telephone_Request(DataGet_REQ, 0);
		break;
		case Error_IND:
			if(datalength!=4)
				writelineEx(gError_Trace, 0, "ASG BAP_Config_Telephone_Indication: BAP-datalength-error");
			else{
				gBAP_Phone_available=noBAPPhone;
				errorcode=Indication_array[3];
				if(errorcode<0x20)				//BCL-error
					writelineEx(gError_Trace, 0, "ASG BAP_Config_Telephone_Indication: BCL-Error: 0x%x - %s", errorcode, gerror_codes_BCL [errorcode-0x10]);
				else if(errorcode<0x30)			//BPL-error
					writelineEx(gError_Trace, 0, "ASG BAP_Config_Telephone_Indication: BPL-Error: 0x%x - %s", errorcode, gerror_codes_BPL [errorcode-0x20]);				
				else if(errorcode<0x40)			//BAL-error
					writelineEx(gError_Trace, 0, "ASG BAP_Config_Telephone_Indication: BAL-Error: 0x%x - %s", errorcode, gerror_codes_BAL [errorcode-0x30]);
				else if(errorcode>=0x80 && errorcode<=0xA2)
					writelineEx(gError_Trace, 0, "ASG BAP_Config_Telephone_Indication: Telephone-Error: 0x%x - %s", errorcode, gerror_codes_telephone [errorcode-0x80]);
				else
					writelineEx(gError_Trace, 0, "ASG BAP_Config_Telephone_Indication: Telephone-Error: 0x%x", errorcode);
			}	
		break;
		default:
			writelineEx(gError_Trace, 0,"ASG BAP_Config_Telephone_Indication: unknown indication %x", indication);
		break;
	}

}
/*@@end*/

/*@@caplFunc:GetAll_Telephone_Indication(dword[],byte,int):*/
GetAll_Telephone_Indication(dword Indication_array [], byte indication, int datalength)
{
	switch (indication){
		case Data_IND:
			if(datalength!=3)
				writelineEx(gError_Trace, 0, "ASG GetAll_Telephone_Indication: BAP-datalength-error");
			else{
				FSG_Setup_Telephone_Request(DataGet_REQ, 0);
				FSG_OperationState_Telephone_Request(DataGet_REQ, 0);
				MobileServiceSupport_Telephone_Request(DataGet_REQ, 0);
				ActiveUser_Request(DataGet_REQ, 0);
				RegisterState_Request(DataGet_REQ, 0);
                LockState_Request(DataGet_REQ, 0);
				NetworkProvider_Request(DataGet_REQ, 0);
				SignalQuality_Request(DataGet_REQ, 0);
				CallState_Request(DataGet_REQ, 0);
				CallInfo_Request(DataGet_REQ, 0);
                CallDurationSync_Request(DataGet_REQ, 0);
                DisconnectReason_Request(DataGet_REQ, 0);
                HandsFreeOnOff_Request(DataGet_REQ, 0);
				MicroMuteOnOff_Request(DataGet_REQ, 0);
				Keypad_Request(DataGet_REQ, 0);
                MobileBatteryLevel_Request (DataGet_REQ, 0);
				DataConnectionIndication_Request(DataGet_REQ, 0);
                MissedCallIndication_Request(DataGet_REQ, 0);
                PBState_Request(DataGet_REQ, 0);
                SMSState_Request(DataGet_REQ, 0);
			}
		break;
		case Error_IND:
			if(datalength!=4)
				writelineEx(gError_Trace, 0, "ASG GetAll_Telephone_Indication: BAP-datalength-error");
			else
				writelineEx(gError_Trace, 0, "ASG GetAll_Telephone_Indication: recieved error, errorcode:0x%x", Indication_array[3]);
		break;
		default:
			writelineEx(gError_Trace, 0, "ASG GetAll_Telephone_Indication: unknown indication %d", indication);
		break;
	}

}
/*@@end*/

/*@@caplFunc:GetAll_Telephone_Request(byte,byte):*/
GetAll_Telephone_Request(byte request, byte errorcode)
{
int Offset, i;
dword requestarray [BAP_buffer_size];

//init lokal variables
	Offset=0;
	
	for(i=0;i<BAP_buffer_size;i++)
		requestarray [i]=0;
//********************

	switch (request){
		case DataGet_REQ:
			//BAP-header
			requestarray[0]=LSGID_Telephone;	//LSG-ID
			requestarray[1]=FctID_GetAll;	//Fct.-ID
			requestarray[2]=DataGet_REQ;
			requestarray[3]=0;

			Offset=3;
			set_status_requestbuffer (requestarray, Offset, Bap_Void);	//send GetAll
		break;
		default:
			writelineEx(gError_Trace, 0, "ASG GetAll_Telephone_Request: unknown request %d", request);
		break;
	}
}
/*@@end*/

/*@@caplFunc:FunctionList_Telephone_Indication(dword[],byte,int):*/
FunctionList_Telephone_Indication(dword Indication_array [], byte indication, int datalength)
{
	switch (indication){
		case Data_IND:
			FSG_Setup_Telephone_Request(DataGet_REQ, 0);
			FSG_OperationState_Telephone_Request(DataGet_REQ, 0);
			//ActiveUser_Request(DataGet_REQ, 0);
			//networkprovider_Request(DataGet_REQ, 0);
		//	HeartBeat_Telephone_Request(DataGet_REQ, 0);	
			GetAll_Telephone_Request(DataGet_REQ, 0);
		break;
		case Error_IND:
			if(datalength!=4)
				writelineEx(gError_Trace, 0, "ASG FunctionList_Telephone_Indication: BAP-datalength-error");
			else
				writelineEx(gError_Trace, 0, "ASG FunctionList_Telephone_Indication: recieved error, errorcode:0x%x", Indication_array[3]);
		break;
		default:
			writelineEx(gError_Trace, 0, "ASG FunctionList_Telephone_Indication: unknown indication %d", indication);
		break;
	}

}
/*@@end*/

/*@@caplFunc:FunctionList_Telephone_Request(byte,byte):*/
FunctionList_Telephone_Request(byte request, byte errorcode)
{
int Offset, i;

dword requestarray [BAP_buffer_size];

//init lokal variables
	Offset=0;
	
	for(i=0;i<BAP_buffer_size;i++)
		requestarray [i]=0;
//********************

	switch (request){
		case DataGet_REQ:
			//BAP-header
			requestarray[0]=LSGID_Telephone;	//LSG-ID
			requestarray[1]=FctID_FunctionList;	//Fct.-ID
			requestarray[2]=DataGet_REQ;
			requestarray[3]=0;

			Offset=3;
			set_status_requestbuffer (requestarray, Offset, Bap_Void);
		break;
		default:
			writelineEx(gError_Trace, 0, "ASG FunctionList_Telephone_Request: unknown request %d", request);
		break;
	}
}
/*@@end*/

/*@@caplFunc:FSG_Setup_Telephone_Indication(dword[],byte,int):*/
FSG_Setup_Telephone_Indication (dword Indication_array [], byte indication, int datalength)
{
	//check array
	switch (indication){
		case Data_IND:
			/*if(datalength!=7)
				writelineEx(gError_Trace, 0, "ASG FSG_Setup_Telephone_Indication: BAP-datalength-error");
			else*/{
				gPhoneCharacteristics=Indication_array[3];
				gSIMCardReader=gPhoneCharacteristics & 0x01;
				gCableConnection=(gPhoneCharacteristics & 0x02)/0x02;
				gHFPConnection=(gPhoneCharacteristics & 0x04)/0x04;
				gRSAPConnection=(gPhoneCharacteristics & 0x08)/0x08;
				
                gMobileConnectionType=Indication_array[4];
								
				putvalue(env_RNS_SIMCardReader, gstring_SIMCardReader[gSIMCardReader]);
				putvalue(env_RNS_CableConnection, gstring_CableConnection[gCableConnection]);
				putvalue(env_RNS_HFPConnection, gstring_HFPConnection[gHFPConnection]);
				putvalue(env_RNS_RSAPConnection, gstring_RSAPConnection[gRSAPConnection]);
				
				if(gMobileConnectionType>4)
					putvalue(env_RNS_MobileConnectionType, ginvalid);
				else
					putvalue(env_RNS_MobileConnectionType, gstring_MobileConnectionType[gMobileConnectionType]);
			}
		break;
		case Error_IND:
			if(datalength!=4)
				writelineEx(gError_Trace, 0, "ASG FSG_Setup_Telephone_Indication: BAP-datalength-error");
			else
				writelineEx(gError_Trace, 0, "ASG FSG_Setup_Telephone_Indication: recieved error, errorcode:0x%x", Indication_array[3]);
		break;
		default:
			writelineEx(gError_Trace, 0, "ASG FSG_Setup_Telephone_Indication: unknown indication %d", indication);
		break;
	}
}
/*@@end*/

/*@@caplFunc:FSG_Setup_Telephone_Request(byte,byte):*/
FSG_Setup_Telephone_Request (byte request, byte errorcode)
{
int Offset, i;
dword requestarray [BAP_buffer_size];

//init lokal variables
	Offset=0;

	for(i=0;i<BAP_buffer_size;i++)
		requestarray [i]=0;
//********************

	
	switch(request){
		case DataGet_REQ:
			requestarray[0]=LSGID_Telephone;	//LSG-ID
			requestarray[1]=FctID_FSG_Setup;	//Fct.-ID
			requestarray[2]=DataGet_REQ;
			Offset=3;
			set_status_requestbuffer (requestarray, Offset, Bap_Void);
		break;
		default:	//error
			writelineEx(gError_Trace, 0, "ASG FSG_Setup_Telephone_Request: unknown request %d", request);
		break;
	}
}
/*@@end*/

/*@@caplFunc:FSG_OperationState_Telephone_Indication(dword[],byte,int):*/
FSG_OperationState_Telephone_Indication (dword Indication_array [], byte indication, int datalength)
{
	
	/*if(datalength!=4)
		writelineEx(gError_Trace, 0, "ASG FSG_OperationState_Telephone_Indication: BAP-datalength-error");
	else*/{
		//check array
		switch (indication){
			case Data_IND:
				gFSG_OperationState_OP_State    =Indication_array[3];
                gFSG_OperationState_Tel_State   =Indication_array[4];
                gFSG_OperationState_PrivacyMode =Indication_array[5];
                
                gFSG_OperationState_PrivacyMode_PM =gFSG_OperationState_PrivacyMode &0x01;
                gFSG_OperationState_PrivacyMode_EPM =(gFSG_OperationState_PrivacyMode &0x02) /0x02;

				if(gFSG_OperationState_OP_State ==0x0F)
                    putvalue(env_ASG_FSGOperationState_OS, gstring_defect);

                else if (gFSG_OperationState_OP_State<0x04)									 
                    putvalue(env_ASG_FSGOperationState_OS, gstring_FSG_OperationState_OP_State[gFSG_OperationState_OP_State]);

                else
					putvalue(env_ASG_FSGOperationState_OS, gstring_reserved);

                if (gFSG_OperationState_Tel_State <0x15)
                    putvalue(env_ASG_FSGOperationState_TS,gFSG_OperationState_Tel_State_string[gFSG_OperationState_Tel_State]);
                else
                    putvalue(env_ASG_FSGOperationState_TS,gstring_reserved);
                 
                if(gFSG_OperationState_PrivacyMode <=0x3)    
                {
                    putvalue(env_ASG_FSGOperationState_PM,gFSG_OperationState_PrivacyMode_string[gFSG_OperationState_PrivacyMode_PM]);
                    putvalue(env_ASG_FSGOperationState_EPM,gFSG_OperationState_PrivacyMode_string[gFSG_OperationState_PrivacyMode_EPM]);
			    }
                else
                {
                    putvalue(env_ASG_FSGOperationState_PM,gstring_reserved);
                    putvalue(env_ASG_FSGOperationState_EPM,gstring_reserved);
                }
            break;
			case Error_IND:
				writelineEx(gError_Trace, 0, "ASG FSG_OperationState_Telephone_Indication: recieved error, errorcode:0x%x", Indication_array[3]);
			break;
			default:
				writelineEx(gError_Trace, 0, "ASG FSG_OperationState_Telephone_Indication: unknown indication %d", indication);
			break;
		}
	}
}
/*@@end*/

/*@@caplFunc:FSG_OperationState_Telephone_Request(byte,byte):*/
FSG_OperationState_Telephone_Request (byte request, byte errorcode)
{
int Offset, i;
dword requestarray [BAP_buffer_size];

//init lokal variables
	Offset=0;

	for(i=0;i<BAP_buffer_size;i++)
		requestarray [i]=0;
//********************

	
	switch(request){
		case DataGet_REQ:
			requestarray[0]=LSGID_Telephone;	//LSG-ID
			requestarray[1]=FctID_FSG_OperationState;	//Fct.-ID
			requestarray[2]=DataGet_REQ;
			Offset=3;
			set_status_requestbuffer (requestarray, Offset, Bap_Void);
		break;
		default:	//error
			writelineEx(gError_Trace, 0, "ASG FSG_OperationState_Telephone_Request: unknown request %d", request);
		break;
	}
}
/*@@end*/

/*@@envVar:env_RNS_Power_on_off:*/
on envVar env_RNS_Power_on_off
{
int length, temp;

temp=0;

	putvalue(env_RNS_string_Power_on_off, gstring_RNS_PowerOnOff [getvalue(env_RNS_Power_on_off)]);	

	if(getvalue(env_RNS_Power_on_off)==1)
	{
		if(gBAP_Init==0)
		{
			gBAP_Init=1;
			//BAP-Init Telephone
			temp=Bap150_Init(NODE_INDEX,LSGID_Telephone);
		 	if(temp==0)
				write("ASG-Telephone BAP_Init succesful");
			else
				write("ASG-Telephone error BAP_Init: %d", temp);
		}

		//BAP-Sutdown
		Bap150_Shutdown(NODE_INDEX,LSGID_Telephone);

		init_variables_System();
		
		//Telephone application	
		init_variables_Telephone();

		//Phonebook application
		init_variables_Phonebook();

		//BAP-Start
		temp=Bap150_Start(NODE_INDEX,LSGID_Telephone);	
		if(temp==0)
			write("ASG-Telephone BAP_Start succesful");
		else
			write("ASG-Telephone error BAP_Start: %d", temp);
		
		settimer(Powerontimer, 20);

		//BAP_ProcessDebug(NODE_INDEX,DEBUG_CAN_CHANNEL, DEBUG_ID, LSGID_XXX, DEBUG_SWITCH_ON);
	}
	else
	{
		Bap150_Shutdown(NODE_INDEX,LSGID_Telephone);
		
		gRNS_PowerOnOff=getvalue(env_RNS_Power_on_off);
		
		Shutdown_RNS();
	}
}
/*@@end*/

/*@@caplFunc:shutdown_RNS():*/
shutdown_RNS ()
{
int i, j;
char empty_string [3];

//init lokal variables
	for(i=0;i<3;i++)
		empty_string[i]=0;
//********************

	//BAP-Communication
	//Timer
	canceltimer(TaskTimer);						//cancel real CAN-communication timer
	canceltimer(test);

	//Panel-values Telephone
		
	//FSG-Setup
	putvalue(env_RNS_SIMCardReader, empty_string);
	putvalue(env_RNS_CableConnection, empty_string);
	putvalue(env_RNS_HFPConnection, empty_string);
	putvalue(env_RNS_RSAPConnection, empty_string);
	putvalue(env_RNS_MobileConnectionType, empty_string);
	putvalue(env_RNS_Telephone_UserProfiles, 0);
	putvalue(env_RNS_Telephone_PhoneType, empty_string);	

	//FSG-OperationState
	putvalue(env_RNS_Telephone_FSG_opstate, empty_string);

    //MobileServiceSupport
    putvalue(env_ASG_MobileServSupp_Bit1,0);
    putvalue(env_ASG_MobileServSupp_Bit2,0);
    putvalue(env_ASG_MobileServSupp_Bit3,0);
    putvalue(env_ASG_MobileServSupp_Bit4,0);
    putvalue(env_ASG_MobileServSupp_Bit14,0);
    putvalue(env_ASG_MobileServSupp_Bit15,0);
    putvalue(env_ASG_MobileServSupp_Bit16,0);
    putvalue(env_ASG_MobileServSupp_Bit17,0);
    putvalue(env_ASG_MobileServSupp_Bit18,0);
    putvalue(env_ASG_MobileServSupp_Bit19,0);
    putvalue(env_ASG_MobileServSupp_Bit20,0);
    putvalue(env_ASG_MobileServSupp_Bit21,0);
    putvalue(env_ASG_MobileServSupp_Bit22,0);
    putvalue(env_ASG_MobileServSupp_Bit23,0);
    putvalue(env_ASG_MobileServSupp_Bit24,0);
    putvalue(env_ASG_MobileServSupp_Bit25,0);
    putvalue(env_ASG_MobileServSupp_Bit26,0);
    putvalue(env_ASG_MobileServSupp_Bit27,0);
    putvalue(env_ASG_MobileServSupp_Bit28,0);
    putvalue(env_ASG_MobileServSupp_Bit29,0);
    putvalue(env_ASG_MobileServSupp_Bit30,0);
    putvalue(env_ASG_MobileServSupp_Bit31,0);
    putvalue(env_ASG_MobileServSupp_Bit32,0);
    putvalue(env_ASG_MobileServSupp_Bit33,0);
    putvalue(env_ASG_MobileServSupp_Bit34,0);
    putvalue(env_ASG_MobileServSupp_Bit35,0);
    putvalue(env_ASG_MobileServSupp_Bit36,0);
    putvalue(env_ASG_MobileServSupp_Bit37,0);
    putvalue(env_ASG_MobileServSupp_Bit38,0);
    putvalue(env_ASG_MobileServSupp_Bit39,0);
    putvalue(env_ASG_MobileServSupp_Bit40,0);
    putvalue(env_ASG_MobileServSupp_Bit41,0);
    putvalue(env_ASG_MobileServSupp_Bit42,0);
    putvalue(env_ASG_MobileServSupp_Bit43,0);
    putvalue(env_ASG_MobileServSupp_Bit44,0);
    putvalue(env_ASG_MobileServSupp_Bit45,0);
    putvalue(env_ASG_MobileServSupp_Bit46,0);
    putvalue(env_ASG_MobileServSupp_Bit47,0);
    putvalue(env_ASG_MobileServSupp_Bit48,0);
    putvalue(env_ASG_MobileServSupp_Bit49,0);
    putvalue(env_ASG_MobileServSupp_Bit50,0);
    putvalue(env_ASG_MobileServSupp_Bit51,0);
    putvalue(env_ASG_MobileServSupp_Bit52,0);
    putvalue(env_ASG_MobileServSupp_Bit53,0);
    putvalue(env_ASG_MobileServSupp_Bit54,0);
    putvalue(env_ASG_MobileServSupp_Bit55,0);

	//active user
	
	for(i=0;i<50;i++)
		gActiveUserName[i]=0;
	putvalue(env_RNS_SIMSerial, empty_string);
	putvalue(env_RNS_SerialNumber, empty_string);
	putvalue(env_RNS_ActiveUserName, empty_string);

	//register state
	putvalue(env_RNS_RegisterState, empty_string);

	//lock state
	putvalue(env_RNS_LockState, empty_string);

	//network provider name
	putvalue(env_RNS_networkprovider_name,empty_string);

	//net info
	putvalue(env_RNS_NetInfoCalldivert, empty_string);
	putvalue(env_RNS_NetInfoCiphering, empty_string);
	
	//line state
	putvalue(env_RNS_LineState, empty_string);	
	
	//call state
	putvalue(env_RNS_CallState_CallID_0,empty_string);
	putvalue(env_RNS_CallState_CallID_1,empty_string);
	putvalue(env_RNS_CallState_CallID_2,empty_string);
	putvalue(env_RNS_CallState_CallID_3,empty_string);
	putvalue(env_RNS_CallState_CallID_4,empty_string);
	putvalue(env_RNS_CallState_CallID_5,empty_string);
	putvalue(env_RNS_CallState_CallID_6,empty_string);
	//CallType
	putvalue(env_RNS_CallType_CallID_0,empty_string);
	putvalue(env_RNS_CallType_CallID_1,empty_string);
	putvalue(env_RNS_CallType_CallID_2,empty_string);
	putvalue(env_RNS_CallType_CallID_3,empty_string);
	putvalue(env_RNS_CallType_CallID_4,empty_string);
	putvalue(env_RNS_CallType_CallID_5,empty_string);
	putvalue(env_RNS_CallType_CallID_6,empty_string);
	//CallInDivert
	putvalue(env_RNS_CallState_CallInDivert_0, 0);
	putvalue(env_RNS_CallState_CallInDivert_1, 0);
	putvalue(env_RNS_CallState_CallInDivert_2, 0);
	putvalue(env_RNS_CallState_CallInDivert_3, 0);
	putvalue(env_RNS_CallState_CallInDivert_4, 0);
	putvalue(env_RNS_CallState_CallInDivert_5, 0);
	putvalue(env_RNS_CallState_CallInDivert_6, 0);
    //CallOutDivert
	putvalue(env_RNS_CallState_CallOuDivert_0, 0);
	putvalue(env_RNS_CallState_CallOuDivert_1, 0);
	putvalue(env_RNS_CallState_CallOuDivert_2, 0);
	putvalue(env_RNS_CallState_CallOuDivert_3, 0);
	putvalue(env_RNS_CallState_CallOuDivert_4, 0);
	putvalue(env_RNS_CallState_CallOuDivert_5, 0);
	putvalue(env_RNS_CallState_CallOuDivert_6, 0);
	   
    
    //HandsFree
	putvalue(env_RNS_HandsFreeOnOff, 1);
	putvalue(env_RNS_HandsFree_string, empty_string);

	//MicroMute
	putvalue(env_RNS_MicroMuteOnOff, 0);
	putvalue(env_RNS_MicroMute_string, empty_string);

	//Keypad
    putvalue(env_RNS_Keypad_Bit0, empty_string);
    putvalue(env_RNS_Keypad_Bit1, empty_string);
    putvalue(env_RNS_Keypad_Bit2, empty_string);
    putvalue(env_RNS_Keypad_Bit3, empty_string);
    putvalue(env_RNS_Keypad_Bit4, empty_string);
    putvalue(env_RNS_Keypad_Bit5, empty_string);
    
    //MobileBatteryLevel   
    putvalue(env_RNS_MobileBatLevel_CL_Mob1, 0);
    putvalue(env_RNS_MobileBatLevel_CL_Mob2, 0);
    putvalue(env_RNS_MobileBatLevel_CL_Hand1, 0);
    putvalue(env_RNS_MobileBatLevel_CL_Hand2, 0);

    putvalue(env_RNS_MobileBatLevel_CL_Bit0, empty_string);
    putvalue(env_RNS_MobileBatLevel_CL_Bit1, empty_string);
    putvalue(env_RNS_MobileBatLevel_CL_Bit2, empty_string);
    putvalue(env_RNS_MobileBatLevel_CL_Bit3, empty_string);

    //DataConnectionIndication
    putvalue(env_RNS_DataConInd_CI, empty_string);
    putvalue(env_RNS_DataConInd_DVUplink,0);
    putvalue(env_RNS_DataConInd_DVDownlink,0);

    //MissedCallIndication
    putvalue(env_RNS_MissedCallInd_Calls, 0);
    putvalue(env_RNS_MissedCallInd_Numbers, 0);
    
    //RingToneMute
	putvalue(env_RNS_RingToneMuteOnOff, 0);
	putvalue(env_RNS_string_RingToneMuteOnOff, gstring_RingToneMute[gRingToneMute]);
	
	//phone enable
	putvalue(env_RNS_PINcode, empty_string);

	//CallInfo
	//PbName
	putvalue(env_RNS_CallInfo_PbName_0, empty_string);
	putvalue(env_RNS_CallInfo_PbName_1, empty_string);
	putvalue(env_RNS_CallInfo_PbName_2, empty_string);
	putvalue(env_RNS_CallInfo_PbName_3, empty_string);
	putvalue(env_RNS_CallInfo_PbName_4, empty_string);
	putvalue(env_RNS_CallInfo_PbName_5, empty_string);
	putvalue(env_RNS_CallInfo_PbName_6, empty_string);
	//TelNumber
	putvalue(env_RNS_CallInfo_TelNumber_0, empty_string);
	putvalue(env_RNS_CallInfo_TelNumber_1, empty_string);
	putvalue(env_RNS_CallInfo_TelNumber_2, empty_string);
	putvalue(env_RNS_CallInfo_TelNumber_3, empty_string);
	putvalue(env_RNS_CallInfo_TelNumber_4, empty_string);
	putvalue(env_RNS_CallInfo_TelNumber_5, empty_string);
	putvalue(env_RNS_CallInfo_TelNumber_6, empty_string);
    //Category
	putvalue(env_RNS_CallInfo_Category_0, empty_string);
    putvalue(env_RNS_CallInfo_Category_1, empty_string);
    putvalue(env_RNS_CallInfo_Category_2, empty_string);
    putvalue(env_RNS_CallInfo_Category_3, empty_string);
    putvalue(env_RNS_CallInfo_Category_4, empty_string);
    putvalue(env_RNS_CallInfo_Category_5, empty_string);
    putvalue(env_RNS_CallInfo_Category_6, empty_string);

    //CallDurationSync
    putvalue(env_RNS_CallDuration_Sync_TS_0, 0);
    putvalue(env_RNS_CallDuration_Sync_TS_1, 0);
    putvalue(env_RNS_CallDuration_Sync_TS_2, 0);
    putvalue(env_RNS_CallDuration_Sync_TS_3, 0);
    putvalue(env_RNS_CallDuration_Sync_TS_4, 0);
    putvalue(env_RNS_CallDuration_Sync_TS_5, 0);
    putvalue(env_RNS_CallDuration_Sync_TS_6, 0);

	//Panel-values Phonebook
	//FSG-Setup
	putvalue(env_RNS_Phonebook_FSGsetup, empty_string);	

	//FSG-OperationState
	putvalue(env_RNS_Phonebook_FSG_opstate, empty_string);

	//property MissedCallIndication
	putvalue(env_RNS_MissedCalls, 0);
	putvalue(env_RNS_MissedNumbers, 0);
	putvalue(env_RNS_MissedCalls_setget, 0);
	putvalue(env_RNS_MissedNumbers_setget, 0);

	//property PbState
	putvalue(env_RNS_Pb_DownloadState, empty_string);
	putvalue(env_RNS_PbEntriesUHV, gPbEntriesUHV);
	
	//property voicemailboxnumber
	putvalue(env_RNS_Mailboxnumber, empty_string);
	putvalue(env_RNS_Mailboxnumber_new, empty_string);

	//property SMSState
	putvalue(env_ASG_UHV_SMSStateSIMReady, empty_string);
	putvalue(env_ASG_UHV_SMSStateStorage, empty_string);
	putvalue(env_ASG_UHV_SMSStateNewSMS, 0);

	//property SMSFlash
	for(i=0;i<SMSFLASH_LENGTH;i++)
		gSMSFlashText[i]=0;
	putvalue(env_ASG_UHV_SMSFlashSMSText, empty_string);
    
    //property RingToneMute
	putvalue(env_RNS_RingToneMuteOnOff, 0);
	putvalue(env_RNS_RingToneMute_string, gstring_RingToneMute[gRingToneMute]);

	//method SMSStoreTemplate
	putvalue(env_ASG_UHV_SMSStoreTemplate_T, empty_string);

	//method SMSSend
	putvalue(env_ASG_UHV_SMSSend_TelNumb, empty_string);
	putvalue(env_ASG_UHV_SMSSend_Text, empty_string);
	putvalue(env_ASG_UHV_SMSSend_Code, gSMSSend_Code);

	//method SMSDeleteAll
	putvalue(env_ASG_UHV_SMSDelete_unread, 0xff);
	putvalue(env_ASG_UHV_SMSDelete_read, 0xff);
	putvalue(env_ASG_UHV_SMSDelete_unsent, 0xff);
	putvalue(env_ASG_UHV_SMSDelete_sent, 0xff);
	putvalue(env_ASG_UHV_SMSDelete_template, 0xff);


	//missedcalls
	//PbName
	putvalue(env_RNS_missedcall0_PbName, empty_string);
	putvalue(env_RNS_missedcall1_PbName, empty_string);
	putvalue(env_RNS_missedcall2_PbName, empty_string);
	putvalue(env_RNS_missedcall3_PbName, empty_string);
	putvalue(env_RNS_missedcall4_PbName, empty_string);
	putvalue(env_RNS_missedcall5_PbName, empty_string);
	putvalue(env_RNS_missedcall6_PbName, empty_string);
	putvalue(env_RNS_missedcall7_PbName, empty_string);
	putvalue(env_RNS_missedcall8_PbName, empty_string);
	putvalue(env_RNS_missedcall9_PbName, empty_string);
	putvalue(env_RNS_missedcall10_PbName, empty_string);
	putvalue(env_RNS_missedcall11_PbName, empty_string);
	putvalue(env_RNS_missedcall12_PbName, empty_string);
	putvalue(env_RNS_missedcall13_PbName, empty_string);
	putvalue(env_RNS_missedcall14_PbName, empty_string);
	putvalue(env_RNS_missedcall15_PbName, empty_string);
	putvalue(env_RNS_missedcall16_PbName, empty_string);
	putvalue(env_RNS_missedcall17_PbName, empty_string);
	putvalue(env_RNS_missedcall18_PbName, empty_string);
	putvalue(env_RNS_missedcall19_PbName, empty_string);
	//TelNumber
	putvalue(env_RNS_missedcall0_TelNumber, empty_string);
	putvalue(env_RNS_missedcall1_TelNumber, empty_string);
	putvalue(env_RNS_missedcall2_TelNumber, empty_string);
	putvalue(env_RNS_missedcall3_TelNumber, empty_string);
	putvalue(env_RNS_missedcall4_TelNumber, empty_string);
	putvalue(env_RNS_missedcall5_TelNumber, empty_string);
	putvalue(env_RNS_missedcall6_TelNumber, empty_string);
	putvalue(env_RNS_missedcall7_TelNumber, empty_string);
	putvalue(env_RNS_missedcall8_TelNumber, empty_string);
	putvalue(env_RNS_missedcall9_TelNumber, empty_string);
	putvalue(env_RNS_missedcall10_TelNumber, empty_string);
	putvalue(env_RNS_missedcall11_TelNumber, empty_string);
	putvalue(env_RNS_missedcall12_TelNumber, empty_string);
	putvalue(env_RNS_missedcall13_TelNumber, empty_string);
	putvalue(env_RNS_missedcall14_TelNumber, empty_string);
	putvalue(env_RNS_missedcall15_TelNumber, empty_string);
	putvalue(env_RNS_missedcall16_TelNumber, empty_string);
	putvalue(env_RNS_missedcall17_TelNumber, empty_string);
	putvalue(env_RNS_missedcall18_TelNumber, empty_string);
	putvalue(env_RNS_missedcall19_TelNumber, empty_string);
	//Date
	putvalue(env_RNS_missedcall0_date, empty_string);
	putvalue(env_RNS_missedcall1_date, empty_string);
	putvalue(env_RNS_missedcall2_date, empty_string);
	putvalue(env_RNS_missedcall3_date, empty_string);
	putvalue(env_RNS_missedcall4_date, empty_string);
	putvalue(env_RNS_missedcall5_date, empty_string);
	putvalue(env_RNS_missedcall6_date, empty_string);
	putvalue(env_RNS_missedcall7_date, empty_string);
	putvalue(env_RNS_missedcall8_date, empty_string);
	putvalue(env_RNS_missedcall9_date, empty_string);
	putvalue(env_RNS_missedcall10_date, empty_string);
	putvalue(env_RNS_missedcall11_date, empty_string);
	putvalue(env_RNS_missedcall12_date, empty_string);
	putvalue(env_RNS_missedcall13_date, empty_string);
	putvalue(env_RNS_missedcall14_date, empty_string);
	putvalue(env_RNS_missedcall15_date, empty_string);
	putvalue(env_RNS_missedcall16_date, empty_string);
	putvalue(env_RNS_missedcall17_date, empty_string);
	putvalue(env_RNS_missedcall18_date, empty_string);
	putvalue(env_RNS_missedcall19_date, empty_string);
	//time
	putvalue(env_RNS_missedcall0_time, empty_string);
	putvalue(env_RNS_missedcall1_time, empty_string);
	putvalue(env_RNS_missedcall2_time, empty_string);
	putvalue(env_RNS_missedcall3_time, empty_string);
	putvalue(env_RNS_missedcall4_time, empty_string);
	putvalue(env_RNS_missedcall5_time, empty_string);
	putvalue(env_RNS_missedcall6_time, empty_string);
	putvalue(env_RNS_missedcall7_time, empty_string);
	putvalue(env_RNS_missedcall8_time, empty_string);
	putvalue(env_RNS_missedcall9_time, empty_string);
	putvalue(env_RNS_missedcall10_time, empty_string);
	putvalue(env_RNS_missedcall11_time, empty_string);
	putvalue(env_RNS_missedcall12_time, empty_string);
	putvalue(env_RNS_missedcall13_time, empty_string);
	putvalue(env_RNS_missedcall14_time, empty_string);
	putvalue(env_RNS_missedcall15_time, empty_string);
	putvalue(env_RNS_missedcall16_time, empty_string);
	putvalue(env_RNS_missedcall17_time, empty_string);
	putvalue(env_RNS_missedcall18_time, empty_string);
	putvalue(env_RNS_missedcall19_time, empty_string);
	//numbertype
	putvalue(env_RNS_missedcall0_numbertype, empty_string);
	putvalue(env_RNS_missedcall1_numbertype, empty_string);
	putvalue(env_RNS_missedcall2_numbertype, empty_string);
	putvalue(env_RNS_missedcall3_numbertype, empty_string);
	putvalue(env_RNS_missedcall4_numbertype, empty_string);
	putvalue(env_RNS_missedcall5_numbertype, empty_string);
	putvalue(env_RNS_missedcall6_numbertype, empty_string);
	putvalue(env_RNS_missedcall7_numbertype, empty_string);
	putvalue(env_RNS_missedcall8_numbertype, empty_string);
	putvalue(env_RNS_missedcall9_numbertype, empty_string);
	putvalue(env_RNS_missedcall10_numbertyp, empty_string);
	putvalue(env_RNS_missedcall11_numbertyp, empty_string);
	putvalue(env_RNS_missedcall12_numbertyp, empty_string);
	putvalue(env_RNS_missedcall13_numbertyp, empty_string);
	putvalue(env_RNS_missedcall14_numbertyp, empty_string);
	putvalue(env_RNS_missedcall15_numbertyp, empty_string);
	putvalue(env_RNS_missedcall16_numbertyp, empty_string);
	putvalue(env_RNS_missedcall17_numbertyp, empty_string);
	putvalue(env_RNS_missedcall18_numbertyp, empty_string);
	putvalue(env_RNS_missedcall19_numbertyp, empty_string);

	//received calls
	//PbName
	putvalue(env_RNS_receivedcall0_PbName, empty_string);
	putvalue(env_RNS_receivedcall1_PbName, empty_string);
	putvalue(env_RNS_receivedcall2_PbName, empty_string);
	putvalue(env_RNS_receivedcall3_PbName, empty_string);
	putvalue(env_RNS_receivedcall4_PbName, empty_string);
	putvalue(env_RNS_receivedcall5_PbName, empty_string);
	putvalue(env_RNS_receivedcall6_PbName, empty_string);
	putvalue(env_RNS_receivedcall7_PbName, empty_string);
	putvalue(env_RNS_receivedcall8_PbName, empty_string);
	putvalue(env_RNS_receivedcall9_PbName, empty_string);
	putvalue(env_RNS_receivedcall10_PbName, empty_string);
	putvalue(env_RNS_receivedcall11_PbName, empty_string);
	putvalue(env_RNS_receivedcall12_PbName, empty_string);
	putvalue(env_RNS_receivedcall13_PbName, empty_string);
	putvalue(env_RNS_receivedcall14_PbName, empty_string);
	putvalue(env_RNS_receivedcall15_PbName, empty_string);
	putvalue(env_RNS_receivedcall16_PbName, empty_string);
	putvalue(env_RNS_receivedcall17_PbName, empty_string);
	putvalue(env_RNS_receivedcall18_PbName, empty_string);
	putvalue(env_RNS_receivedcall19_PbName, empty_string);
	//TelNumber
	putvalue(env_RNS_receivedcall0_TelNumber, empty_string);
	putvalue(env_RNS_receivedcall1_TelNumber, empty_string);
	putvalue(env_RNS_receivedcall2_TelNumber, empty_string);
	putvalue(env_RNS_receivedcall3_TelNumber, empty_string);
	putvalue(env_RNS_receivedcall4_TelNumber, empty_string);
	putvalue(env_RNS_receivedcall5_TelNumber, empty_string);
	putvalue(env_RNS_receivedcall6_TelNumber, empty_string);
	putvalue(env_RNS_receivedcall7_TelNumber, empty_string);
	putvalue(env_RNS_receivedcall8_TelNumber, empty_string);
	putvalue(env_RNS_receivedcall9_TelNumber, empty_string);
	putvalue(env_RNS_receivedcall10_TelNumber, empty_string);
	putvalue(env_RNS_receivedcall11_TelNumber, empty_string);
	putvalue(env_RNS_receivedcall12_TelNumber, empty_string);
	putvalue(env_RNS_receivedcall13_TelNumber, empty_string);
	putvalue(env_RNS_receivedcall14_TelNumber, empty_string);
	putvalue(env_RNS_receivedcall15_TelNumber, empty_string);
	putvalue(env_RNS_receivedcall16_TelNumber, empty_string);
	putvalue(env_RNS_receivedcall17_TelNumber, empty_string);
	putvalue(env_RNS_receivedcall18_TelNumber, empty_string);
	putvalue(env_RNS_receivedcall19_TelNumber, empty_string);
	//Date
	putvalue(env_RNS_receivedcall0_date, empty_string);
	putvalue(env_RNS_receivedcall1_date, empty_string);
	putvalue(env_RNS_receivedcall2_date, empty_string);
	putvalue(env_RNS_receivedcall3_date, empty_string);
	putvalue(env_RNS_receivedcall4_date, empty_string);
	putvalue(env_RNS_receivedcall5_date, empty_string);
	putvalue(env_RNS_receivedcall6_date, empty_string);
	putvalue(env_RNS_receivedcall7_date, empty_string);
	putvalue(env_RNS_receivedcall8_date, empty_string);
	putvalue(env_RNS_receivedcall9_date, empty_string);
	putvalue(env_RNS_receivedcall10_date, empty_string);
	putvalue(env_RNS_receivedcall11_date, empty_string);
	putvalue(env_RNS_receivedcall12_date, empty_string);
	putvalue(env_RNS_receivedcall13_date, empty_string);
	putvalue(env_RNS_receivedcall14_date, empty_string);
	putvalue(env_RNS_receivedcall15_date, empty_string);
	putvalue(env_RNS_receivedcall16_date, empty_string);
	putvalue(env_RNS_receivedcall17_date, empty_string);
	putvalue(env_RNS_receivedcall18_date, empty_string);
	putvalue(env_RNS_receivedcall19_date, empty_string);
	//time
	putvalue(env_RNS_receivedcall0_time, empty_string);
	putvalue(env_RNS_receivedcall1_time, empty_string);
	putvalue(env_RNS_receivedcall2_time, empty_string);
	putvalue(env_RNS_receivedcall3_time, empty_string);
	putvalue(env_RNS_receivedcall4_time, empty_string);
	putvalue(env_RNS_receivedcall5_time, empty_string);
	putvalue(env_RNS_receivedcall6_time, empty_string);
	putvalue(env_RNS_receivedcall7_time, empty_string);
	putvalue(env_RNS_receivedcall8_time, empty_string);
	putvalue(env_RNS_receivedcall9_time, empty_string);
	putvalue(env_RNS_receivedcall10_time, empty_string);
	putvalue(env_RNS_receivedcall11_time, empty_string);
	putvalue(env_RNS_receivedcall12_time, empty_string);
	putvalue(env_RNS_receivedcall13_time, empty_string);
	putvalue(env_RNS_receivedcall14_time, empty_string);
	putvalue(env_RNS_receivedcall15_time, empty_string);
	putvalue(env_RNS_receivedcall16_time, empty_string);
	putvalue(env_RNS_receivedcall17_time, empty_string);
	putvalue(env_RNS_receivedcall18_time, empty_string);
	putvalue(env_RNS_receivedcall19_time, empty_string);
	//numbertype
	putvalue(env_RNS_receivedcall0_numbertype, empty_string);
	putvalue(env_RNS_receivedcall1_numbertype, empty_string);
	putvalue(env_RNS_receivedcall2_numbertype, empty_string);
	putvalue(env_RNS_receivedcall3_numbertype, empty_string);
	putvalue(env_RNS_receivedcall4_numbertype, empty_string);
	putvalue(env_RNS_receivedcall5_numbertype, empty_string);
	putvalue(env_RNS_receivedcall6_numbertype, empty_string);
	putvalue(env_RNS_receivedcall7_numbertype, empty_string);
	putvalue(env_RNS_receivedcall8_numbertype, empty_string);
	putvalue(env_RNS_receivedcall9_numbertype, empty_string);
	putvalue(env_RNS_receivedcall10_numbertyp, empty_string);
	putvalue(env_RNS_receivedcall11_numbertyp, empty_string);
	putvalue(env_RNS_receivedcall12_numbertyp, empty_string);
	putvalue(env_RNS_receivedcall13_numbertyp, empty_string);
	putvalue(env_RNS_receivedcall14_numbertyp, empty_string);
	putvalue(env_RNS_receivedcall15_numbertyp, empty_string);
	putvalue(env_RNS_receivedcall16_numbertyp, empty_string);
	putvalue(env_RNS_receivedcall17_numbertyp, empty_string);
	putvalue(env_RNS_receivedcall18_numbertyp, empty_string);
	putvalue(env_RNS_receivedcall19_numbertyp, empty_string);


	//dialed numbers
	//PbName
	putvalue(env_RNS_dialednumber0_PbName, empty_string);
	putvalue(env_RNS_dialednumber1_PbName, empty_string);
	putvalue(env_RNS_dialednumber2_PbName, empty_string);
	putvalue(env_RNS_dialednumber3_PbName, empty_string);
	putvalue(env_RNS_dialednumber4_PbName, empty_string);
	putvalue(env_RNS_dialednumber5_PbName, empty_string);
	putvalue(env_RNS_dialednumber6_PbName, empty_string);
	putvalue(env_RNS_dialednumber7_PbName, empty_string);
	putvalue(env_RNS_dialednumber8_PbName, empty_string);
	putvalue(env_RNS_dialednumber9_PbName, empty_string);
	putvalue(env_RNS_dialednumber10_PbName, empty_string);
	putvalue(env_RNS_dialednumber11_PbName, empty_string);
	putvalue(env_RNS_dialednumber12_PbName, empty_string);
	putvalue(env_RNS_dialednumber13_PbName, empty_string);
	putvalue(env_RNS_dialednumber14_PbName, empty_string);
	putvalue(env_RNS_dialednumber15_PbName, empty_string);
	putvalue(env_RNS_dialednumber16_PbName, empty_string);
	putvalue(env_RNS_dialednumber17_PbName, empty_string);
	putvalue(env_RNS_dialednumber18_PbName, empty_string);
	putvalue(env_RNS_dialednumber19_PbName, empty_string);
	//TelNumber
	putvalue(env_RNS_dialednumber0_TelNumber, empty_string);
	putvalue(env_RNS_dialednumber1_TelNumber, empty_string);
	putvalue(env_RNS_dialednumber2_TelNumber, empty_string);
	putvalue(env_RNS_dialednumber3_TelNumber, empty_string);
	putvalue(env_RNS_dialednumber4_TelNumber, empty_string);
	putvalue(env_RNS_dialednumber5_TelNumber, empty_string);
	putvalue(env_RNS_dialednumber6_TelNumber, empty_string);
	putvalue(env_RNS_dialednumber7_TelNumber, empty_string);
	putvalue(env_RNS_dialednumber8_TelNumber, empty_string);
	putvalue(env_RNS_dialednumber9_TelNumber, empty_string);
	putvalue(env_RNS_dialednumber10_TelNumber, empty_string);
	putvalue(env_RNS_dialednumber11_TelNumber, empty_string);
	putvalue(env_RNS_dialednumber12_TelNumber, empty_string);
	putvalue(env_RNS_dialednumber13_TelNumber, empty_string);
	putvalue(env_RNS_dialednumber14_TelNumber, empty_string);
	putvalue(env_RNS_dialednumber15_TelNumber, empty_string);
	putvalue(env_RNS_dialednumber16_TelNumber, empty_string);
	putvalue(env_RNS_dialednumber17_TelNumber, empty_string);
	putvalue(env_RNS_dialednumber18_TelNumber, empty_string);
	putvalue(env_RNS_dialednumber19_TelNumber, empty_string);
	//Date
	putvalue(env_RNS_dialednumber0_date, empty_string);
	putvalue(env_RNS_dialednumber1_date, empty_string);
	putvalue(env_RNS_dialednumber2_date, empty_string);
	putvalue(env_RNS_dialednumber3_date, empty_string);
	putvalue(env_RNS_dialednumber4_date, empty_string);
	putvalue(env_RNS_dialednumber5_date, empty_string);
	putvalue(env_RNS_dialednumber6_date, empty_string);
	putvalue(env_RNS_dialednumber7_date, empty_string);
	putvalue(env_RNS_dialednumber8_date, empty_string);
	putvalue(env_RNS_dialednumber9_date, empty_string);
	putvalue(env_RNS_dialednumber10_date, empty_string);
	putvalue(env_RNS_dialednumber11_date, empty_string);
	putvalue(env_RNS_dialednumber12_date, empty_string);
	putvalue(env_RNS_dialednumber13_date, empty_string);
	putvalue(env_RNS_dialednumber14_date, empty_string);
	putvalue(env_RNS_dialednumber15_date, empty_string);
	putvalue(env_RNS_dialednumber16_date, empty_string);
	putvalue(env_RNS_dialednumber17_date, empty_string);
	putvalue(env_RNS_dialednumber18_date, empty_string);
	putvalue(env_RNS_dialednumber19_date, empty_string);
	//time
	putvalue(env_RNS_dialednumber0_time, empty_string);
	putvalue(env_RNS_dialednumber1_time, empty_string);
	putvalue(env_RNS_dialednumber2_time, empty_string);
	putvalue(env_RNS_dialednumber3_time, empty_string);
	putvalue(env_RNS_dialednumber4_time, empty_string);
	putvalue(env_RNS_dialednumber5_time, empty_string);
	putvalue(env_RNS_dialednumber6_time, empty_string);
	putvalue(env_RNS_dialednumber7_time, empty_string);
	putvalue(env_RNS_dialednumber8_time, empty_string);
	putvalue(env_RNS_dialednumber9_time, empty_string);
	putvalue(env_RNS_dialednumber10_time, empty_string);
	putvalue(env_RNS_dialednumber11_time, empty_string);
	putvalue(env_RNS_dialednumber12_time, empty_string);
	putvalue(env_RNS_dialednumber13_time, empty_string);
	putvalue(env_RNS_dialednumber14_time, empty_string);
	putvalue(env_RNS_dialednumber15_time, empty_string);
	putvalue(env_RNS_dialednumber16_time, empty_string);
	putvalue(env_RNS_dialednumber17_time, empty_string);
	putvalue(env_RNS_dialednumber18_time, empty_string);
	putvalue(env_RNS_dialednumber19_time, empty_string);
	//numbertype
	putvalue(env_RNS_dialednumber0_numbertype, empty_string);
	putvalue(env_RNS_dialednumber1_numbertype, empty_string);
	putvalue(env_RNS_dialednumber2_numbertype, empty_string);
	putvalue(env_RNS_dialednumber3_numbertype, empty_string);
	putvalue(env_RNS_dialednumber4_numbertype, empty_string);
	putvalue(env_RNS_dialednumber5_numbertype, empty_string);
	putvalue(env_RNS_dialednumber6_numbertype, empty_string);
	putvalue(env_RNS_dialednumber7_numbertype, empty_string);
	putvalue(env_RNS_dialednumber8_numbertype, empty_string);
	putvalue(env_RNS_dialednumber9_numbertype, empty_string);
	putvalue(env_RNS_dialednumber10_numbertyp, empty_string);
	putvalue(env_RNS_dialednumber11_numbertyp, empty_string);
	putvalue(env_RNS_dialednumber12_numbertyp, empty_string);
	putvalue(env_RNS_dialednumber13_numbertyp, empty_string);
	putvalue(env_RNS_dialednumber14_numbertyp, empty_string);
	putvalue(env_RNS_dialednumber15_numbertyp, empty_string);
	putvalue(env_RNS_dialednumber16_numbertyp, empty_string);
	putvalue(env_RNS_dialednumber17_numbertyp, empty_string);
	putvalue(env_RNS_dialednumber18_numbertyp, empty_string);
	putvalue(env_RNS_dialednumber19_numbertyp, empty_string);
	
	//SMSReceived
	//SMSMPbName
	putvalue(env_ASG_SMSReceived0_PbName, empty_string);
	putvalue(env_ASG_SMSReceived1_PbName, empty_string);
	putvalue(env_ASG_SMSReceived2_PbName, empty_string);
	putvalue(env_ASG_SMSReceived3_PbName, empty_string);
	putvalue(env_ASG_SMSReceived4_PbName, empty_string);
	putvalue(env_ASG_SMSReceived5_PbName, empty_string);
	putvalue(env_ASG_SMSReceived6_PbName, empty_string);
	putvalue(env_ASG_SMSReceived7_PbName, empty_string);
	putvalue(env_ASG_SMSReceived8_PbName, empty_string);
	putvalue(env_ASG_SMSReceived9_PbName, empty_string);
	//SMSAttrib
	putvalue(env_ASG_SMSReceived0_Attrib, 0);
	putvalue(env_ASG_SMSReceived1_Attrib, 0);
	putvalue(env_ASG_SMSReceived2_Attrib, 0);
	putvalue(env_ASG_SMSReceived3_Attrib, 0);
	putvalue(env_ASG_SMSReceived4_Attrib, 0);
	putvalue(env_ASG_SMSReceived5_Attrib, 0);
	putvalue(env_ASG_SMSReceived6_Attrib, 0);
	putvalue(env_ASG_SMSReceived7_Attrib, 0);
	putvalue(env_ASG_SMSReceived8_Attrib, 0);
	putvalue(env_ASG_SMSReceived9_Attrib, 0);
	//SMSTelNumber
	putvalue(env_ASG_SMSReceived0_TelNumber, empty_string);
	putvalue(env_ASG_SMSReceived1_TelNumber, empty_string);
	putvalue(env_ASG_SMSReceived2_TelNumber, empty_string);
	putvalue(env_ASG_SMSReceived3_TelNumber, empty_string);
	putvalue(env_ASG_SMSReceived4_TelNumber, empty_string);
	putvalue(env_ASG_SMSReceived5_TelNumber, empty_string);
	putvalue(env_ASG_SMSReceived6_TelNumber, empty_string);
	putvalue(env_ASG_SMSReceived7_TelNumber, empty_string);
	putvalue(env_ASG_SMSReceived8_TelNumber, empty_string);
	putvalue(env_ASG_SMSReceived9_TelNumber, empty_string);
	//Date
	putvalue(env_ASG_SMSReceived0_day, 0);
	putvalue(env_ASG_SMSReceived0_month, 0);
	putvalue(env_ASG_SMSReceived0_year, 0);
	putvalue(env_ASG_SMSReceived1_day, 0);
	putvalue(env_ASG_SMSReceived1_month, 0);
	putvalue(env_ASG_SMSReceived1_year, 0);
	putvalue(env_ASG_SMSReceived2_day, 0);
	putvalue(env_ASG_SMSReceived2_month, 0);
	putvalue(env_ASG_SMSReceived2_year, 0);
	putvalue(env_ASG_SMSReceived3_day, 0);
	putvalue(env_ASG_SMSReceived3_month, 0);
	putvalue(env_ASG_SMSReceived3_year, 0);
	putvalue(env_ASG_SMSReceived4_day, 0);
	putvalue(env_ASG_SMSReceived4_month, 0);
	putvalue(env_ASG_SMSReceived4_year, 0);
	putvalue(env_ASG_SMSReceived5_day, 0);
	putvalue(env_ASG_SMSReceived5_month, 0);
	putvalue(env_ASG_SMSReceived5_year, 0);
	putvalue(env_ASG_SMSReceived6_day, 0);
	putvalue(env_ASG_SMSReceived6_month, 0);
	putvalue(env_ASG_SMSReceived6_year, 0);
	putvalue(env_ASG_SMSReceived7_day, 0);
	putvalue(env_ASG_SMSReceived7_month, 0);
	putvalue(env_ASG_SMSReceived7_year, 0);
	putvalue(env_ASG_SMSReceived8_day, 0);
	putvalue(env_ASG_SMSReceived8_month, 0);
	putvalue(env_ASG_SMSReceived8_year, 0);
	putvalue(env_ASG_SMSReceived9_day, 0);
	putvalue(env_ASG_SMSReceived9_month, 0);
	putvalue(env_ASG_SMSReceived9_year, 0);
	//Time
	putvalue(env_ASG_SMSReceived0_hour, 0);
	putvalue(env_ASG_SMSReceived0_min, 0);
	putvalue(env_ASG_SMSReceived0_sec, 0);
	putvalue(env_ASG_SMSReceived1_hour, 0);
	putvalue(env_ASG_SMSReceived1_min, 0);
	putvalue(env_ASG_SMSReceived1_sec, 0);
	putvalue(env_ASG_SMSReceived2_hour, 0);
	putvalue(env_ASG_SMSReceived2_min, 0);
	putvalue(env_ASG_SMSReceived2_sec, 0);
	putvalue(env_ASG_SMSReceived3_hour, 0);
	putvalue(env_ASG_SMSReceived3_min, 0);
	putvalue(env_ASG_SMSReceived3_sec, 0);
	putvalue(env_ASG_SMSReceived4_hour, 0);
	putvalue(env_ASG_SMSReceived4_min, 0);
	putvalue(env_ASG_SMSReceived4_sec, 0);
	putvalue(env_ASG_SMSReceived5_hour, 0);
	putvalue(env_ASG_SMSReceived5_min, 0);
	putvalue(env_ASG_SMSReceived5_sec, 0);
	putvalue(env_ASG_SMSReceived6_hour, 0);
	putvalue(env_ASG_SMSReceived6_min, 0);
	putvalue(env_ASG_SMSReceived6_sec, 0);
	putvalue(env_ASG_SMSReceived7_hour, 0);
	putvalue(env_ASG_SMSReceived7_min, 0);
	putvalue(env_ASG_SMSReceived7_sec, 0);
	putvalue(env_ASG_SMSReceived8_hour, 0);
	putvalue(env_ASG_SMSReceived8_min, 0);
	putvalue(env_ASG_SMSReceived8_sec, 0);
	putvalue(env_ASG_SMSReceived9_hour, 0);
	putvalue(env_ASG_SMSReceived9_min, 0);
	putvalue(env_ASG_SMSReceived9_sec, 0);
	//Text
	putvalue(env_ASG_SMSReceived0_Text, empty_string);
	putvalue(env_ASG_SMSReceived1_Text, empty_string);
	putvalue(env_ASG_SMSReceived2_Text, empty_string);
	putvalue(env_ASG_SMSReceived3_Text, empty_string);
	putvalue(env_ASG_SMSReceived4_Text, empty_string);
	putvalue(env_ASG_SMSReceived5_Text, empty_string);
	putvalue(env_ASG_SMSReceived6_Text, empty_string);
	putvalue(env_ASG_SMSReceived7_Text, empty_string);
	putvalue(env_ASG_SMSReceived8_Text, empty_string);
	putvalue(env_ASG_SMSReceived9_Text, empty_string);	

	//SMSTemplate
	//SMSTitle
	putvalue(env_ASG_SMSTemplate0_Title, empty_string);
	putvalue(env_ASG_SMSTemplate1_Title, empty_string);
	putvalue(env_ASG_SMSTemplate2_Title, empty_string);
	putvalue(env_ASG_SMSTemplate3_Title, empty_string);
	putvalue(env_ASG_SMSTemplate4_Title, empty_string);	
	//SMSText
	putvalue(env_ASG_SMSTemplate0_Text, empty_string);
	putvalue(env_ASG_SMSTemplate1_Text, empty_string);
	putvalue(env_ASG_SMSTemplate2_Text, empty_string);
	putvalue(env_ASG_SMSTemplate3_Text, empty_string);
	putvalue(env_ASG_SMSTemplate4_Text, empty_string);

	//CombinedNumbers
    putvalue(env_ASG_CN_ASGID, 0);
    putvalue(env_ASG_CN_TAID, 0);
    putvalue(env_ASG_CN_TotalNumLE, 0);
    putvalue(env_ASG_CN_AH_shift, 0);
    putvalue(env_ASG_CN_AH_dir, FORWARD);
    putvalue(env_ASG_CN_AH_IS, 0);
    putvalue(env_ASG_CN_AH_PosTrans, 0);
    putvalue(env_ASG_CN_AH_RA, 0);
    putvalue(env_ASG_CN_AH_start, 0);
    putvalue(env_ASG_CN_AH_elements, 0);
    putvalue(env_ASG_CN_ListOpState, empty_string);

    putvalue(env_ASG_CN_pos_0, 0);
    putvalue(env_ASG_CN_pos_1, 0);
    putvalue(env_ASG_CN_pos_2, 0);
    
    putvalue(env_ASG_CN_PbName_s_0,empty_string);
    putvalue(env_ASG_CN_PbName_s_1,empty_string);
    putvalue(env_ASG_CN_PbName_s_2,empty_string);

    putvalue(env_ASG_CN_TelNum_s_0,empty_string);
    putvalue(env_ASG_CN_TelNum_s_1,empty_string);
    putvalue(env_ASG_CN_TelNum_s_2,empty_string);
    
    putvalue(env_ASG_CN_CallMode_0, 0);
    putvalue(env_ASG_CN_CallMode_1, 0);
    putvalue(env_ASG_CN_CallMode_2, 0);

    putvalue(env_ASG_CN_CallMode_s_0,empty_string);
    putvalue(env_ASG_CN_CallMode_s_1,empty_string);
    putvalue(env_ASG_CN_CallMode_s_2,empty_string);

    putvalue(env_ASG_CN_day_0, 0);
    putvalue(env_ASG_CN_day_1, 0);
    putvalue(env_ASG_CN_day_2, 0);

    putvalue(env_ASG_CN_month_0, 0);
    putvalue(env_ASG_CN_month_1, 0);
    putvalue(env_ASG_CN_month_2, 0);

    putvalue(env_ASG_CN_year_0, 0);
    putvalue(env_ASG_CN_year_1, 0);
    putvalue(env_ASG_CN_year_2, 0);

    putvalue(env_ASG_CN_hour_0, 0);
    putvalue(env_ASG_CN_hour_1, 0);
    putvalue(env_ASG_CN_hour_2, 0);

    putvalue(env_ASG_CN_minute_0, 0);
    putvalue(env_ASG_CN_minute_1, 0);
    putvalue(env_ASG_CN_minute_2, 0);

    putvalue(env_ASG_CN_second_0, 0);
    putvalue(env_ASG_CN_second_1, 0);
    putvalue(env_ASG_CN_second_2, 0);

    putvalue(env_ASG_CN_OnOff, FALSE);

    putvalue(env_ASG_CN_ListInfo_up,empty_string);
    putvalue(env_ASG_CN_ListInfo_down,empty_string);
    putvalue(env_ASG_CN_ListInfo_Cursor,empty_string);
                   
    ClosePanel("ASG_Telephone_0x31 - CombinedNumbers_EditCache");

    
    //ReceivedCalls
    putvalue(env_ASG_RC_ASGID, 0);
    putvalue(env_ASG_RC_TAID, 0);
    putvalue(env_ASG_RC_TotalNumLE, 0);
    putvalue(env_ASG_RC_AH_shift, 0);
    putvalue(env_ASG_RC_AH_dir, FORWARD);
    putvalue(env_ASG_RC_AH_IS, 0);
    putvalue(env_ASG_RC_AH_PosTrans, 0);
    putvalue(env_ASG_RC_AH_RA, 0);
    putvalue(env_ASG_RC_AH_start, 0);
    putvalue(env_ASG_RC_AH_elements, 0);
    putvalue(env_ASG_RC_ListOpState, empty_string);

    putvalue(env_ASG_RC_pos_0, 0);
    putvalue(env_ASG_RC_pos_1, 0);
    putvalue(env_ASG_RC_pos_2, 0);

    putvalue(env_ASG_RC_PbName_s_0,empty_string);
    putvalue(env_ASG_RC_PbName_s_1,empty_string);
    putvalue(env_ASG_RC_PbName_s_2,empty_string);

    putvalue(env_ASG_RC_TelNum_s_0,empty_string);
    putvalue(env_ASG_RC_TelNum_s_1,empty_string);
    putvalue(env_ASG_RC_TelNum_s_2,empty_string);
    
    putvalue(env_ASG_RC_NumType_0, 0);
    putvalue(env_ASG_RC_NumType_1, 0);
    putvalue(env_ASG_RC_NumType_2, 0);

    putvalue(env_ASG_RC_NumType_s_0,empty_string);
    putvalue(env_ASG_RC_NumType_s_1,empty_string);
    putvalue(env_ASG_RC_NumType_s_2,empty_string);

    putvalue(env_ASG_RC_day_0, 0);
    putvalue(env_ASG_RC_day_1, 0);
    putvalue(env_ASG_RC_day_2, 0);

    putvalue(env_ASG_RC_month_0, 0);
    putvalue(env_ASG_RC_month_1, 0);
    putvalue(env_ASG_RC_month_2, 0);

    putvalue(env_ASG_RC_year_0, 0);
    putvalue(env_ASG_RC_year_1, 0);
    putvalue(env_ASG_RC_year_2, 0);

    putvalue(env_ASG_RC_hour_0, 0);
    putvalue(env_ASG_RC_hour_1, 0);
    putvalue(env_ASG_RC_hour_2, 0);

    putvalue(env_ASG_RC_minute_0, 0);
    putvalue(env_ASG_RC_minute_1, 0);
    putvalue(env_ASG_RC_minute_2, 0);

    putvalue(env_ASG_RC_second_0, 0);
    putvalue(env_ASG_RC_second_1, 0);
    putvalue(env_ASG_RC_second_2, 0);

    putvalue(env_ASG_RC_OnOff, FALSE);

    putvalue(env_ASG_RC_ListInfo_up,empty_string);
    putvalue(env_ASG_RC_ListInfo_down,empty_string);
    putvalue(env_ASG_RC_ListInfo_Cursor,empty_string);
                   
    ClosePanel("ASG_Telephone_0x2F - ReceivedCalls_EditCache");

    //DialedNumbers
    putvalue(env_ASG_DN_ASGID, 0);
    putvalue(env_ASG_DN_TAID, 0);
    putvalue(env_ASG_DN_TotalNumLE, 0);
    putvalue(env_ASG_DN_AH_shift, 0);
    putvalue(env_ASG_DN_AH_dir, FORWARD);
    putvalue(env_ASG_DN_AH_IS, 0);
    putvalue(env_ASG_DN_AH_PosTrans, 0);
    putvalue(env_ASG_DN_AH_RA, 0);
    putvalue(env_ASG_DN_AH_start, 0);
    putvalue(env_ASG_DN_AH_elements, 0);
    putvalue(env_ASG_DN_ListOpState, empty_string);

    putvalue(env_ASG_DN_pos_0, 0);
    putvalue(env_ASG_DN_pos_1, 0);
    putvalue(env_ASG_DN_pos_2, 0);

    putvalue(env_ASG_DN_PbName_s_0,empty_string);
    putvalue(env_ASG_DN_PbName_s_1,empty_string);
    putvalue(env_ASG_DN_PbName_s_2,empty_string);

    putvalue(env_ASG_DN_TelNum_s_0,empty_string);
    putvalue(env_ASG_DN_TelNum_s_1,empty_string);
    putvalue(env_ASG_DN_TelNum_s_2,empty_string);
    
    putvalue(env_ASG_DN_NumType_0, 0);
    putvalue(env_ASG_DN_NumType_1, 0);
    putvalue(env_ASG_DN_NumType_2, 0);

    putvalue(env_ASG_DN_NumType_s_0,empty_string);
    putvalue(env_ASG_DN_NumType_s_1,empty_string);
    putvalue(env_ASG_DN_NumType_s_2,empty_string);

    putvalue(env_ASG_DN_day_0, 0);
    putvalue(env_ASG_DN_day_1, 0);
    putvalue(env_ASG_DN_day_2, 0);

    putvalue(env_ASG_DN_month_0, 0);
    putvalue(env_ASG_DN_month_1, 0);
    putvalue(env_ASG_DN_month_2, 0);

    putvalue(env_ASG_DN_year_0, 0);
    putvalue(env_ASG_DN_year_1, 0);
    putvalue(env_ASG_DN_year_2, 0);

    putvalue(env_ASG_DN_hour_0, 0);
    putvalue(env_ASG_DN_hour_1, 0);
    putvalue(env_ASG_DN_hour_2, 0);

    putvalue(env_ASG_DN_minute_0, 0);
    putvalue(env_ASG_DN_minute_1, 0);
    putvalue(env_ASG_DN_minute_2, 0);

    putvalue(env_ASG_DN_second_0, 0);
    putvalue(env_ASG_DN_second_1, 0);
    putvalue(env_ASG_DN_second_2, 0);

    putvalue(env_ASG_DN_OnOff, FALSE);

    putvalue(env_ASG_DN_ListInfo_up,empty_string);
    putvalue(env_ASG_DN_ListInfo_down,empty_string);
    putvalue(env_ASG_DN_ListInfo_Cursor,empty_string);
                   
    ClosePanel("ASG_Telephone_0x30 - DialedNumbers_EditCache");

    
    //Phonebook
    delete_phonebook();
    display_phonebook();

}
/*@@end*/

/*@@caplFunc:HeartBeat_Telephone_Indication(dword[],byte,int):*/
HeartBeat_Telephone_Indication(dword Indication_array [], byte indication, int datalength)
{
byte errorcode;

errorcode=0;

	switch (indication){
		case Data_IND:
		//	GetAll_Telephone_Request(DataGet_REQ, 0);
		break;
		case Error_IND:
			if(datalength!=4)
				writelineEx(gError_Trace, 0, "ASG HeartBeat_Telephone_Indication: BAP-datalength-error");
			else{
				errorcode=Indication_array[3];
				if(errorcode<0x20)				//BCL-error
					writelineEx(gError_Trace, 0, "ASG HeartBeat_Telephone_Indication: BCL-Error: 0x%x - %s", errorcode, gerror_codes_BCL [errorcode-0x10]);
				else if(errorcode<0x30)			//BPL-error
					writelineEx(gError_Trace, 0, "ASG HeartBeat_Telephone_Indication: BPL-Error: 0x%x - %s", errorcode, gerror_codes_BPL [errorcode-0x20]);				
				else if(errorcode<0x40)			//BAL-error
					writelineEx(gError_Trace, 0, "ASG HeartBeat_Telephone_Indication: BAL-Error: 0x%x - %s", errorcode, gerror_codes_BAL [errorcode-0x30]);
				else if(errorcode>=0x80 && errorcode<=0xA2)
					writelineEx(gError_Trace, 0, "ASG HeartBeat_Telephone_Indication: Phonebook-Error: 0x%x - %s", errorcode, gerror_codes_telephone [errorcode-0x80]);				
				else
					writelineEx(gError_Trace, 0, "ASG Heartbeat_Telephone_Indication: Telephone-Error: 0x%x", errorcode);

				if(errorcode==0x21){
					write("ASG-Telephone: re-init");
					init_variables_Telephone();	
				}
			}
		break;
		default:
			writelineEx(gError_Trace, 0, "ASG HeartBeat_Telephone_Indication: unknown indication %d", indication);
		break;
	}

}
/*@@end*/

/*@@caplFunc:HeartBeat_Telephone_Request(byte,byte):*/
HeartBeat_Telephone_Request (byte request, byte errorcode)
{
int Offset, i;
dword requestarray [BAP_buffer_size];

//init lokal variables
	Offset=0;

	for(i=0;i<BAP_buffer_size;i++)
		requestarray [i]=0;
//********************

	
	switch(request){
		case DataGet_REQ:
			requestarray[0]=LSGID_Telephone;	//LSG-ID
			requestarray[1]=FctID_HeartBeat;	//Fct.-ID
			requestarray[2]=DataGet_REQ;
			Offset=3;
			set_status_requestbuffer (requestarray, Offset, Bap_Void);
		break;
		default:	//error
			writelineEx(gError_Trace, 0, "ASG HeartBeat_Telephone_Request: unknown request %d", request);
		break;
	}
}
/*@@end*/

/*@@caplFunc:SignalQuality_Request(byte,byte):*/
SignalQuality_Request (byte request, byte errorcode)
{
int i, Offset;
dword requestarray [BAP_buffer_size];

//init lokal variables
	Offset=0;

	for(i=0;i<BAP_buffer_size;i++)
		requestarray [i]=0;
//********************


	switch(request){
		case DataGet_REQ:
			requestarray[0]=LSGID_Telephone;	//LSG-ID
			requestarray[1]=FctID_SignalQuality;	//Fct.-ID
			requestarray[2]=request;
			Offset=3;
			set_status_requestbuffer (requestarray, Offset, Bap_Void);
		break;
		default:	//error
			writelineEx(gError_Trace, 0, "SignalQuality_Request: unknown request %d", request);
		break;
	}
}
/*@@end*/

/*@@caplFunc:SignalQuality_Indication(dword[],byte,int):*/
SignalQuality_Indication (dword Indication_array [], byte indication, int datalength)
{
byte errorcode;

//init lokal variables
	errorcode=0x00;
//********************

	//check array
	if(datalength!=4)	//datalength error
		writelineEx(gError_Trace, 0, "ASG LineState_Indication: BAP-datalength-error");
	else{
		switch (indication){
			case Data_IND:
				gSignalQuality =Indication_array[3];
				putvalue(env_RNS_SignalQuality, gSignalQuality);
			break;
			case Error_IND:
				errorcode=Indication_array[3];
				if(errorcode<0x20)				//BCL-error
					writelineEx(gError_Trace, 0, "ASG SignalQuality_Indication: BCL-Error: 0x%x - %s", errorcode, gerror_codes_BCL [errorcode-0x10]);
				else if(errorcode<0x30)			//BPL-error
					writelineEx(gError_Trace, 0, "ASG SignalQuality_Indication: BPL-Error: 0x%x - %s", errorcode, gerror_codes_BPL [errorcode-0x20]);				
				else if(errorcode<0x40)			//BAL-error
					writelineEx(gError_Trace, 0, "ASG SignalQuality_Indication: BAL-Error: 0x%x - %s", errorcode, gerror_codes_BAL [errorcode-0x30]);
				else if(errorcode>=0x80 && errorcode<=0xA2)
					writelineEx(gError_Trace, 0, "ASG SignalQuality_Indication: Telephone-Error: 0x%x - %s", errorcode, gerror_codes_telephone [errorcode-0x80]);
				else
					writelineEx(gError_Trace, 0, "ASG SignalQuality_Indication: Telephone-Error: 0x%x", errorcode);
			break;
			default:
				writelineEx(gError_Trace, 0, "ASG SignalQuality_Indication: unknown indication %d", indication);
			break;
		}
	}
}
/*@@end*/

/*@@caplFunc:LockState_Indication(dword[],byte,int):*/
LockState_Indication (dword Indication_array [], byte indication, int datalength)
{
byte errorcode;

	errorcode=0x00;
	
	//check array
	if(datalength!=4)	//datalength error
		writelineEx(gError_Trace, 0, "ASG LockState_Indication: BAP-datalength-error");
	else
	{
		switch (indication)
		{
			case Data_IND:
				gLockState =Indication_array[3];

                if(gLockState>0x0F)
					putvalue(env_RNS_LockState, ginvalid);
				else
					putvalue(env_RNS_LockState, gstring_LockState[gLockState]);
				
				if(gLockState==1)
				{
					setcontrolbackcolor("ASG-Telephone", "PINCodestring", gRGB_white);
					EnableControl("ASG-Telephone", "PINCodestring", 1);
					EnableControl("ASG-Telephone", "PINCodeenter", 1);
				}
				else
				{
					EnableControl("ASG-Telephone", "PINCodestring", 0);
					setcontrolbackcolor("ASG-Telephone", "PINCodestring", gRGB_grey);
					EnableControl("ASG-Telephone", "PINCodeenter", 0);
				}

			break;
			case Error_IND:
				errorcode=Indication_array[3];
				if(errorcode<0x20)				//BCL-error
					writelineEx(gError_Trace, 0, "ASG LockState_Indication: BCL-Error: 0x%x - %s", errorcode, gerror_codes_BCL [errorcode-0x10]);
				else if(errorcode<0x30)			//BPL-error
					writelineEx(gError_Trace, 0, "ASG LockState_Indication: BPL-Error: 0x%x - %s", errorcode, gerror_codes_BPL [errorcode-0x20]);				
				else if(errorcode<0x40)			//BAL-error
					writelineEx(gError_Trace, 0, "ASG LockState_Indication: BAL-Error: 0x%x - %s", errorcode, gerror_codes_BAL [errorcode-0x30]);
				else if(errorcode>=0x80 && errorcode<=0xA2)
					writelineEx(gError_Trace, 0, "ASG LockState_Indication: Telephone-Error: 0x%x - %s", errorcode, gerror_codes_telephone [errorcode-0x80]);
				else
					writelineEx(gError_Trace, 0, "ASG LockState_Indication: Telephone-Error: 0x%x", errorcode);
			break;
			default:
				writelineEx(gError_Trace, 0, "ASG LockState_Indication: unknown indication %d", indication);
			break;
		}
	}
}
/*@@end*/

/*@@caplFunc:LockState_Request(byte,byte):*/
LockState_Request (byte request, byte errorcode)
{
int i, Offset;
dword requestarray [BAP_buffer_size];

//init lokal variables
	Offset=0;

	for(i=0;i<BAP_buffer_size;i++)
		requestarray [i]=0;
//********************


	switch(request){
		case DataGet_REQ:
			requestarray[0]=LSGID_Telephone;	//LSG-ID
			requestarray[1]=FctID_LockState;	//Fct.-ID
			requestarray[2]=request;
			Offset=3;
			set_status_requestbuffer (requestarray, Offset, Bap_Void);
		break;
		default:	//error
			writelineEx(gError_Trace, 0, "LockState_Request: unknown request %d", request);
		break;
	}
}
/*@@end*/

/*@@caplFunc:ActiveUser_Indication(dword[],byte,int):*/
ActiveUser_Indication (dword Indication_array [], byte indication, int datalength)
{

int i, length_UserName, datapointer;

//init lokal variables
	length_UserName=0;
	datapointer=3;
//********************
	
	for(i=0;i<50;i++)
		gActiveUserName[i]=0;

					
	switch (indication)
	{
		case Data_IND:
	/*		if(datalength)	//(4+length))	//datalength error
				writelineEx(gError_Trace, 0, "ActiveUser_Indication: BAP-datalength-error");
			else{*/

				
				//UserName
				length_UserName=Indication_array[datapointer];
                    datapointer++;
	//			write("user-length: %d", length);					//debug
				if (length_UserName==0)
				{
					putvalue(env_RNS_ActiveUserName,gActiveUserName);
				}
				else
				{
					for (i=0; i<length_UserName; i++)
					{
						gActiveUserName [i]=Indication_array[datapointer];
						datapointer++;
					}

					putvalue(env_RNS_ActiveUserName,gActiveUserName);
				}
	//		}
		break;
		case Error_IND:
			if(datalength!=4)	//datalength error
				writelineEx(gError_Trace, 0, "ActiveUser_Indication: BAP-datalength-error");
			else
				writelineEx(gError_Trace, 0, "ASG ActiveUser_Indication: recieved error, errorcode:0x%x", Indication_array[3]);
		break;
		default:
			writelineEx(gError_Trace, 0, "ASG ActiveUser_Indication: unknown indication %d", indication);
		break;
	}
}
/*@@end*/

/*@@caplFunc:ActiveUser_Request(byte,byte):*/
ActiveUser_Request (byte request, byte errorcode)
{
int i, Offset;
dword requestarray [BAP_buffer_size];

//init lokal variables
	Offset=0;

	for(i=0;i<BAP_buffer_size;i++)
		requestarray [i]=0;
//********************

	
	switch (request){
		case DataGet_REQ:
			requestarray[0]=LSGID_Telephone;	//LSG-ID
			requestarray[1]=FctID_ActiveUser;	//Fct.-ID
			requestarray[2]=request;
			Offset=3;
			set_status_requestbuffer (requestarray, Offset, Bap_Void);
		break;
		default:	//error
			writelineEx(gError_Trace, 0, "ASG ActiveUser_Request: unknown request %d", request);
		break;
	}
}
/*@@end*/

/*@@caplFunc:init_variables_Phonebook():*/
init_variables_Phonebook ()
{
/*
int i=0, j=0;
char empty_string [3];

//init lokal variables
	for(i=0;i<3;i++)
		empty_string[i]=0;
//********************

	
//*************************************************************************
//******************************properties*********************************
//*************************************************************************	
	
	//FSG-Setup
	gPhoneBookStructure=0;
	putvalue(env_RNS_Phonebook_FSGsetup, empty_string);	

	//FSG-OperationState
	gFSG_OperationState_Phonebook=0;
	putvalue(env_RNS_Phonebook_FSG_opstate, empty_string);

	//property MissedCallIndication
	gMissedCalls=0;
	gMissedNumbers=0;
	gMissedCalls_set=0;
	gMissedNumbers_set=0;
	putvalue(env_RNS_MissedCalls, 0);
	putvalue(env_RNS_MissedNumbers, 0);
	putvalue(env_RNS_MissedCalls_setget, 0);
	putvalue(env_RNS_MissedNumbers_setget, 0);

	//property PbState
	gDownLoadState=0;
	gPbEntriesUHV=0;
	putvalue(env_RNS_Pb_DownloadState, empty_string);
	putvalue(env_RNS_PbEntriesUHV, gPbEntriesUHV);

	//property voicemailboxnumber
	for(i=0;i<40;i++)
	{
		gmailboxnumber_rns_cache[i]=0;	
		gmailboxnumber_new[i]=0;
	}
	putvalue(env_RNS_Mailboxnumber, gmailboxnumber_rns_cache);
	putvalue(env_RNS_Mailboxnumber_new, gmailboxnumber_new);

	//property SMSState
	gSMSStateSIMReady=0;
	gSMSStateStorageState=0;
	gSMSStateNumberOfNewSMS=0;
	putvalue(env_ASG_UHV_SMSStateSIMReady, empty_string);
	putvalue(env_ASG_UHV_SMSStateStorage, empty_string);
	putvalue(env_ASG_UHV_SMSStateNewSMS, gSMSStateNumberOfNewSMS);

	//property SMSFlash
	for(i=0;i<SMSFLASH_LENGTH;i++)
		gSMSFlashText[i]=0;
	putvalue(env_ASG_UHV_SMSFlashSMSText, empty_string);


//*************************************************************************
//******************************methods************************************
//*************************************************************************

	//method SMSStoreTemplate
	for(i=0;i<SMSStoreTemplate_TEXT_LENGTH;i++)
		gSMSStoreTemplate_Text[i]=0;
	putvalue(env_ASG_UHV_SMSStoreTemplate_T, empty_string);

	//method SMSSend
	for(i=0;i<SMSSEND_TELNUMBER_LENGHT;i++)
		gSMSSend_TelNumber[i]=0;
	for(i=0;i<SMSSEND_TEXT_LENGTH;i++)
		gSMSSend_Text[i]=0;
	gSMSSend_Code=0;
	putvalue(env_ASG_UHV_SMSSend_TelNumb, empty_string);
	putvalue(env_ASG_UHV_SMSSend_Text, empty_string);
	putvalue(env_ASG_UHV_SMSSend_Code, gSMSSend_Code);

	//method SMSDeleteAll
	gSMSDeleteAllStorage=0;
	putvalue(env_ASG_UHV_SMSDelete_unread, 0);
	putvalue(env_ASG_UHV_SMSDelete_read, 0);
	putvalue(env_ASG_UHV_SMSDelete_unsent, 0);
	putvalue(env_ASG_UHV_SMSDelete_sent, 0);
	putvalue(env_ASG_UHV_SMSDelete_template, 0);


//*************************************************************************
//******************************arrays*************************************
//*************************************************************************

	//missed calls
	deletecallstackmissedcalls();
	display_callstack_missedcalls();
	//deactivate dial-missedcall-button and missedcall-checkboxes
//	EnableControl("ASG-missedcalls", "RNS_Phonebook_missedcall_select", 0);
//	EnableControl("ASG-missedcalls", "RNS_Phonebook_dial_missedcall", 0);

	
	//received calls
	deletecallstackreceivedcalls();
	display_callstack_receivedcalls();
	//deactivate dial-receivedcall-button and receivedcall-checkboxes
//	EnableControl("ASG-receivedcalls", "RNS_Phonebook_receivedcall_select", 0);
//	EnableControl("ASG-receivedcalls", "RNS_Phonebook_dial_receivedcall", 0);


	//dialed numbers
	deletecallstackdialednumbers();
	display_callstack_dialednumbers();
	//deactivate dial-dialednumber-button and dialednumber-checkboxes
//	EnableControl("ASG-dialednumbers", "RNS_Phonebook_dialednumber_select", 0);
//	EnableControl("ASG-dialednumbers", "RNS_Phonebook_dial_dialednumber", 0);
	
	//SMSReceived
	deleteSMSReceivedstack();
	display_SMSReceived();

	//SMSTemplate
	deleteSMSTemplatestack();
	display_SMSTemplate();

	//Phonebook
	delete_phonebook();	
	display_phonebook();

	
*/
}
/*@@end*/

/*@@caplFunc:MissedCalls_Request(byte,word,word,byte,byte):*/
MissedCalls_Request (byte request, word startelement, word elements, byte mode, byte errorcode)
{
int i, Offset, indexsize, recordaddress;
dword requestarray [BAP_buffer_size];

//init lokal variables
	Offset=0;
	indexsize=0;
	recordaddress=0;

	for(i=0;i<BAP_buffer_size;i++)
		requestarray [i]=0;	

//********************
	
	recordaddress=mode & 0x0f;
	indexsize=(mode & 0x80)/0x80;

	switch (request){
		case DataSetGet_REQ:
			/*switch(recordaddress)
			{
				case 1:	//PbName and NumberType only (is only used to delete an entry)	
					//BAP-header
					requestarray[0]=LSGID_Telephone;	//LSG-ID
					requestarray[1]=FctID_MissedCalls;	//Fct.-ID
					requestarray[2]=request;	
		            
                    //ASG_ID & TAID
                    gmissedcalls_ASG_ID=0x1;    //instrument cluster
                    if(gmissedcalls_TAID<15)    
                        gmissedcalls_TAID++;
                    else                        //out of range
                        gmissedcalls_TAID=0;         //reset
                    requestarray[3]=((gmissedcalls_ASG_ID & 0x0F)*0x10) + (gmissedcalls_TAID & 0x0F);//upper and lower nibble

					//extended array header
					requestarray[4]=mode;				//Mode
					if(indexsize)
					{
						requestarray[5]=startelement & 0x00ff;
						requestarray[6]=(startelement & 0xff00)/0x100;
						requestarray[7]=elements & 0x00ff;
						requestarray[8]=(elements & 0xff00)/0x100;
						Offset=9;
					}
					else
					{
						requestarray[5]=startelement;
						requestarray[6]=elements;
						Offset=7;
					}
					
					//PbName
					requestarray[Offset]=0;
					Offset++;
					//NumberType
					requestarray[Offset]=0;
					Offset++;
					
					set_status_requestbuffer (requestarray, Offset, Bap_ByteSequence);
				break;
				default:
					writelineEx(gError_Trace, 0, "ASG UHV-Phonebook missedcalls_Request: invalid recordaddress %d", recordaddress);
				break;
			}*/			
		break;
		case DataGet_REQ:
			//BAP-header
			requestarray[0]=LSGID_Telephone;	//LSG-ID
			requestarray[1]=FctID_MissedCalls;	//Fct.-ID
			requestarray[2]=request;	
			
            //ASG_ID & TAID
            gmissedcalls_ASG_ID=0x1;    //instrument cluster

            if(gmissedcalls_TAID==0 || gmissedcalls_TAID>15)    //invalid values
                gmissedcalls_TAID=0x1;         //reset

            requestarray[3]=((gmissedcalls_ASG_ID & 0x0F)*0x10) + (gmissedcalls_TAID & 0x0F);//upper and lower nibble

			//extended array header
			requestarray[4]=mode;	//Mode
			if(indexsize){
				requestarray[5]=startelement & 0x00ff;
				requestarray[6]=(startelement & 0xff00)/256;
				requestarray[7]=elements & 0x00ff;
				requestarray[8]=(elements & 0xff00)/256;
				Offset=9;
			}
			else{
				requestarray[5]=startelement;
				requestarray[6]=elements;
				Offset=7;
			}
            //*****save evaluation items***********
		    gmissedcalls_start=startelement;
            gmissedcalls_elements=elements;
            gmissedcalls_mode=mode;
            gmissedcalls_shift=(mode&0x10)/0x10;
            gmissedcalls_direction=(mode&0x20)/0x20;
            //*************************************

			set_status_requestbuffer (requestarray, Offset, Bap_ByteSequence);			
		break;
		default:
			writelineEx(gError_Trace, 0, "missedcalls_Request: unknown request %d", request);
		break;
	}

}
/*@@end*/

/*@@caplFunc:MissedCalls_Indication(dword[],byte,int):*/
MissedCalls_Indication (dword Indication_array [], byte indication, int datalength)
{

int i, length, position; 
word startelement, leeloo, elements, datapointer, callstackline;
byte mode, direction, indexsize, transmitpos, shift, recordaddress, temp, restelems, startline, asg_id, taid;
char sday[3], smonth[3], syear[3], shour[3], smin[3], ssec[3];
byte bday, bmonth, byear, bhour, bmin, bsec;

//init lokal variables
	length=0;
	startelement=0;
	leeloo=0;
	position=0;
	elements=0;
	mode=0;
	direction=0;
	indexsize=0;
	transmitpos=0;
	shift=0;
	recordaddress=0;
	datapointer=0;
	callstackline=0;
    temp=0;
    startline=0;
    asg_id=0;
    taid=0;

	for(i=0;i<3;i++){
		sday[i]=0;
		smonth[i]=0;
		syear[i]=0;
		shour[i]=0;
		smin[i]=0;
		ssec[i]=0;
	}

	bday=0;
	bmonth=0;
	byear=0;
	bhour=0;
	bmin=0;
	bsec=0;
//********************
	
	
//	temp=checkdialedreceivedcallstackarray(Indication_array, datalength);
//	write("ASG checkarray: %d",temp);														//debug
	
	if(temp==0xff){																			//check array-datalength
		writelineEx(gError_Trace, 0, "ASG missedcalls_Indication: BAP-datalength-error");
	}
	else{
		switch(indication){
			case Changed_IND:
                mode=Indication_array [3];
            	indexsize=(mode & 0x80)/0x80;
            	transmitpos=(mode & 0x40)/0x40;
            	direction=(mode & 0x20)/0x20;
            	shift = (mode & 0x10)/0x10;
               	recordaddress=mode & 0x0f;

                //indexSize
            	if(indexsize){
            		startelement=Indication_array[4]+Indication_array[5]*0xFF;
            		elements=Indication_array[6]+Indication_array[7]*0xFF;
            		datapointer=8;
            	}
            	else{
	            	startelement=Indication_array[4];
	            	elements=Indication_array[5];
	            	datapointer=6;
            	}
                
                //write("ASG missedcalls_Indication: shift:%d, direction:%d, indexsize: %d, recordaddress: %d",shift, direction, indexsize, recordaddress);//debug
                /*          
                //*********Insert elements************************
                if(shift==1 && direction==0 && transmitpos==0 && elements!=0 && startelement<CALLSTACK)
                {   
                    gmissedcalls_insert_fullblocks=elements/5;
                    restelems=elements%5;
                    write("Bei %d elements braucht man %d Bloecke und %d weitere Elemente", elements, gmissedcalls_insert_fullblocks, restelems);
                    
                    callstack_missedcalls(INSERT_ID,startelement,elements);                    

                    if(gmissedcalls_insert_fullblocks==0)   //5 or less elements requested
                        MissedCalls_Request(DataGet_REQ, startelement, elements, 0x00, 0);    //get new elements
                    else
                    {
                        gmissedcalls_insert_active=TRUE;    //Activate Insertion
                        MissedCalls_Request(DataGet_REQ, startelement, 5, 0x00, 0);    //get 1. block
                        //other blocks are requested after MissedCalls.Status(first block) is received
                    }
                }
                
                //**********Delete elements************************
                else if(shift==1 && direction==1 && transmitpos==0 && elements!=0 && startelement<gmissedcalls_TotalNumListElements)
                {
                    if(startelement<(elements-1))                       //to much elements to delete
                    {
                        elements=startelement+1;                        //reduce elements to valid value
                        putvalue(env_FSG_MissedCalls_AH_elements,elements);
                    }
                                                                //normal operation: delete several elements
                    callstack_missedcalls(DELETE_ID,startelement,elements);    
                    display_callstack_missedcalls();
                }

                //*********Change elements************************
                else if(shift==0 && direction==0 && transmitpos==0 && elements!=0 && startelement<CALLSTACK)
                {
                    gmissedcalls_insert_fullblocks=elements/5;
                    restelems=elements%5;
                    write("Bei %d elements braucht man %d Bloecke und %d weitere Elemente", elements, gmissedcalls_insert_fullblocks, restelems);
                    
                    if(gmissedcalls_insert_fullblocks==0)   //5 or less elements requested
                        MissedCalls_Request(DataGet_REQ, startelement, elements, 0x00, 0);    //get new elements
                    else
                    {
                        gmissedcalls_insert_active=TRUE;    //Activate Insertion
                        MissedCalls_Request(DataGet_REQ, startelement, 5, 0x00, 0);    //get 1. block
                        //other blocks are requested after MissedCalls.Status(first block) is received
                    }
                }

                */
                //************Full range update*************************

                deletecallstackmissedcalls();               //erase current callstack
                if(gSlidingWindowMode==TRUE)
                {
                    gmissedcalls_FullRangeUpdate=1;            //Activate FullRangeUpdate

                    gSlW_DownloadVorhaltUp=FALSE;
    		        gSlW_DownloadVorhaltDown=TRUE;
	    	        gSlW_Download_status=WINDOW;
    
	    	        MissedCalls_Request(DataGet_REQ, SLW_FIRST_LIST_ELEMENT, SLW_WINDOW_CACHE, 0x01, 0);    //Get Window Cache
                }

			break;

			case Data_IND:
                asg_id=(Indication_array [3] & 0xF0)/0x10;
                taid=Indication_array [3] & 0x0F;
                gmissedcalls_TotalNumListElements=Indication_array [4];
                putvalue(env_ASG_MissedCalls_TNLE,gmissedcalls_TotalNumListElements);
                mode=Indication_array [5];
            	indexsize=(mode & 0x80)/0x80;
            	transmitpos=(mode & 0x40)/0x40;
            	direction=(mode & 0x20)/0x20;
            	shift = (mode & 0x10)/0x10;
               	recordaddress=mode & 0x0f;
                //write("ASG missedcalls_Indication: mode 0x%x = shift:%d, direction:%d, transmitpos:%d, indexsize: %d, recordaddress: %d", mode, shift, direction, transmitpos, indexsize, recordaddress);

            	//indexSize
            	if(indexsize){
            		startelement=Indication_array[6]+Indication_array[7]*0xFF;
            		elements=Indication_array[8]+Indication_array[9]*0xFF;
            		datapointer=10;
            	}
            	else{
	            	startelement=Indication_array[6];
	            	elements=Indication_array[7];
	            	datapointer=8;
            	}

                //******check validity of statusarray******
                //StatusArray generated by FSG  or  Answer to GetArray 
                if (asg_id==0 && taid==0)
                    write("ASG missedcalls_Indication: spontanous statusarray, no function!");
                else if(gmissedcalls_ASG_ID!=(asg_id&0x07) || gmissedcalls_TAID!=taid || gmissedcalls_start!=startelement || gmissedcalls_shift!=shift || gmissedcalls_direction!=direction)
                {
                    write("ASG missedcalls_Indication: invalid statusarray, retry!");
                    MissedCalls_Request(DataGet_REQ, gmissedcalls_start, gmissedcalls_elements, gmissedcalls_mode, 0);
                }    
                else    //indication is valid
                {   
                    gmissedcalls_TAID++;//increase TAID

                    if(gSlidingWindowMode==OFF)
                    {
                        if(direction==BACKWARD)
                            startline=SLW_FIRST_LIST_ELEMENT+(elements-1);
                        else
                            startline=SLW_FIRST_LIST_ELEMENT;
                    }
                    else
                    {
                        //**************search current callstackline of startelement*************
                        if(startelement !=0)      //startelement is not first element
                        {
                            for(i=0;i<SLW_ENTRIES;i++)
                            {
                                if(gSlidingWindow_pos[i] ==startelement)
                                {
                                    if(direction==FORWARD)
                                        startline =i+shift;
                                    else //direction==BACKWARD
                                    {
                                        if(i==0)    //first stack line
                                            startline=i;
                                        else    //not first stack line
                                            startline=i-shift;
                                    }
                                    //write("ASG missedcalls_Indication: startline of startelement '0x%x' incl. shift (%x) = %d",startelement,shift,startline);  //debug    
                                    i=SLW_ENTRIES;        //stop loop
                                }
                                else
                                    startline =0xff;    //invalid
                            }
                        }
                        else        //startelement is first element
                            startline =SLW_FIRST_WINDOW_ELEMENT;   //start in first line of window cache

                        if(startline==0xff) //invalid element
                        {
                            write("ASG missedcalls_Indication: invalid startline, break up!");
                            break;          //break up indication
                        }
                    }
                    //****************************************************************************
				    switch(recordaddress){
					    case 0:             //complete record
    					//	deletecallstackmissedcalls();										//missedcalls-array löschen
    
                            position=startline;

                            if(direction==FORWARD)
                            {
                                while(position<(startline+elements))
                                {
                                    //write("ASG missedcalls_Indication: position %d", position);  //debug
                                    //TransmitPos
            	                    if(transmitpos==1)
                                    {
            		                    if(indexsize)
                                        {
                			                gmissedcalls_pos[position]=Indication_array[datapointer]+Indication_array[datapointer+1]*0xFF;
	                		            datapointer=datapointer+2;
	                	                }
	                	                else
                                        {
	            		                    gmissedcalls_pos[position]=Indication_array[datapointer];
	            		                    datapointer++;
	            	                    }
            	                    }
                            
							        //PbName
							        length=Indication_array[datapointer];
                                    datapointer++;
								
								    for(i=0;i<CALL_INFO_NAME_LENGTH;i++)												//delete old name
								    	gmissedcalls_pbname[position][i]=0;
								    if(length==1 && Indication_array[datapointer]==0x00){
								    	strncpy(gmissedcalls_pbname[position], "unknown", CALL_INFO_NAME_LENGTH);
								    }
								    else{
									    for(i=0;i<length;i++)										//save new name
										    gmissedcalls_pbname[position][i]=Indication_array[datapointer+i];
								    }
								    datapointer=datapointer+length;

								    //NumberType
								    if(Indication_array[datapointer]<0x0F)								//known numbertype
								    	gmissedcalls_numbertype[position]=Indication_array[datapointer];
								    else															//unknown numbertype
								    	gmissedcalls_numbertype[position]=0;
							
								    datapointer++;

								    //TelNumber
								    length=Indication_array[datapointer];
								    datapointer++;
								    for(i=0;i<CALL_INFO_NUMBER_LENGTH;i++)												//delete old number
								    	gmissedcalls_telnumber[position][i]=0;
								    for(i=0;i<length;i++)										//save new number
								    	gmissedcalls_telnumber[position][i]=Indication_array[datapointer+i];
								    datapointer=datapointer+length;
							
								    //Date
								    bday=Indication_array[datapointer];
								    datapointer++;
								    bmonth=Indication_array[datapointer];
								    datapointer++;
								    byear=Indication_array[datapointer];
								    datapointer++;
								    ltoa(bday, sday, 10);
								    ltoa(bmonth, smonth, 10);
								    ltoa(byear, syear, 10);
								    if(bday<1 || bday>31)                 //value not valid or date/time info not provided by FSG
                                        bday=0xff;
								    else if(bday<10){
								    	gmissedcalls_date[position][0]='0';
								    	gmissedcalls_date[position][1]=sday[0];
								    }
								    else{
								    	gmissedcalls_date[position][0]=sday[0];
								    	gmissedcalls_date[position][1]=sday[1];
								    }
								    if(bmonth<1 || bmonth>12)                      //value not valid
								    	bday=0xff;
								    else if(bmonth<10){
								    	gmissedcalls_date[position][2]='0';
								    	gmissedcalls_date[position][3]=smonth[0];
								    }
								    else{
								    	gmissedcalls_date[position][2]=smonth[0];
								    	gmissedcalls_date[position][3]=smonth[1];
							    	}
								    if(byear>99)                                    //value not valid
								    	bday=0xff;
								    else if(byear<10){
								    	gmissedcalls_date[position][4]='0';
								    	gmissedcalls_date[position][5]=syear[0];
								    }
								    else{
								    	gmissedcalls_date[position][4]=syear[0];
								    	gmissedcalls_date[position][5]=syear[1];					
								    }
					
								    //Time
								    bhour=Indication_array[datapointer];
								    datapointer++;
								    bmin=Indication_array[datapointer];
								    datapointer++;
								    bsec=Indication_array[datapointer];
								    datapointer++;
								    ltoa(bhour, shour, 10);
								    ltoa(bmin, smin, 10);
								    ltoa(bsec, ssec, 10);
								    if(bhour>23)                                //value not valid
								    	bday=0xff;
								    else if(bhour<10){
								    	gmissedcalls_time[position][0]='0';
								    	gmissedcalls_time[position][1]=shour[0];
								    }
								    else{
								    	gmissedcalls_time[position][0]=shour[0];
								    	gmissedcalls_time[position][1]=shour[1];
								    }
								    if(bmin>59)                                 //value not valid									
                                        bday=0xff;
								    else if(bmin<10){
							    		gmissedcalls_time[position][2]='0';
								    	gmissedcalls_time[position][3]=smin[0];
								    }
								    else{
								    	gmissedcalls_time[position][2]=smin[0];
								    	gmissedcalls_time[position][3]=smin[1];
								    }
								    if(bsec>59)                                 //value not valid									
                                        bday=0xff;
								    else if(bsec<10){
								    	gmissedcalls_time[position][4]='0';
								    	gmissedcalls_time[position][5]=ssec[0];
								    }
								    else{
								    	gmissedcalls_time[position][4]=ssec[0];
								    	gmissedcalls_time[position][5]=ssec[1];
								    }

                                    if(bday==0xff)                      //value not valid or date/time info not provided by FSG
    								{
    									gmissedcalls_date[position][0]=0;
    									gmissedcalls_date[position][1]=0;
                                        gmissedcalls_date[position][2]=0;
    									gmissedcalls_date[position][3]=0;
                                        gmissedcalls_date[position][4]=0;
                                        gmissedcalls_date[position][5]=0;
							
                                        gmissedcalls_time[position][0]=0;
    									gmissedcalls_time[position][1]=0;
                                        gmissedcalls_time[position][2]=0;
    									gmissedcalls_time[position][3]=0;
                                        gmissedcalls_time[position][4]=0;
    									gmissedcalls_time[position][5]=0;
                                    }
								    
                                    //**********Sliding Window**************
                                    if(gSlidingWindowMode==TRUE)
                                    {
                                        gDetail_pos=gmissedcalls_pos[position];
                                        strncpy(gDetail_pbname,gmissedcalls_pbname[position],CALL_INFO_NAME_LENGTH);
                                        gDetail_numbertype=gmissedcalls_numbertype[position];
                                        strncpy(gDetail_telnumber,gmissedcalls_telnumber[position],CALL_INFO_NUMBER_LENGTH);
                                        strncpy(gDetail_date,gmissedcalls_date[position],7);
                                        strncpy(gDetail_time,gmissedcalls_time[position],7);
                                    }
                                    //***************************************
                            
                                    position=position+1;//next line in stack
						        }
                            }
                            else if(direction==BACKWARD && elements>0)
                            {
                                while(position>(startline-elements))
                                {
                                    //write("ASG missedcalls_Indication: position %d", position);  //debug
                                    //TransmitPos
            	                    if(transmitpos==1)
                                    {
            		                    if(indexsize)
                                        {
                			                gmissedcalls_pos[position]=Indication_array[datapointer]+Indication_array[datapointer+1]*0xFF;
	                		            datapointer=datapointer+2;
	                	                }
	                	                else
                                        {
	            		                    gmissedcalls_pos[position]=Indication_array[datapointer];
	            		                    datapointer++;
	            	                    }
            	                    }
                            
							        //PbName
							        length=Indication_array[datapointer];
                                    datapointer++;
								
								    for(i=0;i<CALL_INFO_NAME_LENGTH;i++)												//delete old name
								    	gmissedcalls_pbname[position][i]=0;
								    if(length==1 && Indication_array[datapointer]==0x00){
								    	strncpy(gmissedcalls_pbname[position], "unknown", CALL_INFO_NAME_LENGTH);
								    }
								    else{
									    for(i=0;i<length;i++)										//save new name
										    gmissedcalls_pbname[position][i]=Indication_array[datapointer+i];
								    }
								    datapointer=datapointer+length;

								    //NumberType
								    if(Indication_array[datapointer]<0x0F)								//known numbertype
								    	gmissedcalls_numbertype[position]=Indication_array[datapointer];
								    else															//unknown numbertype
								    	gmissedcalls_numbertype[position]=0;
							
								    datapointer++;

								    //TelNumber
								    length=Indication_array[datapointer];
								    datapointer++;
								    for(i=0;i<CALL_INFO_NUMBER_LENGTH;i++)												//delete old number
								    	gmissedcalls_telnumber[position][i]=0;
								    for(i=0;i<length;i++)										//save new number
								    	gmissedcalls_telnumber[position][i]=Indication_array[datapointer+i];
								    datapointer=datapointer+length;
							
								    //Date
								    bday=Indication_array[datapointer];
								    datapointer++;
								    bmonth=Indication_array[datapointer];
								    datapointer++;
								    byear=Indication_array[datapointer];
								    datapointer++;
								    ltoa(bday, sday, 10);
								    ltoa(bmonth, smonth, 10);
								    ltoa(byear, syear, 10);
								    if(bday<1 || bday>31)                 //value not valid or date/time info not provided by FSG
                                        bday=0xff;
								    else if(bday<10){
								    	gmissedcalls_date[position][0]='0';
								    	gmissedcalls_date[position][1]=sday[0];
								    }
								    else{
								    	gmissedcalls_date[position][0]=sday[0];
								    	gmissedcalls_date[position][1]=sday[1];
								    }
								    if(bmonth<1 || bmonth>12)                      //value not valid
								    	bday=0xff;
								    else if(bmonth<10){
								    	gmissedcalls_date[position][2]='0';
								    	gmissedcalls_date[position][3]=smonth[0];
								    }
								    else{
								    	gmissedcalls_date[position][2]=smonth[0];
								    	gmissedcalls_date[position][3]=smonth[1];
							    	}
								    if(byear>99)                                    //value not valid
								    	bday=0xff;
								    else if(byear<10){
								    	gmissedcalls_date[position][4]='0';
								    	gmissedcalls_date[position][5]=syear[0];
								    }
								    else{
								    	gmissedcalls_date[position][4]=syear[0];
								    	gmissedcalls_date[position][5]=syear[1];					
								    }
					
								    //Time
								    bhour=Indication_array[datapointer];
								    datapointer++;
								    bmin=Indication_array[datapointer];
								    datapointer++;
								    bsec=Indication_array[datapointer];
								    datapointer++;
								    ltoa(bhour, shour, 10);
								    ltoa(bmin, smin, 10);
								    ltoa(bsec, ssec, 10);
								    if(bhour>23)                                //value not valid
								    	bday=0xff;
								    else if(bhour<10){
								    	gmissedcalls_time[position][0]='0';
								    	gmissedcalls_time[position][1]=shour[0];
								    }
								    else{
								    	gmissedcalls_time[position][0]=shour[0];
								    	gmissedcalls_time[position][1]=shour[1];
								    }
								    if(bmin>59)                                 //value not valid									
                                        bday=0xff;
								    else if(bmin<10){
							    		gmissedcalls_time[position][2]='0';
								    	gmissedcalls_time[position][3]=smin[0];
								    }
								    else{
								    	gmissedcalls_time[position][2]=smin[0];
								    	gmissedcalls_time[position][3]=smin[1];
								    }
								    if(bsec>59)                                 //value not valid									
                                        bday=0xff;
								    else if(bsec<10){
								    	gmissedcalls_time[position][4]='0';
								    	gmissedcalls_time[position][5]=ssec[0];
								    }
								    else{
								    	gmissedcalls_time[position][4]=ssec[0];
								    	gmissedcalls_time[position][5]=ssec[1];
								    }

                                    if(bday==0xff)                      //value not valid or date/time info not provided by FSG
    								{
    									gmissedcalls_date[position][0]=0;
    									gmissedcalls_date[position][1]=0;
                                        gmissedcalls_date[position][2]=0;
    									gmissedcalls_date[position][3]=0;
                                        gmissedcalls_date[position][4]=0;
                                        gmissedcalls_date[position][5]=0;
							
                                        gmissedcalls_time[position][0]=0;
    									gmissedcalls_time[position][1]=0;
                                        gmissedcalls_time[position][2]=0;
    									gmissedcalls_time[position][3]=0;
                                        gmissedcalls_time[position][4]=0;
    									gmissedcalls_time[position][5]=0;
                                    }
								    
                                    //**********Sliding Window**************
                                    if(gSlidingWindowMode==TRUE)
                                    {
                                        gDetail_pos=gmissedcalls_pos[position];
                                        strncpy(gDetail_pbname,gmissedcalls_pbname[position],CALL_INFO_NAME_LENGTH);
                                        gDetail_numbertype=gmissedcalls_numbertype[position];
                                        strncpy(gDetail_telnumber,gmissedcalls_telnumber[position],CALL_INFO_NUMBER_LENGTH);
                                        strncpy(gDetail_date,gmissedcalls_date[position],7);
                                        strncpy(gDetail_time,gmissedcalls_time[position],7);
                                    }
                                    //***************************************
                            
                                    position=position-1;//next line in stack
						        }
                            }

						    display_SlW_Detail();
                                      
					    break;
					    case 1:	//PbName an NumberType only
					        //	deletecallstackmissedcalls();	//missedcalls-array löschen

						    position=startline;
						
                            if(direction==FORWARD)
                            {
                                while(position<(startline+elements))
                                {//
                                    //write("ASG missedcalls_Indication: position %d", position);  //debug
							        //TransmitPos
            	                    if(transmitpos==1)
                                    {
                		                if(indexsize)
                                        {
                			                gmissedcalls_pos[position]=Indication_array[datapointer]+Indication_array[datapointer+1]*0xFF;
	                		                datapointer=datapointer+2;
	            	                    }
	            	                    else
                                        {
	            		                    gmissedcalls_pos[position]=Indication_array[datapointer];
	            		                    datapointer++;
	            	                    }
            	                    }

                                    //PbName
							        length=Indication_array[datapointer];
								    datapointer++;
								    for(i=0;i<CALL_INFO_NAME_LENGTH;i++)							//delete old name
									    gmissedcalls_pbname[position][i]=0;
								    if(length==1 && Indication_array[datapointer]==0x00){
									    strncpy(gmissedcalls_pbname[position], "unknown", CALL_INFO_NAME_LENGTH);
								    }
								    else{
									    for(i=0;i<length;i++)										//save new name
										    gmissedcalls_pbname[position][i]=Indication_array[datapointer+i];
								    }
								    datapointer=datapointer+length;

								    //NumberType
								    if(Indication_array[datapointer]<0x0F)								//known numbertype
								    	gmissedcalls_numbertype[position]=Indication_array[datapointer];
								    else															//unknown numbertype
								    	gmissedcalls_numbertype[position]=0;

                                    //**********Sliding Window**************
                                    if(gSlidingWindowMode==TRUE)
                                    {        
                                        //write("gSlidingWindowMode 0x%x, gSlW_Download_status 0x%x",gSlidingWindowMode,gSlW_Download_status);
                                        strncpy(gSlidingWindow_pbname[position],gmissedcalls_pbname[position],CALL_INFO_NAME_LENGTH);
                                        gSlidingWindow_pos[position]=gmissedcalls_pos[position];
                                        gSlidingWindow_numbertype[position]=gmissedcalls_numbertype[position];

                                        if(gSlW_Download_status==VORHALT_UP)
                                        {
                                            gVorhaltUpStatus++;
                                            putvalue(env_ASG_SlidingWindow_Vorhalt_v,gVorhaltUpStatus);
                                        }
                                        else if(gSlW_Download_status==VORHALT_DOWN)
                                        {
                                            gVorhaltDownStatus++;
                                            putvalue(env_ASG_SlidingWindow_Vorhalt_n,gVorhaltDownStatus);
                                        }
                                    }
                                    //**************************************    

                                    datapointer++;
                                    //next line in stack
                                    position=position+1;    //if direction=0 (forward), position = position + 1
					    	    }
                            }
                            else if(direction==BACKWARD && elements>0)
                            {
                                while(position>(startline-elements))
                                {
                                    //write("ASG MissedCalls_Indication: Position = %d", position);//debug
							        //TransmitPos
            	                    if(transmitpos==1)
                                    {
                		                if(indexsize)
                                        {
                			                gmissedcalls_pos[position]=Indication_array[datapointer]+Indication_array[datapointer+1]*0xFF;
	                		                datapointer=datapointer+2;
	            	                    }
	            	                    else
                                        {
	            		                    gmissedcalls_pos[position]=Indication_array[datapointer];
	            		                    datapointer++;
	            	                    }
            	                    }

                                    //PbName
							        length=Indication_array[datapointer];
								    datapointer++;
								    for(i=0;i<CALL_INFO_NAME_LENGTH;i++)							//delete old name
								    	gmissedcalls_pbname[position][i]=0;
								    if(length==1 && Indication_array[datapointer]==0x00){
								    	strncpy(gmissedcalls_pbname[position], "unknown", CALL_INFO_NAME_LENGTH);
								    }
								    else{
									    for(i=0;i<length;i++)										//save new name
										    gmissedcalls_pbname[position][i]=Indication_array[datapointer+i];
								    }
								    datapointer=datapointer+length;

								    //NumberType
								    if(Indication_array[datapointer]<0x0F)								//known numbertype
								    	gmissedcalls_numbertype[position]=Indication_array[datapointer];
								    else															//unknown numbertype
								    	gmissedcalls_numbertype[position]=0;
    
                                    //**********Sliding Window**************
                                    if(gSlidingWindowMode==TRUE)
                                    {        
                                        //write("gSlidingWindowMode 0x%x, gSlW_Download_status 0x%x",gSlidingWindowMode,gSlW_Download_status);
                                        strncpy(gSlidingWindow_pbname[position],gmissedcalls_pbname[position],CALL_INFO_NAME_LENGTH);
                                        gSlidingWindow_pos[position]=gmissedcalls_pos[position];
                                        gSlidingWindow_numbertype[position]=gmissedcalls_numbertype[position];

                                        if(gSlW_Download_status==VORHALT_UP)
                                        {
                                            gVorhaltUpStatus++;
                                            putvalue(env_ASG_SlidingWindow_Vorhalt_v,gVorhaltUpStatus);
                                        }
                                        else if(gSlW_Download_status==VORHALT_DOWN)
                                        {
                                            gVorhaltDownStatus++;
                                            putvalue(env_ASG_SlidingWindow_Vorhalt_n,gVorhaltDownStatus);
                                        }
                                    }
                                    //**************************************

                                    datapointer++;
                                    //next line in stack
                                    position=position-1;    //if direction=1 (backward), position = position - 1
					    	    }
                            }

                        
                            //**********Sliding Window**************
                            if(gSlidingWindowMode==TRUE)
                            {   //write("indication gSlW_Download_status %d, gKeyPressCode %d", gSlW_Download_status, gKeyPressCode); //debug
                                //***********normal caching***************
                                if(gSlW_DownloadVorhaltDown)// && gSlW_Download_status==WINDOW)
                                {
                                    //write("Get Lower Cache");
                                    gSlW_Download_status=VORHALT_DOWN;
                                    gSlW_DownloadVorhaltDown=FALSE;
                                    if(gmissedcalls_FullRangeUpdate!=FALSE) //Full range update is active
                                        gSlW_DownloadVorhaltUp=TRUE;
                                    startelement=(gSlidingWindow_pos[SLW_LAST_WINDOW_ELEMENT]);//last known element in Window-Cache 
                                                                                //direction=0;shift=1;recordaddress=1;
			                        MissedCalls_Request(DataGet_REQ,startelement, SLW_LOWER_CACHE, 0x11, 0);
                                }
                                else if(gSlW_DownloadVorhaltUp)// && gSlW_Download_status==VORHALT_DOWN)
                                {
                                    //write("Get Uppper Cache");
                                    gSlW_Download_status=VORHALT_UP;
                                    gSlW_DownloadVorhaltUp=FALSE;
                                    startelement=(gSlidingWindow_pos[SLW_FIRST_WINDOW_ELEMENT]);//first known element in Window-Cache
                                    //direction=1;shift=1;recordaddress=1;
			                        MissedCalls_Request(DataGet_REQ,startelement, SLW_UPPER_CACHE, 0x31, 0);
                                }
                                else// if(gSlW_Download_status==VORHALT_UP)
                                {
                                    //write("End of Caching");
                                    gSlW_Download_status=NO_SLW_DOWNLOAD;
                                    gmissedcalls_FullRangeUpdate=FALSE;
                                }
                                //else
                                //  gSlW_Download_status=NO_SLW_DOWNLOAD;
                                display_SlW_Window();
                            }

					    break;
					    case 2:	//TelNumber, Date and Time only
					    //	deletecallstackmissedcalls();										//missedcalls-array löschen

						    position=startline;

                            if(direction==FORWARD)
                            {						
                                while(position<(startline+elements))
                                {
    							    //TransmitPos
                	                if(transmitpos==1)
                                    {
                		                if(indexsize)
                                        {
                			                gmissedcalls_pos[position]=Indication_array[datapointer]+Indication_array[datapointer+1]*0xFF;
    	            		                datapointer=datapointer+2;
    	            	                }
    	            	                else
                                        {
    	            		                gmissedcalls_pos[position]=Indication_array[datapointer];
    	            		                datapointer++;
    	            	                }
                	                }   
                            
                                    //TelNumber
    							    length=Indication_array[datapointer];
    							    datapointer++;
    							    for(i=0;i<CALL_INFO_NUMBER_LENGTH;i++)												//delete old number
    								    gmissedcalls_telnumber[position][i]=0;
    							    for(i=0;i<length;i++)										//save new number
    								    gmissedcalls_telnumber[position][i]=Indication_array[datapointer+i];
    							    datapointer=datapointer+length;

    							    //Date
    								bday=Indication_array[datapointer];
    								datapointer++;
    								bmonth=Indication_array[datapointer];
    								datapointer++;
    								byear=Indication_array[datapointer];
    								datapointer++;
    								ltoa(bday, sday, 10);
    								ltoa(bmonth, smonth, 10);
    								ltoa(byear, syear, 10);
    								if(bday<1 || bday>31)                 //value not valid or date/time info not provided by FSG
    								{
                                        bday=0xff;
    								}
    								else if(bday<10){
    									gmissedcalls_date[position][0]='0';
    									gmissedcalls_date[position][1]=sday[0];
    								}
    								else{
    									gmissedcalls_date[position][0]=sday[0];
    									gmissedcalls_date[position][1]=sday[1];
    								}
    								if(bmonth<1 || bmonth>12)                      //value not valid
    								{
    									bday=0xff;
    								}
    								else if(bmonth<10){
    									gmissedcalls_date[position][2]='0';
    									gmissedcalls_date[position][3]=smonth[0];
    								}
    								else{
    									gmissedcalls_date[position][2]=smonth[0];
    									gmissedcalls_date[position][3]=smonth[1];
    								}
    								if(byear>99)                                    //value not valid
    								{
    									bday=0xff;
    								}
    								else if(byear<10){
    									gmissedcalls_date[position][4]='0';
    									gmissedcalls_date[position][5]=syear[0];
    								}
    								else{
    									gmissedcalls_date[position][4]=syear[0];
    									gmissedcalls_date[position][5]=syear[1];					
    								}
					
    								//Time
    								bhour=Indication_array[datapointer];
    								datapointer++;
    								bmin=Indication_array[datapointer];
    								datapointer++;
    								bsec=Indication_array[datapointer];
    								datapointer++;
    								ltoa(bhour, shour, 10);
    								ltoa(bmin, smin, 10);
    								ltoa(bsec, ssec, 10);
    								if(bhour>23)                                //value not valid
    								{
    									bday=0xff;
    								}
    								else if(bhour<10){
    									gmissedcalls_time[position][0]='0';
    									gmissedcalls_time[position][1]=shour[0];
    								}
    								else{
    									gmissedcalls_time[position][0]=shour[0];
    									gmissedcalls_time[position][1]=shour[1];
    								}
    								if(bmin>59)                                 //value not valid
    								{									
                                        bday=0xff;
    								}
    								else if(bmin<10){
    									gmissedcalls_time[position][2]='0';
    									gmissedcalls_time[position][3]=smin[0];
    								}
    								else{
    									gmissedcalls_time[position][2]=smin[0];
    									gmissedcalls_time[position][3]=smin[1];
    								}
    								if(bsec>59)                                 //value not valid
    								{									
                                        bday=0xff;
    								}
    								else if(bsec<10){
    									gmissedcalls_time[position][4]='0';
    									gmissedcalls_time[position][5]=ssec[0];
    								}
    								else{
    									gmissedcalls_time[position][4]=ssec[0];
    									gmissedcalls_time[position][5]=ssec[1];
    								}

                                    if(bday==0xff)                      //value not valid or date/time info not provided by FSG
    								{
    									gmissedcalls_date[position][0]=0;
    									gmissedcalls_date[position][1]=0;
                                        gmissedcalls_date[position][2]=0;
    									gmissedcalls_date[position][3]=0;
                                        gmissedcalls_date[position][4]=0;
                                        gmissedcalls_date[position][5]=0;
							
                                        gmissedcalls_time[position][0]=0;
    									gmissedcalls_time[position][1]=0;
                                        gmissedcalls_time[position][2]=0;
    									gmissedcalls_time[position][3]=0;
                                        gmissedcalls_time[position][4]=0;
    									gmissedcalls_time[position][5]=0;
                                    }
                                    position=position+1;//next line in stack
    						    }
                            }
                            else if(direction==BACKWARD && elements>0)
                            {
                                while(position>(startline-elements))
                                {
    							    //TransmitPos
                	                if(transmitpos==1)
                                    {
                		                if(indexsize)
                                        {
                			                gmissedcalls_pos[position]=Indication_array[datapointer]+Indication_array[datapointer+1]*0xFF;
    	            		                datapointer=datapointer+2;
    	            	                }
    	            	                else
                                        {
    	            		                gmissedcalls_pos[position]=Indication_array[datapointer];
    	            		                datapointer++;
    	            	                }
                	                }   
                            
                                    //TelNumber
    							    length=Indication_array[datapointer];
    							    datapointer++;
    							    for(i=0;i<CALL_INFO_NUMBER_LENGTH;i++)												//delete old number
    								    gmissedcalls_telnumber[position][i]=0;
    							    for(i=0;i<length;i++)										//save new number
    								    gmissedcalls_telnumber[position][i]=Indication_array[datapointer+i];
    							    datapointer=datapointer+length;

    							    //Date
    								bday=Indication_array[datapointer];
    								datapointer++;
    								bmonth=Indication_array[datapointer];
    								datapointer++;
    								byear=Indication_array[datapointer];
    								datapointer++;
    								ltoa(bday, sday, 10);
    								ltoa(bmonth, smonth, 10);
    								ltoa(byear, syear, 10);
    								if(bday<1 || bday>31)                 //value not valid or date/time info not provided by FSG
    								{
                                        bday=0xff;
    								}
    								else if(bday<10){
    									gmissedcalls_date[position][0]='0';
    									gmissedcalls_date[position][1]=sday[0];
    								}
    								else{
    									gmissedcalls_date[position][0]=sday[0];
    									gmissedcalls_date[position][1]=sday[1];
    								}
    								if(bmonth<1 || bmonth>12)                      //value not valid
    								{
    									bday=0xff;
    								}
    								else if(bmonth<10){
    									gmissedcalls_date[position][2]='0';
    									gmissedcalls_date[position][3]=smonth[0];
    								}
    								else{
    									gmissedcalls_date[position][2]=smonth[0];
    									gmissedcalls_date[position][3]=smonth[1];
    								}
    								if(byear>99)                                    //value not valid
    								{
    									bday=0xff;
    								}
    								else if(byear<10){
    									gmissedcalls_date[position][4]='0';
    									gmissedcalls_date[position][5]=syear[0];
    								}
    								else{
    									gmissedcalls_date[position][4]=syear[0];
    									gmissedcalls_date[position][5]=syear[1];					
    								}
					
    								//Time
    								bhour=Indication_array[datapointer];
    								datapointer++;
    								bmin=Indication_array[datapointer];
    								datapointer++;
    								bsec=Indication_array[datapointer];
    								datapointer++;
    								ltoa(bhour, shour, 10);
    								ltoa(bmin, smin, 10);
    								ltoa(bsec, ssec, 10);
    								if(bhour>23)                                //value not valid
    								{
    									bday=0xff;
    								}
    								else if(bhour<10){
    									gmissedcalls_time[position][0]='0';
    									gmissedcalls_time[position][1]=shour[0];
    								}
    								else{
    									gmissedcalls_time[position][0]=shour[0];
    									gmissedcalls_time[position][1]=shour[1];
    								}
    								if(bmin>59)                                 //value not valid
    								{									
                                        bday=0xff;
    								}
    								else if(bmin<10){
    									gmissedcalls_time[position][2]='0';
    									gmissedcalls_time[position][3]=smin[0];
    								}
    								else{
    									gmissedcalls_time[position][2]=smin[0];
    									gmissedcalls_time[position][3]=smin[1];
    								}
    								if(bsec>59)                                 //value not valid
    								{									
                                        bday=0xff;
    								}
    								else if(bsec<10){
    									gmissedcalls_time[position][4]='0';
    									gmissedcalls_time[position][5]=ssec[0];
    								}
    								else{
    									gmissedcalls_time[position][4]=ssec[0];
    									gmissedcalls_time[position][5]=ssec[1];
    								}

                                    if(bday==0xff)                      //value not valid or date/time info not provided by FSG
    								{
    									gmissedcalls_date[position][0]=0;
    									gmissedcalls_date[position][1]=0;
                                        gmissedcalls_date[position][2]=0;
    									gmissedcalls_date[position][3]=0;
                                        gmissedcalls_date[position][4]=0;
                                        gmissedcalls_date[position][5]=0;
							
                                        gmissedcalls_time[position][0]=0;
    									gmissedcalls_time[position][1]=0;
                                        gmissedcalls_time[position][2]=0;
    									gmissedcalls_time[position][3]=0;
                                        gmissedcalls_time[position][4]=0;
    									gmissedcalls_time[position][5]=0;
                                    }
                                    position=position-1;//next line in stack
                                }
						    }

					    break;
                        case 15:	//Pos only
					    //	deletecallstackmissedcalls();										//missedcalls-array löschen

						    position=startline;

                            if(direction==FORWARD)
						    {
                                while(position<(startline+elements))
                                {
    							    //TransmitPos
                	                if(transmitpos==1)
                                    {
                		                if(indexsize)
                                        {
                			                gmissedcalls_pos[position]=Indication_array[datapointer]+Indication_array[datapointer+1]*0xFF;
    	            		                datapointer=datapointer+2;
    	            	                }
    	            	                else
                                        {
    	            		                gmissedcalls_pos[position]=Indication_array[datapointer];
    	            		                datapointer++;
    	            	                }
                	                }
                                    position=position+1;//next line in stack
    						    }
                            }
                            else if(direction==BACKWARD && elements>0)
                            {
                                while(position>(startline-elements))
                                {
    							    //TransmitPos
                	                if(transmitpos==1)
                                    {
                		                if(indexsize)
                                        {
                			                gmissedcalls_pos[position]=Indication_array[datapointer]+Indication_array[datapointer+1]*0xFF;
    	            		                datapointer=datapointer+2;
    	            	                }
    	            	                else
                                        {
    	            		                gmissedcalls_pos[position]=Indication_array[datapointer];
    	            		                datapointer++;
    	            	                }
                	                }
                                    position=position-1;//next line in stack
    						    }
                            }
                            
					    break;
					    default:
						    writelineEx(gError_Trace, 0, "ASG missedcalls_Indication: invalid recoraddress: %d ", recordaddress);
					    break;
				    }
                    //for all RecordAddresses
                    display_callstack_missedcalls();
                }
			break;
			case Error_IND:
				writelineEx(gError_Trace, 0, "ASG missedcalls_Indication: recieved error, errorcode:0x%x", Indication_array[3]);
			break;
			default:
				writelineEx(gError_Trace, 0, "ASG missedcalls_Indication: unknown indication %d", indication);
			break;
		}
	}

}
/*@@end*/

/*@@caplFunc:deletecallstackmissedcalls():*/
deletecallstackmissedcalls ()
{
int i, j;

	for(j=0;j<SLW_ENTRIES;j++){
        gmissedcalls_pos[j]=0;
		for(i=0;i<CALL_INFO_NAME_LENGTH;i++)
			gmissedcalls_pbname[j][i]=0;
        gmissedcalls_numbertype[j]=0;									//delete NumberType									//delete PbName
		for(i=0;i<CALL_INFO_NUMBER_LENGTH;i++)
			gmissedcalls_telnumber[j][i]=0;									//delete TelNumber
		for(i=0;i<7;i++){
			gmissedcalls_date[j][i]=0;										//delete Date
			gmissedcalls_time[j][i]=0;										//delete Time
		}
		
		
	}
}
/*@@end*/

/*@@caplFunc:display_callstack_missedcalls():*/
display_callstack_missedcalls ()
{
int callstackline, i;
char dialdate[CALLSTACK][9];
char dialtime[CALLSTACK][9];
char numbertype[CALLSTACK][10];

char empty_string[3];
//********************

    int slw_first_window_element=SLW_FIRST_WINDOW_ELEMENT;//to prevent invalid array ranges
    int slw_last_window_element=SLW_LAST_WINDOW_ELEMENT;	
//init lokal variables
	for(i=0;i<3;i++)
		empty_string[i]=0;


    //************Sliding Window*************
    if(gSlidingWindowMode==_ON && SLW_WINDOW_CACHE>0)
    {
        putvalue(env_RNS_missedcall4_PbName, gSlidingWindow_pbname[slw_first_window_element-1]);    //Upper Cache        
        putvalue(env_RNS_missedcall5_PbName, gSlidingWindow_pbname[slw_first_window_element]);      //Window Cache
        putvalue(env_RNS_missedcall10_PbName, gSlidingWindow_pbname[slw_last_window_element+1]);    //Lower Cache
    
        if(SLW_WINDOW_CACHE>1)
        {
            putvalue(env_RNS_missedcall3_PbName, gSlidingWindow_pbname[slw_first_window_element-2]);    //Upper Cache        
            putvalue(env_RNS_missedcall6_PbName, gSlidingWindow_pbname[slw_first_window_element+1]);      //Window Cache
            putvalue(env_RNS_missedcall11_PbName, gSlidingWindow_pbname[slw_last_window_element+2]);    //Lower Cache
    
            if(SLW_WINDOW_CACHE>2)
            {
                putvalue(env_RNS_missedcall2_PbName, gSlidingWindow_pbname[slw_first_window_element-3]);    //Upper Cache        
                putvalue(env_RNS_missedcall7_PbName, gSlidingWindow_pbname[slw_first_window_element+2]);      //Window Cache
                putvalue(env_RNS_missedcall12_PbName, gSlidingWindow_pbname[slw_last_window_element+3]);    //Lower Cache
    
                if(SLW_WINDOW_CACHE>3)
                {
                    putvalue(env_RNS_missedcall1_PbName, gSlidingWindow_pbname[slw_first_window_element-4]);    //Upper Cache        
                    putvalue(env_RNS_missedcall8_PbName, gSlidingWindow_pbname[slw_first_window_element+3]);      //Window Cache
                    putvalue(env_RNS_missedcall13_PbName, gSlidingWindow_pbname[slw_last_window_element+4]);    //Lower Cache
    
                    if(SLW_WINDOW_CACHE>4)
                    {
                        putvalue(env_RNS_missedcall0_PbName, gSlidingWindow_pbname[slw_first_window_element-5]);    //Upper Cache        
                        putvalue(env_RNS_missedcall9_PbName, gSlidingWindow_pbname[slw_first_window_element+4]);      //Window Cache
                        putvalue(env_RNS_missedcall14_PbName, gSlidingWindow_pbname[slw_last_window_element+5]);    //Lower Cache
                    }
                }
            }
        }
    }
    //***************************************

    //*********Sliding Window not active*****
    else
    {
        //Pos
    	putvalue(env_RNS_missedcall5_Pos, gmissedcalls_pos [0]);
    	putvalue(env_RNS_missedcall6_Pos, gmissedcalls_pos [1]);
    	putvalue(env_RNS_missedcall7_Pos, gmissedcalls_pos [2]);
    	putvalue(env_RNS_missedcall8_Pos, gmissedcalls_pos [3]);
    	putvalue(env_RNS_missedcall9_Pos, gmissedcalls_pos [4]);

    	//PbName
    	putvalue(env_RNS_missedcall5_PbName, gmissedcalls_pbname [0]);
    	putvalue(env_RNS_missedcall6_PbName, gmissedcalls_pbname [1]);
    	putvalue(env_RNS_missedcall7_PbName, gmissedcalls_pbname [2]);
    	putvalue(env_RNS_missedcall8_PbName, gmissedcalls_pbname [3]);
    	putvalue(env_RNS_missedcall9_PbName, gmissedcalls_pbname [4]);
    
        //numbertype
    	for(i=0;i<SLW_ENTRIES;i++){
    		if(gmissedcalls_numbertype[i]<0x0F)
    			strncpy(numbertype[i], gnumbertype[gmissedcalls_numbertype[i]], 15);
    		else
    			strncpy(numbertype[i], empty_string, 15);
    	}
    	putvalue(env_RNS_missedcall5_numbertype, numbertype [0]);
    	putvalue(env_RNS_missedcall6_numbertype, numbertype [1]);
    	putvalue(env_RNS_missedcall7_numbertype, numbertype [2]);
    	putvalue(env_RNS_missedcall8_numbertype, numbertype [3]);
    	putvalue(env_RNS_missedcall9_numbertype, numbertype [4]);

    	//TelNumber
    	putvalue(env_RNS_missedcall5_TelNumber, gmissedcalls_telnumber [0]);
    	putvalue(env_RNS_missedcall6_TelNumber, gmissedcalls_telnumber [1]);
    	putvalue(env_RNS_missedcall7_TelNumber, gmissedcalls_telnumber [2]);
    	putvalue(env_RNS_missedcall8_TelNumber, gmissedcalls_telnumber [3]);
    	putvalue(env_RNS_missedcall9_TelNumber, gmissedcalls_telnumber [4]);
	
    	//Date
    	for(callstackline=0;callstackline<SLW_ENTRIES;callstackline++){
    		dialdate[callstackline][0]=gmissedcalls_date[callstackline][0];
    		dialdate[callstackline][1]=gmissedcalls_date[callstackline][1];
    		dialdate[callstackline][2]='.';
    		dialdate[callstackline][3]=gmissedcalls_date[callstackline][2];
    		dialdate[callstackline][4]=gmissedcalls_date[callstackline][3];
    		dialdate[callstackline][5]='.';
    		dialdate[callstackline][6]=gmissedcalls_date[callstackline][4];
    		dialdate[callstackline][7]=gmissedcalls_date[callstackline][5];
    	}

    	putvalue(env_RNS_missedcall5_date, dialdate [0]);
    	putvalue(env_RNS_missedcall6_date, dialdate [1]);
    	putvalue(env_RNS_missedcall7_date, dialdate [2]);
    	putvalue(env_RNS_missedcall8_date, dialdate [3]);
    	putvalue(env_RNS_missedcall9_date, dialdate [4]);

    	//time
    	for(callstackline=0;callstackline<SLW_ENTRIES;callstackline++){
    		dialtime[callstackline][0]=gmissedcalls_time[callstackline][0];
    		dialtime[callstackline][1]=gmissedcalls_time[callstackline][1];
    		dialtime[callstackline][2]=':';
    		dialtime[callstackline][3]=gmissedcalls_time[callstackline][2];
    		dialtime[callstackline][4]=gmissedcalls_time[callstackline][3];
    		dialtime[callstackline][5]=':';
    		dialtime[callstackline][6]=gmissedcalls_time[callstackline][4];
    		dialtime[callstackline][7]=gmissedcalls_time[callstackline][5];
    	}
    	putvalue(env_RNS_missedcall5_time, dialtime [0]);
    	putvalue(env_RNS_missedcall6_time, dialtime [1]);
    	putvalue(env_RNS_missedcall7_time, dialtime [2]);
    	putvalue(env_RNS_missedcall8_time, dialtime [3]);
    	putvalue(env_RNS_missedcall9_time, dialtime [4]);
    }
}
/*@@end*/

/*@@caplFunc:ReceivedCalls_Indication(dword[],byte,int):*/
ReceivedCalls_Indication (dword Indication_array [], byte indication, int datalength)
{
    byte mode, direction, shift, recordaddress, indexsize, current_element, transmitpos, length, CacheElements, StartElementInCache;
    word  startelement, elements, startelement_check, Offset =0;
    int i =0, j=0;

    // Init local variables
    mode                    =0;
    direction               =0;
    shift                   =0;
    recordaddress           =0;
    startelement            =0;
    elements                =0;
    current_element         =0;
    transmitpos             =0;
    length                  =0;
    startelement_check      =0;
    StartElementInCache     =FALSE;
    CacheElements           =FALSE;

		switch (gBAP_Indication[2])
		{
			case Data_IND:
				//get data
                gReceivedCalls_ASGID =(Indication_array[3] &0xF0) /0x10;
                gReceivedCalls_TAID  =Indication_array[3] &0x0F;           

                gReceivedCalls_TotalNumListElements =Indication_array[4];
              
                /***ArrayHeader***/
                mode            =(Indication_array[5] &0xF0) /0x10;
                recordaddress   =Indication_array[5] &0x0F;
                Offset =6;
                
                // decode "mode-byte"
                shift       =mode &0x01;
                direction   =(mode &0x02)/0x02;
                transmitpos =(mode &0x04)/0x04;
                indexsize   =(mode &0x08)/0x08; 

                if (indexsize)
                {   
                    startelement =Indication_array[Offset];
                    Offset++;
                    startelement +=(Indication_array[Offset] *0x100);
                    Offset++;

                    elements =Indication_array[Offset];
                    Offset++;
                    elements +=(Indication_array[Offset] *0x100);
                    Offset++;
                }
                else
                {   
                    startelement =Indication_array[Offset];
                    Offset++;

                    elements =Indication_array[Offset];
                    Offset++;
                }           
            
                if(startelement !=0)
                {
                    for (i=0;i<TEL_RECEIVEDCALLS_ASGCACHE_MAX_SIZE;i++)
                    {
                        if(startelement ==gReceivedCalls_Pos[i])  
                            i =TEL_RECEIVEDCALLS_ASGCACHE_MAX_SIZE;              
                    }
                }

                switch (recordaddress)
                {
                    case 0: //recordaddress =0 -> complete record

                        /***startelement ==0***/                        
                        if(0==startelement && gReceivedCalls_ListHandlingType ==TEL_RECEIVEDCALLS_BUILDUPCACHE)
                        {     
                            /***find "start line" in ASG cache***/
                            if(FORWARD ==direction)
                            {    
                                if (gReceivedCalls_cacheDown)
                                {   
                                    current_element         =5; //it's the Pos of last element in ASG cache
                                    
                                    //reset "sliding window" values
                                    gReceivedCalls_cacheDown         =FALSE;
                                }
                                else
                                    current_element =startelement;
                                    
                                if (shift ==TRUE) //startelement not next element
                                    current_element =ReceivedCalls_GetNextLineInCache (current_element, direction);   
                            }
                            
                            else if(BACKWARD ==direction && shift==TRUE)
                            {
                                if(gReceivedCalls_cacheUp)
                                {   
                                    current_element         =6; //it's the Pos of first element in ASG cache
                                    
                                    //reset "sliding window" values
                                        gReceivedCalls_cacheUp           =FALSE;
                                }
                                else 
                                    current_element =TEL_RECEIVEDCALLS_ASGCACHE_MAX_SIZE -1; // position of last element in array 
                            }                
                                
                            /***copy elements***/
                            if (current_element !=TEL_RECEIVEDCALLS_NO_NEXT_POSITION) 
                            {
                                for (j=0; j<elements;j++) //copy elements
                                {   
                                    //check, if elements must be cached and in case find position in array
                                    CacheElements =FALSE;
                                    for (i=0; i<TEL_RECEIVEDCALLS_ASGCACHE_MAX_SIZE; i++)
                                    {  
                                        //if element already cached, find position in ASG-cache
                                        if(indexsize ==FALSE && (transmitpos ==TRUE) && Indication_array[Offset] ==gReceivedCalls_Pos[i] && gReceivedCalls_ListEntryReceptionInformation[i] ==TRUE)
                                        {   
                                            current_element =i; 
                                            CacheElements   =TRUE;
                                        }
                                        else if((indexsize ==TRUE && (transmitpos ==TRUE) && (Indication_array[Offset] +(Indication_array[Offset+1]*0x100)) ==gReceivedCalls_Pos[i] && gReceivedCalls_ListEntryReceptionInformation[i] ==TRUE))
                                        {   
                                            current_element =i; 
                                            CacheElements   =TRUE;
                                        }
                                        //if not already cached, then store element only, if Cache is build-up!
                                        else if((gReceivedCalls_ListHandlingType !=TEL_RECEIVEDCALLS_NOCACHE))
                                            CacheElements   =TRUE;
                                    }
                                                                       
                                    if (transmitpos)
                                    {   
                                        if(CacheElements ==TRUE)
                                        {   
                                            if(indexsize)
                                            {    
                                                gReceivedCalls_Pos[current_element] =Indication_array[Offset];
                                                Offset++;
                                                gReceivedCalls_Pos[current_element] +=Indication_array[Offset] *0x100;
                                            }
                                            else
                                                gReceivedCalls_Pos[current_element] =Indication_array[Offset]; 
                                        }
                                        Offset++;
                                    }
                                    else if(CacheElements ==TRUE)
                                    {
                                        if(direction ==FORWARD && shift==FALSE)
                                            gReceivedCalls_Pos[current_element] =startelement+j;
                                        
                                        else if(direction ==FORWARD && shift==TRUE)
                                            gReceivedCalls_Pos[current_element] =startelement+j+1;

                                        else if(direction ==BACKWARD && shift==FALSE)
                                            gReceivedCalls_Pos[current_element] =startelement-j;
                                        
                                        else if((direction ==BACKWARD) && (shift==TRUE) && (startelement !=0))
                                            gReceivedCalls_Pos[current_element] =startelement-j-1;  
                                    }

                                    //PbName
                                    if(CacheElements ==TRUE)
                                    {
                                        for(i=0; i<TEL_RECEIVEDCALLS_PBNAME_LENGTH;i++) //clear
			                                gReceivedCalls_PbName[current_element][i] =0; 
                                    }
                                         
                                    length =Indication_array[Offset];
                                    Offset++;
                                    
                                    for(i=0; i<length;i++) //copy data
                                    {   
                                        if(CacheElements ==TRUE)
                                            gReceivedCalls_PbName[current_element][i] =Indication_array[Offset];
                                        Offset++;
                                    }
                                    
                                    //NumberType
                                    if(CacheElements ==TRUE)
                                    {
                                        gReceivedCalls_NumberType[current_element] =Indication_array[Offset];
                                        Offset++;
                                    }

                                    //TelNumber
                                    if(CacheElements ==TRUE)
                                    {
                                        for(i=0; i<TEL_RECEIVEDCALLS_TELNUMBER_LENGTH;i++) //clear
			                                gReceivedCalls_TelNumber[current_element][i] =0; 
                                    }
                                         
                                    length =Indication_array[Offset];
                                    Offset++;
                                    
                                    for(i=0; i<length;i++) //copy data
                                    {   
                                        if(CacheElements ==TRUE)
                                            gReceivedCalls_TelNumber[current_element][i] =Indication_array[Offset];
                                        Offset++;
                                    }
                                    
                                    //Day
                                    if(CacheElements ==TRUE)
                                    {
                                        gReceivedCalls_day[current_element] =Indication_array[Offset];
                                        Offset++;
                                    }

                                    //Month
                                    if(CacheElements ==TRUE)
                                    {
                                        gReceivedCalls_month[current_element] =Indication_array[Offset];
                                        Offset++;
                                    }

                                    //Year
                                    if(CacheElements ==TRUE)
                                    {
                                        gReceivedCalls_year[current_element] =Indication_array[Offset];
                                        Offset++;
                                    }

                                    //Hour
                                    if(CacheElements ==TRUE)
                                    {
                                        gReceivedCalls_hour[current_element] =Indication_array[Offset];
                                        Offset++;
                                    }

                                    //Minute
                                    if(CacheElements ==TRUE)
                                    {
                                        gReceivedCalls_minute[current_element] =Indication_array[Offset];
                                        Offset++;
                                    }

                                    //Second
                                    if(CacheElements ==TRUE)
                                    {
                                        gReceivedCalls_second[current_element] =Indication_array[Offset];
                                        Offset++;
                                    }
                                    
                                    if(CacheElements ==TRUE)                                    
                                        gReceivedCalls_ListEntryReceptionInformation [current_element] =TRUE;
                                                       
                                    current_element =ReceivedCalls_GetNextLineInCache (current_element, direction); //go on with next element     
                                }   //copy data of current element finished
                            } //copy of elements finished       
                        } //startelement=0 ends
    
                        /***startelement !=0***/
                        else //if (((startelement !=0) && (gReceivedCalls_ListHandlingType ==TEL_RECEIVEDCALLS_BUILDUPCACHE)) || ((startelement ==0) && (gReceivedCalls_ListHandlingType !=TEL_RECEIVEDCALLS_BUILDUPCACHE))) //startelement !=0
                        {
                            //searching for valid startelement in stored list
					        for(i=0;i<TEL_RECEIVEDCALLS_ASGCACHE_MAX_SIZE;i++)
					        {
						        if(gReceivedCalls_Pos[i] ==startelement)				//found a valid element
						        {                                                                                  
                                    current_element     =i;                         //found element is valid_startelement
						            StartElementInCache =TRUE;
                                    i                   =TEL_RECEIVEDCALLS_ASGCACHE_MAX_SIZE;
                                }
					        }
                            if (StartElementInCache)
                            {   
                                if (shift ==TRUE && startelement!=0) //first array element is next element
                                    current_element =ReceivedCalls_GetNextLineInCache (current_element, direction);                 
                                else if(shift ==TRUE && startelement==0 && direction ==FORWARD)
                                    current_element=5;
                                   
                                for (j=0; j<elements;j++) //copy elements
                                {
                                    if(current_element !=TEL_RECEIVEDCALLS_NO_NEXT_POSITION)
                                    {
                                        CacheElements =TRUE;
                                        //if element already exist in ASG-cache, search the position 
                                        for (i=0; i<TEL_RECEIVEDCALLS_ASGCACHE_MAX_SIZE; i++)
                                        {   
                                            if((transmitpos ==TRUE) && gReceivedCalls_ListEntryReceptionInformation[i] ==TRUE)
                                            {   
                                                startelement_check =0;
                                                if(indexsize)
                                                    startelement_check =Indication_array[Offset] +(Indication_array[Offset+1]*0x100); 
                                                else
                                                    startelement_check =Indication_array[Offset];
                                               
                                                if(startelement_check ==gReceivedCalls_Pos[i])
                                                {   
                                                    current_element =i; 
                                                    CacheElements   =TRUE;
                                                }
                                                startelement_check=0;
                                            }  
                                        }
                                    }
                                    else
                                        CacheElements =FALSE;
                                        
                                    if (transmitpos)
                                    {   
                                        if(CacheElements ==TRUE)
                                        {   
                                            if(indexsize)
                                            {    
                                                gReceivedCalls_Pos[current_element] =Indication_array[Offset];
                                                Offset++;
                                                gReceivedCalls_Pos[current_element] +=Indication_array[Offset] *0x100;
                                            }
                                            else
                                                gReceivedCalls_Pos[current_element] =Indication_array[Offset];
                                        }
                                        Offset++;
                                    }
                                    else if(CacheElements ==TRUE)
                                    {
                                        if(direction ==FORWARD && shift==FALSE)
                                            gReceivedCalls_Pos[current_element] =startelement+j;
                                        
                                        else if(direction ==FORWARD && shift==TRUE)
                                            gReceivedCalls_Pos[current_element] =startelement+j+1;

                                        else if(direction ==BACKWARD && shift==FALSE)
                                            gReceivedCalls_Pos[current_element] =startelement-j;
                                        
                                        else if((direction ==BACKWARD) && (shift==TRUE) && (startelement !=0))
                                            gReceivedCalls_Pos[current_element] =startelement-j-1;  
                                    }
                                    
                                    //PbName
                                    if(CacheElements ==TRUE)
                                    {
                                        for(i=0; i<TEL_RECEIVEDCALLS_PBNAME_LENGTH;i++) //clear
			                                gReceivedCalls_PbName[current_element][i] =0; 
                                    }
                                         
                                    length =Indication_array[Offset];
                                    Offset++;
                                    
                                    for(i=0; i<length;i++) //copy data
                                    {   
                                        if(CacheElements ==TRUE)
                                            gReceivedCalls_PbName[current_element][i] =Indication_array[Offset];
                                        Offset++;
                                    }
                                    
                                    //NumberType
                                    if(CacheElements ==TRUE)
                                    {
                                        gReceivedCalls_NumberType[current_element] =Indication_array[Offset];
                                        Offset++;
                                    }

                                    //TelNumber
                                    if(CacheElements ==TRUE)
                                    {
                                        for(i=0; i<TEL_RECEIVEDCALLS_TELNUMBER_LENGTH;i++) //clear
			                                gReceivedCalls_TelNumber[current_element][i] =0; 
                                    }
                                         
                                    length =Indication_array[Offset];
                                    Offset++;
                                    
                                    for(i=0; i<length;i++) //copy data
                                    {   
                                        if(CacheElements ==TRUE)
                                            gReceivedCalls_TelNumber[current_element][i] =Indication_array[Offset];
                                        Offset++;
                                    }
                                    
                                    //Day
                                    if(CacheElements ==TRUE)
                                    {
                                        gReceivedCalls_day[current_element] =Indication_array[Offset];
                                        Offset++;
                                    }

                                    //Month
                                    if(CacheElements ==TRUE)
                                    {
                                        gReceivedCalls_month[current_element] =Indication_array[Offset];
                                        Offset++;
                                    }

                                    //Year
                                    if(CacheElements ==TRUE)
                                    {
                                        gReceivedCalls_year[current_element] =Indication_array[Offset];
                                        Offset++;
                                    }

                                    //Hour
                                    if(CacheElements ==TRUE)
                                    {
                                        gReceivedCalls_hour[current_element] =Indication_array[Offset];
                                        Offset++;
                                    }

                                    //Minute
                                    if(CacheElements ==TRUE)
                                    {
                                        gReceivedCalls_minute[current_element] =Indication_array[Offset];
                                        Offset++;
                                    }

                                    //Second
                                    if(CacheElements ==TRUE)
                                    {
                                        gReceivedCalls_second[current_element] =Indication_array[Offset];
                                        Offset++;
                                    }
                                    
                                    if(CacheElements ==TRUE)                                   
                                        gReceivedCalls_ListEntryReceptionInformation [current_element] =TRUE;
                                    
                                    if(CacheElements ==TRUE)    
                                        current_element =ReceivedCalls_GetNextLineInCache (current_element, direction); //go on with next element       
                                }   //copy data of current element finished
                            }       //copy of elements finished
                        }           //startelement !=0 ends
                        
                     break; //recordaddress =0 ends
                    
                    case 1: //recordaddress =1 -> PbName, NumberType
                        /***startelement ==0***/                        
                        if(0==startelement && gReceivedCalls_ListHandlingType ==TEL_RECEIVEDCALLS_BUILDUPCACHE)
                        {     
                            /***find "start line" in ASG cache***/
                            if(FORWARD ==direction)
                            {    
                                if (gReceivedCalls_cacheDown)
                                {   
                                    current_element         =5; //it's the Pos of last element in ASG cache
                                    
                                    //reset "sliding window" values
                                    gReceivedCalls_cacheDown         =FALSE;
                                }
                                else
                                    current_element =startelement;
                                    
                                if (shift ==TRUE) //startelement not next element
                                    current_element =ReceivedCalls_GetNextLineInCache (current_element, direction);   
                            }
                            
                            else if(BACKWARD ==direction && shift==TRUE)
                            {
                                if(gReceivedCalls_cacheUp)
                                {   
                                    current_element         =6; //it's the Pos of first element in ASG cache
                                    
                                    //reset "sliding window" values
                                        gReceivedCalls_cacheUp           =FALSE;
                                }
                                else 
                                    current_element =TEL_RECEIVEDCALLS_ASGCACHE_MAX_SIZE -1; // position of last element in array 
                            }                
                                
                            /***copy elements***/
                            if (current_element !=TEL_RECEIVEDCALLS_NO_NEXT_POSITION) 
                            {
                                for (j=0; j<elements;j++) //copy elements
                                {   
                                    //check, if elements must be cached and in case find position in array
                                    CacheElements =FALSE;
                                    for (i=0; i<TEL_RECEIVEDCALLS_ASGCACHE_MAX_SIZE; i++)
                                    {  
                                        //if element already cached, find position in ASG-cache
                                        if(indexsize ==FALSE && (transmitpos ==TRUE) && Indication_array[Offset] ==gReceivedCalls_Pos[i] && gReceivedCalls_ListEntryReceptionInformation[i] ==TRUE)
                                        {   
                                            current_element =i; 
                                            CacheElements   =TRUE;
                                        }
                                        else if((indexsize ==TRUE && (transmitpos ==TRUE) && (Indication_array[Offset] +(Indication_array[Offset+1]*0x100)) ==gReceivedCalls_Pos[i] && gReceivedCalls_ListEntryReceptionInformation[i] ==TRUE))
                                        {   
                                            current_element =i; 
                                            CacheElements   =TRUE;
                                        }
                                        //if not already cached, then store element only, if Cache is build-up!
                                        else if((gReceivedCalls_ListHandlingType !=TEL_RECEIVEDCALLS_NOCACHE))
                                            CacheElements   =TRUE;
                                    }
                                                                       
                                    if (transmitpos)
                                    {   
                                        if(CacheElements ==TRUE)
                                        {   
                                            if(indexsize)
                                            {    
                                                gReceivedCalls_Pos[current_element] =Indication_array[Offset];
                                                Offset++;
                                                gReceivedCalls_Pos[current_element] +=Indication_array[Offset] *0x100;
                                            }
                                            else
                                                gReceivedCalls_Pos[current_element] =Indication_array[Offset]; 
                                        }
                                        Offset++;
                                    }
                                    else if(CacheElements ==TRUE)
                                    {
                                        if(direction ==FORWARD && shift==FALSE)
                                            gReceivedCalls_Pos[current_element] =startelement+j;
                                        
                                        else if(direction ==FORWARD && shift==TRUE)
                                            gReceivedCalls_Pos[current_element] =startelement+j+1;

                                        else if(direction ==BACKWARD && shift==FALSE)
                                            gReceivedCalls_Pos[current_element] =startelement-j;
                                        
                                        else if((direction ==BACKWARD) && (shift==TRUE) && (startelement !=0))
                                            gReceivedCalls_Pos[current_element] =startelement-j-1;  
                                    }

                                    //PbName
                                    if(CacheElements ==TRUE)
                                    {
                                        for(i=0; i<TEL_RECEIVEDCALLS_PBNAME_LENGTH;i++) //clear
			                                gReceivedCalls_PbName[current_element][i] =0; 
                                    }
                                         
                                    length =Indication_array[Offset];
                                    Offset++;
                                    
                                    for(i=0; i<length;i++) //copy data
                                    {   
                                        if(CacheElements ==TRUE)
                                            gReceivedCalls_PbName[current_element][i] =Indication_array[Offset];
                                        Offset++;
                                    }
                                    
                                    //NumberType
                                    if(CacheElements ==TRUE)
                                    {
                                        gReceivedCalls_NumberType[current_element] =Indication_array[Offset];
                                        Offset++;
                                    }
                                    
                                    if(CacheElements ==TRUE)                                    
                                        gReceivedCalls_ListEntryReceptionInformation [current_element] =TRUE;
                                                       
                                    current_element =ReceivedCalls_GetNextLineInCache (current_element, direction); //go on with next element     
                                }   //copy data of current element finished
                            } //copy of elements finished       
                        } //startelement=0 ends
    
                        /***startelement !=0***/
                        else //if (((startelement !=0) && (gReceivedCalls_ListHandlingType ==TEL_RECEIVEDCALLS_BUILDUPCACHE)) || ((startelement ==0) && (gReceivedCalls_ListHandlingType !=TEL_RECEIVEDCALLS_BUILDUPCACHE))) //startelement !=0
                        {
                            //searching for valid startelement in stored list
					        for(i=0;i<TEL_RECEIVEDCALLS_ASGCACHE_MAX_SIZE;i++)
					        {
						        if(gReceivedCalls_Pos[i] ==startelement)				//found a valid element
						        {                                                                                  
                                    current_element     =i;                         //found element is valid_startelement
						            StartElementInCache =TRUE;
                                    i                   =TEL_RECEIVEDCALLS_ASGCACHE_MAX_SIZE;
                                }
					        }
                            if (StartElementInCache)
                            {   
                                if (shift ==TRUE && startelement!=0) //first array element is next element
                                    current_element =ReceivedCalls_GetNextLineInCache (current_element, direction);                 
                                else if(shift ==TRUE && startelement==0 && direction ==FORWARD)
                                    current_element=5;
                                   
                                for (j=0; j<elements;j++) //copy elements
                                {
                                    if(current_element !=TEL_RECEIVEDCALLS_NO_NEXT_POSITION)
                                    {
                                        CacheElements =TRUE;
                                        //if element already exist in ASG-cache, search the position 
                                        for (i=0; i<TEL_RECEIVEDCALLS_ASGCACHE_MAX_SIZE; i++)
                                        {   
                                            if((transmitpos ==TRUE) && gReceivedCalls_ListEntryReceptionInformation[i] ==TRUE)
                                            {   
                                                startelement_check =0;
                                                if(indexsize)
                                                    startelement_check =Indication_array[Offset] +(Indication_array[Offset+1]*0x100); 
                                                else
                                                    startelement_check =Indication_array[Offset];
                                               
                                                if(startelement_check ==gReceivedCalls_Pos[i])
                                                {   
                                                    current_element =i; 
                                                    CacheElements   =TRUE;
                                                }
                                                startelement_check=0;
                                            }  
                                        }
                                    }
                                    else
                                        CacheElements =FALSE;
                                        
                                    if (transmitpos)
                                    {   
                                        if(CacheElements ==TRUE)
                                        {   
                                            if(indexsize)
                                            {    
                                                gReceivedCalls_Pos[current_element] =Indication_array[Offset];
                                                Offset++;
                                                gReceivedCalls_Pos[current_element] +=Indication_array[Offset] *0x100;
                                            }
                                            else
                                                gReceivedCalls_Pos[current_element] =Indication_array[Offset];
                                        }
                                        Offset++;
                                    }
                                    else if(CacheElements ==TRUE)
                                    {
                                        if(direction ==FORWARD && shift==FALSE)
                                            gReceivedCalls_Pos[current_element] =startelement+j;
                                        
                                        else if(direction ==FORWARD && shift==TRUE)
                                            gReceivedCalls_Pos[current_element] =startelement+j+1;

                                        else if(direction ==BACKWARD && shift==FALSE)
                                            gReceivedCalls_Pos[current_element] =startelement-j;
                                        
                                        else if((direction ==BACKWARD) && (shift==TRUE) && (startelement !=0))
                                            gReceivedCalls_Pos[current_element] =startelement-j-1;  
                                    }
                                    
                                    //PbName
                                    if(CacheElements ==TRUE)
                                    {
                                        for(i=0; i<TEL_RECEIVEDCALLS_PBNAME_LENGTH;i++) //clear
			                                gReceivedCalls_PbName[current_element][i] =0; 
                                    }
                                         
                                    length =Indication_array[Offset];
                                    Offset++;
                                    
                                    for(i=0; i<length;i++) //copy data
                                    {   
                                        if(CacheElements ==TRUE)
                                            gReceivedCalls_PbName[current_element][i] =Indication_array[Offset];
                                        Offset++;
                                    }
                                    
                                    //NumberType
                                    if(CacheElements ==TRUE)
                                    {
                                        gReceivedCalls_NumberType[current_element] =Indication_array[Offset];
                                        Offset++;
                                    }

                                    if(CacheElements ==TRUE)                                   
                                        gReceivedCalls_ListEntryReceptionInformation [current_element] =TRUE;
                                    
                                    if(CacheElements ==TRUE)    
                                        current_element =ReceivedCalls_GetNextLineInCache (current_element, direction); //go on with next element       
                                }   //copy data of current element finished
                            }       //copy of elements finished
                        }
                        
                     break; //recordaddress =1 ends
                    
                    case 2: //recordaddress =2 -> TelNumber, Day, Month, Year, Hour, Minute, Second
                        /***startelement ==0***/                        
                        if(0==startelement && gReceivedCalls_ListHandlingType ==TEL_RECEIVEDCALLS_BUILDUPCACHE)
                        {     
                            /***find "start line" in ASG cache***/
                            if(FORWARD ==direction)
                            {    
                                if (gReceivedCalls_cacheDown)
                                {   
                                    current_element         =5; //it's the Pos of last element in ASG cache
                                    
                                    //reset "sliding window" values
                                    gReceivedCalls_cacheDown         =FALSE;
                                }
                                else
                                    current_element =startelement;
                                    
                                if (shift ==TRUE) //startelement not next element
                                    current_element =ReceivedCalls_GetNextLineInCache (current_element, direction);   
                            }
                            
                            else if(BACKWARD ==direction && shift==TRUE)
                            {
                                if(gReceivedCalls_cacheUp)
                                {   
                                    current_element         =6; //it's the Pos of first element in ASG cache
                                    
                                    //reset "sliding window" values
                                        gReceivedCalls_cacheUp           =FALSE;
                                }
                                else 
                                    current_element =TEL_RECEIVEDCALLS_ASGCACHE_MAX_SIZE -1; // position of last element in array 
                            }                
                                
                            /***copy elements***/
                            if (current_element !=TEL_RECEIVEDCALLS_NO_NEXT_POSITION) 
                            {
                                for (j=0; j<elements;j++) //copy elements
                                {   
                                    //check, if elements must be cached and in case find position in array
                                    CacheElements =FALSE;
                                    for (i=0; i<TEL_RECEIVEDCALLS_ASGCACHE_MAX_SIZE; i++)
                                    {  
                                        //if element already cached, find position in ASG-cache
                                        if(indexsize ==FALSE && (transmitpos ==TRUE) && Indication_array[Offset] ==gReceivedCalls_Pos[i] && gReceivedCalls_ListEntryReceptionInformation[i] ==TRUE)
                                        {   
                                            current_element =i; 
                                            CacheElements   =TRUE;
                                        }
                                        else if((indexsize ==TRUE && (transmitpos ==TRUE) && (Indication_array[Offset] +(Indication_array[Offset+1]*0x100)) ==gReceivedCalls_Pos[i] && gReceivedCalls_ListEntryReceptionInformation[i] ==TRUE))
                                        {   
                                            current_element =i; 
                                            CacheElements   =TRUE;
                                        }
                                        //if not already cached, then store element only, if Cache is build-up!
                                        else if((gReceivedCalls_ListHandlingType !=TEL_RECEIVEDCALLS_NOCACHE))
                                            CacheElements   =TRUE;
                                    }
                                                                       
                                    if (transmitpos)
                                    {   
                                        if(CacheElements ==TRUE)
                                        {   
                                            if(indexsize)
                                            {    
                                                gReceivedCalls_Pos[current_element] =Indication_array[Offset];
                                                Offset++;
                                                gReceivedCalls_Pos[current_element] +=Indication_array[Offset] *0x100;
                                            }
                                            else
                                                gReceivedCalls_Pos[current_element] =Indication_array[Offset]; 
                                        }
                                        Offset++;
                                    }
                                    else if(CacheElements ==TRUE)
                                    {
                                        if(direction ==FORWARD && shift==FALSE)
                                            gReceivedCalls_Pos[current_element] =startelement+j;
                                        
                                        else if(direction ==FORWARD && shift==TRUE)
                                            gReceivedCalls_Pos[current_element] =startelement+j+1;

                                        else if(direction ==BACKWARD && shift==FALSE)
                                            gReceivedCalls_Pos[current_element] =startelement-j;
                                        
                                        else if((direction ==BACKWARD) && (shift==TRUE) && (startelement !=0))
                                            gReceivedCalls_Pos[current_element] =startelement-j-1;  
                                    }

                                    //TelNumber
                                    if(CacheElements ==TRUE)
                                    {
                                        for(i=0; i<TEL_RECEIVEDCALLS_TELNUMBER_LENGTH;i++) //clear
			                                gReceivedCalls_TelNumber[current_element][i] =0; 
                                    }
                                         
                                    length =Indication_array[Offset];
                                    Offset++;
                                    
                                    for(i=0; i<length;i++) //copy data
                                    {   
                                        if(CacheElements ==TRUE)
                                            gReceivedCalls_TelNumber[current_element][i] =Indication_array[Offset];
                                        Offset++;
                                    }
                                    
                                    //Day
                                    if(CacheElements ==TRUE)
                                    {
                                        gReceivedCalls_day[current_element] =Indication_array[Offset];
                                        Offset++;
                                    }

                                    //Month
                                    if(CacheElements ==TRUE)
                                    {
                                        gReceivedCalls_month[current_element] =Indication_array[Offset];
                                        Offset++;
                                    }

                                    //Year
                                    if(CacheElements ==TRUE)
                                    {
                                        gReceivedCalls_year[current_element] =Indication_array[Offset];
                                        Offset++;
                                    }

                                    //Hour
                                    if(CacheElements ==TRUE)
                                    {
                                        gReceivedCalls_hour[current_element] =Indication_array[Offset];
                                        Offset++;
                                    }

                                    //Minute
                                    if(CacheElements ==TRUE)
                                    {
                                        gReceivedCalls_minute[current_element] =Indication_array[Offset];
                                        Offset++;
                                    }

                                    //Second
                                    if(CacheElements ==TRUE)
                                    {
                                        gReceivedCalls_second[current_element] =Indication_array[Offset];
                                        Offset++;
                                    }
                                    
                                    if(CacheElements ==TRUE)                                    
                                        gReceivedCalls_ListEntryReceptionInformation [current_element] =TRUE;
                                                       
                                    current_element =ReceivedCalls_GetNextLineInCache (current_element, direction); //go on with next element     
                                }   //copy data of current element finished
                            } //copy of elements finished       
                        } //startelement=0 ends
    
                        /***startelement !=0***/
                        else //if (((startelement !=0) && (gReceivedCalls_ListHandlingType ==TEL_RECEIVEDCALLS_BUILDUPCACHE)) || ((startelement ==0) && (gReceivedCalls_ListHandlingType !=TEL_RECEIVEDCALLS_BUILDUPCACHE))) //startelement !=0
                        {
                            //searching for valid startelement in stored list
					        for(i=0;i<TEL_RECEIVEDCALLS_ASGCACHE_MAX_SIZE;i++)
					        {
						        if(gReceivedCalls_Pos[i] ==startelement)				//found a valid element
						        {                                                                                  
                                    current_element     =i;                         //found element is valid_startelement
						            StartElementInCache =TRUE;
                                    i                   =TEL_RECEIVEDCALLS_ASGCACHE_MAX_SIZE;
                                }
					        }
                            if (StartElementInCache)
                            {   
                                if (shift ==TRUE && startelement!=0) //first array element is next element
                                    current_element =ReceivedCalls_GetNextLineInCache (current_element, direction);                 
                                else if(shift ==TRUE && startelement==0 && direction ==FORWARD)
                                    current_element=5;
                                   
                                for (j=0; j<elements;j++) //copy elements
                                {
                                    if(current_element !=TEL_RECEIVEDCALLS_NO_NEXT_POSITION)
                                    {
                                        CacheElements =TRUE;
                                        //if element already exist in ASG-cache, search the position 
                                        for (i=0; i<TEL_RECEIVEDCALLS_ASGCACHE_MAX_SIZE; i++)
                                        {   
                                            if((transmitpos ==TRUE) && gReceivedCalls_ListEntryReceptionInformation[i] ==TRUE)
                                            {   
                                                startelement_check =0;
                                                if(indexsize)
                                                    startelement_check =Indication_array[Offset] +(Indication_array[Offset+1]*0x100); 
                                                else
                                                    startelement_check =Indication_array[Offset];
                                               
                                                if(startelement_check ==gReceivedCalls_Pos[i])
                                                {   
                                                    current_element =i; 
                                                    CacheElements   =TRUE;
                                                }
                                                startelement_check=0;
                                            }  
                                        }
                                    }
                                    else
                                        CacheElements =FALSE;
                                        
                                    if (transmitpos)
                                    {   
                                        if(CacheElements ==TRUE)
                                        {   
                                            if(indexsize)
                                            {    
                                                gReceivedCalls_Pos[current_element] =Indication_array[Offset];
                                                Offset++;
                                                gReceivedCalls_Pos[current_element] +=Indication_array[Offset] *0x100;
                                            }
                                            else
                                                gReceivedCalls_Pos[current_element] =Indication_array[Offset];
                                        }
                                        Offset++;
                                    }
                                    else if(CacheElements ==TRUE)
                                    {
                                        if(direction ==FORWARD && shift==FALSE)
                                            gReceivedCalls_Pos[current_element] =startelement+j;
                                        
                                        else if(direction ==FORWARD && shift==TRUE)
                                            gReceivedCalls_Pos[current_element] =startelement+j+1;

                                        else if(direction ==BACKWARD && shift==FALSE)
                                            gReceivedCalls_Pos[current_element] =startelement-j;
                                        
                                        else if((direction ==BACKWARD) && (shift==TRUE) && (startelement !=0))
                                            gReceivedCalls_Pos[current_element] =startelement-j-1;  
                                    }

                                    //TelNumber
                                    if(CacheElements ==TRUE)
                                    {
                                        for(i=0; i<TEL_RECEIVEDCALLS_TELNUMBER_LENGTH;i++) //clear
			                                gReceivedCalls_TelNumber[current_element][i] =0; 
                                    }
                                         
                                    length =Indication_array[Offset];
                                    Offset++;
                                    
                                    for(i=0; i<length;i++) //copy data
                                    {   
                                        if(CacheElements ==TRUE)
                                            gReceivedCalls_TelNumber[current_element][i] =Indication_array[Offset];
                                        Offset++;
                                    }
                                    
                                    //Day
                                    if(CacheElements ==TRUE)
                                    {
                                        gReceivedCalls_day[current_element] =Indication_array[Offset];
                                        Offset++;
                                    }

                                    //Month
                                    if(CacheElements ==TRUE)
                                    {
                                        gReceivedCalls_month[current_element] =Indication_array[Offset];
                                        Offset++;
                                    }

                                    //Year
                                    if(CacheElements ==TRUE)
                                    {
                                        gReceivedCalls_year[current_element] =Indication_array[Offset];
                                        Offset++;
                                    }

                                    //Hour
                                    if(CacheElements ==TRUE)
                                    {
                                        gReceivedCalls_hour[current_element] =Indication_array[Offset];
                                        Offset++;
                                    }

                                    //Minute
                                    if(CacheElements ==TRUE)
                                    {
                                        gReceivedCalls_minute[current_element] =Indication_array[Offset];
                                        Offset++;
                                    }

                                    //Second
                                    if(CacheElements ==TRUE)
                                    {
                                        gReceivedCalls_second[current_element] =Indication_array[Offset];
                                        Offset++;
                                    }
                                    
                                    if(CacheElements ==TRUE)                                   
                                        gReceivedCalls_ListEntryReceptionInformation [current_element] =TRUE;
                                    
                                    if(CacheElements ==TRUE)    
                                        current_element =ReceivedCalls_GetNextLineInCache (current_element, direction); //go on with next element       
                                }   //copy data of current element finished
                            }       //copy of elements finished
                        }
                        
                     break; //recordaddress =2 ends
                    
                    case 15: //recordaddress =0xf -> Pos
                        /***startelement ==0***/                        
                        if(0==startelement && gReceivedCalls_ListHandlingType ==TEL_RECEIVEDCALLS_BUILDUPCACHE)
                        {     
                            /***find "start line" in ASG cache***/
                            if(FORWARD ==direction)
                            {    
                                if (gReceivedCalls_cacheDown)
                                {   
                                    current_element         =5; //it's the Pos of last element in ASG cache
                                    
                                    //reset "sliding window" values
                                    gReceivedCalls_cacheDown         =FALSE;
                                }
                                else
                                    current_element =startelement;
                                    
                                if (shift ==TRUE) //startelement not next element
                                    current_element =ReceivedCalls_GetNextLineInCache (current_element, direction);   
                            }
                            
                            else if(BACKWARD ==direction && shift==TRUE)
                            {
                                if(gReceivedCalls_cacheUp)
                                {   
                                    current_element         =6; //it's the Pos of first element in ASG cache
                                    
                                    //reset "sliding window" values
                                        gReceivedCalls_cacheUp           =FALSE;
                                }
                                else 
                                    current_element =TEL_RECEIVEDCALLS_ASGCACHE_MAX_SIZE -1; // position of last element in array 
                            }                
                                
                            /***copy elements***/
                            if (current_element !=TEL_RECEIVEDCALLS_NO_NEXT_POSITION) 
                            {
                                for (j=0; j<elements;j++) //copy elements
                                {   
                                    //check, if elements must be cached and in case find position in array
                                    CacheElements =FALSE;
                                    for (i=0; i<TEL_RECEIVEDCALLS_ASGCACHE_MAX_SIZE; i++)
                                    {  
                                        //if element already cached, find position in ASG-cache
                                        if(indexsize ==FALSE && (transmitpos ==TRUE) && Indication_array[Offset] ==gReceivedCalls_Pos[i] && gReceivedCalls_ListEntryReceptionInformation[i] ==TRUE)
                                        {   
                                            current_element =i; 
                                            CacheElements   =TRUE;
                                        }
                                        else if((indexsize ==TRUE && (transmitpos ==TRUE) && (Indication_array[Offset] +(Indication_array[Offset+1]*0x100)) ==gReceivedCalls_Pos[i] && gReceivedCalls_ListEntryReceptionInformation[i] ==TRUE))
                                        {   
                                            current_element =i; 
                                            CacheElements   =TRUE;
                                        }
                                        //if not already cached, then store element only, if Cache is build-up!
                                        else if((gReceivedCalls_ListHandlingType !=TEL_RECEIVEDCALLS_NOCACHE))
                                            CacheElements   =TRUE;
                                    }
                                                                       
                                    if (transmitpos)
                                    {   
                                        if(CacheElements ==TRUE)
                                        {   
                                            if(indexsize)
                                            {    
                                                gReceivedCalls_Pos[current_element] =Indication_array[Offset];
                                                Offset++;
                                                gReceivedCalls_Pos[current_element] +=Indication_array[Offset] *0x100;
                                            }
                                            else
                                                gReceivedCalls_Pos[current_element] =Indication_array[Offset]; 
                                        }
                                        Offset++;
                                    }
                                    else if(CacheElements ==TRUE)
                                    {
                                        if(direction ==FORWARD && shift==FALSE)
                                            gReceivedCalls_Pos[current_element] =startelement+j;
                                        
                                        else if(direction ==FORWARD && shift==TRUE)
                                            gReceivedCalls_Pos[current_element] =startelement+j+1;

                                        else if(direction ==BACKWARD && shift==FALSE)
                                            gReceivedCalls_Pos[current_element] =startelement-j;
                                        
                                        else if((direction ==BACKWARD) && (shift==TRUE) && (startelement !=0))
                                            gReceivedCalls_Pos[current_element] =startelement-j-1;  
                                    }
                                    
                                    if(CacheElements ==TRUE)                                    
                                        gReceivedCalls_ListEntryReceptionInformation [current_element] =TRUE;
                                                       
                                    current_element =ReceivedCalls_GetNextLineInCache (current_element, direction); //go on with next element     
                                }   //copy data of current element finished
                            } //copy of elements finished       
                        } //startelement=0 ends
    
                        /***startelement !=0***/
                        else //if (((startelement !=0) && (gReceivedCalls_ListHandlingType ==TEL_RECEIVEDCALLS_BUILDUPCACHE)) || ((startelement ==0) && (gReceivedCalls_ListHandlingType !=TEL_RECEIVEDCALLS_BUILDUPCACHE))) //startelement !=0
                        {
                            //searching for valid startelement in stored list
					        for(i=0;i<TEL_RECEIVEDCALLS_ASGCACHE_MAX_SIZE;i++)
					        {
						        if(gReceivedCalls_Pos[i] ==startelement)				//found a valid element
						        {                                                                                  
                                    current_element     =i;                         //found element is valid_startelement
						            StartElementInCache =TRUE;
                                    i                   =TEL_RECEIVEDCALLS_ASGCACHE_MAX_SIZE;
                                }
					        }
                            if (StartElementInCache)
                            {   
                                if (shift ==TRUE && startelement!=0) //first array element is next element
                                    current_element =ReceivedCalls_GetNextLineInCache (current_element, direction);                 
                                else if(shift ==TRUE && startelement==0 && direction ==FORWARD)
                                    current_element=5;
                                   
                                for (j=0; j<elements;j++) //copy elements
                                {
                                    if(current_element !=TEL_RECEIVEDCALLS_NO_NEXT_POSITION)
                                    {
                                        CacheElements =TRUE;
                                        //if element already exist in ASG-cache, search the position 
                                        for (i=0; i<TEL_RECEIVEDCALLS_ASGCACHE_MAX_SIZE; i++)
                                        {   
                                            if((transmitpos ==TRUE) && gReceivedCalls_ListEntryReceptionInformation[i] ==TRUE)
                                            {   
                                                startelement_check =0;
                                                if(indexsize)
                                                    startelement_check =Indication_array[Offset] +(Indication_array[Offset+1]*0x100); 
                                                else
                                                    startelement_check =Indication_array[Offset];
                                               
                                                if(startelement_check ==gReceivedCalls_Pos[i])
                                                {   
                                                    current_element =i; 
                                                    CacheElements   =TRUE;
                                                }
                                                startelement_check=0;
                                            }  
                                        }
                                    }
                                    else
                                        CacheElements =FALSE;
                                        
                                    if (transmitpos)
                                    {   
                                        if(CacheElements ==TRUE)
                                        {   
                                            if(indexsize)
                                            {    
                                                gReceivedCalls_Pos[current_element] =Indication_array[Offset];
                                                Offset++;
                                                gReceivedCalls_Pos[current_element] +=Indication_array[Offset] *0x100;
                                            }
                                            else
                                                gReceivedCalls_Pos[current_element] =Indication_array[Offset];
                                        }
                                        Offset++;
                                    }
                                    else if(CacheElements ==TRUE)
                                    {
                                        if(direction ==FORWARD && shift==FALSE)
                                            gReceivedCalls_Pos[current_element] =startelement+j;
                                        
                                        else if(direction ==FORWARD && shift==TRUE)
                                            gReceivedCalls_Pos[current_element] =startelement+j+1;

                                        else if(direction ==BACKWARD && shift==FALSE)
                                            gReceivedCalls_Pos[current_element] =startelement-j;
                                        
                                        else if((direction ==BACKWARD) && (shift==TRUE) && (startelement !=0))
                                            gReceivedCalls_Pos[current_element] =startelement-j-1;  
                                    }
                                    
                                    
                                    if(CacheElements ==TRUE)                                   
                                        gReceivedCalls_ListEntryReceptionInformation [current_element] =TRUE;
                                    
                                    if(CacheElements ==TRUE)    
                                        current_element =ReceivedCalls_GetNextLineInCache (current_element, direction); //go on with next element       
                                }   //copy data of current element finished
                            }       //copy of elements finished
                        }
                        
                     break; //recordaddress =0xf ends
                }
                                   
                //Panel
                putvalue(env_ASG_RC_ASGID, gReceivedCalls_ASGID);
                putvalue(env_ASG_RC_TAID, gReceivedCalls_TAID);
                putvalue(env_ASG_RC_TotalNumLE, gReceivedCalls_TotalNumListElements);

                gReceivedCalls_recordaddress =recordaddress;
                gReceivedCalls_transmitpos   =transmitpos;             
            
			break;
            
            case Changed_IND:
                //get data  
                /***ArrayHeader***/
                mode            =(Indication_array[3] &0xF0) /0x10;
                recordaddress   =Indication_array[3] &0x0F;
                Offset =4;
                
                // decode "mode-byte"
                shift       =mode &0x01;
                direction   =(mode &0x02)/0x02;
                transmitpos =(mode &0x04)/0x04;
                indexsize   =(mode &0x08)/0x08; 

                if (indexsize)
                {   
                    startelement =Indication_array[Offset];
                    Offset++;
                    startelement +=(Indication_array[Offset] *0x100);
                    Offset++;

                    elements =Indication_array[Offset];
                    Offset++;
                    elements +=(Indication_array[Offset] *0x100);
                    Offset++;
                }
                else
                {   
                    startelement =Indication_array[Offset];
                    Offset++;

                    elements =Indication_array[Offset];
                    Offset++;
                }           
            
                if(startelement !=0)
                {
                    for (i=0;i<TEL_RECEIVEDCALLS_ASGCACHE_MAX_SIZE;i++)
                    {
                        if(startelement ==gReceivedCalls_Pos[i])  
                            i =TEL_RECEIVEDCALLS_ASGCACHE_MAX_SIZE;              
                    }
                }                   

                if(datalength>0x8) // if ChangedArray includes data
                {
                    switch (recordaddress)
                    {
                        case 0: //recordaddress =0 -> complete record

                            /***startelement ==0***/                        
                            if(0==startelement && gReceivedCalls_ListHandlingType ==TEL_RECEIVEDCALLS_BUILDUPCACHE)
                            {     
                                /***find "start line" in ASG cache***/
                                if(FORWARD ==direction)
                                {    
                                    if (gReceivedCalls_cacheDown)
                                    {   
                                        current_element         =5; //it's the Pos of last element in ASG cache
                                    
                                        //reset "sliding window" values
                                        gReceivedCalls_cacheDown         =FALSE;
                                    }
                                    else
                                        current_element =startelement;
                                    
                                    if (shift ==TRUE) //startelement not next element
                                        current_element =ReceivedCalls_GetNextLineInCache (current_element, direction);   
                                }
                            
                                else if(BACKWARD ==direction && shift==TRUE)
                                {
                                    if(gReceivedCalls_cacheUp)
                                    {   
                                        current_element         =6; //it's the Pos of first element in ASG cache
                                    
                                        //reset "sliding window" values
                                            gReceivedCalls_cacheUp           =FALSE;
                                    }
                                    else 
                                        current_element =TEL_RECEIVEDCALLS_ASGCACHE_MAX_SIZE -1; // position of last element in array 
                                }                
                                
                                /***copy elements***/
                                if (current_element !=TEL_RECEIVEDCALLS_NO_NEXT_POSITION) 
                                {
                                    for (j=0; j<elements;j++) //copy elements
                                    {   
                                        //check, if elements must be cached and in case find position in array
                                        CacheElements =FALSE;
                                        for (i=0; i<TEL_RECEIVEDCALLS_ASGCACHE_MAX_SIZE; i++)
                                        {  
                                            //if element already cached, find position in ASG-cache
                                            if(indexsize ==FALSE && (transmitpos ==TRUE) && Indication_array[Offset] ==gReceivedCalls_Pos[i] && gReceivedCalls_ListEntryReceptionInformation[i] ==TRUE)
                                            {   
                                                current_element =i; 
                                                CacheElements   =TRUE;
                                            }
                                            else if((indexsize ==TRUE && (transmitpos ==TRUE) && (Indication_array[Offset] +(Indication_array[Offset+1]*0x100)) ==gReceivedCalls_Pos[i] && gReceivedCalls_ListEntryReceptionInformation[i] ==TRUE))
                                            {   
                                                current_element =i; 
                                                CacheElements   =TRUE;
                                            }
                                            //if not already cached, then store element only, if Cache is build-up!
                                            else if((gReceivedCalls_ListHandlingType !=TEL_RECEIVEDCALLS_NOCACHE))
                                                CacheElements   =TRUE;
                                        }
                                                                       
                                        if (transmitpos)
                                        {   
                                            if(CacheElements ==TRUE)
                                            {   
                                                if(indexsize)
                                                {    
                                                    gReceivedCalls_Pos[current_element] =Indication_array[Offset];
                                                    Offset++;
                                                    gReceivedCalls_Pos[current_element] +=Indication_array[Offset] *0x100;
                                                }
                                                else
                                                    gReceivedCalls_Pos[current_element] =Indication_array[Offset]; 
                                            }
                                            Offset++;
                                        }
                                    
                                        //PbName
                                        if(CacheElements ==TRUE)
                                        {
                                            for(i=0; i<TEL_RECEIVEDCALLS_PBNAME_LENGTH;i++) //clear
			                                    gReceivedCalls_PbName[current_element][i] =0; 
                                        }
                                         
                                        length =Indication_array[Offset];
                                        Offset++;
                                    
                                        for(i=0; i<length;i++) //copy data
                                        {   
                                            if(CacheElements ==TRUE)
                                                gReceivedCalls_PbName[current_element][i] =Indication_array[Offset];
                                            Offset++;
                                        }
                                    
                                        //NumberType
                                        if(CacheElements ==TRUE)
                                        {
                                            gReceivedCalls_NumberType[current_element] =Indication_array[Offset];
                                            Offset++;
                                        }

                                        //TelNumber
                                        if(CacheElements ==TRUE)
                                        {
                                            for(i=0; i<TEL_RECEIVEDCALLS_TELNUMBER_LENGTH;i++) //clear
			                                    gReceivedCalls_TelNumber[current_element][i] =0; 
                                        }
                                         
                                        length =Indication_array[Offset];
                                        Offset++;
                                    
                                        for(i=0; i<length;i++) //copy data
                                        {   
                                            if(CacheElements ==TRUE)
                                                gReceivedCalls_TelNumber[current_element][i] =Indication_array[Offset];
                                            Offset++;
                                        }
                                    
                                        //Day
                                        if(CacheElements ==TRUE)
                                        {
                                            gReceivedCalls_day[current_element] =Indication_array[Offset];
                                            Offset++;
                                        }

                                        //Month
                                        if(CacheElements ==TRUE)
                                        {
                                            gReceivedCalls_month[current_element] =Indication_array[Offset];
                                            Offset++;
                                        }

                                        //Year
                                        if(CacheElements ==TRUE)
                                        {
                                            gReceivedCalls_year[current_element] =Indication_array[Offset];
                                            Offset++;
                                        }

                                        //Hour
                                        if(CacheElements ==TRUE)
                                        {
                                            gReceivedCalls_hour[current_element] =Indication_array[Offset];
                                            Offset++;
                                        }

                                        //Minute
                                        if(CacheElements ==TRUE)
                                        {
                                            gReceivedCalls_minute[current_element] =Indication_array[Offset];
                                            Offset++;
                                        }

                                        //Second
                                        if(CacheElements ==TRUE)
                                        {
                                            gReceivedCalls_second[current_element] =Indication_array[Offset];
                                            Offset++;
                                        }
                                    
                                        if(CacheElements ==TRUE)                                    
                                            gReceivedCalls_ListEntryReceptionInformation [current_element] =TRUE;
                                                       
                                        current_element =ReceivedCalls_GetNextLineInCache (current_element, direction); //go on with next element     
                                    }   //copy data of current element finished
                                } //copy of elements finished       
                            } //startelement=0 ends
    
                            /***startelement !=0***/
                            else //if (((startelement !=0) && (gReceivedCalls_ListHandlingType ==TEL_RECEIVEDCALLS_BUILDUPCACHE)) || ((startelement ==0) && (gReceivedCalls_ListHandlingType !=TEL_RECEIVEDCALLS_BUILDUPCACHE))) //startelement !=0
                            {
                                //searching for valid startelement in stored list
					            for(i=0;i<TEL_RECEIVEDCALLS_ASGCACHE_MAX_SIZE;i++)
					            {
						            if(gReceivedCalls_Pos[i] ==startelement)				//found a valid element
						            {                                                                                  
                                        current_element     =i;                         //found element is valid_startelement
						                StartElementInCache =TRUE;
                                        i                   =TEL_RECEIVEDCALLS_ASGCACHE_MAX_SIZE;
                                    }
					            }
                                if (StartElementInCache)
                                {   
                                    if (shift ==TRUE && startelement!=0) //first array element is next element
                                        current_element =ReceivedCalls_GetNextLineInCache (current_element, direction);                 
                                    else if(shift ==TRUE && startelement==0 && direction ==FORWARD)
                                        current_element=5;
                                   
                                    for (j=0; j<elements;j++) //copy elements
                                    {
                                        if(current_element !=TEL_RECEIVEDCALLS_NO_NEXT_POSITION)
                                        {
                                            CacheElements =TRUE;
                                            //if element already exist in ASG-cache, search the position 
                                            for (i=0; i<TEL_RECEIVEDCALLS_ASGCACHE_MAX_SIZE; i++)
                                            {   
                                                if((transmitpos ==TRUE) && gReceivedCalls_ListEntryReceptionInformation[i] ==TRUE)
                                                {   
                                                    startelement_check =0;
                                                    if(indexsize)
                                                        startelement_check =Indication_array[Offset] +(Indication_array[Offset+1]*0x100); 
                                                    else
                                                        startelement_check =Indication_array[Offset];
                                               
                                                    if(startelement_check ==gReceivedCalls_Pos[i])
                                                    {   
                                                        current_element =i; 
                                                        CacheElements   =TRUE;
                                                    }
                                                    startelement_check=0;
                                                }  
                                            }
                                        }
                                        else
                                            CacheElements =FALSE;
                                        
                                        if (transmitpos)
                                        {   
                                            if(CacheElements ==TRUE)
                                            {   
                                                if(indexsize)
                                                {    
                                                    gReceivedCalls_Pos[current_element] =Indication_array[Offset];
                                                    Offset++;
                                                    gReceivedCalls_Pos[current_element] +=Indication_array[Offset] *0x100;
                                                }
                                                else
                                                    gReceivedCalls_Pos[current_element] =Indication_array[Offset];
                                            }
                                            Offset++;
                                        }
                                    
                                        //PbName
                                        if(CacheElements ==TRUE)
                                        {
                                            for(i=0; i<TEL_RECEIVEDCALLS_PBNAME_LENGTH;i++) //clear
			                                    gReceivedCalls_PbName[current_element][i] =0; 
                                        }
                                         
                                        length =Indication_array[Offset];
                                        Offset++;
                                    
                                        for(i=0; i<length;i++) //copy data
                                        {   
                                            if(CacheElements ==TRUE)
                                                gReceivedCalls_PbName[current_element][i] =Indication_array[Offset];
                                            Offset++;
                                        }
                                    
                                        //NumberType
                                        if(CacheElements ==TRUE)
                                        {
                                            gReceivedCalls_NumberType[current_element] =Indication_array[Offset];
                                            Offset++;
                                        }

                                        //TelNumber
                                        if(CacheElements ==TRUE)
                                        {
                                            for(i=0; i<TEL_RECEIVEDCALLS_TELNUMBER_LENGTH;i++) //clear
			                                    gReceivedCalls_TelNumber[current_element][i] =0; 
                                        }
                                         
                                        length =Indication_array[Offset];
                                        Offset++;
                                    
                                        for(i=0; i<length;i++) //copy data
                                        {   
                                            if(CacheElements ==TRUE)
                                                gReceivedCalls_TelNumber[current_element][i] =Indication_array[Offset];
                                            Offset++;
                                        }
                                    
                                        //Day
                                        if(CacheElements ==TRUE)
                                        {
                                            gReceivedCalls_day[current_element] =Indication_array[Offset];
                                            Offset++;
                                        }

                                        //Month
                                        if(CacheElements ==TRUE)
                                        {
                                            gReceivedCalls_month[current_element] =Indication_array[Offset];
                                            Offset++;
                                        }

                                        //Year
                                        if(CacheElements ==TRUE)
                                        {
                                            gReceivedCalls_year[current_element] =Indication_array[Offset];
                                            Offset++;
                                        }

                                        //Hour
                                        if(CacheElements ==TRUE)
                                        {
                                            gReceivedCalls_hour[current_element] =Indication_array[Offset];
                                            Offset++;
                                        }

                                        //Minute
                                        if(CacheElements ==TRUE)
                                        {
                                            gReceivedCalls_minute[current_element] =Indication_array[Offset];
                                            Offset++;
                                        }

                                        //Second
                                        if(CacheElements ==TRUE)
                                        {
                                            gReceivedCalls_second[current_element] =Indication_array[Offset];
                                            Offset++;
                                        }
                                    
                                        if(CacheElements ==TRUE)                                   
                                            gReceivedCalls_ListEntryReceptionInformation [current_element] =TRUE;
                                    
                                        if(CacheElements ==TRUE)    
                                            current_element =ReceivedCalls_GetNextLineInCache (current_element, direction); //go on with next element       
                                    }   //copy data of current element finished
                                }       //copy of elements finished
                            }           //startelement !=0 ends
                        
                        break; //recordaddress =0 ends
                    
                        case 1: //recordaddress =1 -> PbName, NumberType
                                /***startelement ==0***/                        
                            if(0==startelement && gReceivedCalls_ListHandlingType ==TEL_RECEIVEDCALLS_BUILDUPCACHE)
                            {     
                                /***find "start line" in ASG cache***/
                                if(FORWARD ==direction)
                                {    
                                    if (gReceivedCalls_cacheDown)
                                    {   
                                        current_element         =5; //it's the Pos of last element in ASG cache
                                    
                                        //reset "sliding window" values
                                        gReceivedCalls_cacheDown         =FALSE;
                                    }
                                    else
                                        current_element =startelement;
                                    
                                    if (shift ==TRUE) //startelement not next element
                                        current_element =ReceivedCalls_GetNextLineInCache (current_element, direction);   
                                }   
                            
                                else if(BACKWARD ==direction && shift==TRUE)
                                {
                                    if(gReceivedCalls_cacheUp)
                                    {   
                                        current_element         =6; //it's the Pos of first element in ASG cache
                                    
                                        //reset "sliding window" values
                                            gReceivedCalls_cacheUp           =FALSE;
                                    }
                                    else 
                                        current_element =TEL_RECEIVEDCALLS_ASGCACHE_MAX_SIZE -1; // position of last element in array 
                                }                
                                
                                /***copy elements***/
                                if (current_element !=TEL_RECEIVEDCALLS_NO_NEXT_POSITION) 
                                {
                                    for (j=0; j<elements;j++) //copy elements
                                    {   
                                        //check, if elements must be cached and in case find position in array
                                        CacheElements =FALSE;
                                        for (i=0; i<TEL_RECEIVEDCALLS_ASGCACHE_MAX_SIZE; i++)
                                        {  
                                            //if element already cached, find position in ASG-cache
                                            if(indexsize ==FALSE && (transmitpos ==TRUE) && Indication_array[Offset] ==gReceivedCalls_Pos[i] && gReceivedCalls_ListEntryReceptionInformation[i] ==TRUE)
                                            {   
                                                current_element =i; 
                                                CacheElements   =TRUE;
                                            }
                                            else if((indexsize ==TRUE && (transmitpos ==TRUE) && (Indication_array[Offset] +(Indication_array[Offset+1]*0x100)) ==gReceivedCalls_Pos[i] && gReceivedCalls_ListEntryReceptionInformation[i] ==TRUE))
                                            {   
                                                current_element =i; 
                                                CacheElements   =TRUE;
                                            }
                                            //if not already cached, then store element only, if Cache is build-up!
                                            else if((gReceivedCalls_ListHandlingType !=TEL_RECEIVEDCALLS_NOCACHE))
                                                CacheElements   =TRUE;
                                        }
                                                                       
                                        if (transmitpos)
                                        {   
                                            if(CacheElements ==TRUE)
                                            {   
                                                if(indexsize)
                                                {    
                                                    gReceivedCalls_Pos[current_element] =Indication_array[Offset];
                                                    Offset++;
                                                    gReceivedCalls_Pos[current_element] +=Indication_array[Offset] *0x100;
                                                }
                                                else
                                                    gReceivedCalls_Pos[current_element] =Indication_array[Offset]; 
                                            }
                                            Offset++;
                                        }
                                    
                                        //PbName
                                        if(CacheElements ==TRUE)
                                        {
                                            for(i=0; i<TEL_RECEIVEDCALLS_PBNAME_LENGTH;i++) //clear
			                                    gReceivedCalls_PbName[current_element][i] =0; 
                                        }
                                         
                                        length =Indication_array[Offset];
                                        Offset++;
                                    
                                        for(i=0; i<length;i++) //copy data
                                        {   
                                            if(CacheElements ==TRUE)
                                                gReceivedCalls_PbName[current_element][i] =Indication_array[Offset];
                                            Offset++;
                                        }
                                    
                                        //NumberType
                                        if(CacheElements ==TRUE)
                                        {
                                            gReceivedCalls_NumberType[current_element] =Indication_array[Offset];
                                            Offset++;
                                        }
                                    
                                        if(CacheElements ==TRUE)                                    
                                            gReceivedCalls_ListEntryReceptionInformation [current_element] =TRUE;
                                                       
                                        current_element =ReceivedCalls_GetNextLineInCache (current_element, direction); //go on with next element     
                                    }   //copy data of current element finished
                                } //copy of elements finished       
                            } //startelement=0 ends
    
                            /***startelement !=0***/
                            else //if (((startelement !=0) && (gReceivedCalls_ListHandlingType ==TEL_RECEIVEDCALLS_BUILDUPCACHE)) || ((startelement ==0) && (gReceivedCalls_ListHandlingType !=TEL_RECEIVEDCALLS_BUILDUPCACHE))) //startelement !=0
                            {
                                //searching for valid startelement in stored list
					            for(i=0;i<TEL_RECEIVEDCALLS_ASGCACHE_MAX_SIZE;i++)
					            {
						            if(gReceivedCalls_Pos[i] ==startelement)				//found a valid element
						            {                                                                                  
                                        current_element     =i;                         //found element is valid_startelement
						                StartElementInCache =TRUE;
                                        i                   =TEL_RECEIVEDCALLS_ASGCACHE_MAX_SIZE;
                                    }
					            }
                                if (StartElementInCache)
                                {   
                                    if (shift ==TRUE && startelement!=0) //first array element is next element
                                        current_element =ReceivedCalls_GetNextLineInCache (current_element, direction);                 
                                    else if(shift ==TRUE && startelement==0 && direction ==FORWARD)
                                        current_element=5;
                                   
                                    for (j=0; j<elements;j++) //copy elements
                                    {
                                        if(current_element !=TEL_RECEIVEDCALLS_NO_NEXT_POSITION)
                                        {
                                            CacheElements =TRUE;
                                            //if element already exist in ASG-cache, search the position 
                                            for (i=0; i<TEL_RECEIVEDCALLS_ASGCACHE_MAX_SIZE; i++)
                                            {   
                                                if((transmitpos ==TRUE) && gReceivedCalls_ListEntryReceptionInformation[i] ==TRUE)
                                                {   
                                                    startelement_check =0;
                                                    if(indexsize)
                                                        startelement_check =Indication_array[Offset] +(Indication_array[Offset+1]*0x100); 
                                                    else
                                                        startelement_check =Indication_array[Offset];
                                               
                                                    if(startelement_check ==gReceivedCalls_Pos[i])
                                                    {   
                                                        current_element =i; 
                                                        CacheElements   =TRUE;
                                                    }
                                                    startelement_check=0;
                                                }  
                                            }
                                        }
                                        else
                                            CacheElements =FALSE;
                                        
                                        if (transmitpos)
                                        {   
                                            if(CacheElements ==TRUE)
                                            {   
                                                if(indexsize)
                                                {    
                                                    gReceivedCalls_Pos[current_element] =Indication_array[Offset];
                                                    Offset++;
                                                    gReceivedCalls_Pos[current_element] +=Indication_array[Offset] *0x100;
                                                }
                                                else
                                                    gReceivedCalls_Pos[current_element] =Indication_array[Offset];
                                            }
                                            Offset++;
                                        }
                                    
                                        //PbName
                                        if(CacheElements ==TRUE)
                                        {
                                            for(i=0; i<TEL_RECEIVEDCALLS_PBNAME_LENGTH;i++) //clear
			                                    gReceivedCalls_PbName[current_element][i] =0; 
                                        }
                                         
                                        length =Indication_array[Offset];
                                        Offset++;
                                    
                                        for(i=0; i<length;i++) //copy data
                                        {   
                                            if(CacheElements ==TRUE)
                                                gReceivedCalls_PbName[current_element][i] =Indication_array[Offset];
                                            Offset++;
                                        }
                                    
                                        //NumberType
                                        if(CacheElements ==TRUE)
                                        {
                                            gReceivedCalls_NumberType[current_element] =Indication_array[Offset];
                                            Offset++;
                                        }
                                    
                                        if(CacheElements ==TRUE)                                   
                                            gReceivedCalls_ListEntryReceptionInformation [current_element] =TRUE;
                                    
                                        if(CacheElements ==TRUE)    
                                            current_element =ReceivedCalls_GetNextLineInCache (current_element, direction); //go on with next element       
                                    }   //copy data of current element finished
                                }       //copy of elements finished
                            }           //startelement !=0 ends   
                        break; //recordaddress =1 ends
                    
                        case 2: //recordaddress =2 -> TelNumber, Day, Month, Year, Hour, Minute, Second
                            /***startelement ==0***/                        
                            if(0==startelement && gReceivedCalls_ListHandlingType ==TEL_RECEIVEDCALLS_BUILDUPCACHE)
                            {     
                                /***find "start line" in ASG cache***/
                                if(FORWARD ==direction)
                                {    
                                    if (gReceivedCalls_cacheDown)
                                    {   
                                        current_element         =5; //it's the Pos of last element in ASG cache
                                    
                                        //reset "sliding window" values
                                        gReceivedCalls_cacheDown         =FALSE;
                                    }
                                    else
                                        current_element =startelement;
                                    
                                    if (shift ==TRUE) //startelement not next element
                                        current_element =ReceivedCalls_GetNextLineInCache (current_element, direction);   
                                }
                            
                                else if(BACKWARD ==direction && shift==TRUE)
                                {
                                    if(gReceivedCalls_cacheUp)
                                    {   
                                        current_element         =6; //it's the Pos of first element in ASG cache
                                    
                                        //reset "sliding window" values
                                            gReceivedCalls_cacheUp           =FALSE;
                                    }
                                    else 
                                        current_element =TEL_RECEIVEDCALLS_ASGCACHE_MAX_SIZE -1; // position of last element in array 
                                }                
                                
                                /***copy elements***/
                                if (current_element !=TEL_RECEIVEDCALLS_NO_NEXT_POSITION) 
                                {
                                    for (j=0; j<elements;j++) //copy elements
                                    {   
                                        //check, if elements must be cached and in case find position in array
                                        CacheElements =FALSE;
                                        for (i=0; i<TEL_RECEIVEDCALLS_ASGCACHE_MAX_SIZE; i++)
                                        {  
                                            //if element already cached, find position in ASG-cache
                                            if(indexsize ==FALSE && (transmitpos ==TRUE) && Indication_array[Offset] ==gReceivedCalls_Pos[i] && gReceivedCalls_ListEntryReceptionInformation[i] ==TRUE)
                                            {   
                                                current_element =i; 
                                                CacheElements   =TRUE;
                                            }
                                            else if((indexsize ==TRUE && (transmitpos ==TRUE) && (Indication_array[Offset] +(Indication_array[Offset+1]*0x100)) ==gReceivedCalls_Pos[i] && gReceivedCalls_ListEntryReceptionInformation[i] ==TRUE))
                                            {   
                                                current_element =i; 
                                                CacheElements   =TRUE;
                                            }
                                            //if not already cached, then store element only, if Cache is build-up!
                                            else if((gReceivedCalls_ListHandlingType !=TEL_RECEIVEDCALLS_NOCACHE))
                                                CacheElements   =TRUE;
                                        }
                                                                       
                                        if (transmitpos)
                                        {   
                                            if(CacheElements ==TRUE)
                                            {   
                                                if(indexsize)
                                                {    
                                                    gReceivedCalls_Pos[current_element] =Indication_array[Offset];
                                                    Offset++;
                                                    gReceivedCalls_Pos[current_element] +=Indication_array[Offset] *0x100;
                                                }
                                                else
                                                    gReceivedCalls_Pos[current_element] =Indication_array[Offset]; 
                                            }
                                            Offset++;
                                        }

                                        //TelNumber
                                        if(CacheElements ==TRUE)
                                        {
                                            for(i=0; i<TEL_RECEIVEDCALLS_TELNUMBER_LENGTH;i++) //clear
			                                    gReceivedCalls_TelNumber[current_element][i] =0; 
                                        }
                                         
                                        length =Indication_array[Offset];
                                        Offset++;
                                    
                                        for(i=0; i<length;i++) //copy data
                                        {   
                                            if(CacheElements ==TRUE)
                                                gReceivedCalls_TelNumber[current_element][i] =Indication_array[Offset];
                                            Offset++;
                                        }
                                    
                                        //Day
                                        if(CacheElements ==TRUE)
                                        {
                                            gReceivedCalls_day[current_element] =Indication_array[Offset];
                                            Offset++;
                                        }

                                        //Month
                                        if(CacheElements ==TRUE)
                                        {
                                            gReceivedCalls_month[current_element] =Indication_array[Offset];
                                            Offset++;
                                        }

                                        //Year
                                        if(CacheElements ==TRUE)
                                        {
                                            gReceivedCalls_year[current_element] =Indication_array[Offset];
                                            Offset++;
                                        }

                                        //Hour
                                        if(CacheElements ==TRUE)
                                        {
                                            gReceivedCalls_hour[current_element] =Indication_array[Offset];
                                            Offset++;
                                        }

                                        //Minute
                                        if(CacheElements ==TRUE)
                                        {
                                            gReceivedCalls_minute[current_element] =Indication_array[Offset];
                                            Offset++;
                                        }

                                        //Second
                                        if(CacheElements ==TRUE)
                                        {
                                            gReceivedCalls_second[current_element] =Indication_array[Offset];
                                            Offset++;
                                        }
                                    
                                        if(CacheElements ==TRUE)                                    
                                            gReceivedCalls_ListEntryReceptionInformation [current_element] =TRUE;
                                                       
                                        current_element =ReceivedCalls_GetNextLineInCache (current_element, direction); //go on with next element     
                                    }   //copy data of current element finished
                                } //copy of elements finished       
                            } //startelement=0 ends
    
                            /***startelement !=0***/
                            else //if (((startelement !=0) && (gReceivedCalls_ListHandlingType ==TEL_RECEIVEDCALLS_BUILDUPCACHE)) || ((startelement ==0) && (gReceivedCalls_ListHandlingType !=TEL_RECEIVEDCALLS_BUILDUPCACHE))) //startelement !=0
                            {
                                //searching for valid startelement in stored list
					            for(i=0;i<TEL_RECEIVEDCALLS_ASGCACHE_MAX_SIZE;i++)
					            {
						            if(gReceivedCalls_Pos[i] ==startelement)				//found a valid element
						            {                                                                                  
                                        current_element     =i;                         //found element is valid_startelement
						                StartElementInCache =TRUE;
                                        i                   =TEL_RECEIVEDCALLS_ASGCACHE_MAX_SIZE;
                                    }
					            }
                                if (StartElementInCache)
                                {   
                                    if (shift ==TRUE && startelement!=0) //first array element is next element
                                        current_element =ReceivedCalls_GetNextLineInCache (current_element, direction);                 
                                    else if(shift ==TRUE && startelement==0 && direction ==FORWARD)
                                        current_element=5;
                                   
                                    for (j=0; j<elements;j++) //copy elements
                                    {
                                        if(current_element !=TEL_RECEIVEDCALLS_NO_NEXT_POSITION)
                                        {
                                            CacheElements =TRUE;
                                            //if element already exist in ASG-cache, search the position 
                                            for (i=0; i<TEL_RECEIVEDCALLS_ASGCACHE_MAX_SIZE; i++)
                                            {   
                                                if((transmitpos ==TRUE) && gReceivedCalls_ListEntryReceptionInformation[i] ==TRUE)
                                                {   
                                                    startelement_check =0;
                                                    if(indexsize)
                                                        startelement_check =Indication_array[Offset] +(Indication_array[Offset+1]*0x100); 
                                                    else
                                                        startelement_check =Indication_array[Offset];
                                               
                                                    if(startelement_check ==gReceivedCalls_Pos[i])
                                                    {   
                                                        current_element =i; 
                                                        CacheElements   =TRUE;
                                                    }
                                                    startelement_check=0;
                                                }  
                                            }
                                        }
                                        else
                                            CacheElements =FALSE;
                                        
                                        if (transmitpos)
                                        {   
                                            if(CacheElements ==TRUE)
                                            {   
                                                if(indexsize)
                                                {    
                                                    gReceivedCalls_Pos[current_element] =Indication_array[Offset];
                                                    Offset++;
                                                    gReceivedCalls_Pos[current_element] +=Indication_array[Offset] *0x100;
                                                }
                                                else
                                                    gReceivedCalls_Pos[current_element] =Indication_array[Offset];
                                            }
                                            Offset++;
                                        }
                                    
                                        //TelNumber
                                        if(CacheElements ==TRUE)
                                        {
                                            for(i=0; i<TEL_RECEIVEDCALLS_TELNUMBER_LENGTH;i++) //clear
			                                    gReceivedCalls_TelNumber[current_element][i] =0; 
                                        }
                                         
                                        length =Indication_array[Offset];
                                        Offset++;
                                    
                                        for(i=0; i<length;i++) //copy data
                                        {   
                                            if(CacheElements ==TRUE)
                                                gReceivedCalls_TelNumber[current_element][i] =Indication_array[Offset];
                                            Offset++;
                                        }
                                    
                                        //Day
                                        if(CacheElements ==TRUE)
                                        {
                                            gReceivedCalls_day[current_element] =Indication_array[Offset];
                                            Offset++;
                                        }

                                        //Month
                                        if(CacheElements ==TRUE)
                                        {
                                            gReceivedCalls_month[current_element] =Indication_array[Offset];
                                            Offset++;
                                        }

                                        //Year
                                        if(CacheElements ==TRUE)
                                        {
                                            gReceivedCalls_year[current_element] =Indication_array[Offset];
                                            Offset++;
                                        }

                                        //Hour
                                        if(CacheElements ==TRUE)
                                        {
                                            gReceivedCalls_hour[current_element] =Indication_array[Offset];
                                            Offset++;
                                        }

                                        //Minute
                                        if(CacheElements ==TRUE)
                                        {
                                            gReceivedCalls_minute[current_element] =Indication_array[Offset];
                                            Offset++;
                                        }

                                        //Second
                                        if(CacheElements ==TRUE)
                                        {
                                            gReceivedCalls_second[current_element] =Indication_array[Offset];
                                            Offset++;
                                        }
                                    
                                        if(CacheElements ==TRUE)                                   
                                            gReceivedCalls_ListEntryReceptionInformation [current_element] =TRUE;
                                    
                                        if(CacheElements ==TRUE)    
                                            current_element =ReceivedCalls_GetNextLineInCache (current_element, direction); //go on with next element       
                                    }   //copy data of current element finished
                                }       //copy of elements finished
                            }           //startelement !=0 ends
                        break; //recordaddress =2 ends
                    
                        case 15: //recordaddress =0xf -> Pos
                            /***startelement ==0***/                        
                            if(0==startelement && gReceivedCalls_ListHandlingType ==TEL_RECEIVEDCALLS_BUILDUPCACHE)
                            {     
                                /***find "start line" in ASG cache***/
                                if(FORWARD ==direction)
                                {    
                                    if (gReceivedCalls_cacheDown)
                                    {   
                                        current_element         =5; //it's the Pos of last element in ASG cache
                                    
                                        //reset "sliding window" values
                                        gReceivedCalls_cacheDown         =FALSE;
                                    }
                                    else
                                        current_element =startelement;
                                    
                                    if (shift ==TRUE) //startelement not next element
                                        current_element =ReceivedCalls_GetNextLineInCache (current_element, direction);   
                                }
                            
                                else if(BACKWARD ==direction && shift==TRUE)
                                {
                                    if(gReceivedCalls_cacheUp)
                                    {   
                                        current_element         =6; //it's the Pos of first element in ASG cache
                                    
                                        //reset "sliding window" values
                                            gReceivedCalls_cacheUp           =FALSE;
                                    }
                                    else 
                                        current_element =TEL_RECEIVEDCALLS_ASGCACHE_MAX_SIZE -1; // position of last element in array 
                                }                
                                
                                /***copy elements***/
                                if (current_element !=TEL_RECEIVEDCALLS_NO_NEXT_POSITION) 
                                {
                                    for (j=0; j<elements;j++) //copy elements
                                    {   
                                        //check, if elements must be cached and in case find position in array
                                        CacheElements =FALSE;
                                        for (i=0; i<TEL_RECEIVEDCALLS_ASGCACHE_MAX_SIZE; i++)
                                        {  
                                            //if element already cached, find position in ASG-cache
                                            if(indexsize ==FALSE && (transmitpos ==TRUE) && Indication_array[Offset] ==gReceivedCalls_Pos[i] && gReceivedCalls_ListEntryReceptionInformation[i] ==TRUE)
                                            {   
                                                current_element =i; 
                                                CacheElements   =TRUE;
                                            }
                                            else if((indexsize ==TRUE && (transmitpos ==TRUE) && (Indication_array[Offset] +(Indication_array[Offset+1]*0x100)) ==gReceivedCalls_Pos[i] && gReceivedCalls_ListEntryReceptionInformation[i] ==TRUE))
                                            {   
                                                current_element =i; 
                                                CacheElements   =TRUE;
                                            }
                                            //if not already cached, then store element only, if Cache is build-up!
                                            else if((gReceivedCalls_ListHandlingType !=TEL_RECEIVEDCALLS_NOCACHE))
                                                CacheElements   =TRUE;
                                        }
                                                                       
                                        if (transmitpos)
                                        {   
                                            if(CacheElements ==TRUE)
                                            {   
                                                if(indexsize)
                                                {    
                                                    gReceivedCalls_Pos[current_element] =Indication_array[Offset];
                                                    Offset++;
                                                    gReceivedCalls_Pos[current_element] +=Indication_array[Offset] *0x100;
                                                }
                                                else
                                                    gReceivedCalls_Pos[current_element] =Indication_array[Offset]; 
                                            }
                                            Offset++;
                                        }
                                    
                                        if(CacheElements ==TRUE)                                    
                                            gReceivedCalls_ListEntryReceptionInformation [current_element] =TRUE;
                                                       
                                        current_element =ReceivedCalls_GetNextLineInCache (current_element, direction); //go on with next element     
                                    }   //copy data of current element finished
                                } //copy of elements finished       
                            } //startelement=0 ends
    
                            /***startelement !=0***/
                            else //if (((startelement !=0) && (gReceivedCalls_ListHandlingType ==TEL_RECEIVEDCALLS_BUILDUPCACHE)) || ((startelement ==0) && (gReceivedCalls_ListHandlingType !=TEL_RECEIVEDCALLS_BUILDUPCACHE))) //startelement !=0
                            {
                                //searching for valid startelement in stored list
					            for(i=0;i<TEL_RECEIVEDCALLS_ASGCACHE_MAX_SIZE;i++)
					            {
						            if(gReceivedCalls_Pos[i] ==startelement)				//found a valid element
						            {                                                                                  
                                        current_element     =i;                         //found element is valid_startelement
						                StartElementInCache =TRUE;
                                        i                   =TEL_RECEIVEDCALLS_ASGCACHE_MAX_SIZE;
                                    }
					            }
                                if (StartElementInCache)
                                {   
                                    if (shift ==TRUE && startelement!=0) //first array element is next element
                                        current_element =ReceivedCalls_GetNextLineInCache (current_element, direction);                 
                                    else if(shift ==TRUE && startelement==0 && direction ==FORWARD)
                                        current_element=5;
                                   
                                    for (j=0; j<elements;j++) //copy elements
                                    {
                                        if(current_element !=TEL_RECEIVEDCALLS_NO_NEXT_POSITION)
                                        {
                                            CacheElements =TRUE;
                                            //if element already exist in ASG-cache, search the position 
                                            for (i=0; i<TEL_RECEIVEDCALLS_ASGCACHE_MAX_SIZE; i++)
                                            {   
                                                if((transmitpos ==TRUE) && gReceivedCalls_ListEntryReceptionInformation[i] ==TRUE)
                                                {   
                                                    startelement_check =0;
                                                    if(indexsize)
                                                        startelement_check =Indication_array[Offset] +(Indication_array[Offset+1]*0x100); 
                                                    else
                                                        startelement_check =Indication_array[Offset];
                                               
                                                    if(startelement_check ==gReceivedCalls_Pos[i])
                                                    {   
                                                        current_element =i; 
                                                        CacheElements   =TRUE;
                                                    }
                                                    startelement_check=0;
                                                }  
                                            }
                                        }
                                        else
                                            CacheElements =FALSE;
                                        
                                        if (transmitpos)
                                        {   
                                            if(CacheElements ==TRUE)
                                            {   
                                                if(indexsize)
                                                {    
                                                    gReceivedCalls_Pos[current_element] =Indication_array[Offset];
                                                    Offset++;
                                                    gReceivedCalls_Pos[current_element] +=Indication_array[Offset] *0x100;
                                                }
                                                else
                                                    gReceivedCalls_Pos[current_element] =Indication_array[Offset];
                                            }
                                            Offset++;
                                        }
                                    
                                        if(CacheElements ==TRUE)                                   
                                            gReceivedCalls_ListEntryReceptionInformation [current_element] =TRUE;
                                    
                                        if(CacheElements ==TRUE)    
                                            current_element =ReceivedCalls_GetNextLineInCache (current_element, direction); //go on with next element       
                                    }   //copy data of current element finished
                                }       //copy of elements finished
                            }           //startelement !=0 ends
                        break; //recordaddress =0xf ends
                    }
                }
                                   
                gReceivedCalls_recordaddress =recordaddress;
                gReceivedCalls_transmitpos   =transmitpos;

                //send StatusArray
                transmitpos =FALSE;
                if(startelement>0xFF)
                    indexsize =TRUE;
                else
                    indexsize =FALSE;
                    
                mode    =shift +(direction*0x02) +(transmitpos*0x04) +indexsize*0x08;
                ReceivedCalls_Request(DataGet_REQ, mode, recordaddress, startelement, startelement, elements);

            break;
			
            case Error_IND:
					
				if(Indication_array[3]<0x20 && Indication_array[3] !=0)				//BCL-error
					writelineEx(gError_Trace, 0, "ASG-Telephone ReceivedCalls_Indication: BCL-Error: 0x%x - %s", Indication_array[3], gerror_codes_BCL [Indication_array[3]-0x10]);
				else if(Indication_array[3]<0x30)			//BPL-error
					writelineEx(gError_Trace, 0, "ASG-Telephone ReceivedCalls_Indication: BPL-Error: 0x%x - %s", Indication_array[3], gerror_codes_BPL [Indication_array[3]-0x20]);				
				else if(Indication_array[3]<0x40)			//BAL-error
					writelineEx(gError_Trace, 0, "ASG-Telephone ReceivedCalls_Indication: BAL-Error: 0x%x - %s", Indication_array[3], gerror_codes_BAL [Indication_array[3]-0x30]);
				else
					writelineEx(gError_Trace, 0, "ASG-Telephone ReceivedCalls_Indication: Application-Error: 0x%x", Indication_array[3]);
				
		break;
		default:
			writelineEx(gError_Trace, 0,"ASG-Telefon ReceivedCalls_Indication: unknown indication %x", gBAP_Indication[2]);
		break;
		}

    //for "sliding window concept"
    if(gBAP_Indication[2] !=Error_IND)
    {
        if(gReceivedCalls_TotalNumListElements<=TEL_RECEIVEDCALLS_ASGCACHE_MAX_SIZE)
            gReceivedCalls_SlidingWindow_State =TEL_RECEIVEDCALLS_SLIDINGWINDOW_NOTACTIVE;
        else
            gReceivedCalls_SlidingWindow_State =TEL_RECEIVEDCALLS_SLIDINGWINDOW_ACTIVE;

        if (gReceivedCalls_CallBackReason !=TEL_RECEIVEDCALLS_CALLBACKREASON_NOCALLBACK)
            ReceivedCalls_ListHandling ();
        else
            ReceivedCalls_display();
    }
}
/*@@end*/

/*@@caplFunc:deletecallstackreceivedcalls():*/
deletecallstackreceivedcalls ()
{
int i, j;

	for(j=0;j<CALLSTACK;j++)
    {
		for(i=0;i<CALL_INFO_NAME_LENGTH;i++)
			greceivedcalls_pbname[j][i]=0;									//delete PbName
   		greceivedcalls_numbertype[j]=0;									//delete NumberType
        for(i=0;i<CALL_INFO_NUMBER_LENGTH;i++)
			greceivedcalls_telnumber[j][i]=0;								//delete TelNumber
		for(i=0;i<7;i++)
        {
			greceivedcalls_date[j][i]=0;									//delete Date
			greceivedcalls_time[j][i]=0;									//delete Time
		}
		
	}
}
/*@@end*/

/*@@caplFunc:display_callstack_receivedcalls():*/
display_callstack_receivedcalls ()
{
int callstackline, i;
char dialdate[CALLSTACK][9];
char dialtime[CALLSTACK][9];
char numbertype[CALLSTACK][10];

char empty_string[3];
	
//init lokal variables
	for(i=0;i<3;i++)
		empty_string[i]=0;
//********************

	//PbName
	putvalue(env_RNS_receivedcall0_PbName, greceivedcalls_pbname [0]);
	putvalue(env_RNS_receivedcall1_PbName, greceivedcalls_pbname [1]);
	putvalue(env_RNS_receivedcall2_PbName, greceivedcalls_pbname [2]);
	putvalue(env_RNS_receivedcall3_PbName, greceivedcalls_pbname [3]);
	putvalue(env_RNS_receivedcall4_PbName, greceivedcalls_pbname [4]);
	putvalue(env_RNS_receivedcall5_PbName, greceivedcalls_pbname [5]);
	putvalue(env_RNS_receivedcall6_PbName, greceivedcalls_pbname [6]);
	putvalue(env_RNS_receivedcall7_PbName, greceivedcalls_pbname [7]);
	putvalue(env_RNS_receivedcall8_PbName, greceivedcalls_pbname [8]);
	putvalue(env_RNS_receivedcall9_PbName, greceivedcalls_pbname [9]);
	putvalue(env_RNS_receivedcall10_PbName, greceivedcalls_pbname [10]);
	putvalue(env_RNS_receivedcall11_PbName, greceivedcalls_pbname [11]);
	putvalue(env_RNS_receivedcall12_PbName, greceivedcalls_pbname [12]);
	putvalue(env_RNS_receivedcall13_PbName, greceivedcalls_pbname [13]);
	putvalue(env_RNS_receivedcall14_PbName, greceivedcalls_pbname [14]);
	putvalue(env_RNS_receivedcall15_PbName, greceivedcalls_pbname [15]);
	putvalue(env_RNS_receivedcall16_PbName, greceivedcalls_pbname [16]);
	putvalue(env_RNS_receivedcall17_PbName, greceivedcalls_pbname [17]);
	putvalue(env_RNS_receivedcall18_PbName, greceivedcalls_pbname [18]);
	putvalue(env_RNS_receivedcall19_PbName, greceivedcalls_pbname [19]);

	//TelNumber
	putvalue(env_RNS_receivedcall0_TelNumber, greceivedcalls_telnumber [0]);
	putvalue(env_RNS_receivedcall1_TelNumber, greceivedcalls_telnumber [1]);
	putvalue(env_RNS_receivedcall2_TelNumber, greceivedcalls_telnumber [2]);
	putvalue(env_RNS_receivedcall3_TelNumber, greceivedcalls_telnumber [3]);
	putvalue(env_RNS_receivedcall4_TelNumber, greceivedcalls_telnumber [4]);
	putvalue(env_RNS_receivedcall5_TelNumber, greceivedcalls_telnumber [5]);
	putvalue(env_RNS_receivedcall6_TelNumber, greceivedcalls_telnumber [6]);
	putvalue(env_RNS_receivedcall7_TelNumber, greceivedcalls_telnumber [7]);
	putvalue(env_RNS_receivedcall8_TelNumber, greceivedcalls_telnumber [8]);
	putvalue(env_RNS_receivedcall9_TelNumber, greceivedcalls_telnumber [9]);
	putvalue(env_RNS_receivedcall10_TelNumber, greceivedcalls_telnumber [10]);
	putvalue(env_RNS_receivedcall11_TelNumber, greceivedcalls_telnumber [11]);
	putvalue(env_RNS_receivedcall12_TelNumber, greceivedcalls_telnumber [12]);
	putvalue(env_RNS_receivedcall13_TelNumber, greceivedcalls_telnumber [13]);
	putvalue(env_RNS_receivedcall14_TelNumber, greceivedcalls_telnumber [14]);
	putvalue(env_RNS_receivedcall15_TelNumber, greceivedcalls_telnumber [15]);
	putvalue(env_RNS_receivedcall16_TelNumber, greceivedcalls_telnumber [16]);
	putvalue(env_RNS_receivedcall17_TelNumber, greceivedcalls_telnumber [17]);
	putvalue(env_RNS_receivedcall18_TelNumber, greceivedcalls_telnumber [18]);
	putvalue(env_RNS_receivedcall19_TelNumber, greceivedcalls_telnumber [19]);
	
	

	//Date
	for(callstackline=0;callstackline<20;callstackline++){
		dialdate[callstackline][0]=greceivedcalls_date[callstackline][0];
		dialdate[callstackline][1]=greceivedcalls_date[callstackline][1];
		dialdate[callstackline][2]='.';
		dialdate[callstackline][3]=greceivedcalls_date[callstackline][2];
		dialdate[callstackline][4]=greceivedcalls_date[callstackline][3];
		dialdate[callstackline][5]='.';
		dialdate[callstackline][6]=greceivedcalls_date[callstackline][4];
		dialdate[callstackline][7]=greceivedcalls_date[callstackline][5];
	}

	putvalue(env_RNS_receivedcall0_date, dialdate [0]);
	putvalue(env_RNS_receivedcall1_date, dialdate [1]);
	putvalue(env_RNS_receivedcall2_date, dialdate [2]);
	putvalue(env_RNS_receivedcall3_date, dialdate [3]);
	putvalue(env_RNS_receivedcall4_date, dialdate [4]);
	putvalue(env_RNS_receivedcall5_date, dialdate [5]);
	putvalue(env_RNS_receivedcall6_date, dialdate [6]);
	putvalue(env_RNS_receivedcall7_date, dialdate [7]);
	putvalue(env_RNS_receivedcall8_date, dialdate [8]);
	putvalue(env_RNS_receivedcall9_date, dialdate [9]);
	putvalue(env_RNS_receivedcall10_date, dialdate [10]);
	putvalue(env_RNS_receivedcall11_date, dialdate [11]);
	putvalue(env_RNS_receivedcall12_date, dialdate [12]);
	putvalue(env_RNS_receivedcall13_date, dialdate [13]);
	putvalue(env_RNS_receivedcall14_date, dialdate [14]);
	putvalue(env_RNS_receivedcall15_date, dialdate [15]);
	putvalue(env_RNS_receivedcall16_date, dialdate [16]);
	putvalue(env_RNS_receivedcall17_date, dialdate [17]);
	putvalue(env_RNS_receivedcall18_date, dialdate [18]);
	putvalue(env_RNS_receivedcall19_date, dialdate [19]);

	//time
	for(callstackline=0;callstackline<20;callstackline++){
		dialtime[callstackline][0]=greceivedcalls_time[callstackline][0];
		dialtime[callstackline][1]=greceivedcalls_time[callstackline][1];
		dialtime[callstackline][2]=':';
		dialtime[callstackline][3]=greceivedcalls_time[callstackline][2];
		dialtime[callstackline][4]=greceivedcalls_time[callstackline][3];
		dialtime[callstackline][5]=':';
		dialtime[callstackline][6]=greceivedcalls_time[callstackline][4];
		dialtime[callstackline][7]=greceivedcalls_time[callstackline][5];
	}
	putvalue(env_RNS_receivedcall0_time, dialtime [0]);
	putvalue(env_RNS_receivedcall1_time, dialtime [1]);
	putvalue(env_RNS_receivedcall2_time, dialtime [2]);
	putvalue(env_RNS_receivedcall3_time, dialtime [3]);
	putvalue(env_RNS_receivedcall4_time, dialtime [4]);
	putvalue(env_RNS_receivedcall5_time, dialtime [5]);
	putvalue(env_RNS_receivedcall6_time, dialtime [6]);
	putvalue(env_RNS_receivedcall7_time, dialtime [7]);
	putvalue(env_RNS_receivedcall8_time, dialtime [8]);
	putvalue(env_RNS_receivedcall9_time, dialtime [9]);
	putvalue(env_RNS_receivedcall10_time, dialtime [10]);
	putvalue(env_RNS_receivedcall11_time, dialtime [11]);
	putvalue(env_RNS_receivedcall12_time, dialtime [12]);
	putvalue(env_RNS_receivedcall13_time, dialtime [13]);
	putvalue(env_RNS_receivedcall14_time, dialtime [14]);
	putvalue(env_RNS_receivedcall15_time, dialtime [15]);
	putvalue(env_RNS_receivedcall16_time, dialtime [16]);
	putvalue(env_RNS_receivedcall17_time, dialtime [17]);
	putvalue(env_RNS_receivedcall18_time, dialtime [18]);
	putvalue(env_RNS_receivedcall19_time, dialtime [19]);

	//numbertype
	for(i=0;i<20;i++){
		if(greceivedcalls_numbertype[i]<0x0F)
			strncpy(numbertype[i], gnumbertype[greceivedcalls_numbertype[i]], 15);
		else
			strncpy(numbertype[i], empty_string, 15);
	}
	putvalue(env_RNS_receivedcall0_numbertype, numbertype [0]);
	putvalue(env_RNS_receivedcall1_numbertype, numbertype [1]);
	putvalue(env_RNS_receivedcall2_numbertype, numbertype [2]);
	putvalue(env_RNS_receivedcall3_numbertype, numbertype [3]);
	putvalue(env_RNS_receivedcall4_numbertype, numbertype [4]);
	putvalue(env_RNS_receivedcall5_numbertype, numbertype [5]);
	putvalue(env_RNS_receivedcall6_numbertype, numbertype [6]);
	putvalue(env_RNS_receivedcall7_numbertype, numbertype [7]);
	putvalue(env_RNS_receivedcall8_numbertype, numbertype [8]);
	putvalue(env_RNS_receivedcall9_numbertype, numbertype [9]);
	putvalue(env_RNS_receivedcall10_numbertyp, numbertype [10]);
	putvalue(env_RNS_receivedcall11_numbertyp, numbertype [11]);
	putvalue(env_RNS_receivedcall12_numbertyp, numbertype [12]);
	putvalue(env_RNS_receivedcall13_numbertyp, numbertype [13]);
	putvalue(env_RNS_receivedcall14_numbertyp, numbertype [14]);
	putvalue(env_RNS_receivedcall15_numbertyp, numbertype [15]);
	putvalue(env_RNS_receivedcall16_numbertyp, numbertype [16]);
	putvalue(env_RNS_receivedcall17_numbertyp, numbertype [17]);
	putvalue(env_RNS_receivedcall18_numbertyp, numbertype [18]);
	putvalue(env_RNS_receivedcall19_numbertyp, numbertype [19]);

}
/*@@end*/

/*@@envVar:env_RNS_MissedCallIndication:*/
on envVar env_RNS_MissedCallIndication
{
	if(gRNS_PowerOnOff==Power_on && getvalue(this))
    {
		gMissedCalls=getvalue(env_RNS_MissedCallInd_Calls);
		gMissedNumbers=getvalue(env_RNS_MissedCallInd_Numbers);

		MissedCallIndication_Request(DataSetGet_REQ, 0);
	}


}
/*@@end*/

/*@@caplFunc:init_variables_System():*/
init_variables_System ()
{

int i=0, j=0;
char empty_string [3];

//init lokal variables
	for(i=0;i<3;i++)
		empty_string[i]=0;
//********************

	
	gKl15=0;
	gKlS=0;	

	//BAP-Communication
	for (i=0;i<BAP_buffer_size;i++)
		gBAP_Indication[i]=0;
	
	for (j=0;j<Requestbuffer_lines;j++){
		gBAP_Requestbufffer_status[j]=0;
		gBAP_Requestbufffer_BAPDataTyp[j]=0;
	
		for (i=0;i<BAP_buffer_size;i++)
			gBAP_Request[j][i]=0;
	}

	gwrite_requestbuffer_line=0;
	gstatus_requestbuffer=0;

	//RGB-Values for background colors
	gRGB_red=MakeRGB(255,0,0);
	gRGB_yellow=MakeRGB(255,255,0);
	gRGB_green=MakeRGB(0,255,0);
	gRGB_grey=MakeRGB(192,192,192);
	gRGB_white=MakeRGB(255,255,255);


	//Bap-Phone
	gBAP_Phone_available=noBAPPhone;

	//SlidingWindow for MissedCalls
	gSlidingWindowMode=0;
	putvalue(env_ASG_SlidingWindow_OnOff, gSlidingWindowMode);
	putvalue(env_ASG_SlidingWindow_OnOff_str, gstring_SlW_Mode[gSlidingWindowMode]);

    EnableControl("ASG-Telephone_MissedCalls(array)","MissedCalls_GetArray",1);

    //Phonebook
    //SlidingWindow
	gPhonebook_SlW_Mode=0;
	putvalue(env_ASG_PB_SlW_OnOff, gPhonebook_SlW_Mode);
	putvalue(env_ASG_PB_SlW_OnOff_str, gstring_SlW_Mode[gPhonebook_SlW_Mode]);

    EnableControl("ASG-Telephone_Phonebook(array)","Phonebook_GetArray",1);

    //CombinedNumbers
    ClosePanel("ASG_Telephone_0x31 - CombinedNumbers_EditCache");

    //ReceivedCalls
    ClosePanel("ASG_Telephone_0x2F - ReceivedCalls_EditCache");
    
}
/*@@end*/

/*@@timer:Powerontimer:*/
on timer Powerontimer
{
	gRNS_PowerOnOff=1;

	settimer(TaskTimer, 10);					//start real CAN-communication timer

	//BAP_ProcessDebug(NODE_INDEX,DEBUG_CAN_CHANNEL, DEBUG_ID, LSGID_Phonebook, DEBUG_SWITCH_ON); //BAP-Debug-message	

}
/*@@end*/

/*@@caplFunc:Phonebook_Request(byte,word,word,byte,byte):*/
Phonebook_Request (byte request, word startelement, word elements, byte mode, byte errorcode)
{
int i, Offset, indexsize, recordaddress;
dword requestarray [BAP_buffer_size];

//*********
    //write("# (ASG) Phonebook_Request"); // debug
//*********

//init lokal variables
	Offset=0;
	indexsize=0;
	recordaddress=0;

	for(i=0;i<BAP_buffer_size;i++)
		requestarray [i]=0;	

//********************
	
	recordaddress=mode & 0x0f;
	indexsize=(mode & 0x80)/0x80;

	switch (request){
		case DataGet_REQ:
			//BAP-header
			requestarray[0]=LSGID_Telephone;	//LSG-ID
			requestarray[1]=FctID_Phonebook;	//Fct.-ID
			requestarray[2]=request;	
			
            //ASG_ID & TAID
            gPhonebook_ASG_ID=0x1;    //instrument cluster

            if(gPhonebook_TAID==0 || gPhonebook_TAID>15)    //invalid values
                gPhonebook_TAID=0x1;         //reset

            requestarray[3]=((gPhonebook_ASG_ID & 0x0F)*0x10) + (gPhonebook_TAID & 0x0F);//upper and lower nibble

			//extended array header
			requestarray[4]=mode;	//Mode
			if(indexsize){
				requestarray[5]=startelement & 0x00ff;
				requestarray[6]=(startelement & 0xff00)/256;
				requestarray[7]=elements & 0x00ff;
				requestarray[8]=(elements & 0xff00)/256;
				Offset=9;
			}
			else{
				requestarray[5]=startelement;
				requestarray[6]=elements;
				Offset=7;
			}
            //*****save evaluation items***********
		    gPhonebook_start = startelement;
            gPhonebook_elements = elements;
            gPhonebook_mode = mode;
            gPhonebook_shift = (mode&0x10)/0x10;
            gPhonebook_direction = (mode&0x20)/0x20;
            //write("ASG Phonebook_Request: ASG_ID 0x%x,TAID %d,start 0x%x,elements 0x%x,shift %d,direction %d",gPhonebook_ASG_ID,gPhonebook_TAID,gPhonebook_start,gPhonebook_elements,gPhonebook_shift,gPhonebook_direction);
            //*************************************

            
			set_status_requestbuffer (requestarray, Offset, Bap_ByteSequence);			
		break;
		default:
			writelineEx(gError_Trace, 0, "Phonebook_Request: unknown request %d", request);
		break;
	}

}
/*@@end*/

/*@@caplFunc:Phonebook_Indication(dword[],byte,int):*/
Phonebook_Indication (dword Indication_array [], byte indication, int datalength)
{
int i, length, position; 
word startelement, leeloo, elements, datapointer, phonebookline;
byte mode, direction, indexsize, transmitpos, shift, recordaddress, temp, restelems, startline, asg_id, taid;


//*********
    //write("# (ASG) Phonebook_Indication"); // debug
//*********


//init lokal variables
	length=0;
	startelement=0;
	leeloo=0;
	position=0;
	elements=0;
	mode=0;
	shift=0;
	direction=0;
	indexsize=0;
	transmitpos=0;
	recordaddress=0;
	datapointer=0;
    phonebookline=0;
    temp=0;
    startline=0;
    asg_id=0;
    taid=0;
//********************

	//temp=checkPhonebookarray(Indication_array, datalength);
    //write("ASG checkarray: %d",temp);														//debug
	
	if(temp==0xff){																			//check array-datalength
		writelineEx(gError_Trace, 0, "ASG Phonebook_Indication: BAP-datalength-error");
	}
	else{
		switch(indication){
			case Changed_IND:
				gPhonebookDownload_UHV_ASG=1;
				gPhonebookMemoryPosition=0;
				gPhonebookChangedEntries=elements;
				gPhonebookDownloadLastReceivedEntryPos=0;
				gPhonebookDowloadedEntries=0;

                mode=Indication_array [3];
            	indexsize=(mode & 0x80)/0x80;
            	transmitpos=(mode & 0x40)/0x40;
            	direction=(mode & 0x20)/0x20;
            	shift = (mode & 0x10)/0x10;
               	recordaddress=mode & 0x0f;

                //indexSize
            	if(indexsize){
            		startelement=Indication_array[4]+Indication_array[5]*0xFF;
            		elements=Indication_array[6]+Indication_array[7]*0xFF;
            		datapointer=8;
            	}
            	else{
	            	startelement=Indication_array[4];
	            	elements=Indication_array[5];
	            	datapointer=6;
            	}
                
                //write("ASG Phonebook_Indication: shift:%d, direction:%d, indexsize: %d, recordaddress: %d",shift, direction, indexsize, recordaddress);//debug
                
                //************Full range update*************************

                delete_phonebook();               //erase current phonebook
                if(gPhonebook_SlW_Mode==TRUE)
                {
                    gPhonebook_FullRangeUpdate=1;            //Activate FullRangeUpdate

                    gPhonebook_SlW_DownloadVorhaltUp=FALSE;
    		        gPhonebook_SlW_DownloadVorhaltDown=TRUE;
	    	        gPhonebook_SlW_Download_status=WINDOW;
    
	    	        Phonebook_Request(DataGet_REQ, SLW_FIRST_LIST_ELEMENT, SLW_WINDOW_CACHE, 0x01, 0);    //Get Window Cache
                }
			break;
			case Data_IND:

                asg_id=(Indication_array [3] & 0xF0)/0x10;
                taid=Indication_array [3] & 0x0F;
                gPhonebook_TotalNumListElements=Indication_array[4] + Indication_array[5]*0xFF;
                putvalue(env_ASG_PB_TNLE,gPhonebook_TotalNumListElements);
                mode=Indication_array [6];
            	indexsize=(mode & 0x80)/0x80;
            	transmitpos=(mode & 0x40)/0x40;
            	direction=(mode & 0x20)/0x20;
            	shift = (mode & 0x10)/0x10;
               	recordaddress=mode & 0x0f;
                //write("ASG Phonebook_Indication: mode 0x%x = shift:%d, direction:%d, transmitpos:%d, indexsize: %d, recordaddress: %d", mode, shift, direction, transmitpos, indexsize, recordaddress);

            	//indexSize
            	if(indexsize){
            		startelement=Indication_array[7]+Indication_array[8]*0xFF;
            		elements=Indication_array[9]+Indication_array[10]*0xFF;
            		datapointer=11;
            	}
            	else{
	            	startelement=Indication_array[7];
	            	elements=Indication_array[8];
	            	datapointer=9;
            	}

                //******check validity of statusarray******
                //StatusArray generated by FSG  or  Answer to GetArray 
                //write("Phonebook_Request: ASG_ID 0x%x,TAID %d,start 0x%x,shift %d,direction %d",asg_id,taid,startelement,shift,direction);
                if (asg_id==0 && taid==0)
                    write("ASG Phonebook_Indication: spontanous statusarray, no function!");
                else if(gPhonebook_ASG_ID!=(asg_id&0x07) || gPhonebook_TAID!=taid || gPhonebook_start!=startelement || gPhonebook_shift!=shift || gPhonebook_direction!=direction)
                {
                    write("ASG Phonebook_Indication: invalid statusarray, retry!");
                    Phonebook_Request(DataGet_REQ, gPhonebook_start, gPhonebook_elements, gPhonebook_mode, 0);
                }    
                else    //indication is valid
                {   
                    

                    gPhonebook_TAID++;//increase TAID

                    if(gPhonebook_SlW_Mode==OFF)
                    {
                        if(direction==BACKWARD)
                            startline=SLW_FIRST_LIST_ELEMENT+(elements-1);  //start in last line
                        else
                            startline=SLW_FIRST_LIST_ELEMENT;               //start in first line
                    }
                    else //Sliding window active
                    {
                        
                        //**************search current phonebookline of startelement*************
                        //write("direction = %d, startelement = %d, shift = %d", direction, startelement, shift);
                        if(startelement != 0)      //startelement is not first element
                        {
                            for(i=0;i<SLW_ENTRIES;i++)
                            {
                                //write("gPhonebook_SlW_Pos[%d]: %d", i, gPhonebook_SlW_Pos[i]);
                                if(gPhonebook_SlW_Pos[i] == startelement)
                                {
                                    if(direction==FORWARD)
                                        startline =i+shift;
                                    else //direction==BACKWARD
                                    {
                                        if(i==0)    //first line
                                            startline=i;
                                        else    //not first line
                                            startline=i-shift;
                                    }
                                    //write("ASG Phonebook_Indication: startline of startelement '0x%x' incl. shift (%x) = %d",startelement,shift,startline);  //debug    
                                    i=SLW_ENTRIES;        //stop loop
                                }
                                else
                                    startline =0xff;    //invalid
                            }
                        }
                        else        //startelement is first element
                            startline =SLW_FIRST_WINDOW_ELEMENT;   //start in first line of window cache
                        
                        //write("# --> startline = %d, SLW_FIRST_WINDOW_ELEMENT: %d", startline, SLW_FIRST_WINDOW_ELEMENT);

                        if(startline==0xff) //invalid element
                        {
                            /***********************************************/
                            // startline=SLW_FIRST_WINDOW_ELEMENT; 
                            /***********************************************/

                            write("ASG Phonebook_Indication: invalid startline, break up!");
                            //break;          //break up indication
                        }
                    }
                    //****************************************************************************
				    switch(recordaddress){
					    case 0:             //complete record
                            
                            position=startline;

                            if(direction==FORWARD)
                            {
                                while(position<(startline+elements))
                                {
                                    //write("ASG Phonebook_Indication: position %d", position);  //debug
                                    //TransmitPos
            	                    if(transmitpos==1)
                                    {
            		                    if(indexsize)
                                        {
                			                gPhonebook_Pos[position]=Indication_array[datapointer]+Indication_array[datapointer+1]*0xFF;
	                		            datapointer=datapointer+2;
	                	                }
	                	                else
                                        {
	            		                    gPhonebook_Pos[position]=Indication_array[datapointer];
	            		                    datapointer++;
	            	                    }
            	                    }
                            
							        //PbName
							        length=Indication_array[datapointer];
                                    datapointer++;
								
								    for(i=0;i<PHONEBOOK_PBNAME_LENGTH;i++)												//delete old name
								    	gPhonebook_PbName[position][i]=0;
								    if(length==1 && Indication_array[datapointer]==0x00){
								    	strncpy(gPhonebook_PbName[position], "unknown", PHONEBOOK_PBNAME_LENGTH);
								    }
								    else{
									    for(i=0;i<length;i++)										//save new name
										    gPhonebook_PbName[position][i]=Indication_array[datapointer+i];
								    }
								    datapointer=datapointer+length;

                                    //Storage
                                    gPhonebook_Storage[position]=Indication_array[datapointer];
                                    datapointer++;

                                    //AnyVoiceTag and TelNumberQuantity
        							gPhonebook_AnyVoiceTag[position]=(Indication_array[datapointer] & 0xf0)/0x10;
        							gPhonebook_TelNumberQuantity[position]=Indication_array[datapointer] & 0x0f;
        							datapointer++;

        							//********TelNumber1-10 with VoiceTag and NumberType, dependend on TelNumberQuantity****
        							if(gPhonebook_TelNumberQuantity[position]>0){
        								//*********TelNumber1********
        								length=Indication_array[datapointer];
        								datapointer++;
        								for(i=0;i<length;i++)
        									gPhonebook_TelNumber1[position][i]=Indication_array[datapointer+i];
								
        								datapointer=datapointer+length;

        								//VoiceTag && Reserve of TelNumber1
        									gPhonebook_VoiceTag1[position]=(Indication_array[datapointer] & 0xf0)/0x10;
                                            datapointer++;
                                            //NumberType
        									if(Indication_array[datapointer]<15)				//known numbertype
        										gPhonebook_NumberType1[position]=Indication_array[datapointer];
        									else														//unknown numbertype
        										gPhonebook_NumberType1[position]=0;
        									datapointer++;
        								//***************************

        								//*********TelNumber2********
        								if(gPhonebook_TelNumberQuantity[position]>1){
        									length=Indication_array[datapointer];
        									datapointer++;
        									for(i=0;i<length;i++)
        										gPhonebook_TelNumber2[position][i]=Indication_array[datapointer+i];
								
        									datapointer=datapointer+length;

        									//VoiceTag && Reserve of TelNumber2
        									gPhonebook_VoiceTag2[position]=(Indication_array[datapointer] & 0xf0)/0x10;
                                            datapointer++;
                                            //NumberType
        									if(Indication_array[datapointer]<15)				//known numbertype
        										gPhonebook_NumberType2[position]=Indication_array[datapointer];
        									else														//unknown numbertype
        										gPhonebook_NumberType2[position]=0;
        									datapointer++;
        								}
        								//***************************

        								//*********TelNumber3********
        								if(gPhonebook_TelNumberQuantity[position]>2){
        									length=Indication_array[datapointer];
        									datapointer++;
        									for(i=0;i<length;i++)
        										gPhonebook_TelNumber3[position][i]=Indication_array[datapointer+i];
								
        									datapointer=datapointer+length;

        									//VoiceTag && Reserve of TelNumber3
        									gPhonebook_VoiceTag3[position]=(Indication_array[datapointer] & 0xf0)/0x10;
                                            datapointer++;
                                            //NumberType
        									if(Indication_array[datapointer]<15)				//known numbertype
        										gPhonebook_NumberType3[position]=Indication_array[datapointer];
        									else														//unknown numbertype
        										gPhonebook_NumberType3[position]=0;
        									datapointer++;
        								}
        								//***************************

        								//*********TelNumber4********
        								if(gPhonebook_TelNumberQuantity[position]>3){
        									length=Indication_array[datapointer];
        									datapointer++;
        									for(i=0;i<length;i++)
        										gPhonebook_TelNumber4[position][i]=Indication_array[datapointer+i];
								
        									datapointer=datapointer+length;

        									//VoiceTag && Reserve of TelNumber4
        									gPhonebook_VoiceTag4[position]=(Indication_array[datapointer] & 0xf0)/0x10;
                                            datapointer++;
                                            //NumberType
        									if(Indication_array[datapointer]<15)				//known numbertype
        										gPhonebook_NumberType4[position]=Indication_array[datapointer];
        									else														//unknown numbertype
        										gPhonebook_NumberType4[position]=0;
        									datapointer++;
        								}
        								//***************************

        								//*********TelNumber5********
        								if(gPhonebook_TelNumberQuantity[position]>4){
        									length=Indication_array[datapointer];
        									datapointer++;
        									for(i=0;i<length;i++)
        										gPhonebook_TelNumber5[position][i]=Indication_array[datapointer+i];
								
        									datapointer=datapointer+length;

        									//VoiceTag && Reserve of TelNumber5
        									gPhonebook_VoiceTag5[position]=(Indication_array[datapointer] & 0xf0)/0x10;
                                            datapointer++;
                                            //NumberType
        									if(Indication_array[datapointer]<15)				//known numbertype
        										gPhonebook_NumberType5[position]=Indication_array[datapointer];
        									else														//unknown numbertype
        										gPhonebook_NumberType5[position]=0;
        									datapointer++;
        								}
        								//***************************

                                        //*********TelNumber6********
        								if(gPhonebook_TelNumberQuantity[position]>5){
        									length=Indication_array[datapointer];
        									datapointer++;
        									for(i=0;i<length;i++)
        										gPhonebook_TelNumber6[position][i]=Indication_array[datapointer+i];
								
        									datapointer=datapointer+length;

        									//VoiceTag && Reserve of TelNumber6
        									gPhonebook_VoiceTag6[position]=(Indication_array[datapointer] & 0xf0)/0x10;
                                            datapointer++;
                                            //NumberType
        									if(Indication_array[datapointer]<15)				//known numbertype
        										gPhonebook_NumberType6[position]=Indication_array[datapointer];
        									else														//unknown numbertype
        										gPhonebook_NumberType6[position]=0;
        									datapointer++;
                                        }
        								//***************************

                                        //*********TelNumber7********
        								if(gPhonebook_TelNumberQuantity[position]>6){
        									length=Indication_array[datapointer];
        									datapointer++;
        									for(i=0;i<length;i++)
        										gPhonebook_TelNumber7[position][i]=Indication_array[datapointer+i];
								
        									datapointer=datapointer+length;

        									//VoiceTag && Reserve of TelNumber7
        									gPhonebook_VoiceTag7[position]=(Indication_array[datapointer] & 0xf0)/0x10;
                                            datapointer++;
                                            //NumberType
        									if(Indication_array[datapointer]<15)				//known numbertype
        										gPhonebook_NumberType7[position]=Indication_array[datapointer];
        									else														//unknown numbertype
        										gPhonebook_NumberType7[position]=0;
        									datapointer++;
                                        }
        								//***************************

                                        //*********TelNumber8********
        								if(gPhonebook_TelNumberQuantity[position]>7){
        									length=Indication_array[datapointer];
        									datapointer++;
        									for(i=0;i<length;i++)
        										gPhonebook_TelNumber8[position][i]=Indication_array[datapointer+i];
								
        									datapointer=datapointer+length;

        									//VoiceTag && Reserve of TelNumber8
        									gPhonebook_VoiceTag8[position]=(Indication_array[datapointer] & 0xf0)/0x10;
                                            datapointer++;
                                            //NumberType
        									if(Indication_array[datapointer]<15)				//known numbertype
        										gPhonebook_NumberType8[position]=Indication_array[datapointer];
        									else														//unknown numbertype
        										gPhonebook_NumberType8[position]=0;
        									datapointer++;
                                        }
        								//***************************

                                        //*********TelNumber9********
        								if(gPhonebook_TelNumberQuantity[position]>8){
        									length=Indication_array[datapointer];
        									datapointer++;
        									for(i=0;i<length;i++)
        										gPhonebook_TelNumber9[position][i]=Indication_array[datapointer+i];
								
        									datapointer=datapointer+length;

        									//VoiceTag && Reserve of TelNumber9
        									gPhonebook_VoiceTag9[position]=(Indication_array[datapointer] & 0xf0)/0x10;
                                            datapointer++;
                                            //NumberType
        									if(Indication_array[datapointer]<15)				//known numbertype
        										gPhonebook_NumberType9[position]=Indication_array[datapointer];
        									else														//unknown numbertype
        										gPhonebook_NumberType9[position]=0;
        									datapointer++;
                                        }
        								//***************************

                                        //*********TelNumber10********
        								if(gPhonebook_TelNumberQuantity[position]>9){
        									length=Indication_array[datapointer];
        									datapointer++;
        									for(i=0;i<length;i++)
        										gPhonebook_TelNumber10[position][i]=Indication_array[datapointer+i];
								
        									datapointer=datapointer+length;

        									//VoiceTag && Reserve of TelNumber10
        									gPhonebook_VoiceTag10[position]=(Indication_array[datapointer] & 0xf0)/0x10;
                                            datapointer++;
                                            //NumberType
        									if(Indication_array[datapointer]<15)				//known numbertype
        										gPhonebook_NumberType10[position]=Indication_array[datapointer];
        									else														//unknown numbertype
        										gPhonebook_NumberType10[position]=0;
        									datapointer++;
                                        }
        								//***************************
        							}
        						
								    //AddressIndication
								    gPhonebook_AddressIndication[position]=Indication_array[datapointer];
								    datapointer++;
								    
                                    //**********Sliding Window**************
                                    if(gPhonebook_SlW_Mode==TRUE)
                                    {
                                        gPhonebook_Detail_Pos=gPhonebook_Pos[position];
                                        strncpy(gPhonebook_Detail_PbName,gPhonebook_PbName[position],PHONEBOOK_PBNAME_LENGTH);
                                        gPhonebook_Detail_Storage=gPhonebook_Storage[position];
                                        gPhonebook_Detail_AnyVoiceTag=gPhonebook_AnyVoiceTag[position];
                                        gPhonebook_Detail_TelNumberQuantity=gPhonebook_TelNumberQuantity[position];

                                        strncpy(gPhonebook_Detail_TelNumber1,gPhonebook_TelNumber1[position],PHONEBOOK_TELNUMBER_LENGTH);
                                        gPhonebook_Detail_VoiceTag1=gPhonebook_VoiceTag1[position];
                                        gPhonebook_Detail_NumberType1=gPhonebook_NumberType1[position];

                                        strncpy(gPhonebook_Detail_TelNumber2,gPhonebook_TelNumber2[position],PHONEBOOK_TELNUMBER_LENGTH);
                                        gPhonebook_Detail_VoiceTag2=gPhonebook_VoiceTag2[position];
                                        gPhonebook_Detail_NumberType2=gPhonebook_NumberType2[position];

                                        strncpy(gPhonebook_Detail_TelNumber3,gPhonebook_TelNumber3[position],PHONEBOOK_TELNUMBER_LENGTH);
                                        gPhonebook_Detail_VoiceTag3=gPhonebook_VoiceTag3[position];
                                        gPhonebook_Detail_NumberType3=gPhonebook_NumberType3[position];

                                        strncpy(gPhonebook_Detail_TelNumber4,gPhonebook_TelNumber4[position],PHONEBOOK_TELNUMBER_LENGTH);
                                        gPhonebook_Detail_VoiceTag4=gPhonebook_VoiceTag4[position];
                                        gPhonebook_Detail_NumberType4=gPhonebook_NumberType4[position];

                                        strncpy(gPhonebook_Detail_TelNumber5,gPhonebook_TelNumber5[position],PHONEBOOK_TELNUMBER_LENGTH);
                                        gPhonebook_Detail_VoiceTag5=gPhonebook_VoiceTag5[position];
                                        gPhonebook_Detail_NumberType5=gPhonebook_NumberType5[position];

                                        strncpy(gPhonebook_Detail_TelNumber6,gPhonebook_TelNumber6[position],PHONEBOOK_TELNUMBER_LENGTH);
                                        gPhonebook_Detail_VoiceTag6=gPhonebook_VoiceTag6[position];
                                        gPhonebook_Detail_NumberType6=gPhonebook_NumberType6[position];

                                        strncpy(gPhonebook_Detail_TelNumber7,gPhonebook_TelNumber7[position],PHONEBOOK_TELNUMBER_LENGTH);
                                        gPhonebook_Detail_VoiceTag7=gPhonebook_VoiceTag7[position];
                                        gPhonebook_Detail_NumberType7=gPhonebook_NumberType7[position];

                                        strncpy(gPhonebook_Detail_TelNumber8,gPhonebook_TelNumber8[position],PHONEBOOK_TELNUMBER_LENGTH);
                                        gPhonebook_Detail_VoiceTag8=gPhonebook_VoiceTag8[position];
                                        gPhonebook_Detail_NumberType8=gPhonebook_NumberType8[position];

                                        strncpy(gPhonebook_Detail_TelNumber9,gPhonebook_TelNumber9[position],PHONEBOOK_TELNUMBER_LENGTH);
                                        gPhonebook_Detail_VoiceTag9=gPhonebook_VoiceTag9[position];
                                        gPhonebook_Detail_NumberType9=gPhonebook_NumberType9[position];

                                        strncpy(gPhonebook_Detail_TelNumber10,gPhonebook_TelNumber10[position],PHONEBOOK_TELNUMBER_LENGTH);
                                        gPhonebook_Detail_VoiceTag10=gPhonebook_VoiceTag10[position];
                                        gPhonebook_Detail_NumberType10=gPhonebook_NumberType10[position];

                                        gPhonebook_Detail_AddressIndication=gPhonebook_AddressIndication[position];
                                    }
                                    //***************************************
                            
                                    position=position+1;//next line in stack
						        }
                            }
                            else if(direction==BACKWARD && elements>0)
                            {
                                while(position>(startline-elements))
                                {
                                    //write("ASG Phonebook_Indication: position %d", position);  //debug
                                    //TransmitPos
            	                    if(transmitpos==1)
                                    {
            		                    if(indexsize)
                                        {
                			                gPhonebook_Pos[position]=Indication_array[datapointer]+Indication_array[datapointer+1]*0xFF;
	                		            datapointer=datapointer+2;
	                	                }
	                	                else
                                        {
	            		                    gPhonebook_Pos[position]=Indication_array[datapointer];
	            		                    datapointer++;
	            	                    }
            	                    }
                            
							        //PbName
							        length=Indication_array[datapointer];
                                    datapointer++;
								
								    for(i=0;i<PHONEBOOK_PBNAME_LENGTH;i++)												//delete old name
								    	gPhonebook_PbName[position][i]=0;
								    if(length==1 && Indication_array[datapointer]==0x00){
								    	strncpy(gPhonebook_PbName[position], "unknown", PHONEBOOK_PBNAME_LENGTH);
								    }
								    else{
									    for(i=0;i<length;i++)										//save new name
										    gPhonebook_PbName[position][i]=Indication_array[datapointer+i];
								    }
								    datapointer=datapointer+length;

                                    //Storage
                                    gPhonebook_Storage[position]=Indication_array[datapointer];
                                    datapointer++;

                                    //AnyVoiceTag and TelNumberQuantity
        							gPhonebook_AnyVoiceTag[position]=(Indication_array[datapointer] & 0xf0)/0x10;
        							gPhonebook_TelNumberQuantity[position]=Indication_array[datapointer] & 0x0f;
        							datapointer++;

        							//********TelNumber1-10 with VoiceTag and NumberType, dependend on TelNumberQuantity****
        							if(gPhonebook_TelNumberQuantity[position]>0){
        								//*********TelNumber1********
        								length=Indication_array[datapointer];
        								datapointer++;
        								for(i=0;i<length;i++)
        									gPhonebook_TelNumber1[position][i]=Indication_array[datapointer+i];
								
        								datapointer=datapointer+length;

        								//VoiceTag && Reserve of TelNumber1
        									gPhonebook_VoiceTag1[position]=(Indication_array[datapointer] & 0xf0)/0x10;
                                            datapointer++;
                                            //NumberType
        									if(Indication_array[datapointer]<15)				//known numbertype
        										gPhonebook_NumberType1[position]=Indication_array[datapointer];
        									else														//unknown numbertype
        										gPhonebook_NumberType1[position]=0;
        									datapointer++;
        								//***************************

        								//*********TelNumber2********
        								if(gPhonebook_TelNumberQuantity[position]>1){
        									length=Indication_array[datapointer];
        									datapointer++;
        									for(i=0;i<length;i++)
        										gPhonebook_TelNumber2[position][i]=Indication_array[datapointer+i];
								
        									datapointer=datapointer+length;

        									//VoiceTag && Reserve of TelNumber2
        									gPhonebook_VoiceTag2[position]=(Indication_array[datapointer] & 0xf0)/0x10;
                                            datapointer++;
                                            //NumberType
        									if(Indication_array[datapointer]<15)				//known numbertype
        										gPhonebook_NumberType2[position]=Indication_array[datapointer];
        									else														//unknown numbertype
        										gPhonebook_NumberType2[position]=0;
        									datapointer++;
        								}
        								//***************************

        								//*********TelNumber3********
        								if(gPhonebook_TelNumberQuantity[position]>2){
        									length=Indication_array[datapointer];
        									datapointer++;
        									for(i=0;i<length;i++)
        										gPhonebook_TelNumber3[position][i]=Indication_array[datapointer+i];
								
        									datapointer=datapointer+length;

        									//VoiceTag && Reserve of TelNumber3
        									gPhonebook_VoiceTag3[position]=(Indication_array[datapointer] & 0xf0)/0x10;
                                            datapointer++;
                                            //NumberType
        									if(Indication_array[datapointer]<15)				//known numbertype
        										gPhonebook_NumberType3[position]=Indication_array[datapointer];
        									else														//unknown numbertype
        										gPhonebook_NumberType3[position]=0;
        									datapointer++;
        								}
        								//***************************

        								//*********TelNumber4********
        								if(gPhonebook_TelNumberQuantity[position]>3){
        									length=Indication_array[datapointer];
        									datapointer++;
        									for(i=0;i<length;i++)
        										gPhonebook_TelNumber4[position][i]=Indication_array[datapointer+i];
								
        									datapointer=datapointer+length;

        									//VoiceTag && Reserve of TelNumber4
        									gPhonebook_VoiceTag4[position]=(Indication_array[datapointer] & 0xf0)/0x10;
                                            datapointer++;
                                            //NumberType
        									if(Indication_array[datapointer]<15)				//known numbertype
        										gPhonebook_NumberType4[position]=Indication_array[datapointer];
        									else														//unknown numbertype
        										gPhonebook_NumberType4[position]=0;
        									datapointer++;
        								}
        								//***************************

        								//*********TelNumber5********
        								if(gPhonebook_TelNumberQuantity[position]>4){
        									length=Indication_array[datapointer];
        									datapointer++;
        									for(i=0;i<length;i++)
        										gPhonebook_TelNumber5[position][i]=Indication_array[datapointer+i];
								
        									datapointer=datapointer+length;

        									//VoiceTag && Reserve of TelNumber5
        									gPhonebook_VoiceTag5[position]=(Indication_array[datapointer] & 0xf0)/0x10;
                                            datapointer++;
                                            //NumberType
        									if(Indication_array[datapointer]<15)				//known numbertype
        										gPhonebook_NumberType5[position]=Indication_array[datapointer];
        									else														//unknown numbertype
        										gPhonebook_NumberType5[position]=0;
        									datapointer++;
        								}
        								//***************************

                                        //*********TelNumber6********
        								if(gPhonebook_TelNumberQuantity[position]>5){
        									length=Indication_array[datapointer];
        									datapointer++;
        									for(i=0;i<length;i++)
        										gPhonebook_TelNumber6[position][i]=Indication_array[datapointer+i];
								
        									datapointer=datapointer+length;

        									//VoiceTag && Reserve of TelNumber6
        									gPhonebook_VoiceTag6[position]=(Indication_array[datapointer] & 0xf0)/0x10;
                                            datapointer++;
                                            //NumberType
        									if(Indication_array[datapointer]<15)				//known numbertype
        										gPhonebook_NumberType6[position]=Indication_array[datapointer];
        									else														//unknown numbertype
        										gPhonebook_NumberType6[position]=0;
        									datapointer++;
                                        }
        								//***************************

                                        //*********TelNumber7********
        								if(gPhonebook_TelNumberQuantity[position]>6){
        									length=Indication_array[datapointer];
        									datapointer++;
        									for(i=0;i<length;i++)
        										gPhonebook_TelNumber7[position][i]=Indication_array[datapointer+i];
								
        									datapointer=datapointer+length;

        									//VoiceTag && Reserve of TelNumber7
        									gPhonebook_VoiceTag7[position]=(Indication_array[datapointer] & 0xf0)/0x10;
                                            datapointer++;
                                            //NumberType
        									if(Indication_array[datapointer]<15)				//known numbertype
        										gPhonebook_NumberType7[position]=Indication_array[datapointer];
        									else														//unknown numbertype
        										gPhonebook_NumberType7[position]=0;
        									datapointer++;
                                        }
        								//***************************

                                        //*********TelNumber8********
        								if(gPhonebook_TelNumberQuantity[position]>7){
        									length=Indication_array[datapointer];
        									datapointer++;
        									for(i=0;i<length;i++)
        										gPhonebook_TelNumber8[position][i]=Indication_array[datapointer+i];
								
        									datapointer=datapointer+length;

        									//VoiceTag && Reserve of TelNumber8
        									gPhonebook_VoiceTag8[position]=(Indication_array[datapointer] & 0xf0)/0x10;
                                            datapointer++;
                                            //NumberType
        									if(Indication_array[datapointer]<15)				//known numbertype
        										gPhonebook_NumberType8[position]=Indication_array[datapointer];
        									else														//unknown numbertype
        										gPhonebook_NumberType8[position]=0;
        									datapointer++;
                                        }
        								//***************************

                                        //*********TelNumber9********
        								if(gPhonebook_TelNumberQuantity[position]>8){
        									length=Indication_array[datapointer];
        									datapointer++;
        									for(i=0;i<length;i++)
        										gPhonebook_TelNumber9[position][i]=Indication_array[datapointer+i];
								
        									datapointer=datapointer+length;

        									//VoiceTag && Reserve of TelNumber9
        									gPhonebook_VoiceTag9[position]=(Indication_array[datapointer] & 0xf0)/0x10;
                                            datapointer++;
                                            //NumberType
        									if(Indication_array[datapointer]<15)				//known numbertype
        										gPhonebook_NumberType9[position]=Indication_array[datapointer];
        									else														//unknown numbertype
        										gPhonebook_NumberType9[position]=0;
        									datapointer++;
                                        }
        								//***************************

                                        //*********TelNumber10********
        								if(gPhonebook_TelNumberQuantity[position]>9){
        									length=Indication_array[datapointer];
        									datapointer++;
        									for(i=0;i<length;i++)
        										gPhonebook_TelNumber10[position][i]=Indication_array[datapointer+i];
								
        									datapointer=datapointer+length;

        									//VoiceTag && Reserve of TelNumber10
        									gPhonebook_VoiceTag10[position]=(Indication_array[datapointer] & 0xf0)/0x10;
                                            datapointer++;
                                            //NumberType
        									if(Indication_array[datapointer]<15)				//known numbertype
        										gPhonebook_NumberType10[position]=Indication_array[datapointer];
        									else														//unknown numbertype
        										gPhonebook_NumberType10[position]=0;
        									datapointer++;
                                        }
        								//***************************
        							}
        						
								    //AddressIndication
								    gPhonebook_AddressIndication[position]=Indication_array[datapointer];
								    datapointer++;
								    
                                    //**********Sliding Window**************
                                    if(gPhonebook_SlW_Mode==TRUE)
                                    {
                                        gPhonebook_Detail_Pos=gPhonebook_Pos[position];
                                        strncpy(gPhonebook_Detail_PbName,gPhonebook_PbName[position],PHONEBOOK_PBNAME_LENGTH);
                                        gPhonebook_Detail_Storage=gPhonebook_Storage[position];
                                        gPhonebook_Detail_AnyVoiceTag=gPhonebook_AnyVoiceTag[position];
                                        gPhonebook_Detail_TelNumberQuantity=gPhonebook_TelNumberQuantity[position];

                                        strncpy(gPhonebook_Detail_TelNumber1,gPhonebook_TelNumber1[position],PHONEBOOK_TELNUMBER_LENGTH);
                                        gPhonebook_Detail_VoiceTag1=gPhonebook_VoiceTag1[position];
                                        gPhonebook_Detail_NumberType1=gPhonebook_NumberType1[position];

                                        strncpy(gPhonebook_Detail_TelNumber2,gPhonebook_TelNumber2[position],PHONEBOOK_TELNUMBER_LENGTH);
                                        gPhonebook_Detail_VoiceTag2=gPhonebook_VoiceTag2[position];
                                        gPhonebook_Detail_NumberType2=gPhonebook_NumberType2[position];

                                        strncpy(gPhonebook_Detail_TelNumber3,gPhonebook_TelNumber3[position],PHONEBOOK_TELNUMBER_LENGTH);
                                        gPhonebook_Detail_VoiceTag3=gPhonebook_VoiceTag3[position];
                                        gPhonebook_Detail_NumberType3=gPhonebook_NumberType3[position];

                                        strncpy(gPhonebook_Detail_TelNumber4,gPhonebook_TelNumber4[position],PHONEBOOK_TELNUMBER_LENGTH);
                                        gPhonebook_Detail_VoiceTag4=gPhonebook_VoiceTag4[position];
                                        gPhonebook_Detail_NumberType4=gPhonebook_NumberType4[position];

                                        strncpy(gPhonebook_Detail_TelNumber5,gPhonebook_TelNumber5[position],PHONEBOOK_TELNUMBER_LENGTH);
                                        gPhonebook_Detail_VoiceTag5=gPhonebook_VoiceTag5[position];
                                        gPhonebook_Detail_NumberType5=gPhonebook_NumberType5[position];

                                        strncpy(gPhonebook_Detail_TelNumber6,gPhonebook_TelNumber6[position],PHONEBOOK_TELNUMBER_LENGTH);
                                        gPhonebook_Detail_VoiceTag6=gPhonebook_VoiceTag6[position];
                                        gPhonebook_Detail_NumberType6=gPhonebook_NumberType6[position];

                                        strncpy(gPhonebook_Detail_TelNumber7,gPhonebook_TelNumber7[position],PHONEBOOK_TELNUMBER_LENGTH);
                                        gPhonebook_Detail_VoiceTag7=gPhonebook_VoiceTag7[position];
                                        gPhonebook_Detail_NumberType7=gPhonebook_NumberType7[position];

                                        strncpy(gPhonebook_Detail_TelNumber8,gPhonebook_TelNumber8[position],PHONEBOOK_TELNUMBER_LENGTH);
                                        gPhonebook_Detail_VoiceTag8=gPhonebook_VoiceTag8[position];
                                        gPhonebook_Detail_NumberType8=gPhonebook_NumberType8[position];

                                        strncpy(gPhonebook_Detail_TelNumber9,gPhonebook_TelNumber9[position],PHONEBOOK_TELNUMBER_LENGTH);
                                        gPhonebook_Detail_VoiceTag9=gPhonebook_VoiceTag9[position];
                                        gPhonebook_Detail_NumberType9=gPhonebook_NumberType9[position];

                                        strncpy(gPhonebook_Detail_TelNumber10,gPhonebook_TelNumber10[position],PHONEBOOK_TELNUMBER_LENGTH);
                                        gPhonebook_Detail_VoiceTag10=gPhonebook_VoiceTag10[position];
                                        gPhonebook_Detail_NumberType10=gPhonebook_NumberType10[position];

                                        gPhonebook_Detail_AddressIndication=gPhonebook_AddressIndication[position];
                                    }
                                    //***************************************
                            
                                    position=position-1;//next line in stack
						        }
                            }

						    display_phonebook_detail();
                                      
					    break;
					    case 1:	//PbName,Storage,AnyVoiceTag,TelNumberQuantity,AddressIndication

						    position=startline;
						
                            if(direction==FORWARD)
                            {
                                while(position<(startline+elements))
                                {//
                                    //write("ASG Phonebook_Indication: position %d", position);  //debug
                                    //TransmitPos
            	                    if(transmitpos==1)
                                    {
            		                    if(indexsize)
                                        {
                			                gPhonebook_Pos[position]=Indication_array[datapointer]+Indication_array[datapointer+1]*0xFF;
	                		            datapointer=datapointer+2;
	                	                }
	                	                else
                                        {
	            		                    gPhonebook_Pos[position]=Indication_array[datapointer];
	            		                    datapointer++;
	            	                    }
            	                    }
                            
							        //PbName
							        length=Indication_array[datapointer];
                                    datapointer++;
								
								    for(i=0;i<PHONEBOOK_PBNAME_LENGTH;i++)												//delete old name
								    	gPhonebook_PbName[position][i]=0;
								    if(length==1 && Indication_array[datapointer]==0x00){
								    	strncpy(gPhonebook_PbName[position], "unknown", PHONEBOOK_PBNAME_LENGTH);
								    }
								    else{
									    for(i=0;i<length;i++)										//save new name
										    gPhonebook_PbName[position][i]=Indication_array[datapointer+i];
								    }
								    datapointer=datapointer+length;

                                    //Storage
                                    gPhonebook_Storage[position]=Indication_array[datapointer];
                                    datapointer++;

                                    //AnyVoiceTag and TelNumberQuantity
        							gPhonebook_AnyVoiceTag[position]=(Indication_array[datapointer] & 0xf0)/0x10;
        							gPhonebook_TelNumberQuantity[position]=Indication_array[datapointer] & 0x0f;
        							datapointer++;
        						
								    //AddressIndication
								    gPhonebook_AddressIndication[position]=Indication_array[datapointer];
								    datapointer++;

                                    //**********Sliding Window**************
                                    if(gPhonebook_SlW_Mode==TRUE)
                                    {        
                                        //write("gSlidingWindowMode 0x%x, gSlW_Download_status 0x%x",gSlidingWindowMode,gSlW_Download_status);
                                        gPhonebook_SlW_Pos[position]=gPhonebook_Pos[position];
                                        strncpy(gPhonebook_SlW_PbName[position],gPhonebook_PbName[position],PHONEBOOK_PBNAME_LENGTH);
                                        gPhonebook_SlW_Storage[position]=gPhonebook_Storage[position];
                                        gPhonebook_SlW_AnyVoiceTag[position]=gPhonebook_AnyVoiceTag[position];
                                        gPhonebook_SlW_TelNumberQuantity[position]=gPhonebook_TelNumberQuantity[position];
                                        gPhonebook_SlW_AddressIndication[position]=gPhonebook_AddressIndication[position];

                                        if(gPhonebook_SlW_Download_status==VORHALT_UP)
                                        {
                                            gPhonebook_VorhaltUpStatus++;
                                            putvalue(env_ASG_PB_SlW_Vorhalt_v,gPhonebook_VorhaltUpStatus);
                                        }
                                        else if(gPhonebook_SlW_Download_status==VORHALT_DOWN)
                                        {
                                            gPhonebook_VorhaltDownStatus++;
                                            putvalue(env_ASG_PB_SlW_Vorhalt_n,gPhonebook_VorhaltDownStatus);
                                        }
                                    }
                                    //**************************************    

                                    //next line in stack
                                    position=position+1;    //if direction=0 (forward), position = position + 1
					    	    }
                            }
                            else if(direction==BACKWARD && elements>0)
                            {
                                while(position>(startline-elements))
                                {
                                    //write("ASG Phonebook_Indication: position %d", position);  //debug
                                    //TransmitPos
            	                    if(transmitpos==1)
                                    {
            		                    if(indexsize)
                                        {
                			                gPhonebook_Pos[position]=Indication_array[datapointer]+Indication_array[datapointer+1]*0xFF;
	                		            datapointer=datapointer+2;
	                	                }
	                	                else
                                        {
	            		                    gPhonebook_Pos[position]=Indication_array[datapointer];
	            		                    datapointer++;
	            	                    }
            	                    }
                            
							        //PbName
							        length=Indication_array[datapointer];
                                    datapointer++;
								
								    for(i=0;i<PHONEBOOK_PBNAME_LENGTH;i++)												//delete old name
								    	gPhonebook_PbName[position][i]=0;
								    if(length==1 && Indication_array[datapointer]==0x00){
								    	strncpy(gPhonebook_PbName[position], "unknown", PHONEBOOK_PBNAME_LENGTH);
								    }
								    else{
									    for(i=0;i<length;i++)										//save new name
										    gPhonebook_PbName[position][i]=Indication_array[datapointer+i];
								    }
								    datapointer=datapointer+length;

                                    //Storage
                                    gPhonebook_Storage[position]=Indication_array[datapointer];
                                    datapointer++;

                                    //AnyVoiceTag and TelNumberQuantity
        							gPhonebook_AnyVoiceTag[position]=(Indication_array[datapointer] & 0xf0)/0x10;
        							gPhonebook_TelNumberQuantity[position]=Indication_array[datapointer] & 0x0f;
        							datapointer++;
        						
								    //AddressIndication
								    gPhonebook_AddressIndication[position]=Indication_array[datapointer];
								    datapointer++;
    
                                    //**********Sliding Window**************
                                    if(gPhonebook_SlW_Mode==TRUE)
                                    {        
                                        //write("gSlidingWindowMode 0x%x, gSlW_Download_status 0x%x",gSlidingWindowMode,gSlW_Download_status);
                                        gPhonebook_SlW_Pos[position]=gPhonebook_Pos[position];
                                        strncpy(gPhonebook_SlW_PbName[position],gPhonebook_PbName[position],PHONEBOOK_PBNAME_LENGTH);
                                        gPhonebook_SlW_Storage[position]=gPhonebook_Storage[position];
                                        gPhonebook_SlW_AnyVoiceTag[position]=gPhonebook_AnyVoiceTag[position];
                                        gPhonebook_SlW_TelNumberQuantity[position]=gPhonebook_TelNumberQuantity[position];
                                        gPhonebook_SlW_AddressIndication[position]=gPhonebook_AddressIndication[position];

                                        if(gPhonebook_SlW_Download_status==VORHALT_UP)
                                        {
                                            gPhonebook_VorhaltUpStatus++;
                                            putvalue(env_ASG_PB_SlW_Vorhalt_v,gPhonebook_VorhaltUpStatus);
                                        }
                                        else if(gPhonebook_SlW_Download_status==VORHALT_DOWN)
                                        {
                                            gPhonebook_VorhaltDownStatus++;
                                            putvalue(env_ASG_PB_SlW_Vorhalt_n,gPhonebook_VorhaltDownStatus);
                                        }
                                    }
                                    //**************************************

                                    //next line in stack
                                    position=position-1;    //if direction=1 (backward), position = position - 1
					    	    }
                            }

                        
                            //**********Sliding Window**************
                            if(gPhonebook_SlW_Mode==TRUE)
                            {   //write("indication gPhonebook_SlW_Download_status %d, gKeyPressCode %d", gPhonebook_SlW_Download_status, gKeyPressCode); //debug
                                //***********normal caching***************
                                if(gPhonebook_SlW_DownloadVorhaltDown)// && gPhonebook_SlW_Download_status==WINDOW)
                                {
                                    //write("Get Lower Cache");
                                    gPhonebook_SlW_Download_status=VORHALT_DOWN;
                                    gPhonebook_SlW_DownloadVorhaltDown=FALSE;
                                    if(gPhonebook_FullRangeUpdate!=FALSE) //Full range update is active
                                        gPhonebook_SlW_DownloadVorhaltUp=TRUE;
                                    startelement=(gPhonebook_SlW_Pos[SLW_LAST_WINDOW_ELEMENT]);//last known element in Window-Cache 
                                                                                //direction=0;shift=1;recordaddress=1;
			                        Phonebook_Request(DataGet_REQ,startelement, SLW_LOWER_CACHE, 0x11, 0);
                                }
                                else if(gPhonebook_SlW_DownloadVorhaltUp)// && gPhonebook_SlW_Download_status==VORHALT_DOWN)
                                {
                                    //write("Get Uppper Cache");
                                    gPhonebook_SlW_Download_status=VORHALT_UP;
                                    gPhonebook_SlW_DownloadVorhaltUp=FALSE;
                                    startelement=(gPhonebook_SlW_Pos[SLW_FIRST_WINDOW_ELEMENT]);//first known element in Window-Cache
                                    //direction=1;shift=1;recordaddress=1;
			                        Phonebook_Request(DataGet_REQ,startelement, SLW_UPPER_CACHE, 0x31, 0);
                                }
                                else// if(gPhonebook_SlW_Download_status==VORHALT_UP)
                                {
                                    //write("End of Caching");
                                    gPhonebook_SlW_Download_status=NO_SLW_DOWNLOAD;
                                    gPhonebook_FullRangeUpdate=FALSE;
                                }
                                //else
                                //  gPhonebook_SlW_Download_status=NO_SLW_DOWNLOAD;
                                display_phonebook_slw();
                            }

					    break;
					    case 2:	//TelNumber,VoiceTag,NumberType

						    position=startline;

                            if(direction==FORWARD)
                            {						
                                while(position<(startline+elements))
                                {
    							    //write("ASG Phonebook_Indication: position %d", position);  //debug
                                    //TransmitPos
            	                    if(transmitpos==1)
                                    {
            		                    if(indexsize)
                                        {
                			                gPhonebook_Pos[position]=Indication_array[datapointer]+Indication_array[datapointer+1]*0xFF;
	                		            datapointer=datapointer+2;
	                	                }
	                	                else
                                        {
	            		                    gPhonebook_Pos[position]=Indication_array[datapointer];
	            		                    datapointer++;
	            	                    }
            	                    }

        							//********TelNumber1-10 with VoiceTag and NumberType, dependend on TelNumberQuantity****
        							if(gPhonebook_TelNumberQuantity[position]>0){
        								//*********TelNumber1********
        								length=Indication_array[datapointer];
        								datapointer++;
        								for(i=0;i<length;i++)
        									gPhonebook_TelNumber1[position][i]=Indication_array[datapointer+i];
								
        								datapointer=datapointer+length;

        								//VoiceTag && Reserve of TelNumber1
        									gPhonebook_VoiceTag1[position]=(Indication_array[datapointer] & 0xf0)/0x10;
                                            datapointer++;
                                            //NumberType
        									if(Indication_array[datapointer]<15)				//known numbertype
        										gPhonebook_NumberType1[position]=Indication_array[datapointer];
        									else														//unknown numbertype
        										gPhonebook_NumberType1[position]=0;
        									datapointer++;
        								//***************************

        								//*********TelNumber2********
        								if(gPhonebook_TelNumberQuantity[position]>1){
        									length=Indication_array[datapointer];
        									datapointer++;
        									for(i=0;i<length;i++)
        										gPhonebook_TelNumber2[position][i]=Indication_array[datapointer+i];
								
        									datapointer=datapointer+length;

        									//VoiceTag && Reserve of TelNumber2
        									gPhonebook_VoiceTag2[position]=(Indication_array[datapointer] & 0xf0)/0x10;
                                            datapointer++;
                                            //NumberType
        									if(Indication_array[datapointer]<15)				//known numbertype
        										gPhonebook_NumberType2[position]=Indication_array[datapointer];
        									else														//unknown numbertype
        										gPhonebook_NumberType2[position]=0;
        									datapointer++;
        								}
        								//***************************

        								//*********TelNumber3********
        								if(gPhonebook_TelNumberQuantity[position]>2){
        									length=Indication_array[datapointer];
        									datapointer++;
        									for(i=0;i<length;i++)
        										gPhonebook_TelNumber3[position][i]=Indication_array[datapointer+i];
								
        									datapointer=datapointer+length;

        									//VoiceTag && Reserve of TelNumber3
        									gPhonebook_VoiceTag3[position]=(Indication_array[datapointer] & 0xf0)/0x10;
                                            datapointer++;
                                            //NumberType
        									if(Indication_array[datapointer]<15)				//known numbertype
        										gPhonebook_NumberType3[position]=Indication_array[datapointer];
        									else														//unknown numbertype
        										gPhonebook_NumberType3[position]=0;
        									datapointer++;
        								}
        								//***************************

        								//*********TelNumber4********
        								if(gPhonebook_TelNumberQuantity[position]>3){
        									length=Indication_array[datapointer];
        									datapointer++;
        									for(i=0;i<length;i++)
        										gPhonebook_TelNumber4[position][i]=Indication_array[datapointer+i];
								
        									datapointer=datapointer+length;

        									//VoiceTag && Reserve of TelNumber4
        									gPhonebook_VoiceTag4[position]=(Indication_array[datapointer] & 0xf0)/0x10;
                                            datapointer++;
                                            //NumberType
        									if(Indication_array[datapointer]<15)				//known numbertype
        										gPhonebook_NumberType4[position]=Indication_array[datapointer];
        									else														//unknown numbertype
        										gPhonebook_NumberType4[position]=0;
        									datapointer++;
        								}
        								//***************************

        								//*********TelNumber5********
        								if(gPhonebook_TelNumberQuantity[position]>4){
        									length=Indication_array[datapointer];
        									datapointer++;
        									for(i=0;i<length;i++)
        										gPhonebook_TelNumber5[position][i]=Indication_array[datapointer+i];
								
        									datapointer=datapointer+length;

        									//VoiceTag && Reserve of TelNumber5
        									gPhonebook_VoiceTag5[position]=(Indication_array[datapointer] & 0xf0)/0x10;
                                            datapointer++;
                                            //NumberType
        									if(Indication_array[datapointer]<15)				//known numbertype
        										gPhonebook_NumberType5[position]=Indication_array[datapointer];
        									else														//unknown numbertype
        										gPhonebook_NumberType5[position]=0;
        									datapointer++;
        								}
        								//***************************

                                        //*********TelNumber6********
        								if(gPhonebook_TelNumberQuantity[position]>5){
        									length=Indication_array[datapointer];
        									datapointer++;
        									for(i=0;i<length;i++)
        										gPhonebook_TelNumber6[position][i]=Indication_array[datapointer+i];
								
        									datapointer=datapointer+length;

        									//VoiceTag && Reserve of TelNumber6
        									gPhonebook_VoiceTag6[position]=(Indication_array[datapointer] & 0xf0)/0x10;
                                            datapointer++;
                                            //NumberType
        									if(Indication_array[datapointer]<15)				//known numbertype
        										gPhonebook_NumberType6[position]=Indication_array[datapointer];
        									else														//unknown numbertype
        										gPhonebook_NumberType6[position]=0;
        									datapointer++;
                                        }
        								//***************************

                                        //*********TelNumber7********
        								if(gPhonebook_TelNumberQuantity[position]>6){
        									length=Indication_array[datapointer];
        									datapointer++;
        									for(i=0;i<length;i++)
        										gPhonebook_TelNumber7[position][i]=Indication_array[datapointer+i];
								
        									datapointer=datapointer+length;

        									//VoiceTag && Reserve of TelNumber7
        									gPhonebook_VoiceTag7[position]=(Indication_array[datapointer] & 0xf0)/0x10;
                                            datapointer++;
                                            //NumberType
        									if(Indication_array[datapointer]<15)				//known numbertype
        										gPhonebook_NumberType7[position]=Indication_array[datapointer];
        									else														//unknown numbertype
        										gPhonebook_NumberType7[position]=0;
        									datapointer++;
                                        }
        								//***************************

                                        //*********TelNumber8********
        								if(gPhonebook_TelNumberQuantity[position]>7){
        									length=Indication_array[datapointer];
        									datapointer++;
        									for(i=0;i<length;i++)
        										gPhonebook_TelNumber8[position][i]=Indication_array[datapointer+i];
								
        									datapointer=datapointer+length;

        									//VoiceTag && Reserve of TelNumber8
        									gPhonebook_VoiceTag8[position]=(Indication_array[datapointer] & 0xf0)/0x10;
                                            datapointer++;
                                            //NumberType
        									if(Indication_array[datapointer]<15)				//known numbertype
        										gPhonebook_NumberType8[position]=Indication_array[datapointer];
        									else														//unknown numbertype
        										gPhonebook_NumberType8[position]=0;
        									datapointer++;
                                        }
        								//***************************

                                        //*********TelNumber9********
        								if(gPhonebook_TelNumberQuantity[position]>8){
        									length=Indication_array[datapointer];
        									datapointer++;
        									for(i=0;i<length;i++)
        										gPhonebook_TelNumber9[position][i]=Indication_array[datapointer+i];
								
        									datapointer=datapointer+length;

        									//VoiceTag && Reserve of TelNumber9
        									gPhonebook_VoiceTag9[position]=(Indication_array[datapointer] & 0xf0)/0x10;
                                            datapointer++;
                                            //NumberType
        									if(Indication_array[datapointer]<15)				//known numbertype
        										gPhonebook_NumberType9[position]=Indication_array[datapointer];
        									else														//unknown numbertype
        										gPhonebook_NumberType9[position]=0;
        									datapointer++;
                                        }
        								//***************************

                                        //*********TelNumber10********
        								if(gPhonebook_TelNumberQuantity[position]>9){
        									length=Indication_array[datapointer];
        									datapointer++;
        									for(i=0;i<length;i++)
        										gPhonebook_TelNumber10[position][i]=Indication_array[datapointer+i];
								
        									datapointer=datapointer+length;

        									//VoiceTag && Reserve of TelNumber10
        									gPhonebook_VoiceTag10[position]=(Indication_array[datapointer] & 0xf0)/0x10;
                                            datapointer++;
                                            //NumberType
        									if(Indication_array[datapointer]<15)				//known numbertype
        										gPhonebook_NumberType10[position]=Indication_array[datapointer];
        									else														//unknown numbertype
        										gPhonebook_NumberType10[position]=0;
        									datapointer++;
                                        }
        								//***************************
        							}

                                    position=position+1;//next line in stack
    						    }
                            }
                            else if(direction==BACKWARD && elements>0)
                            {
                                while(position>(startline-elements))
                                {
    							    ///write("ASG Phonebook_Indication: position %d", position);  //debug
                                    //TransmitPos
            	                    if(transmitpos==1)
                                    {
            		                    if(indexsize)
                                        {
                			                gPhonebook_Pos[position]=Indication_array[datapointer]+Indication_array[datapointer+1]*0xFF;
	                		            datapointer=datapointer+2;
	                	                }
	                	                else
                                        {
	            		                    gPhonebook_Pos[position]=Indication_array[datapointer];
	            		                    datapointer++;
	            	                    }
            	                    }

        							//********TelNumber1-10 with VoiceTag and NumberType, dependend on TelNumberQuantity****
        							if(gPhonebook_TelNumberQuantity[position]>0){
        								//*********TelNumber1********
        								length=Indication_array[datapointer];
        								datapointer++;
        								for(i=0;i<length;i++)
        									gPhonebook_TelNumber1[position][i]=Indication_array[datapointer+i];
								
        								datapointer=datapointer+length;

        								//VoiceTag && Reserve of TelNumber1
        									gPhonebook_VoiceTag1[position]=(Indication_array[datapointer] & 0xf0)/0x10;
                                            datapointer++;
                                            //NumberType
        									if(Indication_array[datapointer]<15)				//known numbertype
        										gPhonebook_NumberType1[position]=Indication_array[datapointer];
        									else														//unknown numbertype
        										gPhonebook_NumberType1[position]=0;
        									datapointer++;
        								//***************************

        								//*********TelNumber2********
        								if(gPhonebook_TelNumberQuantity[position]>1){
        									length=Indication_array[datapointer];
        									datapointer++;
        									for(i=0;i<length;i++)
        										gPhonebook_TelNumber2[position][i]=Indication_array[datapointer+i];
								
        									datapointer=datapointer+length;

        									//VoiceTag && Reserve of TelNumber2
        									gPhonebook_VoiceTag2[position]=(Indication_array[datapointer] & 0xf0)/0x10;
                                            datapointer++;
                                            //NumberType
        									if(Indication_array[datapointer]<15)				//known numbertype
        										gPhonebook_NumberType2[position]=Indication_array[datapointer];
        									else														//unknown numbertype
        										gPhonebook_NumberType2[position]=0;
        									datapointer++;
        								}
        								//***************************

        								//*********TelNumber3********
        								if(gPhonebook_TelNumberQuantity[position]>2){
        									length=Indication_array[datapointer];
        									datapointer++;
        									for(i=0;i<length;i++)
        										gPhonebook_TelNumber3[position][i]=Indication_array[datapointer+i];
								
        									datapointer=datapointer+length;

        									//VoiceTag && Reserve of TelNumber3
        									gPhonebook_VoiceTag3[position]=(Indication_array[datapointer] & 0xf0)/0x10;
                                            datapointer++;
                                            //NumberType
        									if(Indication_array[datapointer]<15)				//known numbertype
        										gPhonebook_NumberType3[position]=Indication_array[datapointer];
        									else														//unknown numbertype
        										gPhonebook_NumberType3[position]=0;
        									datapointer++;
        								}
        								//***************************

        								//*********TelNumber4********
        								if(gPhonebook_TelNumberQuantity[position]>3){
        									length=Indication_array[datapointer];
        									datapointer++;
        									for(i=0;i<length;i++)
        										gPhonebook_TelNumber4[position][i]=Indication_array[datapointer+i];
								
        									datapointer=datapointer+length;

        									//VoiceTag && Reserve of TelNumber4
        									gPhonebook_VoiceTag4[position]=(Indication_array[datapointer] & 0xf0)/0x10;
                                            datapointer++;
                                            //NumberType
        									if(Indication_array[datapointer]<15)				//known numbertype
        										gPhonebook_NumberType4[position]=Indication_array[datapointer];
        									else														//unknown numbertype
        										gPhonebook_NumberType4[position]=0;
        									datapointer++;
        								}
        								//***************************

        								//*********TelNumber5********
        								if(gPhonebook_TelNumberQuantity[position]>4){
        									length=Indication_array[datapointer];
        									datapointer++;
        									for(i=0;i<length;i++)
        										gPhonebook_TelNumber5[position][i]=Indication_array[datapointer+i];
								
        									datapointer=datapointer+length;

        									//VoiceTag && Reserve of TelNumber5
        									gPhonebook_VoiceTag5[position]=(Indication_array[datapointer] & 0xf0)/0x10;
                                            datapointer++;
                                            //NumberType
        									if(Indication_array[datapointer]<15)				//known numbertype
        										gPhonebook_NumberType5[position]=Indication_array[datapointer];
        									else														//unknown numbertype
        										gPhonebook_NumberType5[position]=0;
        									datapointer++;
        								}
        								//***************************

                                        //*********TelNumber6********
        								if(gPhonebook_TelNumberQuantity[position]>5){
        									length=Indication_array[datapointer];
        									datapointer++;
        									for(i=0;i<length;i++)
        										gPhonebook_TelNumber6[position][i]=Indication_array[datapointer+i];
								
        									datapointer=datapointer+length;

        									//VoiceTag && Reserve of TelNumber6
        									gPhonebook_VoiceTag6[position]=(Indication_array[datapointer] & 0xf0)/0x10;
                                            datapointer++;
                                            //NumberType
        									if(Indication_array[datapointer]<15)				//known numbertype
        										gPhonebook_NumberType6[position]=Indication_array[datapointer];
        									else														//unknown numbertype
        										gPhonebook_NumberType6[position]=0;
        									datapointer++;
                                        }
        								//***************************

                                        //*********TelNumber7********
        								if(gPhonebook_TelNumberQuantity[position]>6){
        									length=Indication_array[datapointer];
        									datapointer++;
        									for(i=0;i<length;i++)
        										gPhonebook_TelNumber7[position][i]=Indication_array[datapointer+i];
								
        									datapointer=datapointer+length;

        									//VoiceTag && Reserve of TelNumber7
        									gPhonebook_VoiceTag7[position]=(Indication_array[datapointer] & 0xf0)/0x10;
                                            datapointer++;
                                            //NumberType
        									if(Indication_array[datapointer]<15)				//known numbertype
        										gPhonebook_NumberType7[position]=Indication_array[datapointer];
        									else														//unknown numbertype
        										gPhonebook_NumberType7[position]=0;
        									datapointer++;
                                        }
        								//***************************

                                        //*********TelNumber8********
        								if(gPhonebook_TelNumberQuantity[position]>7){
        									length=Indication_array[datapointer];
        									datapointer++;
        									for(i=0;i<length;i++)
        										gPhonebook_TelNumber8[position][i]=Indication_array[datapointer+i];
								
        									datapointer=datapointer+length;

        									//VoiceTag && Reserve of TelNumber8
        									gPhonebook_VoiceTag8[position]=(Indication_array[datapointer] & 0xf0)/0x10;
                                            datapointer++;
                                            //NumberType
        									if(Indication_array[datapointer]<15)				//known numbertype
        										gPhonebook_NumberType8[position]=Indication_array[datapointer];
        									else														//unknown numbertype
        										gPhonebook_NumberType8[position]=0;
        									datapointer++;
                                        }
        								//***************************

                                        //*********TelNumber9********
        								if(gPhonebook_TelNumberQuantity[position]>8){
        									length=Indication_array[datapointer];
        									datapointer++;
        									for(i=0;i<length;i++)
        										gPhonebook_TelNumber9[position][i]=Indication_array[datapointer+i];
								
        									datapointer=datapointer+length;

        									//VoiceTag && Reserve of TelNumber9
        									gPhonebook_VoiceTag9[position]=(Indication_array[datapointer] & 0xf0)/0x10;
                                            datapointer++;
                                            //NumberType
        									if(Indication_array[datapointer]<15)				//known numbertype
        										gPhonebook_NumberType9[position]=Indication_array[datapointer];
        									else														//unknown numbertype
        										gPhonebook_NumberType9[position]=0;
        									datapointer++;
                                        }
        								//***************************

                                        //*********TelNumber10********
        								if(gPhonebook_TelNumberQuantity[position]>9){
        									length=Indication_array[datapointer];
        									datapointer++;
        									for(i=0;i<length;i++)
        										gPhonebook_TelNumber10[position][i]=Indication_array[datapointer+i];
								
        									datapointer=datapointer+length;

        									//VoiceTag && Reserve of TelNumber10
        									gPhonebook_VoiceTag10[position]=(Indication_array[datapointer] & 0xf0)/0x10;
                                            datapointer++;
                                            //NumberType
        									if(Indication_array[datapointer]<15)				//known numbertype
        										gPhonebook_NumberType10[position]=Indication_array[datapointer];
        									else														//unknown numbertype
        										gPhonebook_NumberType10[position]=0;
        									datapointer++;
                                        }
        								//***************************
        							}

                                    position=position-1;//next line in stack
                                }
						    }

					    break;
                        case 3:	//PbName,AnyVoiceTag,TelNumberQuantity,VoiceTag,NumberType

						    position=startline;

                            if(direction==FORWARD)
                            {						
                                while(position<(startline+elements))
                                {
    							    //write("ASG Phonebook_Indication: position %d", position);  //debug
                                    //TransmitPos
            	                    if(transmitpos==1)
                                    {
            		                    if(indexsize)
                                        {
                			                gPhonebook_Pos[position]=Indication_array[datapointer]+Indication_array[datapointer+1]*0xFF;
	                		            datapointer=datapointer+2;
	                	                }
	                	                else
                                        {
	            		                    gPhonebook_Pos[position]=Indication_array[datapointer];
	            		                    datapointer++;
	            	                    }
            	                    }

                                    //PbName
							        length=Indication_array[datapointer];
                                    datapointer++;
								
								    for(i=0;i<PHONEBOOK_PBNAME_LENGTH;i++)												//delete old name
								    	gPhonebook_PbName[position][i]=0;
								    if(length==1 && Indication_array[datapointer]==0x00){
								    	strncpy(gPhonebook_PbName[position], "unknown", PHONEBOOK_PBNAME_LENGTH);
								    }
								    else{
									    for(i=0;i<length;i++)										//save new name
										    gPhonebook_PbName[position][i]=Indication_array[datapointer+i];
								    }
								    datapointer=datapointer+length;

                                    //AnyVoiceTag and TelNumberQuantity
        							gPhonebook_AnyVoiceTag[position]=(Indication_array[datapointer] & 0xf0)/0x10;
        							gPhonebook_TelNumberQuantity[position]=Indication_array[datapointer] & 0x0f;
        							datapointer++;

        							//********VoiceTag and NumberType of TelNumber1-10, dependend on TelNumberQuantity****
        							if(gPhonebook_TelNumberQuantity[position]>0){
        								//*********TelNumber1********
        								//VoiceTag && Reserve of TelNumber1
        									gPhonebook_VoiceTag1[position]=(Indication_array[datapointer] & 0xf0)/0x10;
                                            datapointer++;
                                            //NumberType
        									if(Indication_array[datapointer]<15)				//known numbertype
        										gPhonebook_NumberType1[position]=Indication_array[datapointer];
        									else														//unknown numbertype
        										gPhonebook_NumberType1[position]=0;
        									datapointer++;
        								//***************************

        								//*********TelNumber2********
        								if(gPhonebook_TelNumberQuantity[position]>1){
        									//VoiceTag && Reserve of TelNumber2
        									gPhonebook_VoiceTag2[position]=(Indication_array[datapointer] & 0xf0)/0x10;
                                            datapointer++;
                                            //NumberType
        									if(Indication_array[datapointer]<15)				//known numbertype
        										gPhonebook_NumberType2[position]=Indication_array[datapointer];
        									else														//unknown numbertype
        										gPhonebook_NumberType2[position]=0;
        									datapointer++;
        								}
        								//***************************

        								//*********TelNumber3********
        								if(gPhonebook_TelNumberQuantity[position]>2){
        									//VoiceTag && Reserve of TelNumber3
        									gPhonebook_VoiceTag3[position]=(Indication_array[datapointer] & 0xf0)/0x10;
                                            datapointer++;
                                            //NumberType
        									if(Indication_array[datapointer]<15)				//known numbertype
        										gPhonebook_NumberType3[position]=Indication_array[datapointer];
        									else														//unknown numbertype
        										gPhonebook_NumberType3[position]=0;
        									datapointer++;
        								}
        								//***************************

        								//*********TelNumber4********
        								if(gPhonebook_TelNumberQuantity[position]>3){
        									//VoiceTag && Reserve of TelNumber4
        									gPhonebook_VoiceTag4[position]=(Indication_array[datapointer] & 0xf0)/0x10;
                                            datapointer++;
                                            //NumberType
        									if(Indication_array[datapointer]<15)				//known numbertype
        										gPhonebook_NumberType4[position]=Indication_array[datapointer];
        									else														//unknown numbertype
        										gPhonebook_NumberType4[position]=0;
        									datapointer++;
        								}
        								//***************************

        								//*********TelNumber5********
        								if(gPhonebook_TelNumberQuantity[position]>4){
        									//VoiceTag && Reserve of TelNumber5
        									gPhonebook_VoiceTag5[position]=(Indication_array[datapointer] & 0xf0)/0x10;
                                            datapointer++;
                                            //NumberType
        									if(Indication_array[datapointer]<15)				//known numbertype
        										gPhonebook_NumberType5[position]=Indication_array[datapointer];
        									else														//unknown numbertype
        										gPhonebook_NumberType5[position]=0;
        									datapointer++;
        								}
        								//***************************

                                        //*********TelNumber6********
        								if(gPhonebook_TelNumberQuantity[position]>5){
        									//VoiceTag && Reserve of TelNumber6
        									gPhonebook_VoiceTag6[position]=(Indication_array[datapointer] & 0xf0)/0x10;
                                            datapointer++;
                                            //NumberType
        									if(Indication_array[datapointer]<15)				//known numbertype
        										gPhonebook_NumberType6[position]=Indication_array[datapointer];
        									else														//unknown numbertype
        										gPhonebook_NumberType6[position]=0;
        									datapointer++;
                                        }
        								//***************************

                                        //*********TelNumber7********
        								if(gPhonebook_TelNumberQuantity[position]>6){
        									//VoiceTag && Reserve of TelNumber7
        									gPhonebook_VoiceTag7[position]=(Indication_array[datapointer] & 0xf0)/0x10;
                                            datapointer++;
                                            //NumberType
        									if(Indication_array[datapointer]<15)				//known numbertype
        										gPhonebook_NumberType7[position]=Indication_array[datapointer];
        									else														//unknown numbertype
        										gPhonebook_NumberType7[position]=0;
        									datapointer++;
                                        }
        								//***************************

                                        //*********TelNumber8********
        								if(gPhonebook_TelNumberQuantity[position]>7){
        									//VoiceTag && Reserve of TelNumber8
        									gPhonebook_VoiceTag8[position]=(Indication_array[datapointer] & 0xf0)/0x10;
                                            datapointer++;
                                            //NumberType
        									if(Indication_array[datapointer]<15)				//known numbertype
        										gPhonebook_NumberType8[position]=Indication_array[datapointer];
        									else														//unknown numbertype
        										gPhonebook_NumberType8[position]=0;
        									datapointer++;
                                        }
        								//***************************

                                        //*********TelNumber9********
        								if(gPhonebook_TelNumberQuantity[position]>8){
        									datapointer=datapointer+length;

        									//VoiceTag && Reserve of TelNumber9
        									gPhonebook_VoiceTag9[position]=(Indication_array[datapointer] & 0xf0)/0x10;
                                            datapointer++;
                                            //NumberType
        									if(Indication_array[datapointer]<15)				//known numbertype
        										gPhonebook_NumberType9[position]=Indication_array[datapointer];
        									else														//unknown numbertype
        										gPhonebook_NumberType9[position]=0;
        									datapointer++;
                                        }
        								//***************************

                                        //*********TelNumber10********
        								if(gPhonebook_TelNumberQuantity[position]>9){
        									//VoiceTag && Reserve of TelNumber10
        									gPhonebook_VoiceTag10[position]=(Indication_array[datapointer] & 0xf0)/0x10;
                                            datapointer++;
                                            //NumberType
        									if(Indication_array[datapointer]<15)				//known numbertype
        										gPhonebook_NumberType10[position]=Indication_array[datapointer];
        									else														//unknown numbertype
        										gPhonebook_NumberType10[position]=0;
        									datapointer++;
                                        }
        								//***************************
        							}

                                    position=position+1;//next line in stack
    						    }
                            }
                            else if(direction==BACKWARD && elements>0)
                            {
                                while(position>(startline-elements))
                                {
    							    //write("ASG Phonebook_Indication: position %d", position);  //debug
                                    //TransmitPos
            	                    if(transmitpos==1)
                                    {
            		                    if(indexsize)
                                        {
                			                gPhonebook_Pos[position]=Indication_array[datapointer]+Indication_array[datapointer+1]*0xFF;
	                		            datapointer=datapointer+2;
	                	                }
	                	                else
                                        {
	            		                    gPhonebook_Pos[position]=Indication_array[datapointer];
	            		                    datapointer++;
	            	                    }
            	                    }

                                    //PbName
							        length=Indication_array[datapointer];
                                    datapointer++;
								
								    for(i=0;i<PHONEBOOK_PBNAME_LENGTH;i++)												//delete old name
								    	gPhonebook_PbName[position][i]=0;
								    if(length==1 && Indication_array[datapointer]==0x00){
								    	strncpy(gPhonebook_PbName[position], "unknown", PHONEBOOK_PBNAME_LENGTH);
								    }
								    else{
									    for(i=0;i<length;i++)										//save new name
										    gPhonebook_PbName[position][i]=Indication_array[datapointer+i];
								    }
								    datapointer=datapointer+length;

                                    //AnyVoiceTag and TelNumberQuantity
        							gPhonebook_AnyVoiceTag[position]=(Indication_array[datapointer] & 0xf0)/0x10;
        							gPhonebook_TelNumberQuantity[position]=Indication_array[datapointer] & 0x0f;
        							datapointer++;

        							//********VoiceTag and NumberType of TelNumber1-10, dependend on TelNumberQuantity****
        							if(gPhonebook_TelNumberQuantity[position]>0){
        								//*********TelNumber1********
        								//VoiceTag && Reserve of TelNumber1
        									gPhonebook_VoiceTag1[position]=(Indication_array[datapointer] & 0xf0)/0x10;
                                            datapointer++;
                                            //NumberType
        									if(Indication_array[datapointer]<15)				//known numbertype
        										gPhonebook_NumberType1[position]=Indication_array[datapointer];
        									else														//unknown numbertype
        										gPhonebook_NumberType1[position]=0;
        									datapointer++;
        								//***************************

        								//*********TelNumber2********
        								if(gPhonebook_TelNumberQuantity[position]>1){
        									//VoiceTag && Reserve of TelNumber2
        									gPhonebook_VoiceTag2[position]=(Indication_array[datapointer] & 0xf0)/0x10;
                                            datapointer++;
                                            //NumberType
        									if(Indication_array[datapointer]<15)				//known numbertype
        										gPhonebook_NumberType2[position]=Indication_array[datapointer];
        									else														//unknown numbertype
        										gPhonebook_NumberType2[position]=0;
        									datapointer++;
        								}
        								//***************************

        								//*********TelNumber3********
        								if(gPhonebook_TelNumberQuantity[position]>2){
        									//VoiceTag && Reserve of TelNumber3
        									gPhonebook_VoiceTag3[position]=(Indication_array[datapointer] & 0xf0)/0x10;
                                            datapointer++;
                                            //NumberType
        									if(Indication_array[datapointer]<15)				//known numbertype
        										gPhonebook_NumberType3[position]=Indication_array[datapointer];
        									else														//unknown numbertype
        										gPhonebook_NumberType3[position]=0;
        									datapointer++;
        								}
        								//***************************

        								//*********TelNumber4********
        								if(gPhonebook_TelNumberQuantity[position]>3){
        									//VoiceTag && Reserve of TelNumber4
        									gPhonebook_VoiceTag4[position]=(Indication_array[datapointer] & 0xf0)/0x10;
                                            datapointer++;
                                            //NumberType
        									if(Indication_array[datapointer]<15)				//known numbertype
        										gPhonebook_NumberType4[position]=Indication_array[datapointer];
        									else														//unknown numbertype
        										gPhonebook_NumberType4[position]=0;
        									datapointer++;
        								}
        								//***************************

        								//*********TelNumber5********
        								if(gPhonebook_TelNumberQuantity[position]>4){
        									//VoiceTag && Reserve of TelNumber5
        									gPhonebook_VoiceTag5[position]=(Indication_array[datapointer] & 0xf0)/0x10;
                                            datapointer++;
                                            //NumberType
        									if(Indication_array[datapointer]<15)				//known numbertype
        										gPhonebook_NumberType5[position]=Indication_array[datapointer];
        									else														//unknown numbertype
        										gPhonebook_NumberType5[position]=0;
        									datapointer++;
        								}
        								//***************************

                                        //*********TelNumber6********
        								if(gPhonebook_TelNumberQuantity[position]>5){
        									//VoiceTag && Reserve of TelNumber6
        									gPhonebook_VoiceTag6[position]=(Indication_array[datapointer] & 0xf0)/0x10;
                                            datapointer++;
                                            //NumberType
        									if(Indication_array[datapointer]<15)				//known numbertype
        										gPhonebook_NumberType6[position]=Indication_array[datapointer];
        									else														//unknown numbertype
        										gPhonebook_NumberType6[position]=0;
        									datapointer++;
                                        }
        								//***************************

                                        //*********TelNumber7********
        								if(gPhonebook_TelNumberQuantity[position]>6){
        									//VoiceTag && Reserve of TelNumber7
        									gPhonebook_VoiceTag7[position]=(Indication_array[datapointer] & 0xf0)/0x10;
                                            datapointer++;
                                            //NumberType
        									if(Indication_array[datapointer]<15)				//known numbertype
        										gPhonebook_NumberType7[position]=Indication_array[datapointer];
        									else														//unknown numbertype
        										gPhonebook_NumberType7[position]=0;
        									datapointer++;
                                        }
        								//***************************

                                        //*********TelNumber8********
        								if(gPhonebook_TelNumberQuantity[position]>7){
        									//VoiceTag && Reserve of TelNumber8
        									gPhonebook_VoiceTag8[position]=(Indication_array[datapointer] & 0xf0)/0x10;
                                            datapointer++;
                                            //NumberType
        									if(Indication_array[datapointer]<15)				//known numbertype
        										gPhonebook_NumberType8[position]=Indication_array[datapointer];
        									else														//unknown numbertype
        										gPhonebook_NumberType8[position]=0;
        									datapointer++;
                                        }
        								//***************************

                                        //*********TelNumber9********
        								if(gPhonebook_TelNumberQuantity[position]>8){
        									datapointer=datapointer+length;

        									//VoiceTag && Reserve of TelNumber9
        									gPhonebook_VoiceTag9[position]=(Indication_array[datapointer] & 0xf0)/0x10;
                                            datapointer++;
                                            //NumberType
        									if(Indication_array[datapointer]<15)				//known numbertype
        										gPhonebook_NumberType9[position]=Indication_array[datapointer];
        									else														//unknown numbertype
        										gPhonebook_NumberType9[position]=0;
        									datapointer++;
                                        }
        								//***************************

                                        //*********TelNumber10********
        								if(gPhonebook_TelNumberQuantity[position]>9){
        									//VoiceTag && Reserve of TelNumber10
        									gPhonebook_VoiceTag10[position]=(Indication_array[datapointer] & 0xf0)/0x10;
                                            datapointer++;
                                            //NumberType
        									if(Indication_array[datapointer]<15)				//known numbertype
        										gPhonebook_NumberType10[position]=Indication_array[datapointer];
        									else														//unknown numbertype
        										gPhonebook_NumberType10[position]=0;
        									datapointer++;
                                        }
        								//***************************
        							}

                                    position=position-1;//next line in stack
                                }
						    }

					    break;
                        case 4:	//TelNumberQuantity,TelNumber,VoiceTag,NumberType

						    position=startline;

                            if(direction==FORWARD)
                            {						
                                while(position<(startline+elements))
                                {
    							    //write("ASG Phonebook_Indication: position %d", position);  //debug
                                    //TransmitPos
            	                    if(transmitpos==1)
                                    {
            		                    if(indexsize)
                                        {
                			                gPhonebook_Pos[position]=Indication_array[datapointer]+Indication_array[datapointer+1]*0xFF;
	                		            datapointer=datapointer+2;
	                	                }
	                	                else
                                        {
	            		                    gPhonebook_Pos[position]=Indication_array[datapointer];
	            		                    datapointer++;
	            	                    }
            	                    }

                                    //TelNumberQuantity
        							gPhonebook_TelNumberQuantity[position]=Indication_array[datapointer] & 0x0f;
        							datapointer++;

        							//********TelNumber1-10 with VoiceTag and NumberType, dependend on TelNumberQuantity****
        							if(gPhonebook_TelNumberQuantity[position]>0){
        								//*********TelNumber1********
        								length=Indication_array[datapointer];
        								datapointer++;
        								for(i=0;i<length;i++)
        									gPhonebook_TelNumber1[position][i]=Indication_array[datapointer+i];
								
        								datapointer=datapointer+length;

        								//VoiceTag && Reserve of TelNumber1
        									gPhonebook_VoiceTag1[position]=(Indication_array[datapointer] & 0xf0)/0x10;
                                            datapointer++;
                                            //NumberType
        									if(Indication_array[datapointer]<15)				//known numbertype
        										gPhonebook_NumberType1[position]=Indication_array[datapointer];
        									else														//unknown numbertype
        										gPhonebook_NumberType1[position]=0;
        									datapointer++;
        								//***************************

        								//*********TelNumber2********
        								if(gPhonebook_TelNumberQuantity[position]>1){
        									length=Indication_array[datapointer];
        									datapointer++;
        									for(i=0;i<length;i++)
        										gPhonebook_TelNumber2[position][i]=Indication_array[datapointer+i];
								
        									datapointer=datapointer+length;

        									//VoiceTag && Reserve of TelNumber2
        									gPhonebook_VoiceTag2[position]=(Indication_array[datapointer] & 0xf0)/0x10;
                                            datapointer++;
                                            //NumberType
        									if(Indication_array[datapointer]<15)				//known numbertype
        										gPhonebook_NumberType2[position]=Indication_array[datapointer];
        									else														//unknown numbertype
        										gPhonebook_NumberType2[position]=0;
        									datapointer++;
        								}
        								//***************************

        								//*********TelNumber3********
        								if(gPhonebook_TelNumberQuantity[position]>2){
        									length=Indication_array[datapointer];
        									datapointer++;
        									for(i=0;i<length;i++)
        										gPhonebook_TelNumber3[position][i]=Indication_array[datapointer+i];
								
        									datapointer=datapointer+length;

        									//VoiceTag && Reserve of TelNumber3
        									gPhonebook_VoiceTag3[position]=(Indication_array[datapointer] & 0xf0)/0x10;
                                            datapointer++;
                                            //NumberType
        									if(Indication_array[datapointer]<15)				//known numbertype
        										gPhonebook_NumberType3[position]=Indication_array[datapointer];
        									else														//unknown numbertype
        										gPhonebook_NumberType3[position]=0;
        									datapointer++;
        								}
        								//***************************

        								//*********TelNumber4********
        								if(gPhonebook_TelNumberQuantity[position]>3){
        									length=Indication_array[datapointer];
        									datapointer++;
        									for(i=0;i<length;i++)
        										gPhonebook_TelNumber4[position][i]=Indication_array[datapointer+i];
								
        									datapointer=datapointer+length;

        									//VoiceTag && Reserve of TelNumber4
        									gPhonebook_VoiceTag4[position]=(Indication_array[datapointer] & 0xf0)/0x10;
                                            datapointer++;
                                            //NumberType
        									if(Indication_array[datapointer]<15)				//known numbertype
        										gPhonebook_NumberType4[position]=Indication_array[datapointer];
        									else														//unknown numbertype
        										gPhonebook_NumberType4[position]=0;
        									datapointer++;
        								}
        								//***************************

        								//*********TelNumber5********
        								if(gPhonebook_TelNumberQuantity[position]>4){
        									length=Indication_array[datapointer];
        									datapointer++;
        									for(i=0;i<length;i++)
        										gPhonebook_TelNumber5[position][i]=Indication_array[datapointer+i];
								
        									datapointer=datapointer+length;

        									//VoiceTag && Reserve of TelNumber5
        									gPhonebook_VoiceTag5[position]=(Indication_array[datapointer] & 0xf0)/0x10;
                                            datapointer++;
                                            //NumberType
        									if(Indication_array[datapointer]<15)				//known numbertype
        										gPhonebook_NumberType5[position]=Indication_array[datapointer];
        									else														//unknown numbertype
        										gPhonebook_NumberType5[position]=0;
        									datapointer++;
        								}
        								//***************************

                                        //*********TelNumber6********
        								if(gPhonebook_TelNumberQuantity[position]>5){
        									length=Indication_array[datapointer];
        									datapointer++;
        									for(i=0;i<length;i++)
        										gPhonebook_TelNumber6[position][i]=Indication_array[datapointer+i];
								
        									datapointer=datapointer+length;

        									//VoiceTag && Reserve of TelNumber6
        									gPhonebook_VoiceTag6[position]=(Indication_array[datapointer] & 0xf0)/0x10;
                                            datapointer++;
                                            //NumberType
        									if(Indication_array[datapointer]<15)				//known numbertype
        										gPhonebook_NumberType6[position]=Indication_array[datapointer];
        									else														//unknown numbertype
        										gPhonebook_NumberType6[position]=0;
        									datapointer++;
                                        }
        								//***************************

                                        //*********TelNumber7********
        								if(gPhonebook_TelNumberQuantity[position]>6){
        									length=Indication_array[datapointer];
        									datapointer++;
        									for(i=0;i<length;i++)
        										gPhonebook_TelNumber7[position][i]=Indication_array[datapointer+i];
								
        									datapointer=datapointer+length;

        									//VoiceTag && Reserve of TelNumber7
        									gPhonebook_VoiceTag7[position]=(Indication_array[datapointer] & 0xf0)/0x10;
                                            datapointer++;
                                            //NumberType
        									if(Indication_array[datapointer]<15)				//known numbertype
        										gPhonebook_NumberType7[position]=Indication_array[datapointer];
        									else														//unknown numbertype
        										gPhonebook_NumberType7[position]=0;
        									datapointer++;
                                        }
        								//***************************

                                        //*********TelNumber8********
        								if(gPhonebook_TelNumberQuantity[position]>7){
        									length=Indication_array[datapointer];
        									datapointer++;
        									for(i=0;i<length;i++)
        										gPhonebook_TelNumber8[position][i]=Indication_array[datapointer+i];
								
        									datapointer=datapointer+length;

        									//VoiceTag && Reserve of TelNumber8
        									gPhonebook_VoiceTag8[position]=(Indication_array[datapointer] & 0xf0)/0x10;
                                            datapointer++;
                                            //NumberType
        									if(Indication_array[datapointer]<15)				//known numbertype
        										gPhonebook_NumberType8[position]=Indication_array[datapointer];
        									else														//unknown numbertype
        										gPhonebook_NumberType8[position]=0;
        									datapointer++;
                                        }
        								//***************************

                                        //*********TelNumber9********
        								if(gPhonebook_TelNumberQuantity[position]>8){
        									length=Indication_array[datapointer];
        									datapointer++;
        									for(i=0;i<length;i++)
        										gPhonebook_TelNumber9[position][i]=Indication_array[datapointer+i];
								
        									datapointer=datapointer+length;

        									//VoiceTag && Reserve of TelNumber9
        									gPhonebook_VoiceTag9[position]=(Indication_array[datapointer] & 0xf0)/0x10;
                                            datapointer++;
                                            //NumberType
        									if(Indication_array[datapointer]<15)				//known numbertype
        										gPhonebook_NumberType9[position]=Indication_array[datapointer];
        									else														//unknown numbertype
        										gPhonebook_NumberType9[position]=0;
        									datapointer++;
                                        }
        								//***************************

                                        //*********TelNumber10********
        								if(gPhonebook_TelNumberQuantity[position]>9){
        									length=Indication_array[datapointer];
        									datapointer++;
        									for(i=0;i<length;i++)
        										gPhonebook_TelNumber10[position][i]=Indication_array[datapointer+i];
								
        									datapointer=datapointer+length;

        									//VoiceTag && Reserve of TelNumber10
        									gPhonebook_VoiceTag10[position]=(Indication_array[datapointer] & 0xf0)/0x10;
                                            datapointer++;
                                            //NumberType
        									if(Indication_array[datapointer]<15)				//known numbertype
        										gPhonebook_NumberType10[position]=Indication_array[datapointer];
        									else														//unknown numbertype
        										gPhonebook_NumberType10[position]=0;
        									datapointer++;
                                        }
        								//***************************
        							}

                                    position=position+1;//next line in stack
    						    }
                            }
                            else if(direction==BACKWARD && elements>0)
                            {
                                while(position>(startline-elements))
                                {
    							    ///write("ASG Phonebook_Indication: position %d", position);  //debug
                                    //TransmitPos
            	                    if(transmitpos==1)
                                    {
            		                    if(indexsize)
                                        {
                			                gPhonebook_Pos[position]=Indication_array[datapointer]+Indication_array[datapointer+1]*0xFF;
	                		            datapointer=datapointer+2;
	                	                }
	                	                else
                                        {
	            		                    gPhonebook_Pos[position]=Indication_array[datapointer];
	            		                    datapointer++;
	            	                    }
            	                    }

                                    //TelNumberQuantity
        							gPhonebook_TelNumberQuantity[position]=Indication_array[datapointer] & 0x0f;
        							datapointer++;

        							//********TelNumber1-10 with VoiceTag and NumberType, dependend on TelNumberQuantity****
        							if(gPhonebook_TelNumberQuantity[position]>0){
        								//*********TelNumber1********
        								length=Indication_array[datapointer];
        								datapointer++;
        								for(i=0;i<length;i++)
        									gPhonebook_TelNumber1[position][i]=Indication_array[datapointer+i];
								
        								datapointer=datapointer+length;

        								//VoiceTag && Reserve of TelNumber1
        									gPhonebook_VoiceTag1[position]=(Indication_array[datapointer] & 0xf0)/0x10;
                                            datapointer++;
                                            //NumberType
        									if(Indication_array[datapointer]<15)				//known numbertype
        										gPhonebook_NumberType1[position]=Indication_array[datapointer];
        									else														//unknown numbertype
        										gPhonebook_NumberType1[position]=0;
        									datapointer++;
        								//***************************

        								//*********TelNumber2********
        								if(gPhonebook_TelNumberQuantity[position]>1){
        									length=Indication_array[datapointer];
        									datapointer++;
        									for(i=0;i<length;i++)
        										gPhonebook_TelNumber2[position][i]=Indication_array[datapointer+i];
								
        									datapointer=datapointer+length;

        									//VoiceTag && Reserve of TelNumber2
        									gPhonebook_VoiceTag2[position]=(Indication_array[datapointer] & 0xf0)/0x10;
                                            datapointer++;
                                            //NumberType
        									if(Indication_array[datapointer]<15)				//known numbertype
        										gPhonebook_NumberType2[position]=Indication_array[datapointer];
        									else														//unknown numbertype
        										gPhonebook_NumberType2[position]=0;
        									datapointer++;
        								}
        								//***************************

        								//*********TelNumber3********
        								if(gPhonebook_TelNumberQuantity[position]>2){
        									length=Indication_array[datapointer];
        									datapointer++;
        									for(i=0;i<length;i++)
        										gPhonebook_TelNumber3[position][i]=Indication_array[datapointer+i];
								
        									datapointer=datapointer+length;

        									//VoiceTag && Reserve of TelNumber3
        									gPhonebook_VoiceTag3[position]=(Indication_array[datapointer] & 0xf0)/0x10;
                                            datapointer++;
                                            //NumberType
        									if(Indication_array[datapointer]<15)				//known numbertype
        										gPhonebook_NumberType3[position]=Indication_array[datapointer];
        									else														//unknown numbertype
        										gPhonebook_NumberType3[position]=0;
        									datapointer++;
        								}
        								//***************************

        								//*********TelNumber4********
        								if(gPhonebook_TelNumberQuantity[position]>3){
        									length=Indication_array[datapointer];
        									datapointer++;
        									for(i=0;i<length;i++)
        										gPhonebook_TelNumber4[position][i]=Indication_array[datapointer+i];
								
        									datapointer=datapointer+length;

        									//VoiceTag && Reserve of TelNumber4
        									gPhonebook_VoiceTag4[position]=(Indication_array[datapointer] & 0xf0)/0x10;
                                            datapointer++;
                                            //NumberType
        									if(Indication_array[datapointer]<15)				//known numbertype
        										gPhonebook_NumberType4[position]=Indication_array[datapointer];
        									else														//unknown numbertype
        										gPhonebook_NumberType4[position]=0;
        									datapointer++;
        								}
        								//***************************

        								//*********TelNumber5********
        								if(gPhonebook_TelNumberQuantity[position]>4){
        									length=Indication_array[datapointer];
        									datapointer++;
        									for(i=0;i<length;i++)
        										gPhonebook_TelNumber5[position][i]=Indication_array[datapointer+i];
								
        									datapointer=datapointer+length;

        									//VoiceTag && Reserve of TelNumber5
        									gPhonebook_VoiceTag5[position]=(Indication_array[datapointer] & 0xf0)/0x10;
                                            datapointer++;
                                            //NumberType
        									if(Indication_array[datapointer]<15)				//known numbertype
        										gPhonebook_NumberType5[position]=Indication_array[datapointer];
        									else														//unknown numbertype
        										gPhonebook_NumberType5[position]=0;
        									datapointer++;
        								}
        								//***************************

                                        //*********TelNumber6********
        								if(gPhonebook_TelNumberQuantity[position]>5){
        									length=Indication_array[datapointer];
        									datapointer++;
        									for(i=0;i<length;i++)
        										gPhonebook_TelNumber6[position][i]=Indication_array[datapointer+i];
								
        									datapointer=datapointer+length;

        									//VoiceTag && Reserve of TelNumber6
        									gPhonebook_VoiceTag6[position]=(Indication_array[datapointer] & 0xf0)/0x10;
                                            datapointer++;
                                            //NumberType
        									if(Indication_array[datapointer]<15)				//known numbertype
        										gPhonebook_NumberType6[position]=Indication_array[datapointer];
        									else														//unknown numbertype
        										gPhonebook_NumberType6[position]=0;
        									datapointer++;
                                        }
        								//***************************

                                        //*********TelNumber7********
        								if(gPhonebook_TelNumberQuantity[position]>6){
        									length=Indication_array[datapointer];
        									datapointer++;
        									for(i=0;i<length;i++)
        										gPhonebook_TelNumber7[position][i]=Indication_array[datapointer+i];
								
        									datapointer=datapointer+length;

        									//VoiceTag && Reserve of TelNumber7
        									gPhonebook_VoiceTag7[position]=(Indication_array[datapointer] & 0xf0)/0x10;
                                            datapointer++;
                                            //NumberType
        									if(Indication_array[datapointer]<15)				//known numbertype
        										gPhonebook_NumberType7[position]=Indication_array[datapointer];
        									else														//unknown numbertype
        										gPhonebook_NumberType7[position]=0;
        									datapointer++;
                                        }
        								//***************************

                                        //*********TelNumber8********
        								if(gPhonebook_TelNumberQuantity[position]>7){
        									length=Indication_array[datapointer];
        									datapointer++;
        									for(i=0;i<length;i++)
        										gPhonebook_TelNumber8[position][i]=Indication_array[datapointer+i];
								
        									datapointer=datapointer+length;

        									//VoiceTag && Reserve of TelNumber8
        									gPhonebook_VoiceTag8[position]=(Indication_array[datapointer] & 0xf0)/0x10;
                                            datapointer++;
                                            //NumberType
        									if(Indication_array[datapointer]<15)				//known numbertype
        										gPhonebook_NumberType8[position]=Indication_array[datapointer];
        									else														//unknown numbertype
        										gPhonebook_NumberType8[position]=0;
        									datapointer++;
                                        }
        								//***************************

                                        //*********TelNumber9********
        								if(gPhonebook_TelNumberQuantity[position]>8){
        									length=Indication_array[datapointer];
        									datapointer++;
        									for(i=0;i<length;i++)
        										gPhonebook_TelNumber9[position][i]=Indication_array[datapointer+i];
								
        									datapointer=datapointer+length;

        									//VoiceTag && Reserve of TelNumber9
        									gPhonebook_VoiceTag9[position]=(Indication_array[datapointer] & 0xf0)/0x10;
                                            datapointer++;
                                            //NumberType
        									if(Indication_array[datapointer]<15)				//known numbertype
        										gPhonebook_NumberType9[position]=Indication_array[datapointer];
        									else														//unknown numbertype
        										gPhonebook_NumberType9[position]=0;
        									datapointer++;
                                        }
        								//***************************

                                        //*********TelNumber10********
        								if(gPhonebook_TelNumberQuantity[position]>9){
        									length=Indication_array[datapointer];
        									datapointer++;
        									for(i=0;i<length;i++)
        										gPhonebook_TelNumber10[position][i]=Indication_array[datapointer+i];
								
        									datapointer=datapointer+length;

        									//VoiceTag && Reserve of TelNumber10
        									gPhonebook_VoiceTag10[position]=(Indication_array[datapointer] & 0xf0)/0x10;
                                            datapointer++;
                                            //NumberType
        									if(Indication_array[datapointer]<15)				//known numbertype
        										gPhonebook_NumberType10[position]=Indication_array[datapointer];
        									else														//unknown numbertype
        										gPhonebook_NumberType10[position]=0;
        									datapointer++;
                                        }
        								//***************************
        							}

                                    position=position-1;//next line in stack
                                }
						    }

					    break;
                        case 15:	//Pos only

						    position=startline;

                            if(direction==FORWARD)
						    {
                                while(position<(startline+elements))
                                {
    							    //TransmitPos
                	                if(transmitpos==1)
                                    {
                		                if(indexsize)
                                        {
                			                gPhonebook_Pos[position]=Indication_array[datapointer]+Indication_array[datapointer+1]*0xFF;
    	            		                datapointer=datapointer+2;
    	            	                }
    	            	                else
                                        {
    	            		                gPhonebook_Pos[position]=Indication_array[datapointer];
    	            		                datapointer++;
    	            	                }
                	                }
                                    position=position+1;//next line in stack
    						    }
                            }
                            else if(direction==BACKWARD && elements>0)
                            {
                                while(position>(startline-elements))
                                {
    							    //TransmitPos
                	                if(transmitpos==1)
                                    {
                		                if(indexsize)
                                        {
                			                gPhonebook_Pos[position]=Indication_array[datapointer]+Indication_array[datapointer+1]*0xFF;
    	            		                datapointer=datapointer+2;
    	            	                }
    	            	                else
                                        {
    	            		                gPhonebook_Pos[position]=Indication_array[datapointer];
    	            		                datapointer++;
    	            	                }
                	                }
                                    position=position-1;//next line in stack
    						    }
                            }
                            
					    break;
					    default:
						    writelineEx(gError_Trace, 0, "ASG Phonebook_Indication: invalid recoraddress: %d ", recordaddress);
					    break;
				    }
                    //for all RecordAddresses
                    display_phonebook();
                }
			break;
			case Error_IND:
				writelineEx(gError_Trace, 0, "ASG Phonebook_Indication: recieved error, errorcode:0x%x", Indication_array[3]);
			break;
			default:
				writelineEx(gError_Trace, 0, "ASG Phonebook_Indication: unknown indication %d", indication);
			break;
		}
	}

}
/*@@end*/

/*@@caplFunc:display_SMSReceived():*/
display_SMSReceived ()
{

	//SMSMPbName
	putvalue(env_ASG_SMSReceived0_PbName, gSMSReceived_pbname[0]);
	putvalue(env_ASG_SMSReceived1_PbName, gSMSReceived_pbname[1]);
	putvalue(env_ASG_SMSReceived2_PbName, gSMSReceived_pbname[2]);
	putvalue(env_ASG_SMSReceived3_PbName, gSMSReceived_pbname[3]);
	putvalue(env_ASG_SMSReceived4_PbName, gSMSReceived_pbname[4]);
	putvalue(env_ASG_SMSReceived5_PbName, gSMSReceived_pbname[5]);
	putvalue(env_ASG_SMSReceived6_PbName, gSMSReceived_pbname[6]);
	putvalue(env_ASG_SMSReceived7_PbName, gSMSReceived_pbname[7]);
	putvalue(env_ASG_SMSReceived8_PbName, gSMSReceived_pbname[8]);
	putvalue(env_ASG_SMSReceived9_PbName, gSMSReceived_pbname[9]);

	//SMSAttrib
	putvalue(env_ASG_SMSReceived0_Attrib, gSMSReceived_smsattrib[0]);
	putvalue(env_ASG_SMSReceived1_Attrib, gSMSReceived_smsattrib[1]);
	putvalue(env_ASG_SMSReceived2_Attrib, gSMSReceived_smsattrib[2]);
	putvalue(env_ASG_SMSReceived3_Attrib, gSMSReceived_smsattrib[3]);
	putvalue(env_ASG_SMSReceived4_Attrib, gSMSReceived_smsattrib[4]);
	putvalue(env_ASG_SMSReceived5_Attrib, gSMSReceived_smsattrib[5]);
	putvalue(env_ASG_SMSReceived6_Attrib, gSMSReceived_smsattrib[6]);
	putvalue(env_ASG_SMSReceived7_Attrib, gSMSReceived_smsattrib[7]);
	putvalue(env_ASG_SMSReceived8_Attrib, gSMSReceived_smsattrib[8]);
	putvalue(env_ASG_SMSReceived9_Attrib, gSMSReceived_smsattrib[9]);

	//SMSTelNumber
	putvalue(env_ASG_SMSReceived0_TelNumber, gSMSReceived_telnumber[0]);
	putvalue(env_ASG_SMSReceived1_TelNumber, gSMSReceived_telnumber[1]);
	putvalue(env_ASG_SMSReceived2_TelNumber, gSMSReceived_telnumber[2]);
	putvalue(env_ASG_SMSReceived3_TelNumber, gSMSReceived_telnumber[3]);
	putvalue(env_ASG_SMSReceived4_TelNumber, gSMSReceived_telnumber[4]);
	putvalue(env_ASG_SMSReceived5_TelNumber, gSMSReceived_telnumber[5]);
	putvalue(env_ASG_SMSReceived6_TelNumber, gSMSReceived_telnumber[6]);
	putvalue(env_ASG_SMSReceived7_TelNumber, gSMSReceived_telnumber[7]);
	putvalue(env_ASG_SMSReceived8_TelNumber, gSMSReceived_telnumber[8]);
	putvalue(env_ASG_SMSReceived9_TelNumber, gSMSReceived_telnumber[9]);

	//Date
	putvalue(env_ASG_SMSReceived0_day, gSMSReceived_day[0]);
	putvalue(env_ASG_SMSReceived0_month, gSMSReceived_month[0]);
	putvalue(env_ASG_SMSReceived0_year, gSMSReceived_year[0]);
	putvalue(env_ASG_SMSReceived1_day, gSMSReceived_day[1]);
	putvalue(env_ASG_SMSReceived1_month, gSMSReceived_month[1]);
	putvalue(env_ASG_SMSReceived1_year, gSMSReceived_year[1]);
	putvalue(env_ASG_SMSReceived2_day, gSMSReceived_day[2]);
	putvalue(env_ASG_SMSReceived2_month, gSMSReceived_month[2]);
	putvalue(env_ASG_SMSReceived2_year, gSMSReceived_year[2]);
	putvalue(env_ASG_SMSReceived3_day, gSMSReceived_day[3]);
	putvalue(env_ASG_SMSReceived3_month, gSMSReceived_month[3]);
	putvalue(env_ASG_SMSReceived3_year, gSMSReceived_year[3]);
	putvalue(env_ASG_SMSReceived4_day, gSMSReceived_day[4]);
	putvalue(env_ASG_SMSReceived4_month, gSMSReceived_month[4]);
	putvalue(env_ASG_SMSReceived4_year, gSMSReceived_year[4]);
	putvalue(env_ASG_SMSReceived5_day, gSMSReceived_day[5]);
	putvalue(env_ASG_SMSReceived5_month, gSMSReceived_month[5]);
	putvalue(env_ASG_SMSReceived5_year, gSMSReceived_year[5]);
	putvalue(env_ASG_SMSReceived6_day, gSMSReceived_day[6]);
	putvalue(env_ASG_SMSReceived6_month, gSMSReceived_month[6]);
	putvalue(env_ASG_SMSReceived6_year, gSMSReceived_year[6]);
	putvalue(env_ASG_SMSReceived7_day, gSMSReceived_day[7]);
	putvalue(env_ASG_SMSReceived7_month, gSMSReceived_month[7]);
	putvalue(env_ASG_SMSReceived7_year, gSMSReceived_year[7]);
	putvalue(env_ASG_SMSReceived8_day, gSMSReceived_day[8]);
	putvalue(env_ASG_SMSReceived8_month, gSMSReceived_month[8]);
	putvalue(env_ASG_SMSReceived8_year, gSMSReceived_year[8]);
	putvalue(env_ASG_SMSReceived9_day, gSMSReceived_day[9]);
	putvalue(env_ASG_SMSReceived9_month, gSMSReceived_month[9]);
	putvalue(env_ASG_SMSReceived9_year, gSMSReceived_year[9]);

	//Time
	putvalue(env_ASG_SMSReceived0_hour, gSMSReceived_hour[0]);
	putvalue(env_ASG_SMSReceived0_min, gSMSReceived_minute[0]);
	putvalue(env_ASG_SMSReceived0_sec, gSMSReceived_second[0]);
	putvalue(env_ASG_SMSReceived1_hour, gSMSReceived_hour[1]);
	putvalue(env_ASG_SMSReceived1_min, gSMSReceived_minute[1]);
	putvalue(env_ASG_SMSReceived1_sec, gSMSReceived_second[1]);
	putvalue(env_ASG_SMSReceived2_hour, gSMSReceived_hour[2]);
	putvalue(env_ASG_SMSReceived2_min, gSMSReceived_minute[2]);
	putvalue(env_ASG_SMSReceived2_sec, gSMSReceived_second[2]);
	putvalue(env_ASG_SMSReceived3_hour, gSMSReceived_hour[3]);
	putvalue(env_ASG_SMSReceived3_min, gSMSReceived_minute[3]);
	putvalue(env_ASG_SMSReceived3_sec, gSMSReceived_second[3]);
	putvalue(env_ASG_SMSReceived4_hour, gSMSReceived_hour[4]);
	putvalue(env_ASG_SMSReceived4_min, gSMSReceived_minute[4]);
	putvalue(env_ASG_SMSReceived4_sec, gSMSReceived_second[4]);
	putvalue(env_ASG_SMSReceived5_hour, gSMSReceived_hour[5]);
	putvalue(env_ASG_SMSReceived5_min, gSMSReceived_minute[5]);
	putvalue(env_ASG_SMSReceived5_sec, gSMSReceived_second[5]);
	putvalue(env_ASG_SMSReceived6_hour, gSMSReceived_hour[6]);
	putvalue(env_ASG_SMSReceived6_min, gSMSReceived_minute[6]);
	putvalue(env_ASG_SMSReceived6_sec, gSMSReceived_second[6]);
	putvalue(env_ASG_SMSReceived7_hour, gSMSReceived_hour[7]);
	putvalue(env_ASG_SMSReceived7_min, gSMSReceived_minute[7]);
	putvalue(env_ASG_SMSReceived7_sec, gSMSReceived_second[7]);
	putvalue(env_ASG_SMSReceived8_hour, gSMSReceived_hour[8]);
	putvalue(env_ASG_SMSReceived8_min, gSMSReceived_minute[8]);
	putvalue(env_ASG_SMSReceived8_sec, gSMSReceived_second[8]);
	putvalue(env_ASG_SMSReceived9_hour, gSMSReceived_hour[9]);
	putvalue(env_ASG_SMSReceived9_min, gSMSReceived_minute[9]);
	putvalue(env_ASG_SMSReceived9_sec, gSMSReceived_second[9]);
	//Text
	putvalue(env_ASG_SMSReceived0_Text, gSMSReceived_text[0]);
	putvalue(env_ASG_SMSReceived1_Text, gSMSReceived_text[1]);
	putvalue(env_ASG_SMSReceived2_Text, gSMSReceived_text[2]);
	putvalue(env_ASG_SMSReceived3_Text, gSMSReceived_text[3]);
	putvalue(env_ASG_SMSReceived4_Text, gSMSReceived_text[4]);
	putvalue(env_ASG_SMSReceived5_Text, gSMSReceived_text[5]);
	putvalue(env_ASG_SMSReceived6_Text, gSMSReceived_text[6]);
	putvalue(env_ASG_SMSReceived7_Text, gSMSReceived_text[7]);
	putvalue(env_ASG_SMSReceived8_Text, gSMSReceived_text[8]);
	putvalue(env_ASG_SMSReceived9_Text, gSMSReceived_text[9]);
}
/*@@end*/

/*@@caplFunc:delete_phonebook():*/
delete_phonebook ()
{
/*
int i=0, j=0;

	for(j=0;j<PHONEBOOK_ENTRIES;j++){
		for(i=0;i<PHONEBOOK_PBNAME_LENGTH;i++)
			gPhonebook_pbname [j][i]=0;
		gPhonebook_anyvoicetag [j]=0;
		gPhonebook_TelNumberquantity [j]=0;
		for(i=0;i<PHONEBOOK_TELNUMBER_LENGTH;i++){
			gPhonebook_TelNumber1 [j][i]=0;
			gPhonebook_TelNumber2 [j][i]=0;
			gPhonebook_TelNumber3 [j][i]=0;
			gPhonebook_TelNumber4 [j][i]=0;
			gPhonebook_TelNumber5 [j][i]=0;
		}
		gPhonebook_voicetag1 [j]=0;
		gPhonebook_voicetag2 [j]=0;
		gPhonebook_voicetag3 [j]=0;
		gPhonebook_voicetag4 [j]=0;
		gPhonebook_voicetag5 [j]=0;
		gPhonebook_numbertype1 [j]=0;
		gPhonebook_numbertype2 [j]=0;
		gPhonebook_numbertype3 [j]=0;
		gPhonebook_numbertype4 [j]=0;
		gPhonebook_numbertype5 [j]=0;
	}

*/
}
/*@@end*/

/*@@msg:CAN1.BAP_only_MQB_v095::BAP_Telefon_FSG_01 (0x17332810X):*/
on message BAP_Telefon_FSG_01
{
int i, temp;
byte RX_Data[8];			//received CAN-DATA
dword RX_Header[3];			//received CAN-Header

	if(gRNS_PowerOnOff==Power_on){   
	    RX_Header[0]=this.CAN; 
	    RX_Header[1]=this.ID; 
	    RX_Header[2]=this.DLC; // received length
	
		//write("header: CAN=%d, ID=%x, Länge=%d", RX_Header[0], RX_Header[1], RX_Header[2]);	//debug
		//write("Data:");																		//debug

	    for (i=0; i<this.DLC; i++) {							//CAN-data
		    RX_Data[i]=this.byte(i);
		//	writeEX(1, 0, " %x",RX_Data [i]);													//debug
	    }
	

		temp=Bap150_CAN_SetRxDat(NODE_INDEX,RX_Header,RX_Data);	//send recieved CAN-data with CAN-header to BAP-DLL
		//write("BAP_CAN_SetRxData: %d", temp);
	}
}
/*@@end*/

/*@@envVar:env_ASG_SlidingWindow_OnOff:*/
on envVar env_ASG_SlidingWindow_OnOff
{
char empty_string [2];
byte i, j;

empty_string[0]=0;
empty_string[1]=0;

	if(gRNS_PowerOnOff==Power_on){
		gSlidingWindowMode=getvalue(this);

		if(gSlidingWindowMode){
			EnableControl("ASG-Telephone_SlidingWindow","ASG_SlW", 1);
            EnableControl("ASG-Telephone_MissedCalls(array)","MissedCalls_GetArray",0);

            gVorhaltUpStatus=0;
			gVorhaltDownStatus=0;
            putvalue(env_ASG_SlW_Vorhalt_n_max, SLW_LOWER_CACHE);
			putvalue(env_ASG_SlidingWindow_Vorhalt_n, gVorhaltDownStatus);
			putvalue(env_ASG_SlW_Vorhalt_v_max, SLW_UPPER_CACHE);
			putvalue(env_ASG_SlidingWindow_Vorhalt_v,gVorhaltUpStatus);
			
            gLongKeyPressTime=10;
			gLongKeyPressAgainTime=4000;
			gKeyPressCode=0;
			gScrollingEntries=5;
			putvalue(env_ASG_SlW_Slider_string, gstring_SlWSlider[getvalue(env_ASG_SlW_Slider)]);
			putvalue(env_ASG_SlW_LongPressAgainTime, gLongKeyPressAgainTime);
			putvalue(env_ASG_SlW_LongPressTime, gLongKeyPressTime);
			putvalue(env_ASG_SlW_ScrollingEntries, gScrollingEntries);
	        
            gmissedcalls_FullRangeUpdate=1;            //Activate FullRangeUpdate

			gSlW_DownloadVorhaltUp=FALSE;
			gSlW_DownloadVorhaltDown=TRUE;
			gSlW_Download_status=WINDOW;

			MissedCalls_Request(DataGet_REQ, SLW_FIRST_LIST_ELEMENT, SLW_WINDOW_CACHE, 0x01, 0);
            
		    //display_SlW_Window();
		}
		else{

            EnableControl("ASG-Telephone_MissedCalls(array)","MissedCalls_GetArray",1);
			//reset SlidingWindow-Arrays
			for(i=0;i<SLW_ENTRIES;i++){
                gSlidingWindow_pos[i]=0;
                for(j=0;j<CALL_INFO_NAME_LENGTH;j++)
					gSlidingWindow_pbname[i][j]=0;
				gSlidingWindow_numbertype[i]=0;
			}

			display_SlW_Window();			

			//init Detail-Array
			for(i=0;i<CALL_INFO_NAME_LENGTH;i++)
				gDetail_pbname[i]=0;
			gDetail_anyvoicetag=0;
			gDetail_telnumberquantity=0;
			for(i=0;i<CALL_INFO_NUMBER_LENGTH;i++){
				gDetail_telnumber1[i]=0;
				gDetail_telnumber2[i]=0;
				gDetail_telnumber3[i]=0;
				gDetail_telnumber4[i]=0;
				gDetail_telnumber5[i]=0;
			}
			gDetail_voicetag1=0;
			gDetail_voicetag2=0;
			gDetail_voicetag3=0;
			gDetail_voicetag4=0;
			gDetail_voicetag5=0;
			gDetail_numbertype1=0;
			gDetail_numbertype2=0;
			gDetail_numbertype3=0;
			gDetail_numbertype4=0;
			gDetail_numbertype5=0;

			display_SlW_Detail();

			putvalue(env_ASG_SlW_Vorhalt_v_max, 0);
			putvalue(env_ASG_SlidingWindow_Vorhalt_v,0);
			putvalue(env_ASG_SlW_Vorhalt_n_max, 0);
			putvalue(env_ASG_SlidingWindow_Vorhalt_n, 0);
			putvalue(env_ASG_SlW_LongPressAgainTime, 0);
			putvalue(env_ASG_SlW_Slider_string, empty_string);
			
			EnableControl("ASG-SlindingWindow","ASG_SlW", 0);
		}

		putvalue(env_ASG_SlidingWindow_OnOff_str, gstring_SlW_Mode[gSlidingWindowMode]);
	}

}
/*@@end*/

/*@@caplFunc:display_SlW_Detail():*/
display_SlW_Detail ()
{

	

	putvalue(env_ASG_SlW_Detail_PbName, gDetail_pbname);

	putvalue(env_ASG_SlW_Detail_AnyVoiceTag, gDetail_pos);

	putvalue(env_ASG_SlW_Detail_TelNumber1, gDetail_telnumber);
	putvalue(env_ASG_SlW_Detail_TelNumber2, gDetail_date);
	putvalue(env_ASG_SlW_Detail_TelNumber3, gDetail_time);

	putvalue(env_ASG_SlW_Detail_NumberType1, gnumbertype[gDetail_numbertype]);
	

}
/*@@end*/

/*@@caplFunc:display_SlW_Window():*/
display_SlW_Window ()
{
    int slw_first_window_element=SLW_FIRST_WINDOW_ELEMENT;

	if(SLW_WINDOW_CACHE>0)
    {
        putvalue(env_ASG_SlidingWindow_Pos1, gSlidingWindow_pos[slw_first_window_element]);
        putvalue(env_ASG_SlidingWindow_PbName1, gSlidingWindow_pbname[slw_first_window_element]);
        putvalue(env_ASG_SlidingWindow_Ntype1, gnumbertype[gSlidingWindow_numbertype[slw_first_window_element]]);
        
        if(SLW_WINDOW_CACHE>1)
        {
	        putvalue(env_ASG_SlidingWindow_Pos2, gSlidingWindow_pos[slw_first_window_element+1]);
            putvalue(env_ASG_SlidingWindow_PbName2, gSlidingWindow_pbname[slw_first_window_element+1]);
            putvalue(env_ASG_SlidingWindow_Ntype2, gnumbertype[gSlidingWindow_numbertype[slw_first_window_element+1]]);
        
            if(SLW_WINDOW_CACHE>2)
            {
                putvalue(env_ASG_SlidingWindow_Pos3, gSlidingWindow_pos[slw_first_window_element+2]);
                putvalue(env_ASG_SlidingWindow_PbName3, gSlidingWindow_pbname[slw_first_window_element+2]);
                putvalue(env_ASG_SlidingWindow_Ntype3, gnumbertype[gSlidingWindow_numbertype[slw_first_window_element+2]]);
            
                if(SLW_WINDOW_CACHE>3)
                {
                    putvalue(env_ASG_SlidingWindow_Pos4, gSlidingWindow_pos[slw_first_window_element+3]);
                    putvalue(env_ASG_SlidingWindow_PbName4, gSlidingWindow_pbname[slw_first_window_element+3]);
                    putvalue(env_ASG_SlidingWindow_Ntype4, gnumbertype[gSlidingWindow_numbertype[slw_first_window_element+3]]);
    
                    if(SLW_WINDOW_CACHE>4)
                    {
                        putvalue(env_ASG_SlidingWindow_Pos5, gSlidingWindow_pos[slw_first_window_element+4]);
                        putvalue(env_ASG_SlidingWindow_PbName5, gSlidingWindow_pbname[slw_first_window_element+4]);
                        putvalue(env_ASG_SlidingWindow_Ntype5, gnumbertype[gSlidingWindow_numbertype[slw_first_window_element+4]]);
                    }
                }
            }
        }
    }
}
/*@@end*/

/*@@envVar:env_ASG_SlW_Detailed_select:*/
on envVar env_ASG_SlW_Detailed_select
{
	if(gRNS_PowerOnOff==Power_on && gSlidingWindowMode && getvalue(this)){
        MissedCalls_Request(DataGet_REQ, gSlidingWindow_pos[SLW_FIRST_WINDOW_ELEMENT+getvalue(env_ASG_SlW_Detailed_Number)], 1, 0x00, 0);	
	}

}
/*@@end*/

/*@@envVar:env_ASG_SlidingWindow_Up:*/
on envVar env_ASG_SlidingWindow_Up
{
	if(gRNS_PowerOnOff==Power_on && gSlidingWindowMode){
		if(getvalue(this)){																	//rising edge
			settimer(LongKeyPress_timer, gLongKeyPressTime);
			gKeyPressCode=SCROLL_UP;
			
		}
		else{
			gKeyPressCode=0;
			canceltimer(LongKeyPress_timer);
		}
	}


}
/*@@end*/

/*@@envVar:env_ASG_SlidingWindow_Down:*/
on envVar env_ASG_SlidingWindow_Down
{
	if(gRNS_PowerOnOff==Power_on && gSlidingWindowMode){
		if(getvalue(this)){																	//rising edge
			settimer(LongKeyPress_timer, gLongKeyPressTime);
			gKeyPressCode=SCROLL_DOWN;
			
		}
		else{
			gKeyPressCode=0;
            canceltimer(LongKeyPress_timer);
		}
	}


}
/*@@end*/

/*@@timer:LongKeyPress_timer:*/
on timer LongKeyPress_timer
{
byte mode, Gwendoline, ElCattivo;
int i, j;

Gwendoline=0;//Lösch-Elemente
ElCattivo=0;//Scroll-Elemente

	if(gKeyPressCode==SCROLL_UP){
		if(gVorhaltUpStatus>0 && gSlW_Download_status==NO_SLW_DOWNLOAD)    //some elements in upper cache
        {
			if(gVorhaltUpStatus>=gScrollingEntries)   //requested elements available
				ElCattivo=gScrollingEntries;
			else
				ElCattivo=gVorhaltUpStatus;           //only elements in upper cache available
			Gwendoline=ElCattivo;
            //write("Gwen %d, El %d", Gwendoline, ElCattivo);//debug
 				
			for(i=(SLW_LAST_LIST_ELEMENT-ElCattivo);i>=SLW_FIRST_LIST_ELEMENT;i--){
				gSlidingWindow_pos[i+ElCattivo]=gSlidingWindow_pos[i];
				strncpy(gSlidingWindow_pbname[i+ElCattivo], gSlidingWindow_pbname[i], CALL_INFO_NAME_LENGTH);
		//		write("%s", gSlidingWindow_pbname[i]);							//debug
				gSlidingWindow_numbertype[i+ElCattivo]=gSlidingWindow_numbertype[i];
			}
            if(gVorhaltDownStatus<SLW_LOWER_CACHE){
				i=gVorhaltDownStatus+ElCattivo;     //theoretical number of new elements
                if(i>SLW_LOWER_CACHE)               //to much elements
                    gVorhaltDownStatus=SLW_LOWER_CACHE;
                else                                //valid number of new elements
                    gVorhaltDownStatus=i;
				putvalue(env_ASG_SlidingWindow_Vorhalt_n,gVorhaltDownStatus);
			}
			display_SlW_Window();

			for(j=SLW_FIRST_LIST_ELEMENT;j<Gwendoline;j++)
            {
				gSlidingWindow_pos[j]=0;
                for(i=0;i<CALL_INFO_NAME_LENGTH;i++)
					gSlidingWindow_pbname[j][i]=0;
				gSlidingWindow_numbertype[j]=0;
				gVorhaltUpStatus--;
			}
			putvalue(env_ASG_SlidingWindow_Vorhalt_v,gVorhaltUpStatus);
            //write("scroll up: gSlW_Download_status %d", gSlW_Download_status);//debug
			if(gSlidingWindow_pos[Gwendoline]!=0)   //only for valid entries
            {
                if(gSlW_Download_status==NO_SLW_DOWNLOAD){
				    gSlW_Download_status=VORHALT_UP;
                    //write("gSlidingWindow_pos[Gwendoline] =  0x%x, Gwendoline = %d",gSlidingWindow_pos[Gwendoline], Gwendoline);//debug
				                    //recordaddress=1, shift=1, direction=1
				    MissedCalls_Request(DataGet_REQ, gSlidingWindow_pos[Gwendoline], Gwendoline, 0x31, 0);
			    }
			    else
				    gSlW_DownloadVorhaltUp=TRUE;
            }
		}
		
	}
	else if(gKeyPressCode==SCROLL_DOWN)
    {
		if(gVorhaltDownStatus>0 && gSlW_Download_status==NO_SLW_DOWNLOAD)    //some elements in lower cache
        {
			if(gVorhaltDownStatus>=gScrollingEntries)   //requested elements available
				ElCattivo=gScrollingEntries;
			else
				ElCattivo=gVorhaltDownStatus;           //only elements in lower cache available
            Gwendoline=ElCattivo;
				
			for(i=ElCattivo;i<=SLW_LAST_LIST_ELEMENT;i++)
            {
				gSlidingWindow_pos[i-ElCattivo]=gSlidingWindow_pos[i];
				strncpy(gSlidingWindow_pbname[i-ElCattivo], gSlidingWindow_pbname[i], CALL_INFO_NAME_LENGTH);
		//		write("%s", gSlidingWindow_pbname[i]);							//debug
				gSlidingWindow_numbertype[i-ElCattivo]=gSlidingWindow_numbertype[i];
			}
            if(gVorhaltUpStatus<SLW_UPPER_CACHE)
            {
                i=gVorhaltUpStatus+ElCattivo;     //theoretical number of new elements
                if(i>SLW_UPPER_CACHE)               //to much elements
                    gVorhaltUpStatus=SLW_UPPER_CACHE;
                else                                //valid number of new elements
                    gVorhaltUpStatus=i;
				
				putvalue(env_ASG_SlidingWindow_Vorhalt_v,gVorhaltUpStatus);
    		}
			display_SlW_Window();

			for(j=SLW_LAST_LIST_ELEMENT;j>(SLW_LAST_LIST_ELEMENT-Gwendoline);j--)
            {
				gSlidingWindow_pos[j]=0;
                for(i=0;i<CALL_INFO_NAME_LENGTH;i++)
					gSlidingWindow_pbname[j][i]=0;
				gSlidingWindow_numbertype[j]=0;
				gVorhaltDownStatus--;
			}
			putvalue(env_ASG_SlidingWindow_Vorhalt_n,gVorhaltDownStatus);
            //write("scroll down: gSlW_Download_status %d", gSlW_Download_status);//debug
            if(gSlidingWindow_pos[SLW_LAST_LIST_ELEMENT-Gwendoline]!=0) //only for valid entries
            {
                if(gSlW_Download_status==NO_SLW_DOWNLOAD)
                {
			    	gSlW_Download_status=VORHALT_DOWN;
                    //write("gSlidingWindow_pos[SLW_LAST_LIST_ELEMENT-Gwendoline] =  0x%x, Gwendoline = %d",gSlidingWindow_pos[SLW_LAST_LIST_ELEMENT-Gwendoline], Gwendoline);//debug
									                                                                //mode: recordaddress=1, shift=1, direction=0
			    	MissedCalls_Request(DataGet_REQ, gSlidingWindow_pos[SLW_LAST_LIST_ELEMENT-Gwendoline], Gwendoline, 0x11, 0);
			    }
			    else
				    gSlW_DownloadVorhaltDown=TRUE;
            }
		}
	}
    display_callstack_missedcalls();
	
	settimer(LongKeyPress_timer, gLongKeyPressAgainTime);
}
/*@@end*/

/*@@envVar:env_ASG_SlW_LongPressAgainTime:*/
on envVar env_ASG_SlW_LongPressAgainTime
{
	if(gRNS_PowerOnOff==Power_on && gSlidingWindowMode)
		gLongKeyPressAgainTime=getvalue(this);
}
/*@@end*/

/*@@caplFunc:PbSpeller_Request(byte,byte):*/
PbSpeller_Request(byte request, byte errorcode)
{
int i, Offset;
dword requestarray [BAP_buffer_size], length;

//*********
    //write("# (ASG) PbSpeller_Request"); // debug
//*********

//init lokal variables
	Offset=0;
	length=0;
	
	for(i=0;i<BAP_buffer_size;i++)
		requestarray [i]=0;

	switch (request){
		case StartResult_REQ:
			requestarray[0] = LSGID_Telephone;	//LSG-ID
			requestarray[1] = FctID_PbSpeller;	//Fct.-ID
			requestarray[2] = request;
			requestarray[3] = gSearchMode;
			Offset=4;
			
			length=strlen(gSearchString);
			requestarray[Offset]=length;
			Offset++;

			for(i=0;i<length;i++){
				requestarray[Offset]= gSearchString[i];
				Offset++;
			}
			
            //write("# ---> LSGID_Telephone = 0x%x, FctID_PbSpeller = 0x%x, request = 0x%x, gSearchString = %s, Offset = %d", LSGID_Telephone, FctID_PbSpeller, request, gSearchString, Offset);			
			set_status_requestbuffer (requestarray, Offset, Bap_ByteSequence);
		break;
		
		default:
			write("ASG PbSpeller_Request: invalid request: %d", request);
		break;
	}

}
/*@@end*/

/*@@caplFunc:PbSpeller_Indication(dword[],byte,int):*/
PbSpeller_Indication (dword Indication_array [], byte indication, int datalength)
{
byte i, j, mode, vh_stat;
byte shift, direction, transmitpos, transmit, indexsize, recordaddress;
byte errorcode;

//*********
    //write("# (ASG) PbSpeller_Indication");
//*********

	errorcode=0x00;
	mode=0;
	vh_stat = 0;



	switch (indication){
		case Processing_IND:
		break;
		case Result_IND:
          
			if(datalength != 8)	//datalength error 
				writelineEx(gError_Trace, 0, "ASG PbSpeller_Indication: BAP-datalength-error");
			else
            {
                gPbSpeller_Result = Indication_array[3];
                gMatchingEntries = Indication_array[4] + Indication_array[5]*0x100;
   				gFoundPos = Indication_array[6] + Indication_array[7]*0x100;


                if(gPbSpeller_Result == 0x00) //success
                {                    
                    gMatchingEntries = Indication_array[4] + Indication_array[5]*0x100;
    				gFoundPos = Indication_array[6] + Indication_array[7]*0x100;

                    //write("# --> gMatchingEntries: %d, gFoundPos: %d", gMatchingEntries, gFoundPos);
                 
				    putvalue(env_ASG_PbSpeller_result, gPbSpeller_Result_s[gPbSpeller_Result]);
                    putvalue(env_ASG_PbSpeller_pos, gFoundPos);
                    putvalue(env_ASG_PbSpeller_entries, gMatchingEntries);


                    
                    if(gPhonebook_SlW_Mode==TRUE)
                    {
                        /*
                        delete_phonebook_slw();               //erase current phonebook
                        gPhonebook_FullRangeUpdate=1;            //Activate FullRangeUpdate

                        gPhonebook_SlW_DownloadVorhaltUp=FALSE;
        		        gPhonebook_SlW_DownloadVorhaltDown=TRUE;
    	    	        gPhonebook_SlW_Download_status=WINDOW;
    
    	    	        //Phonebook_Request(DataGet_REQ, SLW_FIRST_LIST_ELEMENT, SLW_WINDOW_CACHE, 0x01, 0);    //Get Window Cache
                        Phonebook_Request(DataGet_REQ, gFoundPos, SLW_WINDOW_CACHE, 0x01, 0);    //Get Window Cache
                        */
                    }
                    else
                    {

                        mode=0x01;//recordaddress=1, shift=0, direction=0           					
                        ////Phonebook_Request(DataGet_REQ, gFoundPos, SLW_WINDOW_CACHE, mode, 0); // note: does not work
                        Phonebook_Request(DataGet_REQ, gFoundPos, 1, mode, 0); 
                    }
                }
                else
                {
                    putvalue(env_ASG_PbSpeller_result, gPbSpeller_Result_s[gPbSpeller_Result]);
                    putvalue(env_ASG_PbSpeller_pos, gFoundPos);
                    putvalue(env_ASG_PbSpeller_entries, gMatchingEntries);
                }
			}
			
		break;
		case Error_IND:
			if(datalength!=4)	//datalength error
				writelineEx(gError_Trace, 0, "ASG PbSpeller_Indication: BAP-datalength-error");
			else
				writelineEx(gError_Trace, 0, "ASG PbSpeller_Indication: recieved error, errorcode:0x%x", Indication_array[3]);
		break;
		default:
			writelineEx(gError_Trace, 0, "ASG PbSpeller_Indication: unknown indication %d", indication);
		break;
	}
}
/*@@end*/

/*@@envVar:env_ASG_SlW_Dial_Detail:*/
on envVar env_ASG_SlW_Dial_Detail
{

int length;
char i, empty_string [3];

//init lokal variables
	length=0;
	for(i=0;i<3;i++)
		empty_string[i]=0;
//********************

	if(gRNS_PowerOnOff==Power_on && getvalue(this)){
		strncpy(gDialNumber,gDetail_telnumber,CALL_INFO_NUMBER_LENGTH);	
		strncpy(gdialnumber_name,gDetail_pbname,CALL_INFO_NAME_LENGTH);	
		length=strlen(gDialNumber);	//mailboxnumber-length
		
        if(length>0)
			dialnumber_Request(StartResult_REQ, gDialNumber, gdialnumber_name, 0);
	}
}
/*@@end*/

/*@@envVar:env_ASG_SlW_LongPressTime:*/
on envVar env_ASG_SlW_LongPressTime
{
	if(gRNS_PowerOnOff==Power_on && gSlidingWindowMode)
		gLongKeyPressTime=getvalue(this);
}
/*@@end*/

/*@@envVar:env_ASG_SlW_ScrollingEntries:*/
on envVar env_ASG_SlW_ScrollingEntries
{
	if(gRNS_PowerOnOff==Power_on && gSlidingWindowMode)
		gScrollingEntries=getvalue(this);
}
/*@@end*/

/*@@caplFunc:MobileServiceSupport_Telephone_Indication(dword[],byte,int):*/
MobileServiceSupport_Telephone_Indication (dword Indication_array [], byte indication, int datalength)
{
    byte errorcode;

	errorcode=0x00;	
//	if(datalength!=8)
//		writelineEx(gError_Trace, 0, "ASG MobileServiceSupport_Telephone_Indication: BAP-datalength-error");

    switch (indication){
			case Data_IND:
                gMobileServiceSupport[0] =Indication_array[3];
                gMobileServiceSupport[1] =Indication_array[4];
                gMobileServiceSupport[2] =Indication_array[5];
                gMobileServiceSupport[3] =Indication_array[6];
                gMobileServiceSupport[4] =Indication_array[7];
                gMobileServiceSupport[5] =Indication_array[8];
                gMobileServiceSupport[6] =Indication_array[9];
                gMobileServiceSupport[7] =Indication_array[10];

                putvalue(env_ASG_MobileServSupp_Bit1,(gMobileServiceSupport[0] &0x40) /0x40);
                putvalue(env_ASG_MobileServSupp_Bit2,(gMobileServiceSupport[0] &0x20) /0x20); 
                putvalue(env_ASG_MobileServSupp_Bit3,(gMobileServiceSupport[0] &0x10) /0x10); 
                putvalue(env_ASG_MobileServSupp_Bit4,(gMobileServiceSupport[0] &0x08) /0x08);
                
                putvalue(env_ASG_MobileServSupp_Bit14,(gMobileServiceSupport[1] &0x02) /0x02);   
                putvalue(env_ASG_MobileServSupp_Bit15,(gMobileServiceSupport[1] &0x01) /0x01); 

			    putvalue(env_ASG_MobileServSupp_Bit16,(gMobileServiceSupport[2] &0x80) /0x80);
                putvalue(env_ASG_MobileServSupp_Bit17,(gMobileServiceSupport[2] &0x40) /0x40);
                putvalue(env_ASG_MobileServSupp_Bit18,(gMobileServiceSupport[2] &0x20) /0x20); 
                putvalue(env_ASG_MobileServSupp_Bit19,(gMobileServiceSupport[2] &0x10) /0x10); 
                putvalue(env_ASG_MobileServSupp_Bit20,(gMobileServiceSupport[2] &0x08) /0x08);
                putvalue(env_ASG_MobileServSupp_Bit21,(gMobileServiceSupport[2] &0x04) /0x04);
                putvalue(env_ASG_MobileServSupp_Bit22,(gMobileServiceSupport[2] &0x02) /0x02);
                putvalue(env_ASG_MobileServSupp_Bit23,(gMobileServiceSupport[2] &0x01) /0x01);

                putvalue(env_ASG_MobileServSupp_Bit24,(gMobileServiceSupport[3] &0x80) /0x80);
                putvalue(env_ASG_MobileServSupp_Bit25,(gMobileServiceSupport[3] &0x40) /0x40);
                putvalue(env_ASG_MobileServSupp_Bit26,(gMobileServiceSupport[3] &0x20) /0x20); 
                putvalue(env_ASG_MobileServSupp_Bit27,(gMobileServiceSupport[3] &0x10) /0x10); 
                putvalue(env_ASG_MobileServSupp_Bit28,(gMobileServiceSupport[3] &0x08) /0x08);
                putvalue(env_ASG_MobileServSupp_Bit29,(gMobileServiceSupport[3] &0x04) /0x04);
                putvalue(env_ASG_MobileServSupp_Bit30,(gMobileServiceSupport[3] &0x02) /0x02);
                putvalue(env_ASG_MobileServSupp_Bit31,(gMobileServiceSupport[3] &0x01) /0x01);

                putvalue(env_ASG_MobileServSupp_Bit32,(gMobileServiceSupport[4] &0x80) /0x80);
                putvalue(env_ASG_MobileServSupp_Bit33,(gMobileServiceSupport[4] &0x40) /0x40);
                putvalue(env_ASG_MobileServSupp_Bit34,(gMobileServiceSupport[4] &0x20) /0x20); 
                putvalue(env_ASG_MobileServSupp_Bit35,(gMobileServiceSupport[4] &0x10) /0x10); 
                putvalue(env_ASG_MobileServSupp_Bit36,(gMobileServiceSupport[4] &0x08) /0x08);
                putvalue(env_ASG_MobileServSupp_Bit37,(gMobileServiceSupport[4] &0x04) /0x04);
                putvalue(env_ASG_MobileServSupp_Bit38,(gMobileServiceSupport[4] &0x02) /0x02);
                putvalue(env_ASG_MobileServSupp_Bit39,(gMobileServiceSupport[4] &0x01) /0x01);

                putvalue(env_ASG_MobileServSupp_Bit40,(gMobileServiceSupport[5] &0x80) /0x80);
                putvalue(env_ASG_MobileServSupp_Bit41,(gMobileServiceSupport[5] &0x40) /0x40);
                putvalue(env_ASG_MobileServSupp_Bit42,(gMobileServiceSupport[5] &0x20) /0x20); 
                putvalue(env_ASG_MobileServSupp_Bit43,(gMobileServiceSupport[5] &0x10) /0x10); 
                putvalue(env_ASG_MobileServSupp_Bit44,(gMobileServiceSupport[5] &0x08) /0x08);
                putvalue(env_ASG_MobileServSupp_Bit45,(gMobileServiceSupport[5] &0x04) /0x04);
                putvalue(env_ASG_MobileServSupp_Bit46,(gMobileServiceSupport[5] &0x02) /0x02);
                putvalue(env_ASG_MobileServSupp_Bit47,(gMobileServiceSupport[5] &0x01) /0x01);

                putvalue(env_ASG_MobileServSupp_Bit48,(gMobileServiceSupport[6] &0x80) /0x80);
                putvalue(env_ASG_MobileServSupp_Bit49,(gMobileServiceSupport[6] &0x40) /0x40);
                putvalue(env_ASG_MobileServSupp_Bit50,(gMobileServiceSupport[6] &0x20) /0x20); 
                putvalue(env_ASG_MobileServSupp_Bit51,(gMobileServiceSupport[6] &0x10) /0x10); 
                putvalue(env_ASG_MobileServSupp_Bit52,(gMobileServiceSupport[6] &0x08) /0x08);
                putvalue(env_ASG_MobileServSupp_Bit53,(gMobileServiceSupport[6] &0x04) /0x04);
                putvalue(env_ASG_MobileServSupp_Bit54,(gMobileServiceSupport[6] &0x02) /0x02);
                putvalue(env_ASG_MobileServSupp_Bit55,(gMobileServiceSupport[6] &0x01) /0x01);

            break;
			case Error_IND:
				errorcode=Indication_array[3];
				if(errorcode<0x20)				//BCL-error
					writelineEx(gError_Trace, 0, "ASG MobileServiceSupport_Indication: BCL-Error: 0x%x - %s", errorcode, gerror_codes_BCL [errorcode-0x10]);
				else if(errorcode<0x30)			//BPL-error
					writelineEx(gError_Trace, 0, "ASG MobileServiceSupport_Indication: BPL-Error: 0x%x - %s", errorcode, gerror_codes_BPL [errorcode-0x20]);				
				else if(errorcode<0x40)			//BAL-error
					writelineEx(gError_Trace, 0, "ASG MobileServiceSupport_Indication: BAL-Error: 0x%x - %s", errorcode, gerror_codes_BAL [errorcode-0x30]);
				else if(errorcode>=0x80 && errorcode<=0xA2)
					writelineEx(gError_Trace, 0, "ASG MobileServiceSupport_Indication: Telephone-Error: 0x%x - %s", errorcode, gerror_codes_telephone [errorcode-0x80]);
				else
					writelineEx(gError_Trace, 0, "ASG MobileServiceSupport_Indication: Telephone-Error: 0x%x", errorcode);
			break;
			default:
				writelineEx(gError_Trace, 0, "ASG MobileServiceSupport_Indication: unknown indication %d", indication);
			break;
		}
	//}
}
/*@@end*/

/*@@caplFunc:MobileServiceSupport_Telephone_Request(byte,byte):*/
MobileServiceSupport_Telephone_Request (byte request, byte errorcode)
{
int Offset, i;
dword requestarray [BAP_buffer_size];

//init lokal variables
	Offset=0;

	for(i=0;i<BAP_buffer_size;i++)
		requestarray [i]=0;
//********************

	
	switch(request){
		case DataGet_REQ:
			requestarray[0]=LSGID_Telephone;			//LSG-ID
			requestarray[1]=FctID_MobileServiceSupport;	//Fct.-ID
			requestarray[2]=DataGet_REQ;
			Offset=3;
			set_status_requestbuffer (requestarray, Offset, Bap_Void);
		break;
		default:	//error
			writelineEx(gError_Trace, 0, "ASG MobileServiceSupport_Telephone_Request: unknown request %d", request);
		break;
	}
}
/*@@end*/

/*@@caplFunc:CallHold_Indication(dword[],byte,int):*/
CallHold_Indication(dword Indication_array [], byte indication, int datalength)
{
byte errorcode;

	errorcode=0x00;


	switch (indication){
		case Processing_IND:
		break;
		case Result_IND:
			if(datalength!=4)	//check array-datalength
				writelineEx(gError_Trace, 0,"ASG CallHold_Indication: datalength-error");
			//else
				//write("ASG CallHold_Indication: recieved result");
		break;
		case Error_IND:
			if(datalength!=4)
				writelineEx(gError_Trace, 0, "ASG CallHold_Indication: BAP-datalength-error");
			else{
				errorcode=Indication_array[3];
				if(errorcode<0x20)				//BCL-error
					writelineEx(gError_Trace, 0, "ASG CallHold_Indication: BCL-Error: 0x%x - %s", errorcode, gerror_codes_BCL [errorcode-0x10]);
				else if(errorcode<0x30)			//BPL-error
					writelineEx(gError_Trace, 0, "ASG CallHold_Indication: BPL-Error: 0x%x - %s", errorcode, gerror_codes_BPL [errorcode-0x20]);				
				else if(errorcode<0x40)			//BAL-error
					writelineEx(gError_Trace, 0, "ASG CallHold_Indication: BAL-Error: 0x%x - %s", errorcode, gerror_codes_BAL [errorcode-0x30]);
				else if(errorcode>=0x80 && errorcode<=0xA2)
					writelineEx(gError_Trace, 0, "ASG CallHold_Indication: Telephone-Error: 0x%x - %s", errorcode, gerror_codes_telephone [errorcode-0x80]);
				else
					writelineEx(gError_Trace, 0, "ASG CallHold_Indication: Telephone-Error: 0x%x", errorcode);
			}
		break;
		default:
			writelineEx(gError_Trace, 0,"ASG CallHold_indication: unknown indication %d", indication);
		break;
	}
}
/*@@end*/

/*@@caplFunc:CallHold_Request(byte,byte):*/
CallHold_Request (byte request, byte errorcode)
{
int i, Offset;
dword requestarray [BAP_buffer_size];

//init lokal variables
	Offset=0;

	for(i=0;i<BAP_buffer_size;i++)
		requestarray [i]=0;
//********************

	
	switch(request){
		case StartResult_REQ:
			requestarray[0]=LSGID_Telephone;		//LSG-ID
			requestarray[1]=FctID_CallHold;			//Fct.-ID
			requestarray[2]=request;
			Offset=3;
			set_status_requestbuffer (requestarray, Offset, Bap_Void);
		break;
		default://error
			writelineEx(gError_Trace, 0,"ASG CallHold_Request: unknown request %d", request);
		break;
	}
}
/*@@end*/

/*@@caplFunc:ResumeCall_Request(byte,byte):*/
ResumeCall_Request (byte request, byte errorcode)
{
int i, Offset;
dword requestarray [BAP_buffer_size];

//init lokal variables
	Offset=0;

	for(i=0;i<BAP_buffer_size;i++)
		requestarray [i]=0;
//********************

	
	switch(request){
		case StartResult_REQ:
			requestarray[0]=LSGID_Telephone;		//LSG-ID
			requestarray[1]=FctID_ResumeCall;			//Fct.-ID
			requestarray[2]=request;
			Offset=3;
			set_status_requestbuffer (requestarray, Offset, Bap_Void);
		break;
		default://error
			writelineEx(gError_Trace, 0,"ASG ResumeCall_Request: unknown request %d", request);
		break;
	}
}
/*@@end*/

/*@@caplFunc:ResumeCall_Indication(dword[],byte,int):*/
ResumeCall_Indication(dword Indication_array [], byte indication, int datalength)
{
byte errorcode;

	errorcode=0x00;


	switch (indication){
		case Processing_IND:
		break;
		case Result_IND:
			if(datalength!=4)	//check array-datalength
				writelineEx(gError_Trace, 0,"ASG ResumeCall_Indication: datalength-error");
			else
				write("ASG ResumeCall_Indication: recieved result");
		break;
		case Error_IND:
			if(datalength!=4)
				writelineEx(gError_Trace, 0, "ASG ResumeCall_Indication: BAP-datalength-error");
			else{
				errorcode=Indication_array[3];
				if(errorcode<0x20)				//BCL-error
					writelineEx(gError_Trace, 0, "ASG ResumeCall_Indication: BCL-Error: 0x%x - %s", errorcode, gerror_codes_BCL [errorcode-0x10]);
				else if(errorcode<0x30)			//BPL-error
					writelineEx(gError_Trace, 0, "ASG ResumeCall_Indication: BPL-Error: 0x%x - %s", errorcode, gerror_codes_BPL [errorcode-0x20]);				
				else if(errorcode<0x40)			//BAL-error
					writelineEx(gError_Trace, 0, "ASG ResumeCall_Indication: BAL-Error: 0x%x - %s", errorcode, gerror_codes_BAL [errorcode-0x30]);
				else if(errorcode>=0x80 && errorcode<=0xA2)
					writelineEx(gError_Trace, 0, "ASG ResumeCall_Indication: Telephone-Error: 0x%x - %s", errorcode, gerror_codes_telephone [errorcode-0x80]);
				else
					writelineEx(gError_Trace, 0, "ASG ResumeCall_Indication: Telephone-Error: 0x%x", errorcode);
			}
		break;
		default:
			writelineEx(gError_Trace, 0,"ASG ResumeCall_indication: unknown indication %d", indication);
		break;
	}
}
/*@@end*/

/*@@envVar:env_ASG_UHV_CallHold:*/
on envVar env_ASG_UHV_CallHold
{
	if(gRNS_PowerOnOff==Power_on && gBAP_Phone_available==BAPPhone && getvalue(this)){
		CallHold_Request (StartResult_REQ, 0);
	}
}
/*@@end*/

/*@@envVar:env_ASG_UHV_CallResume:*/
on envVar env_ASG_UHV_CallResume
{
	if(gRNS_PowerOnOff==Power_on && gBAP_Phone_available==BAPPhone && getvalue(this)){
		ResumeCall_Request (StartResult_REQ, 0);
	}
}
/*@@end*/

/*@@caplFunc:MPSwap_Indication(dword[],byte,int):*/
MPSwap_Indication(dword Indication_array [], byte indication, int datalength)
{
byte errorcode;

	errorcode=0x00;

	switch (indication){
		case Processing_IND:
		break;
		case Result_IND:
			if(datalength!=4)	//check array-datalength
				writelineEx(gError_Trace, 0,"ASG MPSwap_Indication: datalength-error");
			else
				write("ASG MPSwap_Indication: recieved result");
		break;
		case Error_IND:
			if(datalength!=4)
				writelineEx(gError_Trace, 0, "ASG MPSwap_Indication: BAP-datalength-error");
			else{
				errorcode=Indication_array[3];
				if(errorcode<0x20)				//BCL-error
					writelineEx(gError_Trace, 0, "ASG MPSwap_Indication: BCL-Error: 0x%x - %s", errorcode, gerror_codes_BCL [errorcode-0x10]);
				else if(errorcode<0x30)			//BPL-error
					writelineEx(gError_Trace, 0, "ASG MPSwap_Indication: BPL-Error: 0x%x - %s", errorcode, gerror_codes_BPL [errorcode-0x20]);				
				else if(errorcode<0x40)			//BAL-error
					writelineEx(gError_Trace, 0, "ASG MPSwap_Indication: BAL-Error: 0x%x - %s", errorcode, gerror_codes_BAL [errorcode-0x30]);
				else if(errorcode>=0x80 && errorcode<=0xA2)
					writelineEx(gError_Trace, 0, "ASG MPSwap_Indication: Telephone-Error: 0x%x - %s", errorcode, gerror_codes_telephone [errorcode-0x80]);
				else
					writelineEx(gError_Trace, 0, "ASG MPSwap_Indication: Telephone-Error: 0x%x", errorcode);
			}
		break;
		default:
			writelineEx(gError_Trace, 0,"ASG MPSwap_Indication: unknown indication %d", indication);
		break;
	}
}
/*@@end*/

/*@@caplFunc:MPSwap_Request(byte,byte):*/
MPSwap_Request (byte request, byte errorcode)
{
int i, Offset;
dword requestarray [BAP_buffer_size];

//init lokal variables
	Offset=0;

	for(i=0;i<BAP_buffer_size;i++)
		requestarray [i]=0;
//********************

	
	switch(request){
		case StartResult_REQ:
			requestarray[0]=LSGID_Telephone;		//LSG-ID
			requestarray[1]=FctID_MPSwap;			//Fct.-ID
			requestarray[2]=request;
			Offset=3;
			set_status_requestbuffer (requestarray, Offset, Bap_Void);
		break;
		default://error
			writelineEx(gError_Trace, 0,"ASG MPSwap_Request: unknown request %d", request);
		break;
	}
}
/*@@end*/

/*@@envVar:env_ASG_UHV_MPSwap:*/
on envVar env_ASG_UHV_MPSwap
{
	if(gRNS_PowerOnOff==Power_on && gBAP_Phone_available==BAPPhone && getvalue(this)){
		MPSwap_Request (StartResult_REQ, 0);
	}
}
/*@@end*/

/*@@caplFunc:CCJoin_Indication(dword[],byte,int):*/
CCJoin_Indication(dword Indication_array [], byte indication, int datalength)
{
byte errorcode;

	errorcode=0x00;

	switch (indication){
		case Processing_IND:
		break;
		case Result_IND:
			if(datalength!=4)	//check array-datalength
				writelineEx(gError_Trace, 0,"ASG CCJoin_Indication: datalength-error");
			else
				write("ASG CCJoin_Indication: recieved result");
		break;
		case Error_IND:
			if(datalength!=4)
				writelineEx(gError_Trace, 0, "ASG CCJoin_Indication: BAP-datalength-error");
			else{
				errorcode=Indication_array[3];
				if(errorcode<0x20)				//BCL-error
					writelineEx(gError_Trace, 0, "ASG CCJoin_Indication: BCL-Error: 0x%x - %s", errorcode, gerror_codes_BCL [errorcode-0x10]);
				else if(errorcode<0x30)			//BPL-error
					writelineEx(gError_Trace, 0, "ASG CCJoin_Indication: BPL-Error: 0x%x - %s", errorcode, gerror_codes_BPL [errorcode-0x20]);				
				else if(errorcode<0x40)			//BAL-error
					writelineEx(gError_Trace, 0, "ASG CCJoin_Indication: BAL-Error: 0x%x - %s", errorcode, gerror_codes_BAL [errorcode-0x30]);
				else if(errorcode>=0x80 && errorcode<=0xA2)
					writelineEx(gError_Trace, 0, "ASG CCJoin_Indication: Telephone-Error: 0x%x - %s", errorcode, gerror_codes_telephone [errorcode-0x80]);
				else
					writelineEx(gError_Trace, 0, "ASG CCJoin_Indication: Telephone-Error: 0x%x", errorcode);
			}
		break;
		default:
			writelineEx(gError_Trace, 0,"ASG CCJoin_Indication: unknown indication %d", indication);
		break;
	}
}
/*@@end*/

/*@@caplFunc:CCJoin_Request(byte,byte):*/
CCJoin_Request (byte request, byte errorcode)
{
int i, Offset;
dword requestarray [BAP_buffer_size];

//init lokal variables
	Offset=0;

	for(i=0;i<BAP_buffer_size;i++)
		requestarray [i]=0;
//********************

	
	switch(request){
		case StartResult_REQ:
			requestarray[0]=LSGID_Telephone;		//LSG-ID
			requestarray[1]=FctID_CCJoin;			//Fct.-ID
			requestarray[2]=request;
			Offset=3;
			set_status_requestbuffer (requestarray, Offset, Bap_Void);
		break;
		default://error
			writelineEx(gError_Trace, 0,"ASG CCJoin_Request: unknown request %d", request);
		break;
	}
}
/*@@end*/

/*@@envVar:env_ASG_UHV_CCJoin:*/
on envVar env_ASG_UHV_CCJoin
{
	if(gRNS_PowerOnOff==Power_on && gBAP_Phone_available==BAPPhone && getvalue(this)){
		CCJoin_Request (StartResult_REQ, 0);
	}
}
/*@@end*/

/*@@caplFunc:CCSplit_Indication(dword[],byte,int):*/
CCSplit_Indication(dword Indication_array [], byte indication, int datalength)
{
byte errorcode;

	errorcode=0x00;

	switch (indication){
		case Processing_IND:
		break;
		case Result_IND:
			if(datalength!=4)	//check array-datalength
				writelineEx(gError_Trace, 0,"ASG CCSplit_Indication: datalength-error");
			else
				write("ASG CCSplit_Indication: recieved result");
		break;
		case Error_IND:
			if(datalength!=4)
				writelineEx(gError_Trace, 0, "ASG CCJoin_Indication: BAP-datalength-error");
			else{
				errorcode=Indication_array[3];
				if(errorcode<0x20)				//BCL-error
					writelineEx(gError_Trace, 0, "ASG CCSplit_Indication: BCL-Error: 0x%x - %s", errorcode, gerror_codes_BCL [errorcode-0x10]);
				else if(errorcode<0x30)			//BPL-error
					writelineEx(gError_Trace, 0, "ASG CCSplit_Indication: BPL-Error: 0x%x - %s", errorcode, gerror_codes_BPL [errorcode-0x20]);				
				else if(errorcode<0x40)			//BAL-error
					writelineEx(gError_Trace, 0, "ASG CCSplit_Indication: BAL-Error: 0x%x - %s", errorcode, gerror_codes_BAL [errorcode-0x30]);
				else if(errorcode>=0x80 && errorcode<=0xA2)
					writelineEx(gError_Trace, 0, "ASG CCSplit_Indication: Telephone-Error: 0x%x - %s", errorcode, gerror_codes_telephone [errorcode-0x80]);
				else
					writelineEx(gError_Trace, 0, "ASG CCSplit_Indication: Telephone-Error: 0x%x", errorcode);
			}
		break;
		default:
			writelineEx(gError_Trace, 0,"ASG CCSplit_Indication: unknown indication %d", indication);
		break;
	}
}
/*@@end*/

/*@@caplFunc:CCSplit_Request(byte,byte):*/
CCSplit_Request (byte request, byte errorcode)
{
int i, Offset;
dword requestarray [BAP_buffer_size];

//init lokal variables
	Offset=0;

	for(i=0;i<BAP_buffer_size;i++)
		requestarray [i]=0;
//********************

	
	switch(request){
		case StartResult_REQ:
			requestarray[0]=LSGID_Telephone;		//LSG-ID
			requestarray[1]=FctID_CCSplit;			//Fct.-ID
			requestarray[2]=request;
			requestarray[3]=gCCSplitCallID;
			Offset=4;
			set_status_requestbuffer (requestarray, Offset, Bap_UInt8);
		break;
		default://error
			writelineEx(gError_Trace, 0,"ASG CCSplit_Request: unknown request %d", request);
		break;
	}
}
/*@@end*/

/*@@envVar:env_RNS_CallID_0_split:*/
on envVar env_RNS_CallID_0_split
{
	if(gRNS_PowerOnOff==Power_on && gBAP_Phone_available==BAPPhone && getvalue(this)){
		gCCSplitCallID=0;
		CCSplit_Request (StartResult_REQ, 0);
	}
}
/*@@end*/

/*@@envVar:env_RNS_CallID_1_split:*/
on envVar env_RNS_CallID_1_split
{
	if(gRNS_PowerOnOff==Power_on && gBAP_Phone_available==BAPPhone && getvalue(this)){
		gCCSplitCallID=1;
		CCSplit_Request (StartResult_REQ, 0);
	}
}
/*@@end*/

/*@@envVar:env_RNS_CallID_2_split:*/
on envVar env_RNS_CallID_2_split
{
	if(gRNS_PowerOnOff==Power_on && gBAP_Phone_available==BAPPhone && getvalue(this)){
		gCCSplitCallID=2;
		CCSplit_Request (StartResult_REQ, 0);
	}
}
/*@@end*/

/*@@envVar:env_RNS_CallID_3_split:*/
on envVar env_RNS_CallID_3_split
{
	if(gRNS_PowerOnOff==Power_on && gBAP_Phone_available==BAPPhone && getvalue(this)){
		gCCSplitCallID=3;
		CCSplit_Request (StartResult_REQ, 0);
	}
}
/*@@end*/

/*@@envVar:env_RNS_CallID_4_split:*/
on envVar env_RNS_CallID_4_split
{
	if(gRNS_PowerOnOff==Power_on && gBAP_Phone_available==BAPPhone && getvalue(this)){
		gCCSplitCallID=4;
		CCSplit_Request (StartResult_REQ, 0);
	}
}
/*@@end*/

/*@@envVar:env_RNS_CallID_5_split:*/
on envVar env_RNS_CallID_5_split
{
	if(gRNS_PowerOnOff==Power_on && gBAP_Phone_available==BAPPhone && getvalue(this)){
		gCCSplitCallID=5;
		CCSplit_Request (StartResult_REQ, 0);
	}
}
/*@@end*/

/*@@envVar:env_RNS_CallID_6_split:*/
on envVar env_RNS_CallID_6_split
{
	if(gRNS_PowerOnOff==Power_on && gBAP_Phone_available==BAPPhone && getvalue(this)){
		gCCSplitCallID=6;
		CCSplit_Request (StartResult_REQ, 0);
	}
}
/*@@end*/

/*@@envVar:env_ASG_UHV_hangup_active:*/
on envVar env_ASG_UHV_hangup_active
{
	if(gRNS_PowerOnOff==Power_on && gBAP_Phone_available==BAPPhone && getvalue(this)){
			hangupcall_request (StartResult_REQ, ALLACTIVECALLS, 0);
	}
}
/*@@end*/

/*@@envVar:env_ASG_UHV_hangup_held:*/
on envVar env_ASG_UHV_hangup_held
{
	if(gRNS_PowerOnOff==Power_on && gBAP_Phone_available==BAPPhone && getvalue(this)){
			hangupcall_request (StartResult_REQ, ALLHELDCALLS, 0);
	}
}
/*@@end*/

/*@@envVar:env_ASG_UHV_hangup_held_active:*/
on envVar env_ASG_UHV_hangup_held_active
{
	if(gRNS_PowerOnOff==Power_on && gBAP_Phone_available==BAPPhone && getvalue(this)){
			hangupcall_request (StartResult_REQ, ALLACTIVEANDHELDCALLS, 0);
	}
}
/*@@end*/

/*@@envVar:env_ASG_UHV_hangup_all:*/
on envVar env_ASG_UHV_hangup_all
{
	if(gRNS_PowerOnOff==Power_on && gBAP_Phone_available==BAPPhone && getvalue(this)){
			hangupcall_request (StartResult_REQ, ALLCALLS, 0);
	}
}
/*@@end*/

/*@@caplFunc:MPRACAWC_Request(byte,byte):*/
MPRACAWC_Request (byte request, byte errorcode)
{
int i, Offset;
dword requestarray [BAP_buffer_size];

//init lokal variables
	Offset=0;

	for(i=0;i<BAP_buffer_size;i++)
		requestarray [i]=0;
//********************

	
	switch(request)
	{
		case StartResult_REQ:
			requestarray[0]=LSGID_Telephone;									//LSG-ID
			requestarray[1]=FctID_MPReleaseActiveCallAcceptWaitingCall;			//Fct.-ID
			requestarray[2]=request;
			Offset=3;
			set_status_requestbuffer (requestarray, Offset, Bap_Void);
		break;
		default://error
			writelineEx(gError_Trace, 0,"ASG MPRACAWC_Request: unknown request %d", request);
		break;
	}
}
/*@@end*/

/*@@caplFunc:MPRACAWC_Indication(dword[],byte,int):*/
MPRACAWC_Indication(dword Indication_array [], byte indication, int datalength)
{
byte errorcode;

	errorcode=0x00;

	switch (indication)
	{
		case Processing_IND:
		break;
		case Result_IND:
			if(datalength!=4)	//check array-datalength
				writelineEx(gError_Trace, 0,"ASG MPRACAWC_Indication: datalength-error");
			else
				write("ASG MPRACAWC_Indication: recieved result");
		break;
		case Error_IND:
			if(datalength!=4)
				writelineEx(gError_Trace, 0, "ASG MPRACAWC_Indication: BAP-datalength-error");
			else
			{
				errorcode=Indication_array[3];
				if(errorcode<0x20)				//BCL-error
					writelineEx(gError_Trace, 0, "ASG MPRACAWC_Indication: BCL-Error: 0x%x - %s", errorcode, gerror_codes_BCL [errorcode-0x10]);
				else if(errorcode<0x30)			//BPL-error
					writelineEx(gError_Trace, 0, "ASG MPRACAWC_Indication: BPL-Error: 0x%x - %s", errorcode, gerror_codes_BPL [errorcode-0x20]);				
				else if(errorcode<0x40)			//BAL-error
					writelineEx(gError_Trace, 0, "ASG MPRACAWC_Indication: BAL-Error: 0x%x - %s", errorcode, gerror_codes_BAL [errorcode-0x30]);
				else if(errorcode>=0x80 && errorcode<=0xA2)
					writelineEx(gError_Trace, 0, "ASG MPRACAWC_Indication: Telephone-Error: 0x%x - %s", errorcode, gerror_codes_telephone [errorcode-0x80]);
				else
					writelineEx(gError_Trace, 0, "ASG MPRACAWC_Indication: Telephone-Error: 0x%x", errorcode);
			}
		break;
		default:
			writelineEx(gError_Trace, 0,"ASG MPRACAWC_Indication: unknown indication %d", indication);
		break;
	}
}
/*@@end*/

/*@@envVar:env_ASG_UHV_MP_RACAWC:*/
on envVar env_ASG_UHV_MP_RACAWC
{
	if(gRNS_PowerOnOff==Power_on && gBAP_Phone_available==BAPPhone && getvalue(this)){
		MPRACAWC_Request (StartResult_REQ, 0);
	}
}
/*@@end*/

/*@@caplFunc:Keypad_Indication(dword[],byte,int):*/
Keypad_Indication (dword Indication_array [], byte indication, int datalength)
{	
byte errorcode;

	errorcode=0x00;

	//check array
	if(datalength!=4)	//datalength error
		writelineEx(gError_Trace, 0, "ASG Keypad_Indication: BAP_datalength_error");	//send error-message
	else{
		switch (indication){
			case Data_IND:
                gKeyStatus =Indication_array[3];

                if((gKeyStatus &0x01) ==TRUE)
                    putvalue(env_RNS_Keypad_Bit0, gstring_KeyStatus_Bit0);
                else
                    putvalue(env_RNS_Keypad_Bit0, gempty_string);
                
                if(((gKeyStatus &0x02) /0x02) ==TRUE)
                    putvalue(env_RNS_Keypad_Bit1, gstring_KeyStatus_Bit1);
                else
                    putvalue(env_RNS_Keypad_Bit1, gempty_string);

                if(((gKeyStatus &0x04) /0x04) ==TRUE)
                    putvalue(env_RNS_Keypad_Bit2, gstring_KeyStatus_Bit2);
                else
                    putvalue(env_RNS_Keypad_Bit2, gempty_string);

                if(((gKeyStatus &0x08) /0x08) ==TRUE)
                    putvalue(env_RNS_Keypad_Bit3, gstring_KeyStatus_Bit3);
                else
                    putvalue(env_RNS_Keypad_Bit3, gempty_string);

                if(((gKeyStatus &0x10) /0x10) ==TRUE)
                    putvalue(env_RNS_Keypad_Bit4, gstring_KeyStatus_Bit4);
                else
                    putvalue(env_RNS_Keypad_Bit4, gempty_string);

                if(((gKeyStatus &0x20) /0x20) ==TRUE)
                    putvalue(env_RNS_Keypad_Bit5, gstring_KeyStatus_Bit5);
                else
                    putvalue(env_RNS_Keypad_Bit5, gempty_string);

			break;
			case Error_IND:
				errorcode=Indication_array[3];
				if(errorcode<0x20)				//BCL-error
					writelineEx(gError_Trace, 0, "ASG Keypad_Indication: BCL-Error: 0x%x - %s", errorcode, gerror_codes_BCL [errorcode-0x10]);
				else if(errorcode<0x30)			//BPL-error
					writelineEx(gError_Trace, 0, "ASG Keypad_Indication: BPL-Error: 0x%x - %s", errorcode, gerror_codes_BPL [errorcode-0x20]);				
				else if(errorcode<0x40)			//BAL-error
					writelineEx(gError_Trace, 0, "ASG Keypad_Indication: BAL-Error: 0x%x - %s", errorcode, gerror_codes_BAL [errorcode-0x30]);
				else if(errorcode>=0x80 && errorcode<=0xA2)
					writelineEx(gError_Trace, 0, "ASG Keypad_Indication: Telephone-Error: 0x%x - %s", errorcode, gerror_codes_telephone [errorcode-0x80]);
				else
					writelineEx(gError_Trace, 0, "ASG Keypad_Indication: Telephone-Error: 0x%x", errorcode);
			break;
			default:
				writelineEx(gError_Trace, 0, "ASG Keypad_Indication: unknown indication %d", indication);
			break;
		}
	}
}
/*@@end*/

/*@@caplFunc:Keypad_Request(byte,byte):*/
Keypad_Request (byte request, byte errorcode)
{
int i, Offset;
dword requestarray [BAP_buffer_size];

//init lokal variables
	Offset=0;

	for(i=0;i<BAP_buffer_size;i++)
		requestarray [i]=0;
//********************


	switch(request){
		case DataGet_REQ:
			requestarray[0]=LSGID_Telephone;	//LSG-ID
			requestarray[1]=FctID_Keypad;	//Fct.-ID
			requestarray[2]=request;
			Offset=3;
			set_status_requestbuffer (requestarray, Offset, Bap_Void);
		break;
		default:	//error
			writelineEx(gError_Trace, 0, "Keypad_Request: unknown request %d", request);
		break;
	}
}
/*@@end*/

/*@@caplFunc:CallStackDeleteAll_Indication(dword[],byte,int):*/
CallStackDeleteAll_Indication(dword Indication_array [], byte indication, int datalength)
{

	switch (indication){
		case Processing_IND:
		break;
		case Result_IND:
			//check BAP-array
			if(datalength!=3)	//datalength error
				writelineEx(gError_Trace, 0, "ASG CallStackDeleteAll_Indication: BAP_datalength_error");	
			else
				write("ASG: CallStackDeleteAll_Indication: recieved result");
		break;
		case Error_IND:
			//check BAP-array
			if(datalength!=4)	//datalength error
				writelineEx(gError_Trace, 0, "ASG CallStackDeleteAll_Indication: BAP_datalength_error");
			else
				write("ASG: CallStackDeleteAll_Indication: recieved error, errorcode:0x%x", Indication_array[3]);
		break;
		default:
			writelineEx(gError_Trace, 0, "ASG: CallStackDeleteAll_Indication: unknown indication %d", indication);
		break;
	}
}
/*@@end*/

/*@@caplFunc:CallStackDeleteAll_request(byte,byte):*/
CallStackDeleteAll_request (byte request, byte errorcode)
{
int i, Offset;
dword requestarray [BAP_buffer_size];

//init lokal variables
	Offset=0;

	for(i=0;i<BAP_buffer_size;i++)
		requestarray [i]=0;
//********************

	
	switch(request){
		case StartResult_REQ:
			requestarray[0]=LSGID_Phonebook;			//LSG-ID
			requestarray[1]=FctID_CallStackDeleteAll;	//Fct.-ID
			requestarray[2]=request;
			requestarray[3]=gCallStackDeleteAllStorage;
			Offset=4;
			set_status_requestbuffer (requestarray, Offset, Bap_UInt8);
		break;
		default://error
			writelineEx(gError_Trace, 0, "CallStackDeleteAll_request: unknown request %d", request);
		break;
	}
}
/*@@end*/

/*@@envVar:env_ASG_UHV_DeleteDialedNumb:*/
on envVar env_ASG_UHV_DeleteDialedNumb
{
	if(gRNS_PowerOnOff==Power_on && gBAP_Phone_available==BAPPhone && getvalue(this)){
		gCallStackDeleteAllStorage=4;
		CallStackDeleteAll_request (StartResult_REQ, 0);
	}
}
/*@@end*/

/*@@envVar:env_ASG_UHV_DeleteMissed:*/
on envVar env_ASG_UHV_DeleteMissed
{
	if(gRNS_PowerOnOff==Power_on && gBAP_Phone_available==BAPPhone && getvalue(this)){
		gCallStackDeleteAllStorage=1;
		CallStackDeleteAll_request (StartResult_REQ, 0);
	}
}
/*@@end*/

/*@@envVar:env_ASG_UHV_DeleteReceived:*/
on envVar env_ASG_UHV_DeleteReceived
{
	if(gRNS_PowerOnOff==Power_on && gBAP_Phone_available==BAPPhone && getvalue(this)){
		gCallStackDeleteAllStorage=2;
		CallStackDeleteAll_request (StartResult_REQ, 0);
	}
}
/*@@end*/

/*@@envVar:env_ASG_UHV_DeleteAllCallStacks:*/
on envVar env_ASG_UHV_DeleteAllCallStacks
{
	if(gRNS_PowerOnOff==Power_on && gBAP_Phone_available==BAPPhone && getvalue(this)){
		gCallStackDeleteAllStorage=7;
		CallStackDeleteAll_request (StartResult_REQ, 0);
	}
}
/*@@end*/

/*@@caplFunc:SMSState_Indication(dword[],byte,int):*/
SMSState_Indication (dword Indication_array [], byte indication, int datalength)
{
	//check array
	switch (indication){
		case Data_IND:
			if(datalength!=7)
				writelineEx(gError_Trace, 0, "ASG SMSState_Indication: BAP-datalength-error");
			else{
				gSMSStateSIMReady=Indication_array[3];
				gSMSStateStorageState=Indication_array[4];
				gSMSStateNumberOfNewSMS=Indication_array[5]+Indication_array[6]*0x100;
				
				putvalue(env_ASG_UHV_SMSStateSIMReady, gstring_SMSStateSIMReady[gSMSStateSIMReady]);
				putvalue(env_ASG_UHV_SMSStateStorage, gstring_SMSStateStorageState[gSMSStateStorageState]);
				putvalue(env_ASG_UHV_SMSStateNewSMS, gSMSStateNumberOfNewSMS);
			}
		break;
		case Error_IND:
			if(datalength!=4)
				writelineEx(gError_Trace, 0, "ASG SMSState_Indication: BAP-datalength-error");
			else
				writelineEx(gError_Trace, 0, "ASG SMSState_Indication: recieved error, errorcode:0x%x", Indication_array[3]);
		break;
		default:
			writelineEx(gError_Trace, 0, "ASG SMSState_Indication: unknown indication %d", indication);
		break;
	}
}
/*@@end*/

/*@@caplFunc:SMSState_Request(byte,byte):*/
SMSState_Request (byte request, byte errorcode)
{
int i, Offset;
dword requestarray [BAP_buffer_size];

//init lokal variables
	Offset=0;
	
	for(i=0;i<BAP_buffer_size;i++)
		requestarray [i]=0;
//********************

	switch (request){
		case DataGet_REQ:
			requestarray[0]=LSGID_Telephone;			//LSG-ID
			requestarray[1]=FctID_SMSState;				//Fct.-ID
			requestarray[2]=request;			
			Offset=3;
						
			set_status_requestbuffer (requestarray, Offset, Bap_Void);
		break;
		case DataSetGet_REQ:
			requestarray[0]=LSGID_Telephone;	//LSG-ID
			requestarray[1]=FctID_SMSState;		//Fct.-ID
			requestarray[2]=request;	
			
			requestarray[3]=0;	//Dummy
			requestarray[4]=0;//Dummy

			requestarray[5]=gSMSStateNumberOfNewSMS &0x00FF;					
			requestarray[6]=(gSMSStateNumberOfNewSMS &0xFF00) /0x100;					
			
			Offset=7;
		
			set_status_requestbuffer (requestarray, Offset, Bap_ByteSequence);
		break;
		default:
			write("SMSState_Request: invalid request: %d", request);
		break;
	}
}
/*@@end*/

/*@@envVar:env_ASG_UHV_SMSState_delete:*/
on envVar env_ASG_UHV_SMSState_delete
{
	if(gRNS_PowerOnOff==Power_on && gBAP_Phone_available==BAPPhone && getvalue(this))
	{
		gSMSStateNumberOfNewSMS =getvalue(env_ASG_UHV_SMSStateNewSMS);
        SMSState_Request (DataSetGet_REQ, 0);
	}
}
/*@@end*/

/*@@caplFunc:deleteSMSReceivedstack():*/
deleteSMSReceivedstack ()
{
int i, j;

	for(j=0;j<SMSSTACK;j++)
	{
		for(i=0;i<SMSPBNAMELENGTH;i++)
			gSMSReceived_pbname[j][i]=0;								//delete PbName
		for(i=0;i<SMSTELNUMBERLENGTH;i++)
			gSMSReceived_telnumber[j][i]=0;								//delete TelNumber
		for(i=0;i<SMSTEXTLENGTH;i++)
			gSMSReceived_text[j][i]=0;									//delete SMSText

		gSMSReceived_smsattrib[j]=0;									//delete SMSAttrib
		gSMSReceived_day [j]=0;											//delete day 
		gSMSReceived_month [j]=0;										//delete month
		gSMSReceived_year [j]=0;										//delete year
		gSMSReceived_hour [j]=0;										//delete hour
		gSMSReceived_minute [j]=0;										//delete minute
		gSMSReceived_second [j]=0;										//delete second
	}	
}
/*@@end*/

/*@@caplFunc:display_phonebook():*/
display_phonebook ()
{

	//Pos
	putvalue(env_ASG_PB_Pos1, gPhonebook_Pos[0]);
	putvalue(env_ASG_PB_Pos2, gPhonebook_Pos[1]);
	putvalue(env_ASG_PB_Pos3, gPhonebook_Pos[2]);
	putvalue(env_ASG_PB_Pos4, gPhonebook_Pos[3]);
	putvalue(env_ASG_PB_Pos5, gPhonebook_Pos[4]);
	//PbName
	putvalue(env_ASG_PB_PbName1, gPhonebook_PbName[0]);
	putvalue(env_ASG_PB_PbName2, gPhonebook_PbName[1]);
	putvalue(env_ASG_PB_PbName3, gPhonebook_PbName[2]);
	putvalue(env_ASG_PB_PbName4, gPhonebook_PbName[3]);
	putvalue(env_ASG_PB_PbName5, gPhonebook_PbName[4]);
	//AnyVoiceTag
	putvalue(env_ASG_PB_AVT1, gPhonebook_AnyVoiceTag[0]);
	putvalue(env_ASG_PB_AVT2, gPhonebook_AnyVoiceTag[1]);
	putvalue(env_ASG_PB_AVT3, gPhonebook_AnyVoiceTag[2]);
	putvalue(env_ASG_PB_AVT4, gPhonebook_AnyVoiceTag[3]);
	putvalue(env_ASG_PB_AVT5, gPhonebook_AnyVoiceTag[4]);
	//TelNumberQuantity
	putvalue(env_ASG_PB_TNQ1, gPhonebook_TelNumberQuantity[0]);
	putvalue(env_ASG_PB_TNQ2, gPhonebook_TelNumberQuantity[1]);
	putvalue(env_ASG_PB_TNQ3, gPhonebook_TelNumberQuantity[2]);
	putvalue(env_ASG_PB_TNQ4, gPhonebook_TelNumberQuantity[3]);
	putvalue(env_ASG_PB_TNQ5, gPhonebook_TelNumberQuantity[4]);
	//TelNumber 1-5
	putvalue(env_ASG_PB_TelNum11, gPhonebook_TelNumber1[0]);
	putvalue(env_ASG_PB_TelNum21, gPhonebook_TelNumber1[1]);
	putvalue(env_ASG_PB_TelNum31, gPhonebook_TelNumber1[2]);
	putvalue(env_ASG_PB_TelNum41, gPhonebook_TelNumber1[3]);
	putvalue(env_ASG_PB_TelNum51, gPhonebook_TelNumber1[4]);
	//VoiceTag
	putvalue(env_ASG_PB_VoiceTag11, gPhonebook_VoiceTag1[0]);
	putvalue(env_ASG_PB_VoiceTag21, gPhonebook_VoiceTag1[1]);
	putvalue(env_ASG_PB_VoiceTag31, gPhonebook_VoiceTag1[2]);
	putvalue(env_ASG_PB_VoiceTag41, gPhonebook_VoiceTag1[3]);
	putvalue(env_ASG_PB_VoiceTag51, gPhonebook_VoiceTag1[4]);

	//NumberType
	putvalue(env_ASG_PB_NumType11, gnumbertype[gPhonebook_NumberType1[0]]);
	putvalue(env_ASG_PB_NumType21, gnumbertype[gPhonebook_NumberType1[1]]);
	putvalue(env_ASG_PB_NumType31, gnumbertype[gPhonebook_NumberType1[2]]);
	putvalue(env_ASG_PB_NumType41, gnumbertype[gPhonebook_NumberType1[3]]);
	putvalue(env_ASG_PB_NumType51, gnumbertype[gPhonebook_NumberType1[4]]);

}
/*@@end*/

/*@@caplFunc:deleteSMSTemplatestack():*/
deleteSMSTemplatestack ()
{
int i, j;

	for(j=0;j<SMSSTACK;j++)
	{
		for(i=0;i<SMSTITLELENGTH;i++)
			gSMSTemplate_title[j][i]=0;								//delete Title
		for(i=0;i<SMSTEXTLENGTH;i++)
			gSMSTemplate_text[j][i]=0;									//delete SMSText
	}	
}
/*@@end*/

/*@@caplFunc:display_SMSTemplate():*/
display_SMSTemplate ()
{
	//SMSTitle
	putvalue(env_ASG_SMSTemplate0_Title, gSMSTemplate_title[0]);
	putvalue(env_ASG_SMSTemplate1_Title, gSMSTemplate_title[1]);
	putvalue(env_ASG_SMSTemplate2_Title, gSMSTemplate_title[2]);
	putvalue(env_ASG_SMSTemplate3_Title, gSMSTemplate_title[3]);
	putvalue(env_ASG_SMSTemplate4_Title, gSMSTemplate_title[4]);	

	//SMSText
	putvalue(env_ASG_SMSTemplate0_Text, gSMSTemplate_text[0]);
	putvalue(env_ASG_SMSTemplate1_Text, gSMSTemplate_text[1]);
	putvalue(env_ASG_SMSTemplate2_Text, gSMSTemplate_text[2]);
	putvalue(env_ASG_SMSTemplate3_Text, gSMSTemplate_text[3]);
	putvalue(env_ASG_SMSTemplate4_Text, gSMSTemplate_text[4]);
	
}
/*@@end*/

/*@@caplFunc:MPCHAWC_Indication(dword[],byte,int):*/
MPCHAWC_Indication(dword Indication_array [], byte indication, int datalength)
{
byte errorcode;

	errorcode=0x00;

	switch (indication)
	{
		case Processing_IND:
		break;
		case Result_IND:
			if(datalength!=4)	//check array-datalength
				writelineEx(gError_Trace, 0,"ASG MPCHAWC_Indication: datalength-error");
			else
				write("ASG MPCHAWC_Indication: recieved result");
		break;
		case Error_IND:
			if(datalength!=4)
				writelineEx(gError_Trace, 0, "ASG MPCHAWC_Indication: BAP-datalength-error");
			else
			{
				errorcode=Indication_array[3];
				if(errorcode<0x20)				//BCL-error
					writelineEx(gError_Trace, 0, "ASG MPCHAWC_Indication: BCL-Error: 0x%x - %s", errorcode, gerror_codes_BCL [errorcode-0x10]);
				else if(errorcode<0x30)			//BPL-error
					writelineEx(gError_Trace, 0, "ASG MPCHAWC_Indication: BPL-Error: 0x%x - %s", errorcode, gerror_codes_BPL [errorcode-0x20]);				
				else if(errorcode<0x40)			//BAL-error
					writelineEx(gError_Trace, 0, "ASG MPCHAWC_Indication: BAL-Error: 0x%x - %s", errorcode, gerror_codes_BAL [errorcode-0x30]);
				else if(errorcode>=0x80 && errorcode<=0xA2)
					writelineEx(gError_Trace, 0, "ASG MPCHAWC_Indication: Telephone-Error: 0x%x - %s", errorcode, gerror_codes_telephone [errorcode-0x80]);
				else
					writelineEx(gError_Trace, 0, "ASG MPCHAWC_Indication: Telephone-Error: 0x%x", errorcode);
			}
		break;
		default:
			writelineEx(gError_Trace, 0,"ASG MPCHAWC_Indication: unknown indication %d", indication);
		break;
	}
}
/*@@end*/

/*@@caplFunc:MPCHAWC_Request(byte,byte):*/
MPCHAWC_Request (byte request, byte errorcode)
{
int i, Offset;
dword requestarray [BAP_buffer_size];

//init lokal variables
	Offset=0;

	for(i=0;i<BAP_buffer_size;i++)
		requestarray [i]=0;
//********************

	
	switch(request)
	{
		case StartResult_REQ:
			requestarray[0]=LSGID_Telephone;							//LSG-ID
			requestarray[1]=FctID_MPCallHoldAcceptWaitingCall;			//Fct.-ID
			requestarray[2]=request;
			Offset=3;
			set_status_requestbuffer (requestarray, Offset, Bap_Void);
		break;
		default://error
			writelineEx(gError_Trace, 0,"ASG MPCHAWC_Request: unknown request %d", request);
		break;
	}
}
/*@@end*/

/*@@caplFunc:MPRAllCAWC_Indication(dword[],byte,int):*/
MPRAllCAWC_Indication(dword Indication_array [], byte indication, int datalength)
{
byte errorcode;

	errorcode=0x00;

	switch (indication)
	{
		case Processing_IND:
		break;
		case Result_IND:
			if(datalength!=4)	//check array-datalength
				writelineEx(gError_Trace, 0,"ASG MPRAllCAWC_Indication: datalength-error");
			else
				write("ASG MPRAllCAWC_Indication: recieved result");
		break;
		case Error_IND:
			if(datalength!=4)
				writelineEx(gError_Trace, 0, "ASG MPRAllCAWC_Indication: BAP-datalength-error");
			else
			{
				errorcode=Indication_array[3];
				if(errorcode<0x20)				//BCL-error
					writelineEx(gError_Trace, 0, "ASG MPRAllCAWC_Indication: BCL-Error: 0x%x - %s", errorcode, gerror_codes_BCL [errorcode-0x10]);
				else if(errorcode<0x30)			//BPL-error
					writelineEx(gError_Trace, 0, "ASG MPRAllCAWC_Indication: BPL-Error: 0x%x - %s", errorcode, gerror_codes_BPL [errorcode-0x20]);				
				else if(errorcode<0x40)			//BAL-error
					writelineEx(gError_Trace, 0, "ASG MPRAllCAWC_Indication: BAL-Error: 0x%x - %s", errorcode, gerror_codes_BAL [errorcode-0x30]);
				else if(errorcode>=0x80 && errorcode<=0xA2)
					writelineEx(gError_Trace, 0, "ASG MPRAllCAWC_Indication: Telephone-Error: 0x%x - %s", errorcode, gerror_codes_telephone [errorcode-0x80]);
				else
					writelineEx(gError_Trace, 0, "ASG MPRAllCAWC_Indication: Telephone-Error: 0x%x", errorcode);
			}
		break;
		default:
			writelineEx(gError_Trace, 0,"ASG MPRAllCAWC_Indication: unknown indication %d", indication);
		break;
	}
}
/*@@end*/

/*@@caplFunc:MPRAllCAWC_Request(byte,byte):*/
MPRAllCAWC_Request (byte request, byte errorcode)
{
int i, Offset;
dword requestarray [BAP_buffer_size];

//init lokal variables
	Offset=0;

	for(i=0;i<BAP_buffer_size;i++)
		requestarray [i]=0;
//********************

	
	switch(request)
	{
		case StartResult_REQ:
			requestarray[0]=LSGID_Telephone;									//LSG-ID
			requestarray[1]=FctID_MPReleaseAllCallsAcceptWaitingCall;			//Fct.-ID
			requestarray[2]=request;
			Offset=3;
			set_status_requestbuffer (requestarray, Offset, Bap_Void);
		break;
		default://error
			writelineEx(gError_Trace, 0,"ASG MPRAllCAWC_Request: unknown request %d", request);
		break;
	}
}
/*@@end*/

/*@@envVar:env_ASG_UHV_MP_RAllCAWC:*/
on envVar env_ASG_UHV_MP_RAllCAWC
{
	if(gRNS_PowerOnOff==Power_on && gBAP_Phone_available==BAPPhone && getvalue(this)){
		MPRAllCAWC_Request (StartResult_REQ, 0);
	}
}
/*@@end*/

/*@@envVar:env_ASG_UHV_MP_CHAWC:*/
on envVar env_ASG_UHV_MP_CHAWC
{
	if(gRNS_PowerOnOff==Power_on && gBAP_Phone_available==BAPPhone && getvalue(this)){
		MPCHAWC_Request (StartResult_REQ, 0);
	}
}
/*@@end*/

/*@@envVar:env_RNS_delete_dialednumber:*/
on envVar env_RNS_delete_dialednumber
{/*
	if(gRNS_PowerOnOff==Power_on && gBAP_Phone_available==BAPPhone && getvalue(this))
	{
		dialednumbers_Request(DataSetGet_REQ, getvalue(env_RNS_dialednumber_select), 1, 0x01,0);		//Recordaddress=1 for delete
	}*/
}
/*@@end*/

/*@@envVar:env_RNS_dial_dialednumber:*/
on envVar env_RNS_dial_dialednumber
{
int length;
char i, empty_string [3];

//init lokal variables
	length=0;
	for(i=0;i<3;i++)
		empty_string[i]=0;
//********************

	if(gRNS_PowerOnOff==Power_on && gBAP_Phone_available==BAPPhone && getvalue(this) && gdialednumbers_pbname[getvalue(env_RNS_dialednumber_select)][0]!=0){
		length=strlen(gdialednumbers_telnumber[getvalue(env_RNS_dialednumber_select)]);	//number-length
		if(length>0)
			dialnumber_Request(StartResult_REQ, gdialednumbers_telnumber[getvalue(env_RNS_dialednumber_select)], empty_string, 0);
	}
}
/*@@end*/

/*@@envVar:env_RNS_delete_missedcall:*/
on envVar env_RNS_delete_missedcall
{
	if(gRNS_PowerOnOff==Power_on && gBAP_Phone_available==BAPPhone && getvalue(this))
	{
		missedcalls_Request(DataSetGet_REQ, getvalue(env_RNS_missedcall_select), 1, 0x01,0);		//Recordaddress=1 for delete
	}
}
/*@@end*/

/*@@envVar:env_RNS_dial_missedcall:*/
on envVar env_RNS_dial_missedcall
{
int length;
char i, empty_string [3];

//init lokal variables
	length=0;
	for(i=0;i<3;i++)
		empty_string[i]=0;
//********************

	if(gRNS_PowerOnOff==Power_on && gBAP_Phone_available==BAPPhone && getvalue(this) && gmissedcalls_pbname[getvalue(env_RNS_missedcall_select)][0]!=0){
		length=strlen(gmissedcalls_telnumber[getvalue(env_RNS_missedcall_select)]);	//number-length
		if(length>0)
			dialnumber_Request(StartResult_REQ, gmissedcalls_telnumber[getvalue(env_RNS_missedcall_select)], empty_string, 0);
	}
}
/*@@end*/

/*@@envVar:env_RNS_dial_receivedcall:*/
on envVar env_RNS_dial_receivedcall
{
int length;
char i, empty_string [3];

//init lokal variables
	length=0;
	for(i=0;i<3;i++)
		empty_string[i]=0;
//********************

	if(gRNS_PowerOnOff==Power_on && gBAP_Phone_available==BAPPhone && getvalue(this) && greceivedcalls_pbname[getvalue(env_RNS_missedcall_select)][0]!=0){
		length=strlen(greceivedcalls_telnumber[getvalue(env_RNS_receivedcall_select)]);	//number-length
		if(length>0)
			dialnumber_Request(StartResult_REQ, greceivedcalls_telnumber[getvalue(env_RNS_receivedcall_select)], empty_string, 0);
	}
}
/*@@end*/

/*@@envVar:env_RNS_delete_receivedcall:*/
on envVar env_RNS_delete_receivedcall
{/*
	if(gRNS_PowerOnOff==Power_on && gBAP_Phone_available==BAPPhone && getvalue(this))
	{
		Receivedcalls_Request(DataSetGet_REQ, getvalue(env_RNS_receivedcall_select), 1, 0x01,0);		//Recordaddress=1 for delete
	}*/
}
/*@@end*/

/*@@caplFunc:CallDurationSync_Request(byte,byte):*///function
CallDurationSync_Request (byte request, byte errorcode)
{
int Offset, i;
dword requestarray [BAP_buffer_size];

//init lokal variables
	Offset=0;
	
	for(i=0;i<BAP_buffer_size;i++)
		requestarray [i]=0;
//********************

	switch (request){
		case DataGet_REQ:
			requestarray[0]=LSGID_Telephone;	//LSG-ID
			requestarray[1]=FctID_CallDurationSync;	    //Fct.-ID
			requestarray[2]=request;
			Offset=3;
			set_status_requestbuffer (requestarray, Offset, Bap_Void);
		break;
		default:
			writelineEx(gError_Trace, 0, "ASG CallDurationSync_Request: unknown request %d", request);
		break;
	}
}
/*@@end*/

/*@@caplFunc:CallDurationSync_Indication(dword[],byte,int):*///function
CallDurationSync_Indication (dword Indication_array [], byte indication, int datalength)
{
byte errorcode;

	errorcode=0x00;
	
	//check array
	/*if(datalength!=4)	//datalength error
		writelineEx(gError_Trace, 0, "ASG CallDurationSync_Indication: BAP-datalength-error");
	else*/
	{
		switch (indication)
		{
			case Data_IND:
				
                gTimeStampCall[0] =Indication_array[3];				
                gTimeStampCall[0] +=Indication_array[4]*0x100;

                gTimeStampCall[1] =Indication_array[5];				
                gTimeStampCall[1] +=Indication_array[6]*0x100;

                gTimeStampCall[2] =Indication_array[7];				
                gTimeStampCall[2] +=Indication_array[8]*0x100;

                gTimeStampCall[3] =Indication_array[9];				
                gTimeStampCall[3] +=Indication_array[10]*0x100;

                gTimeStampCall[4] =Indication_array[11];				
                gTimeStampCall[4] +=Indication_array[12]*0x100;

                gTimeStampCall[5] =Indication_array[13];				
                gTimeStampCall[5] +=Indication_array[14]*0x100;

                gTimeStampCall[6] =Indication_array[15];				
                gTimeStampCall[6] +=Indication_array[16]*0x100;
                
                putvalue(env_RNS_CallDuration_Sync_TS_0, gTimeStampCall[0]);
                putvalue(env_RNS_CallDuration_Sync_TS_1, gTimeStampCall[1]);
                putvalue(env_RNS_CallDuration_Sync_TS_2, gTimeStampCall[2]);
                putvalue(env_RNS_CallDuration_Sync_TS_3, gTimeStampCall[3]);
                putvalue(env_RNS_CallDuration_Sync_TS_4, gTimeStampCall[4]);
                putvalue(env_RNS_CallDuration_Sync_TS_5, gTimeStampCall[5]);
                putvalue(env_RNS_CallDuration_Sync_TS_6, gTimeStampCall[6]);
                
			break;
			case Error_IND:
				errorcode=Indication_array[3];
				if(errorcode<0x20)				//BCL-error
					writelineEx(gError_Trace, 0, "ASG CallDurationSync_Indication: BCL-Error: 0x%x - %s", errorcode, gerror_codes_BCL [errorcode-0x10]);
				else if(errorcode<0x30)			//BPL-error
					writelineEx(gError_Trace, 0, "ASG CallDurationSync_Indication: BPL-Error: 0x%x - %s", errorcode, gerror_codes_BPL [errorcode-0x20]);				
				else if(errorcode<0x40)			//BAL-error
					writelineEx(gError_Trace, 0, "ASG CallDurationSync_Indication: BAL-Error: 0x%x - %s", errorcode, gerror_codes_BAL [errorcode-0x30]);
				else if(errorcode>=0x80 && errorcode<=0xA2)
					writelineEx(gError_Trace, 0, "ASG CallDurationSync_Indication: Telephone-Error: 0x%x - %s", errorcode, gerror_codes_telephone [errorcode-0x80]);
				else
					writelineEx(gError_Trace, 0, "ASG CallDurationSync_Indication: Telephone-Error: 0x%x", errorcode);
			break;
			default:
				writelineEx(gError_Trace, 0, "ASG CallDurationSync_Indication: unknown indication %d", indication);
			break;
		}
	}
}
/*@@end*/

/*@@caplFunc:DisconnectReason_Request(byte,byte):*///function
DisconnectReason_Request (byte request, byte errorcode)
{
int Offset, i;
dword requestarray [BAP_buffer_size];

//init lokal variables
	Offset=0;
	
	for(i=0;i<BAP_buffer_size;i++)
		requestarray [i]=0;
//********************

	switch (request){
		case DataGet_REQ:
			requestarray[0]=LSGID_Telephone;	//LSG-ID
			requestarray[1]=FctID_DisconnectReason;	    //Fct.-ID
			requestarray[2]=request;
			Offset=3;
			set_status_requestbuffer (requestarray, Offset, Bap_Void);
		break;
		default:
			writelineEx(gError_Trace, 0, "ASG DisconnectReason_Request: unknown request %d", request);
		break;
	}
}
/*@@end*/

/*@@caplFunc:DisconnectReason_Indication(dword[],byte,int):*///function
DisconnectReason_Indication (dword Indication_array [], byte indication, int datalength)
{
byte errorcode;

	errorcode=0x00;
	
	//check array
	/*if(datalength!=4)	//datalength error
		writelineEx(gError_Trace, 0, "ASG CallDurationSync_Indication: BAP-datalength-error");
	else*/
	{
		switch (indication)
		{
			case Data_IND:
				
                gDisconnectReason =Indication_array[3];
                
                if (gDisconnectReason<0x0F)
                    putvalue(env_RNS_DisconReason_DR, gDisconnectReason_string[gDisconnectReason]);
                else
                    putvalue(env_RNS_DisconReason_DR, greserved);
                
			break;
			case Error_IND:
				errorcode=Indication_array[3];
				if(errorcode<0x20)				//BCL-error
					writelineEx(gError_Trace, 0, "ASG DisconnectReason_Indication: BCL-Error: 0x%x - %s", errorcode, gerror_codes_BCL [errorcode-0x10]);
				else if(errorcode<0x30)			//BPL-error
					writelineEx(gError_Trace, 0, "ASG DisconnectReason_Indication: BPL-Error: 0x%x - %s", errorcode, gerror_codes_BPL [errorcode-0x20]);				
				else if(errorcode<0x40)			//BAL-error
					writelineEx(gError_Trace, 0, "ASG DisconnectReason_Indication: BAL-Error: 0x%x - %s", errorcode, gerror_codes_BAL [errorcode-0x30]);
				else if(errorcode>=0x80 && errorcode<=0xA2)
					writelineEx(gError_Trace, 0, "ASG DisconnectReason_Indication: Telephone-Error: 0x%x - %s", errorcode, gerror_codes_telephone [errorcode-0x80]);
				else
					writelineEx(gError_Trace, 0, "ASG DisconnectReason_Indication: Telephone-Error: 0x%x", errorcode);
			break;
			default:
				writelineEx(gError_Trace, 0, "ASG DisconnectReason_Indication: unknown indication %d", indication);
			break;
		}
	}
}
/*@@end*/

/*@@caplFunc:MobileBatteryLevel_Request(byte,byte):*///function
MobileBatteryLevel_Request (byte request, byte errorcode)
{
int i, Offset;
dword requestarray [BAP_buffer_size];

//init lokal variables
	Offset=0;

	for(i=0;i<BAP_buffer_size;i++)
		requestarray [i]=0;
//********************


	switch(request){
		case DataGet_REQ:
			requestarray[0]=LSGID_Telephone;	        //LSG-ID
			requestarray[1]=FctID_MobileBatteryLevel;	//Fct.-ID
			requestarray[2]=request;
			Offset=3;
			set_status_requestbuffer (requestarray, Offset, Bap_Void);
		break;
		default:	//error
			writelineEx(gError_Trace, 0, "MobileBatteryLevel_Request: unknown request %d", request);
		break;
	}
}
/*@@end*/

/*@@caplFunc:MobileBatteryLevel_Indication(dword[],byte,int):*///function
MobileBatteryLevel_Indication (dword Indication_array [], byte indication, int datalength)
{	
byte errorcode;

	errorcode=0x00;

	//check array
	/*if(datalength!=4)	//datalength error
		writelineEx(gError_Trace, 0, "ASG MobileBatteryLevel_Indication: BAP_datalength_error");	//send error-message
	else{*/
		switch (indication){
			case Data_IND:
                gChargeLevelMobile_1 =Indication_array[3];
                gChargeLevelMobile_2 =Indication_array[4];
                gChargeLevelHandset_1 =Indication_array[5];
                gChargeLevelHandset_2 =Indication_array[6];
                gWarningLevel =Indication_array[7];

                putvalue(env_RNS_MobileBatLevel_CL_Mob1, gChargeLevelMobile_1);
                putvalue(env_RNS_MobileBatLevel_CL_Mob2, gChargeLevelMobile_2);
                putvalue(env_RNS_MobileBatLevel_CL_Hand1, gChargeLevelHandset_1);
                putvalue(env_RNS_MobileBatLevel_CL_Hand2, gChargeLevelHandset_2);

                putvalue(env_RNS_MobileBatLevel_CL_Bit0, gWarningLevel_Bit0[gWarningLevel &0x01]);
                putvalue(env_RNS_MobileBatLevel_CL_Bit1, gWarningLevel_Bit1[(gWarningLevel &0x02) /0x02]);
                putvalue(env_RNS_MobileBatLevel_CL_Bit2, gWarningLevel_Bit2[(gWarningLevel &0x04) /0x04]);
                putvalue(env_RNS_MobileBatLevel_CL_Bit3, gWarningLevel_Bit3[(gWarningLevel &0x08) /0x08]);
			break;
			case Error_IND:
				errorcode=Indication_array[3];
				if(errorcode<0x20)				//BCL-error
					writelineEx(gError_Trace, 0, "ASG MobileBatteryLevel_Indication: BCL-Error: 0x%x - %s", errorcode, gerror_codes_BCL [errorcode-0x10]);
				else if(errorcode<0x30)			//BPL-error
					writelineEx(gError_Trace, 0, "ASG MobileBatteryLevel_Indication: BPL-Error: 0x%x - %s", errorcode, gerror_codes_BPL [errorcode-0x20]);				
				else if(errorcode<0x40)			//BAL-error
					writelineEx(gError_Trace, 0, "ASG MobileBatteryLevel_Indication: BAL-Error: 0x%x - %s", errorcode, gerror_codes_BAL [errorcode-0x30]);
				else if(errorcode>=0x80 && errorcode<=0xA2)
					writelineEx(gError_Trace, 0, "ASG MobileBatteryLevel_Indication: Telephone-Error: 0x%x - %s", errorcode, gerror_codes_telephone [errorcode-0x80]);
				else
					writelineEx(gError_Trace, 0, "ASG MobileBatteryLevel_Indication: Telephone-Error: 0x%x", errorcode);
			break;
			default:
				writelineEx(gError_Trace, 0, "ASG MobileBatteryLevel_Indication: unknown indication %d", indication);
			break;
		}
	//}
}
/*@@end*/

/*@@caplFunc:DataConnectionIndication_Indication(dword[],byte,int):*///function
DataConnectionIndication_Indication (dword Indication_array [], byte indication, int datalength)
{	
byte errorcode;

	errorcode=0x00;

	//check array
	/*if(datalength!=4)	//datalength error
		writelineEx(gError_Trace, 0, "ASG DataConnectionIndication_Indication: BAP_datalength_error");	//send error-message
	else{*/
		switch (indication){
			case Data_IND:
                gConnectionIndication =Indication_array[3];

                if (gConnectionIndication <0x02)
                    putValue(env_RNS_DataConInd_CI, gConnectionIndication_string[gConnectionIndication]);
                else
                    putValue(env_RNS_DataConInd_CI, greserved);
                
                gDataVolumeUplink =Indication_array[4];
                gDataVolumeUplink +=Indication_array[5]*0x100;
                gDataVolumeUplink +=Indication_array[6]*0x10000;
                gDataVolumeUplink +=Indication_array[7]*0x1000000;
                putValue(env_RNS_DataConInd_DVUplink, gDataVolumeUplink);

                gDataVolumeDownlink =Indication_array[8];
                gDataVolumeDownlink +=Indication_array[9]*0x100;
                gDataVolumeDownlink +=Indication_array[10]*0x10000;
                gDataVolumeDownlink +=Indication_array[11]*0x1000000;
                putValue(env_RNS_DataConInd_DVDownlink, gDataVolumeDownlink);

			break;
			case Error_IND:
				errorcode=Indication_array[3];
				if(errorcode<0x20)				//BCL-error
					writelineEx(gError_Trace, 0, "ASG DataConnectionIndication_Indication: BCL-Error: 0x%x - %s", errorcode, gerror_codes_BCL [errorcode-0x10]);
				else if(errorcode<0x30)			//BPL-error
					writelineEx(gError_Trace, 0, "ASG DataConnectionIndication_Indication: BPL-Error: 0x%x - %s", errorcode, gerror_codes_BPL [errorcode-0x20]);				
				else if(errorcode<0x40)			//BAL-error
					writelineEx(gError_Trace, 0, "ASG DataConnectionIndication_Indication: BAL-Error: 0x%x - %s", errorcode, gerror_codes_BAL [errorcode-0x30]);
				else if(errorcode>=0x80 && errorcode<=0xA2)
					writelineEx(gError_Trace, 0, "ASG DataConnectionIndication_Indication: Telephone-Error: 0x%x - %s", errorcode, gerror_codes_telephone [errorcode-0x80]);
				else
					writelineEx(gError_Trace, 0, "ASG DataConnectionIndication_Indication: Telephone-Error: 0x%x", errorcode);
			break;
			default:
				writelineEx(gError_Trace, 0, "ASG DataConnectionIndication_Indication: unknown indication %d", indication);
			break;
		}
	//}
}
/*@@end*/

/*@@caplFunc:DataConnectionIndication_Request(byte,byte):*///function
DataConnectionIndication_Request (byte request, byte errorcode)
{
int i, Offset;
dword requestarray [BAP_buffer_size];

//init lokal variables
	Offset=0;

	for(i=0;i<BAP_buffer_size;i++)
		requestarray [i]=0;
//********************


	switch(request){
		case DataGet_REQ:
			requestarray[0]=LSGID_Telephone;	        //LSG-ID
			requestarray[1]=FctID_DataConnectionIndication;	//Fct.-ID
			requestarray[2]=request;
			Offset=3;
			set_status_requestbuffer (requestarray, Offset, Bap_Void);
		break;
		default:	//error
			writelineEx(gError_Trace, 0, "DataConnectionIndication_Request: unknown request %d", request);
		break;
	}
}
/*@@end*/

/*@@caplFunc:MissedCallIndication_Indication(dword[],byte,int):*///function
MissedCallIndication_Indication (dword Indication_array [], byte indication, int datalength)
{	
byte errorcode;

	errorcode=0x00;

	//check array
	/*if(datalength!=4)	//datalength error
		writelineEx(gError_Trace, 0, "ASG MissedCallIndication_Indication: BAP_datalength_error");	//send error-message
	else{*/
		switch (indication){
			case Data_IND:
                gMissedCalls =Indication_array[3];
                gMissedCalls +=Indication_array[4] *0x100;
                putvalue(env_RNS_MissedCallInd_Calls, gMissedCalls);                

                gMissedNumbers =Indication_array[5];
                gMissedNumbers +=Indication_array[6] *0x100;
                putvalue(env_RNS_MissedCallInd_Numbers, gMissedNumbers);

			break;
			case Error_IND:
				errorcode=Indication_array[3];
				if(errorcode<0x20)				//BCL-error
					writelineEx(gError_Trace, 0, "ASG MissedCallIndication_Indication: BCL-Error: 0x%x - %s", errorcode, gerror_codes_BCL [errorcode-0x10]);
				else if(errorcode<0x30)			//BPL-error
					writelineEx(gError_Trace, 0, "ASG MissedCallIndication_Indication: BPL-Error: 0x%x - %s", errorcode, gerror_codes_BPL [errorcode-0x20]);				
				else if(errorcode<0x40)			//BAL-error
					writelineEx(gError_Trace, 0, "ASG MissedCallIndication_Indication: BAL-Error: 0x%x - %s", errorcode, gerror_codes_BAL [errorcode-0x30]);
				else if(errorcode>=0x80 && errorcode<=0xA2)
					writelineEx(gError_Trace, 0, "ASG MissedCallIndication_Indication: Telephone-Error: 0x%x - %s", errorcode, gerror_codes_telephone [errorcode-0x80]);
				else
					writelineEx(gError_Trace, 0, "ASG MissedCallIndication_Indication: Telephone-Error: 0x%x", errorcode);
			break;
			default:
				writelineEx(gError_Trace, 0, "ASG MissedCallIndication_Indication: unknown indication %d", indication);
			break;
		}
	//}
}
/*@@end*/

/*@@caplFunc:MissedCallIndication_Request(byte,byte):*///function
MissedCallIndication_Request (byte request, byte errorcode)
{
int i, Offset;
dword requestarray [BAP_buffer_size];

//init lokal variables
	Offset=0;

	for(i=0;i<BAP_buffer_size;i++)
		requestarray [i]=0;
//********************


	switch(request){
		case DataGet_REQ:
			requestarray[0]=LSGID_Telephone;	        //LSG-ID
			requestarray[1]=FctID_MissedCallIndication;	//Fct.-ID
			requestarray[2]=request;
			Offset=3;
			set_status_requestbuffer (requestarray, Offset, Bap_Void);
		break;
        case DataSetGet_REQ:
			requestarray[0]=LSGID_Telephone;	//LSG-ID
			requestarray[1]=FctID_MissedCallIndication;	//Fct.-ID
			requestarray[2]=request;	
			requestarray[3]=(gMissedCalls &0xff00) /0x100;
            requestarray[4]=(gMissedCalls &0x00ff);
            requestarray[5]=(gMissedNumbers &0xff00) /0x100;
            requestarray[6]=(gMissedNumbers &0x00ff);	
			Offset=7;
			
			set_status_requestbuffer (requestarray, Offset, Bap_ByteSequence);
		break;
		default:	//error
			writelineEx(gError_Trace, 0, "MissedCallIndication_Request: unknown request %d", request);
		break;
	}
}
/*@@end*/

/*@@caplFunc:PbState_Request(byte,byte):*///function
PbState_Request (byte request, byte errorcode)
{
int i, Offset;
dword requestarray [BAP_buffer_size];

//init lokal variables
	Offset=0;

	for(i=0;i<BAP_buffer_size;i++)
		requestarray [i]=0;
//********************


	switch(request){
		case DataGet_REQ:
			requestarray[0]=LSGID_Telephone;	        //LSG-ID
			requestarray[1]=FctID_PbState;	//Fct.-ID
			requestarray[2]=request;
			Offset=3;
			set_status_requestbuffer (requestarray, Offset, Bap_Void);
		break;
		default:	//error
			writelineEx(gError_Trace, 0, "PbState_Request: unknown request %d", request);
		break;
	}
}
/*@@end*/

/*@@caplFunc:PbState_Indication(dword[],byte,int):*///function
PbState_Indication (dword Indication_array [], byte indication, int datalength)
{	
byte errorcode;

	errorcode=0x00;

	//check array
	/*if(datalength!=4)	//datalength error
		writelineEx(gError_Trace, 0, "ASG PbState_Indication: BAP_datalength_error");	//send error-message
	else{*/
		switch (indication){
			case Data_IND:
                gDownloadState =Indication_array[3];
                
                if(gDownloadState <0x05)
                    putvalue(env_RNS_PbState_DownloadState, gDownloadState_string [gDownloadState]);
                else
                    putvalue(env_RNS_PbState_DownloadState,greserved);
                
                gPbEntriesUHV  =Indication_array[4];
                gPbEntriesUHV +=Indication_array[5] *0x100;

                putvalue(env_RNS_PbState_PbEntriesUHV, gPbEntriesUHV);
			break;
			case Error_IND:
				errorcode=Indication_array[3];
				if(errorcode<0x20)				//BCL-error
					writelineEx(gError_Trace, 0, "ASG PbState_Indication: BCL-Error: 0x%x - %s", errorcode, gerror_codes_BCL [errorcode-0x10]);
				else if(errorcode<0x30)			//BPL-error
					writelineEx(gError_Trace, 0, "ASG PbState_Indication: BPL-Error: 0x%x - %s", errorcode, gerror_codes_BPL [errorcode-0x20]);				
				else if(errorcode<0x40)			//BAL-error
					writelineEx(gError_Trace, 0, "ASG PbState_Indication: BAL-Error: 0x%x - %s", errorcode, gerror_codes_BAL [errorcode-0x30]);
				else if(errorcode>=0x80 && errorcode<=0xA2)
					writelineEx(gError_Trace, 0, "ASG PbState_Indication: Telephone-Error: 0x%x - %s", errorcode, gerror_codes_telephone [errorcode-0x80]);
				else
					writelineEx(gError_Trace, 0, "ASG PbState_Indication: Telephone-Error: 0x%x", errorcode);
			break;
			default:
				writelineEx(gError_Trace, 0, "ASG PbState_Indication: unknown indication %d", indication);
			break;
		}
	//}
}
/*@@end*/

/*@@caplFunc:DialNumber_Indication(dword[],byte,int):*///function
DialNumber_Indication (dword Indication_array [], byte indication, int datalength)
{
char i, empty_string [3];

//init lokal variables
	for(i=0;i<3;i++)
		empty_string[i]=0;
//********************

	switch (indication){
		case Processing_IND:
		break;
		case Result_IND:
			/*if(datalength!=3)	//datalength error
				writelineEx(gError_Trace, 0, "ASG dialnumber_Indication Result_IND: BAP_datalength_error");	
			else
				write("ASG dialnumber_Indication: recieved result, call-ID: %d", Indication_array[3]);*/
		
                gDialNumber_result = Indication_array[3];

                switch(gDialNumber_result)
                {
                case 0x00: // successful         
                break;
                case 0x0A: // not successful - confirm emergengy call                   
                break;
                }

                putvalue(env_RNS_dialnumber_Result, gDialNumber_result_s[gDialNumber_result]);
        break;
		case Error_IND:
			if(datalength!=4)	//datalength error
				writelineEx(gError_Trace, 0, "ASG dialnumber_Indication Error_IND: BAP_datalength_error");	
			else
				writelineEx(gError_Trace, 0, "ASG dialnumber_Indication: recieved error, errorcode:0x%x", Indication_array[3]);
		break;
		default:
			writelineEx(gError_Trace, 0, "ASG dialnumber indication: unknown indication %d", indication);
		break;
	}
}
/*@@end*/

/*@@caplFunc:DialNumber_Request(byte,char[],char[],byte):*///function
DialNumber_Request (byte request, char number [], char name [], byte errorcode)
{
int i, length_number, length_name, Offset;
dword requestarray [BAP_buffer_size];

//init lokal variables
	length_number=0;
	length_name=0;
	Offset=0;

	for(i=0;i<BAP_buffer_size;i++)
		requestarray [i]=0;
//********************

	length_number=strlen(number);
	length_name=strlen(name);

	switch(request){
		case StartResult_REQ:
			requestarray[0]=LSGID_Telephone;	//LSG-ID
			requestarray[1]=FctID_DialNumber;	//Fct.-ID
			requestarray[2]=request;	
			requestarray[3]=length_number;
			Offset=4;
			//number
			for (i=0;i<length_number;i++){
				 requestarray[Offset]=number[i];
				 Offset++;
			}
			//name
			requestarray[Offset]=length_name;
			Offset++;
			for (i=0;i<length_name;i++){
				 requestarray[Offset]=name[i];
				 Offset++;
			}

			set_status_requestbuffer (requestarray, Offset, Bap_ByteSequence);
		break;
        case Abort_REQ:
			requestarray[0]=LSGID_Telephone;	//LSG-ID
			requestarray[1]=FctID_DialNumber;	//Fct.-ID
			requestarray[2]=request;
			Offset=3;
			set_status_requestbuffer (requestarray, Offset, Bap_Void);
		break;
		default:
			writelineEx(gError_Trace, 0, "ASG dialnumber_Request: unknown request %d", request);
		break;
	}
}
/*@@end*/

/*@@caplFunc:HangUpCall_Indication(dword[],byte,int):*///function
HangUpCall_Indication(dword Indication_array [], byte indication, int datalength)
{
byte errorcode;

	errorcode=0x00;

	switch (indication){
		case Processing_IND:
		break;
		case Result_IND:
			//check BAP-array
			/*if(datalength!=3)	//datalength error
				writelineEx(gError_Trace, 0, "ASG hangupcall_Indication: BAP_datalength_error");	
			else
				write("ASG: hangupcall_Indication: recieved result");*/
            gHangupCall_Result =Indication_array[3];

            putvalue(env_RNS_HangUpCall_result, gHangupCall_Result_s[gHangupCall_Result]);
		break;
		case Error_IND:
			//check BAP-array
			if(datalength!=4)	//datalength error
				writelineEx(gError_Trace, 0, "ASG hangupcall_Indication: BAP_datalength_error");
			else{
				errorcode=Indication_array[3];
				if(errorcode<0x20)				//BCL-error
					writelineEx(gError_Trace, 0, "ASG hangupcall_Indication: BCL-Error: 0x%x - %s", errorcode, gerror_codes_BCL [errorcode-0x10]);
				else if(errorcode<0x30)			//BPL-error
					writelineEx(gError_Trace, 0, "ASG hangupcall_Indication: BPL-Error: 0x%x - %s", errorcode, gerror_codes_BPL [errorcode-0x20]);				
				else if(errorcode<0x40)			//BAL-error
					writelineEx(gError_Trace, 0, "ASG hangupcall_Indication: BAL-Error: 0x%x - %s", errorcode, gerror_codes_BAL [errorcode-0x30]);
				else if(errorcode>=0x80 && errorcode<=0xA2)
					writelineEx(gError_Trace, 0, "ASG hangupcall_Indication: Telephone-Error: 0x%x - %s", errorcode, gerror_codes_telephone [errorcode-0x80]);
				else
					writelineEx(gError_Trace, 0, "ASG hangupcall_Indication: Telephone-Error: 0x%x", errorcode);
			}
		break;
		default:
			writelineEx(gError_Trace, 0, "ASG hangupcall indication: unknown indication %d", indication);
		break;
	}
}
/*@@end*/

/*@@caplFunc:HangUpCall_request(byte,byte,byte):*///function
HangUpCall_request (byte request, byte call_id, byte errorcode)
{
int i, Offset;
dword requestarray [BAP_buffer_size];

//init lokal variables
	Offset=0;

	for(i=0;i<BAP_buffer_size;i++)
		requestarray [i]=0;
//********************

	
	switch(request){
		case StartResult_REQ:
			requestarray[0]=LSGID_Telephone;	//LSG-ID
			requestarray[1]=FctID_HangupCall;	//Fct.-ID
			requestarray[2]=request;	
			requestarray[3]=call_id;
			Offset=4;
			set_status_requestbuffer (requestarray, Offset, Bap_UInt8);
		break;
		default://error
			writelineEx(gError_Trace, 0, "ASG hangupcall_request: unknown request %d", request);
		break;
	}
}
/*@@end*/

/*@@caplFunc:RegisterState_Indication(dword[],byte,int):*///function
RegisterState_Indication (dword Indication_array [], byte indication, int datalength)
{
byte errorcode;

	errorcode=0x00;
	
	//check array
	/*if(datalength!=4)	//datalength error
		writelineEx(gError_Trace, 0, "ASG RegisterState_Indication: BAP-datalength-error");
	else*/
	{
		switch (indication)
		{
			case Data_IND:
				gRegisterState =Indication_array[3];
                gNetworkType =Indication_array[4]; 
                gPacketDataNetworkType =Indication_array[5];               

                if(gRegisterState  <0x06)
                    putvalue(env_RNS_RegisterState, gstring_registerstate[gRegisterState]);
                else if(gRegisterState  ==0xFF)
                    putvalue(env_RNS_RegisterState, "not supported");
                else
                    putvalue(env_RNS_RegisterState, greserved);


                if(gNetworkType  <0x04)
                    putvalue(env_ASG_UHV_RegisterState_NT, gNetworkType_string[gNetworkType]);
                else
                    putvalue(env_ASG_UHV_RegisterState_NT, greserved);


                if(gPacketDataNetworkType  <0x05)
                    putvalue(env_ASG_UHV_RegisterState_PDNT, gPacketDataNetworkType_string[gPacketDataNetworkType]);
                else
                    putvalue(env_ASG_UHV_RegisterState_PDNT, greserved);

			break;
			case Error_IND:
				errorcode=Indication_array[3];
				if(errorcode<0x20)				//BCL-error
					writelineEx(gError_Trace, 0, "ASG RegisterState_Indication: BCL-Error: 0x%x - %s", errorcode, gerror_codes_BCL [errorcode-0x10]);
				else if(errorcode<0x30)			//BPL-error
					writelineEx(gError_Trace, 0, "ASG RegisterState_Indication: BPL-Error: 0x%x - %s", errorcode, gerror_codes_BPL [errorcode-0x20]);				
				else if(errorcode<0x40)			//BAL-error
					writelineEx(gError_Trace, 0, "ASG RegisterState_Indication: BAL-Error: 0x%x - %s", errorcode, gerror_codes_BAL [errorcode-0x30]);
				else if(errorcode>=0x80 && errorcode<=0xA2)
					writelineEx(gError_Trace, 0, "ASG RegisterState_Indication: Telephone-Error: 0x%x - %s", errorcode, gerror_codes_telephone [errorcode-0x80]);
				else
					writelineEx(gError_Trace, 0, "ASG RegisterState_Indication: Telephone-Error: 0x%x", errorcode);
			break;
			default:
				writelineEx(gError_Trace, 0, "ASG RegisterState_Indication: unknown indication %d", indication);
			break;
		}
	}
}
/*@@end*/

/*@@caplFunc:RegisterState_Request(byte,byte):*///function
RegisterState_Request (byte request, byte errorcode)
{
int i, Offset;
dword requestarray [BAP_buffer_size];

//init lokal variables
	Offset=0;

	for(i=0;i<BAP_buffer_size;i++)
		requestarray [i]=0;
//********************

	
	switch(request){
		case DataGet_REQ:
			requestarray[0]=LSGID_Telephone;	//LSG-ID
			requestarray[1]=FctID_RegisterState;	//Fct.-ID
			requestarray[2]=request;
			Offset=3;
			set_status_requestbuffer (requestarray, Offset, Bap_Void);
		break;
		default:	//error
			writelineEx(gError_Trace, 0, "ASG RegisterState_Request: unknown request %d", request);
		break;
	}
}
/*@@end*/

/*@@envVar:env_RNS_DialNumber_abort:*/
on envVar env_RNS_DialNumber_abort
{
	if(gRNS_PowerOnOff==Power_on && gBAP_Phone_available==BAPPhone  && getvalue(this))
		dialnumber_Request(Abort_REQ, gDialNumber, gdialnumber_name, 0);
}
/*@@end*/

/*@@envVar:env_RNS_HangUpCall:*/
on envVar env_RNS_HangUpCall
{
byte callID;

//init lokal variables
    callID =0;
//********************

	if(gRNS_PowerOnOff==Power_on && gBAP_Phone_available==BAPPhone  && getvalue(this)){
		callID =getvalue(env_RNS_HangUpCall_CallID);	
		
		HangUpCall_Request(StartResult_REQ, callID, 0);
	}
}
/*@@end*/

/*@@caplFunc:callstack_missedcalls(byte,word,word):*///function
callstack_missedcalls(byte StackMode, word Stack_ID, word Stack_elements)
{

int callstackline, i;
byte neo, newnumber;
char missedcalltime [7];


	
//init lokal variables
	callstackline=0;
	neo=0xff;
	newnumber=0;
	//strncpy(missedcalltime, gtime, 7);    //required for NEWCALL
//********************


	switch(StackMode)
	{	
        case INSERT_ID:
            if(gmissedcalls_TotalNumListElements+Stack_elements<CALLSTACK)
                gmissedcalls_TotalNumListElements=gmissedcalls_TotalNumListElements+Stack_elements;
            else
                gmissedcalls_TotalNumListElements=CALLSTACK;

            //********shift down calls in call stack**********************************
            //start at entry, which will be the last; stop at next to last new entry
            for(callstackline=((gmissedcalls_TotalNumListElements-1)-Stack_elements);callstackline>=Stack_ID;callstackline--)
            {
                //PbName
    		    strncpy(gmissedcalls_pbname[callstackline+Stack_elements], gmissedcalls_pbname[callstackline], CALL_INFO_NAME_LENGTH);
                //NumberType
	   			gmissedcalls_numbertype[callstackline+Stack_elements]=gmissedcalls_numbertype[callstackline];
        		//TelNumber
	   	    	strncpy(gmissedcalls_telnumber[callstackline+Stack_elements], gmissedcalls_telnumber[callstackline], CALL_INFO_NUMBER_LENGTH);
	            //Date
    		    strncpy(gmissedcalls_date[callstackline+Stack_elements], gmissedcalls_date[callstackline], 7);
	            //Time
	    		strncpy(gmissedcalls_time[callstackline+Stack_elements], gmissedcalls_time[callstackline], 7);
                //write("shift callstackline = %d", callstackline);     //debug
            }
        break;

		case DELETE_ID:
            //********shift up calls in call stack**********************************
            //start at next to last deleted entry, stop at last entry
            for(callstackline=(Stack_ID+1);callstackline<gmissedcalls_TotalNumListElements;callstackline++)
            {
                //PbName
				strncpy(gmissedcalls_pbname[callstackline-Stack_elements], gmissedcalls_pbname[callstackline], CALL_INFO_NAME_LENGTH);
	            //NumberType
				gmissedcalls_numbertype[callstackline-Stack_elements]=gmissedcalls_numbertype[callstackline];
    			//TelNumber
	    		strncpy(gmissedcalls_telnumber[callstackline-Stack_elements], gmissedcalls_telnumber[callstackline], CALL_INFO_NUMBER_LENGTH);
	            //Date
			    strncpy(gmissedcalls_date[callstackline-Stack_elements], gmissedcalls_date[callstackline], 7);
	            //Time
				strncpy(gmissedcalls_time[callstackline-Stack_elements], gmissedcalls_time[callstackline], 7);
                //write("shift callstackline = %d", callstackline);     //debug
            }
          
            //**********delete last entries********************************
            for(callstackline=(gmissedcalls_TotalNumListElements-Stack_elements);callstackline<gmissedcalls_TotalNumListElements;callstackline++)
            {
		        for(i=0;i<CALL_INFO_NAME_LENGTH;i++)
			        gmissedcalls_pbname[callstackline][i] =0;
                gmissedcalls_numbertype[callstackline] =0;
                for(i=0;i<CALL_INFO_NUMBER_LENGTH;i++)
		    	    gmissedcalls_telnumber[callstackline][i] =0;
                for(i=0;i<7;i++)
	    		    gmissedcalls_date[callstackline][i] =0;
                for(i=0;i<7;i++)
			        gmissedcalls_time[callstackline][i] =0;
                //write("erase callstackline = %d", callstackline);     //debug
            }

            //************update gmissedcalls_TotalNumListElements
            gmissedcalls_TotalNumListElements=callstackline;

		break;
    }
}
/*@@end*/

/*@@envVar:env_ASG_MissedCalls_GetArray:*/
on envVar env_ASG_MissedCalls_GetArray
{
    byte mode, shift, direction, transmitpos, indexsize,recordaddress, requested_startelement, startelement, elements;

    // Init local variables. 
    mode                    =0;
    shift                   =0;
    direction               =0;
    transmitpos             =0;
    indexsize               =0;
    recordaddress           =0;
    startelement            =0;
    elements                =0;

    if(gRNS_PowerOnOff==Power_on && getvalue(this))
	{
        gmissedcalls_ASG_ID             =getvalue(env_ASG_MissedCalls_ASG_ID);
        gmissedcalls_TAID               =getvalue(env_ASG_MissedCalls_TAID);
        shift                           =getvalue(env_ASG_MissedCalls_AH_shift);
        direction                       =getvalue(env_ASG_MissedCalls_AH_dir);
        transmitpos                     =getvalue(env_ASG_MissedCalls_AH_POS);
        indexsize                       =getvalue(env_ASG_MissedCalls_AH_IS);
        recordaddress                   =getvalue(env_ASG_MissedCalls_AH_RA);
        startelement                    =getvalue(env_ASG_MissedCalls_AH_start);
        elements                        =getvalue(env_ASG_MissedCalls_AH_elements);
        if(elements>SLW_WINDOW_CACHE)
        {            
            elements=SLW_WINDOW_CACHE;
            putvalue(env_ASG_MissedCalls_AH_elements,elements);
            write("ASG MissedCalls GetArray: To much elements requested, reduced to %d elements", SLW_WINDOW_CACHE);
        }
        mode=(shift+(direction*0x02)+(transmitpos*0x04)+indexsize*0x08)*0x10 + recordaddress;

        MissedCalls_Request(DataGet_REQ, startelement, elements, mode, 0);
    }
}
/*@@end*/

/*@@caplFunc:MPSWCOH_Request(byte,byte):*///function
MPSWCOH_Request (byte request, byte errorcode)
{
int i, Offset;
dword requestarray [BAP_buffer_size];

//init lokal variables
	Offset=0;

	for(i=0;i<BAP_buffer_size;i++)
		requestarray [i]=0;
//********************

	
	switch(request)
	{
		case StartResult_REQ:
			requestarray[0]=LSGID_Telephone;									//LSG-ID
			requestarray[1]=FctID_MPSetWaitingCallOnHold;			//Fct.-ID
			requestarray[2]=request;
			Offset=3;
			set_status_requestbuffer (requestarray, Offset, Bap_Void);
		break;
		default://error
			writelineEx(gError_Trace, 0,"ASG MPSWCOH_Request: unknown request %d", request);
		break;
	}
}
/*@@end*/

/*@@caplFunc:MPSWCOH_Indication(dword[],byte,int):*///function
MPSWCOH_Indication(dword Indication_array [], byte indication, int datalength)
{
byte errorcode;

	errorcode=0x00;

	switch (indication)
	{
		case Processing_IND:
		break;
		case Result_IND:
			if(datalength!=4)	//check array-datalength
				writelineEx(gError_Trace, 0,"ASG MPSWCOH_Indication: datalength-error");
			else
				write("ASG MPCHAWC_Indication: recieved result");
		break;
		case Error_IND:
			if(datalength!=4)
				writelineEx(gError_Trace, 0, "ASG MPSWCOH_Indication: BAP-datalength-error");
			else
			{
				errorcode=Indication_array[3];
				if(errorcode<0x20)				//BCL-error
					writelineEx(gError_Trace, 0, "ASG MPSWCOH_Indication: BCL-Error: 0x%x - %s", errorcode, gerror_codes_BCL [errorcode-0x10]);
				else if(errorcode<0x30)			//BPL-error
					writelineEx(gError_Trace, 0, "ASG MPSWCOH_Indication: BPL-Error: 0x%x - %s", errorcode, gerror_codes_BPL [errorcode-0x20]);				
				else if(errorcode<0x40)			//BAL-error
					writelineEx(gError_Trace, 0, "ASG MPSWCOH_Indication: BAL-Error: 0x%x - %s", errorcode, gerror_codes_BAL [errorcode-0x30]);
				else if(errorcode>=0x80 && errorcode<=0xA2)
					writelineEx(gError_Trace, 0, "ASG MPSWCOH_Indication: Telephone-Error: 0x%x - %s", errorcode, gerror_codes_telephone [errorcode-0x80]);
				else
					writelineEx(gError_Trace, 0, "ASG MPSWCOH_Indication: Telephone-Error: 0x%x", errorcode);
			}
		break;
		default:
			writelineEx(gError_Trace, 0,"ASG MPSWCOH_Indication: unknown indication %d", indication);
		break;
	}
}
/*@@end*/

/*@@envVar:env_ASG_UHV_MP_SWCOH:*/
on envVar env_ASG_UHV_MP_SWCOH
{
    if(gRNS_PowerOnOff==Power_on && gBAP_Phone_available==BAPPhone && getvalue(this))
		MPSWCOH_Request (StartResult_REQ, 0);
}
/*@@end*/

/*@@caplFunc:display_phonebook_detail():*///function
display_phonebook_detail ()
{

	
    putvalue(env_ASG_PB_SlW_Detail_Pos, gPhonebook_Detail_Pos);   
	putvalue(env_ASG_PB_SlW_Detail_PbName, gPhonebook_Detail_PbName);
    putvalue(env_ASG_PB_SlW_Detail_Sto, gPhonebook_Detail_Storage);
    putvalue(env_ASG_PB_SlW_Detail_AVT, gPhonebook_Detail_AnyVoiceTag);
    putvalue(env_ASG_PB_SlW_Detail_TNQ, gPhonebook_Detail_TelNumberQuantity);

	putvalue(env_ASG_PB_SlW_Detail_TelNumber1, gPhonebook_Detail_TelNumber1);
	putvalue(env_ASG_PB_SlW_Detail_TelNumber2, gPhonebook_Detail_TelNumber2);
	putvalue(env_ASG_PB_SlW_Detail_TelNumber3, gPhonebook_Detail_TelNumber3);
    putvalue(env_ASG_PB_SlW_Detail_TelNumber4, gPhonebook_Detail_TelNumber4);
    putvalue(env_ASG_PB_SlW_Detail_TelNumber5, gPhonebook_Detail_TelNumber5);

    putvalue(env_ASG_PB_SlW_Detail_VoiceTag1, gPhonebook_Detail_VoiceTag1);
	putvalue(env_ASG_PB_SlW_Detail_VoiceTag2, gPhonebook_Detail_VoiceTag2);
	putvalue(env_ASG_PB_SlW_Detail_VoiceTag3, gPhonebook_Detail_VoiceTag3);
    putvalue(env_ASG_PB_SlW_Detail_VoiceTag4, gPhonebook_Detail_VoiceTag4);
    putvalue(env_ASG_PB_SlW_Detail_VoiceTag5, gPhonebook_Detail_VoiceTag5);

	putvalue(env_ASG_PB_SlW_Detail_NumberType1, gnumbertype[gPhonebook_Detail_NumberType1]);
    putvalue(env_ASG_PB_SlW_Detail_NumberType1, gnumbertype[gPhonebook_Detail_NumberType2]);
    putvalue(env_ASG_PB_SlW_Detail_NumberType1, gnumbertype[gPhonebook_Detail_NumberType3]);
    putvalue(env_ASG_PB_SlW_Detail_NumberType1, gnumbertype[gPhonebook_Detail_NumberType4]);
    putvalue(env_ASG_PB_SlW_Detail_NumberType1, gnumbertype[gPhonebook_Detail_NumberType5]);

    putvalue(env_ASG_PB_SlW_Detail_AI, gPhonebook_Detail_AddressIndication);
	

}
/*@@end*/

/*@@caplFunc:display_phonebook_slw():*///function
display_phonebook_slw ()
{
    int slw_first_window_element=SLW_FIRST_WINDOW_ELEMENT;

	if(SLW_WINDOW_CACHE>0)
    {
        putvalue(env_ASG_PB_SlW_Pos1, gPhonebook_SlW_Pos[slw_first_window_element]);
        putvalue(env_ASG_PB_SlW_PbName1, gPhonebook_SlW_PbName[slw_first_window_element]);
        putvalue(env_ASG_PB_SlW_Sto1, gPhonebook_SlW_Storage[slw_first_window_element]);
        putvalue(env_ASG_PB_SlW_AVT1, gPhonebook_SlW_AnyVoiceTag[slw_first_window_element]);
        putvalue(env_ASG_PB_SlW_TNQ1, gPhonebook_SlW_TelNumberQuantity[slw_first_window_element]);
        putvalue(env_ASG_PB_SlW_AI1, gPhonebook_SlW_AddressIndication[slw_first_window_element]);
        
        if(SLW_WINDOW_CACHE>1)
        {
	        putvalue(env_ASG_PB_SlW_Pos2, gPhonebook_SlW_Pos[slw_first_window_element+1]);
            putvalue(env_ASG_PB_SlW_PbName2, gPhonebook_SlW_PbName[slw_first_window_element+1]);
            putvalue(env_ASG_PB_SlW_Sto2, gPhonebook_SlW_Storage[slw_first_window_element+1]);
            putvalue(env_ASG_PB_SlW_AVT2, gPhonebook_SlW_AnyVoiceTag[slw_first_window_element+1]);
            putvalue(env_ASG_PB_SlW_TNQ2, gPhonebook_SlW_TelNumberQuantity[slw_first_window_element+1]);
            putvalue(env_ASG_PB_SlW_AI2, gPhonebook_SlW_AddressIndication[slw_first_window_element+1]);
        
            if(SLW_WINDOW_CACHE>2)
            {
                putvalue(env_ASG_PB_SlW_Pos3, gPhonebook_SlW_Pos[slw_first_window_element+2]);
                putvalue(env_ASG_PB_SlW_PbName3, gPhonebook_SlW_PbName[slw_first_window_element+2]);
                putvalue(env_ASG_PB_SlW_Sto3, gPhonebook_SlW_Storage[slw_first_window_element+2]);
                putvalue(env_ASG_PB_SlW_AVT3, gPhonebook_SlW_AnyVoiceTag[slw_first_window_element+2]);
                putvalue(env_ASG_PB_SlW_TNQ3, gPhonebook_SlW_TelNumberQuantity[slw_first_window_element+2]);
                putvalue(env_ASG_PB_SlW_AI3, gPhonebook_SlW_AddressIndication[slw_first_window_element+2]);
                
            
                if(SLW_WINDOW_CACHE>3)
                {
                    putvalue(env_ASG_PB_SlW_Pos4, gPhonebook_SlW_Pos[slw_first_window_element+3]);
                    putvalue(env_ASG_PB_SlW_PbName4, gPhonebook_SlW_PbName[slw_first_window_element+3]);
                    putvalue(env_ASG_PB_SlW_Sto4, gPhonebook_SlW_Storage[slw_first_window_element+3]);
                    putvalue(env_ASG_PB_SlW_AVT4, gPhonebook_SlW_AnyVoiceTag[slw_first_window_element+3]);
                    putvalue(env_ASG_PB_SlW_TNQ4, gPhonebook_SlW_TelNumberQuantity[slw_first_window_element+3]);
                    putvalue(env_ASG_PB_SlW_AI4, gPhonebook_SlW_AddressIndication[slw_first_window_element+3]);
                    
    
                    if(SLW_WINDOW_CACHE>4)
                    {
                        putvalue(env_ASG_PB_SlW_Pos5, gPhonebook_SlW_Pos[slw_first_window_element+4]);
                        putvalue(env_ASG_PB_SlW_PbName5, gPhonebook_SlW_PbName[slw_first_window_element+4]);
                        putvalue(env_ASG_PB_SlW_Sto5, gPhonebook_SlW_Storage[slw_first_window_element+4]);
                        putvalue(env_ASG_PB_SlW_AVT5, gPhonebook_SlW_AnyVoiceTag[slw_first_window_element+4]);
                        putvalue(env_ASG_PB_SlW_TNQ5, gPhonebook_SlW_TelNumberQuantity[slw_first_window_element+4]);
                        putvalue(env_ASG_PB_SlW_AI5, gPhonebook_SlW_AddressIndication[slw_first_window_element+4]);
                        
                    }
                }
            }
        }
    }

}
/*@@end*/

/*@@envVar:env_ASG_PB_GetArray:*/
on envVar env_ASG_PB_GetArray
{
    byte mode, shift, direction, transmitpos, indexsize,recordaddress;
    word requested_startelement, startelement, elements;


    // Init local variables. 
    mode                    =0;
    shift                   =0;
    direction               =0;
    transmitpos             =0;
    indexsize               =0;
    recordaddress           =0;
    startelement            =0;
    elements                =0;

    if(gRNS_PowerOnOff==Power_on && getvalue(this))
	{
        gPhonebook_ASG_ID             =getvalue(env_ASG_PB_ASG_ID);
        gPhonebook_TAID               =getvalue(env_ASG_PB_TAID);
        shift                           =getvalue(env_ASG_PB_AH_shift);
        direction                       =getvalue(env_ASG_PB_AH_dir);
        transmitpos                     =getvalue(env_ASG_PB_AH_POS);
        indexsize                       =getvalue(env_ASG_PB_AH_IS);
        recordaddress                   =getvalue(env_ASG_PB_AH_RA);
        startelement                    =getvalue(env_ASG_PB_AH_start);
        elements                        =getvalue(env_ASG_PB_AH_elements);
        if(elements>SLW_WINDOW_CACHE)
        {            
            elements=SLW_WINDOW_CACHE;
            putvalue(env_ASG_PB_AH_elements,elements);
            write("ASG Phonebook GetArray: To much elements requested, reduced to %d elements", SLW_WINDOW_CACHE);
        }
        mode=(shift+(direction*0x02)+(transmitpos*0x04)+indexsize*0x08)*0x10 + recordaddress;

        Phonebook_Request(DataGet_REQ, startelement, elements, mode, 0);
    }
}
/*@@end*/

/*@@envVar:env_ASG_PB_SlW_Detailed_select:*/
on envVar env_ASG_PB_SlW_Detailed_select
{
	if(gRNS_PowerOnOff==Power_on && gPhonebook_SlW_Mode && getvalue(this)){
        Phonebook_Request(DataGet_REQ, gPhonebook_SlW_Pos[SLW_FIRST_WINDOW_ELEMENT+getvalue(env_ASG_PB_SlW_Detailed_Number)], 1, 0x00, 0);	
	}

}
/*@@end*/

/*@@envVar:env_ASG_PB_SlW_Dial_Detail:*/
on envVar env_ASG_PB_SlW_Dial_Detail
{

int length;
char i, empty_string [3];

//init lokal variables
	length=0;
	for(i=0;i<3;i++)
		empty_string[i]=0;
//********************

	if(gRNS_PowerOnOff==Power_on && getvalue(this)){
		strncpy(gDialNumber,gPhonebook_Detail_TelNumber1,PHONEBOOK_TELNUMBER_LENGTH);	
		strncpy(gdialnumber_name,gPhonebook_Detail_PbName,PHONEBOOK_PBNAME_LENGTH);	
		length=strlen(gDialNumber);	//mailboxnumber-length
		
        if(length>0)
			dialnumber_Request(StartResult_REQ, gDialNumber, gdialnumber_name, 0);
	}
}
/*@@end*/

/*@@envVar:env_ASG_PB_SlW_LongPressAgainTime:*/
on envVar env_ASG_PB_SlW_LongPressAgainTime
{
	if(gRNS_PowerOnOff==Power_on && gPhonebook_SlW_Mode)
		gLongKeyPressAgainTime=getvalue(this);
}
/*@@end*/

/*@@envVar:env_ASG_PB_SlW_LongPressTime:*/
on envVar env_ASG_PB_SlW_LongPressTime
{
	if(gRNS_PowerOnOff==Power_on && gPhonebook_SlW_Mode)
		gLongKeyPressTime=getvalue(this);
}
/*@@end*/

/*@@envVar:env_ASG_PB_SlW_ScrollingEntries:*/
on envVar env_ASG_PB_SlW_ScrollingEntries
{
	if(gRNS_PowerOnOff==Power_on && gPhonebook_SlW_Mode)
		gPhonebook_ScrollingEntries=getvalue(this);
}
/*@@end*/

/*@@envVar:env_ASG_PB_SlW_Down:*/
on envVar env_ASG_PB_SlW_Down
{
	if(gRNS_PowerOnOff==Power_on && gPhonebook_SlW_Mode){
		if(getvalue(this)){																	//rising edge
			settimer(Phonebook_LongKeyPress_timer, gLongKeyPressTime);
			gPhonebook_KeyPressCode=SCROLL_DOWN;
			
		}
		else{
			gPhonebook_KeyPressCode=0;
            canceltimer(Phonebook_LongKeyPress_timer);
		}
	}


}
/*@@end*/

/*@@envVar:env_ASG_PB_SlW_Up:*/
on envVar env_ASG_PB_SlW_Up
{
	if(gRNS_PowerOnOff==Power_on && gPhonebook_SlW_Mode){
		if(getvalue(this)){																	//rising edge
			settimer(Phonebook_LongKeyPress_timer, gLongKeyPressTime);
			gPhonebook_KeyPressCode=SCROLL_UP;
			
		}
		else{
			gPhonebook_KeyPressCode=0;
			canceltimer(Phonebook_LongKeyPress_timer);
		}
	}


}
/*@@end*/

/*@@envVar:env_ASG_PB_SlW_OnOff:*/
on envVar env_ASG_PB_SlW_OnOff
{
char empty_string [2];
byte i, j;

empty_string[0]=0;
empty_string[1]=0;

	if(gRNS_PowerOnOff==Power_on){
		gPhonebook_SlW_Mode=getvalue(this);

		if(gPhonebook_SlW_Mode){
			EnableControl("ASG-Telephone_Phonebook_SlW","ASG_SlW", 1);
            EnableControl("ASG-Telephone_Phonebook(array)","Phonebook_GetArray",0);

            gPhonebook_VorhaltUpStatus=0;
			gPhonebook_VorhaltDownStatus=0;
            putvalue(env_ASG_PB_SlW_Vorhalt_n_max, SLW_LOWER_CACHE);
			putvalue(env_ASG_PB_SlW_Vorhalt_n, gPhonebook_VorhaltDownStatus);
			putvalue(env_ASG_PB_SlW_Vorhalt_v_max, SLW_UPPER_CACHE);
			putvalue(env_ASG_PB_SlW_Vorhalt_v,gPhonebook_VorhaltUpStatus);
			
            gLongKeyPressTime=10;
			gLongKeyPressAgainTime=4000;
			gPhonebook_KeyPressCode=0;
			gPhonebook_ScrollingEntries=5;
			putvalue(env_ASG_PB_SlW_LongPressAgainTime, gLongKeyPressAgainTime);
			putvalue(env_ASG_PB_SlW_LongPressTime, gLongKeyPressTime);
			putvalue(env_ASG_PB_SlW_ScrollingEntries, gPhonebook_ScrollingEntries);
	        
            gPhonebook_FullRangeUpdate=1;            //Activate FullRangeUpdate

			gPhonebook_SlW_DownloadVorhaltUp=FALSE;
			gPhonebook_SlW_DownloadVorhaltDown=TRUE;
			gPhonebook_SlW_Download_status=WINDOW;

			Phonebook_Request(DataGet_REQ, SLW_FIRST_LIST_ELEMENT, SLW_WINDOW_CACHE, 0x01, 0);
            
		    //display_SlW_Window();
		}
		else{

            EnableControl("ASG-Telephone_Phonebook(array)","Phonebook_GetArray",1);
			
            delete_phonebook_slw();

			display_phonebook_slw();			

			display_phonebook_detail();
		}

		putvalue(env_ASG_PB_SlW_OnOff_str, gstring_SlW_Mode[gPhonebook_SlW_Mode]);
	}

}
/*@@end*/

/*@@timer:Phonebook_LongKeyPress_timer:*/
on timer Phonebook_LongKeyPress_timer
{
byte mode, Gwendoline, ElCattivo;
int i, j;

Gwendoline=0;//Lösch-Elemente
ElCattivo=0;//Scroll-Elemente

	if(gPhonebook_KeyPressCode==SCROLL_UP){
		if(gPhonebook_VorhaltUpStatus>0 && gPhonebook_SlW_Download_status==NO_SLW_DOWNLOAD)    //some elements in upper cache
        {
			if(gPhonebook_VorhaltUpStatus>=gPhonebook_ScrollingEntries)   //requested elements available
				ElCattivo=gPhonebook_ScrollingEntries;
			else
				ElCattivo=gPhonebook_VorhaltUpStatus;           //only elements in upper cache available
			Gwendoline=ElCattivo;
            //write("Gwen %d, El %d", Gwendoline, ElCattivo);//debug
 				
			for(i=(SLW_LAST_LIST_ELEMENT-ElCattivo);i>=SLW_FIRST_LIST_ELEMENT;i--){
				gPhonebook_SlW_Pos[i+ElCattivo]=gPhonebook_SlW_Pos[i];
				strncpy(gPhonebook_SlW_PbName[i+ElCattivo], gPhonebook_SlW_PbName[i], PHONEBOOK_PBNAME_LENGTH);
				gPhonebook_SlW_Storage[i+ElCattivo]=gPhonebook_SlW_Storage[i];
                gPhonebook_SlW_AnyVoiceTag[i+ElCattivo]=gPhonebook_SlW_AnyVoiceTag[i];
                gPhonebook_SlW_TelNumberQuantity[i+ElCattivo]=gPhonebook_SlW_TelNumberQuantity[i];
                gPhonebook_SlW_AddressIndication[i+ElCattivo]=gPhonebook_SlW_AddressIndication[i];
			}
            if(gPhonebook_VorhaltDownStatus<SLW_LOWER_CACHE){
				i=gPhonebook_VorhaltDownStatus+ElCattivo;     //theoretical number of new elements
                if(i>SLW_LOWER_CACHE)               //to much elements
                    gPhonebook_VorhaltDownStatus=SLW_LOWER_CACHE;
                else                                //valid number of new elements
                    gPhonebook_VorhaltDownStatus=i;
				putvalue(env_ASG_PB_SlW_Vorhalt_n,gPhonebook_VorhaltDownStatus);
			}
			display_phonebook_slw();

			for(j=SLW_FIRST_LIST_ELEMENT;j<Gwendoline;j++)
            {
				gPhonebook_SlW_Pos[j]=0;
                for(i=0;i<PHONEBOOK_PBNAME_LENGTH;i++)
					gPhonebook_SlW_PbName[j][i]=0;
				gPhonebook_SlW_Storage[j]=0;
                gPhonebook_SlW_AnyVoiceTag[j]=0;
                gPhonebook_SlW_TelNumberQuantity[j]=0;
                gPhonebook_SlW_AddressIndication[j]=0;
				gPhonebook_VorhaltUpStatus--;
			}
			putvalue(env_ASG_PB_SlW_Vorhalt_v,gPhonebook_VorhaltUpStatus);
            //write("scroll up: gPhonebook_SlW_Download_status %d", gPhonebook_SlW_Download_status);//debug
			if(gPhonebook_SlW_Pos[Gwendoline]!=0)   //only for valid entries
            {
                if(gPhonebook_SlW_Download_status==NO_SLW_DOWNLOAD){
				    gPhonebook_SlW_Download_status=VORHALT_UP;
                    //write("gPhonebook_SlidingWindow_Pos[Gwendoline] =  0x%x, Gwendoline = %d",gPhonebook_SlidingWindow_Pos[Gwendoline], Gwendoline);//debug
				                    //recordaddress=1, shift=1, direction=1
                    //write("# --| request: Phonebook_Request(DataGet_REQ, gPhonebook_SlW_Pos[%d] = %d, Gwendoline = %d, 0x31, 0)", Gwendoline, gPhonebook_SlW_Pos[Gwendoline], Gwendoline);
				    Phonebook_Request(DataGet_REQ, gPhonebook_SlW_Pos[Gwendoline], Gwendoline, 0x31, 0);
			    }
			    else
				    gPhonebook_SlW_DownloadVorhaltUp=TRUE;
            }
		}
		
	}
	else if(gPhonebook_KeyPressCode==SCROLL_DOWN)
    {
		if(gPhonebook_VorhaltDownStatus>0 && gPhonebook_SlW_Download_status==NO_SLW_DOWNLOAD)    //some elements in lower cache
        {
			if(gPhonebook_VorhaltDownStatus>=gPhonebook_ScrollingEntries)   //requested elements available
				ElCattivo=gPhonebook_ScrollingEntries;
			else
				ElCattivo=gPhonebook_VorhaltDownStatus;           //only elements in lower cache available
            Gwendoline=ElCattivo;
				
			for(i=ElCattivo;i<=SLW_LAST_LIST_ELEMENT;i++)
            {
				gPhonebook_SlW_Pos[i-ElCattivo]=gPhonebook_SlW_Pos[i];
				strncpy(gPhonebook_SlW_PbName[i-ElCattivo], gPhonebook_SlW_PbName[i], PHONEBOOK_PBNAME_LENGTH);
				gPhonebook_SlW_Storage[i-ElCattivo]=gPhonebook_SlW_Storage[i];
                gPhonebook_SlW_AnyVoiceTag[i-ElCattivo]=gPhonebook_SlW_AnyVoiceTag[i];
                gPhonebook_SlW_TelNumberQuantity[i-ElCattivo]=gPhonebook_SlW_TelNumberQuantity[i];
                gPhonebook_SlW_AddressIndication[i-ElCattivo]=gPhonebook_SlW_AddressIndication[i];
			}
            if(gPhonebook_VorhaltUpStatus<SLW_UPPER_CACHE)
            {
                i=gPhonebook_VorhaltUpStatus+ElCattivo;     //theoretical number of new elements
                if(i>SLW_UPPER_CACHE)               //to much elements
                    gPhonebook_VorhaltUpStatus=SLW_UPPER_CACHE;
                else                                //valid number of new elements
                    gPhonebook_VorhaltUpStatus=i;
				
				putvalue(env_ASG_PB_SlW_Vorhalt_v,gPhonebook_VorhaltUpStatus);
    		}
			display_phonebook_slw();

			for(j=SLW_LAST_LIST_ELEMENT;j>(SLW_LAST_LIST_ELEMENT-Gwendoline);j--)
            {
				gPhonebook_SlW_Pos[j]=0;
                for(i=0;i<PHONEBOOK_PBNAME_LENGTH;i++)
					gPhonebook_SlW_PbName[j][i]=0;
				gPhonebook_SlW_Storage[j]=0;
                gPhonebook_SlW_AnyVoiceTag[j]=0;
                gPhonebook_SlW_TelNumberQuantity[j]=0;
                gPhonebook_SlW_AddressIndication[j]=0;
				gPhonebook_VorhaltDownStatus--;
			}
			putvalue(env_ASG_PB_SlW_Vorhalt_n,gPhonebook_VorhaltDownStatus);
            //write("scroll down: gPhonebook_SlW_Download_status %d", gPhonebook_SlW_Download_status);//debug
            if(gPhonebook_SlW_Pos[SLW_LAST_LIST_ELEMENT-Gwendoline]!=0) //only for valid entries
            {
                if(gPhonebook_SlW_Download_status==NO_SLW_DOWNLOAD)
                {
			    	gPhonebook_SlW_Download_status=VORHALT_DOWN;
                    //write("gPhonebook_SlidingWindow_Pos[SLW_LAST_LIST_ELEMENT-Gwendoline] =  0x%x, Gwendoline = %d",gPhonebook_SlidingWindow_Pos[SLW_LAST_LIST_ELEMENT-Gwendoline], Gwendoline);//debug
									                                                                //mode: recordaddress=1, shift=1, direction=0
			    	Phonebook_Request(DataGet_REQ, gPhonebook_SlW_Pos[SLW_LAST_LIST_ELEMENT-Gwendoline], Gwendoline, 0x11, 0);
			    }
			    else
				    gPhonebook_SlW_DownloadVorhaltDown=TRUE;
            }
		}
	}
    //display_callstack_missedcalls();
	
	settimer(Phonebook_LongKeyPress_timer, gLongKeyPressAgainTime);
}
/*@@end*/

/*@@caplFunc:delete_phonebook_slw():*///function
delete_phonebook_slw ()
{
    int i,j;

    for(i=0;i<SLW_ENTRIES;i++)
    {
        gPhonebook_SlW_Pos[i] =0;
        for(j=0;j>PHONEBOOK_PBNAME_LENGTH;j++)
            gPhonebook_SlW_PbName [i][j]=0;				//array for name in phonebook
        gPhonebook_SlW_Storage [i] =0;
        gPhonebook_SlW_AnyVoiceTag[i] =0;
        gPhonebook_SlW_TelNumberQuantity[i] =0;
        gPhonebook_SlW_AddressIndication[i] =0;
    }

        gPhonebook_Detail_Pos=0;
        for(i=0;i>PHONEBOOK_PBNAME_LENGTH;i++)
            gPhonebook_Detail_PbName[i]=0;				//array for name in phonebook
        gPhonebook_Detail_Storage=0;
        gPhonebook_Detail_AnyVoiceTag=0;
        gPhonebook_Detail_TelNumberQuantity=0;

        for(i=0;i>PHONEBOOK_PBNAME_LENGTH;i++)
            gPhonebook_Detail_TelNumber1 [i]=0;
        for(i=0;i>PHONEBOOK_TELNUMBER_LENGTH;i++)
            gPhonebook_Detail_TelNumber2 [i]=0;
        for(i=0;i>PHONEBOOK_TELNUMBER_LENGTH;i++)
            gPhonebook_Detail_TelNumber3 [i]=0;
        for(i=0;i>PHONEBOOK_TELNUMBER_LENGTH;i++)
            gPhonebook_Detail_TelNumber4 [i]=0;
        for(i=0;i>PHONEBOOK_TELNUMBER_LENGTH;i++)
            gPhonebook_Detail_TelNumber5 [i]=0;        
        for(i=0;i>PHONEBOOK_TELNUMBER_LENGTH;i++)
            gPhonebook_Detail_TelNumber6 [i]=0;        
        for(i=0;i>PHONEBOOK_TELNUMBER_LENGTH;i++)
            gPhonebook_Detail_TelNumber7 [i]=0;        
        for(i=0;i>PHONEBOOK_TELNUMBER_LENGTH;i++)
            gPhonebook_Detail_TelNumber8 [i]=0;
        for(i=0;i>PHONEBOOK_TELNUMBER_LENGTH;i++)
            gPhonebook_Detail_TelNumber9 [i]=0;
        for(i=0;i>PHONEBOOK_TELNUMBER_LENGTH;i++)
            gPhonebook_Detail_TelNumber10 [i]=0;
        gPhonebook_Detail_VoiceTag1=0;
        gPhonebook_Detail_VoiceTag2=0;
        gPhonebook_Detail_VoiceTag3=0;
        gPhonebook_Detail_VoiceTag4=0;
        gPhonebook_Detail_VoiceTag5=0;
        gPhonebook_Detail_VoiceTag6=0;
        gPhonebook_Detail_VoiceTag7=0;
        gPhonebook_Detail_VoiceTag8=0;
        gPhonebook_Detail_VoiceTag9=0;
        gPhonebook_Detail_VoiceTag10=0;
        gPhonebook_Detail_NumberType1=0;
        gPhonebook_Detail_NumberType2=0;
        gPhonebook_Detail_NumberType3=0;
        gPhonebook_Detail_NumberType4=0;
        gPhonebook_Detail_NumberType5=0;
        gPhonebook_Detail_NumberType6=0;
        gPhonebook_Detail_NumberType7=0;
        gPhonebook_Detail_NumberType8=0;
        gPhonebook_Detail_NumberType9=0;
        gPhonebook_Detail_NumberType10=0;

        gPhonebook_Detail_AddressIndication=0;
}
/*@@end*/

/*@@envVar:env_FSG_CallDurationSync_OK:*/
on envVar env_FSG_CallDurationSync_OK
{
    if(getvalue(this))
    {
        OpenPanel("FSG-Telephone_send_data");
    }
}
/*@@end*/

/*@@caplFunc:RingToneMuteOnOff_Indication(dword[],byte,int):*///function
RingToneMuteOnOff_Indication (dword Indication_array[], byte indication, int datalength)
{
    //write("ASG: RingToneMuteOnOff_Indication");	
    
	switch (indication){
		case Data_IND:
			if(datalength != 4)
            {
				writelineEx(gError_Trace, 0, "ASG RingToneMuteOnOff: BAP-datalength-error");
            }
			else
            {
                gRingToneMute = (Indication_array[3] & 0x01);
                if(gRingToneMute != getvalue(env_RNS_RingToneMuteOnOff))
					gRingToneMute_noDataSetGet = 1;
                putvalue(env_RNS_RingToneMute_string, gstring_RingToneMute[gRingToneMute]);
                putvalue(env_RNS_RingToneMuteOnOff, gRingToneMute);
			}
		    break;
		case Error_IND:
			if(datalength != 4)
				writelineEx(gError_Trace, 0, "ASG RingToneMuteOnOff: BAP-datalength-error");
			else
				writelineEx(gError_Trace, 0, "ASG RingToneMuteOnOff: recieved error, errorcode:0x%x", Indication_array[3]);
		    break;
		default:
			writelineEx(gError_Trace, 0, "ASG RingToneMuteOnOff: unknown indication %d", indication);
		    break;
    }
}
/*@@end*/

/*@@caplFunc:RingToneMuteOnOff_Request(byte,byte):*///function
RingToneMuteOnOff_Request (byte request, byte errorcode)
{
    int offset, i;
    dword requestarray [BAP_buffer_size];

    //write("ASG: RingToneMuteOnOff_Request");

	offset=0;

	for(i=0;i<BAP_buffer_size;i++)
		requestarray [i]=0;
	
	switch(request){
		case DataSetGet_REQ:
			requestarray[0] = LSGID_Telephone;	//LSG-ID
			requestarray[1] = FctID_RingToneMuteOnOff;	//Fct.-ID
			requestarray[2] = request;	
			requestarray[3] = gRingToneMute;
			offset = 4;
			set_status_requestbuffer(requestarray, offset, Bap_UInt8);
		    break;
		case DataGet_REQ:
			requestarray[0] = LSGID_Telephone;	//LSG-ID
			requestarray[1] = FctID_RingToneMuteOnOff;	//Fct.-ID
			requestarray[2] = request;
			offset = 3;
			set_status_requestbuffer (requestarray, offset, Bap_Void);
		    break;
		default:	//error
			writelineEx(gError_Trace, 0, "ASG RingToneMuteOnOff_Request: unknown request %d", request);
		    break;
	}
}
/*@@end*/

/*@@envVar:env_RNS_RingToneMuteOnOff:*/
on envVar env_RNS_RingToneMuteOnOff
{
    if(gRNS_PowerOnOff == Power_on && gBAP_Phone_available == BAPPhone)    
    {
        if(gRingToneMute_noDataSetGet == 0)
        {
            gRingToneMute = getvalue(this);        
            //write("set gRingToneMute to %d, gRingToneMute: %d", getvalue(this), gRingToneMute);
            RingToneMuteOnOff_Request(DataSetGet_REQ, 0);
        }
        else
        {
            gRingToneMute_noDataSetGet = 0;
        }
    }
}

	
/*@@end*/

/*@@caplFunc:CombinedNumbers_Request(byte,byte,byte,word,word,word):*///function
CombinedNumbers_Request(byte request, byte mode, byte recordaddress, word requested_startelement, word startelement, word elements)
{   
    int  i, j;
    byte shift, direction, transmitpos;
    dword requestarray [BAP_buffer_size];
    word indexsize, valid_startelement,Offset, current_line;
    byte empty_line_exists;

    //write("startelement = %d", startelement);

    // Init local variables. 
    for(i=0;i<BAP_buffer_size;i++)
	    requestarray [i]=0;

    empty_line_exists = 0;
    
    indexsize   =0;
    Offset      =0;
    valid_startelement=0;

    // decode "mode-byte"
    indexsize   =(mode &0x08)/0x08; 

    // Handle request.
    requestarray[0] =LSGID_Telephone;	    //LSG-ID
	requestarray[1] =FctID_CombinedNumbers;	//Fct.-ID
	requestarray[2] =request;               //request type

    switch(request)
	{
        case DataGet_REQ:              
                requestarray[3] =((gCombinedNumbers_ASGID *0x10) &0xF0) +(gCombinedNumbers_TAID &0x0F);

                /***ArrayHeader***/
			    requestarray[4] =((mode *0x10) &0xF0) +(recordaddress &0x0F);          
                Offset =5;

                if(indexsize)
                {
                    requestarray[Offset] =requested_startelement &0x00FF;
                    Offset++;
                    requestarray[Offset] =(requested_startelement &0xFF00) /0x100;
                    Offset++;  

                    requestarray[Offset] =elements &0x00FF;
                    Offset++;
                    requestarray[Offset] =(elements &0xFF00) /0x100;
                    Offset++;       
                }
                else
                {
                    requestarray[Offset] =requested_startelement;
                    Offset++;

                    requestarray[Offset] =elements;
                    Offset++;

                }
            
            set_status_requestbuffer (requestarray, Offset, Bap_ByteSequence);
         break;
        case DataSetGet_REQ:
                requestarray[3] =((gCombinedNumbers_ASGID *0x10) &0xF0) +(gCombinedNumbers_TAID &0x0F);

                /***ArrayHeader***/
			    requestarray[4] =((mode *0x10) &0xF0) +(recordaddress &0x0F);          
                Offset =5;

                if(indexsize)
                {
                    requestarray[Offset] =requested_startelement &0x00FF;
                    Offset++;
                    requestarray[Offset] =(requested_startelement &0xFF00) /0x100;
                    Offset++;  

                    requestarray[Offset] =elements &0x00FF;
                    Offset++;
                    requestarray[Offset] =(elements &0xFF00) /0x100;
                    Offset++;       
                }
                else
                {
                    requestarray[Offset] =requested_startelement;
                    Offset++;

                    requestarray[Offset] =elements;
                    Offset++;
                }

                
                // decode "mode-byte"
                shift       =mode &0x01;
                direction   =(mode &0x02)/0x02;
                transmitpos =(mode &0x04)/0x04;
                indexsize   =(mode &0x08)/0x08;
                
                
                //for(i=0; i<9; i++)
                //    write("gCombinedNumbers_Pos[%d] = %d, gCombinedNumbers_ListEntryReceptionInformation[%d] = %d", i, gCombinedNumbers_Pos[i], i, gCombinedNumbers_ListEntryReceptionInformation[i]);

                //searching for valid 'current_element'
				for(i=6;i<9;i++)
				{
                    //write("gCombinedNumbers_Pos[%d] = %d", i, gCombinedNumbers_Pos[i]); 

					if((gCombinedNumbers_Pos[i] == startelement) && (gCombinedNumbers_ListEntryReceptionInformation[i] ==  1))				//found a valid element
					{                                          
                        if(shift==TRUE)											//shift is set, this means starting with the next/previous element (depending on the direction-setting)
                            current_line =CombinedNumbers_GetNextLineInCache(i, direction);
                        else
                            current_line =i;                              //found element is valid_startelement

						i = 9; // break
					}
                    else
                        current_line = 99;

                    if (i==8)
                        i =-1;
                        
                    if (i==5)
                        i=9; // break
				}

                //write("current_line = %d", current_line);

                     
                for(i=0; i<elements; i++)    
                {
                    //write("# i = %d, current_line = %d, recordaddress = %d, transmitpos = %d", i, current_line, recordaddress, transmitpos);
                    if(current_line <TEL_COMBINEDNUMBERS_ASGCACHE_MAX_SIZE) //current_element exists in ASG-array
                    {
                        //copy data
                        switch(recordaddress)
			            {
                            case 0: //complete record
                                if (transmitpos) // Pos  ->Array position transmitted
                                {
                                    if (indexsize)
                                    {
                                        requestarray[Offset] =(gCombinedNumbers_Pos[current_line] &0xFF);
                                        Offset++;
                                        requestarray[Offset] =((gCombinedNumbers_Pos[current_line]&0xFF00) /0x100);
                                        Offset++;
                                    }
                                    else
                                    {
                                        requestarray[Offset] =gCombinedNumbers_Pos[current_line];
                                        Offset++;
                                    }
                                }
                                                                                              
                                //PbName
                                requestarray[Offset] =strlen(gCombinedNumbers_PbName[current_line]);
                                Offset++;
                                
                                //write("# 005: gCombinedNumbers_PbName  a");
                                for(j=0;j<strlen(gCombinedNumbers_PbName[current_line]);j++)
                    			{
			                        requestarray[Offset] =gCombinedNumbers_PbName[current_line][j];	
			                        Offset++;
			                    }
                                //write("# 005: gCombinedNumbers_PbName  b");

                                
                                //CallMode
                                requestarray[Offset] =gCombinedNumbers_CallMode[current_line];
                                Offset++;

                                //TelNumber
                                requestarray[Offset] =strlen(gCombinedNumbers_TelNumber[current_line]);
                                Offset++;
                                
                                //write("# 006: gCombinedNumbers_TelNumber  a");
                                for(j=0;j<strlen(gCombinedNumbers_TelNumber[current_line]);j++)
                    			{
			                        requestarray[Offset] =gCombinedNumbers_TelNumber[current_line][j];	
			                        Offset++;
			                    }
                                //write("# 006: gCombinedNumbers_TelNumber  b");

                                //Day
                                requestarray[Offset] =gCombinedNumbers_day[current_line];
                                Offset++;

                                //Month
                                requestarray[Offset] =gCombinedNumbers_month[current_line];
                                Offset++;

                                //Year
                                requestarray[Offset] =gCombinedNumbers_year[current_line];
                                Offset++;

                                //Hour
                                requestarray[Offset] =gCombinedNumbers_hour[current_line];
                                Offset++;

                                //Minute
                                requestarray[Offset] =gCombinedNumbers_minute[current_line];
                                Offset++;

                                //Second
                                requestarray[Offset] =gCombinedNumbers_second[current_line];
                                Offset++;   
                        
                            break;

                            case 1: //PbName, CallMode
                                if (transmitpos) // Pos  ->Array position transmitted
                                {
                                    if (indexsize)
                                    {
                                        requestarray[Offset] =(gCombinedNumbers_Pos[current_line] &0xFF);
                                        Offset++;
                                        requestarray[Offset] =((gCombinedNumbers_Pos[current_line]&0xFF00) /0x100);
                                        Offset++;
                                    }
                                    else
                                    {
                                        requestarray[Offset] =gCombinedNumbers_Pos[current_line];
                                        Offset++;
                                    }
                                }
                                                                                              
                                //PbName
                                requestarray[Offset] =strlen(gCombinedNumbers_PbName[current_line]);
                                Offset++;
                                
                                for(j=0;j<strlen(gCombinedNumbers_PbName[current_line]);j++)
                    			{
			                        requestarray[Offset] =gCombinedNumbers_PbName[current_line][j];	
			                        Offset++;
			                    }
                                
                                //CallMode
                                requestarray[Offset] =gCombinedNumbers_CallMode[current_line];
                                Offset++; 
                                
                            break;

                            case 2: //TelNumber, Day, Month, Year, Hour, Minute, Second
                                if (transmitpos) // Pos  ->Array position transmitted
                                {
                                    if (indexsize)
                                    {
                                        requestarray[Offset] =(gCombinedNumbers_Pos[current_line] &0xFF);
                                        Offset++;
                                        requestarray[Offset] =((gCombinedNumbers_Pos[current_line]&0xFF00) /0x100);
                                        Offset++;
                                    }
                                    else
                                    {
                                        requestarray[Offset] =gCombinedNumbers_Pos[current_line];
                                        Offset++;
                                    }
                                }
                                                                                              
                                //TelNumber
                                requestarray[Offset] =strlen(gCombinedNumbers_TelNumber[current_line]);
                                Offset++;
                                
                                for(j=0;j<strlen(gCombinedNumbers_TelNumber[current_line]);j++)
                    			{
			                        requestarray[Offset] =gCombinedNumbers_TelNumber[current_line][j];	
			                        Offset++;
			                    }

                                //Day
                                requestarray[Offset] =gCombinedNumbers_day[current_line];
                                Offset++;

                                //Month
                                requestarray[Offset] =gCombinedNumbers_month[current_line];
                                Offset++;

                                //Year
                                requestarray[Offset] =gCombinedNumbers_year[current_line];
                                Offset++;

                                //Hour
                                requestarray[Offset] =gCombinedNumbers_hour[current_line];
                                Offset++;

                                //Minute
                                requestarray[Offset] =gCombinedNumbers_minute[current_line];
                                Offset++;

                                //Second
                                requestarray[Offset] =gCombinedNumbers_second[current_line];
                                Offset++;  
                             break;

                            case 15: //Pos
                                if (transmitpos) // Pos  ->Array position transmitted
                                {
                                    if (indexsize)
                                    {
                                        requestarray[Offset] =(gCombinedNumbers_Pos[current_line] &0xFF);
                                        Offset++;
                                        requestarray[Offset] =((gCombinedNumbers_Pos[current_line]&0xFF00) /0x100);
                                        Offset++;
                                    }
                                    else
                                    {
                                        requestarray[Offset] =gCombinedNumbers_Pos[current_line];
                                        Offset++;
                                    }
                                }
                                                                                               
                             break;
                            default:
                             break;
                        }// end 'switch'
                        

                        current_line =CombinedNumbers_GetNextLineInCache(current_line, direction); //next line

                    }//end 'if'                    
                    else
                    {   
                        write("current_element does not exist in ASG-array");
                        i =elements; // break
                    }
                }//end 'for'

                set_status_requestbuffer (requestarray, Offset, Bap_ByteSequence);
        break;

        default:	
			writelineEx(gError_Trace, 0, "ASG-Telephone CombinedNumbers_Request: invalid request %d", request);
		break;
    }
}
/*@@end*/

/*@@caplFunc:CombinedNumbers_GetNextCachedElement(int,byte):*///function
int CombinedNumbers_GetNextCachedElement (int currentElement,byte direction)
{
    int i=0, nextElement=0;

    switch (direction)
    {
        case TEL_COMBINEDNUMBERS_DISPLAYLIST_FIND_NEXT_ELEMENT:                
                nextElement = ++currentElement;

                if (nextElement<TEL_COMBINEDNUMBERS_ASGCACHE_MAX_SIZE) //start at next element, if next element is not >8
                {
                    for(i =nextElement; i<TEL_COMBINEDNUMBERS_ASGCACHE_MAX_SIZE;i++)
                    {
                        if(gCombinedNumbers_ListEntryReceptionInformation[i] ==TRUE)
                        {   
                            nextElement =i; 
                            i= TEL_COMBINEDNUMBERS_ASGCACHE_MAX_SIZE;
                        }
                        else
                            nextElement =0;
                    }
                }
                else    //start at first element
                {
                    nextElement =0;

                    for(i =nextElement; i<TEL_COMBINEDNUMBERS_ASGCACHE_MAX_SIZE;i++)
                    {
                        if(gCombinedNumbers_ListEntryReceptionInformation[i] ==TRUE)
                        {   
                            nextElement =i; 
                            i =TEL_COMBINEDNUMBERS_ASGCACHE_MAX_SIZE;
                        }   
                    }
                }
        break;

        case TEL_COMBINEDNUMBERS_DISPLAYLIST_FIND_PREVIUOS_ELEMENT:
                nextElement = --currentElement;
                if (nextElement ==0 && gCombinedNumbers_ListEntryReceptionInformation[nextElement] ==TRUE)
                    nextElement =0;
                else if (nextElement>0) 
                {
                    for(i =nextElement; i>0; i--)
                    {
                        if(gCombinedNumbers_ListEntryReceptionInformation[i] ==TRUE)
                        {   
                            nextElement =i; 
                            i =0;
                        }
                        else
                            nextElement =TEL_COMBINEDNUMBERS_ASGCACHE_MAX_SIZE-1;
                    }
                }    
                else    //start at last element
                {
                    nextElement =TEL_COMBINEDNUMBERS_ASGCACHE_MAX_SIZE-1;

                    for(i =nextElement; i>0; i--)
                    {
                        if(gCombinedNumbers_ListEntryReceptionInformation[i] ==TRUE)
                        {   
                            nextElement =i; 
                            i =0;
                        }
                        else if(gCombinedNumbers_ListEntryReceptionInformation[0] ==TRUE)
                            nextElement =0;          
                    }
                }
        break;

        default:
        break;
    }
    return(nextElement);
}
/*@@end*/

/*@@caplFunc:CombinedNumbers_GetNextLineInCache(int,byte):*///function
int CombinedNumbers_GetNextLineInCache (int currentElement,byte direction)
{
    int i=0, nextElement=0;

    // elements: 6 7 8 | 0 1 2 | 3 4 5
    switch (direction)
    {
        case FORWARD:
                           
                if(currentElement<TEL_COMBINEDNUMBERS_ASGCACHE_MAX_SIZE-1 && currentElement !=5) 
                    nextElement = ++currentElement;  
                
                else if (currentElement ==8)            
                    nextElement =0;
                else
                    nextElement =TEL_COMBINEDNUMBERS_NO_NEXT_POSITION;
        break;

        case BACKWARD:
                if(currentElement<TEL_COMBINEDNUMBERS_ASGCACHE_MAX_SIZE && currentElement !=0 && currentElement !=6) 
                    nextElement =--currentElement;
                
                else if (currentElement ==0)            
                    nextElement =8;
                
                else
                    nextElement =TEL_COMBINEDNUMBERS_NO_NEXT_POSITION;
        break;

        default:
        break;
    }
    return(nextElement);
}
/*@@end*/

/*@@caplFunc:CombinedNumbers_display():*///function
CombinedNumbers_display()
{   
    int Element_1 =0, Element_2 =1, Element_3 =2;

    if(Power_on==gRNS_PowerOnOff && getvalue(env_ASG_CN_OnOff))
	{   
        /******'sliding window' not active******/         
        if(gCombinedNumbers_DisplayStatus ==TEL_COMBINEDNUMBERS_DISPLAYLIST_SEARCH_ELEMENTS)
        {
            //1. Element              
            if(gCombinedNumbers_CursorAction ==TEL_COMBINEDNUMBERS_CURSORACTION_DOWN)
                Element_1 =CombinedNumbers_GetNextCachedElement(gCombinedNumbers_LastFirstElement, TEL_COMBINEDNUMBERS_DISPLAYLIST_FIND_NEXT_ELEMENT);
            
            else if(gCombinedNumbers_CursorAction ==TEL_COMBINEDNUMBERS_CURSORACTION_UP)            
                Element_1 =CombinedNumbers_GetNextCachedElement(gCombinedNumbers_LastFirstElement, TEL_COMBINEDNUMBERS_DISPLAYLIST_FIND_PREVIUOS_ELEMENT);

            if(gCombinedNumbers_Pos[Element_1] ==gCombinedNumbers_FirstElement)
            {   
                putvalue(env_ASG_CN_ListInfo_up,"first element");
                                
                gCombinedNumbers_MoveList_up_allowed =FALSE;
            }
            else
            {
                putvalue(env_ASG_CN_ListInfo_up,empty_string);
                                
                gCombinedNumbers_MoveList_up_allowed =TRUE;
            }  

            //Pos
            putvalue(env_ASG_CN_pos_0, gCombinedNumbers_Pos[Element_1]);               
            
            //PbName
            if (gCombinedNumbers_recordaddress ==0 || gCombinedNumbers_recordaddress ==1)
                putvalue(env_ASG_CN_PbName_s_0,gCombinedNumbers_PbName[Element_1]);

            //CallMode
            if (gCombinedNumbers_recordaddress ==0 || gCombinedNumbers_recordaddress ==1) 
            {
                putvalue(env_ASG_CN_CallMode_0, gCombinedNumbers_CallMode[Element_1]);

                if(gCombinedNumbers_CallMode[Element_1] <0x4)
                    putvalue(env_ASG_CN_CallMode_s_0,gCombinedNumbers_CallMode_s[gCombinedNumbers_CallMode[Element_1]]);
                else
                    putvalue(env_ASG_CN_CallMode_s_0,gstring_reserved);
            }
            
            //TelNumber
            if (gCombinedNumbers_recordaddress ==0 || gCombinedNumbers_recordaddress ==2)
                putvalue(env_ASG_CN_TelNum_s_0,gCombinedNumbers_TelNumber[Element_1]);

            //Day
            if (gCombinedNumbers_recordaddress ==0 || gCombinedNumbers_recordaddress ==2)
                putvalue(env_ASG_CN_day_0,gCombinedNumbers_day[Element_1]);

            //Month
            if (gCombinedNumbers_recordaddress ==0 || gCombinedNumbers_recordaddress ==2)
                putvalue(env_ASG_CN_month_0,gCombinedNumbers_month[Element_1]);
            
            //Year
            if (gCombinedNumbers_recordaddress ==0 || gCombinedNumbers_recordaddress ==2)
                putvalue(env_ASG_CN_year_0,gCombinedNumbers_year[Element_1]);

            //Hour
            if (gCombinedNumbers_recordaddress ==0 || gCombinedNumbers_recordaddress ==2)
                putvalue(env_ASG_CN_hour_0,gCombinedNumbers_hour[Element_1]);
            
            //Minute
            if (gCombinedNumbers_recordaddress ==0 || gCombinedNumbers_recordaddress ==2)
                putvalue(env_ASG_CN_minute_0,gCombinedNumbers_minute[Element_1]);

            //Second
            if (gCombinedNumbers_recordaddress ==0 || gCombinedNumbers_recordaddress ==2)
                putvalue(env_ASG_CN_second_0,gCombinedNumbers_second[Element_1]);
            
            gCombinedNumbers_LastFirstElement =Element_1;
            
            
            //2. Element             
            Element_2 =CombinedNumbers_GetNextCachedElement(Element_1, TEL_COMBINEDNUMBERS_DISPLAYLIST_FIND_NEXT_ELEMENT);
            
            if(gCombinedNumbers_Pos[Element_2] ==gCombinedNumbers_LastElement)
            {   
                putvalue(env_ASG_CN_ListInfo_Cursor,"last element");
                                
                gCombinedNumbers_MoveList_down_allowed =FALSE;               
            }
            else
            {
                putvalue(env_ASG_CN_ListInfo_Cursor,empty_string);
                                
                gCombinedNumbers_MoveList_down_allowed =TRUE;
            } 

            //Pos
            putvalue(env_ASG_CN_pos_1, gCombinedNumbers_Pos[Element_2]);               
            
            //PbName
            if (gCombinedNumbers_recordaddress ==0 || gCombinedNumbers_recordaddress ==1)
                putvalue(env_ASG_CN_PbName_s_1,gCombinedNumbers_PbName[Element_2]);

            //CallMode
            if (gCombinedNumbers_recordaddress ==0 || gCombinedNumbers_recordaddress ==1) 
            {
                putvalue(env_ASG_CN_CallMode_1, gCombinedNumbers_CallMode[Element_2]);

                if(gCombinedNumbers_CallMode[Element_2] <0x4)
                    putvalue(env_ASG_CN_CallMode_s_1,gCombinedNumbers_CallMode_s[gCombinedNumbers_CallMode[Element_2]]);
                else
                    putvalue(env_ASG_CN_CallMode_s_1,gstring_reserved);
            }
            
            //TelNumber
            if (gCombinedNumbers_recordaddress ==0 || gCombinedNumbers_recordaddress ==2)
                putvalue(env_ASG_CN_TelNum_s_1,gCombinedNumbers_TelNumber[Element_2]);

            //Day
            if (gCombinedNumbers_recordaddress ==0 || gCombinedNumbers_recordaddress ==2)
                putvalue(env_ASG_CN_day_1,gCombinedNumbers_day[Element_2]);

            //Month
            if (gCombinedNumbers_recordaddress ==0 || gCombinedNumbers_recordaddress ==2)
                putvalue(env_ASG_CN_month_1,gCombinedNumbers_month[Element_2]);
            
            //Year
            if (gCombinedNumbers_recordaddress ==0 || gCombinedNumbers_recordaddress ==2)
                putvalue(env_ASG_CN_year_1,gCombinedNumbers_year[Element_2]);

            //Hour
            if (gCombinedNumbers_recordaddress ==0 || gCombinedNumbers_recordaddress ==2)
                putvalue(env_ASG_CN_hour_1,gCombinedNumbers_hour[Element_2]);
            
            //Minute
            if (gCombinedNumbers_recordaddress ==0 || gCombinedNumbers_recordaddress ==2)
                putvalue(env_ASG_CN_minute_1,gCombinedNumbers_minute[Element_2]);

            //Second
            if (gCombinedNumbers_recordaddress ==0 || gCombinedNumbers_recordaddress ==2)
                putvalue(env_ASG_CN_second_1,gCombinedNumbers_second[Element_2]);
             
            
            //3. Element          
            Element_3 =CombinedNumbers_GetNextCachedElement(Element_2, TEL_COMBINEDNUMBERS_DISPLAYLIST_FIND_NEXT_ELEMENT);

            if(gCombinedNumbers_Pos[Element_3] ==gCombinedNumbers_LastElement)
            {   
                putvalue(env_ASG_CN_ListInfo_down,"last element");
                                
                gCombinedNumbers_MoveList_down_allowed =FALSE;
            }
            else
            {
                putvalue(env_ASG_CN_ListInfo_down,empty_string);
                                
                gCombinedNumbers_MoveList_down_allowed =TRUE;
            } 

            //Pos
            putvalue(env_ASG_CN_pos_2, gCombinedNumbers_Pos[Element_3]);               
            
            //PbName
            if (gCombinedNumbers_recordaddress ==0 || gCombinedNumbers_recordaddress ==1)
                putvalue(env_ASG_CN_PbName_s_2,gCombinedNumbers_PbName[Element_3]);

            //CallMode
            if (gCombinedNumbers_recordaddress ==0 || gCombinedNumbers_recordaddress ==1) 
            {
                putvalue(env_ASG_CN_CallMode_2, gCombinedNumbers_CallMode[Element_3]);

                if(gCombinedNumbers_CallMode[Element_3] <0x4)
                    putvalue(env_ASG_CN_CallMode_s_2,gCombinedNumbers_CallMode_s[gCombinedNumbers_CallMode[Element_3]]);
                else
                    putvalue(env_ASG_CN_CallMode_s_2,gstring_reserved);
            }
            
            //TelNumber
            if (gCombinedNumbers_recordaddress ==0 || gCombinedNumbers_recordaddress ==2)
                putvalue(env_ASG_CN_TelNum_s_2,gCombinedNumbers_TelNumber[Element_3]);

            //Day
            if (gCombinedNumbers_recordaddress ==0 || gCombinedNumbers_recordaddress ==2)
                putvalue(env_ASG_CN_day_2,gCombinedNumbers_day[Element_3]);

            //Month
            if (gCombinedNumbers_recordaddress ==0 || gCombinedNumbers_recordaddress ==2)
                putvalue(env_ASG_CN_month_2,gCombinedNumbers_month[Element_3]);
            
            //Year
            if (gCombinedNumbers_recordaddress ==0 || gCombinedNumbers_recordaddress ==2)
                putvalue(env_ASG_CN_year_2,gCombinedNumbers_year[Element_3]);

            //Hour
            if (gCombinedNumbers_recordaddress ==0 || gCombinedNumbers_recordaddress ==2)
                putvalue(env_ASG_CN_hour_2,gCombinedNumbers_hour[Element_3]);
            
            //Minute
            if (gCombinedNumbers_recordaddress ==0 || gCombinedNumbers_recordaddress ==2)
                putvalue(env_ASG_CN_minute_2,gCombinedNumbers_minute[Element_3]);

            //Second
            if (gCombinedNumbers_recordaddress ==0 || gCombinedNumbers_recordaddress ==2)
                putvalue(env_ASG_CN_second_2,gCombinedNumbers_second[Element_3]);     
        }

        /******'sliding Window' active or 'build-up List'******/
        else if(gCombinedNumbers_DisplayStatus ==TEL_COMBINEDNUMBERS_DISPLAYLIST_FIRST_ELEMENTS) 
        {   
            //1. Element    
            if(gCombinedNumbers_ListEntryReceptionInformation [0] ==TRUE && getvalue(env_ASG_CN_OnOff))
            {   
                Element_1 =0;

                if(gCombinedNumbers_Pos[Element_1] ==gCombinedNumbers_FirstElement)
                {   
                    putvalue(env_ASG_CN_ListInfo_up,"first element");
                                        
                    gCombinedNumbers_MoveList_up_allowed =FALSE;
                }
                else 
                {   
                    putvalue(env_ASG_CN_ListInfo_up,empty_string);
                                        
                    gCombinedNumbers_MoveList_up_allowed =TRUE;
                }
                
                
                //Pos
                putvalue(env_ASG_CN_pos_0, gCombinedNumbers_Pos[Element_1]);               
            
                //PbName
                if (gCombinedNumbers_recordaddress ==0 || gCombinedNumbers_recordaddress ==1)
                    putvalue(env_ASG_CN_PbName_s_0,gCombinedNumbers_PbName[Element_1]);

                //CallMode
                if (gCombinedNumbers_recordaddress ==0 || gCombinedNumbers_recordaddress ==1) 
                {
                    putvalue(env_ASG_CN_CallMode_0, gCombinedNumbers_CallMode[Element_1]);

                    if(gCombinedNumbers_CallMode[Element_1] <0x4)
                        putvalue(env_ASG_CN_CallMode_s_0,gCombinedNumbers_CallMode_s[gCombinedNumbers_CallMode[Element_1]]);
                    else
                        putvalue(env_ASG_CN_CallMode_s_0,gstring_reserved);
                }
            
                //TelNumber
                if (gCombinedNumbers_recordaddress ==0 || gCombinedNumbers_recordaddress ==2)
                    putvalue(env_ASG_CN_TelNum_s_0,gCombinedNumbers_TelNumber[Element_1]);

                //Day
                if (gCombinedNumbers_recordaddress ==0 || gCombinedNumbers_recordaddress ==2)
                    putvalue(env_ASG_CN_day_0,gCombinedNumbers_day[Element_1]);

                //Month
                if (gCombinedNumbers_recordaddress ==0 || gCombinedNumbers_recordaddress ==2)
                    putvalue(env_ASG_CN_month_0,gCombinedNumbers_month[Element_1]);
            
                //Year
                if (gCombinedNumbers_recordaddress ==0 || gCombinedNumbers_recordaddress ==2)
                    putvalue(env_ASG_CN_year_0,gCombinedNumbers_year[Element_1]);

                //Hour
                if (gCombinedNumbers_recordaddress ==0 || gCombinedNumbers_recordaddress ==2)
                    putvalue(env_ASG_CN_hour_0,gCombinedNumbers_hour[Element_1]);
            
                //Minute
                if (gCombinedNumbers_recordaddress ==0 || gCombinedNumbers_recordaddress ==2)
                    putvalue(env_ASG_CN_minute_0,gCombinedNumbers_minute[Element_1]);

                //Second
                if (gCombinedNumbers_recordaddress ==0 || gCombinedNumbers_recordaddress ==2)
                    putvalue(env_ASG_CN_second_0,gCombinedNumbers_second[Element_1]);
            }


            //2. Element    
            if(gCombinedNumbers_ListEntryReceptionInformation [1] ==TRUE && getvalue(env_ASG_CN_OnOff))
            {
                Element_2 =1;
                
                if(gCombinedNumbers_Pos[Element_2] ==gCombinedNumbers_LastElement)
                {   
                    putvalue(env_ASG_CN_ListInfo_Cursor,"last element");
                                        
                    gCombinedNumbers_MoveList_down_allowed =FALSE;               
                }
                else
                {
                    putvalue(env_ASG_CN_ListInfo_Cursor,empty_string);
                                        
                    gCombinedNumbers_MoveList_down_allowed =TRUE;
                } 

                //Pos
                putvalue(env_ASG_CN_pos_1, gCombinedNumbers_Pos[Element_2]);               
            
                //PbName
                if (gCombinedNumbers_recordaddress ==0 || gCombinedNumbers_recordaddress ==1)
                    putvalue(env_ASG_CN_PbName_s_1,gCombinedNumbers_PbName[Element_2]);

                //CallMode
                if (gCombinedNumbers_recordaddress ==0 || gCombinedNumbers_recordaddress ==1) 
                {
                    putvalue(env_ASG_CN_CallMode_1, gCombinedNumbers_CallMode[Element_2]);

                    if(gCombinedNumbers_CallMode[Element_2] <0x4)
                        putvalue(env_ASG_CN_CallMode_s_1,gCombinedNumbers_CallMode_s[gCombinedNumbers_CallMode[Element_2]]);
                    
                    else
                        putvalue(env_ASG_CN_CallMode_s_1,gstring_reserved);
                }
                
                //TelNumber
                if (gCombinedNumbers_recordaddress ==0 || gCombinedNumbers_recordaddress ==2)
                    putvalue(env_ASG_CN_TelNum_s_1,gCombinedNumbers_TelNumber[Element_2]);

                //Day
                if (gCombinedNumbers_recordaddress ==0 || gCombinedNumbers_recordaddress ==2)
                    putvalue(env_ASG_CN_day_1,gCombinedNumbers_day[Element_2]);

                //Month
                if (gCombinedNumbers_recordaddress ==0 || gCombinedNumbers_recordaddress ==2)
                    putvalue(env_ASG_CN_month_1,gCombinedNumbers_month[Element_2]);
            
                //Year
                if (gCombinedNumbers_recordaddress ==0 || gCombinedNumbers_recordaddress ==2)
                    putvalue(env_ASG_CN_year_1,gCombinedNumbers_year[Element_2]);

                //Hour
                if (gCombinedNumbers_recordaddress ==0 || gCombinedNumbers_recordaddress ==2)
                    putvalue(env_ASG_CN_hour_1,gCombinedNumbers_hour[Element_2]);
            
                //Minute
                if (gCombinedNumbers_recordaddress ==0 || gCombinedNumbers_recordaddress ==2)
                    putvalue(env_ASG_CN_minute_1,gCombinedNumbers_minute[Element_2]);

                //Second
                if (gCombinedNumbers_recordaddress ==0 || gCombinedNumbers_recordaddress ==2)
                    putvalue(env_ASG_CN_second_1,gCombinedNumbers_second[Element_2]);
             }

            //3. Element    
            if(gCombinedNumbers_ListEntryReceptionInformation [2] ==TRUE && getvalue(env_ASG_CN_OnOff))
            {
                Element_3 =2;
                if(gCombinedNumbers_Pos[Element_3] ==gCombinedNumbers_LastElement)
                {   
                    putvalue(env_ASG_CN_ListInfo_down,"last element");
                                        
                    gCombinedNumbers_MoveList_down_allowed =FALSE;
                }
                
                else
                {
                    putvalue(env_ASG_CN_ListInfo_down,empty_string);
                                        
                    gCombinedNumbers_MoveList_down_allowed =TRUE;
                }   

                //Pos
                putvalue(env_ASG_CN_pos_2, gCombinedNumbers_Pos[Element_3]);               
            
                //PbName
                if (gCombinedNumbers_recordaddress ==0 || gCombinedNumbers_recordaddress ==1)
                    putvalue(env_ASG_CN_PbName_s_2,gCombinedNumbers_PbName[Element_3]);

                //CallMode
                if (gCombinedNumbers_recordaddress ==0 || gCombinedNumbers_recordaddress ==1) 
                {
                    putvalue(env_ASG_CN_CallMode_2, gCombinedNumbers_CallMode[Element_3]);

                    if(gCombinedNumbers_CallMode[Element_3] <0x4)
                        putvalue(env_ASG_CN_CallMode_s_2,gCombinedNumbers_CallMode_s[gCombinedNumbers_CallMode[Element_3]]);
                    else
                        putvalue(env_ASG_CN_CallMode_s_2,gstring_reserved);
                }
            
                //TelNumber
                if (gCombinedNumbers_recordaddress ==0 || gCombinedNumbers_recordaddress ==2)
                    putvalue(env_ASG_CN_TelNum_s_2,gCombinedNumbers_TelNumber[Element_3]);

                //Day
                if (gCombinedNumbers_recordaddress ==0 || gCombinedNumbers_recordaddress ==2)
                    putvalue(env_ASG_CN_day_2,gCombinedNumbers_day[Element_3]);

                //Month
                if (gCombinedNumbers_recordaddress ==0 || gCombinedNumbers_recordaddress ==2)
                    putvalue(env_ASG_CN_month_2,gCombinedNumbers_month[Element_3]);
            
                //Year
                if (gCombinedNumbers_recordaddress ==0 || gCombinedNumbers_recordaddress ==2)
                    putvalue(env_ASG_CN_year_2,gCombinedNumbers_year[Element_3]);

                //Hour
                if (gCombinedNumbers_recordaddress ==0 || gCombinedNumbers_recordaddress ==2)
                    putvalue(env_ASG_CN_hour_2,gCombinedNumbers_hour[Element_3]);
            
                //Minute
                if (gCombinedNumbers_recordaddress ==0 || gCombinedNumbers_recordaddress ==2)
                    putvalue(env_ASG_CN_minute_2,gCombinedNumbers_minute[Element_3]);

                //Second
                if (gCombinedNumbers_recordaddress ==0 || gCombinedNumbers_recordaddress ==2)
                    putvalue(env_ASG_CN_second_2,gCombinedNumbers_second[Element_3]);    
            }

            CombinedNumbers_DisplayCache();
        }
        else if (gCombinedNumbers_DisplayStatus ==TEL_COMBINEDNUMBERS_DISPLAYLIST_REFRESH)
        {               
            //1. Element
            if(gCombinedNumbers_SlidingWindow_State ==TEL_COMBINEDNUMBERS_SLIDINGWINDOW_NOTACTIVE)
                Element_1 =gCombinedNumbers_LastFirstElement; 
            else
                Element_1 =0;

            if(gCombinedNumbers_Pos[Element_1] ==gCombinedNumbers_FirstElement)
            {   
                putvalue(env_ASG_CN_ListInfo_up,"first element");
                                
                gCombinedNumbers_MoveList_up_allowed =FALSE;
            }
            else 
            {
                putvalue(env_ASG_CN_ListInfo_up,empty_string);
                                
                gCombinedNumbers_MoveList_up_allowed =TRUE;
                gCombinedNumbers_UpCaching_required  =FALSE;
            } 

            //Pos
            putvalue(env_ASG_CN_pos_0, gCombinedNumbers_Pos[Element_1]);               
            
            //PbName
            if (gCombinedNumbers_recordaddress ==0 || gCombinedNumbers_recordaddress ==1)
                putvalue(env_ASG_CN_PbName_s_0,gCombinedNumbers_PbName[Element_1]);

            //CallMode
            if (gCombinedNumbers_recordaddress ==0 || gCombinedNumbers_recordaddress ==1) 
            {
                putvalue(env_ASG_CN_CallMode_0, gCombinedNumbers_CallMode[Element_1]);

                if(gCombinedNumbers_CallMode[Element_1] <0x4)
                    putvalue(env_ASG_CN_CallMode_s_0,gCombinedNumbers_CallMode_s[gCombinedNumbers_CallMode[Element_1]]);
                else
                    putvalue(env_ASG_CN_CallMode_s_0,gstring_reserved);
            }
            
            //TelNumber
            if (gCombinedNumbers_recordaddress ==0 || gCombinedNumbers_recordaddress ==2)
                putvalue(env_ASG_CN_TelNum_s_0,gCombinedNumbers_TelNumber[Element_1]);

            //Day
            if (gCombinedNumbers_recordaddress ==0 || gCombinedNumbers_recordaddress ==2)
                putvalue(env_ASG_CN_day_0,gCombinedNumbers_day[Element_1]);

            //Month
            if (gCombinedNumbers_recordaddress ==0 || gCombinedNumbers_recordaddress ==2)
                putvalue(env_ASG_CN_month_0,gCombinedNumbers_month[Element_1]);
            
            //Year
            if (gCombinedNumbers_recordaddress ==0 || gCombinedNumbers_recordaddress ==2)
                putvalue(env_ASG_CN_year_0,gCombinedNumbers_year[Element_1]);

            //Hour
            if (gCombinedNumbers_recordaddress ==0 || gCombinedNumbers_recordaddress ==2)
                putvalue(env_ASG_CN_hour_0,gCombinedNumbers_hour[Element_1]);
            
            //Minute
            if (gCombinedNumbers_recordaddress ==0 || gCombinedNumbers_recordaddress ==2)
                putvalue(env_ASG_CN_minute_0,gCombinedNumbers_minute[Element_1]);

            //Second
            if (gCombinedNumbers_recordaddress ==0 || gCombinedNumbers_recordaddress ==2)
                putvalue(env_ASG_CN_second_0,gCombinedNumbers_second[Element_1]);
            

            //2. Element             
            if(gCombinedNumbers_SlidingWindow_State ==TEL_COMBINEDNUMBERS_SLIDINGWINDOW_NOTACTIVE)
                Element_2 =CombinedNumbers_GetNextCachedElement(Element_1, TEL_COMBINEDNUMBERS_DISPLAYLIST_FIND_NEXT_ELEMENT);
            else
                Element_2 =1;

            if(gCombinedNumbers_ListEntryReceptionInformation[Element_2])
            {
                if(gCombinedNumbers_Pos[Element_2] ==gCombinedNumbers_LastElement)
                {   
                    putvalue(env_ASG_CN_ListInfo_Cursor,"last element");
                                        
                    gCombinedNumbers_MoveList_down_allowed =FALSE;               
                }
                else
                {
                    putvalue(env_ASG_CN_ListInfo_Cursor,empty_string);
                                        
                    gCombinedNumbers_MoveList_down_allowed =TRUE;
                } 

                //Pos
                putvalue(env_ASG_CN_pos_1, gCombinedNumbers_Pos[Element_2]);               
            
                //PbName
                if (gCombinedNumbers_recordaddress ==0 || gCombinedNumbers_recordaddress ==1)
                    putvalue(env_ASG_CN_PbName_s_1,gCombinedNumbers_PbName[Element_2]);

                //CallMode
                if (gCombinedNumbers_recordaddress ==0 || gCombinedNumbers_recordaddress ==1) 
                {
                    putvalue(env_ASG_CN_CallMode_1, gCombinedNumbers_CallMode[Element_2]);

                    if(gCombinedNumbers_CallMode[Element_2] <0x4)
                        putvalue(env_ASG_CN_CallMode_s_1,gCombinedNumbers_CallMode_s[gCombinedNumbers_CallMode[Element_2]]);
                    
                    else
                        putvalue(env_ASG_CN_CallMode_s_1,gstring_reserved);
                }
            
                //TelNumber
                if (gCombinedNumbers_recordaddress ==0 || gCombinedNumbers_recordaddress ==2)
                    putvalue(env_ASG_CN_TelNum_s_1,gCombinedNumbers_TelNumber[Element_2]);

                //Day
                if (gCombinedNumbers_recordaddress ==0 || gCombinedNumbers_recordaddress ==2)
                    putvalue(env_ASG_CN_day_1,gCombinedNumbers_day[Element_2]);

                //Month
                if (gCombinedNumbers_recordaddress ==0 || gCombinedNumbers_recordaddress ==2)
                    putvalue(env_ASG_CN_month_1,gCombinedNumbers_month[Element_2]);
            
                //Year
                if (gCombinedNumbers_recordaddress ==0 || gCombinedNumbers_recordaddress ==2)
                    putvalue(env_ASG_CN_year_1,gCombinedNumbers_year[Element_2]);

                //Hour
                if (gCombinedNumbers_recordaddress ==0 || gCombinedNumbers_recordaddress ==2)
                    putvalue(env_ASG_CN_hour_1,gCombinedNumbers_hour[Element_2]);
            
                //Minute
                if (gCombinedNumbers_recordaddress ==0 || gCombinedNumbers_recordaddress ==2)
                    putvalue(env_ASG_CN_minute_1,gCombinedNumbers_minute[Element_2]);

                //Second
                if (gCombinedNumbers_recordaddress ==0 || gCombinedNumbers_recordaddress ==2)
                    putvalue(env_ASG_CN_second_1,gCombinedNumbers_second[Element_2]);
            }

            //3. Element          
            if(gCombinedNumbers_SlidingWindow_State ==TEL_COMBINEDNUMBERS_SLIDINGWINDOW_NOTACTIVE)
                Element_3 =CombinedNumbers_GetNextCachedElement(Element_2, TEL_COMBINEDNUMBERS_DISPLAYLIST_FIND_NEXT_ELEMENT);
            else
                Element_3 =2;

            if(gCombinedNumbers_ListEntryReceptionInformation[Element_3])
            {    
                if(gCombinedNumbers_Pos[Element_3] ==gCombinedNumbers_LastElement)
                {   
                    putvalue(env_ASG_CN_ListInfo_down,"last element");
                                        
                    gCombinedNumbers_MoveList_down_allowed =FALSE;
                }
                else
                {
                    putvalue(env_ASG_CN_ListInfo_down,empty_string);
                    
                    gCombinedNumbers_MoveList_down_allowed =TRUE;
                } 

                //Pos
                putvalue(env_ASG_CN_pos_2, gCombinedNumbers_Pos[Element_3]);               
            
                //PbName
                if (gCombinedNumbers_recordaddress ==0 || gCombinedNumbers_recordaddress ==1)
                    putvalue(env_ASG_CN_PbName_s_2,gCombinedNumbers_PbName[Element_3]);

                //CallMode
                if (gCombinedNumbers_recordaddress ==0 || gCombinedNumbers_recordaddress ==1) 
                {
                    putvalue(env_ASG_CN_CallMode_2, gCombinedNumbers_CallMode[Element_3]);

                    if(gCombinedNumbers_CallMode[Element_3] <0x4)
                        putvalue(env_ASG_CN_CallMode_s_2,gCombinedNumbers_CallMode_s[gCombinedNumbers_CallMode[Element_3]]);
                    else
                        putvalue(env_ASG_CN_CallMode_s_2,gstring_reserved);
                }
            
                //TelNumber
                if (gCombinedNumbers_recordaddress ==0 || gCombinedNumbers_recordaddress ==2)
                    putvalue(env_ASG_CN_TelNum_s_2,gCombinedNumbers_TelNumber[Element_3]);

                //Day
                if (gCombinedNumbers_recordaddress ==0 || gCombinedNumbers_recordaddress ==2)
                    putvalue(env_ASG_CN_day_2,gCombinedNumbers_day[Element_3]);

                //Month
                if (gCombinedNumbers_recordaddress ==0 || gCombinedNumbers_recordaddress ==2)
                    putvalue(env_ASG_CN_month_2,gCombinedNumbers_month[Element_3]);
            
                //Year
                if (gCombinedNumbers_recordaddress ==0 || gCombinedNumbers_recordaddress ==2)
                    putvalue(env_ASG_CN_year_2,gCombinedNumbers_year[Element_3]);

                //Hour
                if (gCombinedNumbers_recordaddress ==0 || gCombinedNumbers_recordaddress ==2)
                    putvalue(env_ASG_CN_hour_2,gCombinedNumbers_hour[Element_3]);
            
                //Minute
                if (gCombinedNumbers_recordaddress ==0 || gCombinedNumbers_recordaddress ==2)
                    putvalue(env_ASG_CN_minute_2,gCombinedNumbers_minute[Element_3]);

                //Second
                if (gCombinedNumbers_recordaddress ==0 || gCombinedNumbers_recordaddress ==2)
                    putvalue(env_ASG_CN_second_2,gCombinedNumbers_second[Element_3]); 
            }

            CombinedNumbers_DisplayCache();
        }
    }
}
/*@@end*/

/*@@envVar:env_ASG_CN_GetArray:*/
on envVar env_ASG_CN_GetArray
{
    byte mode, shift, direction, transmitpos, indexsize,recordaddress;
    word requested_startelement, startelement, elements;

    // Init local variables. 
    mode                    =0;
    shift                   =0;
    direction               =0;
    transmitpos             =0;
    indexsize               =0;
    recordaddress           =0;
    requested_startelement  =0;
    startelement            =0;
    elements                =0;

    if(gRNS_PowerOnOff==Power_on && getvalue(this) && gCombinedNumbers_ListHandlingType ==TEL_COMBINEDNUMBERS_NOCACHE)
	{
        gCombinedNumbers_ASGID            =getvalue(env_ASG_CN_ASGID);
        gCombinedNumbers_TAID             =getvalue(env_ASG_CN_TAID);

        shift                           =getvalue(env_ASG_CN_AH_shift);
        direction                       =getvalue(env_ASG_CN_AH_dir);
        transmitpos                     =getvalue(env_ASG_CN_AH_PosTrans);
        indexsize                       =getvalue(env_ASG_CN_AH_IS);
        recordaddress                   =getvalue(env_ASG_CN_AH_RA);
        startelement                    =getvalue(env_ASG_CN_AH_start);
        elements                        =getvalue(env_ASG_CN_AH_elements);
        
        requested_startelement  =startelement;
        mode                    =shift +(direction*0x02) +(transmitpos*0x04) +indexsize*0x08;

        CombinedNumbers_Request(DataGet_REQ, mode, recordaddress, requested_startelement, startelement, elements);
    }
}
/*@@end*/

/*@@envVar:env_ASG_CN_OnOff:*/
on envVar env_ASG_CN_OnOff
{
    int i =0, j =0;
    if(gRNS_PowerOnOff==Power_on)
	{   
        if(getvalue(this))
        {
            gCombinedNumbers_ListHandlingType      =TEL_COMBINEDNUMBERS_BUILDUPCACHE;             //build-up complete cache...
            gCombinedNumbers_cacheBuildUp          =TEL_COMBINEDNUMBERS_BUILDUPCACHECACHE_WINDOW; //...and start with area "window"            
            gCombinedNumbers_UpCaching_required    =TRUE;
            gCombinedNumbers_DownCaching_required  =TRUE;
            gCombinedNumbers_MoveList_down_allowed =TRUE;
            gCombinedNumbers_MoveList_up_allowed   =FALSE; 

            CombinedNumbers_ListHandling ();

        }
        else
        {
            gCombinedNumbers_SlidingWindow_State   =TEL_COMBINEDNUMBERS_SLIDINGWINDOW_NOTACTIVE;
            gCombinedNumbers_ListHandlingType      =TEL_COMBINEDNUMBERS_NOCACHE;
            gCombinedNumbers_cacheBuildUp          =TEL_COMBINEDNUMBERS_BUILDUPCACHENOCACHE;
            gCombinedNumbers_CallBackReason        =TEL_COMBINEDNUMBERS_CALLBACKREASON_NOCALLBACK;

            gCombinedNumbers_cacheDown             =FALSE;
            gCombinedNumbers_cacheUp               =FALSE;
            gCombinedNumbers_LastFirstElement      =0;

            gCombinedNumbers_recordaddress         =0;
            gCombinedNumbers_transmitpos           =1;
            gCombinedNumbers_CursorAction          =TEL_COMBINEDNUMBERS_CURSORACTION_NOTHING;
            gCombinedNumbers_DisplayStatus         =TEL_COMBINEDNUMBERS_DISPLAYLIST_FIRST_ELEMENTS;
            
            gCombinedNumbers_LastElement           =0;
            gCombinedNumbers_FirstElement          =0;
            gCombinedNumbers_DownCaching_required  =FALSE;
            gCombinedNumbers_UpCaching_required    =FALSE; 
            gCombinedNumbers_MoveList_down_allowed =FALSE; 
            gCombinedNumbers_MoveList_up_allowed   =FALSE;

            for(j=0; j<TEL_COMBINEDNUMBERS_ASGCACHE_MAX_SIZE; j++)
            {     
                gCombinedNumbers_Pos[j]                 =0;
                gCombinedNumbers_CallMode[j]            =0;
                gCombinedNumbers_day[j]                 =0;
                gCombinedNumbers_month[j]               =0;
                gCombinedNumbers_year[j]                =0;
                gCombinedNumbers_hour[j]                =0;
                gCombinedNumbers_minute[j]              =0;
                gCombinedNumbers_second[j]              =0;
                
                gCombinedNumbers_ListEntryReceptionInformation[j]  =0;

                for(i=0;i<TEL_COMBINEDNUMBERS_PBNAME_LENGTH;i++)
			        gCombinedNumbers_PbName[j][i] =0;
                
                for(i=0;i<TEL_COMBINEDNUMBERS_TELNUMBER_LENGTH;i++)
			        gCombinedNumbers_TelNumber[j][i] =0;
            }
            putvalue(env_ASG_CN_pos_0, 0);
            putvalue(env_ASG_CN_pos_1, 0);
            putvalue(env_ASG_CN_pos_2, 0);
    
            putvalue(env_ASG_CN_CallMode_0, 0);
            putvalue(env_ASG_CN_CallMode_1, 0);
            putvalue(env_ASG_CN_CallMode_2, 0);

            putvalue(env_ASG_CN_CallMode_s_0,empty_string);
            putvalue(env_ASG_CN_CallMode_s_1,empty_string);
            putvalue(env_ASG_CN_CallMode_s_2,empty_string);

            putvalue(env_ASG_CN_PbName_s_0, empty_string);
            putvalue(env_ASG_CN_PbName_s_1, empty_string);
            putvalue(env_ASG_CN_PbName_s_2, empty_string);

            putvalue(env_ASG_CN_TelNum_s_0, empty_string);
            putvalue(env_ASG_CN_TelNum_s_1, empty_string);
            putvalue(env_ASG_CN_TelNum_s_2, empty_string);

            putvalue(env_ASG_CN_day_0, 0);
            putvalue(env_ASG_CN_day_1, 0);
            putvalue(env_ASG_CN_day_2, 0);

            putvalue(env_ASG_CN_month_0, 0);
            putvalue(env_ASG_CN_month_1, 0);
            putvalue(env_ASG_CN_month_2, 0);

            putvalue(env_ASG_CN_year_0, 0);
            putvalue(env_ASG_CN_year_1, 0);
            putvalue(env_ASG_CN_year_2, 0);

            putvalue(env_ASG_CN_hour_0, 0);
            putvalue(env_ASG_CN_hour_1, 0);
            putvalue(env_ASG_CN_hour_2, 0);

            putvalue(env_ASG_CN_minute_0, 0);
            putvalue(env_ASG_CN_minute_1, 0);
            putvalue(env_ASG_CN_minute_2, 0);

            putvalue(env_ASG_CN_second_0, 0);
            putvalue(env_ASG_CN_second_1, 0);
            putvalue(env_ASG_CN_second_2, 0);
            
            
            putvalue(env_ASG_CN_pos_01, 0);
            putvalue(env_ASG_CN_PbName_s_01, empty_string);
            putvalue(env_ASG_CN_TelNum_s_01, empty_string);
            putvalue(env_ASG_CN_CallMode_01, 0);
            putvalue(env_ASG_CN_day_01, 0);
            putvalue(env_ASG_CN_month_01, 0);
            putvalue(env_ASG_CN_year_01, 0);
            putvalue(env_ASG_CN_hour_01, 0);
            putvalue(env_ASG_CN_minute_01, 0);
            putvalue(env_ASG_CN_second_01, 0);

            enableControl("ASG_Telephone_0x31 - CombinedNumbers_EditCache", "env_ASG_CN_pos_01", 0);
            enableControl("ASG_Telephone_0x31 - CombinedNumbers_EditCache", "env_ASG_CN_PbName_s_01", 0);
            enableControl("ASG_Telephone_0x31 - CombinedNumbers_EditCache", "env_ASG_CN_TelNum_s_01", 0);
            enableControl("ASG_Telephone_0x31 - CombinedNumbers_EditCache", "env_ASG_CN_CallMode_01", 0);
            enableControl("ASG_Telephone_0x31 - CombinedNumbers_EditCache", "env_ASG_CN_day_01", 0);
            enableControl("ASG_Telephone_0x31 - CombinedNumbers_EditCache", "env_ASG_CN_month_01", 0);
            enableControl("ASG_Telephone_0x31 - CombinedNumbers_EditCache", "env_ASG_CN_year_01", 0);
            enableControl("ASG_Telephone_0x31 - CombinedNumbers_EditCache", "env_ASG_CN_hour_01", 0);
            enableControl("ASG_Telephone_0x31 - CombinedNumbers_EditCache", "env_ASG_CN_minute_01", 0);
            enableControl("ASG_Telephone_0x31 - CombinedNumbers_EditCache", "env_ASG_CN_second_01", 0);
        
            
            putvalue(env_ASG_CN_pos_02, 0);
            putvalue(env_ASG_CN_PbName_s_02, empty_string);
            putvalue(env_ASG_CN_TelNum_s_02, empty_string);
            putvalue(env_ASG_CN_CallMode_02, 0);
            putvalue(env_ASG_CN_day_02, 0);
            putvalue(env_ASG_CN_month_02, 0);
            putvalue(env_ASG_CN_year_02, 0);
            putvalue(env_ASG_CN_hour_02, 0);
            putvalue(env_ASG_CN_minute_02, 0);
            putvalue(env_ASG_CN_second_02, 0);

            enableControl("ASG_Telephone_0x31 - CombinedNumbers_EditCache", "env_ASG_CN_pos_02", 0);
            enableControl("ASG_Telephone_0x31 - CombinedNumbers_EditCache", "env_ASG_CN_PbName_s_02", 0);
            enableControl("ASG_Telephone_0x31 - CombinedNumbers_EditCache", "env_ASG_CN_TelNum_s_02", 0);
            enableControl("ASG_Telephone_0x31 - CombinedNumbers_EditCache", "env_ASG_CN_CallMode_02", 0);
            enableControl("ASG_Telephone_0x31 - CombinedNumbers_EditCache", "env_ASG_CN_day_02", 0);
            enableControl("ASG_Telephone_0x31 - CombinedNumbers_EditCache", "env_ASG_CN_month_02", 0);
            enableControl("ASG_Telephone_0x31 - CombinedNumbers_EditCache", "env_ASG_CN_year_02", 0);
            enableControl("ASG_Telephone_0x31 - CombinedNumbers_EditCache", "env_ASG_CN_hour_02", 0);
            enableControl("ASG_Telephone_0x31 - CombinedNumbers_EditCache", "env_ASG_CN_minute_02", 0);
            enableControl("ASG_Telephone_0x31 - CombinedNumbers_EditCache", "env_ASG_CN_second_02", 0);
        

            putvalue(env_ASG_CN_pos_03, 0);
            putvalue(env_ASG_CN_PbName_s_03, empty_string);
            putvalue(env_ASG_CN_TelNum_s_03, empty_string);
            putvalue(env_ASG_CN_CallMode_03, 0);
            putvalue(env_ASG_CN_day_03, 0);
            putvalue(env_ASG_CN_month_03, 0);
            putvalue(env_ASG_CN_year_03, 0);
            putvalue(env_ASG_CN_hour_03, 0);
            putvalue(env_ASG_CN_minute_03, 0);
            putvalue(env_ASG_CN_second_03, 0);

            enableControl("ASG_Telephone_0x31 - CombinedNumbers_EditCache", "env_ASG_CN_pos_03", 0);
            enableControl("ASG_Telephone_0x31 - CombinedNumbers_EditCache", "env_ASG_CN_PbName_s_03", 0);
            enableControl("ASG_Telephone_0x31 - CombinedNumbers_EditCache", "env_ASG_CN_TelNum_s_03", 0);
            enableControl("ASG_Telephone_0x31 - CombinedNumbers_EditCache", "env_ASG_CN_CallMode_03", 0);
            enableControl("ASG_Telephone_0x31 - CombinedNumbers_EditCache", "env_ASG_CN_day_03", 0);
            enableControl("ASG_Telephone_0x31 - CombinedNumbers_EditCache", "env_ASG_CN_month_03", 0);
            enableControl("ASG_Telephone_0x31 - CombinedNumbers_EditCache", "env_ASG_CN_year_03", 0);
            enableControl("ASG_Telephone_0x31 - CombinedNumbers_EditCache", "env_ASG_CN_hour_03", 0);
            enableControl("ASG_Telephone_0x31 - CombinedNumbers_EditCache", "env_ASG_CN_minute_03", 0);
            enableControl("ASG_Telephone_0x31 - CombinedNumbers_EditCache", "env_ASG_CN_second_03", 0);
        

            putvalue(env_ASG_CN_pos_11, 0);
            putvalue(env_ASG_CN_PbName_s_11, empty_string);
            putvalue(env_ASG_CN_TelNum_s_11, empty_string);
            putvalue(env_ASG_CN_CallMode_11, 0);
            putvalue(env_ASG_CN_day_11, 0);
            putvalue(env_ASG_CN_month_11, 0);
            putvalue(env_ASG_CN_year_11, 0);
            putvalue(env_ASG_CN_hour_11, 0);
            putvalue(env_ASG_CN_minute_11, 0);
            putvalue(env_ASG_CN_second_11, 0);

            enableControl("ASG_Telephone_0x31 - CombinedNumbers_EditCache", "env_ASG_CN_pos_11", 0);
            enableControl("ASG_Telephone_0x31 - CombinedNumbers_EditCache", "env_ASG_CN_PbName_s_11", 0);
            enableControl("ASG_Telephone_0x31 - CombinedNumbers_EditCache", "env_ASG_CN_TelNum_s_11", 0);
            enableControl("ASG_Telephone_0x31 - CombinedNumbers_EditCache", "env_ASG_CN_CallMode_11", 0);
            enableControl("ASG_Telephone_0x31 - CombinedNumbers_EditCache", "env_ASG_CN_day_11", 0);
            enableControl("ASG_Telephone_0x31 - CombinedNumbers_EditCache", "env_ASG_CN_month_11", 0);
            enableControl("ASG_Telephone_0x31 - CombinedNumbers_EditCache", "env_ASG_CN_year_11", 0);
            enableControl("ASG_Telephone_0x31 - CombinedNumbers_EditCache", "env_ASG_CN_hour_11", 0);
            enableControl("ASG_Telephone_0x31 - CombinedNumbers_EditCache", "env_ASG_CN_minute_11", 0);
            enableControl("ASG_Telephone_0x31 - CombinedNumbers_EditCache", "env_ASG_CN_second_11", 0);
   
            
            putvalue(env_ASG_CN_pos_12, 0);
            putvalue(env_ASG_CN_PbName_s_12, empty_string);
            putvalue(env_ASG_CN_TelNum_s_12, empty_string);
            putvalue(env_ASG_CN_CallMode_12, 0);
            putvalue(env_ASG_CN_day_12, 0);
            putvalue(env_ASG_CN_month_12, 0);
            putvalue(env_ASG_CN_year_12, 0);
            putvalue(env_ASG_CN_hour_12, 0);
            putvalue(env_ASG_CN_minute_12, 0);
            putvalue(env_ASG_CN_second_12, 0);

            enableControl("ASG_Telephone_0x31 - CombinedNumbers_EditCache", "env_ASG_CN_pos_12", 0);
            enableControl("ASG_Telephone_0x31 - CombinedNumbers_EditCache", "env_ASG_CN_PbName_s_12", 0);
            enableControl("ASG_Telephone_0x31 - CombinedNumbers_EditCache", "env_ASG_CN_TelNum_s_12", 0);
            enableControl("ASG_Telephone_0x31 - CombinedNumbers_EditCache", "env_ASG_CN_CallMode_12", 0);
            enableControl("ASG_Telephone_0x31 - CombinedNumbers_EditCache", "env_ASG_CN_day_12", 0);
            enableControl("ASG_Telephone_0x31 - CombinedNumbers_EditCache", "env_ASG_CN_month_12", 0);
            enableControl("ASG_Telephone_0x31 - CombinedNumbers_EditCache", "env_ASG_CN_year_12", 0);
            enableControl("ASG_Telephone_0x31 - CombinedNumbers_EditCache", "env_ASG_CN_hour_12", 0);
            enableControl("ASG_Telephone_0x31 - CombinedNumbers_EditCache", "env_ASG_CN_minute_12", 0);
            enableControl("ASG_Telephone_0x31 - CombinedNumbers_EditCache", "env_ASG_CN_second_12", 0);


            putvalue(env_ASG_CN_pos_13, 0);
            putvalue(env_ASG_CN_PbName_s_13, empty_string);
            putvalue(env_ASG_CN_TelNum_s_13, empty_string);
            putvalue(env_ASG_CN_CallMode_13, 0);
            putvalue(env_ASG_CN_day_13, 0);
            putvalue(env_ASG_CN_month_13, 0);
            putvalue(env_ASG_CN_year_13, 0);
            putvalue(env_ASG_CN_hour_13, 0);
            putvalue(env_ASG_CN_minute_13, 0);
            putvalue(env_ASG_CN_second_13, 0);

            
            enableControl("ASG_Telephone_0x31 - CombinedNumbers_EditCache", "env_ASG_CN_pos_13", 0);
            enableControl("ASG_Telephone_0x31 - CombinedNumbers_EditCache", "env_ASG_CN_PbName_s_13", 0);
            enableControl("ASG_Telephone_0x31 - CombinedNumbers_EditCache", "env_ASG_CN_TelNum_s_13", 0);
            enableControl("ASG_Telephone_0x31 - CombinedNumbers_EditCache", "env_ASG_CN_CallMode_13", 0);
            enableControl("ASG_Telephone_0x31 - CombinedNumbers_EditCache", "env_ASG_CN_day_13", 0);
            enableControl("ASG_Telephone_0x31 - CombinedNumbers_EditCache", "env_ASG_CN_month_13", 0);
            enableControl("ASG_Telephone_0x31 - CombinedNumbers_EditCache", "env_ASG_CN_year_13", 0);
            enableControl("ASG_Telephone_0x31 - CombinedNumbers_EditCache", "env_ASG_CN_hour_13", 0);
            enableControl("ASG_Telephone_0x31 - CombinedNumbers_EditCache", "env_ASG_CN_minute_13", 0);
            enableControl("ASG_Telephone_0x31 - CombinedNumbers_EditCache", "env_ASG_CN_second_13", 0);

            putvalue(env_ASG_CN_pos_21, 0);
            putvalue(env_ASG_CN_PbName_s_21, empty_string);
            putvalue(env_ASG_CN_TelNum_s_21, empty_string);
            putvalue(env_ASG_CN_CallMode_21, 0);
            putvalue(env_ASG_CN_day_21, 0);
            putvalue(env_ASG_CN_month_21, 0);
            putvalue(env_ASG_CN_year_21, 0);
            putvalue(env_ASG_CN_hour_21, 0);
            putvalue(env_ASG_CN_minute_21, 0);
            putvalue(env_ASG_CN_second_21, 0);

            enableControl("ASG_Telephone_0x31 - CombinedNumbers_EditCache", "env_ASG_CN_pos_21", 0);
            enableControl("ASG_Telephone_0x31 - CombinedNumbers_EditCache", "env_ASG_CN_PbName_s_21", 0);
            enableControl("ASG_Telephone_0x31 - CombinedNumbers_EditCache", "env_ASG_CN_TelNum_s_21", 0);
            enableControl("ASG_Telephone_0x31 - CombinedNumbers_EditCache", "env_ASG_CN_CallMode_21", 0);
            enableControl("ASG_Telephone_0x31 - CombinedNumbers_EditCache", "env_ASG_CN_day_21", 0);
            enableControl("ASG_Telephone_0x31 - CombinedNumbers_EditCache", "env_ASG_CN_month_21", 0);
            enableControl("ASG_Telephone_0x31 - CombinedNumbers_EditCache", "env_ASG_CN_year_21", 0);
            enableControl("ASG_Telephone_0x31 - CombinedNumbers_EditCache", "env_ASG_CN_hour_21", 0);
            enableControl("ASG_Telephone_0x31 - CombinedNumbers_EditCache", "env_ASG_CN_minute_21", 0);
            enableControl("ASG_Telephone_0x31 - CombinedNumbers_EditCache", "env_ASG_CN_second_21", 0);

            putvalue(env_ASG_CN_pos_22, 0);
            putvalue(env_ASG_CN_PbName_s_22, empty_string);
            putvalue(env_ASG_CN_TelNum_s_22, empty_string);
            putvalue(env_ASG_CN_CallMode_22, 0);
            putvalue(env_ASG_CN_day_22, 0);
            putvalue(env_ASG_CN_month_22, 0);
            putvalue(env_ASG_CN_year_22, 0);
            putvalue(env_ASG_CN_hour_22, 0);
            putvalue(env_ASG_CN_minute_22, 0);
            putvalue(env_ASG_CN_second_22, 0);

            enableControl("ASG_Telephone_0x31 - CombinedNumbers_EditCache", "env_ASG_CN_pos_22", 0);
            enableControl("ASG_Telephone_0x31 - CombinedNumbers_EditCache", "env_ASG_CN_PbName_s_22", 0);
            enableControl("ASG_Telephone_0x31 - CombinedNumbers_EditCache", "env_ASG_CN_TelNum_s_22", 0);
            enableControl("ASG_Telephone_0x31 - CombinedNumbers_EditCache", "env_ASG_CN_CallMode_22", 0);
            enableControl("ASG_Telephone_0x31 - CombinedNumbers_EditCache", "env_ASG_CN_day_22", 0);
            enableControl("ASG_Telephone_0x31 - CombinedNumbers_EditCache", "env_ASG_CN_month_22", 0);
            enableControl("ASG_Telephone_0x31 - CombinedNumbers_EditCache", "env_ASG_CN_year_22", 0);
            enableControl("ASG_Telephone_0x31 - CombinedNumbers_EditCache", "env_ASG_CN_hour_22", 0);
            enableControl("ASG_Telephone_0x31 - CombinedNumbers_EditCache", "env_ASG_CN_minute_22", 0);
            enableControl("ASG_Telephone_0x31 - CombinedNumbers_EditCache", "env_ASG_CN_second_22", 0);
       
            putvalue(env_ASG_CN_pos_23, 0);
            putvalue(env_ASG_CN_PbName_s_23, empty_string);
            putvalue(env_ASG_CN_TelNum_s_23, empty_string);
            putvalue(env_ASG_CN_CallMode_23, 0);
            putvalue(env_ASG_CN_day_23, 0);
            putvalue(env_ASG_CN_month_23, 0);
            putvalue(env_ASG_CN_year_23, 0);
            putvalue(env_ASG_CN_hour_23, 0);
            putvalue(env_ASG_CN_minute_23, 0);
            putvalue(env_ASG_CN_second_23, 0);

            enableControl("ASG_Telephone_0x31 - CombinedNumbers_EditCache", "env_ASG_CN_pos_23", 0);
            enableControl("ASG_Telephone_0x31 - CombinedNumbers_EditCache", "env_ASG_CN_PbName_s_23", 0);
            enableControl("ASG_Telephone_0x31 - CombinedNumbers_EditCache", "env_ASG_CN_TelNum_s_23", 0);
            enableControl("ASG_Telephone_0x31 - CombinedNumbers_EditCache", "env_ASG_CN_CallMode_23", 0);
            enableControl("ASG_Telephone_0x31 - CombinedNumbers_EditCache", "env_ASG_CN_day_23", 0);
            enableControl("ASG_Telephone_0x31 - CombinedNumbers_EditCache", "env_ASG_CN_month_23", 0);
            enableControl("ASG_Telephone_0x31 - CombinedNumbers_EditCache", "env_ASG_CN_year_23", 0);
            enableControl("ASG_Telephone_0x31 - CombinedNumbers_EditCache", "env_ASG_CN_hour_23", 0);
            enableControl("ASG_Telephone_0x31 - CombinedNumbers_EditCache", "env_ASG_CN_minute_23", 0);
            enableControl("ASG_Telephone_0x31 - CombinedNumbers_EditCache", "env_ASG_CN_second_23", 0);

            putvalue(env_ASG_CN_ListInfo_up,empty_string);
            putvalue(env_ASG_CN_ListInfo_down,empty_string);
            putvalue(env_ASG_CN_ListInfo_Cursor,empty_string);

            ClosePanel("ASG_Telephone_0x31 - CombinedNumbers_EditCache");          
        }
    }
}   
/*@@end*/

/*@@envVar:env_ASG_CN_down:*/
on envVar env_ASG_CN_down
{
    int i=0, j=0;

    if(gRNS_PowerOnOff==Power_on && getvalue(this) && gCombinedNumbers_ListHandlingType ==TEL_COMBINEDNUMBERS_NOCACHE)
	{      
        gCombinedNumbers_CursorAction =TEL_COMBINEDNUMBERS_CURSORACTION_DOWN;
        
        if(gCombinedNumbers_SlidingWindow_State ==TEL_COMBINEDNUMBERS_SLIDINGWINDOW_ACTIVE && gCombinedNumbers_MoveList_down_allowed)
        {   
            gCombinedNumbers_ListHandlingType  =TEL_COMBINEDNUMBERS_DOWN_CACHE;
            gCombinedNumbers_DisplayStatus     =TEL_COMBINEDNUMBERS_DISPLAYLIST_FIRST_ELEMENTS;
            gCombinedNumbers_CursorAction      =TEL_COMBINEDNUMBERS_CURSORACTION_NOTHING;
            
            CombinedNumbers_ListHandling ();
        }
        else if(gCombinedNumbers_SlidingWindow_State ==TEL_COMBINEDNUMBERS_SLIDINGWINDOW_NOTACTIVE && gCombinedNumbers_MoveList_down_allowed)
        {
            gCombinedNumbers_DisplayStatus     =TEL_COMBINEDNUMBERS_DISPLAYLIST_SEARCH_ELEMENTS;
            gCombinedNumbers_CursorAction      =TEL_COMBINEDNUMBERS_CURSORACTION_DOWN;

            CombinedNumbers_display();

            //reset values
            gCombinedNumbers_DisplayStatus     =TEL_COMBINEDNUMBERS_DISPLAYLIST_REFRESH;
            gCombinedNumbers_CursorAction      =TEL_COMBINEDNUMBERS_CURSORACTION_NOTHING;
        }
    }
}
/*@@end*/

/*@@envVar:env_ASG_CN_up:*/
on envVar env_ASG_CN_up
{
    int i=0, j=0;

    if(gRNS_PowerOnOff==Power_on && getvalue(this) && gCombinedNumbers_ListHandlingType ==TEL_COMBINEDNUMBERS_NOCACHE)
	{   
        gCombinedNumbers_CursorAction =TEL_COMBINEDNUMBERS_CURSORACTION_UP;

        if(gCombinedNumbers_SlidingWindow_State ==TEL_COMBINEDNUMBERS_SLIDINGWINDOW_ACTIVE && gCombinedNumbers_MoveList_up_allowed)
        {  
            gCombinedNumbers_ListHandlingType  =TEL_COMBINEDNUMBERS_UP_CACHE;
            gCombinedNumbers_DisplayStatus     =TEL_COMBINEDNUMBERS_DISPLAYLIST_FIRST_ELEMENTS;
            gCombinedNumbers_CursorAction      =TEL_COMBINEDNUMBERS_CURSORACTION_NOTHING;
            
            CombinedNumbers_ListHandling ();
        }
        else if(gCombinedNumbers_SlidingWindow_State ==TEL_COMBINEDNUMBERS_SLIDINGWINDOW_NOTACTIVE && gCombinedNumbers_MoveList_up_allowed)
        {
            gCombinedNumbers_DisplayStatus     =TEL_COMBINEDNUMBERS_DISPLAYLIST_SEARCH_ELEMENTS;
            gCombinedNumbers_CursorAction      =TEL_COMBINEDNUMBERS_CURSORACTION_UP;

            CombinedNumbers_ListHandling();
            
            CombinedNumbers_display();

            //reset values
            gCombinedNumbers_DisplayStatus     =TEL_COMBINEDNUMBERS_DISPLAYLIST_REFRESH;
            gCombinedNumbers_CursorAction      =TEL_COMBINEDNUMBERS_CURSORACTION_NOTHING;
        }    
    }
}
/*@@end*/

/*@@caplFunc:CombinedNumbers_Indication(dword[],byte,int):*///function
CombinedNumbers_Indication (dword Indication_array [], byte indication, int datalength)
{
    byte mode, direction, shift, recordaddress, indexsize, transmitpos, length, CacheElements;
    word  startelement, elements, startelement_check,StartElementInCache,current_element, Offset =0;
    int i =0, j=0;

    // Init local variables
    mode                    =0;
    direction               =0;
    shift                   =0;
    recordaddress           =0;
    startelement            =0;
    elements                =0;
    current_element         =0;
    transmitpos             =0;
    length                  =0;
    startelement_check      =0;
    StartElementInCache     =FALSE;
    CacheElements           =FALSE;

		switch (gBAP_Indication[2])
		{
			case Data_IND:
				//get data
                gCombinedNumbers_ASGID =(Indication_array[3] &0xF0) /0x10;
                gCombinedNumbers_TAID  =Indication_array[3] &0x0F;           

                gCombinedNumbers_TotalNumListElements =Indication_array[4];
              
                /***ArrayHeader***/
                mode            =(Indication_array[5] &0xF0) /0x10;
                recordaddress   =Indication_array[5] &0x0F;
                Offset =6;
                
                // decode "mode-byte"
                shift       =mode &0x01;
                direction   =(mode &0x02)/0x02;
                transmitpos =(mode &0x04)/0x04;
                indexsize   =(mode &0x08)/0x08; 

                if (indexsize)
                {   
                    startelement =Indication_array[Offset];
                    Offset++;
                    startelement +=(Indication_array[Offset] *0x100);
                    Offset++;

                    elements =Indication_array[Offset];
                    Offset++;
                    elements +=(Indication_array[Offset] *0x100);
                    Offset++;
                }
                else
                {   
                    startelement =Indication_array[Offset];
                    Offset++;

                    elements =Indication_array[Offset];
                    Offset++;
                }           
            
                if(startelement !=0)
                {
                    for (i=0;i<TEL_COMBINEDNUMBERS_ASGCACHE_MAX_SIZE;i++)
                    {
                        if(startelement ==gCombinedNumbers_Pos[i])  
                            i =TEL_COMBINEDNUMBERS_ASGCACHE_MAX_SIZE;              
                    }
                }

                switch (recordaddress)
                {
                    case 0: //recordaddress =0 -> complete record

                        /***startelement ==0***/                        
                        if(0==startelement && gCombinedNumbers_ListHandlingType ==TEL_COMBINEDNUMBERS_BUILDUPCACHE)
                        {     
                            /***find "start line" in ASG cache***/
                            if(FORWARD ==direction)
                            {    
                                if (gCombinedNumbers_cacheDown)
                                {   
                                    current_element         =5; //it's the Pos of last element in ASG cache
                                    
                                    //reset "sliding window" values
                                    gCombinedNumbers_cacheDown         =FALSE;
                                }
                                else
                                    current_element =startelement;
                                    
                                if (shift ==TRUE) //startelement not next element
                                    current_element =CombinedNumbers_GetNextLineInCache (current_element, direction);   
                            }
                            
                            else if(BACKWARD ==direction && shift==TRUE)
                            {
                                if(gCombinedNumbers_cacheUp)
                                {   
                                    current_element         =6; //it's the Pos of first element in ASG cache
                                    
                                    //reset "sliding window" values
                                        gCombinedNumbers_cacheUp           =FALSE;
                                }
                                else 
                                    current_element =TEL_COMBINEDNUMBERS_ASGCACHE_MAX_SIZE -1; // position of last element in array 
                            }                
                                
                            /***copy elements***/
                            if (current_element !=TEL_COMBINEDNUMBERS_NO_NEXT_POSITION) 
                            {
                                for (j=0; j<elements;j++) //copy elements
                                {   
                                    //check, if elements must be cached and in case find position in array
                                    CacheElements =FALSE;
                                    for (i=0; i<TEL_COMBINEDNUMBERS_ASGCACHE_MAX_SIZE; i++)
                                    {  
                                        //if element already cached, find position in ASG-cache
                                        if(indexsize ==FALSE && (transmitpos ==TRUE) && Indication_array[Offset] ==gCombinedNumbers_Pos[i] && gCombinedNumbers_ListEntryReceptionInformation[i] ==TRUE)
                                        {   
                                            current_element =i; 
                                            CacheElements   =TRUE;
                                        }
                                        else if((indexsize ==TRUE && (transmitpos ==TRUE) && (Indication_array[Offset] +(Indication_array[Offset+1]*0x100)) ==gCombinedNumbers_Pos[i] && gCombinedNumbers_ListEntryReceptionInformation[i] ==TRUE))
                                        {   
                                            current_element =i; 
                                            CacheElements   =TRUE;
                                        }
                                        //if not already cached, then store element only, if Cache is build-up!
                                        else if((gCombinedNumbers_ListHandlingType !=TEL_COMBINEDNUMBERS_NOCACHE))
                                            CacheElements   =TRUE;
                                    }
                                                                       
                                    if (transmitpos)
                                    {   
                                        if(CacheElements ==TRUE)
                                        {   
                                            if(indexsize)
                                            {    
                                                gCombinedNumbers_Pos[current_element] =Indication_array[Offset];
                                                Offset++;
                                                gCombinedNumbers_Pos[current_element] +=Indication_array[Offset] *0x100;
                                            }
                                            else
                                                gCombinedNumbers_Pos[current_element] =Indication_array[Offset]; 
                                        }
                                        Offset++;
                                    }
                                    else if(CacheElements ==TRUE)
                                    {
                                        if(direction ==FORWARD && shift==FALSE)
                                            gCombinedNumbers_Pos[current_element] =startelement+j;
                                        
                                        else if(direction ==FORWARD && shift==TRUE)
                                            gCombinedNumbers_Pos[current_element] =startelement+j+1;

                                        else if(direction ==BACKWARD && shift==FALSE)
                                            gCombinedNumbers_Pos[current_element] =startelement-j;
                                        
                                        else if((direction ==BACKWARD) && (shift==TRUE) && (startelement !=0))
                                            gCombinedNumbers_Pos[current_element] =startelement-j-1;  
                                    }

                                    //PbName
                                    if(CacheElements ==TRUE)
                                    {
                                        for(i=0; i<TEL_COMBINEDNUMBERS_PBNAME_LENGTH;i++) //clear
			                                gCombinedNumbers_PbName[current_element][i] =0; 
                                    }
                                         
                                    length =Indication_array[Offset];
                                    Offset++;
                                    
                                    for(i=0; i<length;i++) //copy data
                                    {   
                                        if(CacheElements ==TRUE)
                                            gCombinedNumbers_PbName[current_element][i] =Indication_array[Offset];
                                        Offset++;
                                    }
                                    
                                    //CallMode
                                    if(CacheElements ==TRUE)
                                    {
                                        gCombinedNumbers_CallMode[current_element] =Indication_array[Offset];
                                        Offset++;
                                    }

                                    //TelNumber
                                    if(CacheElements ==TRUE)
                                    {
                                        for(i=0; i<TEL_COMBINEDNUMBERS_TELNUMBER_LENGTH;i++) //clear
			                                gCombinedNumbers_TelNumber[current_element][i] =0; 
                                    }
                                         
                                    length =Indication_array[Offset];
                                    Offset++;
                                    
                                    for(i=0; i<length;i++) //copy data
                                    {   
                                        if(CacheElements ==TRUE)
                                            gCombinedNumbers_TelNumber[current_element][i] =Indication_array[Offset];
                                        Offset++;
                                    }
                                    
                                    //Day
                                    if(CacheElements ==TRUE)
                                    {
                                        gCombinedNumbers_day[current_element] =Indication_array[Offset];
                                        Offset++;
                                    }

                                    //Month
                                    if(CacheElements ==TRUE)
                                    {
                                        gCombinedNumbers_month[current_element] =Indication_array[Offset];
                                        Offset++;
                                    }

                                    //Year
                                    if(CacheElements ==TRUE)
                                    {
                                        gCombinedNumbers_year[current_element] =Indication_array[Offset];
                                        Offset++;
                                    }

                                    //Hour
                                    if(CacheElements ==TRUE)
                                    {
                                        gCombinedNumbers_hour[current_element] =Indication_array[Offset];
                                        Offset++;
                                    }

                                    //Minute
                                    if(CacheElements ==TRUE)
                                    {
                                        gCombinedNumbers_minute[current_element] =Indication_array[Offset];
                                        Offset++;
                                    }

                                    //Second
                                    if(CacheElements ==TRUE)
                                    {
                                        gCombinedNumbers_second[current_element] =Indication_array[Offset];
                                        Offset++;
                                    }
                                    
                                    if(CacheElements ==TRUE)                                    
                                        gCombinedNumbers_ListEntryReceptionInformation [current_element] =TRUE;
                                                       
                                    current_element =CombinedNumbers_GetNextLineInCache (current_element, direction); //go on with next element     
                                }   //copy data of current element finished
                            } //copy of elements finished       
                        } //startelement=0 ends
    
                        /***startelement !=0***/
                        else //if (((startelement !=0) && (gCombinedNumbers_ListHandlingType ==TEL_COMBINEDNUMBERS_BUILDUPCACHE)) || ((startelement ==0) && (gCombinedNumbers_ListHandlingType !=TEL_COMBINEDNUMBERS_BUILDUPCACHE))) //startelement !=0
                        {
                            //searching for valid startelement in stored list
					        for(i=0;i<TEL_COMBINEDNUMBERS_ASGCACHE_MAX_SIZE;i++)
					        {
						        if(gCombinedNumbers_Pos[i] ==startelement)				//found a valid element
						        {                                                                                  
                                    current_element     =i;                         //found element is valid_startelement
						            StartElementInCache =TRUE;
                                    i                   =TEL_COMBINEDNUMBERS_ASGCACHE_MAX_SIZE;
                                }
					        }
                            if (StartElementInCache)
                            {   
                                if (shift ==TRUE && startelement!=0) //first array element is next element
                                    current_element =CombinedNumbers_GetNextLineInCache (current_element, direction);                 
                                else if(shift ==TRUE && startelement==0 && direction ==FORWARD)
                                    current_element=5;
                                   
                                for (j=0; j<elements;j++) //copy elements
                                {
                                    if(current_element !=TEL_COMBINEDNUMBERS_NO_NEXT_POSITION)
                                    {
                                        CacheElements =TRUE;
                                        //if element already exist in ASG-cache, search the position 
                                        for (i=0; i<TEL_COMBINEDNUMBERS_ASGCACHE_MAX_SIZE; i++)
                                        {   
                                            if((transmitpos ==TRUE) && gCombinedNumbers_ListEntryReceptionInformation[i] ==TRUE)
                                            {   
                                                startelement_check =0;
                                                if(indexsize)
                                                    startelement_check =Indication_array[Offset] +(Indication_array[Offset+1]*0x100); 
                                                else
                                                    startelement_check =Indication_array[Offset];
                                               
                                                if(startelement_check ==gCombinedNumbers_Pos[i])
                                                {   
                                                    current_element =i; 
                                                    CacheElements   =TRUE;
                                                }
                                                startelement_check=0;
                                            }  
                                        }
                                    }
                                    else
                                        CacheElements =FALSE;
                                        
                                    if (transmitpos)
                                    {   
                                        if(CacheElements ==TRUE)
                                        {   
                                            if(indexsize)
                                            {    
                                                gCombinedNumbers_Pos[current_element] =Indication_array[Offset];
                                                Offset++;
                                                gCombinedNumbers_Pos[current_element] +=Indication_array[Offset] *0x100;
                                            }
                                            else
                                                gCombinedNumbers_Pos[current_element] =Indication_array[Offset];
                                        }
                                        Offset++;
                                    }
                                    else if(CacheElements ==TRUE)
                                    {
                                        if(direction ==FORWARD && shift==FALSE)
                                            gCombinedNumbers_Pos[current_element] =startelement+j;
                                        
                                        else if(direction ==FORWARD && shift==TRUE)
                                            gCombinedNumbers_Pos[current_element] =startelement+j+1;

                                        else if(direction ==BACKWARD && shift==FALSE)
                                            gCombinedNumbers_Pos[current_element] =startelement-j;
                                        
                                        else if((direction ==BACKWARD) && (shift==TRUE) && (startelement !=0))
                                            gCombinedNumbers_Pos[current_element] =startelement-j-1;  
                                    }
                                    
                                    //PbName
                                    if(CacheElements ==TRUE)
                                    {
                                        for(i=0; i<TEL_COMBINEDNUMBERS_PBNAME_LENGTH;i++) //clear
			                                gCombinedNumbers_PbName[current_element][i] =0; 
                                    }
                                         
                                    length =Indication_array[Offset];
                                    Offset++;
                                    
                                    for(i=0; i<length;i++) //copy data
                                    {   
                                        if(CacheElements ==TRUE)
                                            gCombinedNumbers_PbName[current_element][i] =Indication_array[Offset];
                                        Offset++;
                                    }
                                    
                                    //CallMode
                                    if(CacheElements ==TRUE)
                                    {
                                        gCombinedNumbers_CallMode[current_element] =Indication_array[Offset];
                                        Offset++;
                                    }

                                    //TelNumber
                                    if(CacheElements ==TRUE)
                                    {
                                        for(i=0; i<TEL_COMBINEDNUMBERS_TELNUMBER_LENGTH;i++) //clear
			                                gCombinedNumbers_TelNumber[current_element][i] =0; 
                                    }
                                         
                                    length =Indication_array[Offset];
                                    Offset++;
                                    
                                    for(i=0; i<length;i++) //copy data
                                    {   
                                        if(CacheElements ==TRUE)
                                            gCombinedNumbers_TelNumber[current_element][i] =Indication_array[Offset];
                                        Offset++;
                                    }
                                    
                                    //Day
                                    if(CacheElements ==TRUE)
                                    {
                                        gCombinedNumbers_day[current_element] =Indication_array[Offset];
                                        Offset++;
                                    }

                                    //Month
                                    if(CacheElements ==TRUE)
                                    {
                                        gCombinedNumbers_month[current_element] =Indication_array[Offset];
                                        Offset++;
                                    }

                                    //Year
                                    if(CacheElements ==TRUE)
                                    {
                                        gCombinedNumbers_year[current_element] =Indication_array[Offset];
                                        Offset++;
                                    }

                                    //Hour
                                    if(CacheElements ==TRUE)
                                    {
                                        gCombinedNumbers_hour[current_element] =Indication_array[Offset];
                                        Offset++;
                                    }

                                    //Minute
                                    if(CacheElements ==TRUE)
                                    {
                                        gCombinedNumbers_minute[current_element] =Indication_array[Offset];
                                        Offset++;
                                    }

                                    //Second
                                    if(CacheElements ==TRUE)
                                    {
                                        gCombinedNumbers_second[current_element] =Indication_array[Offset];
                                        Offset++;
                                    }
                                    
                                    if(CacheElements ==TRUE)                                   
                                        gCombinedNumbers_ListEntryReceptionInformation [current_element] =TRUE;
                                    
                                    if(CacheElements ==TRUE)    
                                        current_element =CombinedNumbers_GetNextLineInCache (current_element, direction); //go on with next element       
                                }   //copy data of current element finished
                            }       //copy of elements finished
                        }           //startelement !=0 ends
                        
                     break; //recordaddress =0 ends
                    
                    case 1: //recordaddress =1 -> PbName, CallMode
                        /***startelement ==0***/                        
                        if(0==startelement && gCombinedNumbers_ListHandlingType ==TEL_COMBINEDNUMBERS_BUILDUPCACHE)
                        {     
                            /***find "start line" in ASG cache***/
                            if(FORWARD ==direction)
                            {    
                                if (gCombinedNumbers_cacheDown)
                                {   
                                    current_element         =5; //it's the Pos of last element in ASG cache
                                    
                                    //reset "sliding window" values
                                    gCombinedNumbers_cacheDown         =FALSE;
                                }
                                else
                                    current_element =startelement;
                                    
                                if (shift ==TRUE) //startelement not next element
                                    current_element =CombinedNumbers_GetNextLineInCache (current_element, direction);   
                            }
                            
                            else if(BACKWARD ==direction && shift==TRUE)
                            {
                                if(gCombinedNumbers_cacheUp)
                                {   
                                    current_element         =6; //it's the Pos of first element in ASG cache
                                    
                                    //reset "sliding window" values
                                        gCombinedNumbers_cacheUp           =FALSE;
                                }
                                else 
                                    current_element =TEL_COMBINEDNUMBERS_ASGCACHE_MAX_SIZE -1; // position of last element in array 
                            }                
                                
                            /***copy elements***/
                            if (current_element !=TEL_COMBINEDNUMBERS_NO_NEXT_POSITION) 
                            {
                                for (j=0; j<elements;j++) //copy elements
                                {   
                                    //check, if elements must be cached and in case find position in array
                                    CacheElements =FALSE;
                                    for (i=0; i<TEL_COMBINEDNUMBERS_ASGCACHE_MAX_SIZE; i++)
                                    {  
                                        //if element already cached, find position in ASG-cache
                                        if(indexsize ==FALSE && (transmitpos ==TRUE) && Indication_array[Offset] ==gCombinedNumbers_Pos[i] && gCombinedNumbers_ListEntryReceptionInformation[i] ==TRUE)
                                        {   
                                            current_element =i; 
                                            CacheElements   =TRUE;
                                        }
                                        else if((indexsize ==TRUE && (transmitpos ==TRUE) && (Indication_array[Offset] +(Indication_array[Offset+1]*0x100)) ==gCombinedNumbers_Pos[i] && gCombinedNumbers_ListEntryReceptionInformation[i] ==TRUE))
                                        {   
                                            current_element =i; 
                                            CacheElements   =TRUE;
                                        }
                                        //if not already cached, then store element only, if Cache is build-up!
                                        else if((gCombinedNumbers_ListHandlingType !=TEL_COMBINEDNUMBERS_NOCACHE))
                                            CacheElements   =TRUE;
                                    }
                                                                       
                                    if (transmitpos)
                                    {   
                                        if(CacheElements ==TRUE)
                                        {   
                                            if(indexsize)
                                            {    
                                                gCombinedNumbers_Pos[current_element] =Indication_array[Offset];
                                                Offset++;
                                                gCombinedNumbers_Pos[current_element] +=Indication_array[Offset] *0x100;
                                            }
                                            else
                                                gCombinedNumbers_Pos[current_element] =Indication_array[Offset]; 
                                        }
                                        Offset++;
                                    }
                                    else if(CacheElements ==TRUE)
                                    {
                                        if(direction ==FORWARD && shift==FALSE)
                                            gCombinedNumbers_Pos[current_element] =startelement+j;
                                        
                                        else if(direction ==FORWARD && shift==TRUE)
                                            gCombinedNumbers_Pos[current_element] =startelement+j+1;

                                        else if(direction ==BACKWARD && shift==FALSE)
                                            gCombinedNumbers_Pos[current_element] =startelement-j;
                                        
                                        else if((direction ==BACKWARD) && (shift==TRUE) && (startelement !=0))
                                            gCombinedNumbers_Pos[current_element] =startelement-j-1;  
                                    }

                                    //PbName
                                    if(CacheElements ==TRUE)
                                    {
                                        for(i=0; i<TEL_COMBINEDNUMBERS_PBNAME_LENGTH;i++) //clear
			                                gCombinedNumbers_PbName[current_element][i] =0; 
                                    }
                                         
                                    length =Indication_array[Offset];
                                    Offset++;
                                    
                                    for(i=0; i<length;i++) //copy data
                                    {   
                                        if(CacheElements ==TRUE)
                                            gCombinedNumbers_PbName[current_element][i] =Indication_array[Offset];
                                        Offset++;
                                    }
                                    
                                    //CallMode
                                    if(CacheElements ==TRUE)
                                    {
                                        gCombinedNumbers_CallMode[current_element] =Indication_array[Offset];
                                        Offset++;
                                    }
                                    
                                    if(CacheElements ==TRUE)                                    
                                        gCombinedNumbers_ListEntryReceptionInformation [current_element] =TRUE;
                                                       
                                    current_element =CombinedNumbers_GetNextLineInCache (current_element, direction); //go on with next element     
                                }   //copy data of current element finished
                            } //copy of elements finished       
                        } //startelement=0 ends
    
                        /***startelement !=0***/
                        else //if (((startelement !=0) && (gCombinedNumbers_ListHandlingType ==TEL_COMBINEDNUMBERS_BUILDUPCACHE)) || ((startelement ==0) && (gCombinedNumbers_ListHandlingType !=TEL_COMBINEDNUMBERS_BUILDUPCACHE))) //startelement !=0
                        {
                            //searching for valid startelement in stored list
					        for(i=0;i<TEL_COMBINEDNUMBERS_ASGCACHE_MAX_SIZE;i++)
					        {
						        if(gCombinedNumbers_Pos[i] ==startelement)				//found a valid element
						        {                                                                                  
                                    current_element     =i;                         //found element is valid_startelement
						            StartElementInCache =TRUE;
                                    i                   =TEL_COMBINEDNUMBERS_ASGCACHE_MAX_SIZE;
                                }
					        }
                            if (StartElementInCache)
                            {   
                                if (shift ==TRUE && startelement!=0) //first array element is next element
                                    current_element =CombinedNumbers_GetNextLineInCache (current_element, direction);                 
                                else if(shift ==TRUE && startelement==0 && direction ==FORWARD)
                                    current_element=5;
                                   
                                for (j=0; j<elements;j++) //copy elements
                                {
                                    if(current_element !=TEL_COMBINEDNUMBERS_NO_NEXT_POSITION)
                                    {
                                        CacheElements =TRUE;
                                        //if element already exist in ASG-cache, search the position 
                                        for (i=0; i<TEL_COMBINEDNUMBERS_ASGCACHE_MAX_SIZE; i++)
                                        {   
                                            if((transmitpos ==TRUE) && gCombinedNumbers_ListEntryReceptionInformation[i] ==TRUE)
                                            {   
                                                startelement_check =0;
                                                if(indexsize)
                                                    startelement_check =Indication_array[Offset] +(Indication_array[Offset+1]*0x100); 
                                                else
                                                    startelement_check =Indication_array[Offset];
                                               
                                                if(startelement_check ==gCombinedNumbers_Pos[i])
                                                {   
                                                    current_element =i; 
                                                    CacheElements   =TRUE;
                                                }
                                                startelement_check=0;
                                            }  
                                        }
                                    }
                                    else
                                        CacheElements =FALSE;
                                        
                                    if (transmitpos)
                                    {   
                                        if(CacheElements ==TRUE)
                                        {   
                                            if(indexsize)
                                            {    
                                                gCombinedNumbers_Pos[current_element] =Indication_array[Offset];
                                                Offset++;
                                                gCombinedNumbers_Pos[current_element] +=Indication_array[Offset] *0x100;
                                            }
                                            else
                                                gCombinedNumbers_Pos[current_element] =Indication_array[Offset];
                                        }
                                        Offset++;
                                    }
                                    else if(CacheElements ==TRUE)
                                    {
                                        if(direction ==FORWARD && shift==FALSE)
                                            gCombinedNumbers_Pos[current_element] =startelement+j;
                                        
                                        else if(direction ==FORWARD && shift==TRUE)
                                            gCombinedNumbers_Pos[current_element] =startelement+j+1;

                                        else if(direction ==BACKWARD && shift==FALSE)
                                            gCombinedNumbers_Pos[current_element] =startelement-j;
                                        
                                        else if((direction ==BACKWARD) && (shift==TRUE) && (startelement !=0))
                                            gCombinedNumbers_Pos[current_element] =startelement-j-1;  
                                    }
                                    
                                    //PbName
                                    if(CacheElements ==TRUE)
                                    {
                                        for(i=0; i<TEL_COMBINEDNUMBERS_PBNAME_LENGTH;i++) //clear
			                                gCombinedNumbers_PbName[current_element][i] =0; 
                                    }
                                         
                                    length =Indication_array[Offset];
                                    Offset++;
                                    
                                    for(i=0; i<length;i++) //copy data
                                    {   
                                        if(CacheElements ==TRUE)
                                            gCombinedNumbers_PbName[current_element][i] =Indication_array[Offset];
                                        Offset++;
                                    }
                                    
                                    //CallMode
                                    if(CacheElements ==TRUE)
                                    {
                                        gCombinedNumbers_CallMode[current_element] =Indication_array[Offset];
                                        Offset++;
                                    }

                                    if(CacheElements ==TRUE)                                   
                                        gCombinedNumbers_ListEntryReceptionInformation [current_element] =TRUE;
                                    
                                    if(CacheElements ==TRUE)    
                                        current_element =CombinedNumbers_GetNextLineInCache (current_element, direction); //go on with next element       
                                }   //copy data of current element finished
                            }       //copy of elements finished
                        }
                        
                     break; //recordaddress =1 ends
                    
                    case 2: //recordaddress =2 -> TelNumber, Day, Month, Year, Hour, Minute, Second
                        /***startelement ==0***/                        
                        if(0==startelement && gCombinedNumbers_ListHandlingType ==TEL_COMBINEDNUMBERS_BUILDUPCACHE)
                        {     
                            /***find "start line" in ASG cache***/
                            if(FORWARD ==direction)
                            {    
                                if (gCombinedNumbers_cacheDown)
                                {   
                                    current_element         =5; //it's the Pos of last element in ASG cache
                                    
                                    //reset "sliding window" values
                                    gCombinedNumbers_cacheDown         =FALSE;
                                }
                                else
                                    current_element =startelement;
                                    
                                if (shift ==TRUE) //startelement not next element
                                    current_element =CombinedNumbers_GetNextLineInCache (current_element, direction);   
                            }
                            
                            else if(BACKWARD ==direction && shift==TRUE)
                            {
                                if(gCombinedNumbers_cacheUp)
                                {   
                                    current_element         =6; //it's the Pos of first element in ASG cache
                                    
                                    //reset "sliding window" values
                                        gCombinedNumbers_cacheUp           =FALSE;
                                }
                                else 
                                    current_element =TEL_COMBINEDNUMBERS_ASGCACHE_MAX_SIZE -1; // position of last element in array 
                            }                
                                
                            /***copy elements***/
                            if (current_element !=TEL_COMBINEDNUMBERS_NO_NEXT_POSITION) 
                            {
                                for (j=0; j<elements;j++) //copy elements
                                {   
                                    //check, if elements must be cached and in case find position in array
                                    CacheElements =FALSE;
                                    for (i=0; i<TEL_COMBINEDNUMBERS_ASGCACHE_MAX_SIZE; i++)
                                    {  
                                        //if element already cached, find position in ASG-cache
                                        if(indexsize ==FALSE && (transmitpos ==TRUE) && Indication_array[Offset] ==gCombinedNumbers_Pos[i] && gCombinedNumbers_ListEntryReceptionInformation[i] ==TRUE)
                                        {   
                                            current_element =i; 
                                            CacheElements   =TRUE;
                                        }
                                        else if((indexsize ==TRUE && (transmitpos ==TRUE) && (Indication_array[Offset] +(Indication_array[Offset+1]*0x100)) ==gCombinedNumbers_Pos[i] && gCombinedNumbers_ListEntryReceptionInformation[i] ==TRUE))
                                        {   
                                            current_element =i; 
                                            CacheElements   =TRUE;
                                        }
                                        //if not already cached, then store element only, if Cache is build-up!
                                        else if((gCombinedNumbers_ListHandlingType !=TEL_COMBINEDNUMBERS_NOCACHE))
                                            CacheElements   =TRUE;
                                    }
                                                                       
                                    if (transmitpos)
                                    {   
                                        if(CacheElements ==TRUE)
                                        {   
                                            if(indexsize)
                                            {    
                                                gCombinedNumbers_Pos[current_element] =Indication_array[Offset];
                                                Offset++;
                                                gCombinedNumbers_Pos[current_element] +=Indication_array[Offset] *0x100;
                                            }
                                            else
                                                gCombinedNumbers_Pos[current_element] =Indication_array[Offset]; 
                                        }
                                        Offset++;
                                    }
                                    else if(CacheElements ==TRUE)
                                    {
                                        if(direction ==FORWARD && shift==FALSE)
                                            gCombinedNumbers_Pos[current_element] =startelement+j;
                                        
                                        else if(direction ==FORWARD && shift==TRUE)
                                            gCombinedNumbers_Pos[current_element] =startelement+j+1;

                                        else if(direction ==BACKWARD && shift==FALSE)
                                            gCombinedNumbers_Pos[current_element] =startelement-j;
                                        
                                        else if((direction ==BACKWARD) && (shift==TRUE) && (startelement !=0))
                                            gCombinedNumbers_Pos[current_element] =startelement-j-1;  
                                    }

                                    //TelNumber
                                    if(CacheElements ==TRUE)
                                    {
                                        for(i=0; i<TEL_COMBINEDNUMBERS_TELNUMBER_LENGTH;i++) //clear
			                                gCombinedNumbers_TelNumber[current_element][i] =0; 
                                    }
                                         
                                    length =Indication_array[Offset];
                                    Offset++;
                                    
                                    for(i=0; i<length;i++) //copy data
                                    {   
                                        if(CacheElements ==TRUE)
                                            gCombinedNumbers_TelNumber[current_element][i] =Indication_array[Offset];
                                        Offset++;
                                    }
                                    
                                    //Day
                                    if(CacheElements ==TRUE)
                                    {
                                        gCombinedNumbers_day[current_element] =Indication_array[Offset];
                                        Offset++;
                                    }

                                    //Month
                                    if(CacheElements ==TRUE)
                                    {
                                        gCombinedNumbers_month[current_element] =Indication_array[Offset];
                                        Offset++;
                                    }

                                    //Year
                                    if(CacheElements ==TRUE)
                                    {
                                        gCombinedNumbers_year[current_element] =Indication_array[Offset];
                                        Offset++;
                                    }

                                    //Hour
                                    if(CacheElements ==TRUE)
                                    {
                                        gCombinedNumbers_hour[current_element] =Indication_array[Offset];
                                        Offset++;
                                    }

                                    //Minute
                                    if(CacheElements ==TRUE)
                                    {
                                        gCombinedNumbers_minute[current_element] =Indication_array[Offset];
                                        Offset++;
                                    }

                                    //Second
                                    if(CacheElements ==TRUE)
                                    {
                                        gCombinedNumbers_second[current_element] =Indication_array[Offset];
                                        Offset++;
                                    }
                                    
                                    if(CacheElements ==TRUE)                                    
                                        gCombinedNumbers_ListEntryReceptionInformation [current_element] =TRUE;
                                                       
                                    current_element =CombinedNumbers_GetNextLineInCache (current_element, direction); //go on with next element     
                                }   //copy data of current element finished
                            } //copy of elements finished       
                        } //startelement=0 ends
    
                        /***startelement !=0***/
                        else //if (((startelement !=0) && (gCombinedNumbers_ListHandlingType ==TEL_COMBINEDNUMBERS_BUILDUPCACHE)) || ((startelement ==0) && (gCombinedNumbers_ListHandlingType !=TEL_COMBINEDNUMBERS_BUILDUPCACHE))) //startelement !=0
                        {
                            //searching for valid startelement in stored list
					        for(i=0;i<TEL_COMBINEDNUMBERS_ASGCACHE_MAX_SIZE;i++)
					        {
						        if(gCombinedNumbers_Pos[i] ==startelement)				//found a valid element
						        {                                                                                  
                                    current_element     =i;                         //found element is valid_startelement
						            StartElementInCache =TRUE;
                                    i                   =TEL_COMBINEDNUMBERS_ASGCACHE_MAX_SIZE;
                                }
					        }
                            if (StartElementInCache)
                            {   
                                if (shift ==TRUE && startelement!=0) //first array element is next element
                                    current_element =CombinedNumbers_GetNextLineInCache (current_element, direction);                 
                                else if(shift ==TRUE && startelement==0 && direction ==FORWARD)
                                    current_element=5;
                                   
                                for (j=0; j<elements;j++) //copy elements
                                {
                                    if(current_element !=TEL_COMBINEDNUMBERS_NO_NEXT_POSITION)
                                    {
                                        CacheElements =TRUE;
                                        //if element already exist in ASG-cache, search the position 
                                        for (i=0; i<TEL_COMBINEDNUMBERS_ASGCACHE_MAX_SIZE; i++)
                                        {   
                                            if((transmitpos ==TRUE) && gCombinedNumbers_ListEntryReceptionInformation[i] ==TRUE)
                                            {   
                                                startelement_check =0;
                                                if(indexsize)
                                                    startelement_check =Indication_array[Offset] +(Indication_array[Offset+1]*0x100); 
                                                else
                                                    startelement_check =Indication_array[Offset];
                                               
                                                if(startelement_check ==gCombinedNumbers_Pos[i])
                                                {   
                                                    current_element =i; 
                                                    CacheElements   =TRUE;
                                                }
                                                startelement_check=0;
                                            }  
                                        }
                                    }
                                    else
                                        CacheElements =FALSE;
                                        
                                    if (transmitpos)
                                    {   
                                        if(CacheElements ==TRUE)
                                        {   
                                            if(indexsize)
                                            {    
                                                gCombinedNumbers_Pos[current_element] =Indication_array[Offset];
                                                Offset++;
                                                gCombinedNumbers_Pos[current_element] +=Indication_array[Offset] *0x100;
                                            }
                                            else
                                                gCombinedNumbers_Pos[current_element] =Indication_array[Offset];
                                        }
                                        Offset++;
                                    }
                                    else if(CacheElements ==TRUE)
                                    {
                                        if(direction ==FORWARD && shift==FALSE)
                                            gCombinedNumbers_Pos[current_element] =startelement+j;
                                        
                                        else if(direction ==FORWARD && shift==TRUE)
                                            gCombinedNumbers_Pos[current_element] =startelement+j+1;

                                        else if(direction ==BACKWARD && shift==FALSE)
                                            gCombinedNumbers_Pos[current_element] =startelement-j;
                                        
                                        else if((direction ==BACKWARD) && (shift==TRUE) && (startelement !=0))
                                            gCombinedNumbers_Pos[current_element] =startelement-j-1;  
                                    }

                                    //TelNumber
                                    if(CacheElements ==TRUE)
                                    {
                                        for(i=0; i<TEL_COMBINEDNUMBERS_TELNUMBER_LENGTH;i++) //clear
			                                gCombinedNumbers_TelNumber[current_element][i] =0; 
                                    }
                                         
                                    length =Indication_array[Offset];
                                    Offset++;
                                    
                                    for(i=0; i<length;i++) //copy data
                                    {   
                                        if(CacheElements ==TRUE)
                                            gCombinedNumbers_TelNumber[current_element][i] =Indication_array[Offset];
                                        Offset++;
                                    }
                                    
                                    //Day
                                    if(CacheElements ==TRUE)
                                    {
                                        gCombinedNumbers_day[current_element] =Indication_array[Offset];
                                        Offset++;
                                    }

                                    //Month
                                    if(CacheElements ==TRUE)
                                    {
                                        gCombinedNumbers_month[current_element] =Indication_array[Offset];
                                        Offset++;
                                    }

                                    //Year
                                    if(CacheElements ==TRUE)
                                    {
                                        gCombinedNumbers_year[current_element] =Indication_array[Offset];
                                        Offset++;
                                    }

                                    //Hour
                                    if(CacheElements ==TRUE)
                                    {
                                        gCombinedNumbers_hour[current_element] =Indication_array[Offset];
                                        Offset++;
                                    }

                                    //Minute
                                    if(CacheElements ==TRUE)
                                    {
                                        gCombinedNumbers_minute[current_element] =Indication_array[Offset];
                                        Offset++;
                                    }

                                    //Second
                                    if(CacheElements ==TRUE)
                                    {
                                        gCombinedNumbers_second[current_element] =Indication_array[Offset];
                                        Offset++;
                                    }
                                    
                                    if(CacheElements ==TRUE)                                   
                                        gCombinedNumbers_ListEntryReceptionInformation [current_element] =TRUE;
                                    
                                    if(CacheElements ==TRUE)    
                                        current_element =CombinedNumbers_GetNextLineInCache (current_element, direction); //go on with next element       
                                }   //copy data of current element finished
                            }       //copy of elements finished
                        }
                        
                     break; //recordaddress =2 ends
                    
                    case 15: //recordaddress =0xf -> Pos
                        /***startelement ==0***/                        
                        if(0==startelement && gCombinedNumbers_ListHandlingType ==TEL_COMBINEDNUMBERS_BUILDUPCACHE)
                        {     
                            /***find "start line" in ASG cache***/
                            if(FORWARD ==direction)
                            {    
                                if (gCombinedNumbers_cacheDown)
                                {   
                                    current_element         =5; //it's the Pos of last element in ASG cache
                                    
                                    //reset "sliding window" values
                                    gCombinedNumbers_cacheDown         =FALSE;
                                }
                                else
                                    current_element =startelement;
                                    
                                if (shift ==TRUE) //startelement not next element
                                    current_element =CombinedNumbers_GetNextLineInCache (current_element, direction);   
                            }
                            
                            else if(BACKWARD ==direction && shift==TRUE)
                            {
                                if(gCombinedNumbers_cacheUp)
                                {   
                                    current_element         =6; //it's the Pos of first element in ASG cache
                                    
                                    //reset "sliding window" values
                                        gCombinedNumbers_cacheUp           =FALSE;
                                }
                                else 
                                    current_element =TEL_COMBINEDNUMBERS_ASGCACHE_MAX_SIZE -1; // position of last element in array 
                            }                
                                
                            /***copy elements***/
                            if (current_element !=TEL_COMBINEDNUMBERS_NO_NEXT_POSITION) 
                            {
                                for (j=0; j<elements;j++) //copy elements
                                {   
                                    //check, if elements must be cached and in case find position in array
                                    CacheElements =FALSE;
                                    for (i=0; i<TEL_COMBINEDNUMBERS_ASGCACHE_MAX_SIZE; i++)
                                    {  
                                        //if element already cached, find position in ASG-cache
                                        if(indexsize ==FALSE && (transmitpos ==TRUE) && Indication_array[Offset] ==gCombinedNumbers_Pos[i] && gCombinedNumbers_ListEntryReceptionInformation[i] ==TRUE)
                                        {   
                                            current_element =i; 
                                            CacheElements   =TRUE;
                                        }
                                        else if((indexsize ==TRUE && (transmitpos ==TRUE) && (Indication_array[Offset] +(Indication_array[Offset+1]*0x100)) ==gCombinedNumbers_Pos[i] && gCombinedNumbers_ListEntryReceptionInformation[i] ==TRUE))
                                        {   
                                            current_element =i; 
                                            CacheElements   =TRUE;
                                        }
                                        //if not already cached, then store element only, if Cache is build-up!
                                        else if((gCombinedNumbers_ListHandlingType !=TEL_COMBINEDNUMBERS_NOCACHE))
                                            CacheElements   =TRUE;
                                    }
                                                                       
                                    if (transmitpos)
                                    {   
                                        if(CacheElements ==TRUE)
                                        {   
                                            if(indexsize)
                                            {    
                                                gCombinedNumbers_Pos[current_element] =Indication_array[Offset];
                                                Offset++;
                                                gCombinedNumbers_Pos[current_element] +=Indication_array[Offset] *0x100;
                                            }
                                            else
                                                gCombinedNumbers_Pos[current_element] =Indication_array[Offset]; 
                                        }
                                        Offset++;
                                    }
                                    else if(CacheElements ==TRUE)
                                    {
                                        if(direction ==FORWARD && shift==FALSE)
                                            gCombinedNumbers_Pos[current_element] =startelement+j;
                                        
                                        else if(direction ==FORWARD && shift==TRUE)
                                            gCombinedNumbers_Pos[current_element] =startelement+j+1;

                                        else if(direction ==BACKWARD && shift==FALSE)
                                            gCombinedNumbers_Pos[current_element] =startelement-j;
                                        
                                        else if((direction ==BACKWARD) && (shift==TRUE) && (startelement !=0))
                                            gCombinedNumbers_Pos[current_element] =startelement-j-1;  
                                    }
                                    
                                    if(CacheElements ==TRUE)                                    
                                        gCombinedNumbers_ListEntryReceptionInformation [current_element] =TRUE;
                                                       
                                    current_element =CombinedNumbers_GetNextLineInCache (current_element, direction); //go on with next element     
                                }   //copy data of current element finished
                            } //copy of elements finished       
                        } //startelement=0 ends
    
                        /***startelement !=0***/
                        else //if (((startelement !=0) && (gCombinedNumbers_ListHandlingType ==TEL_COMBINEDNUMBERS_BUILDUPCACHE)) || ((startelement ==0) && (gCombinedNumbers_ListHandlingType !=TEL_COMBINEDNUMBERS_BUILDUPCACHE))) //startelement !=0
                        {
                            //searching for valid startelement in stored list
					        for(i=0;i<TEL_COMBINEDNUMBERS_ASGCACHE_MAX_SIZE;i++)
					        {
						        if(gCombinedNumbers_Pos[i] ==startelement)				//found a valid element
						        {                                                                                  
                                    current_element     =i;                         //found element is valid_startelement
						            StartElementInCache =TRUE;
                                    i                   =TEL_COMBINEDNUMBERS_ASGCACHE_MAX_SIZE;
                                }
					        }
                            if (StartElementInCache)
                            {   
                                if (shift ==TRUE && startelement!=0) //first array element is next element
                                    current_element =CombinedNumbers_GetNextLineInCache (current_element, direction);                 
                                else if(shift ==TRUE && startelement==0 && direction ==FORWARD)
                                    current_element=5;
                                   
                                for (j=0; j<elements;j++) //copy elements
                                {
                                    if(current_element !=TEL_COMBINEDNUMBERS_NO_NEXT_POSITION)
                                    {
                                        CacheElements =TRUE;
                                        //if element already exist in ASG-cache, search the position 
                                        for (i=0; i<TEL_COMBINEDNUMBERS_ASGCACHE_MAX_SIZE; i++)
                                        {   
                                            if((transmitpos ==TRUE) && gCombinedNumbers_ListEntryReceptionInformation[i] ==TRUE)
                                            {   
                                                startelement_check =0;
                                                if(indexsize)
                                                    startelement_check =Indication_array[Offset] +(Indication_array[Offset+1]*0x100); 
                                                else
                                                    startelement_check =Indication_array[Offset];
                                               
                                                if(startelement_check ==gCombinedNumbers_Pos[i])
                                                {   
                                                    current_element =i; 
                                                    CacheElements   =TRUE;
                                                }
                                                startelement_check=0;
                                            }  
                                        }
                                    }
                                    else
                                        CacheElements =FALSE;
                                        
                                    if (transmitpos)
                                    {   
                                        if(CacheElements ==TRUE)
                                        {   
                                            if(indexsize)
                                            {    
                                                gCombinedNumbers_Pos[current_element] =Indication_array[Offset];
                                                Offset++;
                                                gCombinedNumbers_Pos[current_element] +=Indication_array[Offset] *0x100;
                                            }
                                            else
                                                gCombinedNumbers_Pos[current_element] =Indication_array[Offset];
                                        }
                                        Offset++;
                                    }
                                    else if(CacheElements ==TRUE)
                                    {
                                        if(direction ==FORWARD && shift==FALSE)
                                            gCombinedNumbers_Pos[current_element] =startelement+j;
                                        
                                        else if(direction ==FORWARD && shift==TRUE)
                                            gCombinedNumbers_Pos[current_element] =startelement+j+1;

                                        else if(direction ==BACKWARD && shift==FALSE)
                                            gCombinedNumbers_Pos[current_element] =startelement-j;
                                        
                                        else if((direction ==BACKWARD) && (shift==TRUE) && (startelement !=0))
                                            gCombinedNumbers_Pos[current_element] =startelement-j-1;  
                                    }
                                    
                                    
                                    if(CacheElements ==TRUE)                                   
                                        gCombinedNumbers_ListEntryReceptionInformation [current_element] =TRUE;
                                    
                                    if(CacheElements ==TRUE)    
                                        current_element =CombinedNumbers_GetNextLineInCache (current_element, direction); //go on with next element       
                                }   //copy data of current element finished
                            }       //copy of elements finished
                        }
                        
                     break; //recordaddress =0xf ends
                }
                                   
                //Panel
                putvalue(env_ASG_CN_ASGID, gCombinedNumbers_ASGID);
                putvalue(env_ASG_CN_TAID, gCombinedNumbers_TAID);
                putvalue(env_ASG_CN_TotalNumLE, gCombinedNumbers_TotalNumListElements);

                gCombinedNumbers_recordaddress =recordaddress;
                gCombinedNumbers_transmitpos   =transmitpos;             
            
			break;
            
            case Changed_IND:
                //get data  
                /***ArrayHeader***/
                mode            =(Indication_array[3] &0xF0) /0x10;
                recordaddress   =Indication_array[3] &0x0F;
                Offset =4;
                
                // decode "mode-byte"
                shift       =mode &0x01;
                direction   =(mode &0x02)/0x02;
                transmitpos =(mode &0x04)/0x04;
                indexsize   =(mode &0x08)/0x08; 

                if (indexsize)
                {   
                    startelement =Indication_array[Offset];
                    Offset++;
                    startelement +=(Indication_array[Offset] *0x100);
                    Offset++;

                    elements =Indication_array[Offset];
                    Offset++;
                    elements +=(Indication_array[Offset] *0x100);
                    Offset++;
                }
                else
                {   
                    startelement =Indication_array[Offset];
                    Offset++;

                    elements =Indication_array[Offset];
                    Offset++;
                }           
            
                if(startelement !=0)
                {
                    for (i=0;i<TEL_COMBINEDNUMBERS_ASGCACHE_MAX_SIZE;i++)
                    {
                        if(startelement ==gCombinedNumbers_Pos[i])  
                            i =TEL_COMBINEDNUMBERS_ASGCACHE_MAX_SIZE;              
                    }
                }                   

                if(datalength>0x8) // if ChangedArray includes data
                {
                    switch (recordaddress)
                    {
                        case 0: //recordaddress =0 -> complete record

                            /***startelement ==0***/                        
                            if(0==startelement && gCombinedNumbers_ListHandlingType ==TEL_COMBINEDNUMBERS_BUILDUPCACHE)
                            {     
                                /***find "start line" in ASG cache***/
                                if(FORWARD ==direction)
                                {    
                                    if (gCombinedNumbers_cacheDown)
                                    {   
                                        current_element         =5; //it's the Pos of last element in ASG cache
                                    
                                        //reset "sliding window" values
                                        gCombinedNumbers_cacheDown         =FALSE;
                                    }
                                    else
                                        current_element =startelement;
                                    
                                    if (shift ==TRUE) //startelement not next element
                                        current_element =CombinedNumbers_GetNextLineInCache (current_element, direction);   
                                }
                            
                                else if(BACKWARD ==direction && shift==TRUE)
                                {
                                    if(gCombinedNumbers_cacheUp)
                                    {   
                                        current_element         =6; //it's the Pos of first element in ASG cache
                                    
                                        //reset "sliding window" values
                                            gCombinedNumbers_cacheUp           =FALSE;
                                    }
                                    else 
                                        current_element =TEL_COMBINEDNUMBERS_ASGCACHE_MAX_SIZE -1; // position of last element in array 
                                }                
                                
                                /***copy elements***/
                                if (current_element !=TEL_COMBINEDNUMBERS_NO_NEXT_POSITION) 
                                {
                                    for (j=0; j<elements;j++) //copy elements
                                    {   
                                        //check, if elements must be cached and in case find position in array
                                        CacheElements =FALSE;
                                        for (i=0; i<TEL_COMBINEDNUMBERS_ASGCACHE_MAX_SIZE; i++)
                                        {  
                                            //if element already cached, find position in ASG-cache
                                            if(indexsize ==FALSE && (transmitpos ==TRUE) && Indication_array[Offset] ==gCombinedNumbers_Pos[i] && gCombinedNumbers_ListEntryReceptionInformation[i] ==TRUE)
                                            {   
                                                current_element =i; 
                                                CacheElements   =TRUE;
                                            }
                                            else if((indexsize ==TRUE && (transmitpos ==TRUE) && (Indication_array[Offset] +(Indication_array[Offset+1]*0x100)) ==gCombinedNumbers_Pos[i] && gCombinedNumbers_ListEntryReceptionInformation[i] ==TRUE))
                                            {   
                                                current_element =i; 
                                                CacheElements   =TRUE;
                                            }
                                            //if not already cached, then store element only, if Cache is build-up!
                                            else if((gCombinedNumbers_ListHandlingType !=TEL_COMBINEDNUMBERS_NOCACHE))
                                                CacheElements   =TRUE;
                                        }
                                                                       
                                        if (transmitpos)
                                        {   
                                            if(CacheElements ==TRUE)
                                            {   
                                                if(indexsize)
                                                {    
                                                    gCombinedNumbers_Pos[current_element] =Indication_array[Offset];
                                                    Offset++;
                                                    gCombinedNumbers_Pos[current_element] +=Indication_array[Offset] *0x100;
                                                }
                                                else
                                                    gCombinedNumbers_Pos[current_element] =Indication_array[Offset]; 
                                            }
                                            Offset++;
                                        }
                                    
                                        //PbName
                                        if(CacheElements ==TRUE)
                                        {
                                            for(i=0; i<TEL_COMBINEDNUMBERS_PBNAME_LENGTH;i++) //clear
			                                    gCombinedNumbers_PbName[current_element][i] =0; 
                                        }
                                         
                                        length =Indication_array[Offset];
                                        Offset++;
                                    
                                        for(i=0; i<length;i++) //copy data
                                        {   
                                            if(CacheElements ==TRUE)
                                                gCombinedNumbers_PbName[current_element][i] =Indication_array[Offset];
                                            Offset++;
                                        }
                                    
                                        //CallMode
                                        if(CacheElements ==TRUE)
                                        {
                                            gCombinedNumbers_CallMode[current_element] =Indication_array[Offset];
                                            Offset++;
                                        }

                                        //TelNumber
                                        if(CacheElements ==TRUE)
                                        {
                                            for(i=0; i<TEL_COMBINEDNUMBERS_TELNUMBER_LENGTH;i++) //clear
			                                    gCombinedNumbers_TelNumber[current_element][i] =0; 
                                        }
                                         
                                        length =Indication_array[Offset];
                                        Offset++;
                                    
                                        for(i=0; i<length;i++) //copy data
                                        {   
                                            if(CacheElements ==TRUE)
                                                gCombinedNumbers_TelNumber[current_element][i] =Indication_array[Offset];
                                            Offset++;
                                        }
                                    
                                        //Day
                                        if(CacheElements ==TRUE)
                                        {
                                            gCombinedNumbers_day[current_element] =Indication_array[Offset];
                                            Offset++;
                                        }

                                        //Month
                                        if(CacheElements ==TRUE)
                                        {
                                            gCombinedNumbers_month[current_element] =Indication_array[Offset];
                                            Offset++;
                                        }

                                        //Year
                                        if(CacheElements ==TRUE)
                                        {
                                            gCombinedNumbers_year[current_element] =Indication_array[Offset];
                                            Offset++;
                                        }

                                        //Hour
                                        if(CacheElements ==TRUE)
                                        {
                                            gCombinedNumbers_hour[current_element] =Indication_array[Offset];
                                            Offset++;
                                        }

                                        //Minute
                                        if(CacheElements ==TRUE)
                                        {
                                            gCombinedNumbers_minute[current_element] =Indication_array[Offset];
                                            Offset++;
                                        }

                                        //Second
                                        if(CacheElements ==TRUE)
                                        {
                                            gCombinedNumbers_second[current_element] =Indication_array[Offset];
                                            Offset++;
                                        }
                                    
                                        if(CacheElements ==TRUE)                                    
                                            gCombinedNumbers_ListEntryReceptionInformation [current_element] =TRUE;
                                                       
                                        current_element =CombinedNumbers_GetNextLineInCache (current_element, direction); //go on with next element     
                                    }   //copy data of current element finished
                                } //copy of elements finished       
                            } //startelement=0 ends
    
                            /***startelement !=0***/
                            else //if (((startelement !=0) && (gCombinedNumbers_ListHandlingType ==TEL_COMBINEDNUMBERS_BUILDUPCACHE)) || ((startelement ==0) && (gCombinedNumbers_ListHandlingType !=TEL_COMBINEDNUMBERS_BUILDUPCACHE))) //startelement !=0
                            {
                                //searching for valid startelement in stored list
					            for(i=0;i<TEL_COMBINEDNUMBERS_ASGCACHE_MAX_SIZE;i++)
					            {
						            if(gCombinedNumbers_Pos[i] ==startelement)				//found a valid element
						            {                                                                                  
                                        current_element     =i;                         //found element is valid_startelement
						                StartElementInCache =TRUE;
                                        i                   =TEL_COMBINEDNUMBERS_ASGCACHE_MAX_SIZE;
                                    }
					            }
                                if (StartElementInCache)
                                {   
                                    if (shift ==TRUE && startelement!=0) //first array element is next element
                                        current_element =CombinedNumbers_GetNextLineInCache (current_element, direction);                 
                                    else if(shift ==TRUE && startelement==0 && direction ==FORWARD)
                                        current_element=5;
                                   
                                    for (j=0; j<elements;j++) //copy elements
                                    {
                                        if(current_element !=TEL_COMBINEDNUMBERS_NO_NEXT_POSITION)
                                        {
                                            CacheElements =TRUE;
                                            //if element already exist in ASG-cache, search the position 
                                            for (i=0; i<TEL_COMBINEDNUMBERS_ASGCACHE_MAX_SIZE; i++)
                                            {   
                                                if((transmitpos ==TRUE) && gCombinedNumbers_ListEntryReceptionInformation[i] ==TRUE)
                                                {   
                                                    startelement_check =0;
                                                    if(indexsize)
                                                        startelement_check =Indication_array[Offset] +(Indication_array[Offset+1]*0x100); 
                                                    else
                                                        startelement_check =Indication_array[Offset];
                                               
                                                    if(startelement_check ==gCombinedNumbers_Pos[i])
                                                    {   
                                                        current_element =i; 
                                                        CacheElements   =TRUE;
                                                    }
                                                    startelement_check=0;
                                                }  
                                            }
                                        }
                                        else
                                            CacheElements =FALSE;
                                        
                                        if (transmitpos)
                                        {   
                                            if(CacheElements ==TRUE)
                                            {   
                                                if(indexsize)
                                                {    
                                                    gCombinedNumbers_Pos[current_element] =Indication_array[Offset];
                                                    Offset++;
                                                    gCombinedNumbers_Pos[current_element] +=Indication_array[Offset] *0x100;
                                                }
                                                else
                                                    gCombinedNumbers_Pos[current_element] =Indication_array[Offset];
                                            }
                                            Offset++;
                                        }
                                    
                                        //PbName
                                        if(CacheElements ==TRUE)
                                        {
                                            for(i=0; i<TEL_COMBINEDNUMBERS_PBNAME_LENGTH;i++) //clear
			                                    gCombinedNumbers_PbName[current_element][i] =0; 
                                        }
                                         
                                        length =Indication_array[Offset];
                                        Offset++;
                                    
                                        for(i=0; i<length;i++) //copy data
                                        {   
                                            if(CacheElements ==TRUE)
                                                gCombinedNumbers_PbName[current_element][i] =Indication_array[Offset];
                                            Offset++;
                                        }
                                    
                                        //CallMode
                                        if(CacheElements ==TRUE)
                                        {
                                            gCombinedNumbers_CallMode[current_element] =Indication_array[Offset];
                                            Offset++;
                                        }

                                        //TelNumber
                                        if(CacheElements ==TRUE)
                                        {
                                            for(i=0; i<TEL_COMBINEDNUMBERS_TELNUMBER_LENGTH;i++) //clear
			                                    gCombinedNumbers_TelNumber[current_element][i] =0; 
                                        }
                                         
                                        length =Indication_array[Offset];
                                        Offset++;
                                    
                                        for(i=0; i<length;i++) //copy data
                                        {   
                                            if(CacheElements ==TRUE)
                                                gCombinedNumbers_TelNumber[current_element][i] =Indication_array[Offset];
                                            Offset++;
                                        }
                                    
                                        //Day
                                        if(CacheElements ==TRUE)
                                        {
                                            gCombinedNumbers_day[current_element] =Indication_array[Offset];
                                            Offset++;
                                        }

                                        //Month
                                        if(CacheElements ==TRUE)
                                        {
                                            gCombinedNumbers_month[current_element] =Indication_array[Offset];
                                            Offset++;
                                        }

                                        //Year
                                        if(CacheElements ==TRUE)
                                        {
                                            gCombinedNumbers_year[current_element] =Indication_array[Offset];
                                            Offset++;
                                        }

                                        //Hour
                                        if(CacheElements ==TRUE)
                                        {
                                            gCombinedNumbers_hour[current_element] =Indication_array[Offset];
                                            Offset++;
                                        }

                                        //Minute
                                        if(CacheElements ==TRUE)
                                        {
                                            gCombinedNumbers_minute[current_element] =Indication_array[Offset];
                                            Offset++;
                                        }

                                        //Second
                                        if(CacheElements ==TRUE)
                                        {
                                            gCombinedNumbers_second[current_element] =Indication_array[Offset];
                                            Offset++;
                                        }
                                    
                                        if(CacheElements ==TRUE)                                   
                                            gCombinedNumbers_ListEntryReceptionInformation [current_element] =TRUE;
                                    
                                        if(CacheElements ==TRUE)    
                                            current_element =CombinedNumbers_GetNextLineInCache (current_element, direction); //go on with next element       
                                    }   //copy data of current element finished
                                }       //copy of elements finished
                            }           //startelement !=0 ends
                        
                        break; //recordaddress =0 ends
                    
                        case 1: //recordaddress =1 -> PbName, CallMode
                                /***startelement ==0***/                        
                            if(0==startelement && gCombinedNumbers_ListHandlingType ==TEL_COMBINEDNUMBERS_BUILDUPCACHE)
                            {     
                                /***find "start line" in ASG cache***/
                                if(FORWARD ==direction)
                                {    
                                    if (gCombinedNumbers_cacheDown)
                                    {   
                                        current_element         =5; //it's the Pos of last element in ASG cache
                                    
                                        //reset "sliding window" values
                                        gCombinedNumbers_cacheDown         =FALSE;
                                    }
                                    else
                                        current_element =startelement;
                                    
                                    if (shift ==TRUE) //startelement not next element
                                        current_element =CombinedNumbers_GetNextLineInCache (current_element, direction);   
                                }   
                            
                                else if(BACKWARD ==direction && shift==TRUE)
                                {
                                    if(gCombinedNumbers_cacheUp)
                                    {   
                                        current_element         =6; //it's the Pos of first element in ASG cache
                                    
                                        //reset "sliding window" values
                                            gCombinedNumbers_cacheUp           =FALSE;
                                    }
                                    else 
                                        current_element =TEL_COMBINEDNUMBERS_ASGCACHE_MAX_SIZE -1; // position of last element in array 
                                }                
                                
                                /***copy elements***/
                                if (current_element !=TEL_COMBINEDNUMBERS_NO_NEXT_POSITION) 
                                {
                                    for (j=0; j<elements;j++) //copy elements
                                    {   
                                        //check, if elements must be cached and in case find position in array
                                        CacheElements =FALSE;
                                        for (i=0; i<TEL_COMBINEDNUMBERS_ASGCACHE_MAX_SIZE; i++)
                                        {  
                                            //if element already cached, find position in ASG-cache
                                            if(indexsize ==FALSE && (transmitpos ==TRUE) && Indication_array[Offset] ==gCombinedNumbers_Pos[i] && gCombinedNumbers_ListEntryReceptionInformation[i] ==TRUE)
                                            {   
                                                current_element =i; 
                                                CacheElements   =TRUE;
                                            }
                                            else if((indexsize ==TRUE && (transmitpos ==TRUE) && (Indication_array[Offset] +(Indication_array[Offset+1]*0x100)) ==gCombinedNumbers_Pos[i] && gCombinedNumbers_ListEntryReceptionInformation[i] ==TRUE))
                                            {   
                                                current_element =i; 
                                                CacheElements   =TRUE;
                                            }
                                            //if not already cached, then store element only, if Cache is build-up!
                                            else if((gCombinedNumbers_ListHandlingType !=TEL_COMBINEDNUMBERS_NOCACHE))
                                                CacheElements   =TRUE;
                                        }
                                                                       
                                        if (transmitpos)
                                        {   
                                            if(CacheElements ==TRUE)
                                            {   
                                                if(indexsize)
                                                {    
                                                    gCombinedNumbers_Pos[current_element] =Indication_array[Offset];
                                                    Offset++;
                                                    gCombinedNumbers_Pos[current_element] +=Indication_array[Offset] *0x100;
                                                }
                                                else
                                                    gCombinedNumbers_Pos[current_element] =Indication_array[Offset]; 
                                            }
                                            Offset++;
                                        }
                                    
                                        //PbName
                                        if(CacheElements ==TRUE)
                                        {
                                            for(i=0; i<TEL_COMBINEDNUMBERS_PBNAME_LENGTH;i++) //clear
			                                    gCombinedNumbers_PbName[current_element][i] =0; 
                                        }
                                         
                                        length =Indication_array[Offset];
                                        Offset++;
                                    
                                        for(i=0; i<length;i++) //copy data
                                        {   
                                            if(CacheElements ==TRUE)
                                                gCombinedNumbers_PbName[current_element][i] =Indication_array[Offset];
                                            Offset++;
                                        }
                                    
                                        //CallMode
                                        if(CacheElements ==TRUE)
                                        {
                                            gCombinedNumbers_CallMode[current_element] =Indication_array[Offset];
                                            Offset++;
                                        }
                                    
                                        if(CacheElements ==TRUE)                                    
                                            gCombinedNumbers_ListEntryReceptionInformation [current_element] =TRUE;
                                                       
                                        current_element =CombinedNumbers_GetNextLineInCache (current_element, direction); //go on with next element     
                                    }   //copy data of current element finished
                                } //copy of elements finished       
                            } //startelement=0 ends
    
                            /***startelement !=0***/
                            else //if (((startelement !=0) && (gCombinedNumbers_ListHandlingType ==TEL_COMBINEDNUMBERS_BUILDUPCACHE)) || ((startelement ==0) && (gCombinedNumbers_ListHandlingType !=TEL_COMBINEDNUMBERS_BUILDUPCACHE))) //startelement !=0
                            {
                                //searching for valid startelement in stored list
					            for(i=0;i<TEL_COMBINEDNUMBERS_ASGCACHE_MAX_SIZE;i++)
					            {
						            if(gCombinedNumbers_Pos[i] ==startelement)				//found a valid element
						            {                                                                                  
                                        current_element     =i;                         //found element is valid_startelement
						                StartElementInCache =TRUE;
                                        i                   =TEL_COMBINEDNUMBERS_ASGCACHE_MAX_SIZE;
                                    }
					            }
                                if (StartElementInCache)
                                {   
                                    if (shift ==TRUE && startelement!=0) //first array element is next element
                                        current_element =CombinedNumbers_GetNextLineInCache (current_element, direction);                 
                                    else if(shift ==TRUE && startelement==0 && direction ==FORWARD)
                                        current_element=5;
                                   
                                    for (j=0; j<elements;j++) //copy elements
                                    {
                                        if(current_element !=TEL_COMBINEDNUMBERS_NO_NEXT_POSITION)
                                        {
                                            CacheElements =TRUE;
                                            //if element already exist in ASG-cache, search the position 
                                            for (i=0; i<TEL_COMBINEDNUMBERS_ASGCACHE_MAX_SIZE; i++)
                                            {   
                                                if((transmitpos ==TRUE) && gCombinedNumbers_ListEntryReceptionInformation[i] ==TRUE)
                                                {   
                                                    startelement_check =0;
                                                    if(indexsize)
                                                        startelement_check =Indication_array[Offset] +(Indication_array[Offset+1]*0x100); 
                                                    else
                                                        startelement_check =Indication_array[Offset];
                                               
                                                    if(startelement_check ==gCombinedNumbers_Pos[i])
                                                    {   
                                                        current_element =i; 
                                                        CacheElements   =TRUE;
                                                    }
                                                    startelement_check=0;
                                                }  
                                            }
                                        }
                                        else
                                            CacheElements =FALSE;
                                        
                                        if (transmitpos)
                                        {   
                                            if(CacheElements ==TRUE)
                                            {   
                                                if(indexsize)
                                                {    
                                                    gCombinedNumbers_Pos[current_element] =Indication_array[Offset];
                                                    Offset++;
                                                    gCombinedNumbers_Pos[current_element] +=Indication_array[Offset] *0x100;
                                                }
                                                else
                                                    gCombinedNumbers_Pos[current_element] =Indication_array[Offset];
                                            }
                                            Offset++;
                                        }
                                    
                                        //PbName
                                        if(CacheElements ==TRUE)
                                        {
                                            for(i=0; i<TEL_COMBINEDNUMBERS_PBNAME_LENGTH;i++) //clear
			                                    gCombinedNumbers_PbName[current_element][i] =0; 
                                        }
                                         
                                        length =Indication_array[Offset];
                                        Offset++;
                                    
                                        for(i=0; i<length;i++) //copy data
                                        {   
                                            if(CacheElements ==TRUE)
                                                gCombinedNumbers_PbName[current_element][i] =Indication_array[Offset];
                                            Offset++;
                                        }
                                    
                                        //CallMode
                                        if(CacheElements ==TRUE)
                                        {
                                            gCombinedNumbers_CallMode[current_element] =Indication_array[Offset];
                                            Offset++;
                                        }
                                    
                                        if(CacheElements ==TRUE)                                   
                                            gCombinedNumbers_ListEntryReceptionInformation [current_element] =TRUE;
                                    
                                        if(CacheElements ==TRUE)    
                                            current_element =CombinedNumbers_GetNextLineInCache (current_element, direction); //go on with next element       
                                    }   //copy data of current element finished
                                }       //copy of elements finished
                            }           //startelement !=0 ends   
                        break; //recordaddress =1 ends
                    
                        case 2: //recordaddress =2 -> TelNumber, Day, Month, Year, Hour, Minute, Second
                            /***startelement ==0***/                        
                            if(0==startelement && gCombinedNumbers_ListHandlingType ==TEL_COMBINEDNUMBERS_BUILDUPCACHE)
                            {     
                                /***find "start line" in ASG cache***/
                                if(FORWARD ==direction)
                                {    
                                    if (gCombinedNumbers_cacheDown)
                                    {   
                                        current_element         =5; //it's the Pos of last element in ASG cache
                                    
                                        //reset "sliding window" values
                                        gCombinedNumbers_cacheDown         =FALSE;
                                    }
                                    else
                                        current_element =startelement;
                                    
                                    if (shift ==TRUE) //startelement not next element
                                        current_element =CombinedNumbers_GetNextLineInCache (current_element, direction);   
                                }
                            
                                else if(BACKWARD ==direction && shift==TRUE)
                                {
                                    if(gCombinedNumbers_cacheUp)
                                    {   
                                        current_element         =6; //it's the Pos of first element in ASG cache
                                    
                                        //reset "sliding window" values
                                            gCombinedNumbers_cacheUp           =FALSE;
                                    }
                                    else 
                                        current_element =TEL_COMBINEDNUMBERS_ASGCACHE_MAX_SIZE -1; // position of last element in array 
                                }                
                                
                                /***copy elements***/
                                if (current_element !=TEL_COMBINEDNUMBERS_NO_NEXT_POSITION) 
                                {
                                    for (j=0; j<elements;j++) //copy elements
                                    {   
                                        //check, if elements must be cached and in case find position in array
                                        CacheElements =FALSE;
                                        for (i=0; i<TEL_COMBINEDNUMBERS_ASGCACHE_MAX_SIZE; i++)
                                        {  
                                            //if element already cached, find position in ASG-cache
                                            if(indexsize ==FALSE && (transmitpos ==TRUE) && Indication_array[Offset] ==gCombinedNumbers_Pos[i] && gCombinedNumbers_ListEntryReceptionInformation[i] ==TRUE)
                                            {   
                                                current_element =i; 
                                                CacheElements   =TRUE;
                                            }
                                            else if((indexsize ==TRUE && (transmitpos ==TRUE) && (Indication_array[Offset] +(Indication_array[Offset+1]*0x100)) ==gCombinedNumbers_Pos[i] && gCombinedNumbers_ListEntryReceptionInformation[i] ==TRUE))
                                            {   
                                                current_element =i; 
                                                CacheElements   =TRUE;
                                            }
                                            //if not already cached, then store element only, if Cache is build-up!
                                            else if((gCombinedNumbers_ListHandlingType !=TEL_COMBINEDNUMBERS_NOCACHE))
                                                CacheElements   =TRUE;
                                        }
                                                                       
                                        if (transmitpos)
                                        {   
                                            if(CacheElements ==TRUE)
                                            {   
                                                if(indexsize)
                                                {    
                                                    gCombinedNumbers_Pos[current_element] =Indication_array[Offset];
                                                    Offset++;
                                                    gCombinedNumbers_Pos[current_element] +=Indication_array[Offset] *0x100;
                                                }
                                                else
                                                    gCombinedNumbers_Pos[current_element] =Indication_array[Offset]; 
                                            }
                                            Offset++;
                                        }

                                        //TelNumber
                                        if(CacheElements ==TRUE)
                                        {
                                            for(i=0; i<TEL_COMBINEDNUMBERS_TELNUMBER_LENGTH;i++) //clear
			                                    gCombinedNumbers_TelNumber[current_element][i] =0; 
                                        }
                                         
                                        length =Indication_array[Offset];
                                        Offset++;
                                    
                                        for(i=0; i<length;i++) //copy data
                                        {   
                                            if(CacheElements ==TRUE)
                                                gCombinedNumbers_TelNumber[current_element][i] =Indication_array[Offset];
                                            Offset++;
                                        }
                                    
                                        //Day
                                        if(CacheElements ==TRUE)
                                        {
                                            gCombinedNumbers_day[current_element] =Indication_array[Offset];
                                            Offset++;
                                        }

                                        //Month
                                        if(CacheElements ==TRUE)
                                        {
                                            gCombinedNumbers_month[current_element] =Indication_array[Offset];
                                            Offset++;
                                        }

                                        //Year
                                        if(CacheElements ==TRUE)
                                        {
                                            gCombinedNumbers_year[current_element] =Indication_array[Offset];
                                            Offset++;
                                        }

                                        //Hour
                                        if(CacheElements ==TRUE)
                                        {
                                            gCombinedNumbers_hour[current_element] =Indication_array[Offset];
                                            Offset++;
                                        }

                                        //Minute
                                        if(CacheElements ==TRUE)
                                        {
                                            gCombinedNumbers_minute[current_element] =Indication_array[Offset];
                                            Offset++;
                                        }

                                        //Second
                                        if(CacheElements ==TRUE)
                                        {
                                            gCombinedNumbers_second[current_element] =Indication_array[Offset];
                                            Offset++;
                                        }
                                    
                                        if(CacheElements ==TRUE)                                    
                                            gCombinedNumbers_ListEntryReceptionInformation [current_element] =TRUE;
                                                       
                                        current_element =CombinedNumbers_GetNextLineInCache (current_element, direction); //go on with next element     
                                    }   //copy data of current element finished
                                } //copy of elements finished       
                            } //startelement=0 ends
    
                            /***startelement !=0***/
                            else //if (((startelement !=0) && (gCombinedNumbers_ListHandlingType ==TEL_COMBINEDNUMBERS_BUILDUPCACHE)) || ((startelement ==0) && (gCombinedNumbers_ListHandlingType !=TEL_COMBINEDNUMBERS_BUILDUPCACHE))) //startelement !=0
                            {
                                //searching for valid startelement in stored list
					            for(i=0;i<TEL_COMBINEDNUMBERS_ASGCACHE_MAX_SIZE;i++)
					            {
						            if(gCombinedNumbers_Pos[i] ==startelement)				//found a valid element
						            {                                                                                  
                                        current_element     =i;                         //found element is valid_startelement
						                StartElementInCache =TRUE;
                                        i                   =TEL_COMBINEDNUMBERS_ASGCACHE_MAX_SIZE;
                                    }
					            }
                                if (StartElementInCache)
                                {   
                                    if (shift ==TRUE && startelement!=0) //first array element is next element
                                        current_element =CombinedNumbers_GetNextLineInCache (current_element, direction);                 
                                    else if(shift ==TRUE && startelement==0 && direction ==FORWARD)
                                        current_element=5;
                                   
                                    for (j=0; j<elements;j++) //copy elements
                                    {
                                        if(current_element !=TEL_COMBINEDNUMBERS_NO_NEXT_POSITION)
                                        {
                                            CacheElements =TRUE;
                                            //if element already exist in ASG-cache, search the position 
                                            for (i=0; i<TEL_COMBINEDNUMBERS_ASGCACHE_MAX_SIZE; i++)
                                            {   
                                                if((transmitpos ==TRUE) && gCombinedNumbers_ListEntryReceptionInformation[i] ==TRUE)
                                                {   
                                                    startelement_check =0;
                                                    if(indexsize)
                                                        startelement_check =Indication_array[Offset] +(Indication_array[Offset+1]*0x100); 
                                                    else
                                                        startelement_check =Indication_array[Offset];
                                               
                                                    if(startelement_check ==gCombinedNumbers_Pos[i])
                                                    {   
                                                        current_element =i; 
                                                        CacheElements   =TRUE;
                                                    }
                                                    startelement_check=0;
                                                }  
                                            }
                                        }
                                        else
                                            CacheElements =FALSE;
                                        
                                        if (transmitpos)
                                        {   
                                            if(CacheElements ==TRUE)
                                            {   
                                                if(indexsize)
                                                {    
                                                    gCombinedNumbers_Pos[current_element] =Indication_array[Offset];
                                                    Offset++;
                                                    gCombinedNumbers_Pos[current_element] +=Indication_array[Offset] *0x100;
                                                }
                                                else
                                                    gCombinedNumbers_Pos[current_element] =Indication_array[Offset];
                                            }
                                            Offset++;
                                        }
                                    
                                        //TelNumber
                                        if(CacheElements ==TRUE)
                                        {
                                            for(i=0; i<TEL_COMBINEDNUMBERS_TELNUMBER_LENGTH;i++) //clear
			                                    gCombinedNumbers_TelNumber[current_element][i] =0; 
                                        }
                                         
                                        length =Indication_array[Offset];
                                        Offset++;
                                    
                                        for(i=0; i<length;i++) //copy data
                                        {   
                                            if(CacheElements ==TRUE)
                                                gCombinedNumbers_TelNumber[current_element][i] =Indication_array[Offset];
                                            Offset++;
                                        }
                                    
                                        //Day
                                        if(CacheElements ==TRUE)
                                        {
                                            gCombinedNumbers_day[current_element] =Indication_array[Offset];
                                            Offset++;
                                        }

                                        //Month
                                        if(CacheElements ==TRUE)
                                        {
                                            gCombinedNumbers_month[current_element] =Indication_array[Offset];
                                            Offset++;
                                        }

                                        //Year
                                        if(CacheElements ==TRUE)
                                        {
                                            gCombinedNumbers_year[current_element] =Indication_array[Offset];
                                            Offset++;
                                        }

                                        //Hour
                                        if(CacheElements ==TRUE)
                                        {
                                            gCombinedNumbers_hour[current_element] =Indication_array[Offset];
                                            Offset++;
                                        }

                                        //Minute
                                        if(CacheElements ==TRUE)
                                        {
                                            gCombinedNumbers_minute[current_element] =Indication_array[Offset];
                                            Offset++;
                                        }

                                        //Second
                                        if(CacheElements ==TRUE)
                                        {
                                            gCombinedNumbers_second[current_element] =Indication_array[Offset];
                                            Offset++;
                                        }
                                    
                                        if(CacheElements ==TRUE)                                   
                                            gCombinedNumbers_ListEntryReceptionInformation [current_element] =TRUE;
                                    
                                        if(CacheElements ==TRUE)    
                                            current_element =CombinedNumbers_GetNextLineInCache (current_element, direction); //go on with next element       
                                    }   //copy data of current element finished
                                }       //copy of elements finished
                            }           //startelement !=0 ends
                        break; //recordaddress =2 ends
                    
                        case 15: //recordaddress =0xf -> Pos
                            /***startelement ==0***/                        
                            if(0==startelement && gCombinedNumbers_ListHandlingType ==TEL_COMBINEDNUMBERS_BUILDUPCACHE)
                            {     
                                /***find "start line" in ASG cache***/
                                if(FORWARD ==direction)
                                {    
                                    if (gCombinedNumbers_cacheDown)
                                    {   
                                        current_element         =5; //it's the Pos of last element in ASG cache
                                    
                                        //reset "sliding window" values
                                        gCombinedNumbers_cacheDown         =FALSE;
                                    }
                                    else
                                        current_element =startelement;
                                    
                                    if (shift ==TRUE) //startelement not next element
                                        current_element =CombinedNumbers_GetNextLineInCache (current_element, direction);   
                                }
                            
                                else if(BACKWARD ==direction && shift==TRUE)
                                {
                                    if(gCombinedNumbers_cacheUp)
                                    {   
                                        current_element         =6; //it's the Pos of first element in ASG cache
                                    
                                        //reset "sliding window" values
                                            gCombinedNumbers_cacheUp           =FALSE;
                                    }
                                    else 
                                        current_element =TEL_COMBINEDNUMBERS_ASGCACHE_MAX_SIZE -1; // position of last element in array 
                                }                
                                
                                /***copy elements***/
                                if (current_element !=TEL_COMBINEDNUMBERS_NO_NEXT_POSITION) 
                                {
                                    for (j=0; j<elements;j++) //copy elements
                                    {   
                                        //check, if elements must be cached and in case find position in array
                                        CacheElements =FALSE;
                                        for (i=0; i<TEL_COMBINEDNUMBERS_ASGCACHE_MAX_SIZE; i++)
                                        {  
                                            //if element already cached, find position in ASG-cache
                                            if(indexsize ==FALSE && (transmitpos ==TRUE) && Indication_array[Offset] ==gCombinedNumbers_Pos[i] && gCombinedNumbers_ListEntryReceptionInformation[i] ==TRUE)
                                            {   
                                                current_element =i; 
                                                CacheElements   =TRUE;
                                            }
                                            else if((indexsize ==TRUE && (transmitpos ==TRUE) && (Indication_array[Offset] +(Indication_array[Offset+1]*0x100)) ==gCombinedNumbers_Pos[i] && gCombinedNumbers_ListEntryReceptionInformation[i] ==TRUE))
                                            {   
                                                current_element =i; 
                                                CacheElements   =TRUE;
                                            }
                                            //if not already cached, then store element only, if Cache is build-up!
                                            else if((gCombinedNumbers_ListHandlingType !=TEL_COMBINEDNUMBERS_NOCACHE))
                                                CacheElements   =TRUE;
                                        }
                                                                       
                                        if (transmitpos)
                                        {   
                                            if(CacheElements ==TRUE)
                                            {   
                                                if(indexsize)
                                                {    
                                                    gCombinedNumbers_Pos[current_element] =Indication_array[Offset];
                                                    Offset++;
                                                    gCombinedNumbers_Pos[current_element] +=Indication_array[Offset] *0x100;
                                                }
                                                else
                                                    gCombinedNumbers_Pos[current_element] =Indication_array[Offset]; 
                                            }
                                            Offset++;
                                        }
                                    
                                        if(CacheElements ==TRUE)                                    
                                            gCombinedNumbers_ListEntryReceptionInformation [current_element] =TRUE;
                                                       
                                        current_element =CombinedNumbers_GetNextLineInCache (current_element, direction); //go on with next element     
                                    }   //copy data of current element finished
                                } //copy of elements finished       
                            } //startelement=0 ends
    
                            /***startelement !=0***/
                            else //if (((startelement !=0) && (gCombinedNumbers_ListHandlingType ==TEL_COMBINEDNUMBERS_BUILDUPCACHE)) || ((startelement ==0) && (gCombinedNumbers_ListHandlingType !=TEL_COMBINEDNUMBERS_BUILDUPCACHE))) //startelement !=0
                            {
                                //searching for valid startelement in stored list
					            for(i=0;i<TEL_COMBINEDNUMBERS_ASGCACHE_MAX_SIZE;i++)
					            {
						            if(gCombinedNumbers_Pos[i] ==startelement)				//found a valid element
						            {                                                                                  
                                        current_element     =i;                         //found element is valid_startelement
						                StartElementInCache =TRUE;
                                        i                   =TEL_COMBINEDNUMBERS_ASGCACHE_MAX_SIZE;
                                    }
					            }
                                if (StartElementInCache)
                                {   
                                    if (shift ==TRUE && startelement!=0) //first array element is next element
                                        current_element =CombinedNumbers_GetNextLineInCache (current_element, direction);                 
                                    else if(shift ==TRUE && startelement==0 && direction ==FORWARD)
                                        current_element=5;
                                   
                                    for (j=0; j<elements;j++) //copy elements
                                    {
                                        if(current_element !=TEL_COMBINEDNUMBERS_NO_NEXT_POSITION)
                                        {
                                            CacheElements =TRUE;
                                            //if element already exist in ASG-cache, search the position 
                                            for (i=0; i<TEL_COMBINEDNUMBERS_ASGCACHE_MAX_SIZE; i++)
                                            {   
                                                if((transmitpos ==TRUE) && gCombinedNumbers_ListEntryReceptionInformation[i] ==TRUE)
                                                {   
                                                    startelement_check =0;
                                                    if(indexsize)
                                                        startelement_check =Indication_array[Offset] +(Indication_array[Offset+1]*0x100); 
                                                    else
                                                        startelement_check =Indication_array[Offset];
                                               
                                                    if(startelement_check ==gCombinedNumbers_Pos[i])
                                                    {   
                                                        current_element =i; 
                                                        CacheElements   =TRUE;
                                                    }
                                                    startelement_check=0;
                                                }  
                                            }
                                        }
                                        else
                                            CacheElements =FALSE;
                                        
                                        if (transmitpos)
                                        {   
                                            if(CacheElements ==TRUE)
                                            {   
                                                if(indexsize)
                                                {    
                                                    gCombinedNumbers_Pos[current_element] =Indication_array[Offset];
                                                    Offset++;
                                                    gCombinedNumbers_Pos[current_element] +=Indication_array[Offset] *0x100;
                                                }
                                                else
                                                    gCombinedNumbers_Pos[current_element] =Indication_array[Offset];
                                            }
                                            Offset++;
                                        }
                                    
                                        if(CacheElements ==TRUE)                                   
                                            gCombinedNumbers_ListEntryReceptionInformation [current_element] =TRUE;
                                    
                                        if(CacheElements ==TRUE)    
                                            current_element =CombinedNumbers_GetNextLineInCache (current_element, direction); //go on with next element       
                                    }   //copy data of current element finished
                                }       //copy of elements finished
                            }           //startelement !=0 ends
                        break; //recordaddress =0xf ends
                    }
                }
                                   
                gCombinedNumbers_recordaddress =recordaddress;
                gCombinedNumbers_transmitpos   =transmitpos;

                //send StatusArray
                transmitpos =FALSE;
                if(startelement>0xFF)
                    indexsize =TRUE;
                else
                    indexsize =FALSE;
                    
                mode    =shift +(direction*0x02) +(transmitpos*0x04) +indexsize*0x08;
                CombinedNumbers_Request(DataGet_REQ, mode, recordaddress, startelement, startelement, elements);

            break;
			
            case Error_IND:
					
				if(Indication_array[3]<0x20 && Indication_array[3] !=0)				//BCL-error
					writelineEx(gError_Trace, 0, "ASG-Telephone CombinedNumbers_Indication: BCL-Error: 0x%x - %s", Indication_array[3], gerror_codes_BCL [Indication_array[3]-0x10]);
				else if(Indication_array[3]<0x30)			//BPL-error
					writelineEx(gError_Trace, 0, "ASG-Telephone CombinedNumbers_Indication: BPL-Error: 0x%x - %s", Indication_array[3], gerror_codes_BPL [Indication_array[3]-0x20]);				
				else if(Indication_array[3]<0x40)			//BAL-error
					writelineEx(gError_Trace, 0, "ASG-Telephone CombinedNumbers_Indication: BAL-Error: 0x%x - %s", Indication_array[3], gerror_codes_BAL [Indication_array[3]-0x30]);
				else
					writelineEx(gError_Trace, 0, "ASG-Telephone CombinedNumbers_Indication: Application-Error: 0x%x", Indication_array[3]);
				
		break;
		default:
			writelineEx(gError_Trace, 0,"ASG-Telefon CombinedNumbers_Indication: unknown indication %x", gBAP_Indication[2]);
		break;
		}

    //for "sliding window concept"
    if(gBAP_Indication[2] !=Error_IND)
    {
        if(gCombinedNumbers_TotalNumListElements<=TEL_COMBINEDNUMBERS_ASGCACHE_MAX_SIZE)
            gCombinedNumbers_SlidingWindow_State =TEL_COMBINEDNUMBERS_SLIDINGWINDOW_NOTACTIVE;
        else
            gCombinedNumbers_SlidingWindow_State =TEL_COMBINEDNUMBERS_SLIDINGWINDOW_ACTIVE;

        if (gCombinedNumbers_CallBackReason !=TEL_COMBINEDNUMBERS_CALLBACKREASON_NOCALLBACK)
            CombinedNumbers_ListHandling ();
        else
            CombinedNumbers_display();
    }
}
/*@@end*/

/*@@envVar:env_ASG_CN_SetGetArray:*/
on envVar env_ASG_CN_SetGetArray
{
    byte mode, shift, direction, transmitpos, indexsize,recordaddress;
    word requested_startelement, startelement, elements;

    // Init local variables. 
    mode                    =0;
    shift                   =0;
    direction               =0;
    transmitpos             =0;
    indexsize               =0;
    recordaddress           =0;
    requested_startelement  =0;
    startelement            =0;
    elements                =0;

    //write("# on envVar env_ASG_CN_SetGetArray");

    if(gRNS_PowerOnOff==Power_on && getvalue(this) && gCombinedNumbers_ListHandlingType ==TEL_COMBINEDNUMBERS_NOCACHE)
	{
        gCombinedNumbers_ASGID            =getvalue(env_ASG_CN_ASGID);
        gCombinedNumbers_TAID             =getvalue(env_ASG_CN_TAID);

        shift                           =getvalue(env_ASG_CN_AH_shift);
        direction                       =getvalue(env_ASG_CN_AH_dir);
        transmitpos                     =getvalue(env_ASG_CN_AH_PosTrans);
        indexsize                       =getvalue(env_ASG_CN_AH_IS);
        recordaddress                   =getvalue(env_ASG_CN_AH_RA);
        startelement                    =getvalue(env_ASG_CN_AH_start);
        elements                        =getvalue(env_ASG_CN_AH_elements);
        
        requested_startelement  =startelement;
        mode                    =(shift +(direction*0x02) +(transmitpos*0x04) +(indexsize*0x08));

        //write("# recordaddress = %d, requested_startelement = %d, startelement = %d, elements = %d", recordaddress, requested_startelement, startelement, elements);

        CombinedNumbers_Request(DataSetGet_REQ, mode, recordaddress, requested_startelement, startelement, elements);
    }
}
/*@@end*/

/*@@envVar:env_ASG_CN_GetCachedData:*/
on envVar env_ASG_CN_GetCachedData
{
    if(gRNS_PowerOnOff==Power_on && getvalue(this))
        CombinedNumbers_DisplayCache();
        
}
/*@@end*/

/*@@envVar:env_ASG_CN_TakeOver:*/
on envVar env_ASG_CN_TakeOver
{
    if(gRNS_PowerOnOff==Power_on && getvalue(this))
	{
        //upper cache
        if(gCombinedNumbers_ListEntryReceptionInformation[6])
        {
            gCombinedNumbers_Pos[6]         =getvalue(env_ASG_CN_pos_01);
            getvalue(env_ASG_CN_PbName_s_01, gCombinedNumbers_PbName[6]);
            getvalue(env_ASG_CN_TelNum_s_01, gCombinedNumbers_TelNumber[6]);
            gCombinedNumbers_CallMode[6]    =getvalue(env_ASG_CN_CallMode_01);
            gCombinedNumbers_day[6]         =getvalue(env_ASG_CN_day_01);
            gCombinedNumbers_month[6]       =getvalue(env_ASG_CN_month_01);
            gCombinedNumbers_year[6]        =getvalue(env_ASG_CN_year_01);
            gCombinedNumbers_hour[6]        =getvalue(env_ASG_CN_hour_01);
            gCombinedNumbers_minute[6]      =getvalue(env_ASG_CN_minute_01);
            gCombinedNumbers_second[6]      =getvalue(env_ASG_CN_second_01);
        }

        else
        {
            putvalue(env_ASG_CN_pos_01, 0);
            putvalue(env_ASG_CN_PbName_s_01, empty_string);
            putvalue(env_ASG_CN_TelNum_s_01, empty_string);
            putvalue(env_ASG_CN_CallMode_01, 0);
            putvalue(env_ASG_CN_day_01, 0);
            putvalue(env_ASG_CN_month_01, 0);
            putvalue(env_ASG_CN_year_01, 0);
            putvalue(env_ASG_CN_hour_01, 0);
            putvalue(env_ASG_CN_minute_01, 0);
            putvalue(env_ASG_CN_second_01, 0);
        }


        if(gCombinedNumbers_ListEntryReceptionInformation[7])
        {
            gCombinedNumbers_Pos[7]         =getvalue(env_ASG_CN_pos_02);
            getvalue(env_ASG_CN_PbName_s_02, gCombinedNumbers_PbName[7]);
            getvalue(env_ASG_CN_TelNum_s_02, gCombinedNumbers_TelNumber[7]);
            gCombinedNumbers_CallMode[7]    =getvalue(env_ASG_CN_CallMode_02);
            gCombinedNumbers_day[7]         =getvalue(env_ASG_CN_day_02);
            gCombinedNumbers_month[7]       =getvalue(env_ASG_CN_month_02);
            gCombinedNumbers_year[7]        =getvalue(env_ASG_CN_year_02);
            gCombinedNumbers_hour[7]        =getvalue(env_ASG_CN_hour_02);
            gCombinedNumbers_minute[7]      =getvalue(env_ASG_CN_minute_02);
            gCombinedNumbers_second[7]      =getvalue(env_ASG_CN_second_02);
        }

        else
        {
            putvalue(env_ASG_CN_pos_02, 0);
            putvalue(env_ASG_CN_PbName_s_02, empty_string);
            putvalue(env_ASG_CN_TelNum_s_02, empty_string);
            putvalue(env_ASG_CN_CallMode_02, 0);
            putvalue(env_ASG_CN_day_02, 0);
            putvalue(env_ASG_CN_month_02, 0);
            putvalue(env_ASG_CN_year_02, 0);
            putvalue(env_ASG_CN_hour_02, 0);
            putvalue(env_ASG_CN_minute_02, 0);
            putvalue(env_ASG_CN_second_02, 0);
        }


        if(gCombinedNumbers_ListEntryReceptionInformation[8])
        {
            gCombinedNumbers_Pos[8]         =getvalue(env_ASG_CN_pos_03);
            getvalue(env_ASG_CN_PbName_s_03, gCombinedNumbers_PbName[8]);
            getvalue(env_ASG_CN_TelNum_s_03, gCombinedNumbers_TelNumber[8]);
            gCombinedNumbers_CallMode[8]    =getvalue(env_ASG_CN_CallMode_03);
            gCombinedNumbers_day[8]         =getvalue(env_ASG_CN_day_03);
            gCombinedNumbers_month[8]       =getvalue(env_ASG_CN_month_03);
            gCombinedNumbers_year[8]        =getvalue(env_ASG_CN_year_03);
            gCombinedNumbers_hour[8]        =getvalue(env_ASG_CN_hour_03);
            gCombinedNumbers_minute[8]      =getvalue(env_ASG_CN_minute_03);
            gCombinedNumbers_second[8]      =getvalue(env_ASG_CN_second_03);
        }

        else
        {
            putvalue(env_ASG_CN_pos_03, 0);
            putvalue(env_ASG_CN_PbName_s_03, empty_string);
            putvalue(env_ASG_CN_TelNum_s_03, empty_string);
            putvalue(env_ASG_CN_CallMode_03, 0);
            putvalue(env_ASG_CN_day_03, 0);
            putvalue(env_ASG_CN_month_03, 0);
            putvalue(env_ASG_CN_year_03, 0);
            putvalue(env_ASG_CN_hour_03, 0);
            putvalue(env_ASG_CN_minute_03, 0);
            putvalue(env_ASG_CN_second_03, 0);
        }

        
        //display area
        if(gCombinedNumbers_ListEntryReceptionInformation[0])
        {
            gCombinedNumbers_Pos[0]         =getvalue(env_ASG_CN_pos_11);
            getvalue(env_ASG_CN_PbName_s_11, gCombinedNumbers_PbName[0]);
            getvalue(env_ASG_CN_TelNum_s_11, gCombinedNumbers_TelNumber[0]);
            gCombinedNumbers_CallMode[0]    =getvalue(env_ASG_CN_CallMode_11);
            gCombinedNumbers_day[0]         =getvalue(env_ASG_CN_day_11);
            gCombinedNumbers_month[0]       =getvalue(env_ASG_CN_month_11);
            gCombinedNumbers_year[0]        =getvalue(env_ASG_CN_year_11);
            gCombinedNumbers_hour[0]        =getvalue(env_ASG_CN_hour_11);
            gCombinedNumbers_minute[0]      =getvalue(env_ASG_CN_minute_11);
            gCombinedNumbers_second[0]      =getvalue(env_ASG_CN_second_11);
        }

        else
        {
            putvalue(env_ASG_CN_pos_11, 0);
            putvalue(env_ASG_CN_PbName_s_11, empty_string);
            putvalue(env_ASG_CN_TelNum_s_11, empty_string);
            putvalue(env_ASG_CN_CallMode_11, 0);
            putvalue(env_ASG_CN_day_11, 0);
            putvalue(env_ASG_CN_month_11, 0);
            putvalue(env_ASG_CN_year_11, 0);
            putvalue(env_ASG_CN_hour_11, 0);
            putvalue(env_ASG_CN_minute_11, 0);
            putvalue(env_ASG_CN_second_11, 0);
        }


        if(gCombinedNumbers_ListEntryReceptionInformation[1])
        {
            gCombinedNumbers_Pos[1]         =getvalue(env_ASG_CN_pos_12);
            getvalue(env_ASG_CN_PbName_s_12, gCombinedNumbers_PbName[1]);
            getvalue(env_ASG_CN_TelNum_s_12, gCombinedNumbers_TelNumber[1]);
            gCombinedNumbers_CallMode[1]    =getvalue(env_ASG_CN_CallMode_12);
            gCombinedNumbers_day[1]         =getvalue(env_ASG_CN_day_12);
            gCombinedNumbers_month[1]       =getvalue(env_ASG_CN_month_12);
            gCombinedNumbers_year[1]        =getvalue(env_ASG_CN_year_12);
            gCombinedNumbers_hour[1]        =getvalue(env_ASG_CN_hour_12);
            gCombinedNumbers_minute[1]      =getvalue(env_ASG_CN_minute_12);
            gCombinedNumbers_second[1]      =getvalue(env_ASG_CN_second_12);
        }

        else
        {
            putvalue(env_ASG_CN_pos_12, 0);
            putvalue(env_ASG_CN_PbName_s_12, empty_string);
            putvalue(env_ASG_CN_TelNum_s_12, empty_string);
            putvalue(env_ASG_CN_CallMode_12, 0);
            putvalue(env_ASG_CN_day_12, 0);
            putvalue(env_ASG_CN_month_12, 0);
            putvalue(env_ASG_CN_year_12, 0);
            putvalue(env_ASG_CN_hour_12, 0);
            putvalue(env_ASG_CN_minute_12, 0);
            putvalue(env_ASG_CN_second_12, 0);
        }


        if(gCombinedNumbers_ListEntryReceptionInformation[2])
        {
            gCombinedNumbers_Pos[2]         =getvalue(env_ASG_CN_pos_13);
            getvalue(env_ASG_CN_PbName_s_13, gCombinedNumbers_PbName[2]);
            getvalue(env_ASG_CN_TelNum_s_13, gCombinedNumbers_TelNumber[2]);
            gCombinedNumbers_CallMode[2]    =getvalue(env_ASG_CN_CallMode_13);
            gCombinedNumbers_day[2]         =getvalue(env_ASG_CN_day_13);
            gCombinedNumbers_month[2]       =getvalue(env_ASG_CN_month_13);
            gCombinedNumbers_year[2]        =getvalue(env_ASG_CN_year_13);
            gCombinedNumbers_hour[2]        =getvalue(env_ASG_CN_hour_13);
            gCombinedNumbers_minute[2]      =getvalue(env_ASG_CN_minute_13);
            gCombinedNumbers_second[2]      =getvalue(env_ASG_CN_second_13);
        }

        else
        {
            putvalue(env_ASG_CN_pos_13, 0);
            putvalue(env_ASG_CN_PbName_s_13, empty_string);
            putvalue(env_ASG_CN_TelNum_s_13, empty_string);
            putvalue(env_ASG_CN_CallMode_13, 0);
            putvalue(env_ASG_CN_day_13, 0);
            putvalue(env_ASG_CN_month_13, 0);
            putvalue(env_ASG_CN_year_13, 0);
            putvalue(env_ASG_CN_hour_13, 0);
            putvalue(env_ASG_CN_minute_13, 0);
            putvalue(env_ASG_CN_second_13, 0);
        }

        
        //lower cache
        if(gCombinedNumbers_ListEntryReceptionInformation[3])
        {
            gCombinedNumbers_Pos[3]         =getvalue(env_ASG_CN_pos_21);
            getvalue(env_ASG_CN_PbName_s_21, gCombinedNumbers_PbName[3]);
            getvalue(env_ASG_CN_TelNum_s_21, gCombinedNumbers_TelNumber[3]);
            gCombinedNumbers_CallMode[3]    =getvalue(env_ASG_CN_CallMode_21);
            gCombinedNumbers_day[3]         =getvalue(env_ASG_CN_day_21);
            gCombinedNumbers_month[3]       =getvalue(env_ASG_CN_month_21);
            gCombinedNumbers_year[3]        =getvalue(env_ASG_CN_year_21);
            gCombinedNumbers_hour[3]        =getvalue(env_ASG_CN_hour_21);
            gCombinedNumbers_minute[3]      =getvalue(env_ASG_CN_minute_21);
            gCombinedNumbers_second[3]      =getvalue(env_ASG_CN_second_21);
        }

        else
        {
            putvalue(env_ASG_CN_pos_21, 0);
            putvalue(env_ASG_CN_PbName_s_21, empty_string);
            putvalue(env_ASG_CN_TelNum_s_21, empty_string);
            putvalue(env_ASG_CN_CallMode_21, 0);
            putvalue(env_ASG_CN_day_21, 0);
            putvalue(env_ASG_CN_month_21, 0);
            putvalue(env_ASG_CN_year_21, 0);
            putvalue(env_ASG_CN_hour_21, 0);
            putvalue(env_ASG_CN_minute_21, 0);
            putvalue(env_ASG_CN_second_21, 0);
        }


        if(gCombinedNumbers_ListEntryReceptionInformation[4])
        {
            gCombinedNumbers_Pos[4]         =getvalue(env_ASG_CN_pos_22);
            getvalue(env_ASG_CN_PbName_s_22, gCombinedNumbers_PbName[4]);
            getvalue(env_ASG_CN_TelNum_s_22, gCombinedNumbers_TelNumber[4]);
            gCombinedNumbers_CallMode[4]    =getvalue(env_ASG_CN_CallMode_22);
            gCombinedNumbers_day[4]         =getvalue(env_ASG_CN_day_22);
            gCombinedNumbers_month[4]       =getvalue(env_ASG_CN_month_22);
            gCombinedNumbers_year[4]        =getvalue(env_ASG_CN_year_22);
            gCombinedNumbers_hour[4]        =getvalue(env_ASG_CN_hour_22);
            gCombinedNumbers_minute[4]      =getvalue(env_ASG_CN_minute_22);
            gCombinedNumbers_second[4]      =getvalue(env_ASG_CN_second_22);
        }

        else
        {
            putvalue(env_ASG_CN_pos_22, 0);
            putvalue(env_ASG_CN_PbName_s_22, empty_string);
            putvalue(env_ASG_CN_TelNum_s_22, empty_string);
            putvalue(env_ASG_CN_CallMode_22, 0);
            putvalue(env_ASG_CN_day_22, 0);
            putvalue(env_ASG_CN_month_22, 0);
            putvalue(env_ASG_CN_year_22, 0);
            putvalue(env_ASG_CN_hour_22, 0);
            putvalue(env_ASG_CN_minute_22, 0);
            putvalue(env_ASG_CN_second_22, 0);
        }


        if(gCombinedNumbers_ListEntryReceptionInformation[5])
        {
            gCombinedNumbers_Pos[5]         =getvalue(env_ASG_CN_pos_23);
            getvalue(env_ASG_CN_PbName_s_23, gCombinedNumbers_PbName[5]);
            getvalue(env_ASG_CN_TelNum_s_23, gCombinedNumbers_TelNumber[5]);
            gCombinedNumbers_CallMode[5]    =getvalue(env_ASG_CN_CallMode_23);
            gCombinedNumbers_day[5]         =getvalue(env_ASG_CN_day_23);
            gCombinedNumbers_month[5]       =getvalue(env_ASG_CN_month_23);
            gCombinedNumbers_year[5]        =getvalue(env_ASG_CN_year_23);
            gCombinedNumbers_hour[5]        =getvalue(env_ASG_CN_hour_23);
            gCombinedNumbers_minute[5]      =getvalue(env_ASG_CN_minute_23);
            gCombinedNumbers_second[5]      =getvalue(env_ASG_CN_second_23);
        }

        else
        {
            putvalue(env_ASG_CN_pos_23, 0);
            putvalue(env_ASG_CN_PbName_s_23, empty_string);
            putvalue(env_ASG_CN_TelNum_s_23, empty_string);
            putvalue(env_ASG_CN_CallMode_23, 0);
            putvalue(env_ASG_CN_day_23, 0);
            putvalue(env_ASG_CN_month_23, 0);
            putvalue(env_ASG_CN_year_23, 0);
            putvalue(env_ASG_CN_hour_23, 0);
            putvalue(env_ASG_CN_minute_23, 0);
            putvalue(env_ASG_CN_second_23, 0);
        }

        CombinedNumbers_display();
    }
}
/*@@end*/

/*@@caplFunc:ReceivedCalls_ListHandling():*///function
ReceivedCalls_ListHandling () //for sliding window concept, list handling and 'build-up' list...
{
    byte mode, shift, direction, transmitpos, indexsize, recordaddress, buffer_NumberType, buffer_day, buffer_month, buffer_year, buffer_hour, buffer_minute, buffer_second, buffer_ReceptionInfo;
    word requested_startelement, startelement, elements, buffer_Pos;
    char buffer_PbName[TEL_RECEIVEDCALLS_PBNAME_LENGTH], buffer_TelNumber[TEL_RECEIVEDCALLS_TELNUMBER_LENGTH];
    int i,j,k;
    
    // Init local variables. 
    mode                        =0;
    shift                       =0;
    direction                   =0;
    transmitpos                 =0;
    indexsize                   =0;
    recordaddress               =0;
    requested_startelement      =0;
    startelement                =0;
    elements                    =0;
    i                           =0;
    j                           =0;
    k                           =0;
    buffer_ReceptionInfo        =0;
    buffer_Pos                  =0;
    buffer_NumberType             =0;
    buffer_day                  =0;
    buffer_month                =0;
    buffer_year                 =0;
    buffer_hour                 =0;
    buffer_minute               =0;
    buffer_second               =0;
    
    /***build-up complete cache***/

    switch (gReceivedCalls_ListHandlingType)
    {
        case TEL_RECEIVEDCALLS_BUILDUPCACHE:
             
            switch (gReceivedCalls_cacheBuildUp)
            {   
                //cache-up  -> not used in consecutive ID AND no endless list
                case TEL_RECEIVEDCALLS_BUILDUPCACHECACHE_UP:  
                    if(gReceivedCalls_CallBackReason !=TEL_RECEIVEDCALLS_BUILDUPCACHENOCACHE && gReceivedCalls_CallBackReason !=TEL_RECEIVEDCALLS_CALLBACKREASON_CACHENEXT)
                    {
                        switch (gReceivedCalls_CallBackReason)
                        {
                            case TEL_RECEIVEDCALLS_CALLBACKREASON_CHECKCACHE:

                                    if(gReceivedCalls_ListEntryReceptionInformation[2] ==TRUE) //cache-down required?
                                    {            
                                        gReceivedCalls_cacheBuildUp      =TEL_RECEIVEDCALLS_BUILDUPCACHECACHE_DOWN;      //next step: build-up upper cache
                                        gReceivedCalls_CallBackReason    =TEL_RECEIVEDCALLS_CALLBACKREASON_CACHENEXT;    
                                        
                                        
                                        ReceivedCalls_ListHandling ();
                                    }
                                    else //stop caching
                                    {   
                                        gReceivedCalls_cacheBuildUp      =TEL_RECEIVEDCALLS_BUILDUPCACHENOCACHE;  //"build-up cache" finished
                                        gReceivedCalls_ListHandlingType  =TEL_RECEIVEDCALLS_NOCACHE;              
                                        gReceivedCalls_CallBackReason    =TEL_RECEIVEDCALLS_CALLBACKREASON_NOCALLBACK; 
                                        gReceivedCalls_CursorAction      =TEL_RECEIVEDCALLS_CURSORACTION_NOTHING;
                                        
                                        putvalue(env_ASG_RC_ListOpState, empty_string);
                                        ReceivedCalls_display();
                                    }
                            break;
                        }
                    }
                    else
                    {   
                        shift               =TRUE;
                        direction           =BACKWARD;
                        transmitpos         =FALSE;
                        recordaddress       =0;
                        startelement        =0;
                        
                        if(startelement>0xFF)
                            indexsize =TRUE;
                        else
                            indexsize =FALSE;

                        elements            =3;
                
                        requested_startelement  =startelement;
                        mode                    =shift +(direction*0x02) +(transmitpos*0x04) +indexsize*0x08;

                        gReceivedCalls_CallBackReason  =TEL_RECEIVEDCALLS_CALLBACKREASON_CHECKCACHE;

                        ReceivedCalls_Request(DataGet_REQ, mode, recordaddress, requested_startelement, startelement, elements);
                    }
                break;
                
                //cache "window"
                case TEL_RECEIVEDCALLS_BUILDUPCACHECACHE_WINDOW: 
                    if(gReceivedCalls_CallBackReason !=TEL_RECEIVEDCALLS_BUILDUPCACHENOCACHE && gReceivedCalls_CallBackReason !=TEL_RECEIVEDCALLS_CALLBACKREASON_CACHENEXT)
                    {   
                        switch (gReceivedCalls_CallBackReason)
                        {
                            case TEL_RECEIVEDCALLS_CALLBACKREASON_CHECKCACHE:
                                                 
                                    if(gReceivedCalls_ListEntryReceptionInformation[0])
                                        gReceivedCalls_FirstElement =gReceivedCalls_Pos[0];
                                    
                                    //last element in display area?
                                    for(i=0;i<3;i++)
                                    {
                                        if(gReceivedCalls_ListEntryReceptionInformation[i] !=1)
                                        {
                                            gReceivedCalls_LastElement =gReceivedCalls_Pos[i-1];
                                            i=3;
                                        }
                                    }
                                    
                                    if(gReceivedCalls_ListEntryReceptionInformation[2] ==TRUE) //cache-down required?
                                    {            
                                        gReceivedCalls_cacheBuildUp      =TEL_RECEIVEDCALLS_BUILDUPCACHECACHE_DOWN;      //next step: build-up upper cache
                                        gReceivedCalls_CallBackReason    =TEL_RECEIVEDCALLS_CALLBACKREASON_CACHENEXT;    
                                        
                                        
                                        ReceivedCalls_ListHandling ();
                                    }
                                    else //stop caching
                                    {   
                                        gReceivedCalls_cacheBuildUp      =TEL_RECEIVEDCALLS_BUILDUPCACHENOCACHE;  //"build-up cache" finished
                                        gReceivedCalls_ListHandlingType  =TEL_RECEIVEDCALLS_NOCACHE;              
                                        gReceivedCalls_CallBackReason    =TEL_RECEIVEDCALLS_CALLBACKREASON_NOCALLBACK; 
                                        gReceivedCalls_CursorAction      =TEL_RECEIVEDCALLS_CURSORACTION_NOTHING;
                                        
                                        putvalue(env_ASG_RC_ListOpState, empty_string);
                                        ReceivedCalls_display();
                                    }
                                                                      
                            break;
                        }
                    }
                    else
                    { 
                        putvalue(env_ASG_RC_ListOpState, "build-up list...");
                        shift               =FALSE;
                        direction           =FORWARD;
                        transmitpos         =getvalue(env_ASG_RC_AH_PosTrans);
                        recordaddress       =0;
                        startelement        =0;
                        
                        if(startelement>0xFF)
                            indexsize =TRUE;
                        else
                            indexsize =FALSE;

                        elements            =3; 
    
                        requested_startelement  =startelement;
                        mode                    =shift +(direction*0x02) +(transmitpos*0x04) +indexsize*0x08;

                        gReceivedCalls_CallBackReason  =TEL_RECEIVEDCALLS_CALLBACKREASON_CHECKCACHE;

                        ReceivedCalls_Request(DataGet_REQ, mode, recordaddress, requested_startelement, startelement, elements);
                    }
                break;
                
                //cache-down
                case TEL_RECEIVEDCALLS_BUILDUPCACHECACHE_DOWN:
                    if(gReceivedCalls_CallBackReason !=TEL_RECEIVEDCALLS_BUILDUPCACHENOCACHE && gReceivedCalls_CallBackReason !=TEL_RECEIVEDCALLS_CALLBACKREASON_CACHENEXT)
                    {
                        switch (gReceivedCalls_CallBackReason)
                        {
                            case TEL_RECEIVEDCALLS_CALLBACKREASON_CHECKCACHE:
                                    
                                    //stop caching
                                    gReceivedCalls_cacheBuildUp      =TEL_RECEIVEDCALLS_BUILDUPCACHENOCACHE;  //"build-up cache" finished
                                    gReceivedCalls_ListHandlingType  =TEL_RECEIVEDCALLS_NOCACHE;              
                                    gReceivedCalls_CallBackReason    =TEL_RECEIVEDCALLS_CALLBACKREASON_NOCALLBACK;
                                    gReceivedCalls_CursorAction      =TEL_RECEIVEDCALLS_CURSORACTION_NOTHING;
                                    
                                    gReceivedCalls_DisplayStatus     =TEL_RECEIVEDCALLS_DISPLAYLIST_REFRESH;
                                    
                                    putvalue(env_ASG_RC_ListOpState, empty_string);

                                    //last element in display area?
                                    for(i=3;i<6;i++)
                                    {
                                        if(gReceivedCalls_ListEntryReceptionInformation[i] !=1)
                                        {
                                            gReceivedCalls_LastElement =gReceivedCalls_Pos[i-1];
                                            i=6;
                                        }
                                    }

                                    ReceivedCalls_display();
                            break;
                        }
                    }
                    else
                    { 
                        shift                   =TRUE;
                        direction               =FORWARD;
                        transmitpos             =getvalue(env_ASG_RC_AH_PosTrans);;
                        recordaddress           =0;
                        for(i=0;i<TEL_RECEIVEDCALLS_ASGCACHE_MAX_SIZE; i++) //find last cached element
                        {   
                            if(gReceivedCalls_ListEntryReceptionInformation[i] ==FALSE) //abort loop
                                i =TEL_RECEIVEDCALLS_ASGCACHE_MAX_SIZE; 
                            else
                                startelement    =gReceivedCalls_Pos[i];
                        }
                        
                        if(startelement>0xFF)
                            indexsize =TRUE;
                        else
                            indexsize =FALSE;
                            
                        elements                =3;                         
        
                        requested_startelement  =startelement;
                        mode                    =shift +(direction*0x02) +(transmitpos*0x04) +indexsize*0x08;

                        gReceivedCalls_CallBackReason    =TEL_RECEIVEDCALLS_CALLBACKREASON_CHECKCACHE;
                        
                        ReceivedCalls_Request(DataGet_REQ, mode, recordaddress, requested_startelement, startelement, elements);
                    }
                break;

                default:
                break;
            }//build-up cache finished
        break;
        
        /********sliding-window********/
        case TEL_RECEIVEDCALLS_DOWN_CACHE: 
                    if (gReceivedCalls_CallBackReason ==TEL_RECEIVEDCALLS_CALLBACKREASON_CHECKCACHE) //check if valid data received
                    {   
                        if(gReceivedCalls_ListEntryReceptionInformation[5] ==0) //No valid data in last list pos -> last list element reached, start with element 0!  
                        {    
                            gReceivedCalls_LastElement            =gReceivedCalls_Pos[4];
                            gReceivedCalls_DownCaching_required   =FALSE;
                            gReceivedCalls_CallBackReason         =TEL_RECEIVEDCALLS_CALLBACKREASON_DISPLAYLIST;
                            
                            ReceivedCalls_ListHandling ();
                        }
                        else
                        {
                            gReceivedCalls_CallBackReason =TEL_RECEIVEDCALLS_CALLBACKREASON_DISPLAYLIST;
                            ReceivedCalls_ListHandling(); 
                        }
                        
                        //for cache up
                        if((gReceivedCalls_ListEntryReceptionInformation[6] ==1) && (gReceivedCalls_Pos[6] !=gReceivedCalls_FirstElement))
                        {    gReceivedCalls_UpCaching_required     =TRUE;
                            
                        }
                            
                    }
                    else if (gReceivedCalls_CallBackReason ==TEL_RECEIVEDCALLS_CALLBACKREASON_DISPLAYLIST)
                    {   
                        gReceivedCalls_ListHandlingType  =TEL_RECEIVEDCALLS_NOCACHE;
                        gReceivedCalls_cacheDown         =FALSE;
                        gReceivedCalls_DisplayStatus     =TEL_RECEIVEDCALLS_DISPLAYLIST_FIRST_ELEMENTS;
                        
                        putvalue(env_ASG_RC_ListOpState, empty_string);
                        ReceivedCalls_display();

                        gReceivedCalls_DisplayStatus     =TEL_RECEIVEDCALLS_DISPLAYLIST_REFRESH;
                        gReceivedCalls_CallBackReason    =TEL_RECEIVEDCALLS_CALLBACKREASON_NOCALLBACK;
                    }
                    else
                    {   
                        putvalue(env_ASG_RC_ListOpState, "list operating...");
                                
                        shift                   =TRUE;
                        direction               =FORWARD;
                        transmitpos             =getvalue(env_ASG_RC_AH_PosTrans);;
                        recordaddress           =0;
                        
                        if(startelement>0xFF)
                            indexsize =TRUE;
                        else
                            indexsize =FALSE;

                        startelement            =gReceivedCalls_Pos[5]; //last element
                        elements                =1;
                        
                        for(i=0;i<TEL_RECEIVEDCALLS_ASGCACHE_MAX_SIZE;i++)
                        {   
                            j =i+1;
                            
                            switch (i)
                            {   
                                case 0: 
                                    //buffer data of Pos '0' (local)
                                    buffer_ReceptionInfo    =gReceivedCalls_ListEntryReceptionInformation[i];
                                    buffer_Pos              =gReceivedCalls_Pos[i];
                                    buffer_NumberType         =gReceivedCalls_NumberType[i];
                                    buffer_day              =gReceivedCalls_day[i];
                                    buffer_month            =gReceivedCalls_month[i];
                                    buffer_year             =gReceivedCalls_year[i];
                                    buffer_hour             =gReceivedCalls_hour[i];
                                    buffer_minute           =gReceivedCalls_minute[i];
                                    buffer_second           =gReceivedCalls_second[i];

                                    for (k=0; k<TEL_RECEIVEDCALLS_PBNAME_LENGTH;k++) //clear string
                                        buffer_PbName[k] =0;                                     

                                    for(k=0;k<strlen(gReceivedCalls_PbName[i]);k++) 
                                        buffer_PbName[k]=gReceivedCalls_PbName[i][k];
                                    
                                    for (k=0; k<TEL_RECEIVEDCALLS_TELNUMBER_LENGTH;k++) //clear string
                                        buffer_TelNumber[k] =0;                                     

                                    for(k=0;k<strlen(gReceivedCalls_TelNumber[i]);k++) 
                                        buffer_TelNumber[k]=gReceivedCalls_TelNumber[i][k];
                                    

                                    //copy data from Pos '1' to Pos '0'
                                    gReceivedCalls_Pos[i]             =gReceivedCalls_Pos[j]; 
                                    gReceivedCalls_NumberType[i]        =gReceivedCalls_NumberType[j];
                                    gReceivedCalls_day[i]             =gReceivedCalls_day[j];
                                    gReceivedCalls_month[i]           =gReceivedCalls_month[j];
                                    gReceivedCalls_year[i]            =gReceivedCalls_year[j];
                                    gReceivedCalls_hour[i]            =gReceivedCalls_hour[j];
                                    gReceivedCalls_minute[i]          =gReceivedCalls_minute[j];
                                    gReceivedCalls_second[i]          =gReceivedCalls_second[j];
                                
                                    for (k=0; k<TEL_RECEIVEDCALLS_PBNAME_LENGTH;k++) //clear string
                                        gReceivedCalls_PbName[i][k] =0;                                     

                                    for(k=0;k<strlen(gReceivedCalls_PbName[j]);k++) 
                                        gReceivedCalls_PbName[i][k]=gReceivedCalls_PbName[j][k];

                                    for (k=0; k<TEL_RECEIVEDCALLS_TELNUMBER_LENGTH;k++) //clear string
                                        gReceivedCalls_TelNumber[i][k] =0;                                     

                                    for(k=0;k<strlen(gReceivedCalls_TelNumber[j]);k++) 
                                        gReceivedCalls_TelNumber[i][k]=gReceivedCalls_TelNumber[j][k];

                                break;
                            
                                case 5:
                                    //clear last element in list 
                                    gReceivedCalls_ListEntryReceptionInformation[i]   =0;
                                    gReceivedCalls_Pos[i]                             =0;
                                    gReceivedCalls_NumberType[i]                        =0;
                                    gReceivedCalls_day[i]                             =0;
                                    gReceivedCalls_month[i]                           =0;
                                    gReceivedCalls_year[i]                            =0;
                                    gReceivedCalls_hour[i]                            =0;
                                    gReceivedCalls_minute[i]                          =0;
                                    gReceivedCalls_second[i]                          =0;

                                    for (k=0; k<TEL_RECEIVEDCALLS_PBNAME_LENGTH;k++) //clear string
                                        gReceivedCalls_PbName[i][k] =0;
                                    
                                    for (k=0; k<TEL_RECEIVEDCALLS_TELNUMBER_LENGTH;k++) //clear string
                                        gReceivedCalls_TelNumber[i][k] =0;
                                                                 
                                break;
                            
                                case 8: 
                                    //copy data from buffer in Pos '8'
                                    gReceivedCalls_ListEntryReceptionInformation[i]   =buffer_ReceptionInfo;
                                    gReceivedCalls_Pos[i]                             =buffer_Pos; 
                                    gReceivedCalls_NumberType[i]                        =buffer_NumberType;
                                    gReceivedCalls_day[i]                             =buffer_day;
                                    gReceivedCalls_month[i]                           =buffer_month;
                                    gReceivedCalls_year[i]                            =buffer_year;
                                    gReceivedCalls_hour[i]                            =buffer_hour;
                                    gReceivedCalls_minute[i]                          =buffer_minute;
                                    gReceivedCalls_second[i]                          =buffer_second;

                                    for (k=0; k<TEL_RECEIVEDCALLS_PBNAME_LENGTH;k++) //clear string
                                        gReceivedCalls_PbName[i][k] =0; 
                                    
                                    for(k=0;k<strlen(buffer_PbName);k++) 
                                        gReceivedCalls_PbName[i][k]=buffer_PbName[k];

                                    for (k=0; k<TEL_RECEIVEDCALLS_TELNUMBER_LENGTH;k++) //clear string
                                        gReceivedCalls_TelNumber[i][k] =0; 
                                    
                                    for(k=0;k<strlen(buffer_TelNumber);k++) 
                                        gReceivedCalls_TelNumber[i][k]=buffer_TelNumber[k];
                                    
                                break;
                                
                                default://other elements
                                    //copy element on other position
                                    gReceivedCalls_ListEntryReceptionInformation[i]   =gReceivedCalls_ListEntryReceptionInformation[j];
                                    gReceivedCalls_Pos[i]                             =gReceivedCalls_Pos[j]; 
                                    gReceivedCalls_NumberType[i]                        =gReceivedCalls_NumberType[j];
                                    gReceivedCalls_day[i]                             =gReceivedCalls_day[j];
                                    gReceivedCalls_month[i]                           =gReceivedCalls_month[j];
                                    gReceivedCalls_year[i]                            =gReceivedCalls_year[j]; 
                                    gReceivedCalls_hour[i]                            =gReceivedCalls_hour[j];
                                    gReceivedCalls_minute[i]                          =gReceivedCalls_minute[j];
                                    gReceivedCalls_second[i]                          =gReceivedCalls_second[j];
                                    
                                    for (k=0; k<TEL_RECEIVEDCALLS_PBNAME_LENGTH;k++) //clear string
                                        gReceivedCalls_PbName[i][k] =0; 
                                    
                                    for(k=0;k<strlen(gReceivedCalls_PbName[j]);k++) 
                                        gReceivedCalls_PbName[i][k]=gReceivedCalls_PbName[j][k];
                                        
                                    for (k=0; k<TEL_RECEIVEDCALLS_TELNUMBER_LENGTH;k++) //clear string
                                        gReceivedCalls_TelNumber[i][k] =0; 
                                    
                                    for(k=0;k<strlen(gReceivedCalls_TelNumber[j]);k++) 
                                        gReceivedCalls_TelNumber[i][k]=gReceivedCalls_TelNumber[j][k];        
                                break;
                            } // end of switch 'i'
                        }
                        requested_startelement  =startelement;
                        mode                    =shift +(direction*0x02) +(transmitpos*0x04) +indexsize*0x08;

                        if(gReceivedCalls_DownCaching_required)
                        {
                            ReceivedCalls_Request(DataGet_REQ, mode, recordaddress, requested_startelement, startelement, elements);                        
                        
                            //to check, if valid data received
                            gReceivedCalls_CallBackReason    =TEL_RECEIVEDCALLS_CALLBACKREASON_CHECKCACHE;
                        }
                        else
                        {
                            gReceivedCalls_CallBackReason =TEL_RECEIVEDCALLS_CALLBACKREASON_DISPLAYLIST;
                            ReceivedCalls_ListHandling(); 
                        }
                    }
        break;

        case TEL_RECEIVEDCALLS_UP_CACHE: 
                    if (gReceivedCalls_CallBackReason ==TEL_RECEIVEDCALLS_CALLBACKREASON_CHECKCACHE) //check if valid data received
                    {   
                        if((gReceivedCalls_ListEntryReceptionInformation[6] ==1) && (gReceivedCalls_Pos[6] ==gReceivedCalls_FirstElement)) //first element in list reached
                        {
                            gReceivedCalls_UpCaching_required     =FALSE;
                            gReceivedCalls_CallBackReason         =TEL_RECEIVEDCALLS_CALLBACKREASON_DISPLAYLIST;
                            
                            ReceivedCalls_ListHandling ();
                        }
                        else if((gReceivedCalls_ListEntryReceptionInformation[6] ==1) && (gReceivedCalls_Pos[6] !=gReceivedCalls_FirstElement))
                        {
                            gReceivedCalls_UpCaching_required     =TRUE;
                            gReceivedCalls_CallBackReason         =TEL_RECEIVEDCALLS_CALLBACKREASON_DISPLAYLIST;
                            
                            ReceivedCalls_ListHandling ();
                        }
                        else
                        {   
                            gReceivedCalls_CallBackReason =TEL_RECEIVEDCALLS_CALLBACKREASON_DISPLAYLIST;
                            ReceivedCalls_ListHandling();
                        }
                        
                        //for cache down
                        if(gReceivedCalls_ListEntryReceptionInformation[5] ==1)
                            gReceivedCalls_DownCaching_required     =TRUE;
                                       
                    }

                    else if (gReceivedCalls_CallBackReason ==TEL_RECEIVEDCALLS_CALLBACKREASON_DISPLAYLIST)
                    {   
                        gReceivedCalls_ListHandlingType  =TEL_RECEIVEDCALLS_NOCACHE;
                        gReceivedCalls_cacheUp           =FALSE;
                        gReceivedCalls_DisplayStatus     =TEL_RECEIVEDCALLS_DISPLAYLIST_FIRST_ELEMENTS;
                        
                        putvalue(env_ASG_RC_ListOpState, empty_string);
                        ReceivedCalls_display();
                        gReceivedCalls_DisplayStatus     =TEL_RECEIVEDCALLS_DISPLAYLIST_REFRESH;
                        gReceivedCalls_CallBackReason    =TEL_RECEIVEDCALLS_CALLBACKREASON_NOCALLBACK;
                    }

                    else
                    {           
                        putvalue(env_ASG_RC_ListOpState, "list operating...");

                        shift                   =TRUE;
                        direction               =BACKWARD;
                        transmitpos             =getvalue(env_ASG_RC_AH_PosTrans);;
                        recordaddress           =0;
                        startelement            =gReceivedCalls_Pos[6]; //first element
                        
                        if(startelement>0xFF)
                            indexsize =TRUE;
                        else
                            indexsize =FALSE;

                        elements                =1;
                    
                        for(i=TEL_RECEIVEDCALLS_ASGCACHE_MAX_SIZE-1;i>=0;i--)
                        {  
                            j =i-1;
                            switch (i)
                            {   
                                case 8: 
                                    //buffer data of Pos '8' (local)
                                    buffer_ReceptionInfo    =gReceivedCalls_ListEntryReceptionInformation[i];
                                    buffer_Pos              =gReceivedCalls_Pos[i];
                                    buffer_NumberType         =gReceivedCalls_NumberType[i];
                                    buffer_day              =gReceivedCalls_day[i];
                                    buffer_month            =gReceivedCalls_month[i];
                                    buffer_year             =gReceivedCalls_year[i];
                                    buffer_hour             =gReceivedCalls_hour[i];
                                    buffer_minute           =gReceivedCalls_minute[i];
                                    buffer_second           =gReceivedCalls_second[i];                          

                                    for (k=0; k<TEL_RECEIVEDCALLS_PBNAME_LENGTH;k++) //clear string
                                        buffer_PbName[k] =0;                                     

                                    for(k=0;k<strlen(gReceivedCalls_PbName[i]);k++) 
                                        buffer_PbName[k]=gReceivedCalls_PbName[i][k];

                                    for (k=0; k<TEL_RECEIVEDCALLS_TELNUMBER_LENGTH;k++) //clear string
                                        buffer_TelNumber[k] =0;                                     

                                    for(k=0;k<strlen(gReceivedCalls_TelNumber[i]);k++) 
                                        buffer_TelNumber[k]=gReceivedCalls_TelNumber[i][k];

                                    
                                    //copy data from Pos '7' to Pos '8'
                                    gReceivedCalls_ListEntryReceptionInformation[i]   =gReceivedCalls_ListEntryReceptionInformation[j];
                                    gReceivedCalls_Pos[i]                             =gReceivedCalls_Pos[j]; 
                                    gReceivedCalls_NumberType[i]                        =gReceivedCalls_NumberType[j];
                                    gReceivedCalls_day[i]                             =gReceivedCalls_day[j];
                                    gReceivedCalls_month[i]                           =gReceivedCalls_month[j];
                                    gReceivedCalls_year[i]                            =gReceivedCalls_year[j];
                                    gReceivedCalls_hour[i]                            =gReceivedCalls_hour[j];
                                    gReceivedCalls_minute[i]                          =gReceivedCalls_minute[j];
                                    gReceivedCalls_second[i]                          =gReceivedCalls_second[j];

                                    for (k=0; k<TEL_RECEIVEDCALLS_PBNAME_LENGTH;k++) //clear string
                                        gReceivedCalls_PbName[i][k] =0; 
                                    
                                    for(k=0;k<strlen(gReceivedCalls_PbName[j]);k++) 
                                        gReceivedCalls_PbName[i][k]=gReceivedCalls_PbName[j][k];
                                    
                                    for (k=0; k<TEL_RECEIVEDCALLS_TELNUMBER_LENGTH;k++) //clear string
                                        gReceivedCalls_TelNumber[i][k] =0; 
                                    
                                    for(k=0;k<strlen(gReceivedCalls_TelNumber[j]);k++) 
                                        gReceivedCalls_TelNumber[i][k]=gReceivedCalls_TelNumber[j][k];     
                                break;
                            
                                case 6: 
                                    //clear first element in list 
                                    gReceivedCalls_ListEntryReceptionInformation[i] =0;
                                    gReceivedCalls_Pos[i]                           =0;
                                    gReceivedCalls_NumberType[i]                      =0;
                                    gReceivedCalls_day[i]                           =0;
                                    gReceivedCalls_month[i]                         =0;
                                    gReceivedCalls_year[i]                          =0;
                                    gReceivedCalls_hour[i]                          =0;
                                    gReceivedCalls_minute[i]                        =0;
                                    gReceivedCalls_second[i]                        =0;
                            
                                    for (k=0; k<TEL_RECEIVEDCALLS_PBNAME_LENGTH;k++) //clear string
                                        gReceivedCalls_PbName[i][k] =0;
                                    
                                    for (k=0; k<TEL_RECEIVEDCALLS_TELNUMBER_LENGTH;k++) //clear string
                                        gReceivedCalls_TelNumber[i][k] =0;
                                                                            
                                break;
                            
                                case 0: 
                                    //copy data from buffer in Pos '0'
                                    gReceivedCalls_ListEntryReceptionInformation[i]   =buffer_ReceptionInfo;
                                    gReceivedCalls_Pos[i]                             =buffer_Pos; 
                                    gReceivedCalls_NumberType[i]                        =buffer_NumberType;
                                    gReceivedCalls_day[i]                             =buffer_day;
                                    gReceivedCalls_month[i]                           =buffer_month;
                                    gReceivedCalls_year[i]                            =buffer_year;
                                    gReceivedCalls_hour[i]                            =buffer_hour;
                                    gReceivedCalls_minute[i]                          =buffer_minute;
                                    gReceivedCalls_second[i]                          =buffer_second;

                                    for (k=0; k<TEL_RECEIVEDCALLS_PBNAME_LENGTH;k++) //clear string
                                        gReceivedCalls_PbName[i][k] =0; 
                                    
                                    for(k=0;k<strlen(buffer_PbName);k++) 
                                        gReceivedCalls_PbName[i][k]=buffer_PbName[k];

                                    for (k=0; k<TEL_RECEIVEDCALLS_TELNUMBER_LENGTH;k++) //clear string
                                        gReceivedCalls_TelNumber[i][k] =0; 
                                    
                                    for(k=0;k<strlen(buffer_TelNumber);k++) 
                                        gReceivedCalls_TelNumber[i][k]=buffer_TelNumber[k];
                                break;
                                
                                default: //other elements
                                    //copy element on other position
                                    gReceivedCalls_ListEntryReceptionInformation[i]   =gReceivedCalls_ListEntryReceptionInformation[j];
                                    gReceivedCalls_Pos[i]                             =gReceivedCalls_Pos[j]; 
                                    gReceivedCalls_NumberType[i]                        =gReceivedCalls_NumberType[j];
                                    gReceivedCalls_day[i]                             =gReceivedCalls_day[j];
                                    gReceivedCalls_month[i]                           =gReceivedCalls_month[j];
                                    gReceivedCalls_year[i]                            =gReceivedCalls_year[j];
                                    gReceivedCalls_hour[i]                            =gReceivedCalls_hour[j];
                                    gReceivedCalls_minute[i]                          =gReceivedCalls_minute[j];
                                    gReceivedCalls_second[i]                          =gReceivedCalls_second[j];

                                    for (k=0; k<TEL_RECEIVEDCALLS_PBNAME_LENGTH;k++) //clear string
                                        gReceivedCalls_PbName[i][k] =0; 
                                    
                                    for(k=0;k<strlen(gReceivedCalls_PbName[j]);k++) 
                                        gReceivedCalls_PbName[i][k]=gReceivedCalls_PbName[j][k];
                                    
                                    for (k=0; k<TEL_RECEIVEDCALLS_TELNUMBER_LENGTH;k++) //clear string
                                        gReceivedCalls_TelNumber[i][k] =0; 
                                    
                                    for(k=0;k<strlen(gReceivedCalls_TelNumber[j]);k++) 
                                        gReceivedCalls_TelNumber[i][k]=gReceivedCalls_TelNumber[j][k];
                                    
                                break;
                            } // end of switch 'i'
                        }
                        requested_startelement  =startelement;
                        mode                    =shift +(direction*0x02) +(transmitpos*0x04) +indexsize*0x08;

                        if(gReceivedCalls_UpCaching_required)
                        {
                            ReceivedCalls_Request(DataGet_REQ, mode, recordaddress, requested_startelement, startelement, elements);                        
                        
                            //to check, if valid data received
                            gReceivedCalls_CallBackReason    =TEL_RECEIVEDCALLS_CALLBACKREASON_CHECKCACHE;
                        }
                        else
                        {
                            gReceivedCalls_CallBackReason =TEL_RECEIVEDCALLS_CALLBACKREASON_CHECKCACHE;
                            ReceivedCalls_ListHandling(); 
                        }
                    }
        break;

        default:
        break;
    } //end of switch 'type of cache handling' 
}
/*@@end*/

/*@@envVar:env_ASG_CN_EditDispCache:*/
on envVar env_ASG_CN_EditDispCache
{
    if(gRNS_PowerOnOff==Power_on && getvalue(this))
    {    
        OpenPanel("ASG_Telephone_0x31 - CombinedNumbers_EditCache");
        
        CombinedNumbers_DisplayCache();
    }
}
/*@@end*/

/*@@caplFunc:CombinedNumbers_DisplayCache():*///function
CombinedNumbers_DisplayCache ()
{
    //upper cache
        if(gCombinedNumbers_ListEntryReceptionInformation[6])
        {
            putvalue(env_ASG_CN_pos_01, gCombinedNumbers_Pos[6]);
            putvalue(env_ASG_CN_PbName_s_01, gCombinedNumbers_PbName[6]);
            putvalue(env_ASG_CN_TelNum_s_01, gCombinedNumbers_TelNumber[6]);
            putvalue(env_ASG_CN_CallMode_01, gCombinedNumbers_CallMode[6]);
            putvalue(env_ASG_CN_day_01, gCombinedNumbers_day[6]);
            putvalue(env_ASG_CN_month_01, gCombinedNumbers_month[6]);
            putvalue(env_ASG_CN_year_01, gCombinedNumbers_year[6]);
            putvalue(env_ASG_CN_hour_01, gCombinedNumbers_hour[6]);
            putvalue(env_ASG_CN_minute_01, gCombinedNumbers_minute[6]);
            putvalue(env_ASG_CN_second_01, gCombinedNumbers_second[6]);

            enableControl("ASG_Telephone_0x31 - CombinedNumbers_EditCache", "env_ASG_CN_pos_01", 1);
            enableControl("ASG_Telephone_0x31 - CombinedNumbers_EditCache", "env_ASG_CN_PbName_s_01", 1);
            enableControl("ASG_Telephone_0x31 - CombinedNumbers_EditCache", "env_ASG_CN_TelNum_s_01", 1);
            enableControl("ASG_Telephone_0x31 - CombinedNumbers_EditCache", "env_ASG_CN_CallMode_01", 1);
            enableControl("ASG_Telephone_0x31 - CombinedNumbers_EditCache", "env_ASG_CN_day_01", 1);
            enableControl("ASG_Telephone_0x31 - CombinedNumbers_EditCache", "env_ASG_CN_month_01", 1);
            enableControl("ASG_Telephone_0x31 - CombinedNumbers_EditCache", "env_ASG_CN_year_01", 1);
            enableControl("ASG_Telephone_0x31 - CombinedNumbers_EditCache", "env_ASG_CN_hour_01", 1);
            enableControl("ASG_Telephone_0x31 - CombinedNumbers_EditCache", "env_ASG_CN_minute_01", 1);
            enableControl("ASG_Telephone_0x31 - CombinedNumbers_EditCache", "env_ASG_CN_second_01", 1);
        }

        else
        {
            putvalue(env_ASG_CN_pos_01, 0);
            putvalue(env_ASG_CN_PbName_s_01, empty_string);
            putvalue(env_ASG_CN_TelNum_s_01, empty_string);
            putvalue(env_ASG_CN_CallMode_01, 0);
            putvalue(env_ASG_CN_day_01, 0);
            putvalue(env_ASG_CN_month_01, 0);
            putvalue(env_ASG_CN_year_01, 0);
            putvalue(env_ASG_CN_hour_01, 0);
            putvalue(env_ASG_CN_minute_01, 0);
            putvalue(env_ASG_CN_second_01, 0);

            enableControl("ASG_Telephone_0x31 - CombinedNumbers_EditCache", "env_ASG_CN_pos_01", 0);
            enableControl("ASG_Telephone_0x31 - CombinedNumbers_EditCache", "env_ASG_CN_PbName_s_01", 0);
            enableControl("ASG_Telephone_0x31 - CombinedNumbers_EditCache", "env_ASG_CN_TelNum_s_01", 0);
            enableControl("ASG_Telephone_0x31 - CombinedNumbers_EditCache", "env_ASG_CN_CallMode_01", 0);
            enableControl("ASG_Telephone_0x31 - CombinedNumbers_EditCache", "env_ASG_CN_day_01", 0);
            enableControl("ASG_Telephone_0x31 - CombinedNumbers_EditCache", "env_ASG_CN_month_01", 0);
            enableControl("ASG_Telephone_0x31 - CombinedNumbers_EditCache", "env_ASG_CN_year_01", 0);
            enableControl("ASG_Telephone_0x31 - CombinedNumbers_EditCache", "env_ASG_CN_hour_01", 0);
            enableControl("ASG_Telephone_0x31 - CombinedNumbers_EditCache", "env_ASG_CN_minute_01", 0);
            enableControl("ASG_Telephone_0x31 - CombinedNumbers_EditCache", "env_ASG_CN_second_01", 0);
        }


        if(gCombinedNumbers_ListEntryReceptionInformation[7])
        {
            putvalue(env_ASG_CN_pos_02, gCombinedNumbers_Pos[7]);
            putvalue(env_ASG_CN_PbName_s_02, gCombinedNumbers_PbName[7]);
            putvalue(env_ASG_CN_TelNum_s_02, gCombinedNumbers_TelNumber[7]);
            putvalue(env_ASG_CN_CallMode_02, gCombinedNumbers_CallMode[7]);
            putvalue(env_ASG_CN_day_02, gCombinedNumbers_day[7]);
            putvalue(env_ASG_CN_month_02, gCombinedNumbers_month[7]);
            putvalue(env_ASG_CN_year_02, gCombinedNumbers_year[7]);
            putvalue(env_ASG_CN_hour_02, gCombinedNumbers_hour[7]);
            putvalue(env_ASG_CN_minute_02, gCombinedNumbers_minute[7]);
            putvalue(env_ASG_CN_second_02, gCombinedNumbers_second[7]);

            enableControl("ASG_Telephone_0x31 - CombinedNumbers_EditCache", "env_ASG_CN_pos_02", 1);
            enableControl("ASG_Telephone_0x31 - CombinedNumbers_EditCache", "env_ASG_CN_PbName_s_02", 1);
            enableControl("ASG_Telephone_0x31 - CombinedNumbers_EditCache", "env_ASG_CN_TelNum_s_02", 1);
            enableControl("ASG_Telephone_0x31 - CombinedNumbers_EditCache", "env_ASG_CN_CallMode_02", 1);
            enableControl("ASG_Telephone_0x31 - CombinedNumbers_EditCache", "env_ASG_CN_day_02", 1);
            enableControl("ASG_Telephone_0x31 - CombinedNumbers_EditCache", "env_ASG_CN_month_02", 1);
            enableControl("ASG_Telephone_0x31 - CombinedNumbers_EditCache", "env_ASG_CN_year_02", 1);
            enableControl("ASG_Telephone_0x31 - CombinedNumbers_EditCache", "env_ASG_CN_hour_02", 1);
            enableControl("ASG_Telephone_0x31 - CombinedNumbers_EditCache", "env_ASG_CN_minute_02", 1);
            enableControl("ASG_Telephone_0x31 - CombinedNumbers_EditCache", "env_ASG_CN_second_02", 1);
        }

        else
        {
            putvalue(env_ASG_CN_pos_02, 0);
            putvalue(env_ASG_CN_PbName_s_02, empty_string);
            putvalue(env_ASG_CN_TelNum_s_02, empty_string);
            putvalue(env_ASG_CN_CallMode_02, 0);
            putvalue(env_ASG_CN_day_02, 0);
            putvalue(env_ASG_CN_month_02, 0);
            putvalue(env_ASG_CN_year_02, 0);
            putvalue(env_ASG_CN_hour_02, 0);
            putvalue(env_ASG_CN_minute_02, 0);
            putvalue(env_ASG_CN_second_02, 0);

            enableControl("ASG_Telephone_0x31 - CombinedNumbers_EditCache", "env_ASG_CN_pos_02", 0);
            enableControl("ASG_Telephone_0x31 - CombinedNumbers_EditCache", "env_ASG_CN_PbName_s_02", 0);
            enableControl("ASG_Telephone_0x31 - CombinedNumbers_EditCache", "env_ASG_CN_TelNum_s_02", 0);
            enableControl("ASG_Telephone_0x31 - CombinedNumbers_EditCache", "env_ASG_CN_CallMode_02", 0);
            enableControl("ASG_Telephone_0x31 - CombinedNumbers_EditCache", "env_ASG_CN_day_02", 0);
            enableControl("ASG_Telephone_0x31 - CombinedNumbers_EditCache", "env_ASG_CN_month_02", 0);
            enableControl("ASG_Telephone_0x31 - CombinedNumbers_EditCache", "env_ASG_CN_year_02", 0);
            enableControl("ASG_Telephone_0x31 - CombinedNumbers_EditCache", "env_ASG_CN_hour_02", 0);
            enableControl("ASG_Telephone_0x31 - CombinedNumbers_EditCache", "env_ASG_CN_minute_02", 0);
            enableControl("ASG_Telephone_0x31 - CombinedNumbers_EditCache", "env_ASG_CN_second_02", 0);
        }


        if(gCombinedNumbers_ListEntryReceptionInformation[8])
        {
            putvalue(env_ASG_CN_pos_03, gCombinedNumbers_Pos[8]);
            putvalue(env_ASG_CN_PbName_s_03, gCombinedNumbers_PbName[8]);
            putvalue(env_ASG_CN_TelNum_s_03, gCombinedNumbers_TelNumber[8]);
            putvalue(env_ASG_CN_CallMode_03, gCombinedNumbers_CallMode[8]);
            putvalue(env_ASG_CN_day_03, gCombinedNumbers_day[8]);
            putvalue(env_ASG_CN_month_03, gCombinedNumbers_month[8]);
            putvalue(env_ASG_CN_year_03, gCombinedNumbers_year[8]);
            putvalue(env_ASG_CN_hour_03, gCombinedNumbers_hour[8]);
            putvalue(env_ASG_CN_minute_03, gCombinedNumbers_minute[8]);
            putvalue(env_ASG_CN_second_03, gCombinedNumbers_second[8]);

            enableControl("ASG_Telephone_0x31 - CombinedNumbers_EditCache", "env_ASG_CN_pos_03", 1);
            enableControl("ASG_Telephone_0x31 - CombinedNumbers_EditCache", "env_ASG_CN_PbName_s_03", 1);
            enableControl("ASG_Telephone_0x31 - CombinedNumbers_EditCache", "env_ASG_CN_TelNum_s_03", 1);
            enableControl("ASG_Telephone_0x31 - CombinedNumbers_EditCache", "env_ASG_CN_CallMode_03", 1);
            enableControl("ASG_Telephone_0x31 - CombinedNumbers_EditCache", "env_ASG_CN_day_03", 1);
            enableControl("ASG_Telephone_0x31 - CombinedNumbers_EditCache", "env_ASG_CN_month_03", 1);
            enableControl("ASG_Telephone_0x31 - CombinedNumbers_EditCache", "env_ASG_CN_year_03", 1);
            enableControl("ASG_Telephone_0x31 - CombinedNumbers_EditCache", "env_ASG_CN_hour_03", 1);
            enableControl("ASG_Telephone_0x31 - CombinedNumbers_EditCache", "env_ASG_CN_minute_03", 1);
            enableControl("ASG_Telephone_0x31 - CombinedNumbers_EditCache", "env_ASG_CN_second_03", 1);
        }

        else
        {
            putvalue(env_ASG_CN_pos_03, 0);
            putvalue(env_ASG_CN_PbName_s_03, empty_string);
            putvalue(env_ASG_CN_TelNum_s_03, empty_string);
            putvalue(env_ASG_CN_CallMode_03, 0);
            putvalue(env_ASG_CN_day_03, 0);
            putvalue(env_ASG_CN_month_03, 0);
            putvalue(env_ASG_CN_year_03, 0);
            putvalue(env_ASG_CN_hour_03, 0);
            putvalue(env_ASG_CN_minute_03, 0);
            putvalue(env_ASG_CN_second_03, 0);

            enableControl("ASG_Telephone_0x31 - CombinedNumbers_EditCache", "env_ASG_CN_pos_03", 0);
            enableControl("ASG_Telephone_0x31 - CombinedNumbers_EditCache", "env_ASG_CN_PbName_s_03", 0);
            enableControl("ASG_Telephone_0x31 - CombinedNumbers_EditCache", "env_ASG_CN_TelNum_s_03", 0);
            enableControl("ASG_Telephone_0x31 - CombinedNumbers_EditCache", "env_ASG_CN_CallMode_03", 0);
            enableControl("ASG_Telephone_0x31 - CombinedNumbers_EditCache", "env_ASG_CN_day_03", 0);
            enableControl("ASG_Telephone_0x31 - CombinedNumbers_EditCache", "env_ASG_CN_month_03", 0);
            enableControl("ASG_Telephone_0x31 - CombinedNumbers_EditCache", "env_ASG_CN_year_03", 0);
            enableControl("ASG_Telephone_0x31 - CombinedNumbers_EditCache", "env_ASG_CN_hour_03", 0);
            enableControl("ASG_Telephone_0x31 - CombinedNumbers_EditCache", "env_ASG_CN_minute_03", 0);
            enableControl("ASG_Telephone_0x31 - CombinedNumbers_EditCache", "env_ASG_CN_second_03", 0);
        }

        
        //display area
        if(gCombinedNumbers_ListEntryReceptionInformation[0])
        {
            putvalue(env_ASG_CN_pos_11, gCombinedNumbers_Pos[0]);
            putvalue(env_ASG_CN_PbName_s_11, gCombinedNumbers_PbName[0]);
            putvalue(env_ASG_CN_TelNum_s_11, gCombinedNumbers_TelNumber[0]);
            putvalue(env_ASG_CN_CallMode_11, gCombinedNumbers_CallMode[0]);
            putvalue(env_ASG_CN_day_11, gCombinedNumbers_day[0]);
            putvalue(env_ASG_CN_month_11, gCombinedNumbers_month[0]);
            putvalue(env_ASG_CN_year_11, gCombinedNumbers_year[0]);
            putvalue(env_ASG_CN_hour_11, gCombinedNumbers_hour[0]);
            putvalue(env_ASG_CN_minute_11, gCombinedNumbers_minute[0]);
            putvalue(env_ASG_CN_second_11, gCombinedNumbers_second[0]);

            enableControl("ASG_Telephone_0x31 - CombinedNumbers_EditCache", "env_ASG_CN_pos_11", 1);
            enableControl("ASG_Telephone_0x31 - CombinedNumbers_EditCache", "env_ASG_CN_PbName_s_11", 1);
            enableControl("ASG_Telephone_0x31 - CombinedNumbers_EditCache", "env_ASG_CN_TelNum_s_11", 1);
            enableControl("ASG_Telephone_0x31 - CombinedNumbers_EditCache", "env_ASG_CN_CallMode_11", 1);
            enableControl("ASG_Telephone_0x31 - CombinedNumbers_EditCache", "env_ASG_CN_day_11", 1);
            enableControl("ASG_Telephone_0x31 - CombinedNumbers_EditCache", "env_ASG_CN_month_11", 1);
            enableControl("ASG_Telephone_0x31 - CombinedNumbers_EditCache", "env_ASG_CN_year_11", 1);
            enableControl("ASG_Telephone_0x31 - CombinedNumbers_EditCache", "env_ASG_CN_hour_11", 1);
            enableControl("ASG_Telephone_0x31 - CombinedNumbers_EditCache", "env_ASG_CN_minute_11", 1);
            enableControl("ASG_Telephone_0x31 - CombinedNumbers_EditCache", "env_ASG_CN_second_11", 1);
        }

        else
        {
            putvalue(env_ASG_CN_pos_11, 0);
            putvalue(env_ASG_CN_PbName_s_11, empty_string);
            putvalue(env_ASG_CN_TelNum_s_11, empty_string);
            putvalue(env_ASG_CN_CallMode_11, 0);
            putvalue(env_ASG_CN_day_11, 0);
            putvalue(env_ASG_CN_month_11, 0);
            putvalue(env_ASG_CN_year_11, 0);
            putvalue(env_ASG_CN_hour_11, 0);
            putvalue(env_ASG_CN_minute_11, 0);
            putvalue(env_ASG_CN_second_11, 0);

            enableControl("ASG_Telephone_0x31 - CombinedNumbers_EditCache", "env_ASG_CN_pos_11", 0);
            enableControl("ASG_Telephone_0x31 - CombinedNumbers_EditCache", "env_ASG_CN_PbName_s_11", 0);
            enableControl("ASG_Telephone_0x31 - CombinedNumbers_EditCache", "env_ASG_CN_TelNum_s_11", 0);
            enableControl("ASG_Telephone_0x31 - CombinedNumbers_EditCache", "env_ASG_CN_CallMode_11", 0);
            enableControl("ASG_Telephone_0x31 - CombinedNumbers_EditCache", "env_ASG_CN_day_11", 0);
            enableControl("ASG_Telephone_0x31 - CombinedNumbers_EditCache", "env_ASG_CN_month_11", 0);
            enableControl("ASG_Telephone_0x31 - CombinedNumbers_EditCache", "env_ASG_CN_year_11", 0);
            enableControl("ASG_Telephone_0x31 - CombinedNumbers_EditCache", "env_ASG_CN_hour_11", 0);
            enableControl("ASG_Telephone_0x31 - CombinedNumbers_EditCache", "env_ASG_CN_minute_11", 0);
            enableControl("ASG_Telephone_0x31 - CombinedNumbers_EditCache", "env_ASG_CN_second_11", 0);
        }


        if(gCombinedNumbers_ListEntryReceptionInformation[1])
        {
            putvalue(env_ASG_CN_pos_12, gCombinedNumbers_Pos[1]);
            putvalue(env_ASG_CN_PbName_s_12, gCombinedNumbers_PbName[1]);
            putvalue(env_ASG_CN_TelNum_s_12, gCombinedNumbers_TelNumber[1]);
            putvalue(env_ASG_CN_CallMode_12, gCombinedNumbers_CallMode[1]);
            putvalue(env_ASG_CN_day_12, gCombinedNumbers_day[1]);
            putvalue(env_ASG_CN_month_12, gCombinedNumbers_month[1]);
            putvalue(env_ASG_CN_year_12, gCombinedNumbers_year[1]);
            putvalue(env_ASG_CN_hour_12, gCombinedNumbers_hour[1]);
            putvalue(env_ASG_CN_minute_12, gCombinedNumbers_minute[1]);
            putvalue(env_ASG_CN_second_12, gCombinedNumbers_second[1]);

            enableControl("ASG_Telephone_0x31 - CombinedNumbers_EditCache", "env_ASG_CN_pos_12", 1);
            enableControl("ASG_Telephone_0x31 - CombinedNumbers_EditCache", "env_ASG_CN_PbName_s_12", 1);
            enableControl("ASG_Telephone_0x31 - CombinedNumbers_EditCache", "env_ASG_CN_TelNum_s_12", 1);
            enableControl("ASG_Telephone_0x31 - CombinedNumbers_EditCache", "env_ASG_CN_CallMode_12", 1);
            enableControl("ASG_Telephone_0x31 - CombinedNumbers_EditCache", "env_ASG_CN_day_12", 1);
            enableControl("ASG_Telephone_0x31 - CombinedNumbers_EditCache", "env_ASG_CN_month_12", 1);
            enableControl("ASG_Telephone_0x31 - CombinedNumbers_EditCache", "env_ASG_CN_year_12", 1);
            enableControl("ASG_Telephone_0x31 - CombinedNumbers_EditCache", "env_ASG_CN_hour_12", 1);
            enableControl("ASG_Telephone_0x31 - CombinedNumbers_EditCache", "env_ASG_CN_minute_12", 1);
            enableControl("ASG_Telephone_0x31 - CombinedNumbers_EditCache", "env_ASG_CN_second_12", 1);
        }

        else
        {
            putvalue(env_ASG_CN_pos_12, 0);
            putvalue(env_ASG_CN_PbName_s_12, empty_string);
            putvalue(env_ASG_CN_TelNum_s_12, empty_string);
            putvalue(env_ASG_CN_CallMode_12, 0);
            putvalue(env_ASG_CN_day_12, 0);
            putvalue(env_ASG_CN_month_12, 0);
            putvalue(env_ASG_CN_year_12, 0);
            putvalue(env_ASG_CN_hour_12, 0);
            putvalue(env_ASG_CN_minute_12, 0);
            putvalue(env_ASG_CN_second_12, 0);

            enableControl("ASG_Telephone_0x31 - CombinedNumbers_EditCache", "env_ASG_CN_pos_12", 0);
            enableControl("ASG_Telephone_0x31 - CombinedNumbers_EditCache", "env_ASG_CN_PbName_s_12", 0);
            enableControl("ASG_Telephone_0x31 - CombinedNumbers_EditCache", "env_ASG_CN_TelNum_s_12", 0);
            enableControl("ASG_Telephone_0x31 - CombinedNumbers_EditCache", "env_ASG_CN_CallMode_12", 0);
            enableControl("ASG_Telephone_0x31 - CombinedNumbers_EditCache", "env_ASG_CN_day_12", 0);
            enableControl("ASG_Telephone_0x31 - CombinedNumbers_EditCache", "env_ASG_CN_month_12", 0);
            enableControl("ASG_Telephone_0x31 - CombinedNumbers_EditCache", "env_ASG_CN_year_12", 0);
            enableControl("ASG_Telephone_0x31 - CombinedNumbers_EditCache", "env_ASG_CN_hour_12", 0);
            enableControl("ASG_Telephone_0x31 - CombinedNumbers_EditCache", "env_ASG_CN_minute_12", 0);
            enableControl("ASG_Telephone_0x31 - CombinedNumbers_EditCache", "env_ASG_CN_second_12", 0);
        }


        if(gCombinedNumbers_ListEntryReceptionInformation[2])
        {
            putvalue(env_ASG_CN_pos_13, gCombinedNumbers_Pos[2]);
            putvalue(env_ASG_CN_PbName_s_13, gCombinedNumbers_PbName[2]);
            putvalue(env_ASG_CN_TelNum_s_13, gCombinedNumbers_TelNumber[2]);
            putvalue(env_ASG_CN_CallMode_13, gCombinedNumbers_CallMode[2]);
            putvalue(env_ASG_CN_day_13, gCombinedNumbers_day[2]);
            putvalue(env_ASG_CN_month_13, gCombinedNumbers_month[2]);
            putvalue(env_ASG_CN_year_13, gCombinedNumbers_year[2]);
            putvalue(env_ASG_CN_hour_13, gCombinedNumbers_hour[2]);
            putvalue(env_ASG_CN_minute_13, gCombinedNumbers_minute[2]);
            putvalue(env_ASG_CN_second_13, gCombinedNumbers_second[2]);

            enableControl("ASG_Telephone_0x31 - CombinedNumbers_EditCache", "env_ASG_CN_pos_13", 1);
            enableControl("ASG_Telephone_0x31 - CombinedNumbers_EditCache", "env_ASG_CN_PbName_s_13", 1);
            enableControl("ASG_Telephone_0x31 - CombinedNumbers_EditCache", "env_ASG_CN_TelNum_s_13", 1);
            enableControl("ASG_Telephone_0x31 - CombinedNumbers_EditCache", "env_ASG_CN_CallMode_13", 1);
            enableControl("ASG_Telephone_0x31 - CombinedNumbers_EditCache", "env_ASG_CN_day_13", 1);
            enableControl("ASG_Telephone_0x31 - CombinedNumbers_EditCache", "env_ASG_CN_month_13", 1);
            enableControl("ASG_Telephone_0x31 - CombinedNumbers_EditCache", "env_ASG_CN_year_13", 1);
            enableControl("ASG_Telephone_0x31 - CombinedNumbers_EditCache", "env_ASG_CN_hour_13", 1);
            enableControl("ASG_Telephone_0x31 - CombinedNumbers_EditCache", "env_ASG_CN_minute_13", 1);
            enableControl("ASG_Telephone_0x31 - CombinedNumbers_EditCache", "env_ASG_CN_second_13", 1);
        }

        else
        {
            putvalue(env_ASG_CN_pos_13, 0);
            putvalue(env_ASG_CN_PbName_s_13, empty_string);
            putvalue(env_ASG_CN_TelNum_s_13, empty_string);
            putvalue(env_ASG_CN_CallMode_13, 0);
            putvalue(env_ASG_CN_day_13, 0);
            putvalue(env_ASG_CN_month_13, 0);
            putvalue(env_ASG_CN_year_13, 0);
            putvalue(env_ASG_CN_hour_13, 0);
            putvalue(env_ASG_CN_minute_13, 0);
            putvalue(env_ASG_CN_second_13, 0);

            enableControl("ASG_Telephone_0x31 - CombinedNumbers_EditCache", "env_ASG_CN_pos_13", 0);
            enableControl("ASG_Telephone_0x31 - CombinedNumbers_EditCache", "env_ASG_CN_PbName_s_13", 0);
            enableControl("ASG_Telephone_0x31 - CombinedNumbers_EditCache", "env_ASG_CN_TelNum_s_13", 0);
            enableControl("ASG_Telephone_0x31 - CombinedNumbers_EditCache", "env_ASG_CN_CallMode_13", 0);
            enableControl("ASG_Telephone_0x31 - CombinedNumbers_EditCache", "env_ASG_CN_day_13", 0);
            enableControl("ASG_Telephone_0x31 - CombinedNumbers_EditCache", "env_ASG_CN_month_13", 0);
            enableControl("ASG_Telephone_0x31 - CombinedNumbers_EditCache", "env_ASG_CN_year_13", 0);
            enableControl("ASG_Telephone_0x31 - CombinedNumbers_EditCache", "env_ASG_CN_hour_13", 0);
            enableControl("ASG_Telephone_0x31 - CombinedNumbers_EditCache", "env_ASG_CN_minute_13", 0);
            enableControl("ASG_Telephone_0x31 - CombinedNumbers_EditCache", "env_ASG_CN_second_13", 0);
        }

        
        //lower cache
        if(gCombinedNumbers_ListEntryReceptionInformation[3])
        {
            putvalue(env_ASG_CN_pos_21, gCombinedNumbers_Pos[3]);
            putvalue(env_ASG_CN_PbName_s_21, gCombinedNumbers_PbName[3]);
            putvalue(env_ASG_CN_TelNum_s_21, gCombinedNumbers_TelNumber[3]);
            putvalue(env_ASG_CN_CallMode_21, gCombinedNumbers_CallMode[3]);
            putvalue(env_ASG_CN_day_21, gCombinedNumbers_day[3]);
            putvalue(env_ASG_CN_month_21, gCombinedNumbers_month[3]);
            putvalue(env_ASG_CN_year_21, gCombinedNumbers_year[3]);
            putvalue(env_ASG_CN_hour_21, gCombinedNumbers_hour[3]);
            putvalue(env_ASG_CN_minute_21, gCombinedNumbers_minute[3]);
            putvalue(env_ASG_CN_second_21, gCombinedNumbers_second[3]);

            enableControl("ASG_Telephone_0x31 - CombinedNumbers_EditCache", "env_ASG_CN_pos_21", 1);
            enableControl("ASG_Telephone_0x31 - CombinedNumbers_EditCache", "env_ASG_CN_PbName_s_21", 1);
            enableControl("ASG_Telephone_0x31 - CombinedNumbers_EditCache", "env_ASG_CN_TelNum_s_21", 1);
            enableControl("ASG_Telephone_0x31 - CombinedNumbers_EditCache", "env_ASG_CN_CallMode_21", 1);
            enableControl("ASG_Telephone_0x31 - CombinedNumbers_EditCache", "env_ASG_CN_day_21", 1);
            enableControl("ASG_Telephone_0x31 - CombinedNumbers_EditCache", "env_ASG_CN_month_21", 1);
            enableControl("ASG_Telephone_0x31 - CombinedNumbers_EditCache", "env_ASG_CN_year_21", 1);
            enableControl("ASG_Telephone_0x31 - CombinedNumbers_EditCache", "env_ASG_CN_hour_21", 1);
            enableControl("ASG_Telephone_0x31 - CombinedNumbers_EditCache", "env_ASG_CN_minute_21", 1);
            enableControl("ASG_Telephone_0x31 - CombinedNumbers_EditCache", "env_ASG_CN_second_21", 1);
        }

        else
        {
            putvalue(env_ASG_CN_pos_21, 0);
            putvalue(env_ASG_CN_PbName_s_21, empty_string);
            putvalue(env_ASG_CN_TelNum_s_21, empty_string);
            putvalue(env_ASG_CN_CallMode_21, 0);
            putvalue(env_ASG_CN_day_21, 0);
            putvalue(env_ASG_CN_month_21, 0);
            putvalue(env_ASG_CN_year_21, 0);
            putvalue(env_ASG_CN_hour_21, 0);
            putvalue(env_ASG_CN_minute_21, 0);
            putvalue(env_ASG_CN_second_21, 0);

            enableControl("ASG_Telephone_0x31 - CombinedNumbers_EditCache", "env_ASG_CN_pos_21", 0);
            enableControl("ASG_Telephone_0x31 - CombinedNumbers_EditCache", "env_ASG_CN_PbName_s_21", 0);
            enableControl("ASG_Telephone_0x31 - CombinedNumbers_EditCache", "env_ASG_CN_TelNum_s_21", 0);
            enableControl("ASG_Telephone_0x31 - CombinedNumbers_EditCache", "env_ASG_CN_CallMode_21", 0);
            enableControl("ASG_Telephone_0x31 - CombinedNumbers_EditCache", "env_ASG_CN_day_21", 0);
            enableControl("ASG_Telephone_0x31 - CombinedNumbers_EditCache", "env_ASG_CN_month_21", 0);
            enableControl("ASG_Telephone_0x31 - CombinedNumbers_EditCache", "env_ASG_CN_year_21", 0);
            enableControl("ASG_Telephone_0x31 - CombinedNumbers_EditCache", "env_ASG_CN_hour_21", 0);
            enableControl("ASG_Telephone_0x31 - CombinedNumbers_EditCache", "env_ASG_CN_minute_21", 0);
            enableControl("ASG_Telephone_0x31 - CombinedNumbers_EditCache", "env_ASG_CN_second_21", 0);
        }


        if(gCombinedNumbers_ListEntryReceptionInformation[4])
        {
            putvalue(env_ASG_CN_pos_22, gCombinedNumbers_Pos[4]);
            putvalue(env_ASG_CN_PbName_s_22, gCombinedNumbers_PbName[4]);
            putvalue(env_ASG_CN_TelNum_s_22, gCombinedNumbers_TelNumber[4]);
            putvalue(env_ASG_CN_CallMode_22, gCombinedNumbers_CallMode[4]);
            putvalue(env_ASG_CN_day_22, gCombinedNumbers_day[4]);
            putvalue(env_ASG_CN_month_22, gCombinedNumbers_month[4]);
            putvalue(env_ASG_CN_year_22, gCombinedNumbers_year[4]);
            putvalue(env_ASG_CN_hour_22, gCombinedNumbers_hour[4]);
            putvalue(env_ASG_CN_minute_22, gCombinedNumbers_minute[4]);
            putvalue(env_ASG_CN_second_22, gCombinedNumbers_second[4]);

            enableControl("ASG_Telephone_0x31 - CombinedNumbers_EditCache", "env_ASG_CN_pos_22", 1);
            enableControl("ASG_Telephone_0x31 - CombinedNumbers_EditCache", "env_ASG_CN_PbName_s_22", 1);
            enableControl("ASG_Telephone_0x31 - CombinedNumbers_EditCache", "env_ASG_CN_TelNum_s_22", 1);
            enableControl("ASG_Telephone_0x31 - CombinedNumbers_EditCache", "env_ASG_CN_CallMode_22", 1);
            enableControl("ASG_Telephone_0x31 - CombinedNumbers_EditCache", "env_ASG_CN_day_22", 1);
            enableControl("ASG_Telephone_0x31 - CombinedNumbers_EditCache", "env_ASG_CN_month_22", 1);
            enableControl("ASG_Telephone_0x31 - CombinedNumbers_EditCache", "env_ASG_CN_year_22", 1);
            enableControl("ASG_Telephone_0x31 - CombinedNumbers_EditCache", "env_ASG_CN_hour_22", 1);
            enableControl("ASG_Telephone_0x31 - CombinedNumbers_EditCache", "env_ASG_CN_minute_22", 1);
            enableControl("ASG_Telephone_0x31 - CombinedNumbers_EditCache", "env_ASG_CN_second_22", 1);
        }

        else
        {
            putvalue(env_ASG_CN_pos_22, 0);
            putvalue(env_ASG_CN_PbName_s_22, empty_string);
            putvalue(env_ASG_CN_TelNum_s_22, empty_string);
            putvalue(env_ASG_CN_CallMode_22, 0);
            putvalue(env_ASG_CN_day_22, 0);
            putvalue(env_ASG_CN_month_22, 0);
            putvalue(env_ASG_CN_year_22, 0);
            putvalue(env_ASG_CN_hour_22, 0);
            putvalue(env_ASG_CN_minute_22, 0);
            putvalue(env_ASG_CN_second_22, 0);

            enableControl("ASG_Telephone_0x31 - CombinedNumbers_EditCache", "env_ASG_CN_pos_22", 0);
            enableControl("ASG_Telephone_0x31 - CombinedNumbers_EditCache", "env_ASG_CN_PbName_s_22", 0);
            enableControl("ASG_Telephone_0x31 - CombinedNumbers_EditCache", "env_ASG_CN_TelNum_s_22", 0);
            enableControl("ASG_Telephone_0x31 - CombinedNumbers_EditCache", "env_ASG_CN_CallMode_22", 0);
            enableControl("ASG_Telephone_0x31 - CombinedNumbers_EditCache", "env_ASG_CN_day_22", 0);
            enableControl("ASG_Telephone_0x31 - CombinedNumbers_EditCache", "env_ASG_CN_month_22", 0);
            enableControl("ASG_Telephone_0x31 - CombinedNumbers_EditCache", "env_ASG_CN_year_22", 0);
            enableControl("ASG_Telephone_0x31 - CombinedNumbers_EditCache", "env_ASG_CN_hour_22", 0);
            enableControl("ASG_Telephone_0x31 - CombinedNumbers_EditCache", "env_ASG_CN_minute_22", 0);
            enableControl("ASG_Telephone_0x31 - CombinedNumbers_EditCache", "env_ASG_CN_second_22", 0);
        }


        if(gCombinedNumbers_ListEntryReceptionInformation[5])
        {
            putvalue(env_ASG_CN_pos_23, gCombinedNumbers_Pos[5]);
            putvalue(env_ASG_CN_PbName_s_23, gCombinedNumbers_PbName[5]);
            putvalue(env_ASG_CN_TelNum_s_23, gCombinedNumbers_TelNumber[5]);
            putvalue(env_ASG_CN_CallMode_23, gCombinedNumbers_CallMode[5]);
            putvalue(env_ASG_CN_day_23, gCombinedNumbers_day[5]);
            putvalue(env_ASG_CN_month_23, gCombinedNumbers_month[5]);
            putvalue(env_ASG_CN_year_23, gCombinedNumbers_year[5]);
            putvalue(env_ASG_CN_hour_23, gCombinedNumbers_hour[5]);
            putvalue(env_ASG_CN_minute_23, gCombinedNumbers_minute[5]);
            putvalue(env_ASG_CN_second_23, gCombinedNumbers_second[5]);

            enableControl("ASG_Telephone_0x31 - CombinedNumbers_EditCache", "env_ASG_CN_pos_23", 1);
            enableControl("ASG_Telephone_0x31 - CombinedNumbers_EditCache", "env_ASG_CN_PbName_s_23", 1);
            enableControl("ASG_Telephone_0x31 - CombinedNumbers_EditCache", "env_ASG_CN_TelNum_s_23", 1);
            enableControl("ASG_Telephone_0x31 - CombinedNumbers_EditCache", "env_ASG_CN_CallMode_23", 1);
            enableControl("ASG_Telephone_0x31 - CombinedNumbers_EditCache", "env_ASG_CN_day_23", 1);
            enableControl("ASG_Telephone_0x31 - CombinedNumbers_EditCache", "env_ASG_CN_month_23", 1);
            enableControl("ASG_Telephone_0x31 - CombinedNumbers_EditCache", "env_ASG_CN_year_23", 1);
            enableControl("ASG_Telephone_0x31 - CombinedNumbers_EditCache", "env_ASG_CN_hour_23", 1);
            enableControl("ASG_Telephone_0x31 - CombinedNumbers_EditCache", "env_ASG_CN_minute_23", 1);
            enableControl("ASG_Telephone_0x31 - CombinedNumbers_EditCache", "env_ASG_CN_second_23", 1);
        }

        else
        {
            putvalue(env_ASG_CN_pos_23, 0);
            putvalue(env_ASG_CN_PbName_s_23, empty_string);
            putvalue(env_ASG_CN_TelNum_s_23, empty_string);
            putvalue(env_ASG_CN_CallMode_23, 0);
            putvalue(env_ASG_CN_day_23, 0);
            putvalue(env_ASG_CN_month_23, 0);
            putvalue(env_ASG_CN_year_23, 0);
            putvalue(env_ASG_CN_hour_23, 0);
            putvalue(env_ASG_CN_minute_23, 0);
            putvalue(env_ASG_CN_second_23, 0);

            enableControl("ASG_Telephone_0x31 - CombinedNumbers_EditCache", "env_ASG_CN_pos_23", 0);
            enableControl("ASG_Telephone_0x31 - CombinedNumbers_EditCache", "env_ASG_CN_PbName_s_23", 0);
            enableControl("ASG_Telephone_0x31 - CombinedNumbers_EditCache", "env_ASG_CN_TelNum_s_23", 0);
            enableControl("ASG_Telephone_0x31 - CombinedNumbers_EditCache", "env_ASG_CN_CallMode_23", 0);
            enableControl("ASG_Telephone_0x31 - CombinedNumbers_EditCache", "env_ASG_CN_day_23", 0);
            enableControl("ASG_Telephone_0x31 - CombinedNumbers_EditCache", "env_ASG_CN_month_23", 0);
            enableControl("ASG_Telephone_0x31 - CombinedNumbers_EditCache", "env_ASG_CN_year_23", 0);
            enableControl("ASG_Telephone_0x31 - CombinedNumbers_EditCache", "env_ASG_CN_hour_23", 0);
            enableControl("ASG_Telephone_0x31 - CombinedNumbers_EditCache", "env_ASG_CN_minute_23", 0);
            enableControl("ASG_Telephone_0x31 - CombinedNumbers_EditCache", "env_ASG_CN_second_23", 0);
        }
}
/*@@end*/

/*@@envVar:env_ASG_RC_EditDispCache:*/
on envVar env_ASG_RC_EditDispCache
{
    if(gRNS_PowerOnOff==Power_on && getvalue(this))
    {    
        OpenPanel("ASG_Telephone_0x2F - ReceivedCalls_EditCache");
        
        ReceivedCalls_DisplayCache();
    }
}
/*@@end*/

/*@@envVar:env_ASG_RC_GetArray:*/
on envVar env_ASG_RC_GetArray
{
    byte mode, shift, direction, transmitpos, indexsize,recordaddress;
    word requested_startelement, startelement, elements;

    // Init local variables. 
    mode                    =0;
    shift                   =0;
    direction               =0;
    transmitpos             =0;
    indexsize               =0;
    recordaddress           =0;
    requested_startelement  =0;
    startelement            =0;
    elements                =0;

    if(gRNS_PowerOnOff==Power_on && getvalue(this) && gReceivedCalls_ListHandlingType ==TEL_RECEIVEDCALLS_NOCACHE)
	{
        gReceivedCalls_ASGID            =getvalue(env_ASG_RC_ASGID);
        gReceivedCalls_TAID             =getvalue(env_ASG_RC_TAID);

        shift                           =getvalue(env_ASG_RC_AH_shift);
        direction                       =getvalue(env_ASG_RC_AH_dir);
        transmitpos                     =getvalue(env_ASG_RC_AH_PosTrans);
        indexsize                       =getvalue(env_ASG_RC_AH_IS);
        recordaddress                   =getvalue(env_ASG_RC_AH_RA);
        startelement                    =getvalue(env_ASG_RC_AH_start);
        elements                        =getvalue(env_ASG_RC_AH_elements);
        
        requested_startelement  =startelement;
        mode                    =shift +(direction*0x02) +(transmitpos*0x04) +indexsize*0x08;

        ReceivedCalls_Request(DataGet_REQ, mode, recordaddress, requested_startelement, startelement, elements);
    }
}
/*@@end*/

/*@@envVar:env_ASG_RC_GetCachedData:*/
on envVar env_ASG_RC_GetCachedData
{
    if(gRNS_PowerOnOff==Power_on && getvalue(this))
        ReceivedCalls_DisplayCache();
        
}
/*@@end*/

/*@@envVar:env_ASG_RC_OnOff:*/
on envVar env_ASG_RC_OnOff
{
    int i =0, j =0;
    if(gRNS_PowerOnOff==Power_on)
	{   
        if(getvalue(this))
        {
            gReceivedCalls_ListHandlingType      =TEL_RECEIVEDCALLS_BUILDUPCACHE;             //build-up complete cache...
            gReceivedCalls_cacheBuildUp          =TEL_RECEIVEDCALLS_BUILDUPCACHECACHE_WINDOW; //...and start with area "window"            
            gReceivedCalls_UpCaching_required    =TRUE;
            gReceivedCalls_DownCaching_required  =TRUE;
            gReceivedCalls_MoveList_down_allowed =TRUE;
            gReceivedCalls_MoveList_up_allowed   =FALSE; 

            ReceivedCalls_ListHandling ();

        }
        else
        {
            gReceivedCalls_SlidingWindow_State   =TEL_RECEIVEDCALLS_SLIDINGWINDOW_NOTACTIVE;
            gReceivedCalls_ListHandlingType      =TEL_RECEIVEDCALLS_NOCACHE;
            gReceivedCalls_cacheBuildUp          =TEL_RECEIVEDCALLS_BUILDUPCACHENOCACHE;
            gReceivedCalls_CallBackReason        =TEL_RECEIVEDCALLS_CALLBACKREASON_NOCALLBACK;

            gReceivedCalls_cacheDown             =FALSE;
            gReceivedCalls_cacheUp               =FALSE;
            gReceivedCalls_LastFirstElement      =0;

            gReceivedCalls_recordaddress         =0;
            gReceivedCalls_transmitpos           =1;
            gReceivedCalls_CursorAction          =TEL_RECEIVEDCALLS_CURSORACTION_NOTHING;
            gReceivedCalls_DisplayStatus         =TEL_RECEIVEDCALLS_DISPLAYLIST_FIRST_ELEMENTS;
            
            gReceivedCalls_LastElement           =0;
            gReceivedCalls_FirstElement          =0;
            gReceivedCalls_DownCaching_required  =FALSE;
            gReceivedCalls_UpCaching_required    =FALSE; 
            gReceivedCalls_MoveList_down_allowed =FALSE; 
            gReceivedCalls_MoveList_up_allowed   =FALSE;

            for(j=0; j<TEL_RECEIVEDCALLS_ASGCACHE_MAX_SIZE; j++)
            {     
                gReceivedCalls_Pos[j]                 =0;
                gReceivedCalls_NumberType[j]            =0;
                gReceivedCalls_day[j]                 =0;
                gReceivedCalls_month[j]               =0;
                gReceivedCalls_year[j]                =0;
                gReceivedCalls_hour[j]                =0;
                gReceivedCalls_minute[j]              =0;
                gReceivedCalls_second[j]              =0;
                
                gReceivedCalls_ListEntryReceptionInformation[j]  =0;

                for(i=0;i<TEL_RECEIVEDCALLS_PBNAME_LENGTH;i++)
			        gReceivedCalls_PbName[j][i] =0;
                
                for(i=0;i<TEL_RECEIVEDCALLS_TELNUMBER_LENGTH;i++)
			        gReceivedCalls_TelNumber[j][i] =0;
            }
            putvalue(env_ASG_RC_pos_0, 0);
            putvalue(env_ASG_RC_pos_1, 0);
            putvalue(env_ASG_RC_pos_2, 0);
    
            putvalue(env_ASG_RC_NumType_0, 0);
            putvalue(env_ASG_RC_NumType_1, 0);
            putvalue(env_ASG_RC_NumType_2, 0);

            putvalue(env_ASG_RC_NumType_s_0,empty_string);
            putvalue(env_ASG_RC_NumType_s_1,empty_string);
            putvalue(env_ASG_RC_NumType_s_2,empty_string);

            putvalue(env_ASG_RC_PbName_s_0, empty_string);
            putvalue(env_ASG_RC_PbName_s_1, empty_string);
            putvalue(env_ASG_RC_PbName_s_2, empty_string);

            putvalue(env_ASG_RC_TelNum_s_0, empty_string);
            putvalue(env_ASG_RC_TelNum_s_1, empty_string);
            putvalue(env_ASG_RC_TelNum_s_2, empty_string);

            putvalue(env_ASG_RC_day_0, 0);
            putvalue(env_ASG_RC_day_1, 0);
            putvalue(env_ASG_RC_day_2, 0);

            putvalue(env_ASG_RC_month_0, 0);
            putvalue(env_ASG_RC_month_1, 0);
            putvalue(env_ASG_RC_month_2, 0);

            putvalue(env_ASG_RC_year_0, 0);
            putvalue(env_ASG_RC_year_1, 0);
            putvalue(env_ASG_RC_year_2, 0);

            putvalue(env_ASG_RC_hour_0, 0);
            putvalue(env_ASG_RC_hour_1, 0);
            putvalue(env_ASG_RC_hour_2, 0);

            putvalue(env_ASG_RC_minute_0, 0);
            putvalue(env_ASG_RC_minute_1, 0);
            putvalue(env_ASG_RC_minute_2, 0);

            putvalue(env_ASG_RC_second_0, 0);
            putvalue(env_ASG_RC_second_1, 0);
            putvalue(env_ASG_RC_second_2, 0);
            
            
            putvalue(env_ASG_RC_pos_01, 0);
            putvalue(env_ASG_RC_PbName_s_01, empty_string);
            putvalue(env_ASG_RC_TelNum_s_01, empty_string);
            putvalue(env_ASG_RC_NumType_01, 0);
            putvalue(env_ASG_RC_day_01, 0);
            putvalue(env_ASG_RC_month_01, 0);
            putvalue(env_ASG_RC_year_01, 0);
            putvalue(env_ASG_RC_hour_01, 0);
            putvalue(env_ASG_RC_minute_01, 0);
            putvalue(env_ASG_RC_second_01, 0);

            enableControl("ASG_Telephone_0x31 - ReceivedCalls_EditCache", "env_ASG_RC_pos_01", 0);
            enableControl("ASG_Telephone_0x31 - ReceivedCalls_EditCache", "env_ASG_RC_PbName_s_01", 0);
            enableControl("ASG_Telephone_0x31 - ReceivedCalls_EditCache", "env_ASG_RC_TelNum_s_01", 0);
            enableControl("ASG_Telephone_0x31 - ReceivedCalls_EditCache", "env_ASG_RC_NumType_01", 0);
            enableControl("ASG_Telephone_0x31 - ReceivedCalls_EditCache", "env_ASG_RC_day_01", 0);
            enableControl("ASG_Telephone_0x31 - ReceivedCalls_EditCache", "env_ASG_RC_month_01", 0);
            enableControl("ASG_Telephone_0x31 - ReceivedCalls_EditCache", "env_ASG_RC_year_01", 0);
            enableControl("ASG_Telephone_0x31 - ReceivedCalls_EditCache", "env_ASG_RC_hour_01", 0);
            enableControl("ASG_Telephone_0x31 - ReceivedCalls_EditCache", "env_ASG_RC_minute_01", 0);
            enableControl("ASG_Telephone_0x31 - ReceivedCalls_EditCache", "env_ASG_RC_second_01", 0);
        
            
            putvalue(env_ASG_RC_pos_02, 0);
            putvalue(env_ASG_RC_PbName_s_02, empty_string);
            putvalue(env_ASG_RC_TelNum_s_02, empty_string);
            putvalue(env_ASG_RC_NumType_02, 0);
            putvalue(env_ASG_RC_day_02, 0);
            putvalue(env_ASG_RC_month_02, 0);
            putvalue(env_ASG_RC_year_02, 0);
            putvalue(env_ASG_RC_hour_02, 0);
            putvalue(env_ASG_RC_minute_02, 0);
            putvalue(env_ASG_RC_second_02, 0);

            enableControl("ASG_Telephone_0x31 - ReceivedCalls_EditCache", "env_ASG_RC_pos_02", 0);
            enableControl("ASG_Telephone_0x31 - ReceivedCalls_EditCache", "env_ASG_RC_PbName_s_02", 0);
            enableControl("ASG_Telephone_0x31 - ReceivedCalls_EditCache", "env_ASG_RC_TelNum_s_02", 0);
            enableControl("ASG_Telephone_0x31 - ReceivedCalls_EditCache", "env_ASG_RC_NumType_02", 0);
            enableControl("ASG_Telephone_0x31 - ReceivedCalls_EditCache", "env_ASG_RC_day_02", 0);
            enableControl("ASG_Telephone_0x31 - ReceivedCalls_EditCache", "env_ASG_RC_month_02", 0);
            enableControl("ASG_Telephone_0x31 - ReceivedCalls_EditCache", "env_ASG_RC_year_02", 0);
            enableControl("ASG_Telephone_0x31 - ReceivedCalls_EditCache", "env_ASG_RC_hour_02", 0);
            enableControl("ASG_Telephone_0x31 - ReceivedCalls_EditCache", "env_ASG_RC_minute_02", 0);
            enableControl("ASG_Telephone_0x31 - ReceivedCalls_EditCache", "env_ASG_RC_second_02", 0);
        

            putvalue(env_ASG_RC_pos_03, 0);
            putvalue(env_ASG_RC_PbName_s_03, empty_string);
            putvalue(env_ASG_RC_TelNum_s_03, empty_string);
            putvalue(env_ASG_RC_NumType_03, 0);
            putvalue(env_ASG_RC_day_03, 0);
            putvalue(env_ASG_RC_month_03, 0);
            putvalue(env_ASG_RC_year_03, 0);
            putvalue(env_ASG_RC_hour_03, 0);
            putvalue(env_ASG_RC_minute_03, 0);
            putvalue(env_ASG_RC_second_03, 0);

            enableControl("ASG_Telephone_0x31 - ReceivedCalls_EditCache", "env_ASG_RC_pos_03", 0);
            enableControl("ASG_Telephone_0x31 - ReceivedCalls_EditCache", "env_ASG_RC_PbName_s_03", 0);
            enableControl("ASG_Telephone_0x31 - ReceivedCalls_EditCache", "env_ASG_RC_TelNum_s_03", 0);
            enableControl("ASG_Telephone_0x31 - ReceivedCalls_EditCache", "env_ASG_RC_NumType_03", 0);
            enableControl("ASG_Telephone_0x31 - ReceivedCalls_EditCache", "env_ASG_RC_day_03", 0);
            enableControl("ASG_Telephone_0x31 - ReceivedCalls_EditCache", "env_ASG_RC_month_03", 0);
            enableControl("ASG_Telephone_0x31 - ReceivedCalls_EditCache", "env_ASG_RC_year_03", 0);
            enableControl("ASG_Telephone_0x31 - ReceivedCalls_EditCache", "env_ASG_RC_hour_03", 0);
            enableControl("ASG_Telephone_0x31 - ReceivedCalls_EditCache", "env_ASG_RC_minute_03", 0);
            enableControl("ASG_Telephone_0x31 - ReceivedCalls_EditCache", "env_ASG_RC_second_03", 0);
        

            putvalue(env_ASG_RC_pos_11, 0);
            putvalue(env_ASG_RC_PbName_s_11, empty_string);
            putvalue(env_ASG_RC_TelNum_s_11, empty_string);
            putvalue(env_ASG_RC_NumType_11, 0);
            putvalue(env_ASG_RC_day_11, 0);
            putvalue(env_ASG_RC_month_11, 0);
            putvalue(env_ASG_RC_year_11, 0);
            putvalue(env_ASG_RC_hour_11, 0);
            putvalue(env_ASG_RC_minute_11, 0);
            putvalue(env_ASG_RC_second_11, 0);

            enableControl("ASG_Telephone_0x31 - ReceivedCalls_EditCache", "env_ASG_RC_pos_11", 0);
            enableControl("ASG_Telephone_0x31 - ReceivedCalls_EditCache", "env_ASG_RC_PbName_s_11", 0);
            enableControl("ASG_Telephone_0x31 - ReceivedCalls_EditCache", "env_ASG_RC_TelNum_s_11", 0);
            enableControl("ASG_Telephone_0x31 - ReceivedCalls_EditCache", "env_ASG_RC_NumType_11", 0);
            enableControl("ASG_Telephone_0x31 - ReceivedCalls_EditCache", "env_ASG_RC_day_11", 0);
            enableControl("ASG_Telephone_0x31 - ReceivedCalls_EditCache", "env_ASG_RC_month_11", 0);
            enableControl("ASG_Telephone_0x31 - ReceivedCalls_EditCache", "env_ASG_RC_year_11", 0);
            enableControl("ASG_Telephone_0x31 - ReceivedCalls_EditCache", "env_ASG_RC_hour_11", 0);
            enableControl("ASG_Telephone_0x31 - ReceivedCalls_EditCache", "env_ASG_RC_minute_11", 0);
            enableControl("ASG_Telephone_0x31 - ReceivedCalls_EditCache", "env_ASG_RC_second_11", 0);
   
            
            putvalue(env_ASG_RC_pos_12, 0);
            putvalue(env_ASG_RC_PbName_s_12, empty_string);
            putvalue(env_ASG_RC_TelNum_s_12, empty_string);
            putvalue(env_ASG_RC_NumType_12, 0);
            putvalue(env_ASG_RC_day_12, 0);
            putvalue(env_ASG_RC_month_12, 0);
            putvalue(env_ASG_RC_year_12, 0);
            putvalue(env_ASG_RC_hour_12, 0);
            putvalue(env_ASG_RC_minute_12, 0);
            putvalue(env_ASG_RC_second_12, 0);

            enableControl("ASG_Telephone_0x31 - ReceivedCalls_EditCache", "env_ASG_RC_pos_12", 0);
            enableControl("ASG_Telephone_0x31 - ReceivedCalls_EditCache", "env_ASG_RC_PbName_s_12", 0);
            enableControl("ASG_Telephone_0x31 - ReceivedCalls_EditCache", "env_ASG_RC_TelNum_s_12", 0);
            enableControl("ASG_Telephone_0x31 - ReceivedCalls_EditCache", "env_ASG_RC_NumType_12", 0);
            enableControl("ASG_Telephone_0x31 - ReceivedCalls_EditCache", "env_ASG_RC_day_12", 0);
            enableControl("ASG_Telephone_0x31 - ReceivedCalls_EditCache", "env_ASG_RC_month_12", 0);
            enableControl("ASG_Telephone_0x31 - ReceivedCalls_EditCache", "env_ASG_RC_year_12", 0);
            enableControl("ASG_Telephone_0x31 - ReceivedCalls_EditCache", "env_ASG_RC_hour_12", 0);
            enableControl("ASG_Telephone_0x31 - ReceivedCalls_EditCache", "env_ASG_RC_minute_12", 0);
            enableControl("ASG_Telephone_0x31 - ReceivedCalls_EditCache", "env_ASG_RC_second_12", 0);


            putvalue(env_ASG_RC_pos_13, 0);
            putvalue(env_ASG_RC_PbName_s_13, empty_string);
            putvalue(env_ASG_RC_TelNum_s_13, empty_string);
            putvalue(env_ASG_RC_NumType_13, 0);
            putvalue(env_ASG_RC_day_13, 0);
            putvalue(env_ASG_RC_month_13, 0);
            putvalue(env_ASG_RC_year_13, 0);
            putvalue(env_ASG_RC_hour_13, 0);
            putvalue(env_ASG_RC_minute_13, 0);
            putvalue(env_ASG_RC_second_13, 0);

            
            enableControl("ASG_Telephone_0x31 - ReceivedCalls_EditCache", "env_ASG_RC_pos_13", 0);
            enableControl("ASG_Telephone_0x31 - ReceivedCalls_EditCache", "env_ASG_RC_PbName_s_13", 0);
            enableControl("ASG_Telephone_0x31 - ReceivedCalls_EditCache", "env_ASG_RC_TelNum_s_13", 0);
            enableControl("ASG_Telephone_0x31 - ReceivedCalls_EditCache", "env_ASG_RC_NumType_13", 0);
            enableControl("ASG_Telephone_0x31 - ReceivedCalls_EditCache", "env_ASG_RC_day_13", 0);
            enableControl("ASG_Telephone_0x31 - ReceivedCalls_EditCache", "env_ASG_RC_month_13", 0);
            enableControl("ASG_Telephone_0x31 - ReceivedCalls_EditCache", "env_ASG_RC_year_13", 0);
            enableControl("ASG_Telephone_0x31 - ReceivedCalls_EditCache", "env_ASG_RC_hour_13", 0);
            enableControl("ASG_Telephone_0x31 - ReceivedCalls_EditCache", "env_ASG_RC_minute_13", 0);
            enableControl("ASG_Telephone_0x31 - ReceivedCalls_EditCache", "env_ASG_RC_second_13", 0);

            putvalue(env_ASG_RC_pos_21, 0);
            putvalue(env_ASG_RC_PbName_s_21, empty_string);
            putvalue(env_ASG_RC_TelNum_s_21, empty_string);
            putvalue(env_ASG_RC_NumType_21, 0);
            putvalue(env_ASG_RC_day_21, 0);
            putvalue(env_ASG_RC_month_21, 0);
            putvalue(env_ASG_RC_year_21, 0);
            putvalue(env_ASG_RC_hour_21, 0);
            putvalue(env_ASG_RC_minute_21, 0);
            putvalue(env_ASG_RC_second_21, 0);

            enableControl("ASG_Telephone_0x31 - ReceivedCalls_EditCache", "env_ASG_RC_pos_21", 0);
            enableControl("ASG_Telephone_0x31 - ReceivedCalls_EditCache", "env_ASG_RC_PbName_s_21", 0);
            enableControl("ASG_Telephone_0x31 - ReceivedCalls_EditCache", "env_ASG_RC_TelNum_s_21", 0);
            enableControl("ASG_Telephone_0x31 - ReceivedCalls_EditCache", "env_ASG_RC_NumType_21", 0);
            enableControl("ASG_Telephone_0x31 - ReceivedCalls_EditCache", "env_ASG_RC_day_21", 0);
            enableControl("ASG_Telephone_0x31 - ReceivedCalls_EditCache", "env_ASG_RC_month_21", 0);
            enableControl("ASG_Telephone_0x31 - ReceivedCalls_EditCache", "env_ASG_RC_year_21", 0);
            enableControl("ASG_Telephone_0x31 - ReceivedCalls_EditCache", "env_ASG_RC_hour_21", 0);
            enableControl("ASG_Telephone_0x31 - ReceivedCalls_EditCache", "env_ASG_RC_minute_21", 0);
            enableControl("ASG_Telephone_0x31 - ReceivedCalls_EditCache", "env_ASG_RC_second_21", 0);

            putvalue(env_ASG_RC_pos_22, 0);
            putvalue(env_ASG_RC_PbName_s_22, empty_string);
            putvalue(env_ASG_RC_TelNum_s_22, empty_string);
            putvalue(env_ASG_RC_NumType_22, 0);
            putvalue(env_ASG_RC_day_22, 0);
            putvalue(env_ASG_RC_month_22, 0);
            putvalue(env_ASG_RC_year_22, 0);
            putvalue(env_ASG_RC_hour_22, 0);
            putvalue(env_ASG_RC_minute_22, 0);
            putvalue(env_ASG_RC_second_22, 0);

            enableControl("ASG_Telephone_0x31 - ReceivedCalls_EditCache", "env_ASG_RC_pos_22", 0);
            enableControl("ASG_Telephone_0x31 - ReceivedCalls_EditCache", "env_ASG_RC_PbName_s_22", 0);
            enableControl("ASG_Telephone_0x31 - ReceivedCalls_EditCache", "env_ASG_RC_TelNum_s_22", 0);
            enableControl("ASG_Telephone_0x31 - ReceivedCalls_EditCache", "env_ASG_RC_NumType_22", 0);
            enableControl("ASG_Telephone_0x31 - ReceivedCalls_EditCache", "env_ASG_RC_day_22", 0);
            enableControl("ASG_Telephone_0x31 - ReceivedCalls_EditCache", "env_ASG_RC_month_22", 0);
            enableControl("ASG_Telephone_0x31 - ReceivedCalls_EditCache", "env_ASG_RC_year_22", 0);
            enableControl("ASG_Telephone_0x31 - ReceivedCalls_EditCache", "env_ASG_RC_hour_22", 0);
            enableControl("ASG_Telephone_0x31 - ReceivedCalls_EditCache", "env_ASG_RC_minute_22", 0);
            enableControl("ASG_Telephone_0x31 - ReceivedCalls_EditCache", "env_ASG_RC_second_22", 0);
       
            putvalue(env_ASG_RC_pos_23, 0);
            putvalue(env_ASG_RC_PbName_s_23, empty_string);
            putvalue(env_ASG_RC_TelNum_s_23, empty_string);
            putvalue(env_ASG_RC_NumType_23, 0);
            putvalue(env_ASG_RC_day_23, 0);
            putvalue(env_ASG_RC_month_23, 0);
            putvalue(env_ASG_RC_year_23, 0);
            putvalue(env_ASG_RC_hour_23, 0);
            putvalue(env_ASG_RC_minute_23, 0);
            putvalue(env_ASG_RC_second_23, 0);

            enableControl("ASG_Telephone_0x31 - ReceivedCalls_EditCache", "env_ASG_RC_pos_23", 0);
            enableControl("ASG_Telephone_0x31 - ReceivedCalls_EditCache", "env_ASG_RC_PbName_s_23", 0);
            enableControl("ASG_Telephone_0x31 - ReceivedCalls_EditCache", "env_ASG_RC_TelNum_s_23", 0);
            enableControl("ASG_Telephone_0x31 - ReceivedCalls_EditCache", "env_ASG_RC_NumType_23", 0);
            enableControl("ASG_Telephone_0x31 - ReceivedCalls_EditCache", "env_ASG_RC_day_23", 0);
            enableControl("ASG_Telephone_0x31 - ReceivedCalls_EditCache", "env_ASG_RC_month_23", 0);
            enableControl("ASG_Telephone_0x31 - ReceivedCalls_EditCache", "env_ASG_RC_year_23", 0);
            enableControl("ASG_Telephone_0x31 - ReceivedCalls_EditCache", "env_ASG_RC_hour_23", 0);
            enableControl("ASG_Telephone_0x31 - ReceivedCalls_EditCache", "env_ASG_RC_minute_23", 0);
            enableControl("ASG_Telephone_0x31 - ReceivedCalls_EditCache", "env_ASG_RC_second_23", 0);

            putvalue(env_ASG_RC_ListInfo_up,empty_string);
            putvalue(env_ASG_RC_ListInfo_down,empty_string);
            putvalue(env_ASG_RC_ListInfo_Cursor,empty_string);

            ClosePanel("ASG_Telephone_0x31 - ReceivedCalls_EditCache");          
        }
    }
}   
/*@@end*/

/*@@envVar:env_ASG_RC_SetGetArray:*/
on envVar env_ASG_RC_SetGetArray
{
    byte mode, shift, direction, transmitpos, indexsize,recordaddress;
    word requested_startelement, startelement, elements;

    // Init local variables. 
    mode                    =0;
    shift                   =0;
    direction               =0;
    transmitpos             =0;
    indexsize               =0;
    recordaddress           =0;
    requested_startelement  =0;
    startelement            =0;
    elements                =0;

    if(gRNS_PowerOnOff==Power_on && getvalue(this) && gReceivedCalls_ListHandlingType ==TEL_RECEIVEDCALLS_NOCACHE)
	{
        gReceivedCalls_ASGID            =getvalue(env_ASG_RC_ASGID);
        gReceivedCalls_TAID             =getvalue(env_ASG_RC_TAID);

        shift                           =getvalue(env_ASG_RC_AH_shift);
        direction                       =getvalue(env_ASG_RC_AH_dir);
        transmitpos                     =getvalue(env_ASG_RC_AH_PosTrans);
        indexsize                       =getvalue(env_ASG_RC_AH_IS);
        recordaddress                   =getvalue(env_ASG_RC_AH_RA);
        startelement                    =getvalue(env_ASG_RC_AH_start);
        elements                        =getvalue(env_ASG_RC_AH_elements);
        
        requested_startelement  =startelement;
        mode                    =(shift +(direction*0x02) +(transmitpos*0x04) +(indexsize*0x08));

        ReceivedCalls_Request(DataSetGet_REQ, mode, recordaddress, requested_startelement, startelement, elements);
    }
}
/*@@end*/

/*@@envVar:env_ASG_RC_TakeOver:*/
on envVar env_ASG_RC_TakeOver
{
    if(gRNS_PowerOnOff==Power_on && getvalue(this))
	{
        //upper cache
        if(gReceivedCalls_ListEntryReceptionInformation[6])
        {
            gReceivedCalls_Pos[6]         =getvalue(env_ASG_RC_pos_01);
            getvalue(env_ASG_RC_PbName_s_01, gReceivedCalls_PbName[6]);
            getvalue(env_ASG_RC_TelNum_s_01, gReceivedCalls_TelNumber[6]);
            gReceivedCalls_NumberType[6]    =getvalue(env_ASG_RC_NumType_01);
            gReceivedCalls_day[6]         =getvalue(env_ASG_RC_day_01);
            gReceivedCalls_month[6]       =getvalue(env_ASG_RC_month_01);
            gReceivedCalls_year[6]        =getvalue(env_ASG_RC_year_01);
            gReceivedCalls_hour[6]        =getvalue(env_ASG_RC_hour_01);
            gReceivedCalls_minute[6]      =getvalue(env_ASG_RC_minute_01);
            gReceivedCalls_second[6]      =getvalue(env_ASG_RC_second_01);
        }

        else
        {
            putvalue(env_ASG_RC_pos_01, 0);
            putvalue(env_ASG_RC_PbName_s_01, empty_string);
            putvalue(env_ASG_RC_TelNum_s_01, empty_string);
            putvalue(env_ASG_RC_NumType_01, 0);
            putvalue(env_ASG_RC_day_01, 0);
            putvalue(env_ASG_RC_month_01, 0);
            putvalue(env_ASG_RC_year_01, 0);
            putvalue(env_ASG_RC_hour_01, 0);
            putvalue(env_ASG_RC_minute_01, 0);
            putvalue(env_ASG_RC_second_01, 0);
        }


        if(gReceivedCalls_ListEntryReceptionInformation[7])
        {
            gReceivedCalls_Pos[7]         =getvalue(env_ASG_RC_pos_02);
            getvalue(env_ASG_RC_PbName_s_02, gReceivedCalls_PbName[7]);
            getvalue(env_ASG_RC_TelNum_s_02, gReceivedCalls_TelNumber[7]);
            gReceivedCalls_NumberType[7]    =getvalue(env_ASG_RC_NumType_02);
            gReceivedCalls_day[7]         =getvalue(env_ASG_RC_day_02);
            gReceivedCalls_month[7]       =getvalue(env_ASG_RC_month_02);
            gReceivedCalls_year[7]        =getvalue(env_ASG_RC_year_02);
            gReceivedCalls_hour[7]        =getvalue(env_ASG_RC_hour_02);
            gReceivedCalls_minute[7]      =getvalue(env_ASG_RC_minute_02);
            gReceivedCalls_second[7]      =getvalue(env_ASG_RC_second_02);
        }

        else
        {
            putvalue(env_ASG_RC_pos_02, 0);
            putvalue(env_ASG_RC_PbName_s_02, empty_string);
            putvalue(env_ASG_RC_TelNum_s_02, empty_string);
            putvalue(env_ASG_RC_NumType_02, 0);
            putvalue(env_ASG_RC_day_02, 0);
            putvalue(env_ASG_RC_month_02, 0);
            putvalue(env_ASG_RC_year_02, 0);
            putvalue(env_ASG_RC_hour_02, 0);
            putvalue(env_ASG_RC_minute_02, 0);
            putvalue(env_ASG_RC_second_02, 0);
        }


        if(gReceivedCalls_ListEntryReceptionInformation[8])
        {
            gReceivedCalls_Pos[8]         =getvalue(env_ASG_RC_pos_03);
            getvalue(env_ASG_RC_PbName_s_03, gReceivedCalls_PbName[8]);
            getvalue(env_ASG_RC_TelNum_s_03, gReceivedCalls_TelNumber[8]);
            gReceivedCalls_NumberType[8]    =getvalue(env_ASG_RC_NumType_03);
            gReceivedCalls_day[8]         =getvalue(env_ASG_RC_day_03);
            gReceivedCalls_month[8]       =getvalue(env_ASG_RC_month_03);
            gReceivedCalls_year[8]        =getvalue(env_ASG_RC_year_03);
            gReceivedCalls_hour[8]        =getvalue(env_ASG_RC_hour_03);
            gReceivedCalls_minute[8]      =getvalue(env_ASG_RC_minute_03);
            gReceivedCalls_second[8]      =getvalue(env_ASG_RC_second_03);
        }

        else
        {
            putvalue(env_ASG_RC_pos_03, 0);
            putvalue(env_ASG_RC_PbName_s_03, empty_string);
            putvalue(env_ASG_RC_TelNum_s_03, empty_string);
            putvalue(env_ASG_RC_NumType_03, 0);
            putvalue(env_ASG_RC_day_03, 0);
            putvalue(env_ASG_RC_month_03, 0);
            putvalue(env_ASG_RC_year_03, 0);
            putvalue(env_ASG_RC_hour_03, 0);
            putvalue(env_ASG_RC_minute_03, 0);
            putvalue(env_ASG_RC_second_03, 0);
        }

        
        //display area
        if(gReceivedCalls_ListEntryReceptionInformation[0])
        {
            gReceivedCalls_Pos[0]         =getvalue(env_ASG_RC_pos_11);
            getvalue(env_ASG_RC_PbName_s_11, gReceivedCalls_PbName[0]);
            getvalue(env_ASG_RC_TelNum_s_11, gReceivedCalls_TelNumber[0]);
            gReceivedCalls_NumberType[0]    =getvalue(env_ASG_RC_NumType_11);
            gReceivedCalls_day[0]         =getvalue(env_ASG_RC_day_11);
            gReceivedCalls_month[0]       =getvalue(env_ASG_RC_month_11);
            gReceivedCalls_year[0]        =getvalue(env_ASG_RC_year_11);
            gReceivedCalls_hour[0]        =getvalue(env_ASG_RC_hour_11);
            gReceivedCalls_minute[0]      =getvalue(env_ASG_RC_minute_11);
            gReceivedCalls_second[0]      =getvalue(env_ASG_RC_second_11);
        }

        else
        {
            putvalue(env_ASG_RC_pos_11, 0);
            putvalue(env_ASG_RC_PbName_s_11, empty_string);
            putvalue(env_ASG_RC_TelNum_s_11, empty_string);
            putvalue(env_ASG_RC_NumType_11, 0);
            putvalue(env_ASG_RC_day_11, 0);
            putvalue(env_ASG_RC_month_11, 0);
            putvalue(env_ASG_RC_year_11, 0);
            putvalue(env_ASG_RC_hour_11, 0);
            putvalue(env_ASG_RC_minute_11, 0);
            putvalue(env_ASG_RC_second_11, 0);
        }


        if(gReceivedCalls_ListEntryReceptionInformation[1])
        {
            gReceivedCalls_Pos[1]         =getvalue(env_ASG_RC_pos_12);
            getvalue(env_ASG_RC_PbName_s_12, gReceivedCalls_PbName[1]);
            getvalue(env_ASG_RC_TelNum_s_12, gReceivedCalls_TelNumber[1]);
            gReceivedCalls_NumberType[1]    =getvalue(env_ASG_RC_NumType_12);
            gReceivedCalls_day[1]         =getvalue(env_ASG_RC_day_12);
            gReceivedCalls_month[1]       =getvalue(env_ASG_RC_month_12);
            gReceivedCalls_year[1]        =getvalue(env_ASG_RC_year_12);
            gReceivedCalls_hour[1]        =getvalue(env_ASG_RC_hour_12);
            gReceivedCalls_minute[1]      =getvalue(env_ASG_RC_minute_12);
            gReceivedCalls_second[1]      =getvalue(env_ASG_RC_second_12);
        }

        else
        {
            putvalue(env_ASG_RC_pos_12, 0);
            putvalue(env_ASG_RC_PbName_s_12, empty_string);
            putvalue(env_ASG_RC_TelNum_s_12, empty_string);
            putvalue(env_ASG_RC_NumType_12, 0);
            putvalue(env_ASG_RC_day_12, 0);
            putvalue(env_ASG_RC_month_12, 0);
            putvalue(env_ASG_RC_year_12, 0);
            putvalue(env_ASG_RC_hour_12, 0);
            putvalue(env_ASG_RC_minute_12, 0);
            putvalue(env_ASG_RC_second_12, 0);
        }


        if(gReceivedCalls_ListEntryReceptionInformation[2])
        {
            gReceivedCalls_Pos[2]         =getvalue(env_ASG_RC_pos_13);
            getvalue(env_ASG_RC_PbName_s_13, gReceivedCalls_PbName[2]);
            getvalue(env_ASG_RC_TelNum_s_13, gReceivedCalls_TelNumber[2]);
            gReceivedCalls_NumberType[2]    =getvalue(env_ASG_RC_NumType_13);
            gReceivedCalls_day[2]         =getvalue(env_ASG_RC_day_13);
            gReceivedCalls_month[2]       =getvalue(env_ASG_RC_month_13);
            gReceivedCalls_year[2]        =getvalue(env_ASG_RC_year_13);
            gReceivedCalls_hour[2]        =getvalue(env_ASG_RC_hour_13);
            gReceivedCalls_minute[2]      =getvalue(env_ASG_RC_minute_13);
            gReceivedCalls_second[2]      =getvalue(env_ASG_RC_second_13);
        }

        else
        {
            putvalue(env_ASG_RC_pos_13, 0);
            putvalue(env_ASG_RC_PbName_s_13, empty_string);
            putvalue(env_ASG_RC_TelNum_s_13, empty_string);
            putvalue(env_ASG_RC_NumType_13, 0);
            putvalue(env_ASG_RC_day_13, 0);
            putvalue(env_ASG_RC_month_13, 0);
            putvalue(env_ASG_RC_year_13, 0);
            putvalue(env_ASG_RC_hour_13, 0);
            putvalue(env_ASG_RC_minute_13, 0);
            putvalue(env_ASG_RC_second_13, 0);
        }

        
        //lower cache
        if(gReceivedCalls_ListEntryReceptionInformation[3])
        {
            gReceivedCalls_Pos[3]         =getvalue(env_ASG_RC_pos_21);
            getvalue(env_ASG_RC_PbName_s_21, gReceivedCalls_PbName[3]);
            getvalue(env_ASG_RC_TelNum_s_21, gReceivedCalls_TelNumber[3]);
            gReceivedCalls_NumberType[3]    =getvalue(env_ASG_RC_NumType_21);
            gReceivedCalls_day[3]         =getvalue(env_ASG_RC_day_21);
            gReceivedCalls_month[3]       =getvalue(env_ASG_RC_month_21);
            gReceivedCalls_year[3]        =getvalue(env_ASG_RC_year_21);
            gReceivedCalls_hour[3]        =getvalue(env_ASG_RC_hour_21);
            gReceivedCalls_minute[3]      =getvalue(env_ASG_RC_minute_21);
            gReceivedCalls_second[3]      =getvalue(env_ASG_RC_second_21);
        }

        else
        {
            putvalue(env_ASG_RC_pos_21, 0);
            putvalue(env_ASG_RC_PbName_s_21, empty_string);
            putvalue(env_ASG_RC_TelNum_s_21, empty_string);
            putvalue(env_ASG_RC_NumType_21, 0);
            putvalue(env_ASG_RC_day_21, 0);
            putvalue(env_ASG_RC_month_21, 0);
            putvalue(env_ASG_RC_year_21, 0);
            putvalue(env_ASG_RC_hour_21, 0);
            putvalue(env_ASG_RC_minute_21, 0);
            putvalue(env_ASG_RC_second_21, 0);
        }


        if(gReceivedCalls_ListEntryReceptionInformation[4])
        {
            gReceivedCalls_Pos[4]         =getvalue(env_ASG_RC_pos_22);
            getvalue(env_ASG_RC_PbName_s_22, gReceivedCalls_PbName[4]);
            getvalue(env_ASG_RC_TelNum_s_22, gReceivedCalls_TelNumber[4]);
            gReceivedCalls_NumberType[4]    =getvalue(env_ASG_RC_NumType_22);
            gReceivedCalls_day[4]         =getvalue(env_ASG_RC_day_22);
            gReceivedCalls_month[4]       =getvalue(env_ASG_RC_month_22);
            gReceivedCalls_year[4]        =getvalue(env_ASG_RC_year_22);
            gReceivedCalls_hour[4]        =getvalue(env_ASG_RC_hour_22);
            gReceivedCalls_minute[4]      =getvalue(env_ASG_RC_minute_22);
            gReceivedCalls_second[4]      =getvalue(env_ASG_RC_second_22);
        }

        else
        {
            putvalue(env_ASG_RC_pos_22, 0);
            putvalue(env_ASG_RC_PbName_s_22, empty_string);
            putvalue(env_ASG_RC_TelNum_s_22, empty_string);
            putvalue(env_ASG_RC_NumType_22, 0);
            putvalue(env_ASG_RC_day_22, 0);
            putvalue(env_ASG_RC_month_22, 0);
            putvalue(env_ASG_RC_year_22, 0);
            putvalue(env_ASG_RC_hour_22, 0);
            putvalue(env_ASG_RC_minute_22, 0);
            putvalue(env_ASG_RC_second_22, 0);
        }


        if(gReceivedCalls_ListEntryReceptionInformation[5])
        {
            gReceivedCalls_Pos[5]         =getvalue(env_ASG_RC_pos_23);
            getvalue(env_ASG_RC_PbName_s_23, gReceivedCalls_PbName[5]);
            getvalue(env_ASG_RC_TelNum_s_23, gReceivedCalls_TelNumber[5]);
            gReceivedCalls_NumberType[5]    =getvalue(env_ASG_RC_NumType_23);
            gReceivedCalls_day[5]         =getvalue(env_ASG_RC_day_23);
            gReceivedCalls_month[5]       =getvalue(env_ASG_RC_month_23);
            gReceivedCalls_year[5]        =getvalue(env_ASG_RC_year_23);
            gReceivedCalls_hour[5]        =getvalue(env_ASG_RC_hour_23);
            gReceivedCalls_minute[5]      =getvalue(env_ASG_RC_minute_23);
            gReceivedCalls_second[5]      =getvalue(env_ASG_RC_second_23);
        }

        else
        {
            putvalue(env_ASG_RC_pos_23, 0);
            putvalue(env_ASG_RC_PbName_s_23, empty_string);
            putvalue(env_ASG_RC_TelNum_s_23, empty_string);
            putvalue(env_ASG_RC_NumType_23, 0);
            putvalue(env_ASG_RC_day_23, 0);
            putvalue(env_ASG_RC_month_23, 0);
            putvalue(env_ASG_RC_year_23, 0);
            putvalue(env_ASG_RC_hour_23, 0);
            putvalue(env_ASG_RC_minute_23, 0);
            putvalue(env_ASG_RC_second_23, 0);
        }

        ReceivedCalls_display();
    }
}
/*@@end*/

/*@@envVar:env_ASG_RC_down:*/
on envVar env_ASG_RC_down
{
    int i=0, j=0;

    if(gRNS_PowerOnOff==Power_on && getvalue(this) && gReceivedCalls_ListHandlingType ==TEL_RECEIVEDCALLS_NOCACHE)
	{      
        gReceivedCalls_CursorAction =TEL_RECEIVEDCALLS_CURSORACTION_DOWN;
        
        if(gReceivedCalls_SlidingWindow_State ==TEL_RECEIVEDCALLS_SLIDINGWINDOW_ACTIVE && gReceivedCalls_MoveList_down_allowed)
        {   
            gReceivedCalls_ListHandlingType  =TEL_RECEIVEDCALLS_DOWN_CACHE;
            gReceivedCalls_DisplayStatus     =TEL_RECEIVEDCALLS_DISPLAYLIST_FIRST_ELEMENTS;
            gReceivedCalls_CursorAction      =TEL_RECEIVEDCALLS_CURSORACTION_NOTHING;
            
            ReceivedCalls_ListHandling ();
        }
        else if(gReceivedCalls_SlidingWindow_State ==TEL_RECEIVEDCALLS_SLIDINGWINDOW_NOTACTIVE && gReceivedCalls_MoveList_down_allowed)
        {
            gReceivedCalls_DisplayStatus     =TEL_RECEIVEDCALLS_DISPLAYLIST_SEARCH_ELEMENTS;
            gReceivedCalls_CursorAction      =TEL_RECEIVEDCALLS_CURSORACTION_DOWN;

            ReceivedCalls_display();

            //reset values
            gReceivedCalls_DisplayStatus     =TEL_RECEIVEDCALLS_DISPLAYLIST_REFRESH;
            gReceivedCalls_CursorAction      =TEL_RECEIVEDCALLS_CURSORACTION_NOTHING;
        }
    }
}
/*@@end*/

/*@@envVar:env_ASG_RC_up:*/
on envVar env_ASG_RC_up
{
    int i=0, j=0;

    if(gRNS_PowerOnOff==Power_on && getvalue(this) && gReceivedCalls_ListHandlingType ==TEL_RECEIVEDCALLS_NOCACHE)
	{   
        gReceivedCalls_CursorAction =TEL_RECEIVEDCALLS_CURSORACTION_UP;

        if(gReceivedCalls_SlidingWindow_State ==TEL_RECEIVEDCALLS_SLIDINGWINDOW_ACTIVE && gReceivedCalls_MoveList_up_allowed)
        {  
            gReceivedCalls_ListHandlingType  =TEL_RECEIVEDCALLS_UP_CACHE;
            gReceivedCalls_DisplayStatus     =TEL_RECEIVEDCALLS_DISPLAYLIST_FIRST_ELEMENTS;
            gReceivedCalls_CursorAction      =TEL_RECEIVEDCALLS_CURSORACTION_NOTHING;
            
            ReceivedCalls_ListHandling ();
        }
        else if(gReceivedCalls_SlidingWindow_State ==TEL_RECEIVEDCALLS_SLIDINGWINDOW_NOTACTIVE && gReceivedCalls_MoveList_up_allowed)
        {
            gReceivedCalls_DisplayStatus     =TEL_RECEIVEDCALLS_DISPLAYLIST_SEARCH_ELEMENTS;
            gReceivedCalls_CursorAction      =TEL_RECEIVEDCALLS_CURSORACTION_UP;

            ReceivedCalls_ListHandling();
            
            ReceivedCalls_display();

            //reset values
            gReceivedCalls_DisplayStatus     =TEL_RECEIVEDCALLS_DISPLAYLIST_REFRESH;
            gReceivedCalls_CursorAction      =TEL_RECEIVEDCALLS_CURSORACTION_NOTHING;
        }    
    }
}
/*@@end*/

/*@@caplFunc:ReceivedCalls_DisplayCache():*///function
ReceivedCalls_DisplayCache ()
{
    //upper cache
        if(gReceivedCalls_ListEntryReceptionInformation[6])
        {
            putvalue(env_ASG_RC_pos_01, gReceivedCalls_Pos[6]);
            putvalue(env_ASG_RC_PbName_s_01, gReceivedCalls_PbName[6]);
            putvalue(env_ASG_RC_TelNum_s_01, gReceivedCalls_TelNumber[6]);
            putvalue(env_ASG_RC_NumType_01, gReceivedCalls_NumberType[6]);
            putvalue(env_ASG_RC_day_01, gReceivedCalls_day[6]);
            putvalue(env_ASG_RC_month_01, gReceivedCalls_month[6]);
            putvalue(env_ASG_RC_year_01, gReceivedCalls_year[6]);
            putvalue(env_ASG_RC_hour_01, gReceivedCalls_hour[6]);
            putvalue(env_ASG_RC_minute_01, gReceivedCalls_minute[6]);
            putvalue(env_ASG_RC_second_01, gReceivedCalls_second[6]);

            enableControl("ASG_Telephone_0x2F - ReceivedCalls_EditCache", "env_ASG_RC_pos_01", 1);
            enableControl("ASG_Telephone_0x2F - ReceivedCalls_EditCache", "env_ASG_RC_PbName_s_01", 1);
            enableControl("ASG_Telephone_0x2F - ReceivedCalls_EditCache", "env_ASG_RC_TelNum_s_01", 1);
            enableControl("ASG_Telephone_0x2F - ReceivedCalls_EditCache", "env_ASG_RC_NumType_01", 1);
            enableControl("ASG_Telephone_0x2F - ReceivedCalls_EditCache", "env_ASG_RC_day_01", 1);
            enableControl("ASG_Telephone_0x2F - ReceivedCalls_EditCache", "env_ASG_RC_month_01", 1);
            enableControl("ASG_Telephone_0x2F - ReceivedCalls_EditCache", "env_ASG_RC_year_01", 1);
            enableControl("ASG_Telephone_0x2F - ReceivedCalls_EditCache", "env_ASG_RC_hour_01", 1);
            enableControl("ASG_Telephone_0x2F - ReceivedCalls_EditCache", "env_ASG_RC_minute_01", 1);
            enableControl("ASG_Telephone_0x2F - ReceivedCalls_EditCache", "env_ASG_RC_second_01", 1);
        }

        else
        {
            putvalue(env_ASG_RC_pos_01, 0);
            putvalue(env_ASG_RC_PbName_s_01, empty_string);
            putvalue(env_ASG_RC_TelNum_s_01, empty_string);
            putvalue(env_ASG_RC_NumType_01, 0);
            putvalue(env_ASG_RC_day_01, 0);
            putvalue(env_ASG_RC_month_01, 0);
            putvalue(env_ASG_RC_year_01, 0);
            putvalue(env_ASG_RC_hour_01, 0);
            putvalue(env_ASG_RC_minute_01, 0);
            putvalue(env_ASG_RC_second_01, 0);

            enableControl("ASG_Telephone_0x2F - ReceivedCalls_EditCache", "env_ASG_RC_pos_01", 0);
            enableControl("ASG_Telephone_0x2F - ReceivedCalls_EditCache", "env_ASG_RC_PbName_s_01", 0);
            enableControl("ASG_Telephone_0x2F - ReceivedCalls_EditCache", "env_ASG_RC_TelNum_s_01", 0);
            enableControl("ASG_Telephone_0x2F - ReceivedCalls_EditCache", "env_ASG_RC_NumType_01", 0);
            enableControl("ASG_Telephone_0x2F - ReceivedCalls_EditCache", "env_ASG_RC_day_01", 0);
            enableControl("ASG_Telephone_0x2F - ReceivedCalls_EditCache", "env_ASG_RC_month_01", 0);
            enableControl("ASG_Telephone_0x2F - ReceivedCalls_EditCache", "env_ASG_RC_year_01", 0);
            enableControl("ASG_Telephone_0x2F - ReceivedCalls_EditCache", "env_ASG_RC_hour_01", 0);
            enableControl("ASG_Telephone_0x2F - ReceivedCalls_EditCache", "env_ASG_RC_minute_01", 0);
            enableControl("ASG_Telephone_0x2F - ReceivedCalls_EditCache", "env_ASG_RC_second_01", 0);
        }


        if(gReceivedCalls_ListEntryReceptionInformation[7])
        {
            putvalue(env_ASG_RC_pos_02, gReceivedCalls_Pos[7]);
            putvalue(env_ASG_RC_PbName_s_02, gReceivedCalls_PbName[7]);
            putvalue(env_ASG_RC_TelNum_s_02, gReceivedCalls_TelNumber[7]);
            putvalue(env_ASG_RC_NumType_02, gReceivedCalls_NumberType[7]);
            putvalue(env_ASG_RC_day_02, gReceivedCalls_day[7]);
            putvalue(env_ASG_RC_month_02, gReceivedCalls_month[7]);
            putvalue(env_ASG_RC_year_02, gReceivedCalls_year[7]);
            putvalue(env_ASG_RC_hour_02, gReceivedCalls_hour[7]);
            putvalue(env_ASG_RC_minute_02, gReceivedCalls_minute[7]);
            putvalue(env_ASG_RC_second_02, gReceivedCalls_second[7]);

            enableControl("ASG_Telephone_0x2F - ReceivedCalls_EditCache", "env_ASG_RC_pos_02", 1);
            enableControl("ASG_Telephone_0x2F - ReceivedCalls_EditCache", "env_ASG_RC_PbName_s_02", 1);
            enableControl("ASG_Telephone_0x2F - ReceivedCalls_EditCache", "env_ASG_RC_TelNum_s_02", 1);
            enableControl("ASG_Telephone_0x2F - ReceivedCalls_EditCache", "env_ASG_RC_NumType_02", 1);
            enableControl("ASG_Telephone_0x2F - ReceivedCalls_EditCache", "env_ASG_RC_day_02", 1);
            enableControl("ASG_Telephone_0x2F - ReceivedCalls_EditCache", "env_ASG_RC_month_02", 1);
            enableControl("ASG_Telephone_0x2F - ReceivedCalls_EditCache", "env_ASG_RC_year_02", 1);
            enableControl("ASG_Telephone_0x2F - ReceivedCalls_EditCache", "env_ASG_RC_hour_02", 1);
            enableControl("ASG_Telephone_0x2F - ReceivedCalls_EditCache", "env_ASG_RC_minute_02", 1);
            enableControl("ASG_Telephone_0x2F - ReceivedCalls_EditCache", "env_ASG_RC_second_02", 1);
        }

        else
        {
            putvalue(env_ASG_RC_pos_02, 0);
            putvalue(env_ASG_RC_PbName_s_02, empty_string);
            putvalue(env_ASG_RC_TelNum_s_02, empty_string);
            putvalue(env_ASG_RC_NumType_02, 0);
            putvalue(env_ASG_RC_day_02, 0);
            putvalue(env_ASG_RC_month_02, 0);
            putvalue(env_ASG_RC_year_02, 0);
            putvalue(env_ASG_RC_hour_02, 0);
            putvalue(env_ASG_RC_minute_02, 0);
            putvalue(env_ASG_RC_second_02, 0);

            enableControl("ASG_Telephone_0x2F - ReceivedCalls_EditCache", "env_ASG_RC_pos_02", 0);
            enableControl("ASG_Telephone_0x2F - ReceivedCalls_EditCache", "env_ASG_RC_PbName_s_02", 0);
            enableControl("ASG_Telephone_0x2F - ReceivedCalls_EditCache", "env_ASG_RC_TelNum_s_02", 0);
            enableControl("ASG_Telephone_0x2F - ReceivedCalls_EditCache", "env_ASG_RC_NumType_02", 0);
            enableControl("ASG_Telephone_0x2F - ReceivedCalls_EditCache", "env_ASG_RC_day_02", 0);
            enableControl("ASG_Telephone_0x2F - ReceivedCalls_EditCache", "env_ASG_RC_month_02", 0);
            enableControl("ASG_Telephone_0x2F - ReceivedCalls_EditCache", "env_ASG_RC_year_02", 0);
            enableControl("ASG_Telephone_0x2F - ReceivedCalls_EditCache", "env_ASG_RC_hour_02", 0);
            enableControl("ASG_Telephone_0x2F - ReceivedCalls_EditCache", "env_ASG_RC_minute_02", 0);
            enableControl("ASG_Telephone_0x2F - ReceivedCalls_EditCache", "env_ASG_RC_second_02", 0);
        }


        if(gReceivedCalls_ListEntryReceptionInformation[8])
        {
            putvalue(env_ASG_RC_pos_03, gReceivedCalls_Pos[8]);
            putvalue(env_ASG_RC_PbName_s_03, gReceivedCalls_PbName[8]);
            putvalue(env_ASG_RC_TelNum_s_03, gReceivedCalls_TelNumber[8]);
            putvalue(env_ASG_RC_NumType_03, gReceivedCalls_NumberType[8]);
            putvalue(env_ASG_RC_day_03, gReceivedCalls_day[8]);
            putvalue(env_ASG_RC_month_03, gReceivedCalls_month[8]);
            putvalue(env_ASG_RC_year_03, gReceivedCalls_year[8]);
            putvalue(env_ASG_RC_hour_03, gReceivedCalls_hour[8]);
            putvalue(env_ASG_RC_minute_03, gReceivedCalls_minute[8]);
            putvalue(env_ASG_RC_second_03, gReceivedCalls_second[8]);

            enableControl("ASG_Telephone_0x2F - ReceivedCalls_EditCache", "env_ASG_RC_pos_03", 1);
            enableControl("ASG_Telephone_0x2F - ReceivedCalls_EditCache", "env_ASG_RC_PbName_s_03", 1);
            enableControl("ASG_Telephone_0x2F - ReceivedCalls_EditCache", "env_ASG_RC_TelNum_s_03", 1);
            enableControl("ASG_Telephone_0x2F - ReceivedCalls_EditCache", "env_ASG_RC_NumType_03", 1);
            enableControl("ASG_Telephone_0x2F - ReceivedCalls_EditCache", "env_ASG_RC_day_03", 1);
            enableControl("ASG_Telephone_0x2F - ReceivedCalls_EditCache", "env_ASG_RC_month_03", 1);
            enableControl("ASG_Telephone_0x2F - ReceivedCalls_EditCache", "env_ASG_RC_year_03", 1);
            enableControl("ASG_Telephone_0x2F - ReceivedCalls_EditCache", "env_ASG_RC_hour_03", 1);
            enableControl("ASG_Telephone_0x2F - ReceivedCalls_EditCache", "env_ASG_RC_minute_03", 1);
            enableControl("ASG_Telephone_0x2F - ReceivedCalls_EditCache", "env_ASG_RC_second_03", 1);
        }

        else
        {
            putvalue(env_ASG_RC_pos_03, 0);
            putvalue(env_ASG_RC_PbName_s_03, empty_string);
            putvalue(env_ASG_RC_TelNum_s_03, empty_string);
            putvalue(env_ASG_RC_NumType_03, 0);
            putvalue(env_ASG_RC_day_03, 0);
            putvalue(env_ASG_RC_month_03, 0);
            putvalue(env_ASG_RC_year_03, 0);
            putvalue(env_ASG_RC_hour_03, 0);
            putvalue(env_ASG_RC_minute_03, 0);
            putvalue(env_ASG_RC_second_03, 0);

            enableControl("ASG_Telephone_0x2F - ReceivedCalls_EditCache", "env_ASG_RC_pos_03", 0);
            enableControl("ASG_Telephone_0x2F - ReceivedCalls_EditCache", "env_ASG_RC_PbName_s_03", 0);
            enableControl("ASG_Telephone_0x2F - ReceivedCalls_EditCache", "env_ASG_RC_TelNum_s_03", 0);
            enableControl("ASG_Telephone_0x2F - ReceivedCalls_EditCache", "env_ASG_RC_NumType_03", 0);
            enableControl("ASG_Telephone_0x2F - ReceivedCalls_EditCache", "env_ASG_RC_day_03", 0);
            enableControl("ASG_Telephone_0x2F - ReceivedCalls_EditCache", "env_ASG_RC_month_03", 0);
            enableControl("ASG_Telephone_0x2F - ReceivedCalls_EditCache", "env_ASG_RC_year_03", 0);
            enableControl("ASG_Telephone_0x2F - ReceivedCalls_EditCache", "env_ASG_RC_hour_03", 0);
            enableControl("ASG_Telephone_0x2F - ReceivedCalls_EditCache", "env_ASG_RC_minute_03", 0);
            enableControl("ASG_Telephone_0x2F - ReceivedCalls_EditCache", "env_ASG_RC_second_03", 0);
        }

        
        //display area
        if(gReceivedCalls_ListEntryReceptionInformation[0])
        {
            putvalue(env_ASG_RC_pos_11, gReceivedCalls_Pos[0]);
            putvalue(env_ASG_RC_PbName_s_11, gReceivedCalls_PbName[0]);
            putvalue(env_ASG_RC_TelNum_s_11, gReceivedCalls_TelNumber[0]);
            putvalue(env_ASG_RC_NumType_11, gReceivedCalls_NumberType[0]);
            putvalue(env_ASG_RC_day_11, gReceivedCalls_day[0]);
            putvalue(env_ASG_RC_month_11, gReceivedCalls_month[0]);
            putvalue(env_ASG_RC_year_11, gReceivedCalls_year[0]);
            putvalue(env_ASG_RC_hour_11, gReceivedCalls_hour[0]);
            putvalue(env_ASG_RC_minute_11, gReceivedCalls_minute[0]);
            putvalue(env_ASG_RC_second_11, gReceivedCalls_second[0]);

            enableControl("ASG_Telephone_0x2F - ReceivedCalls_EditCache", "env_ASG_RC_pos_11", 1);
            enableControl("ASG_Telephone_0x2F - ReceivedCalls_EditCache", "env_ASG_RC_PbName_s_11", 1);
            enableControl("ASG_Telephone_0x2F - ReceivedCalls_EditCache", "env_ASG_RC_TelNum_s_11", 1);
            enableControl("ASG_Telephone_0x2F - ReceivedCalls_EditCache", "env_ASG_RC_NumType_11", 1);
            enableControl("ASG_Telephone_0x2F - ReceivedCalls_EditCache", "env_ASG_RC_day_11", 1);
            enableControl("ASG_Telephone_0x2F - ReceivedCalls_EditCache", "env_ASG_RC_month_11", 1);
            enableControl("ASG_Telephone_0x2F - ReceivedCalls_EditCache", "env_ASG_RC_year_11", 1);
            enableControl("ASG_Telephone_0x2F - ReceivedCalls_EditCache", "env_ASG_RC_hour_11", 1);
            enableControl("ASG_Telephone_0x2F - ReceivedCalls_EditCache", "env_ASG_RC_minute_11", 1);
            enableControl("ASG_Telephone_0x2F - ReceivedCalls_EditCache", "env_ASG_RC_second_11", 1);
        }

        else
        {
            putvalue(env_ASG_RC_pos_11, 0);
            putvalue(env_ASG_RC_PbName_s_11, empty_string);
            putvalue(env_ASG_RC_TelNum_s_11, empty_string);
            putvalue(env_ASG_RC_NumType_11, 0);
            putvalue(env_ASG_RC_day_11, 0);
            putvalue(env_ASG_RC_month_11, 0);
            putvalue(env_ASG_RC_year_11, 0);
            putvalue(env_ASG_RC_hour_11, 0);
            putvalue(env_ASG_RC_minute_11, 0);
            putvalue(env_ASG_RC_second_11, 0);

            enableControl("ASG_Telephone_0x2F - ReceivedCalls_EditCache", "env_ASG_RC_pos_11", 0);
            enableControl("ASG_Telephone_0x2F - ReceivedCalls_EditCache", "env_ASG_RC_PbName_s_11", 0);
            enableControl("ASG_Telephone_0x2F - ReceivedCalls_EditCache", "env_ASG_RC_TelNum_s_11", 0);
            enableControl("ASG_Telephone_0x2F - ReceivedCalls_EditCache", "env_ASG_RC_NumType_11", 0);
            enableControl("ASG_Telephone_0x2F - ReceivedCalls_EditCache", "env_ASG_RC_day_11", 0);
            enableControl("ASG_Telephone_0x2F - ReceivedCalls_EditCache", "env_ASG_RC_month_11", 0);
            enableControl("ASG_Telephone_0x2F - ReceivedCalls_EditCache", "env_ASG_RC_year_11", 0);
            enableControl("ASG_Telephone_0x2F - ReceivedCalls_EditCache", "env_ASG_RC_hour_11", 0);
            enableControl("ASG_Telephone_0x2F - ReceivedCalls_EditCache", "env_ASG_RC_minute_11", 0);
            enableControl("ASG_Telephone_0x2F - ReceivedCalls_EditCache", "env_ASG_RC_second_11", 0);
        }


        if(gReceivedCalls_ListEntryReceptionInformation[1])
        {
            putvalue(env_ASG_RC_pos_12, gReceivedCalls_Pos[1]);
            putvalue(env_ASG_RC_PbName_s_12, gReceivedCalls_PbName[1]);
            putvalue(env_ASG_RC_TelNum_s_12, gReceivedCalls_TelNumber[1]);
            putvalue(env_ASG_RC_NumType_12, gReceivedCalls_NumberType[1]);
            putvalue(env_ASG_RC_day_12, gReceivedCalls_day[1]);
            putvalue(env_ASG_RC_month_12, gReceivedCalls_month[1]);
            putvalue(env_ASG_RC_year_12, gReceivedCalls_year[1]);
            putvalue(env_ASG_RC_hour_12, gReceivedCalls_hour[1]);
            putvalue(env_ASG_RC_minute_12, gReceivedCalls_minute[1]);
            putvalue(env_ASG_RC_second_12, gReceivedCalls_second[1]);

            enableControl("ASG_Telephone_0x2F - ReceivedCalls_EditCache", "env_ASG_RC_pos_12", 1);
            enableControl("ASG_Telephone_0x2F - ReceivedCalls_EditCache", "env_ASG_RC_PbName_s_12", 1);
            enableControl("ASG_Telephone_0x2F - ReceivedCalls_EditCache", "env_ASG_RC_TelNum_s_12", 1);
            enableControl("ASG_Telephone_0x2F - ReceivedCalls_EditCache", "env_ASG_RC_NumType_12", 1);
            enableControl("ASG_Telephone_0x2F - ReceivedCalls_EditCache", "env_ASG_RC_day_12", 1);
            enableControl("ASG_Telephone_0x2F - ReceivedCalls_EditCache", "env_ASG_RC_month_12", 1);
            enableControl("ASG_Telephone_0x2F - ReceivedCalls_EditCache", "env_ASG_RC_year_12", 1);
            enableControl("ASG_Telephone_0x2F - ReceivedCalls_EditCache", "env_ASG_RC_hour_12", 1);
            enableControl("ASG_Telephone_0x2F - ReceivedCalls_EditCache", "env_ASG_RC_minute_12", 1);
            enableControl("ASG_Telephone_0x2F - ReceivedCalls_EditCache", "env_ASG_RC_second_12", 1);
        }

        else
        {
            putvalue(env_ASG_RC_pos_12, 0);
            putvalue(env_ASG_RC_PbName_s_12, empty_string);
            putvalue(env_ASG_RC_TelNum_s_12, empty_string);
            putvalue(env_ASG_RC_NumType_12, 0);
            putvalue(env_ASG_RC_day_12, 0);
            putvalue(env_ASG_RC_month_12, 0);
            putvalue(env_ASG_RC_year_12, 0);
            putvalue(env_ASG_RC_hour_12, 0);
            putvalue(env_ASG_RC_minute_12, 0);
            putvalue(env_ASG_RC_second_12, 0);

            enableControl("ASG_Telephone_0x2F - ReceivedCalls_EditCache", "env_ASG_RC_pos_12", 0);
            enableControl("ASG_Telephone_0x2F - ReceivedCalls_EditCache", "env_ASG_RC_PbName_s_12", 0);
            enableControl("ASG_Telephone_0x2F - ReceivedCalls_EditCache", "env_ASG_RC_TelNum_s_12", 0);
            enableControl("ASG_Telephone_0x2F - ReceivedCalls_EditCache", "env_ASG_RC_NumType_12", 0);
            enableControl("ASG_Telephone_0x2F - ReceivedCalls_EditCache", "env_ASG_RC_day_12", 0);
            enableControl("ASG_Telephone_0x2F - ReceivedCalls_EditCache", "env_ASG_RC_month_12", 0);
            enableControl("ASG_Telephone_0x2F - ReceivedCalls_EditCache", "env_ASG_RC_year_12", 0);
            enableControl("ASG_Telephone_0x2F - ReceivedCalls_EditCache", "env_ASG_RC_hour_12", 0);
            enableControl("ASG_Telephone_0x2F - ReceivedCalls_EditCache", "env_ASG_RC_minute_12", 0);
            enableControl("ASG_Telephone_0x2F - ReceivedCalls_EditCache", "env_ASG_RC_second_12", 0);
        }


        if(gReceivedCalls_ListEntryReceptionInformation[2])
        {
            putvalue(env_ASG_RC_pos_13, gReceivedCalls_Pos[2]);
            putvalue(env_ASG_RC_PbName_s_13, gReceivedCalls_PbName[2]);
            putvalue(env_ASG_RC_TelNum_s_13, gReceivedCalls_TelNumber[2]);
            putvalue(env_ASG_RC_NumType_13, gReceivedCalls_NumberType[2]);
            putvalue(env_ASG_RC_day_13, gReceivedCalls_day[2]);
            putvalue(env_ASG_RC_month_13, gReceivedCalls_month[2]);
            putvalue(env_ASG_RC_year_13, gReceivedCalls_year[2]);
            putvalue(env_ASG_RC_hour_13, gReceivedCalls_hour[2]);
            putvalue(env_ASG_RC_minute_13, gReceivedCalls_minute[2]);
            putvalue(env_ASG_RC_second_13, gReceivedCalls_second[2]);

            enableControl("ASG_Telephone_0x2F - ReceivedCalls_EditCache", "env_ASG_RC_pos_13", 1);
            enableControl("ASG_Telephone_0x2F - ReceivedCalls_EditCache", "env_ASG_RC_PbName_s_13", 1);
            enableControl("ASG_Telephone_0x2F - ReceivedCalls_EditCache", "env_ASG_RC_TelNum_s_13", 1);
            enableControl("ASG_Telephone_0x2F - ReceivedCalls_EditCache", "env_ASG_RC_NumType_13", 1);
            enableControl("ASG_Telephone_0x2F - ReceivedCalls_EditCache", "env_ASG_RC_day_13", 1);
            enableControl("ASG_Telephone_0x2F - ReceivedCalls_EditCache", "env_ASG_RC_month_13", 1);
            enableControl("ASG_Telephone_0x2F - ReceivedCalls_EditCache", "env_ASG_RC_year_13", 1);
            enableControl("ASG_Telephone_0x2F - ReceivedCalls_EditCache", "env_ASG_RC_hour_13", 1);
            enableControl("ASG_Telephone_0x2F - ReceivedCalls_EditCache", "env_ASG_RC_minute_13", 1);
            enableControl("ASG_Telephone_0x2F - ReceivedCalls_EditCache", "env_ASG_RC_second_13", 1);
        }

        else
        {
            putvalue(env_ASG_RC_pos_13, 0);
            putvalue(env_ASG_RC_PbName_s_13, empty_string);
            putvalue(env_ASG_RC_TelNum_s_13, empty_string);
            putvalue(env_ASG_RC_NumType_13, 0);
            putvalue(env_ASG_RC_day_13, 0);
            putvalue(env_ASG_RC_month_13, 0);
            putvalue(env_ASG_RC_year_13, 0);
            putvalue(env_ASG_RC_hour_13, 0);
            putvalue(env_ASG_RC_minute_13, 0);
            putvalue(env_ASG_RC_second_13, 0);

            enableControl("ASG_Telephone_0x2F - ReceivedCalls_EditCache", "env_ASG_RC_pos_13", 0);
            enableControl("ASG_Telephone_0x2F - ReceivedCalls_EditCache", "env_ASG_RC_PbName_s_13", 0);
            enableControl("ASG_Telephone_0x2F - ReceivedCalls_EditCache", "env_ASG_RC_TelNum_s_13", 0);
            enableControl("ASG_Telephone_0x2F - ReceivedCalls_EditCache", "env_ASG_RC_NumType_13", 0);
            enableControl("ASG_Telephone_0x2F - ReceivedCalls_EditCache", "env_ASG_RC_day_13", 0);
            enableControl("ASG_Telephone_0x2F - ReceivedCalls_EditCache", "env_ASG_RC_month_13", 0);
            enableControl("ASG_Telephone_0x2F - ReceivedCalls_EditCache", "env_ASG_RC_year_13", 0);
            enableControl("ASG_Telephone_0x2F - ReceivedCalls_EditCache", "env_ASG_RC_hour_13", 0);
            enableControl("ASG_Telephone_0x2F - ReceivedCalls_EditCache", "env_ASG_RC_minute_13", 0);
            enableControl("ASG_Telephone_0x2F - ReceivedCalls_EditCache", "env_ASG_RC_second_13", 0);
        }

        
        //lower cache
        if(gReceivedCalls_ListEntryReceptionInformation[3])
        {
            putvalue(env_ASG_RC_pos_21, gReceivedCalls_Pos[3]);
            putvalue(env_ASG_RC_PbName_s_21, gReceivedCalls_PbName[3]);
            putvalue(env_ASG_RC_TelNum_s_21, gReceivedCalls_TelNumber[3]);
            putvalue(env_ASG_RC_NumType_21, gReceivedCalls_NumberType[3]);
            putvalue(env_ASG_RC_day_21, gReceivedCalls_day[3]);
            putvalue(env_ASG_RC_month_21, gReceivedCalls_month[3]);
            putvalue(env_ASG_RC_year_21, gReceivedCalls_year[3]);
            putvalue(env_ASG_RC_hour_21, gReceivedCalls_hour[3]);
            putvalue(env_ASG_RC_minute_21, gReceivedCalls_minute[3]);
            putvalue(env_ASG_RC_second_21, gReceivedCalls_second[3]);

            enableControl("ASG_Telephone_0x2F - ReceivedCalls_EditCache", "env_ASG_RC_pos_21", 1);
            enableControl("ASG_Telephone_0x2F - ReceivedCalls_EditCache", "env_ASG_RC_PbName_s_21", 1);
            enableControl("ASG_Telephone_0x2F - ReceivedCalls_EditCache", "env_ASG_RC_TelNum_s_21", 1);
            enableControl("ASG_Telephone_0x2F - ReceivedCalls_EditCache", "env_ASG_RC_NumType_21", 1);
            enableControl("ASG_Telephone_0x2F - ReceivedCalls_EditCache", "env_ASG_RC_day_21", 1);
            enableControl("ASG_Telephone_0x2F - ReceivedCalls_EditCache", "env_ASG_RC_month_21", 1);
            enableControl("ASG_Telephone_0x2F - ReceivedCalls_EditCache", "env_ASG_RC_year_21", 1);
            enableControl("ASG_Telephone_0x2F - ReceivedCalls_EditCache", "env_ASG_RC_hour_21", 1);
            enableControl("ASG_Telephone_0x2F - ReceivedCalls_EditCache", "env_ASG_RC_minute_21", 1);
            enableControl("ASG_Telephone_0x2F - ReceivedCalls_EditCache", "env_ASG_RC_second_21", 1);
        }

        else
        {
            putvalue(env_ASG_RC_pos_21, 0);
            putvalue(env_ASG_RC_PbName_s_21, empty_string);
            putvalue(env_ASG_RC_TelNum_s_21, empty_string);
            putvalue(env_ASG_RC_NumType_21, 0);
            putvalue(env_ASG_RC_day_21, 0);
            putvalue(env_ASG_RC_month_21, 0);
            putvalue(env_ASG_RC_year_21, 0);
            putvalue(env_ASG_RC_hour_21, 0);
            putvalue(env_ASG_RC_minute_21, 0);
            putvalue(env_ASG_RC_second_21, 0);

            enableControl("ASG_Telephone_0x2F - ReceivedCalls_EditCache", "env_ASG_RC_pos_21", 0);
            enableControl("ASG_Telephone_0x2F - ReceivedCalls_EditCache", "env_ASG_RC_PbName_s_21", 0);
            enableControl("ASG_Telephone_0x2F - ReceivedCalls_EditCache", "env_ASG_RC_TelNum_s_21", 0);
            enableControl("ASG_Telephone_0x2F - ReceivedCalls_EditCache", "env_ASG_RC_NumType_21", 0);
            enableControl("ASG_Telephone_0x2F - ReceivedCalls_EditCache", "env_ASG_RC_day_21", 0);
            enableControl("ASG_Telephone_0x2F - ReceivedCalls_EditCache", "env_ASG_RC_month_21", 0);
            enableControl("ASG_Telephone_0x2F - ReceivedCalls_EditCache", "env_ASG_RC_year_21", 0);
            enableControl("ASG_Telephone_0x2F - ReceivedCalls_EditCache", "env_ASG_RC_hour_21", 0);
            enableControl("ASG_Telephone_0x2F - ReceivedCalls_EditCache", "env_ASG_RC_minute_21", 0);
            enableControl("ASG_Telephone_0x2F - ReceivedCalls_EditCache", "env_ASG_RC_second_21", 0);
        }


        if(gReceivedCalls_ListEntryReceptionInformation[4])
        {
            putvalue(env_ASG_RC_pos_22, gReceivedCalls_Pos[4]);
            putvalue(env_ASG_RC_PbName_s_22, gReceivedCalls_PbName[4]);
            putvalue(env_ASG_RC_TelNum_s_22, gReceivedCalls_TelNumber[4]);
            putvalue(env_ASG_RC_NumType_22, gReceivedCalls_NumberType[4]);
            putvalue(env_ASG_RC_day_22, gReceivedCalls_day[4]);
            putvalue(env_ASG_RC_month_22, gReceivedCalls_month[4]);
            putvalue(env_ASG_RC_year_22, gReceivedCalls_year[4]);
            putvalue(env_ASG_RC_hour_22, gReceivedCalls_hour[4]);
            putvalue(env_ASG_RC_minute_22, gReceivedCalls_minute[4]);
            putvalue(env_ASG_RC_second_22, gReceivedCalls_second[4]);

            enableControl("ASG_Telephone_0x2F - ReceivedCalls_EditCache", "env_ASG_RC_pos_22", 1);
            enableControl("ASG_Telephone_0x2F - ReceivedCalls_EditCache", "env_ASG_RC_PbName_s_22", 1);
            enableControl("ASG_Telephone_0x2F - ReceivedCalls_EditCache", "env_ASG_RC_TelNum_s_22", 1);
            enableControl("ASG_Telephone_0x2F - ReceivedCalls_EditCache", "env_ASG_RC_NumType_22", 1);
            enableControl("ASG_Telephone_0x2F - ReceivedCalls_EditCache", "env_ASG_RC_day_22", 1);
            enableControl("ASG_Telephone_0x2F - ReceivedCalls_EditCache", "env_ASG_RC_month_22", 1);
            enableControl("ASG_Telephone_0x2F - ReceivedCalls_EditCache", "env_ASG_RC_year_22", 1);
            enableControl("ASG_Telephone_0x2F - ReceivedCalls_EditCache", "env_ASG_RC_hour_22", 1);
            enableControl("ASG_Telephone_0x2F - ReceivedCalls_EditCache", "env_ASG_RC_minute_22", 1);
            enableControl("ASG_Telephone_0x2F - ReceivedCalls_EditCache", "env_ASG_RC_second_22", 1);
        }

        else
        {
            putvalue(env_ASG_RC_pos_22, 0);
            putvalue(env_ASG_RC_PbName_s_22, empty_string);
            putvalue(env_ASG_RC_TelNum_s_22, empty_string);
            putvalue(env_ASG_RC_NumType_22, 0);
            putvalue(env_ASG_RC_day_22, 0);
            putvalue(env_ASG_RC_month_22, 0);
            putvalue(env_ASG_RC_year_22, 0);
            putvalue(env_ASG_RC_hour_22, 0);
            putvalue(env_ASG_RC_minute_22, 0);
            putvalue(env_ASG_RC_second_22, 0);

            enableControl("ASG_Telephone_0x2F - ReceivedCalls_EditCache", "env_ASG_RC_pos_22", 0);
            enableControl("ASG_Telephone_0x2F - ReceivedCalls_EditCache", "env_ASG_RC_PbName_s_22", 0);
            enableControl("ASG_Telephone_0x2F - ReceivedCalls_EditCache", "env_ASG_RC_TelNum_s_22", 0);
            enableControl("ASG_Telephone_0x2F - ReceivedCalls_EditCache", "env_ASG_RC_NumType_22", 0);
            enableControl("ASG_Telephone_0x2F - ReceivedCalls_EditCache", "env_ASG_RC_day_22", 0);
            enableControl("ASG_Telephone_0x2F - ReceivedCalls_EditCache", "env_ASG_RC_month_22", 0);
            enableControl("ASG_Telephone_0x2F - ReceivedCalls_EditCache", "env_ASG_RC_year_22", 0);
            enableControl("ASG_Telephone_0x2F - ReceivedCalls_EditCache", "env_ASG_RC_hour_22", 0);
            enableControl("ASG_Telephone_0x2F - ReceivedCalls_EditCache", "env_ASG_RC_minute_22", 0);
            enableControl("ASG_Telephone_0x2F - ReceivedCalls_EditCache", "env_ASG_RC_second_22", 0);
        }


        if(gReceivedCalls_ListEntryReceptionInformation[5])
        {
            putvalue(env_ASG_RC_pos_23, gReceivedCalls_Pos[5]);
            putvalue(env_ASG_RC_PbName_s_23, gReceivedCalls_PbName[5]);
            putvalue(env_ASG_RC_TelNum_s_23, gReceivedCalls_TelNumber[5]);
            putvalue(env_ASG_RC_NumType_23, gReceivedCalls_NumberType[5]);
            putvalue(env_ASG_RC_day_23, gReceivedCalls_day[5]);
            putvalue(env_ASG_RC_month_23, gReceivedCalls_month[5]);
            putvalue(env_ASG_RC_year_23, gReceivedCalls_year[5]);
            putvalue(env_ASG_RC_hour_23, gReceivedCalls_hour[5]);
            putvalue(env_ASG_RC_minute_23, gReceivedCalls_minute[5]);
            putvalue(env_ASG_RC_second_23, gReceivedCalls_second[5]);

            enableControl("ASG_Telephone_0x2F - ReceivedCalls_EditCache", "env_ASG_RC_pos_23", 1);
            enableControl("ASG_Telephone_0x2F - ReceivedCalls_EditCache", "env_ASG_RC_PbName_s_23", 1);
            enableControl("ASG_Telephone_0x2F - ReceivedCalls_EditCache", "env_ASG_RC_TelNum_s_23", 1);
            enableControl("ASG_Telephone_0x2F - ReceivedCalls_EditCache", "env_ASG_RC_NumType_23", 1);
            enableControl("ASG_Telephone_0x2F - ReceivedCalls_EditCache", "env_ASG_RC_day_23", 1);
            enableControl("ASG_Telephone_0x2F - ReceivedCalls_EditCache", "env_ASG_RC_month_23", 1);
            enableControl("ASG_Telephone_0x2F - ReceivedCalls_EditCache", "env_ASG_RC_year_23", 1);
            enableControl("ASG_Telephone_0x2F - ReceivedCalls_EditCache", "env_ASG_RC_hour_23", 1);
            enableControl("ASG_Telephone_0x2F - ReceivedCalls_EditCache", "env_ASG_RC_minute_23", 1);
            enableControl("ASG_Telephone_0x2F - ReceivedCalls_EditCache", "env_ASG_RC_second_23", 1);
        }

        else
        {
            putvalue(env_ASG_RC_pos_23, 0);
            putvalue(env_ASG_RC_PbName_s_23, empty_string);
            putvalue(env_ASG_RC_TelNum_s_23, empty_string);
            putvalue(env_ASG_RC_NumType_23, 0);
            putvalue(env_ASG_RC_day_23, 0);
            putvalue(env_ASG_RC_month_23, 0);
            putvalue(env_ASG_RC_year_23, 0);
            putvalue(env_ASG_RC_hour_23, 0);
            putvalue(env_ASG_RC_minute_23, 0);
            putvalue(env_ASG_RC_second_23, 0);

            enableControl("ASG_Telephone_0x2F - ReceivedCalls_EditCache", "env_ASG_RC_pos_23", 0);
            enableControl("ASG_Telephone_0x2F - ReceivedCalls_EditCache", "env_ASG_RC_PbName_s_23", 0);
            enableControl("ASG_Telephone_0x2F - ReceivedCalls_EditCache", "env_ASG_RC_TelNum_s_23", 0);
            enableControl("ASG_Telephone_0x2F - ReceivedCalls_EditCache", "env_ASG_RC_NumType_23", 0);
            enableControl("ASG_Telephone_0x2F - ReceivedCalls_EditCache", "env_ASG_RC_day_23", 0);
            enableControl("ASG_Telephone_0x2F - ReceivedCalls_EditCache", "env_ASG_RC_month_23", 0);
            enableControl("ASG_Telephone_0x2F - ReceivedCalls_EditCache", "env_ASG_RC_year_23", 0);
            enableControl("ASG_Telephone_0x2F - ReceivedCalls_EditCache", "env_ASG_RC_hour_23", 0);
            enableControl("ASG_Telephone_0x2F - ReceivedCalls_EditCache", "env_ASG_RC_minute_23", 0);
            enableControl("ASG_Telephone_0x2F - ReceivedCalls_EditCache", "env_ASG_RC_second_23", 0);
        }
}
/*@@end*/

/*@@caplFunc:ReceivedCalls_GetNextCachedElement(int,byte):*///function
int ReceivedCalls_GetNextCachedElement (int currentElement,byte direction)
{
    int i=0, nextElement=0;

    switch (direction)
    {
        case TEL_RECEIVEDCALLS_DISPLAYLIST_FIND_NEXT_ELEMENT:                
                nextElement = ++currentElement;

                if (nextElement<TEL_RECEIVEDCALLS_ASGCACHE_MAX_SIZE) //start at next element, if next element is not >8
                {
                    for(i =nextElement; i<TEL_RECEIVEDCALLS_ASGCACHE_MAX_SIZE;i++)
                    {
                        if(gReceivedCalls_ListEntryReceptionInformation[i] ==TRUE)
                        {   
                            nextElement =i; 
                            i= TEL_RECEIVEDCALLS_ASGCACHE_MAX_SIZE;
                        }
                        else
                            nextElement =0;
                    }
                }
                else    //start at first element
                {
                    nextElement =0;

                    for(i =nextElement; i<TEL_RECEIVEDCALLS_ASGCACHE_MAX_SIZE;i++)
                    {
                        if(gReceivedCalls_ListEntryReceptionInformation[i] ==TRUE)
                        {   
                            nextElement =i; 
                            i =TEL_RECEIVEDCALLS_ASGCACHE_MAX_SIZE;
                        }   
                    }
                }
        break;

        case TEL_RECEIVEDCALLS_DISPLAYLIST_FIND_PREVIUOS_ELEMENT:
                nextElement = --currentElement;
                if (nextElement ==0 && gReceivedCalls_ListEntryReceptionInformation[nextElement] ==TRUE)
                    nextElement =0;
                else if (nextElement>0) 
                {
                    for(i =nextElement; i>0; i--)
                    {
                        if(gReceivedCalls_ListEntryReceptionInformation[i] ==TRUE)
                        {   
                            nextElement =i; 
                            i =0;
                        }
                        else
                            nextElement =TEL_RECEIVEDCALLS_ASGCACHE_MAX_SIZE-1;
                    }
                }    
                else    //start at last element
                {
                    nextElement =TEL_RECEIVEDCALLS_ASGCACHE_MAX_SIZE-1;

                    for(i =nextElement; i>0; i--)
                    {
                        if(gReceivedCalls_ListEntryReceptionInformation[i] ==TRUE)
                        {   
                            nextElement =i; 
                            i =0;
                        }
                        else if(gReceivedCalls_ListEntryReceptionInformation[0] ==TRUE)
                            nextElement =0;          
                    }
                }
        break;

        default:
        break;
    }
    return(nextElement);
}
/*@@end*/

/*@@caplFunc:ReceivedCalls_GetNextLineInCache(int,byte):*///function
int ReceivedCalls_GetNextLineInCache (int currentElement,byte direction)
{
    int i=0, nextElement=0;

    switch (direction)
    {
        case FORWARD:
                           
                if(currentElement<TEL_RECEIVEDCALLS_ASGCACHE_MAX_SIZE-1 && currentElement !=5) 
                    nextElement = ++currentElement;  
                
                else if (currentElement ==8)            
                    nextElement =0;
                else
                    nextElement =TEL_RECEIVEDCALLS_NO_NEXT_POSITION;
        break;

        case BACKWARD:
                if(currentElement<TEL_RECEIVEDCALLS_ASGCACHE_MAX_SIZE && currentElement !=0 && currentElement !=6) 
                    nextElement =--currentElement;
                
                else if (currentElement ==0)            
                    nextElement =8;
                
                else
                    nextElement =TEL_RECEIVEDCALLS_NO_NEXT_POSITION;
        break;

        default:
        break;
    }
    return(nextElement);
}
/*@@end*/

/*@@caplFunc:ReceivedCalls_Request(byte,byte,byte,word,word,word):*///function
ReceivedCalls_Request(byte request, byte mode, byte recordaddress, word requested_startelement, word startelement, word elements)
{   
    int  i, j;
    byte Offset, shift, direction, transmitpos, current_line;
    dword requestarray [BAP_buffer_size];
    word indexsize, valid_startelement;

    // Init local variables. 
    for(i=0;i<BAP_buffer_size;i++)
	    requestarray [i]=0;
    
    indexsize   =0;
    Offset      =0;
    valid_startelement=0;

    // decode "mode-byte"
    indexsize   =(mode &0x08)/0x08; 

    // Handle request.
    requestarray[0] =LSGID_Telephone;	    //LSG-ID
	requestarray[1] =FctID_ReceivedCalls;	//Fct.-ID
	requestarray[2] =request;               //request type

    switch(request)
	{
        case DataGet_REQ:              
                requestarray[3] =((gReceivedCalls_ASGID *0x10) &0xF0) +(gReceivedCalls_TAID &0x0F);

                /***ArrayHeader***/
			    requestarray[4] =((mode *0x10) &0xF0) +(recordaddress &0x0F);          
                Offset =5;

                if(indexsize)
                {
                    requestarray[Offset] =requested_startelement &0x00FF;
                    Offset++;
                    requestarray[Offset] =(requested_startelement &0xFF00) /0x100;
                    Offset++;  

                    requestarray[Offset] =elements &0x00FF;
                    Offset++;
                    requestarray[Offset] =(elements &0xFF00) /0x100;
                    Offset++;       
                }
                else
                {
                    requestarray[Offset] =requested_startelement;
                    Offset++;

                    requestarray[Offset] =elements;
                    Offset++;
                }
            
            set_status_requestbuffer (requestarray, Offset, Bap_ByteSequence);
         break;
        case DataSetGet_REQ:
                requestarray[3] =((gReceivedCalls_ASGID *0x10) &0xF0) +(gReceivedCalls_TAID &0x0F);

                /***ArrayHeader***/
			    requestarray[4] =((mode *0x10) &0xF0) +(recordaddress &0x0F);          
                Offset =5;

                if(indexsize)
                {
                    requestarray[Offset] =requested_startelement &0x00FF;
                    Offset++;
                    requestarray[Offset] =(requested_startelement &0xFF00) /0x100;
                    Offset++;  

                    requestarray[Offset] =elements &0x00FF;
                    Offset++;
                    requestarray[Offset] =(elements &0xFF00) /0x100;
                    Offset++;       
                }
                else
                {
                    requestarray[Offset] =requested_startelement;
                    Offset++;

                    requestarray[Offset] =elements;
                    Offset++;
                }

                
                // decode "mode-byte"
                shift       =mode &0x01;
                direction   =(mode &0x02)/0x02;
                transmitpos =(mode &0x04)/0x04;
                indexsize   =(mode &0x08)/0x08;
                
                //searching for valid 'current_element'
				for(i=6;i<9;i++)
				{
					if((gReceivedCalls_Pos[i] ==startelement) && (gReceivedCalls_ListEntryReceptionInformation[i] ==1))				//found a valid element
					{                                          
                        if(shift==TRUE)											//shift is set, this means starting with the next/previous element (depending on the direction-setting)
                            current_line =ReceivedCalls_GetNextLineInCache(i, direction);

                        else
                            current_line =i;                              //found element is valid_startelement

						i=9;
					}
                    else
                        current_line =99;

                    if (i==8)
                        i =-1;
                        
                    if (i==5)
                        i=9;
				}
                     
                for(i=0; i<elements; i++)    
                {
                    if(current_line <TEL_RECEIVEDCALLS_ASGCACHE_MAX_SIZE) //current_element exists in ASG-array
                    {
                        //copy data
                        switch(recordaddress)
			            {
                            case 0: //complete record
                                
                                if (transmitpos) // Pos  ->Array position transmitted
                                {
                                    if (indexsize)
                                    {
                                        requestarray[Offset] =(gReceivedCalls_Pos[current_line] &0xFF);
                                        Offset++;
                                        requestarray[Offset] =((gReceivedCalls_Pos[current_line]&0xFF00) /0x100);
                                        Offset++;
                                    }
                                    else
                                    {
                                        requestarray[Offset] =gReceivedCalls_Pos[current_line];
                                        Offset++;
                                    }
                                }
                                                                                              
                                //PbName
                                requestarray[Offset] =strlen(gReceivedCalls_PbName[current_line]);
                                Offset++;
                                
                                for(j=0;j<strlen(gReceivedCalls_PbName[current_line]);j++)
                    			{
			                        requestarray[Offset] =gReceivedCalls_PbName[current_line][j];	
			                        Offset++;
			                    }
                                
                                //NumberType
                                requestarray[Offset] =gReceivedCalls_NumberType[current_line];
                                Offset++;

                                //TelNumber
                                requestarray[Offset] =strlen(gReceivedCalls_TelNumber[current_line]);
                                Offset++;
                                
                                for(j=0;j<strlen(gReceivedCalls_TelNumber[current_line]);j++)
                    			{
			                        requestarray[Offset] =gReceivedCalls_TelNumber[current_line][j];	
			                        Offset++;
			                    }

                                //Day
                                requestarray[Offset] =gReceivedCalls_day[current_line];
                                Offset++;

                                //Month
                                requestarray[Offset] =gReceivedCalls_month[current_line];
                                Offset++;

                                //Year
                                requestarray[Offset] =gReceivedCalls_year[current_line];
                                Offset++;

                                //Hour
                                requestarray[Offset] =gReceivedCalls_hour[current_line];
                                Offset++;

                                //Minute
                                requestarray[Offset] =gReceivedCalls_minute[current_line];
                                Offset++;

                                //Second
                                requestarray[Offset] =gReceivedCalls_second[current_line];
                                Offset++;    
                        
                            break;

                            case 1: //PbName, NumberType
                                if (transmitpos) // Pos  ->Array position transmitted
                                {
                                    if (indexsize)
                                    {
                                        requestarray[Offset] =(gReceivedCalls_Pos[current_line] &0xFF);
                                        Offset++;
                                        requestarray[Offset] =((gReceivedCalls_Pos[current_line]&0xFF00) /0x100);
                                        Offset++;
                                    }
                                    else
                                    {
                                        requestarray[Offset] =gReceivedCalls_Pos[current_line];
                                        Offset++;
                                    }
                                }
                                                                                              
                                //PbName
                                requestarray[Offset] =strlen(gReceivedCalls_PbName[current_line]);
                                Offset++;
                                
                                for(j=0;j<strlen(gReceivedCalls_PbName[current_line]);j++)
                    			{
			                        requestarray[Offset] =gReceivedCalls_PbName[current_line][j];	
			                        Offset++;
			                    }
                                
                                //NumberType
                                requestarray[Offset] =gReceivedCalls_NumberType[current_line];
                                Offset++; 
                                
                            break;

                            case 2: //TelNumber, Day, Month, Year, Hour, Minute, Second
                                if (transmitpos) // Pos  ->Array position transmitted
                                {
                                    if (indexsize)
                                    {
                                        requestarray[Offset] =(gReceivedCalls_Pos[current_line] &0xFF);
                                        Offset++;
                                        requestarray[Offset] =((gReceivedCalls_Pos[current_line]&0xFF00) /0x100);
                                        Offset++;
                                    }
                                    else
                                    {
                                        requestarray[Offset] =gReceivedCalls_Pos[current_line];
                                        Offset++;
                                    }
                                }
                                                                                              
                                //TelNumber
                                requestarray[Offset] =strlen(gReceivedCalls_TelNumber[current_line]);
                                Offset++;
                                
                                for(j=0;j<strlen(gReceivedCalls_TelNumber[current_line]);j++)
                    			{
			                        requestarray[Offset] =gReceivedCalls_TelNumber[current_line][j];	
			                        Offset++;
			                    }

                                //Day
                                requestarray[Offset] =gReceivedCalls_day[current_line];
                                Offset++;

                                //Month
                                requestarray[Offset] =gReceivedCalls_month[current_line];
                                Offset++;

                                //Year
                                requestarray[Offset] =gReceivedCalls_year[current_line];
                                Offset++;

                                //Hour
                                requestarray[Offset] =gReceivedCalls_hour[current_line];
                                Offset++;

                                //Minute
                                requestarray[Offset] =gReceivedCalls_minute[current_line];
                                Offset++;

                                //Second
                                requestarray[Offset] =gReceivedCalls_second[current_line];
                                Offset++;  
                             break;

                            case 15: //Pos
                                if (transmitpos) // Pos  ->Array position transmitted
                                {
                                    if (indexsize)
                                    {
                                        requestarray[Offset] =(gReceivedCalls_Pos[current_line] &0xFF);
                                        Offset++;
                                        requestarray[Offset] =((gReceivedCalls_Pos[current_line]&0xFF00) /0x100);
                                        Offset++;
                                    }
                                    else
                                    {
                                        requestarray[Offset] =gReceivedCalls_Pos[current_line];
                                        Offset++;
                                    }
                                }
                                                                                               
                             break;
                            default:
                             break;
                        }// end 'switch'
                        

                        current_line =ReceivedCalls_GetNextLineInCache(current_line, direction); //next line

                    }//end 'if'
                    
                    else
                        i =elements;
                }//end 'for'

                set_status_requestbuffer (requestarray, Offset, Bap_ByteSequence);
        break;

        default:	
			writelineEx(gError_Trace, 0, "ASG-Telephone ReceivedCalls_Request: invalid request %d", request);
		break;
    }
}
/*@@end*/

/*@@caplFunc:ReceivedCalls_display():*///function
ReceivedCalls_display()
{   
    int Element_1 =0, Element_2 =1, Element_3 =2;

    if(Power_on==gRNS_PowerOnOff && getvalue(env_ASG_RC_OnOff))
	{   
        /******'sliding window' not active******/         
        if(gReceivedCalls_DisplayStatus ==TEL_RECEIVEDCALLS_DISPLAYLIST_SEARCH_ELEMENTS)
        {
            //1. Element              
            if(gReceivedCalls_CursorAction ==TEL_RECEIVEDCALLS_CURSORACTION_DOWN)
                Element_1 =ReceivedCalls_GetNextCachedElement(gReceivedCalls_LastFirstElement, TEL_RECEIVEDCALLS_DISPLAYLIST_FIND_NEXT_ELEMENT);
            
            else if(gReceivedCalls_CursorAction ==TEL_RECEIVEDCALLS_CURSORACTION_UP)            
                Element_1 =ReceivedCalls_GetNextCachedElement(gReceivedCalls_LastFirstElement, TEL_RECEIVEDCALLS_DISPLAYLIST_FIND_PREVIUOS_ELEMENT);

            if(gReceivedCalls_Pos[Element_1] ==gReceivedCalls_FirstElement)
            {   
                putvalue(env_ASG_RC_ListInfo_up,"first element");
                                
                gReceivedCalls_MoveList_up_allowed =FALSE;
            }
            else
            {
                putvalue(env_ASG_RC_ListInfo_up,empty_string);
                                
                gReceivedCalls_MoveList_up_allowed =TRUE;
            }  

            //Pos
            putvalue(env_ASG_RC_pos_0, gReceivedCalls_Pos[Element_1]);               
            
            //PbName
            if (gReceivedCalls_recordaddress ==0 || gReceivedCalls_recordaddress ==1)
                putvalue(env_ASG_RC_PbName_s_0,gReceivedCalls_PbName[Element_1]);

            //NumberType
            if (gReceivedCalls_recordaddress ==0 || gReceivedCalls_recordaddress ==1) 
            {
                putvalue(env_ASG_RC_NumType_0, gReceivedCalls_NumberType[Element_1]);

                if(gReceivedCalls_NumberType[Element_1] <0x0F)
                    putvalue(env_ASG_RC_NumType_s_0,gReceivedCalls_NumberType_s[gReceivedCalls_NumberType[Element_1]]);
                else
                    putvalue(env_ASG_RC_NumType_s_0,gstring_reserved);
            }
            
            //TelNumber
            if (gReceivedCalls_recordaddress ==0 || gReceivedCalls_recordaddress ==2)
                putvalue(env_ASG_RC_TelNum_s_0,gReceivedCalls_TelNumber[Element_1]);

            //Day
            if (gReceivedCalls_recordaddress ==0 || gReceivedCalls_recordaddress ==2)
                putvalue(env_ASG_RC_day_0,gReceivedCalls_day[Element_1]);

            //Month
            if (gReceivedCalls_recordaddress ==0 || gReceivedCalls_recordaddress ==2)
                putvalue(env_ASG_RC_month_0,gReceivedCalls_month[Element_1]);
            
            //Year
            if (gReceivedCalls_recordaddress ==0 || gReceivedCalls_recordaddress ==2)
                putvalue(env_ASG_RC_year_0,gReceivedCalls_year[Element_1]);

            //Hour
            if (gReceivedCalls_recordaddress ==0 || gReceivedCalls_recordaddress ==2)
                putvalue(env_ASG_RC_hour_0,gReceivedCalls_hour[Element_1]);
            
            //Minute
            if (gReceivedCalls_recordaddress ==0 || gReceivedCalls_recordaddress ==2)
                putvalue(env_ASG_RC_minute_0,gReceivedCalls_minute[Element_1]);

            //Second
            if (gReceivedCalls_recordaddress ==0 || gReceivedCalls_recordaddress ==2)
                putvalue(env_ASG_RC_second_0,gReceivedCalls_second[Element_1]);
            
            gReceivedCalls_LastFirstElement =Element_1;
            
            
            //2. Element             
            Element_2 =ReceivedCalls_GetNextCachedElement(Element_1, TEL_RECEIVEDCALLS_DISPLAYLIST_FIND_NEXT_ELEMENT);
            
            if(gReceivedCalls_Pos[Element_2] ==gReceivedCalls_LastElement)
            {   
                putvalue(env_ASG_RC_ListInfo_Cursor,"last element");
                                
                gReceivedCalls_MoveList_down_allowed =FALSE;               
            }
            else
            {
                putvalue(env_ASG_RC_ListInfo_Cursor,empty_string);
                                
                gReceivedCalls_MoveList_down_allowed =TRUE;
            } 

            //Pos
            putvalue(env_ASG_RC_pos_1, gReceivedCalls_Pos[Element_2]);               
            
            //PbName
            if (gReceivedCalls_recordaddress ==0 || gReceivedCalls_recordaddress ==1)
                putvalue(env_ASG_RC_PbName_s_1,gReceivedCalls_PbName[Element_2]);

            //NumberType
            if (gReceivedCalls_recordaddress ==0 || gReceivedCalls_recordaddress ==1) 
            {
                putvalue(env_ASG_RC_NumType_1, gReceivedCalls_NumberType[Element_2]);

                if(gReceivedCalls_NumberType[Element_2] <0x0F)
                    putvalue(env_ASG_RC_NumType_s_1,gReceivedCalls_NumberType_s[gReceivedCalls_NumberType[Element_2]]);
                else
                    putvalue(env_ASG_RC_NumType_s_1,gstring_reserved);
            }
            
            //TelNumber
            if (gReceivedCalls_recordaddress ==0 || gReceivedCalls_recordaddress ==2)
                putvalue(env_ASG_RC_TelNum_s_1,gReceivedCalls_TelNumber[Element_2]);

            //Day
            if (gReceivedCalls_recordaddress ==0 || gReceivedCalls_recordaddress ==2)
                putvalue(env_ASG_RC_day_1,gReceivedCalls_day[Element_2]);

            //Month
            if (gReceivedCalls_recordaddress ==0 || gReceivedCalls_recordaddress ==2)
                putvalue(env_ASG_RC_month_1,gReceivedCalls_month[Element_2]);
            
            //Year
            if (gReceivedCalls_recordaddress ==0 || gReceivedCalls_recordaddress ==2)
                putvalue(env_ASG_RC_year_1,gReceivedCalls_year[Element_2]);

            //Hour
            if (gReceivedCalls_recordaddress ==0 || gReceivedCalls_recordaddress ==2)
                putvalue(env_ASG_RC_hour_1,gReceivedCalls_hour[Element_2]);
            
            //Minute
            if (gReceivedCalls_recordaddress ==0 || gReceivedCalls_recordaddress ==2)
                putvalue(env_ASG_RC_minute_1,gReceivedCalls_minute[Element_2]);

            //Second
            if (gReceivedCalls_recordaddress ==0 || gReceivedCalls_recordaddress ==2)
                putvalue(env_ASG_RC_second_1,gReceivedCalls_second[Element_2]);
             
            
            //3. Element          
            Element_3 =ReceivedCalls_GetNextCachedElement(Element_2, TEL_RECEIVEDCALLS_DISPLAYLIST_FIND_NEXT_ELEMENT);

            if(gReceivedCalls_Pos[Element_3] ==gReceivedCalls_LastElement)
            {   
                putvalue(env_ASG_RC_ListInfo_down,"last element");
                                
                gReceivedCalls_MoveList_down_allowed =FALSE;
            }
            else
            {
                putvalue(env_ASG_RC_ListInfo_down,empty_string);
                                
                gReceivedCalls_MoveList_down_allowed =TRUE;
            } 

            //Pos
            putvalue(env_ASG_RC_pos_2, gReceivedCalls_Pos[Element_3]);               
            
            //PbName
            if (gReceivedCalls_recordaddress ==0 || gReceivedCalls_recordaddress ==1)
                putvalue(env_ASG_RC_PbName_s_2,gReceivedCalls_PbName[Element_3]);

            //NumberType
            if (gReceivedCalls_recordaddress ==0 || gReceivedCalls_recordaddress ==1) 
            {
                putvalue(env_ASG_RC_NumType_2, gReceivedCalls_NumberType[Element_3]);

                if(gReceivedCalls_NumberType[Element_3] <0x0F)
                    putvalue(env_ASG_RC_NumType_s_2,gReceivedCalls_NumberType_s[gReceivedCalls_NumberType[Element_3]]);
                else
                    putvalue(env_ASG_RC_NumType_s_2,gstring_reserved);
            }
            
            //TelNumber
            if (gReceivedCalls_recordaddress ==0 || gReceivedCalls_recordaddress ==2)
                putvalue(env_ASG_RC_TelNum_s_2,gReceivedCalls_TelNumber[Element_3]);

            //Day
            if (gReceivedCalls_recordaddress ==0 || gReceivedCalls_recordaddress ==2)
                putvalue(env_ASG_RC_day_2,gReceivedCalls_day[Element_3]);

            //Month
            if (gReceivedCalls_recordaddress ==0 || gReceivedCalls_recordaddress ==2)
                putvalue(env_ASG_RC_month_2,gReceivedCalls_month[Element_3]);
            
            //Year
            if (gReceivedCalls_recordaddress ==0 || gReceivedCalls_recordaddress ==2)
                putvalue(env_ASG_RC_year_2,gReceivedCalls_year[Element_3]);

            //Hour
            if (gReceivedCalls_recordaddress ==0 || gReceivedCalls_recordaddress ==2)
                putvalue(env_ASG_RC_hour_2,gReceivedCalls_hour[Element_3]);
            
            //Minute
            if (gReceivedCalls_recordaddress ==0 || gReceivedCalls_recordaddress ==2)
                putvalue(env_ASG_RC_minute_2,gReceivedCalls_minute[Element_3]);

            //Second
            if (gReceivedCalls_recordaddress ==0 || gReceivedCalls_recordaddress ==2)
                putvalue(env_ASG_RC_second_2,gReceivedCalls_second[Element_3]);     
        }

        /******'sliding Window' active or 'build-up List'******/
        else if(gReceivedCalls_DisplayStatus ==TEL_RECEIVEDCALLS_DISPLAYLIST_FIRST_ELEMENTS) 
        {   
            //1. Element    
            if(gReceivedCalls_ListEntryReceptionInformation [0] ==TRUE && getvalue(env_ASG_RC_OnOff))
            {   
                Element_1 =0;

                if(gReceivedCalls_Pos[Element_1] ==gReceivedCalls_FirstElement)
                {   
                    putvalue(env_ASG_RC_ListInfo_up,"first element");
                                        
                    gReceivedCalls_MoveList_up_allowed =FALSE;
                }
                else 
                {   
                    putvalue(env_ASG_RC_ListInfo_up,empty_string);
                                        
                    gReceivedCalls_MoveList_up_allowed =TRUE;
                }
                
                
                //Pos
                putvalue(env_ASG_RC_pos_0, gReceivedCalls_Pos[Element_1]);               
            
                //PbName
                if (gReceivedCalls_recordaddress ==0 || gReceivedCalls_recordaddress ==1)
                    putvalue(env_ASG_RC_PbName_s_0,gReceivedCalls_PbName[Element_1]);

                //NumberType
                if (gReceivedCalls_recordaddress ==0 || gReceivedCalls_recordaddress ==1) 
                {
                    putvalue(env_ASG_RC_NumType_0, gReceivedCalls_NumberType[Element_1]);

                    if(gReceivedCalls_NumberType[Element_1] <0x0F)
                        putvalue(env_ASG_RC_NumType_s_0,gReceivedCalls_NumberType_s[gReceivedCalls_NumberType[Element_1]]);
                    else
                        putvalue(env_ASG_RC_NumType_s_0,gstring_reserved);
                }
            
                //TelNumber
                if (gReceivedCalls_recordaddress ==0 || gReceivedCalls_recordaddress ==2)
                    putvalue(env_ASG_RC_TelNum_s_0,gReceivedCalls_TelNumber[Element_1]);

                //Day
                if (gReceivedCalls_recordaddress ==0 || gReceivedCalls_recordaddress ==2)
                    putvalue(env_ASG_RC_day_0,gReceivedCalls_day[Element_1]);

                //Month
                if (gReceivedCalls_recordaddress ==0 || gReceivedCalls_recordaddress ==2)
                    putvalue(env_ASG_RC_month_0,gReceivedCalls_month[Element_1]);
            
                //Year
                if (gReceivedCalls_recordaddress ==0 || gReceivedCalls_recordaddress ==2)
                    putvalue(env_ASG_RC_year_0,gReceivedCalls_year[Element_1]);

                //Hour
                if (gReceivedCalls_recordaddress ==0 || gReceivedCalls_recordaddress ==2)
                    putvalue(env_ASG_RC_hour_0,gReceivedCalls_hour[Element_1]);
            
                //Minute
                if (gReceivedCalls_recordaddress ==0 || gReceivedCalls_recordaddress ==2)
                    putvalue(env_ASG_RC_minute_0,gReceivedCalls_minute[Element_1]);

                //Second
                if (gReceivedCalls_recordaddress ==0 || gReceivedCalls_recordaddress ==2)
                    putvalue(env_ASG_RC_second_0,gReceivedCalls_second[Element_1]);
            }


            //2. Element    
            if(gReceivedCalls_ListEntryReceptionInformation [1] ==TRUE && getvalue(env_ASG_RC_OnOff))
            {
                Element_2 =1;
                
                if(gReceivedCalls_Pos[Element_2] ==gReceivedCalls_LastElement)
                {   
                    putvalue(env_ASG_RC_ListInfo_Cursor,"last element");
                                        
                    gReceivedCalls_MoveList_down_allowed =FALSE;               
                }
                else
                {
                    putvalue(env_ASG_RC_ListInfo_Cursor,empty_string);
                                        
                    gReceivedCalls_MoveList_down_allowed =TRUE;
                } 

                //Pos
                putvalue(env_ASG_RC_pos_1, gReceivedCalls_Pos[Element_2]);               
            
                //PbName
                if (gReceivedCalls_recordaddress ==0 || gReceivedCalls_recordaddress ==1)
                    putvalue(env_ASG_RC_PbName_s_1,gReceivedCalls_PbName[Element_2]);

                //NumberType
                if (gReceivedCalls_recordaddress ==0 || gReceivedCalls_recordaddress ==1) 
                {
                    putvalue(env_ASG_RC_NumType_1, gReceivedCalls_NumberType[Element_2]);

                    if(gReceivedCalls_NumberType[Element_2] <0x0F)
                        putvalue(env_ASG_RC_NumType_s_1,gReceivedCalls_NumberType_s[gReceivedCalls_NumberType[Element_2]]);
                    
                    else
                        putvalue(env_ASG_RC_NumType_s_1,gstring_reserved);
                }
                
                //TelNumber
                if (gReceivedCalls_recordaddress ==0 || gReceivedCalls_recordaddress ==2)
                    putvalue(env_ASG_RC_TelNum_s_1,gReceivedCalls_TelNumber[Element_2]);

                //Day
                if (gReceivedCalls_recordaddress ==0 || gReceivedCalls_recordaddress ==2)
                    putvalue(env_ASG_RC_day_1,gReceivedCalls_day[Element_2]);

                //Month
                if (gReceivedCalls_recordaddress ==0 || gReceivedCalls_recordaddress ==2)
                    putvalue(env_ASG_RC_month_1,gReceivedCalls_month[Element_2]);
            
                //Year
                if (gReceivedCalls_recordaddress ==0 || gReceivedCalls_recordaddress ==2)
                    putvalue(env_ASG_RC_year_1,gReceivedCalls_year[Element_2]);

                //Hour
                if (gReceivedCalls_recordaddress ==0 || gReceivedCalls_recordaddress ==2)
                    putvalue(env_ASG_RC_hour_1,gReceivedCalls_hour[Element_2]);
            
                //Minute
                if (gReceivedCalls_recordaddress ==0 || gReceivedCalls_recordaddress ==2)
                    putvalue(env_ASG_RC_minute_1,gReceivedCalls_minute[Element_2]);

                //Second
                if (gReceivedCalls_recordaddress ==0 || gReceivedCalls_recordaddress ==2)
                    putvalue(env_ASG_RC_second_1,gReceivedCalls_second[Element_2]);
             }

            //3. Element    
            if(gReceivedCalls_ListEntryReceptionInformation [2] ==TRUE && getvalue(env_ASG_RC_OnOff))
            {
                Element_3 =2;
                if(gReceivedCalls_Pos[Element_3] ==gReceivedCalls_LastElement)
                {   
                    putvalue(env_ASG_RC_ListInfo_down,"last element");
                                        
                    gReceivedCalls_MoveList_down_allowed =FALSE;
                }
                
                else
                {
                    putvalue(env_ASG_RC_ListInfo_down,empty_string);
                                        
                    gReceivedCalls_MoveList_down_allowed =TRUE;
                }   

                //Pos
                putvalue(env_ASG_RC_pos_2, gReceivedCalls_Pos[Element_3]);               
            
                //PbName
                if (gReceivedCalls_recordaddress ==0 || gReceivedCalls_recordaddress ==1)
                    putvalue(env_ASG_RC_PbName_s_2,gReceivedCalls_PbName[Element_3]);

                //NumberType
                if (gReceivedCalls_recordaddress ==0 || gReceivedCalls_recordaddress ==1) 
                {
                    putvalue(env_ASG_RC_NumType_2, gReceivedCalls_NumberType[Element_3]);

                    if(gReceivedCalls_NumberType[Element_3] <0x0F)
                        putvalue(env_ASG_RC_NumType_s_2,gReceivedCalls_NumberType_s[gReceivedCalls_NumberType[Element_3]]);
                    else
                        putvalue(env_ASG_RC_NumType_s_2,gstring_reserved);
                }
            
                //TelNumber
                if (gReceivedCalls_recordaddress ==0 || gReceivedCalls_recordaddress ==2)
                    putvalue(env_ASG_RC_TelNum_s_2,gReceivedCalls_TelNumber[Element_3]);

                //Day
                if (gReceivedCalls_recordaddress ==0 || gReceivedCalls_recordaddress ==2)
                    putvalue(env_ASG_RC_day_2,gReceivedCalls_day[Element_3]);

                //Month
                if (gReceivedCalls_recordaddress ==0 || gReceivedCalls_recordaddress ==2)
                    putvalue(env_ASG_RC_month_2,gReceivedCalls_month[Element_3]);
            
                //Year
                if (gReceivedCalls_recordaddress ==0 || gReceivedCalls_recordaddress ==2)
                    putvalue(env_ASG_RC_year_2,gReceivedCalls_year[Element_3]);

                //Hour
                if (gReceivedCalls_recordaddress ==0 || gReceivedCalls_recordaddress ==2)
                    putvalue(env_ASG_RC_hour_2,gReceivedCalls_hour[Element_3]);
            
                //Minute
                if (gReceivedCalls_recordaddress ==0 || gReceivedCalls_recordaddress ==2)
                    putvalue(env_ASG_RC_minute_2,gReceivedCalls_minute[Element_3]);

                //Second
                if (gReceivedCalls_recordaddress ==0 || gReceivedCalls_recordaddress ==2)
                    putvalue(env_ASG_RC_second_2,gReceivedCalls_second[Element_3]);    
            }

            ReceivedCalls_DisplayCache();
        }
        else if (gReceivedCalls_DisplayStatus ==TEL_RECEIVEDCALLS_DISPLAYLIST_REFRESH)
        {               
            //1. Element
            if(gReceivedCalls_SlidingWindow_State ==TEL_RECEIVEDCALLS_SLIDINGWINDOW_NOTACTIVE)
                Element_1 =gReceivedCalls_LastFirstElement; 
            else
                Element_1 =0;

            if(gReceivedCalls_Pos[Element_1] ==gReceivedCalls_FirstElement)
            {   
                putvalue(env_ASG_RC_ListInfo_up,"first element");
                                
                gReceivedCalls_MoveList_up_allowed =FALSE;
            }
            else 
            {
                putvalue(env_ASG_RC_ListInfo_up,empty_string);
                                
                gReceivedCalls_MoveList_up_allowed =TRUE;
                gReceivedCalls_UpCaching_required  =FALSE;
            } 

            //Pos
            putvalue(env_ASG_RC_pos_0, gReceivedCalls_Pos[Element_1]);               
            
            //PbName
            if (gReceivedCalls_recordaddress ==0 || gReceivedCalls_recordaddress ==1)
                putvalue(env_ASG_RC_PbName_s_0,gReceivedCalls_PbName[Element_1]);

            //NumberType
            if (gReceivedCalls_recordaddress ==0 || gReceivedCalls_recordaddress ==1) 
            {
                putvalue(env_ASG_RC_NumType_0, gReceivedCalls_NumberType[Element_1]);

                if(gReceivedCalls_NumberType[Element_1] <0x0F)
                    putvalue(env_ASG_RC_NumType_s_0,gReceivedCalls_NumberType_s[gReceivedCalls_NumberType[Element_1]]);
                else
                    putvalue(env_ASG_RC_NumType_s_0,gstring_reserved);
            }
            
            //TelNumber
            if (gReceivedCalls_recordaddress ==0 || gReceivedCalls_recordaddress ==2)
                putvalue(env_ASG_RC_TelNum_s_0,gReceivedCalls_TelNumber[Element_1]);

            //Day
            if (gReceivedCalls_recordaddress ==0 || gReceivedCalls_recordaddress ==2)
                putvalue(env_ASG_RC_day_0,gReceivedCalls_day[Element_1]);

            //Month
            if (gReceivedCalls_recordaddress ==0 || gReceivedCalls_recordaddress ==2)
                putvalue(env_ASG_RC_month_0,gReceivedCalls_month[Element_1]);
            
            //Year
            if (gReceivedCalls_recordaddress ==0 || gReceivedCalls_recordaddress ==2)
                putvalue(env_ASG_RC_year_0,gReceivedCalls_year[Element_1]);

            //Hour
            if (gReceivedCalls_recordaddress ==0 || gReceivedCalls_recordaddress ==2)
                putvalue(env_ASG_RC_hour_0,gReceivedCalls_hour[Element_1]);
            
            //Minute
            if (gReceivedCalls_recordaddress ==0 || gReceivedCalls_recordaddress ==2)
                putvalue(env_ASG_RC_minute_0,gReceivedCalls_minute[Element_1]);

            //Second
            if (gReceivedCalls_recordaddress ==0 || gReceivedCalls_recordaddress ==2)
                putvalue(env_ASG_RC_second_0,gReceivedCalls_second[Element_1]);
            

            //2. Element             
            if(gReceivedCalls_SlidingWindow_State ==TEL_RECEIVEDCALLS_SLIDINGWINDOW_NOTACTIVE)
                Element_2 =ReceivedCalls_GetNextCachedElement(Element_1, TEL_RECEIVEDCALLS_DISPLAYLIST_FIND_NEXT_ELEMENT);
            else
                Element_2 =1;

            if(gReceivedCalls_ListEntryReceptionInformation[Element_2])
            {
                if(gReceivedCalls_Pos[Element_2] ==gReceivedCalls_LastElement)
                {   
                    putvalue(env_ASG_RC_ListInfo_Cursor,"last element");
                                        
                    gReceivedCalls_MoveList_down_allowed =FALSE;               
                }
                else
                {
                    putvalue(env_ASG_RC_ListInfo_Cursor,empty_string);
                                        
                    gReceivedCalls_MoveList_down_allowed =TRUE;
                } 

                //Pos
                putvalue(env_ASG_RC_pos_1, gReceivedCalls_Pos[Element_2]);               
            
                //PbName
                if (gReceivedCalls_recordaddress ==0 || gReceivedCalls_recordaddress ==1)
                    putvalue(env_ASG_RC_PbName_s_1,gReceivedCalls_PbName[Element_2]);

                //NumberType
                if (gReceivedCalls_recordaddress ==0 || gReceivedCalls_recordaddress ==1) 
                {
                    putvalue(env_ASG_RC_NumType_1, gReceivedCalls_NumberType[Element_2]);

                    if(gReceivedCalls_NumberType[Element_2] <0x0F)
                        putvalue(env_ASG_RC_NumType_s_1,gReceivedCalls_NumberType_s[gReceivedCalls_NumberType[Element_2]]);
                    
                    else
                        putvalue(env_ASG_RC_NumType_s_1,gstring_reserved);
                }
            
                //TelNumber
                if (gReceivedCalls_recordaddress ==0 || gReceivedCalls_recordaddress ==2)
                    putvalue(env_ASG_RC_TelNum_s_1,gReceivedCalls_TelNumber[Element_2]);

                //Day
                if (gReceivedCalls_recordaddress ==0 || gReceivedCalls_recordaddress ==2)
                    putvalue(env_ASG_RC_day_1,gReceivedCalls_day[Element_2]);

                //Month
                if (gReceivedCalls_recordaddress ==0 || gReceivedCalls_recordaddress ==2)
                    putvalue(env_ASG_RC_month_1,gReceivedCalls_month[Element_2]);
            
                //Year
                if (gReceivedCalls_recordaddress ==0 || gReceivedCalls_recordaddress ==2)
                    putvalue(env_ASG_RC_year_1,gReceivedCalls_year[Element_2]);

                //Hour
                if (gReceivedCalls_recordaddress ==0 || gReceivedCalls_recordaddress ==2)
                    putvalue(env_ASG_RC_hour_1,gReceivedCalls_hour[Element_2]);
            
                //Minute
                if (gReceivedCalls_recordaddress ==0 || gReceivedCalls_recordaddress ==2)
                    putvalue(env_ASG_RC_minute_1,gReceivedCalls_minute[Element_2]);

                //Second
                if (gReceivedCalls_recordaddress ==0 || gReceivedCalls_recordaddress ==2)
                    putvalue(env_ASG_RC_second_1,gReceivedCalls_second[Element_2]);
            }

            //3. Element          
            if(gReceivedCalls_SlidingWindow_State ==TEL_RECEIVEDCALLS_SLIDINGWINDOW_NOTACTIVE)
                Element_3 =ReceivedCalls_GetNextCachedElement(Element_2, TEL_RECEIVEDCALLS_DISPLAYLIST_FIND_NEXT_ELEMENT);
            else
                Element_3 =2;

            if(gReceivedCalls_ListEntryReceptionInformation[Element_3])
            {    
                if(gReceivedCalls_Pos[Element_3] ==gReceivedCalls_LastElement)
                {   
                    putvalue(env_ASG_RC_ListInfo_down,"last element");
                                        
                    gReceivedCalls_MoveList_down_allowed =FALSE;
                }
                else
                {
                    putvalue(env_ASG_RC_ListInfo_down,empty_string);
                    
                    gReceivedCalls_MoveList_down_allowed =TRUE;
                } 

                //Pos
                putvalue(env_ASG_RC_pos_2, gReceivedCalls_Pos[Element_3]);               
            
                //PbName
                if (gReceivedCalls_recordaddress ==0 || gReceivedCalls_recordaddress ==1)
                    putvalue(env_ASG_RC_PbName_s_2,gReceivedCalls_PbName[Element_3]);

                //NumberType
                if (gReceivedCalls_recordaddress ==0 || gReceivedCalls_recordaddress ==1) 
                {
                    putvalue(env_ASG_RC_NumType_2, gReceivedCalls_NumberType[Element_3]);

                    if(gReceivedCalls_NumberType[Element_3] <0x0F)
                        putvalue(env_ASG_RC_NumType_s_2,gReceivedCalls_NumberType_s[gReceivedCalls_NumberType[Element_3]]);
                    else
                        putvalue(env_ASG_RC_NumType_s_2,gstring_reserved);
                }
            
                //TelNumber
                if (gReceivedCalls_recordaddress ==0 || gReceivedCalls_recordaddress ==2)
                    putvalue(env_ASG_RC_TelNum_s_2,gReceivedCalls_TelNumber[Element_3]);

                //Day
                if (gReceivedCalls_recordaddress ==0 || gReceivedCalls_recordaddress ==2)
                    putvalue(env_ASG_RC_day_2,gReceivedCalls_day[Element_3]);

                //Month
                if (gReceivedCalls_recordaddress ==0 || gReceivedCalls_recordaddress ==2)
                    putvalue(env_ASG_RC_month_2,gReceivedCalls_month[Element_3]);
            
                //Year
                if (gReceivedCalls_recordaddress ==0 || gReceivedCalls_recordaddress ==2)
                    putvalue(env_ASG_RC_year_2,gReceivedCalls_year[Element_3]);

                //Hour
                if (gReceivedCalls_recordaddress ==0 || gReceivedCalls_recordaddress ==2)
                    putvalue(env_ASG_RC_hour_2,gReceivedCalls_hour[Element_3]);
            
                //Minute
                if (gReceivedCalls_recordaddress ==0 || gReceivedCalls_recordaddress ==2)
                    putvalue(env_ASG_RC_minute_2,gReceivedCalls_minute[Element_3]);

                //Second
                if (gReceivedCalls_recordaddress ==0 || gReceivedCalls_recordaddress ==2)
                    putvalue(env_ASG_RC_second_2,gReceivedCalls_second[Element_3]); 
            }

            ReceivedCalls_DisplayCache();
        }
    }
}
/*@@end*/

/*@@caplFunc:CombinedNumbers_ListHandling():*///function
CombinedNumbers_ListHandling () //for sliding window concept, list handling and 'build-up' list...
{
    byte mode, shift, direction, transmitpos, indexsize, recordaddress, buffer_CallMode, buffer_day, buffer_month, buffer_year, buffer_hour, buffer_minute, buffer_second, buffer_ReceptionInfo;
    word requested_startelement, startelement, elements, buffer_Pos;
    char buffer_PbName[TEL_COMBINEDNUMBERS_PBNAME_LENGTH], buffer_TelNumber[TEL_COMBINEDNUMBERS_TELNUMBER_LENGTH];
    int i,j,k;
    
    // Init local variables. 
    mode                        =0;
    shift                       =0;
    direction                   =0;
    transmitpos                 =0;
    indexsize                   =0;
    recordaddress               =0;
    requested_startelement      =0;
    startelement                =0;
    elements                    =0;
    i                           =0;
    j                           =0;
    k                           =0;
    buffer_ReceptionInfo        =0;
    buffer_Pos                  =0;
    buffer_CallMode             =0;
    buffer_day                  =0;
    buffer_month                =0;
    buffer_year                 =0;
    buffer_hour                 =0;
    buffer_minute               =0;
    buffer_second               =0;
    
    /***build-up complete cache***/

    switch (gCombinedNumbers_ListHandlingType)
    {
        case TEL_COMBINEDNUMBERS_BUILDUPCACHE:
             
            switch (gCombinedNumbers_cacheBuildUp)
            {   
                //cache-up  -> not used in consecutive ID AND no endless list
                case TEL_COMBINEDNUMBERS_BUILDUPCACHECACHE_UP:  
                    if(gCombinedNumbers_CallBackReason !=TEL_COMBINEDNUMBERS_BUILDUPCACHENOCACHE && gCombinedNumbers_CallBackReason !=TEL_COMBINEDNUMBERS_CALLBACKREASON_CACHENEXT)
                    {
                        switch (gCombinedNumbers_CallBackReason)
                        {
                            case TEL_COMBINEDNUMBERS_CALLBACKREASON_CHECKCACHE:

                                    if(gCombinedNumbers_ListEntryReceptionInformation[2] ==TRUE) //cache-down required?
                                    {            
                                        gCombinedNumbers_cacheBuildUp      =TEL_COMBINEDNUMBERS_BUILDUPCACHECACHE_DOWN;      //next step: build-up upper cache
                                        gCombinedNumbers_CallBackReason    =TEL_COMBINEDNUMBERS_CALLBACKREASON_CACHENEXT;    
                                        
                                        
                                        CombinedNumbers_ListHandling ();
                                    }
                                    else //stop caching
                                    {   
                                        gCombinedNumbers_cacheBuildUp      =TEL_COMBINEDNUMBERS_BUILDUPCACHENOCACHE;  //"build-up cache" finished
                                        gCombinedNumbers_ListHandlingType  =TEL_COMBINEDNUMBERS_NOCACHE;              
                                        gCombinedNumbers_CallBackReason    =TEL_COMBINEDNUMBERS_CALLBACKREASON_NOCALLBACK; 
                                        gCombinedNumbers_CursorAction      =TEL_COMBINEDNUMBERS_CURSORACTION_NOTHING;
                                        
                                        putvalue(env_ASG_CN_ListOpState, empty_string);
                                        CombinedNumbers_display();
                                    }
                            break;
                        }
                    }
                    else
                    {   
                        shift               =TRUE;
                        direction           =BACKWARD;
                        transmitpos         =FALSE;
                        recordaddress       =0;
                        startelement        =0;
                        
                        if(startelement>0xFF)
                            indexsize =TRUE;
                        else
                            indexsize =FALSE;

                        elements            =3;
                
                        requested_startelement  =startelement;
                        mode                    =shift +(direction*0x02) +(transmitpos*0x04) +indexsize*0x08;

                        gCombinedNumbers_CallBackReason  =TEL_COMBINEDNUMBERS_CALLBACKREASON_CHECKCACHE;

                        CombinedNumbers_Request(DataGet_REQ, mode, recordaddress, requested_startelement, startelement, elements);
                    }
                break;
                
                //cache "window"
                case TEL_COMBINEDNUMBERS_BUILDUPCACHECACHE_WINDOW: 
                    if(gCombinedNumbers_CallBackReason !=TEL_COMBINEDNUMBERS_BUILDUPCACHENOCACHE && gCombinedNumbers_CallBackReason !=TEL_COMBINEDNUMBERS_CALLBACKREASON_CACHENEXT)
                    {   
                        switch (gCombinedNumbers_CallBackReason)
                        {
                            case TEL_COMBINEDNUMBERS_CALLBACKREASON_CHECKCACHE:
                                                 
                                    if(gCombinedNumbers_ListEntryReceptionInformation[0])
                                        gCombinedNumbers_FirstElement =gCombinedNumbers_Pos[0];
                                    
                                    //last element in display area?
                                    for(i=0;i<3;i++)
                                    {
                                        if(gCombinedNumbers_ListEntryReceptionInformation[i] !=1)
                                        {
                                            gCombinedNumbers_LastElement =gCombinedNumbers_Pos[i-1];
                                            i=3;
                                        }
                                    }
                                    
                                    if(gCombinedNumbers_ListEntryReceptionInformation[2] ==TRUE) //cache-down required?
                                    {            
                                        gCombinedNumbers_cacheBuildUp      =TEL_COMBINEDNUMBERS_BUILDUPCACHECACHE_DOWN;      //next step: build-up upper cache
                                        gCombinedNumbers_CallBackReason    =TEL_COMBINEDNUMBERS_CALLBACKREASON_CACHENEXT;    
                                        
                                        
                                        CombinedNumbers_ListHandling ();
                                    }
                                    else //stop caching
                                    {   
                                        gCombinedNumbers_cacheBuildUp      =TEL_COMBINEDNUMBERS_BUILDUPCACHENOCACHE;  //"build-up cache" finished
                                        gCombinedNumbers_ListHandlingType  =TEL_COMBINEDNUMBERS_NOCACHE;              
                                        gCombinedNumbers_CallBackReason    =TEL_COMBINEDNUMBERS_CALLBACKREASON_NOCALLBACK; 
                                        gCombinedNumbers_CursorAction      =TEL_COMBINEDNUMBERS_CURSORACTION_NOTHING;
                                        
                                        putvalue(env_ASG_CN_ListOpState, empty_string);
                                        CombinedNumbers_display();
                                    }
                                                                      
                            break;
                        }
                    }
                    else
                    { 
                        putvalue(env_ASG_CN_ListOpState, "build-up list...");
                        shift               =FALSE;
                        direction           =FORWARD;
                        transmitpos         =getvalue(env_ASG_CN_AH_PosTrans);
                        recordaddress       =0;
                        startelement        =0;
                        
                        if(startelement>0xFF)
                            indexsize =TRUE;
                        else
                            indexsize =FALSE;

                        elements            =3; 
    
                        requested_startelement  =startelement;
                        mode                    =shift +(direction*0x02) +(transmitpos*0x04) +indexsize*0x08;

                        gCombinedNumbers_CallBackReason  =TEL_COMBINEDNUMBERS_CALLBACKREASON_CHECKCACHE;

                        CombinedNumbers_Request(DataGet_REQ, mode, recordaddress, requested_startelement, startelement, elements);
                    }
                break;
                
                //cache-down
                case TEL_COMBINEDNUMBERS_BUILDUPCACHECACHE_DOWN:
                    if(gCombinedNumbers_CallBackReason !=TEL_COMBINEDNUMBERS_BUILDUPCACHENOCACHE && gCombinedNumbers_CallBackReason !=TEL_COMBINEDNUMBERS_CALLBACKREASON_CACHENEXT)
                    {
                        switch (gCombinedNumbers_CallBackReason)
                        {
                            case TEL_COMBINEDNUMBERS_CALLBACKREASON_CHECKCACHE:
                                    
                                    //stop caching
                                    gCombinedNumbers_cacheBuildUp      =TEL_COMBINEDNUMBERS_BUILDUPCACHENOCACHE;  //"build-up cache" finished
                                    gCombinedNumbers_ListHandlingType  =TEL_COMBINEDNUMBERS_NOCACHE;              
                                    gCombinedNumbers_CallBackReason    =TEL_COMBINEDNUMBERS_CALLBACKREASON_NOCALLBACK;
                                    gCombinedNumbers_CursorAction      =TEL_COMBINEDNUMBERS_CURSORACTION_NOTHING;
                                    
                                    gCombinedNumbers_DisplayStatus     =TEL_COMBINEDNUMBERS_DISPLAYLIST_REFRESH;
                                    
                                    putvalue(env_ASG_CN_ListOpState, empty_string);

                                    //last element in display area?
                                    for(i=3;i<6;i++)
                                    {
                                        if(gCombinedNumbers_ListEntryReceptionInformation[i] !=1)
                                        {
                                            gCombinedNumbers_LastElement =gCombinedNumbers_Pos[i-1];
                                            i=6;
                                        }
                                    }

                                    CombinedNumbers_display();
                            break;
                        }
                    }
                    else
                    { 
                        shift                   =TRUE;
                        direction               =FORWARD;
                        transmitpos             =getvalue(env_ASG_CN_AH_PosTrans);;
                        recordaddress           =0;
                        for(i=0;i<TEL_COMBINEDNUMBERS_ASGCACHE_MAX_SIZE; i++) //find last cached element
                        {   
                            if(gCombinedNumbers_ListEntryReceptionInformation[i] ==FALSE) //abort loop
                                i =TEL_COMBINEDNUMBERS_ASGCACHE_MAX_SIZE; 
                            else
                                startelement    =gCombinedNumbers_Pos[i];
                        }
                        
                        if(startelement>0xFF)
                            indexsize =TRUE;
                        else
                            indexsize =FALSE;
                            
                        elements                =3;                         
        
                        requested_startelement  =startelement;
                        mode                    =shift +(direction*0x02) +(transmitpos*0x04) +indexsize*0x08;

                        gCombinedNumbers_CallBackReason    =TEL_COMBINEDNUMBERS_CALLBACKREASON_CHECKCACHE;
                        
                        CombinedNumbers_Request(DataGet_REQ, mode, recordaddress, requested_startelement, startelement, elements);
                    }
                break;

                default:
                break;
            }//build-up cache finished
        break;
        
        /********sliding-window********/
        case TEL_COMBINEDNUMBERS_DOWN_CACHE: 
                    if (gCombinedNumbers_CallBackReason ==TEL_COMBINEDNUMBERS_CALLBACKREASON_CHECKCACHE) //check if valid data received
                    {   
                        if(gCombinedNumbers_ListEntryReceptionInformation[5] ==0) //No valid data in last list pos -> last list element reached, start with element 0!  
                        {    
                            gCombinedNumbers_LastElement            =gCombinedNumbers_Pos[4];
                            gCombinedNumbers_DownCaching_required   =FALSE;
                            gCombinedNumbers_CallBackReason         =TEL_COMBINEDNUMBERS_CALLBACKREASON_DISPLAYLIST;
                            
                            CombinedNumbers_ListHandling ();
                        }
                        else
                        {
                            gCombinedNumbers_CallBackReason =TEL_COMBINEDNUMBERS_CALLBACKREASON_DISPLAYLIST;
                            CombinedNumbers_ListHandling(); 
                        }
                        
                        //for cache up
                        if((gCombinedNumbers_ListEntryReceptionInformation[6] ==1) && (gCombinedNumbers_Pos[6] !=gCombinedNumbers_FirstElement))
                        {    gCombinedNumbers_UpCaching_required     =TRUE;
                            
                        }
                            
                    }
                    else if (gCombinedNumbers_CallBackReason ==TEL_COMBINEDNUMBERS_CALLBACKREASON_DISPLAYLIST)
                    {   
                        gCombinedNumbers_ListHandlingType  =TEL_COMBINEDNUMBERS_NOCACHE;
                        gCombinedNumbers_cacheDown         =FALSE;
                        gCombinedNumbers_DisplayStatus     =TEL_COMBINEDNUMBERS_DISPLAYLIST_FIRST_ELEMENTS;
                        
                        putvalue(env_ASG_CN_ListOpState, empty_string);
                        CombinedNumbers_display();

                        gCombinedNumbers_DisplayStatus     =TEL_COMBINEDNUMBERS_DISPLAYLIST_REFRESH;
                        gCombinedNumbers_CallBackReason    =TEL_COMBINEDNUMBERS_CALLBACKREASON_NOCALLBACK;
                    }
                    else
                    {   
                        putvalue(env_ASG_CN_ListOpState, "list operating...");
                                
                        shift                   =TRUE;
                        direction               =FORWARD;
                        transmitpos             =getvalue(env_ASG_CN_AH_PosTrans);;
                        recordaddress           =0;
                        
                        if(startelement>0xFF)
                            indexsize =TRUE;
                        else
                            indexsize =FALSE;

                        startelement            =gCombinedNumbers_Pos[5]; //last element
                        elements                =1;
                        
                        for(i=0;i<TEL_COMBINEDNUMBERS_ASGCACHE_MAX_SIZE;i++)
                        {   
                            j =i+1;
                            
                            switch (i)
                            {   
                                case 0: 
                                    //buffer data of Pos '0' (local)
                                    buffer_ReceptionInfo    =gCombinedNumbers_ListEntryReceptionInformation[i];
                                    buffer_Pos              =gCombinedNumbers_Pos[i];
                                    buffer_CallMode         =gCombinedNumbers_CallMode[i];
                                    buffer_day              =gCombinedNumbers_day[i];
                                    buffer_month            =gCombinedNumbers_month[i];
                                    buffer_year             =gCombinedNumbers_year[i];
                                    buffer_hour             =gCombinedNumbers_hour[i];
                                    buffer_minute           =gCombinedNumbers_minute[i];
                                    buffer_second           =gCombinedNumbers_second[i];

                                    for (k=0; k<TEL_COMBINEDNUMBERS_PBNAME_LENGTH;k++) //clear string
                                        buffer_PbName[k] =0;                                     

                                    for(k=0;k<strlen(gCombinedNumbers_PbName[i]);k++) 
                                        buffer_PbName[k]=gCombinedNumbers_PbName[i][k];
                                    
                                    for (k=0; k<TEL_COMBINEDNUMBERS_TELNUMBER_LENGTH;k++) //clear string
                                        buffer_TelNumber[k] =0;                                     

                                    for(k=0;k<strlen(gCombinedNumbers_TelNumber[i]);k++) 
                                        buffer_TelNumber[k]=gCombinedNumbers_TelNumber[i][k];
                                    

                                    //copy data from Pos '1' to Pos '0'
                                    gCombinedNumbers_Pos[i]             =gCombinedNumbers_Pos[j]; 
                                    gCombinedNumbers_CallMode[i]        =gCombinedNumbers_CallMode[j];
                                    gCombinedNumbers_day[i]             =gCombinedNumbers_day[j];
                                    gCombinedNumbers_month[i]           =gCombinedNumbers_month[j];
                                    gCombinedNumbers_year[i]            =gCombinedNumbers_year[j];
                                    gCombinedNumbers_hour[i]            =gCombinedNumbers_hour[j];
                                    gCombinedNumbers_minute[i]          =gCombinedNumbers_minute[j];
                                    gCombinedNumbers_second[i]          =gCombinedNumbers_second[j];
                                
                                    for (k=0; k<TEL_COMBINEDNUMBERS_PBNAME_LENGTH;k++) //clear string
                                        gCombinedNumbers_PbName[i][k] =0;                                     

                                    for(k=0;k<strlen(gCombinedNumbers_PbName[j]);k++) 
                                        gCombinedNumbers_PbName[i][k]=gCombinedNumbers_PbName[j][k];

                                    for (k=0; k<TEL_COMBINEDNUMBERS_TELNUMBER_LENGTH;k++) //clear string
                                        gCombinedNumbers_TelNumber[i][k] =0;                                     

                                    for(k=0;k<strlen(gCombinedNumbers_TelNumber[j]);k++) 
                                        gCombinedNumbers_TelNumber[i][k]=gCombinedNumbers_TelNumber[j][k];

                                break;
                            
                                case 5:
                                    //clear last element in list 
                                    gCombinedNumbers_ListEntryReceptionInformation[i]   =0;
                                    gCombinedNumbers_Pos[i]                             =0;
                                    gCombinedNumbers_CallMode[i]                        =0;
                                    gCombinedNumbers_day[i]                             =0;
                                    gCombinedNumbers_month[i]                           =0;
                                    gCombinedNumbers_year[i]                            =0;
                                    gCombinedNumbers_hour[i]                            =0;
                                    gCombinedNumbers_minute[i]                          =0;
                                    gCombinedNumbers_second[i]                          =0;

                                    for (k=0; k<TEL_COMBINEDNUMBERS_PBNAME_LENGTH;k++) //clear string
                                        gCombinedNumbers_PbName[i][k] =0;
                                    
                                    for (k=0; k<TEL_COMBINEDNUMBERS_TELNUMBER_LENGTH;k++) //clear string
                                        gCombinedNumbers_TelNumber[i][k] =0;
                                                                 
                                break;
                            
                                case 8: 
                                    //copy data from buffer in Pos '8'
                                    gCombinedNumbers_ListEntryReceptionInformation[i]   =buffer_ReceptionInfo;
                                    gCombinedNumbers_Pos[i]                             =buffer_Pos; 
                                    gCombinedNumbers_CallMode[i]                        =buffer_CallMode;
                                    gCombinedNumbers_day[i]                             =buffer_day;
                                    gCombinedNumbers_month[i]                           =buffer_month;
                                    gCombinedNumbers_year[i]                            =buffer_year;
                                    gCombinedNumbers_hour[i]                            =buffer_hour;
                                    gCombinedNumbers_minute[i]                          =buffer_minute;
                                    gCombinedNumbers_second[i]                          =buffer_second;

                                    for (k=0; k<TEL_COMBINEDNUMBERS_PBNAME_LENGTH;k++) //clear string
                                        gCombinedNumbers_PbName[i][k] =0; 
                                    
                                    for(k=0;k<strlen(buffer_PbName);k++) 
                                        gCombinedNumbers_PbName[i][k]=buffer_PbName[k];

                                    for (k=0; k<TEL_COMBINEDNUMBERS_TELNUMBER_LENGTH;k++) //clear string
                                        gCombinedNumbers_TelNumber[i][k] =0; 
                                    
                                    for(k=0;k<strlen(buffer_TelNumber);k++) 
                                        gCombinedNumbers_TelNumber[i][k]=buffer_TelNumber[k];
                                    
                                break;
                                
                                default://other elements
                                    //copy element on other position
                                    gCombinedNumbers_ListEntryReceptionInformation[i]   =gCombinedNumbers_ListEntryReceptionInformation[j];
                                    gCombinedNumbers_Pos[i]                             =gCombinedNumbers_Pos[j]; 
                                    gCombinedNumbers_CallMode[i]                        =gCombinedNumbers_CallMode[j];
                                    gCombinedNumbers_day[i]                             =gCombinedNumbers_day[j];
                                    gCombinedNumbers_month[i]                           =gCombinedNumbers_month[j];
                                    gCombinedNumbers_year[i]                            =gCombinedNumbers_year[j]; 
                                    gCombinedNumbers_hour[i]                            =gCombinedNumbers_hour[j];
                                    gCombinedNumbers_minute[i]                          =gCombinedNumbers_minute[j];
                                    gCombinedNumbers_second[i]                          =gCombinedNumbers_second[j];
                                    
                                    for (k=0; k<TEL_COMBINEDNUMBERS_PBNAME_LENGTH;k++) //clear string
                                        gCombinedNumbers_PbName[i][k] =0; 
                                    
                                    for(k=0;k<strlen(gCombinedNumbers_PbName[j]);k++) 
                                        gCombinedNumbers_PbName[i][k]=gCombinedNumbers_PbName[j][k];
                                        
                                    for (k=0; k<TEL_COMBINEDNUMBERS_TELNUMBER_LENGTH;k++) //clear string
                                        gCombinedNumbers_TelNumber[i][k] =0; 
                                    
                                    for(k=0;k<strlen(gCombinedNumbers_TelNumber[j]);k++) 
                                        gCombinedNumbers_TelNumber[i][k]=gCombinedNumbers_TelNumber[j][k];        
                                break;
                            } // end of switch 'i'
                        }
                        requested_startelement  =startelement;
                        mode                    =shift +(direction*0x02) +(transmitpos*0x04) +indexsize*0x08;

                        if(gCombinedNumbers_DownCaching_required)
                        {
                            CombinedNumbers_Request(DataGet_REQ, mode, recordaddress, requested_startelement, startelement, elements);                        
                        
                            //to check, if valid data received
                            gCombinedNumbers_CallBackReason    =TEL_COMBINEDNUMBERS_CALLBACKREASON_CHECKCACHE;
                        }
                        else
                        {
                            gCombinedNumbers_CallBackReason =TEL_COMBINEDNUMBERS_CALLBACKREASON_DISPLAYLIST;
                            CombinedNumbers_ListHandling(); 
                        }
                    }
        break;

        case TEL_COMBINEDNUMBERS_UP_CACHE: 
                    if (gCombinedNumbers_CallBackReason ==TEL_COMBINEDNUMBERS_CALLBACKREASON_CHECKCACHE) //check if valid data received
                    {   
                        if((gCombinedNumbers_ListEntryReceptionInformation[6] ==1) && (gCombinedNumbers_Pos[6] ==gCombinedNumbers_FirstElement)) //first element in list reached
                        {
                            gCombinedNumbers_UpCaching_required     =FALSE;
                            gCombinedNumbers_CallBackReason         =TEL_COMBINEDNUMBERS_CALLBACKREASON_DISPLAYLIST;
                            
                            CombinedNumbers_ListHandling ();
                        }
                        else if((gCombinedNumbers_ListEntryReceptionInformation[6] ==1) && (gCombinedNumbers_Pos[6] !=gCombinedNumbers_FirstElement))
                        {
                            gCombinedNumbers_UpCaching_required     =TRUE;
                            gCombinedNumbers_CallBackReason         =TEL_COMBINEDNUMBERS_CALLBACKREASON_DISPLAYLIST;
                            
                            CombinedNumbers_ListHandling ();
                        }
                        else
                        {   
                            gCombinedNumbers_CallBackReason =TEL_COMBINEDNUMBERS_CALLBACKREASON_DISPLAYLIST;
                            CombinedNumbers_ListHandling();
                        }
                        
                        //for cache down
                        if(gCombinedNumbers_ListEntryReceptionInformation[5] ==1)
                            gCombinedNumbers_DownCaching_required     =TRUE;
                                       
                    }

                    else if (gCombinedNumbers_CallBackReason ==TEL_COMBINEDNUMBERS_CALLBACKREASON_DISPLAYLIST)
                    {   
                        gCombinedNumbers_ListHandlingType  =TEL_COMBINEDNUMBERS_NOCACHE;
                        gCombinedNumbers_cacheUp           =FALSE;
                        gCombinedNumbers_DisplayStatus     =TEL_COMBINEDNUMBERS_DISPLAYLIST_FIRST_ELEMENTS;
                        
                        putvalue(env_ASG_CN_ListOpState, empty_string);
                        CombinedNumbers_display();
                        gCombinedNumbers_DisplayStatus     =TEL_COMBINEDNUMBERS_DISPLAYLIST_REFRESH;
                        gCombinedNumbers_CallBackReason    =TEL_COMBINEDNUMBERS_CALLBACKREASON_NOCALLBACK;
                    }

                    else
                    {           
                        putvalue(env_ASG_CN_ListOpState, "list operating...");

                        shift                   =TRUE;
                        direction               =BACKWARD;
                        transmitpos             =getvalue(env_ASG_CN_AH_PosTrans);;
                        recordaddress           =0;
                        startelement            =gCombinedNumbers_Pos[6]; //first element
                        
                        if(startelement>0xFF)
                            indexsize =TRUE;
                        else
                            indexsize =FALSE;

                        elements                =1;
                    
                        for(i=TEL_COMBINEDNUMBERS_ASGCACHE_MAX_SIZE-1;i>=0;i--)
                        {  
                            j =i-1;
                            switch (i)
                            {   
                                case 8: 
                                    //buffer data of Pos '8' (local)
                                    buffer_ReceptionInfo    =gCombinedNumbers_ListEntryReceptionInformation[i];
                                    buffer_Pos              =gCombinedNumbers_Pos[i];
                                    buffer_CallMode         =gCombinedNumbers_CallMode[i];
                                    buffer_day              =gCombinedNumbers_day[i];
                                    buffer_month            =gCombinedNumbers_month[i];
                                    buffer_year             =gCombinedNumbers_year[i];
                                    buffer_hour             =gCombinedNumbers_hour[i];
                                    buffer_minute           =gCombinedNumbers_minute[i];
                                    buffer_second           =gCombinedNumbers_second[i];                          

                                    for (k=0; k<TEL_COMBINEDNUMBERS_PBNAME_LENGTH;k++) //clear string
                                        buffer_PbName[k] =0;                                     

                                    for(k=0;k<strlen(gCombinedNumbers_PbName[i]);k++) 
                                        buffer_PbName[k]=gCombinedNumbers_PbName[i][k];

                                    for (k=0; k<TEL_COMBINEDNUMBERS_TELNUMBER_LENGTH;k++) //clear string
                                        buffer_TelNumber[k] =0;                                     

                                    for(k=0;k<strlen(gCombinedNumbers_TelNumber[i]);k++) 
                                        buffer_TelNumber[k]=gCombinedNumbers_TelNumber[i][k];

                                    
                                    //copy data from Pos '7' to Pos '8'
                                    gCombinedNumbers_ListEntryReceptionInformation[i]   =gCombinedNumbers_ListEntryReceptionInformation[j];
                                    gCombinedNumbers_Pos[i]                             =gCombinedNumbers_Pos[j]; 
                                    gCombinedNumbers_CallMode[i]                        =gCombinedNumbers_CallMode[j];
                                    gCombinedNumbers_day[i]                             =gCombinedNumbers_day[j];
                                    gCombinedNumbers_month[i]                           =gCombinedNumbers_month[j];
                                    gCombinedNumbers_year[i]                            =gCombinedNumbers_year[j];
                                    gCombinedNumbers_hour[i]                            =gCombinedNumbers_hour[j];
                                    gCombinedNumbers_minute[i]                          =gCombinedNumbers_minute[j];
                                    gCombinedNumbers_second[i]                          =gCombinedNumbers_second[j];

                                    for (k=0; k<TEL_COMBINEDNUMBERS_PBNAME_LENGTH;k++) //clear string
                                        gCombinedNumbers_PbName[i][k] =0; 
                                    
                                    for(k=0;k<strlen(gCombinedNumbers_PbName[j]);k++) 
                                        gCombinedNumbers_PbName[i][k]=gCombinedNumbers_PbName[j][k];
                                    
                                    for (k=0; k<TEL_COMBINEDNUMBERS_TELNUMBER_LENGTH;k++) //clear string
                                        gCombinedNumbers_TelNumber[i][k] =0; 
                                    
                                    for(k=0;k<strlen(gCombinedNumbers_TelNumber[j]);k++) 
                                        gCombinedNumbers_TelNumber[i][k]=gCombinedNumbers_TelNumber[j][k];     
                                break;
                            
                                case 6: 
                                    //clear first element in list 
                                    gCombinedNumbers_ListEntryReceptionInformation[i] =0;
                                    gCombinedNumbers_Pos[i]                           =0;
                                    gCombinedNumbers_CallMode[i]                      =0;
                                    gCombinedNumbers_day[i]                           =0;
                                    gCombinedNumbers_month[i]                         =0;
                                    gCombinedNumbers_year[i]                          =0;
                                    gCombinedNumbers_hour[i]                          =0;
                                    gCombinedNumbers_minute[i]                        =0;
                                    gCombinedNumbers_second[i]                        =0;
                            
                                    for (k=0; k<TEL_COMBINEDNUMBERS_PBNAME_LENGTH;k++) //clear string
                                        gCombinedNumbers_PbName[i][k] =0;
                                    
                                    for (k=0; k<TEL_COMBINEDNUMBERS_TELNUMBER_LENGTH;k++) //clear string
                                        gCombinedNumbers_TelNumber[i][k] =0;
                                                                            
                                break;
                            
                                case 0: 
                                    //copy data from buffer in Pos '0'
                                    gCombinedNumbers_ListEntryReceptionInformation[i]   =buffer_ReceptionInfo;
                                    gCombinedNumbers_Pos[i]                             =buffer_Pos; 
                                    gCombinedNumbers_CallMode[i]                        =buffer_CallMode;
                                    gCombinedNumbers_day[i]                             =buffer_day;
                                    gCombinedNumbers_month[i]                           =buffer_month;
                                    gCombinedNumbers_year[i]                            =buffer_year;
                                    gCombinedNumbers_hour[i]                            =buffer_hour;
                                    gCombinedNumbers_minute[i]                          =buffer_minute;
                                    gCombinedNumbers_second[i]                          =buffer_second;

                                    for (k=0; k<TEL_COMBINEDNUMBERS_PBNAME_LENGTH;k++) //clear string
                                        gCombinedNumbers_PbName[i][k] =0; 
                                    
                                    for(k=0;k<strlen(buffer_PbName);k++) 
                                        gCombinedNumbers_PbName[i][k]=buffer_PbName[k];

                                    for (k=0; k<TEL_COMBINEDNUMBERS_TELNUMBER_LENGTH;k++) //clear string
                                        gCombinedNumbers_TelNumber[i][k] =0; 
                                    
                                    for(k=0;k<strlen(buffer_TelNumber);k++) 
                                        gCombinedNumbers_TelNumber[i][k]=buffer_TelNumber[k];
                                break;
                                
                                default: //other elements
                                    //copy element on other position
                                    gCombinedNumbers_ListEntryReceptionInformation[i]   =gCombinedNumbers_ListEntryReceptionInformation[j];
                                    gCombinedNumbers_Pos[i]                             =gCombinedNumbers_Pos[j]; 
                                    gCombinedNumbers_CallMode[i]                        =gCombinedNumbers_CallMode[j];
                                    gCombinedNumbers_day[i]                             =gCombinedNumbers_day[j];
                                    gCombinedNumbers_month[i]                           =gCombinedNumbers_month[j];
                                    gCombinedNumbers_year[i]                            =gCombinedNumbers_year[j];
                                    gCombinedNumbers_hour[i]                            =gCombinedNumbers_hour[j];
                                    gCombinedNumbers_minute[i]                          =gCombinedNumbers_minute[j];
                                    gCombinedNumbers_second[i]                          =gCombinedNumbers_second[j];

                                    for (k=0; k<TEL_COMBINEDNUMBERS_PBNAME_LENGTH;k++) //clear string
                                        gCombinedNumbers_PbName[i][k] =0; 
                                    
                                    for(k=0;k<strlen(gCombinedNumbers_PbName[j]);k++) 
                                        gCombinedNumbers_PbName[i][k]=gCombinedNumbers_PbName[j][k];
                                    
                                    for (k=0; k<TEL_COMBINEDNUMBERS_TELNUMBER_LENGTH;k++) //clear string
                                        gCombinedNumbers_TelNumber[i][k] =0; 
                                    
                                    for(k=0;k<strlen(gCombinedNumbers_TelNumber[j]);k++) 
                                        gCombinedNumbers_TelNumber[i][k]=gCombinedNumbers_TelNumber[j][k];
                                    
                                break;
                            } // end of switch 'i'
                        }
                        requested_startelement  =startelement;
                        mode                    =shift +(direction*0x02) +(transmitpos*0x04) +indexsize*0x08;

                        if(gCombinedNumbers_UpCaching_required)
                        {
                            CombinedNumbers_Request(DataGet_REQ, mode, recordaddress, requested_startelement, startelement, elements);                        
                        
                            //to check, if valid data received
                            gCombinedNumbers_CallBackReason    =TEL_COMBINEDNUMBERS_CALLBACKREASON_CHECKCACHE;
                        }
                        else
                        {
                            gCombinedNumbers_CallBackReason =TEL_COMBINEDNUMBERS_CALLBACKREASON_CHECKCACHE;
                            CombinedNumbers_ListHandling(); 
                        }
                    }
        break;

        default:
        break;
    } //end of switch 'type of cache handling' 
}
/*@@end*/

/*@@envVar:env_ASG_DN_EditDispCache:*/
on envVar env_ASG_DN_EditDispCache
{
    if(gRNS_PowerOnOff==Power_on && getvalue(this))
    {    
        OpenPanel("ASG_Telephone_0x30 - DialedNumbers_EditCache");
        
        DialedNumbers_DisplayCache();
    }
}
/*@@end*/

/*@@envVar:env_ASG_DN_GetArray:*/
on envVar env_ASG_DN_GetArray
{
    byte mode, shift, direction, transmitpos, indexsize,recordaddress;
    word requested_startelement, startelement, elements;

    // Init local variables. 
    mode                    =0;
    shift                   =0;
    direction               =0;
    transmitpos             =0;
    indexsize               =0;
    recordaddress           =0;
    requested_startelement  =0;
    startelement            =0;
    elements                =0;

    if(gRNS_PowerOnOff==Power_on && getvalue(this) && gDialedNumbers_ListHandlingType ==TEL_DIALEDNUMBERS_NOCACHE)
	{
        gDialedNumbers_ASGID            =getvalue(env_ASG_DN_ASGID);
        gDialedNumbers_TAID             =getvalue(env_ASG_DN_TAID);

        shift                           =getvalue(env_ASG_DN_AH_shift);
        direction                       =getvalue(env_ASG_DN_AH_dir);
        transmitpos                     =getvalue(env_ASG_DN_AH_PosTrans);
        indexsize                       =getvalue(env_ASG_DN_AH_IS);
        recordaddress                   =getvalue(env_ASG_DN_AH_RA);
        startelement                    =getvalue(env_ASG_DN_AH_start);
        elements                        =getvalue(env_ASG_DN_AH_elements);
        
        requested_startelement  =startelement;
        mode                    =shift +(direction*0x02) +(transmitpos*0x04) +indexsize*0x08;

        DialedNumbers_Request(DataGet_REQ, mode, recordaddress, requested_startelement, startelement, elements);
    }
}
/*@@end*/

/*@@envVar:env_ASG_DN_GetCachedData:*/
on envVar env_ASG_DN_GetCachedData
{
    if(gRNS_PowerOnOff==Power_on && getvalue(this))
        DialedNumbers_DisplayCache();
        
}
/*@@end*/

/*@@envVar:env_ASG_DN_OnOff:*/
on envVar env_ASG_DN_OnOff
{
    int i =0, j =0;
    if(gRNS_PowerOnOff==Power_on)
	{   
        if(getvalue(this))
        {
            gDialedNumbers_ListHandlingType      =TEL_DIALEDNUMBERS_BUILDUPCACHE;             //build-up complete cache...
            gDialedNumbers_cacheBuildUp          =TEL_DIALEDNUMBERS_BUILDUPCACHECACHE_WINDOW; //...and start with area "window"            
            gDialedNumbers_UpCaching_required    =TRUE;
            gDialedNumbers_DownCaching_required  =TRUE;
            gDialedNumbers_MoveList_down_allowed =TRUE;
            gDialedNumbers_MoveList_up_allowed   =FALSE; 

            DialedNumbers_ListHandling ();

        }
        else
        {
            gDialedNumbers_SlidingWindow_State   =TEL_DIALEDNUMBERS_SLIDINGWINDOW_NOTACTIVE;
            gDialedNumbers_ListHandlingType      =TEL_DIALEDNUMBERS_NOCACHE;
            gDialedNumbers_cacheBuildUp          =TEL_DIALEDNUMBERS_BUILDUPCACHENOCACHE;
            gDialedNumbers_CallBackReason        =TEL_DIALEDNUMBERS_CALLBACKREASON_NOCALLBACK;

            gDialedNumbers_cacheDown             =FALSE;
            gDialedNumbers_cacheUp               =FALSE;
            gDialedNumbers_LastFirstElement      =0;

            gDialedNumbers_recordaddress         =0;
            gDialedNumbers_transmitpos           =1;
            gDialedNumbers_CursorAction          =TEL_DIALEDNUMBERS_CURSORACTION_NOTHING;
            gDialedNumbers_DisplayStatus         =TEL_DIALEDNUMBERS_DISPLAYLIST_FIRST_ELEMENTS;
            
            gDialedNumbers_LastElement           =0;
            gDialedNumbers_FirstElement          =0;
            gDialedNumbers_DownCaching_required  =FALSE;
            gDialedNumbers_UpCaching_required    =FALSE; 
            gDialedNumbers_MoveList_down_allowed =FALSE; 
            gDialedNumbers_MoveList_up_allowed   =FALSE;

            for(j=0; j<TEL_DIALEDNUMBERS_ASGCACHE_MAX_SIZE; j++)
            {     
                gDialedNumbers_Pos[j]                 =0;
                gDialedNumbers_NumberType[j]            =0;
                gDialedNumbers_day[j]                 =0;
                gDialedNumbers_month[j]               =0;
                gDialedNumbers_year[j]                =0;
                gDialedNumbers_hour[j]                =0;
                gDialedNumbers_minute[j]              =0;
                gDialedNumbers_second[j]              =0;
                
                gDialedNumbers_ListEntryReceptionInformation[j]  =0;

                for(i=0;i<TEL_DIALEDNUMBERS_PBNAME_LENGTH;i++)
			        gDialedNumbers_PbName[j][i] =0;
                
                for(i=0;i<TEL_DIALEDNUMBERS_TELNUMBER_LENGTH;i++)
			        gDialedNumbers_TelNumber[j][i] =0;
            }
            putvalue(env_ASG_DN_pos_0, 0);
            putvalue(env_ASG_DN_pos_1, 0);
            putvalue(env_ASG_DN_pos_2, 0);
    
            putvalue(env_ASG_DN_NumType_0, 0);
            putvalue(env_ASG_DN_NumType_1, 0);
            putvalue(env_ASG_DN_NumType_2, 0);

            putvalue(env_ASG_DN_NumType_s_0,empty_string);
            putvalue(env_ASG_DN_NumType_s_1,empty_string);
            putvalue(env_ASG_DN_NumType_s_2,empty_string);

            putvalue(env_ASG_DN_PbName_s_0, empty_string);
            putvalue(env_ASG_DN_PbName_s_1, empty_string);
            putvalue(env_ASG_DN_PbName_s_2, empty_string);

            putvalue(env_ASG_DN_TelNum_s_0, empty_string);
            putvalue(env_ASG_DN_TelNum_s_1, empty_string);
            putvalue(env_ASG_DN_TelNum_s_2, empty_string);

            putvalue(env_ASG_DN_day_0, 0);
            putvalue(env_ASG_DN_day_1, 0);
            putvalue(env_ASG_DN_day_2, 0);

            putvalue(env_ASG_DN_month_0, 0);
            putvalue(env_ASG_DN_month_1, 0);
            putvalue(env_ASG_DN_month_2, 0);

            putvalue(env_ASG_DN_year_0, 0);
            putvalue(env_ASG_DN_year_1, 0);
            putvalue(env_ASG_DN_year_2, 0);

            putvalue(env_ASG_DN_hour_0, 0);
            putvalue(env_ASG_DN_hour_1, 0);
            putvalue(env_ASG_DN_hour_2, 0);

            putvalue(env_ASG_DN_minute_0, 0);
            putvalue(env_ASG_DN_minute_1, 0);
            putvalue(env_ASG_DN_minute_2, 0);

            putvalue(env_ASG_DN_second_0, 0);
            putvalue(env_ASG_DN_second_1, 0);
            putvalue(env_ASG_DN_second_2, 0);
            
            
            putvalue(env_ASG_DN_pos_01, 0);
            putvalue(env_ASG_DN_PbName_s_01, empty_string);
            putvalue(env_ASG_DN_TelNum_s_01, empty_string);
            putvalue(env_ASG_DN_NumType_01, 0);
            putvalue(env_ASG_DN_day_01, 0);
            putvalue(env_ASG_DN_month_01, 0);
            putvalue(env_ASG_DN_year_01, 0);
            putvalue(env_ASG_DN_hour_01, 0);
            putvalue(env_ASG_DN_minute_01, 0);
            putvalue(env_ASG_DN_second_01, 0);

            enableControl("ASG_Telephone_0x31 - DialedNumbers_EditCache", "env_ASG_DN_pos_01", 0);
            enableControl("ASG_Telephone_0x31 - DialedNumbers_EditCache", "env_ASG_DN_PbName_s_01", 0);
            enableControl("ASG_Telephone_0x31 - DialedNumbers_EditCache", "env_ASG_DN_TelNum_s_01", 0);
            enableControl("ASG_Telephone_0x31 - DialedNumbers_EditCache", "env_ASG_DN_NumType_01", 0);
            enableControl("ASG_Telephone_0x31 - DialedNumbers_EditCache", "env_ASG_DN_day_01", 0);
            enableControl("ASG_Telephone_0x31 - DialedNumbers_EditCache", "env_ASG_DN_month_01", 0);
            enableControl("ASG_Telephone_0x31 - DialedNumbers_EditCache", "env_ASG_DN_year_01", 0);
            enableControl("ASG_Telephone_0x31 - DialedNumbers_EditCache", "env_ASG_DN_hour_01", 0);
            enableControl("ASG_Telephone_0x31 - DialedNumbers_EditCache", "env_ASG_DN_minute_01", 0);
            enableControl("ASG_Telephone_0x31 - DialedNumbers_EditCache", "env_ASG_DN_second_01", 0);
        
            
            putvalue(env_ASG_DN_pos_02, 0);
            putvalue(env_ASG_DN_PbName_s_02, empty_string);
            putvalue(env_ASG_DN_TelNum_s_02, empty_string);
            putvalue(env_ASG_DN_NumType_02, 0);
            putvalue(env_ASG_DN_day_02, 0);
            putvalue(env_ASG_DN_month_02, 0);
            putvalue(env_ASG_DN_year_02, 0);
            putvalue(env_ASG_DN_hour_02, 0);
            putvalue(env_ASG_DN_minute_02, 0);
            putvalue(env_ASG_DN_second_02, 0);

            enableControl("ASG_Telephone_0x31 - DialedNumbers_EditCache", "env_ASG_DN_pos_02", 0);
            enableControl("ASG_Telephone_0x31 - DialedNumbers_EditCache", "env_ASG_DN_PbName_s_02", 0);
            enableControl("ASG_Telephone_0x31 - DialedNumbers_EditCache", "env_ASG_DN_TelNum_s_02", 0);
            enableControl("ASG_Telephone_0x31 - DialedNumbers_EditCache", "env_ASG_DN_NumType_02", 0);
            enableControl("ASG_Telephone_0x31 - DialedNumbers_EditCache", "env_ASG_DN_day_02", 0);
            enableControl("ASG_Telephone_0x31 - DialedNumbers_EditCache", "env_ASG_DN_month_02", 0);
            enableControl("ASG_Telephone_0x31 - DialedNumbers_EditCache", "env_ASG_DN_year_02", 0);
            enableControl("ASG_Telephone_0x31 - DialedNumbers_EditCache", "env_ASG_DN_hour_02", 0);
            enableControl("ASG_Telephone_0x31 - DialedNumbers_EditCache", "env_ASG_DN_minute_02", 0);
            enableControl("ASG_Telephone_0x31 - DialedNumbers_EditCache", "env_ASG_DN_second_02", 0);
        

            putvalue(env_ASG_DN_pos_03, 0);
            putvalue(env_ASG_DN_PbName_s_03, empty_string);
            putvalue(env_ASG_DN_TelNum_s_03, empty_string);
            putvalue(env_ASG_DN_NumType_03, 0);
            putvalue(env_ASG_DN_day_03, 0);
            putvalue(env_ASG_DN_month_03, 0);
            putvalue(env_ASG_DN_year_03, 0);
            putvalue(env_ASG_DN_hour_03, 0);
            putvalue(env_ASG_DN_minute_03, 0);
            putvalue(env_ASG_DN_second_03, 0);

            enableControl("ASG_Telephone_0x31 - DialedNumbers_EditCache", "env_ASG_DN_pos_03", 0);
            enableControl("ASG_Telephone_0x31 - DialedNumbers_EditCache", "env_ASG_DN_PbName_s_03", 0);
            enableControl("ASG_Telephone_0x31 - DialedNumbers_EditCache", "env_ASG_DN_TelNum_s_03", 0);
            enableControl("ASG_Telephone_0x31 - DialedNumbers_EditCache", "env_ASG_DN_NumType_03", 0);
            enableControl("ASG_Telephone_0x31 - DialedNumbers_EditCache", "env_ASG_DN_day_03", 0);
            enableControl("ASG_Telephone_0x31 - DialedNumbers_EditCache", "env_ASG_DN_month_03", 0);
            enableControl("ASG_Telephone_0x31 - DialedNumbers_EditCache", "env_ASG_DN_year_03", 0);
            enableControl("ASG_Telephone_0x31 - DialedNumbers_EditCache", "env_ASG_DN_hour_03", 0);
            enableControl("ASG_Telephone_0x31 - DialedNumbers_EditCache", "env_ASG_DN_minute_03", 0);
            enableControl("ASG_Telephone_0x31 - DialedNumbers_EditCache", "env_ASG_DN_second_03", 0);
        

            putvalue(env_ASG_DN_pos_11, 0);
            putvalue(env_ASG_DN_PbName_s_11, empty_string);
            putvalue(env_ASG_DN_TelNum_s_11, empty_string);
            putvalue(env_ASG_DN_NumType_11, 0);
            putvalue(env_ASG_DN_day_11, 0);
            putvalue(env_ASG_DN_month_11, 0);
            putvalue(env_ASG_DN_year_11, 0);
            putvalue(env_ASG_DN_hour_11, 0);
            putvalue(env_ASG_DN_minute_11, 0);
            putvalue(env_ASG_DN_second_11, 0);

            enableControl("ASG_Telephone_0x31 - DialedNumbers_EditCache", "env_ASG_DN_pos_11", 0);
            enableControl("ASG_Telephone_0x31 - DialedNumbers_EditCache", "env_ASG_DN_PbName_s_11", 0);
            enableControl("ASG_Telephone_0x31 - DialedNumbers_EditCache", "env_ASG_DN_TelNum_s_11", 0);
            enableControl("ASG_Telephone_0x31 - DialedNumbers_EditCache", "env_ASG_DN_NumType_11", 0);
            enableControl("ASG_Telephone_0x31 - DialedNumbers_EditCache", "env_ASG_DN_day_11", 0);
            enableControl("ASG_Telephone_0x31 - DialedNumbers_EditCache", "env_ASG_DN_month_11", 0);
            enableControl("ASG_Telephone_0x31 - DialedNumbers_EditCache", "env_ASG_DN_year_11", 0);
            enableControl("ASG_Telephone_0x31 - DialedNumbers_EditCache", "env_ASG_DN_hour_11", 0);
            enableControl("ASG_Telephone_0x31 - DialedNumbers_EditCache", "env_ASG_DN_minute_11", 0);
            enableControl("ASG_Telephone_0x31 - DialedNumbers_EditCache", "env_ASG_DN_second_11", 0);
   
            
            putvalue(env_ASG_DN_pos_12, 0);
            putvalue(env_ASG_DN_PbName_s_12, empty_string);
            putvalue(env_ASG_DN_TelNum_s_12, empty_string);
            putvalue(env_ASG_DN_NumType_12, 0);
            putvalue(env_ASG_DN_day_12, 0);
            putvalue(env_ASG_DN_month_12, 0);
            putvalue(env_ASG_DN_year_12, 0);
            putvalue(env_ASG_DN_hour_12, 0);
            putvalue(env_ASG_DN_minute_12, 0);
            putvalue(env_ASG_DN_second_12, 0);

            enableControl("ASG_Telephone_0x31 - DialedNumbers_EditCache", "env_ASG_DN_pos_12", 0);
            enableControl("ASG_Telephone_0x31 - DialedNumbers_EditCache", "env_ASG_DN_PbName_s_12", 0);
            enableControl("ASG_Telephone_0x31 - DialedNumbers_EditCache", "env_ASG_DN_TelNum_s_12", 0);
            enableControl("ASG_Telephone_0x31 - DialedNumbers_EditCache", "env_ASG_DN_NumType_12", 0);
            enableControl("ASG_Telephone_0x31 - DialedNumbers_EditCache", "env_ASG_DN_day_12", 0);
            enableControl("ASG_Telephone_0x31 - DialedNumbers_EditCache", "env_ASG_DN_month_12", 0);
            enableControl("ASG_Telephone_0x31 - DialedNumbers_EditCache", "env_ASG_DN_year_12", 0);
            enableControl("ASG_Telephone_0x31 - DialedNumbers_EditCache", "env_ASG_DN_hour_12", 0);
            enableControl("ASG_Telephone_0x31 - DialedNumbers_EditCache", "env_ASG_DN_minute_12", 0);
            enableControl("ASG_Telephone_0x31 - DialedNumbers_EditCache", "env_ASG_DN_second_12", 0);


            putvalue(env_ASG_DN_pos_13, 0);
            putvalue(env_ASG_DN_PbName_s_13, empty_string);
            putvalue(env_ASG_DN_TelNum_s_13, empty_string);
            putvalue(env_ASG_DN_NumType_13, 0);
            putvalue(env_ASG_DN_day_13, 0);
            putvalue(env_ASG_DN_month_13, 0);
            putvalue(env_ASG_DN_year_13, 0);
            putvalue(env_ASG_DN_hour_13, 0);
            putvalue(env_ASG_DN_minute_13, 0);
            putvalue(env_ASG_DN_second_13, 0);

            
            enableControl("ASG_Telephone_0x31 - DialedNumbers_EditCache", "env_ASG_DN_pos_13", 0);
            enableControl("ASG_Telephone_0x31 - DialedNumbers_EditCache", "env_ASG_DN_PbName_s_13", 0);
            enableControl("ASG_Telephone_0x31 - DialedNumbers_EditCache", "env_ASG_DN_TelNum_s_13", 0);
            enableControl("ASG_Telephone_0x31 - DialedNumbers_EditCache", "env_ASG_DN_NumType_13", 0);
            enableControl("ASG_Telephone_0x31 - DialedNumbers_EditCache", "env_ASG_DN_day_13", 0);
            enableControl("ASG_Telephone_0x31 - DialedNumbers_EditCache", "env_ASG_DN_month_13", 0);
            enableControl("ASG_Telephone_0x31 - DialedNumbers_EditCache", "env_ASG_DN_year_13", 0);
            enableControl("ASG_Telephone_0x31 - DialedNumbers_EditCache", "env_ASG_DN_hour_13", 0);
            enableControl("ASG_Telephone_0x31 - DialedNumbers_EditCache", "env_ASG_DN_minute_13", 0);
            enableControl("ASG_Telephone_0x31 - DialedNumbers_EditCache", "env_ASG_DN_second_13", 0);

            putvalue(env_ASG_DN_pos_21, 0);
            putvalue(env_ASG_DN_PbName_s_21, empty_string);
            putvalue(env_ASG_DN_TelNum_s_21, empty_string);
            putvalue(env_ASG_DN_NumType_21, 0);
            putvalue(env_ASG_DN_day_21, 0);
            putvalue(env_ASG_DN_month_21, 0);
            putvalue(env_ASG_DN_year_21, 0);
            putvalue(env_ASG_DN_hour_21, 0);
            putvalue(env_ASG_DN_minute_21, 0);
            putvalue(env_ASG_DN_second_21, 0);

            enableControl("ASG_Telephone_0x31 - DialedNumbers_EditCache", "env_ASG_DN_pos_21", 0);
            enableControl("ASG_Telephone_0x31 - DialedNumbers_EditCache", "env_ASG_DN_PbName_s_21", 0);
            enableControl("ASG_Telephone_0x31 - DialedNumbers_EditCache", "env_ASG_DN_TelNum_s_21", 0);
            enableControl("ASG_Telephone_0x31 - DialedNumbers_EditCache", "env_ASG_DN_NumType_21", 0);
            enableControl("ASG_Telephone_0x31 - DialedNumbers_EditCache", "env_ASG_DN_day_21", 0);
            enableControl("ASG_Telephone_0x31 - DialedNumbers_EditCache", "env_ASG_DN_month_21", 0);
            enableControl("ASG_Telephone_0x31 - DialedNumbers_EditCache", "env_ASG_DN_year_21", 0);
            enableControl("ASG_Telephone_0x31 - DialedNumbers_EditCache", "env_ASG_DN_hour_21", 0);
            enableControl("ASG_Telephone_0x31 - DialedNumbers_EditCache", "env_ASG_DN_minute_21", 0);
            enableControl("ASG_Telephone_0x31 - DialedNumbers_EditCache", "env_ASG_DN_second_21", 0);

            putvalue(env_ASG_DN_pos_22, 0);
            putvalue(env_ASG_DN_PbName_s_22, empty_string);
            putvalue(env_ASG_DN_TelNum_s_22, empty_string);
            putvalue(env_ASG_DN_NumType_22, 0);
            putvalue(env_ASG_DN_day_22, 0);
            putvalue(env_ASG_DN_month_22, 0);
            putvalue(env_ASG_DN_year_22, 0);
            putvalue(env_ASG_DN_hour_22, 0);
            putvalue(env_ASG_DN_minute_22, 0);
            putvalue(env_ASG_DN_second_22, 0);

            enableControl("ASG_Telephone_0x31 - DialedNumbers_EditCache", "env_ASG_DN_pos_22", 0);
            enableControl("ASG_Telephone_0x31 - DialedNumbers_EditCache", "env_ASG_DN_PbName_s_22", 0);
            enableControl("ASG_Telephone_0x31 - DialedNumbers_EditCache", "env_ASG_DN_TelNum_s_22", 0);
            enableControl("ASG_Telephone_0x31 - DialedNumbers_EditCache", "env_ASG_DN_NumType_22", 0);
            enableControl("ASG_Telephone_0x31 - DialedNumbers_EditCache", "env_ASG_DN_day_22", 0);
            enableControl("ASG_Telephone_0x31 - DialedNumbers_EditCache", "env_ASG_DN_month_22", 0);
            enableControl("ASG_Telephone_0x31 - DialedNumbers_EditCache", "env_ASG_DN_year_22", 0);
            enableControl("ASG_Telephone_0x31 - DialedNumbers_EditCache", "env_ASG_DN_hour_22", 0);
            enableControl("ASG_Telephone_0x31 - DialedNumbers_EditCache", "env_ASG_DN_minute_22", 0);
            enableControl("ASG_Telephone_0x31 - DialedNumbers_EditCache", "env_ASG_DN_second_22", 0);
       
            putvalue(env_ASG_DN_pos_23, 0);
            putvalue(env_ASG_DN_PbName_s_23, empty_string);
            putvalue(env_ASG_DN_TelNum_s_23, empty_string);
            putvalue(env_ASG_DN_NumType_23, 0);
            putvalue(env_ASG_DN_day_23, 0);
            putvalue(env_ASG_DN_month_23, 0);
            putvalue(env_ASG_DN_year_23, 0);
            putvalue(env_ASG_DN_hour_23, 0);
            putvalue(env_ASG_DN_minute_23, 0);
            putvalue(env_ASG_DN_second_23, 0);

            enableControl("ASG_Telephone_0x31 - DialedNumbers_EditCache", "env_ASG_DN_pos_23", 0);
            enableControl("ASG_Telephone_0x31 - DialedNumbers_EditCache", "env_ASG_DN_PbName_s_23", 0);
            enableControl("ASG_Telephone_0x31 - DialedNumbers_EditCache", "env_ASG_DN_TelNum_s_23", 0);
            enableControl("ASG_Telephone_0x31 - DialedNumbers_EditCache", "env_ASG_DN_NumType_23", 0);
            enableControl("ASG_Telephone_0x31 - DialedNumbers_EditCache", "env_ASG_DN_day_23", 0);
            enableControl("ASG_Telephone_0x31 - DialedNumbers_EditCache", "env_ASG_DN_month_23", 0);
            enableControl("ASG_Telephone_0x31 - DialedNumbers_EditCache", "env_ASG_DN_year_23", 0);
            enableControl("ASG_Telephone_0x31 - DialedNumbers_EditCache", "env_ASG_DN_hour_23", 0);
            enableControl("ASG_Telephone_0x31 - DialedNumbers_EditCache", "env_ASG_DN_minute_23", 0);
            enableControl("ASG_Telephone_0x31 - DialedNumbers_EditCache", "env_ASG_DN_second_23", 0);

            putvalue(env_ASG_DN_ListInfo_up,empty_string);
            putvalue(env_ASG_DN_ListInfo_down,empty_string);
            putvalue(env_ASG_DN_ListInfo_Cursor,empty_string);

            ClosePanel("ASG_Telephone_0x31 - DialedNumbers_EditCache");          
        }
    }
}   
/*@@end*/

/*@@envVar:env_ASG_DN_SetGetArray:*/
on envVar env_ASG_DN_SetGetArray
{
    byte mode, shift, direction, transmitpos, indexsize,recordaddress;
    word requested_startelement, startelement, elements;

    // Init local variables. 
    mode                    =0;
    shift                   =0;
    direction               =0;
    transmitpos             =0;
    indexsize               =0;
    recordaddress           =0;
    requested_startelement  =0;
    startelement            =0;
    elements                =0;

    //write("# env_ASG_DN_SetGetArray");

    if(gRNS_PowerOnOff==Power_on && getvalue(this) && gDialedNumbers_ListHandlingType ==TEL_DIALEDNUMBERS_NOCACHE)
	{
        //write("# ----------");
        gDialedNumbers_ASGID            =getvalue(env_ASG_DN_ASGID);
        gDialedNumbers_TAID             =getvalue(env_ASG_DN_TAID);

        shift                           =getvalue(env_ASG_DN_AH_shift);
        direction                       =getvalue(env_ASG_DN_AH_dir);
        transmitpos                     =getvalue(env_ASG_DN_AH_PosTrans);
        indexsize                       =getvalue(env_ASG_DN_AH_IS);
        recordaddress                   =getvalue(env_ASG_DN_AH_RA);
        startelement                    =getvalue(env_ASG_DN_AH_start);
        elements                        =getvalue(env_ASG_DN_AH_elements);
        
        requested_startelement  =startelement;
        mode                    =(shift +(direction*0x02) +(transmitpos*0x04) +(indexsize*0x08));

        DialedNumbers_Request(DataSetGet_REQ, mode, recordaddress, requested_startelement, startelement, elements);
    }
}
/*@@end*/

/*@@envVar:env_ASG_DN_TakeOver:*/
on envVar env_ASG_DN_TakeOver
{
    if(gRNS_PowerOnOff==Power_on && getvalue(this))
	{
        //upper cache
        if(gDialedNumbers_ListEntryReceptionInformation[6])
        {
            gDialedNumbers_Pos[6]         =getvalue(env_ASG_DN_pos_01);
            getvalue(env_ASG_DN_PbName_s_01, gDialedNumbers_PbName[6]);
            getvalue(env_ASG_DN_TelNum_s_01, gDialedNumbers_TelNumber[6]);
            gDialedNumbers_NumberType[6]    =getvalue(env_ASG_DN_NumType_01);
            gDialedNumbers_day[6]         =getvalue(env_ASG_DN_day_01);
            gDialedNumbers_month[6]       =getvalue(env_ASG_DN_month_01);
            gDialedNumbers_year[6]        =getvalue(env_ASG_DN_year_01);
            gDialedNumbers_hour[6]        =getvalue(env_ASG_DN_hour_01);
            gDialedNumbers_minute[6]      =getvalue(env_ASG_DN_minute_01);
            gDialedNumbers_second[6]      =getvalue(env_ASG_DN_second_01);
        }

        else
        {
            putvalue(env_ASG_DN_pos_01, 0);
            putvalue(env_ASG_DN_PbName_s_01, empty_string);
            putvalue(env_ASG_DN_TelNum_s_01, empty_string);
            putvalue(env_ASG_DN_NumType_01, 0);
            putvalue(env_ASG_DN_day_01, 0);
            putvalue(env_ASG_DN_month_01, 0);
            putvalue(env_ASG_DN_year_01, 0);
            putvalue(env_ASG_DN_hour_01, 0);
            putvalue(env_ASG_DN_minute_01, 0);
            putvalue(env_ASG_DN_second_01, 0);
        }


        if(gDialedNumbers_ListEntryReceptionInformation[7])
        {
            gDialedNumbers_Pos[7]         =getvalue(env_ASG_DN_pos_02);
            getvalue(env_ASG_DN_PbName_s_02, gDialedNumbers_PbName[7]);
            getvalue(env_ASG_DN_TelNum_s_02, gDialedNumbers_TelNumber[7]);
            gDialedNumbers_NumberType[7]    =getvalue(env_ASG_DN_NumType_02);
            gDialedNumbers_day[7]         =getvalue(env_ASG_DN_day_02);
            gDialedNumbers_month[7]       =getvalue(env_ASG_DN_month_02);
            gDialedNumbers_year[7]        =getvalue(env_ASG_DN_year_02);
            gDialedNumbers_hour[7]        =getvalue(env_ASG_DN_hour_02);
            gDialedNumbers_minute[7]      =getvalue(env_ASG_DN_minute_02);
            gDialedNumbers_second[7]      =getvalue(env_ASG_DN_second_02);
        }

        else
        {
            putvalue(env_ASG_DN_pos_02, 0);
            putvalue(env_ASG_DN_PbName_s_02, empty_string);
            putvalue(env_ASG_DN_TelNum_s_02, empty_string);
            putvalue(env_ASG_DN_NumType_02, 0);
            putvalue(env_ASG_DN_day_02, 0);
            putvalue(env_ASG_DN_month_02, 0);
            putvalue(env_ASG_DN_year_02, 0);
            putvalue(env_ASG_DN_hour_02, 0);
            putvalue(env_ASG_DN_minute_02, 0);
            putvalue(env_ASG_DN_second_02, 0);
        }


        if(gDialedNumbers_ListEntryReceptionInformation[8])
        {
            gDialedNumbers_Pos[8]         =getvalue(env_ASG_DN_pos_03);
            getvalue(env_ASG_DN_PbName_s_03, gDialedNumbers_PbName[8]);
            getvalue(env_ASG_DN_TelNum_s_03, gDialedNumbers_TelNumber[8]);
            gDialedNumbers_NumberType[8]    =getvalue(env_ASG_DN_NumType_03);
            gDialedNumbers_day[8]         =getvalue(env_ASG_DN_day_03);
            gDialedNumbers_month[8]       =getvalue(env_ASG_DN_month_03);
            gDialedNumbers_year[8]        =getvalue(env_ASG_DN_year_03);
            gDialedNumbers_hour[8]        =getvalue(env_ASG_DN_hour_03);
            gDialedNumbers_minute[8]      =getvalue(env_ASG_DN_minute_03);
            gDialedNumbers_second[8]      =getvalue(env_ASG_DN_second_03);
        }

        else
        {
            putvalue(env_ASG_DN_pos_03, 0);
            putvalue(env_ASG_DN_PbName_s_03, empty_string);
            putvalue(env_ASG_DN_TelNum_s_03, empty_string);
            putvalue(env_ASG_DN_NumType_03, 0);
            putvalue(env_ASG_DN_day_03, 0);
            putvalue(env_ASG_DN_month_03, 0);
            putvalue(env_ASG_DN_year_03, 0);
            putvalue(env_ASG_DN_hour_03, 0);
            putvalue(env_ASG_DN_minute_03, 0);
            putvalue(env_ASG_DN_second_03, 0);
        }

        
        //display area
        if(gDialedNumbers_ListEntryReceptionInformation[0])
        {
            gDialedNumbers_Pos[0]         =getvalue(env_ASG_DN_pos_11);
            getvalue(env_ASG_DN_PbName_s_11, gDialedNumbers_PbName[0]);
            getvalue(env_ASG_DN_TelNum_s_11, gDialedNumbers_TelNumber[0]);
            gDialedNumbers_NumberType[0]    =getvalue(env_ASG_DN_NumType_11);
            gDialedNumbers_day[0]         =getvalue(env_ASG_DN_day_11);
            gDialedNumbers_month[0]       =getvalue(env_ASG_DN_month_11);
            gDialedNumbers_year[0]        =getvalue(env_ASG_DN_year_11);
            gDialedNumbers_hour[0]        =getvalue(env_ASG_DN_hour_11);
            gDialedNumbers_minute[0]      =getvalue(env_ASG_DN_minute_11);
            gDialedNumbers_second[0]      =getvalue(env_ASG_DN_second_11);
        }

        else
        {
            putvalue(env_ASG_DN_pos_11, 0);
            putvalue(env_ASG_DN_PbName_s_11, empty_string);
            putvalue(env_ASG_DN_TelNum_s_11, empty_string);
            putvalue(env_ASG_DN_NumType_11, 0);
            putvalue(env_ASG_DN_day_11, 0);
            putvalue(env_ASG_DN_month_11, 0);
            putvalue(env_ASG_DN_year_11, 0);
            putvalue(env_ASG_DN_hour_11, 0);
            putvalue(env_ASG_DN_minute_11, 0);
            putvalue(env_ASG_DN_second_11, 0);
        }


        if(gDialedNumbers_ListEntryReceptionInformation[1])
        {
            gDialedNumbers_Pos[1]         =getvalue(env_ASG_DN_pos_12);
            getvalue(env_ASG_DN_PbName_s_12, gDialedNumbers_PbName[1]);
            getvalue(env_ASG_DN_TelNum_s_12, gDialedNumbers_TelNumber[1]);
            gDialedNumbers_NumberType[1]    =getvalue(env_ASG_DN_NumType_12);
            gDialedNumbers_day[1]         =getvalue(env_ASG_DN_day_12);
            gDialedNumbers_month[1]       =getvalue(env_ASG_DN_month_12);
            gDialedNumbers_year[1]        =getvalue(env_ASG_DN_year_12);
            gDialedNumbers_hour[1]        =getvalue(env_ASG_DN_hour_12);
            gDialedNumbers_minute[1]      =getvalue(env_ASG_DN_minute_12);
            gDialedNumbers_second[1]      =getvalue(env_ASG_DN_second_12);
        }

        else
        {
            putvalue(env_ASG_DN_pos_12, 0);
            putvalue(env_ASG_DN_PbName_s_12, empty_string);
            putvalue(env_ASG_DN_TelNum_s_12, empty_string);
            putvalue(env_ASG_DN_NumType_12, 0);
            putvalue(env_ASG_DN_day_12, 0);
            putvalue(env_ASG_DN_month_12, 0);
            putvalue(env_ASG_DN_year_12, 0);
            putvalue(env_ASG_DN_hour_12, 0);
            putvalue(env_ASG_DN_minute_12, 0);
            putvalue(env_ASG_DN_second_12, 0);
        }


        if(gDialedNumbers_ListEntryReceptionInformation[2])
        {
            gDialedNumbers_Pos[2]         =getvalue(env_ASG_DN_pos_13);
            getvalue(env_ASG_DN_PbName_s_13, gDialedNumbers_PbName[2]);
            getvalue(env_ASG_DN_TelNum_s_13, gDialedNumbers_TelNumber[2]);
            gDialedNumbers_NumberType[2]    =getvalue(env_ASG_DN_NumType_13);
            gDialedNumbers_day[2]         =getvalue(env_ASG_DN_day_13);
            gDialedNumbers_month[2]       =getvalue(env_ASG_DN_month_13);
            gDialedNumbers_year[2]        =getvalue(env_ASG_DN_year_13);
            gDialedNumbers_hour[2]        =getvalue(env_ASG_DN_hour_13);
            gDialedNumbers_minute[2]      =getvalue(env_ASG_DN_minute_13);
            gDialedNumbers_second[2]      =getvalue(env_ASG_DN_second_13);
        }

        else
        {
            putvalue(env_ASG_DN_pos_13, 0);
            putvalue(env_ASG_DN_PbName_s_13, empty_string);
            putvalue(env_ASG_DN_TelNum_s_13, empty_string);
            putvalue(env_ASG_DN_NumType_13, 0);
            putvalue(env_ASG_DN_day_13, 0);
            putvalue(env_ASG_DN_month_13, 0);
            putvalue(env_ASG_DN_year_13, 0);
            putvalue(env_ASG_DN_hour_13, 0);
            putvalue(env_ASG_DN_minute_13, 0);
            putvalue(env_ASG_DN_second_13, 0);
        }

        
        //lower cache
        if(gDialedNumbers_ListEntryReceptionInformation[3])
        {
            gDialedNumbers_Pos[3]         =getvalue(env_ASG_DN_pos_21);
            getvalue(env_ASG_DN_PbName_s_21, gDialedNumbers_PbName[3]);
            getvalue(env_ASG_DN_TelNum_s_21, gDialedNumbers_TelNumber[3]);
            gDialedNumbers_NumberType[3]    =getvalue(env_ASG_DN_NumType_21);
            gDialedNumbers_day[3]         =getvalue(env_ASG_DN_day_21);
            gDialedNumbers_month[3]       =getvalue(env_ASG_DN_month_21);
            gDialedNumbers_year[3]        =getvalue(env_ASG_DN_year_21);
            gDialedNumbers_hour[3]        =getvalue(env_ASG_DN_hour_21);
            gDialedNumbers_minute[3]      =getvalue(env_ASG_DN_minute_21);
            gDialedNumbers_second[3]      =getvalue(env_ASG_DN_second_21);
        }

        else
        {
            putvalue(env_ASG_DN_pos_21, 0);
            putvalue(env_ASG_DN_PbName_s_21, empty_string);
            putvalue(env_ASG_DN_TelNum_s_21, empty_string);
            putvalue(env_ASG_DN_NumType_21, 0);
            putvalue(env_ASG_DN_day_21, 0);
            putvalue(env_ASG_DN_month_21, 0);
            putvalue(env_ASG_DN_year_21, 0);
            putvalue(env_ASG_DN_hour_21, 0);
            putvalue(env_ASG_DN_minute_21, 0);
            putvalue(env_ASG_DN_second_21, 0);
        }


        if(gDialedNumbers_ListEntryReceptionInformation[4])
        {
            gDialedNumbers_Pos[4]         =getvalue(env_ASG_DN_pos_22);
            getvalue(env_ASG_DN_PbName_s_22, gDialedNumbers_PbName[4]);
            getvalue(env_ASG_DN_TelNum_s_22, gDialedNumbers_TelNumber[4]);
            gDialedNumbers_NumberType[4]    =getvalue(env_ASG_DN_NumType_22);
            gDialedNumbers_day[4]         =getvalue(env_ASG_DN_day_22);
            gDialedNumbers_month[4]       =getvalue(env_ASG_DN_month_22);
            gDialedNumbers_year[4]        =getvalue(env_ASG_DN_year_22);
            gDialedNumbers_hour[4]        =getvalue(env_ASG_DN_hour_22);
            gDialedNumbers_minute[4]      =getvalue(env_ASG_DN_minute_22);
            gDialedNumbers_second[4]      =getvalue(env_ASG_DN_second_22);
        }

        else
        {
            putvalue(env_ASG_DN_pos_22, 0);
            putvalue(env_ASG_DN_PbName_s_22, empty_string);
            putvalue(env_ASG_DN_TelNum_s_22, empty_string);
            putvalue(env_ASG_DN_NumType_22, 0);
            putvalue(env_ASG_DN_day_22, 0);
            putvalue(env_ASG_DN_month_22, 0);
            putvalue(env_ASG_DN_year_22, 0);
            putvalue(env_ASG_DN_hour_22, 0);
            putvalue(env_ASG_DN_minute_22, 0);
            putvalue(env_ASG_DN_second_22, 0);
        }


        if(gDialedNumbers_ListEntryReceptionInformation[5])
        {
            gDialedNumbers_Pos[5]         =getvalue(env_ASG_DN_pos_23);
            getvalue(env_ASG_DN_PbName_s_23, gDialedNumbers_PbName[5]);
            getvalue(env_ASG_DN_TelNum_s_23, gDialedNumbers_TelNumber[5]);
            gDialedNumbers_NumberType[5]    =getvalue(env_ASG_DN_NumType_23);
            gDialedNumbers_day[5]         =getvalue(env_ASG_DN_day_23);
            gDialedNumbers_month[5]       =getvalue(env_ASG_DN_month_23);
            gDialedNumbers_year[5]        =getvalue(env_ASG_DN_year_23);
            gDialedNumbers_hour[5]        =getvalue(env_ASG_DN_hour_23);
            gDialedNumbers_minute[5]      =getvalue(env_ASG_DN_minute_23);
            gDialedNumbers_second[5]      =getvalue(env_ASG_DN_second_23);
        }

        else
        {
            putvalue(env_ASG_DN_pos_23, 0);
            putvalue(env_ASG_DN_PbName_s_23, empty_string);
            putvalue(env_ASG_DN_TelNum_s_23, empty_string);
            putvalue(env_ASG_DN_NumType_23, 0);
            putvalue(env_ASG_DN_day_23, 0);
            putvalue(env_ASG_DN_month_23, 0);
            putvalue(env_ASG_DN_year_23, 0);
            putvalue(env_ASG_DN_hour_23, 0);
            putvalue(env_ASG_DN_minute_23, 0);
            putvalue(env_ASG_DN_second_23, 0);
        }

        DialedNumbers_display();
    }
}
/*@@end*/

/*@@envVar:env_ASG_DN_down:*/
on envVar env_ASG_DN_down
{
    int i=0, j=0;

    if(gRNS_PowerOnOff==Power_on && getvalue(this) && gDialedNumbers_ListHandlingType ==TEL_DIALEDNUMBERS_NOCACHE)
	{      
        gDialedNumbers_CursorAction =TEL_DIALEDNUMBERS_CURSORACTION_DOWN;
        
        if(gDialedNumbers_SlidingWindow_State ==TEL_DIALEDNUMBERS_SLIDINGWINDOW_ACTIVE && gDialedNumbers_MoveList_down_allowed)
        {   
            gDialedNumbers_ListHandlingType  =TEL_DIALEDNUMBERS_DOWN_CACHE;
            gDialedNumbers_DisplayStatus     =TEL_DIALEDNUMBERS_DISPLAYLIST_FIRST_ELEMENTS;
            gDialedNumbers_CursorAction      =TEL_DIALEDNUMBERS_CURSORACTION_NOTHING;
            
            DialedNumbers_ListHandling ();
        }
        else if(gDialedNumbers_SlidingWindow_State ==TEL_DIALEDNUMBERS_SLIDINGWINDOW_NOTACTIVE && gDialedNumbers_MoveList_down_allowed)
        {
            gDialedNumbers_DisplayStatus     =TEL_DIALEDNUMBERS_DISPLAYLIST_SEARCH_ELEMENTS;
            gDialedNumbers_CursorAction      =TEL_DIALEDNUMBERS_CURSORACTION_DOWN;

            DialedNumbers_display();

            //reset values
            gDialedNumbers_DisplayStatus     =TEL_DIALEDNUMBERS_DISPLAYLIST_REFRESH;
            gDialedNumbers_CursorAction      =TEL_DIALEDNUMBERS_CURSORACTION_NOTHING;
        }
    }
}
/*@@end*/

/*@@envVar:env_ASG_DN_up:*/
on envVar env_ASG_DN_up
{
    int i=0, j=0;

    if(gRNS_PowerOnOff==Power_on && getvalue(this) && gDialedNumbers_ListHandlingType ==TEL_DIALEDNUMBERS_NOCACHE)
	{   
        gDialedNumbers_CursorAction =TEL_DIALEDNUMBERS_CURSORACTION_UP;

        if(gDialedNumbers_SlidingWindow_State ==TEL_DIALEDNUMBERS_SLIDINGWINDOW_ACTIVE && gDialedNumbers_MoveList_up_allowed)
        {  
            gDialedNumbers_ListHandlingType  =TEL_DIALEDNUMBERS_UP_CACHE;
            gDialedNumbers_DisplayStatus     =TEL_DIALEDNUMBERS_DISPLAYLIST_FIRST_ELEMENTS;
            gDialedNumbers_CursorAction      =TEL_DIALEDNUMBERS_CURSORACTION_NOTHING;
            
            DialedNumbers_ListHandling ();
        }
        else if(gDialedNumbers_SlidingWindow_State ==TEL_DIALEDNUMBERS_SLIDINGWINDOW_NOTACTIVE && gDialedNumbers_MoveList_up_allowed)
        {
            gDialedNumbers_DisplayStatus     =TEL_DIALEDNUMBERS_DISPLAYLIST_SEARCH_ELEMENTS;
            gDialedNumbers_CursorAction      =TEL_DIALEDNUMBERS_CURSORACTION_UP;

            DialedNumbers_ListHandling();
            
            DialedNumbers_display();

            //reset values
            gDialedNumbers_DisplayStatus     =TEL_DIALEDNUMBERS_DISPLAYLIST_REFRESH;
            gDialedNumbers_CursorAction      =TEL_DIALEDNUMBERS_CURSORACTION_NOTHING;
        }    
    }
}
/*@@end*/

/*@@caplFunc:DialedNumbers_DisplayCache():*///function
DialedNumbers_DisplayCache ()
{
    //upper cache
        if(gDialedNumbers_ListEntryReceptionInformation[6])
        {
            putvalue(env_ASG_DN_pos_01, gDialedNumbers_Pos[6]);
            putvalue(env_ASG_DN_PbName_s_01, gDialedNumbers_PbName[6]);
            putvalue(env_ASG_DN_TelNum_s_01, gDialedNumbers_TelNumber[6]);
            putvalue(env_ASG_DN_NumType_01, gDialedNumbers_NumberType[6]);
            putvalue(env_ASG_DN_day_01, gDialedNumbers_day[6]);
            putvalue(env_ASG_DN_month_01, gDialedNumbers_month[6]);
            putvalue(env_ASG_DN_year_01, gDialedNumbers_year[6]);
            putvalue(env_ASG_DN_hour_01, gDialedNumbers_hour[6]);
            putvalue(env_ASG_DN_minute_01, gDialedNumbers_minute[6]);
            putvalue(env_ASG_DN_second_01, gDialedNumbers_second[6]);

            enableControl("ASG_Telephone_0x30 - DialedNumbers_EditCache", "env_ASG_DN_pos_01", 1);
            enableControl("ASG_Telephone_0x30 - DialedNumbers_EditCache", "env_ASG_DN_PbName_s_01", 1);
            enableControl("ASG_Telephone_0x30 - DialedNumbers_EditCache", "env_ASG_DN_TelNum_s_01", 1);
            enableControl("ASG_Telephone_0x30 - DialedNumbers_EditCache", "env_ASG_DN_NumType_01", 1);
            enableControl("ASG_Telephone_0x30 - DialedNumbers_EditCache", "env_ASG_DN_day_01", 1);
            enableControl("ASG_Telephone_0x30 - DialedNumbers_EditCache", "env_ASG_DN_month_01", 1);
            enableControl("ASG_Telephone_0x30 - DialedNumbers_EditCache", "env_ASG_DN_year_01", 1);
            enableControl("ASG_Telephone_0x30 - DialedNumbers_EditCache", "env_ASG_DN_hour_01", 1);
            enableControl("ASG_Telephone_0x30 - DialedNumbers_EditCache", "env_ASG_DN_minute_01", 1);
            enableControl("ASG_Telephone_0x30 - DialedNumbers_EditCache", "env_ASG_DN_second_01", 1);
        }

        else
        {
            putvalue(env_ASG_DN_pos_01, 0);
            putvalue(env_ASG_DN_PbName_s_01, empty_string);
            putvalue(env_ASG_DN_TelNum_s_01, empty_string);
            putvalue(env_ASG_DN_NumType_01, 0);
            putvalue(env_ASG_DN_day_01, 0);
            putvalue(env_ASG_DN_month_01, 0);
            putvalue(env_ASG_DN_year_01, 0);
            putvalue(env_ASG_DN_hour_01, 0);
            putvalue(env_ASG_DN_minute_01, 0);
            putvalue(env_ASG_DN_second_01, 0);

            enableControl("ASG_Telephone_0x30 - DialedNumbers_EditCache", "env_ASG_DN_pos_01", 0);
            enableControl("ASG_Telephone_0x30 - DialedNumbers_EditCache", "env_ASG_DN_PbName_s_01", 0);
            enableControl("ASG_Telephone_0x30 - DialedNumbers_EditCache", "env_ASG_DN_TelNum_s_01", 0);
            enableControl("ASG_Telephone_0x30 - DialedNumbers_EditCache", "env_ASG_DN_NumType_01", 0);
            enableControl("ASG_Telephone_0x30 - DialedNumbers_EditCache", "env_ASG_DN_day_01", 0);
            enableControl("ASG_Telephone_0x30 - DialedNumbers_EditCache", "env_ASG_DN_month_01", 0);
            enableControl("ASG_Telephone_0x30 - DialedNumbers_EditCache", "env_ASG_DN_year_01", 0);
            enableControl("ASG_Telephone_0x30 - DialedNumbers_EditCache", "env_ASG_DN_hour_01", 0);
            enableControl("ASG_Telephone_0x30 - DialedNumbers_EditCache", "env_ASG_DN_minute_01", 0);
            enableControl("ASG_Telephone_0x30 - DialedNumbers_EditCache", "env_ASG_DN_second_01", 0);
        }


        if(gDialedNumbers_ListEntryReceptionInformation[7])
        {
            putvalue(env_ASG_DN_pos_02, gDialedNumbers_Pos[7]);
            putvalue(env_ASG_DN_PbName_s_02, gDialedNumbers_PbName[7]);
            putvalue(env_ASG_DN_TelNum_s_02, gDialedNumbers_TelNumber[7]);
            putvalue(env_ASG_DN_NumType_02, gDialedNumbers_NumberType[7]);
            putvalue(env_ASG_DN_day_02, gDialedNumbers_day[7]);
            putvalue(env_ASG_DN_month_02, gDialedNumbers_month[7]);
            putvalue(env_ASG_DN_year_02, gDialedNumbers_year[7]);
            putvalue(env_ASG_DN_hour_02, gDialedNumbers_hour[7]);
            putvalue(env_ASG_DN_minute_02, gDialedNumbers_minute[7]);
            putvalue(env_ASG_DN_second_02, gDialedNumbers_second[7]);

            enableControl("ASG_Telephone_0x30 - DialedNumbers_EditCache", "env_ASG_DN_pos_02", 1);
            enableControl("ASG_Telephone_0x30 - DialedNumbers_EditCache", "env_ASG_DN_PbName_s_02", 1);
            enableControl("ASG_Telephone_0x30 - DialedNumbers_EditCache", "env_ASG_DN_TelNum_s_02", 1);
            enableControl("ASG_Telephone_0x30 - DialedNumbers_EditCache", "env_ASG_DN_NumType_02", 1);
            enableControl("ASG_Telephone_0x30 - DialedNumbers_EditCache", "env_ASG_DN_day_02", 1);
            enableControl("ASG_Telephone_0x30 - DialedNumbers_EditCache", "env_ASG_DN_month_02", 1);
            enableControl("ASG_Telephone_0x30 - DialedNumbers_EditCache", "env_ASG_DN_year_02", 1);
            enableControl("ASG_Telephone_0x30 - DialedNumbers_EditCache", "env_ASG_DN_hour_02", 1);
            enableControl("ASG_Telephone_0x30 - DialedNumbers_EditCache", "env_ASG_DN_minute_02", 1);
            enableControl("ASG_Telephone_0x30 - DialedNumbers_EditCache", "env_ASG_DN_second_02", 1);
        }

        else
        {
            putvalue(env_ASG_DN_pos_02, 0);
            putvalue(env_ASG_DN_PbName_s_02, empty_string);
            putvalue(env_ASG_DN_TelNum_s_02, empty_string);
            putvalue(env_ASG_DN_NumType_02, 0);
            putvalue(env_ASG_DN_day_02, 0);
            putvalue(env_ASG_DN_month_02, 0);
            putvalue(env_ASG_DN_year_02, 0);
            putvalue(env_ASG_DN_hour_02, 0);
            putvalue(env_ASG_DN_minute_02, 0);
            putvalue(env_ASG_DN_second_02, 0);

            enableControl("ASG_Telephone_0x30 - DialedNumbers_EditCache", "env_ASG_DN_pos_02", 0);
            enableControl("ASG_Telephone_0x30 - DialedNumbers_EditCache", "env_ASG_DN_PbName_s_02", 0);
            enableControl("ASG_Telephone_0x30 - DialedNumbers_EditCache", "env_ASG_DN_TelNum_s_02", 0);
            enableControl("ASG_Telephone_0x30 - DialedNumbers_EditCache", "env_ASG_DN_NumType_02", 0);
            enableControl("ASG_Telephone_0x30 - DialedNumbers_EditCache", "env_ASG_DN_day_02", 0);
            enableControl("ASG_Telephone_0x30 - DialedNumbers_EditCache", "env_ASG_DN_month_02", 0);
            enableControl("ASG_Telephone_0x30 - DialedNumbers_EditCache", "env_ASG_DN_year_02", 0);
            enableControl("ASG_Telephone_0x30 - DialedNumbers_EditCache", "env_ASG_DN_hour_02", 0);
            enableControl("ASG_Telephone_0x30 - DialedNumbers_EditCache", "env_ASG_DN_minute_02", 0);
            enableControl("ASG_Telephone_0x30 - DialedNumbers_EditCache", "env_ASG_DN_second_02", 0);
        }


        if(gDialedNumbers_ListEntryReceptionInformation[8])
        {
            putvalue(env_ASG_DN_pos_03, gDialedNumbers_Pos[8]);
            putvalue(env_ASG_DN_PbName_s_03, gDialedNumbers_PbName[8]);
            putvalue(env_ASG_DN_TelNum_s_03, gDialedNumbers_TelNumber[8]);
            putvalue(env_ASG_DN_NumType_03, gDialedNumbers_NumberType[8]);
            putvalue(env_ASG_DN_day_03, gDialedNumbers_day[8]);
            putvalue(env_ASG_DN_month_03, gDialedNumbers_month[8]);
            putvalue(env_ASG_DN_year_03, gDialedNumbers_year[8]);
            putvalue(env_ASG_DN_hour_03, gDialedNumbers_hour[8]);
            putvalue(env_ASG_DN_minute_03, gDialedNumbers_minute[8]);
            putvalue(env_ASG_DN_second_03, gDialedNumbers_second[8]);

            enableControl("ASG_Telephone_0x30 - DialedNumbers_EditCache", "env_ASG_DN_pos_03", 1);
            enableControl("ASG_Telephone_0x30 - DialedNumbers_EditCache", "env_ASG_DN_PbName_s_03", 1);
            enableControl("ASG_Telephone_0x30 - DialedNumbers_EditCache", "env_ASG_DN_TelNum_s_03", 1);
            enableControl("ASG_Telephone_0x30 - DialedNumbers_EditCache", "env_ASG_DN_NumType_03", 1);
            enableControl("ASG_Telephone_0x30 - DialedNumbers_EditCache", "env_ASG_DN_day_03", 1);
            enableControl("ASG_Telephone_0x30 - DialedNumbers_EditCache", "env_ASG_DN_month_03", 1);
            enableControl("ASG_Telephone_0x30 - DialedNumbers_EditCache", "env_ASG_DN_year_03", 1);
            enableControl("ASG_Telephone_0x30 - DialedNumbers_EditCache", "env_ASG_DN_hour_03", 1);
            enableControl("ASG_Telephone_0x30 - DialedNumbers_EditCache", "env_ASG_DN_minute_03", 1);
            enableControl("ASG_Telephone_0x30 - DialedNumbers_EditCache", "env_ASG_DN_second_03", 1);
        }

        else
        {
            putvalue(env_ASG_DN_pos_03, 0);
            putvalue(env_ASG_DN_PbName_s_03, empty_string);
            putvalue(env_ASG_DN_TelNum_s_03, empty_string);
            putvalue(env_ASG_DN_NumType_03, 0);
            putvalue(env_ASG_DN_day_03, 0);
            putvalue(env_ASG_DN_month_03, 0);
            putvalue(env_ASG_DN_year_03, 0);
            putvalue(env_ASG_DN_hour_03, 0);
            putvalue(env_ASG_DN_minute_03, 0);
            putvalue(env_ASG_DN_second_03, 0);

            enableControl("ASG_Telephone_0x30 - DialedNumbers_EditCache", "env_ASG_DN_pos_03", 0);
            enableControl("ASG_Telephone_0x30 - DialedNumbers_EditCache", "env_ASG_DN_PbName_s_03", 0);
            enableControl("ASG_Telephone_0x30 - DialedNumbers_EditCache", "env_ASG_DN_TelNum_s_03", 0);
            enableControl("ASG_Telephone_0x30 - DialedNumbers_EditCache", "env_ASG_DN_NumType_03", 0);
            enableControl("ASG_Telephone_0x30 - DialedNumbers_EditCache", "env_ASG_DN_day_03", 0);
            enableControl("ASG_Telephone_0x30 - DialedNumbers_EditCache", "env_ASG_DN_month_03", 0);
            enableControl("ASG_Telephone_0x30 - DialedNumbers_EditCache", "env_ASG_DN_year_03", 0);
            enableControl("ASG_Telephone_0x30 - DialedNumbers_EditCache", "env_ASG_DN_hour_03", 0);
            enableControl("ASG_Telephone_0x30 - DialedNumbers_EditCache", "env_ASG_DN_minute_03", 0);
            enableControl("ASG_Telephone_0x30 - DialedNumbers_EditCache", "env_ASG_DN_second_03", 0);
        }

        
        //display area
        if(gDialedNumbers_ListEntryReceptionInformation[0])
        {
            putvalue(env_ASG_DN_pos_11, gDialedNumbers_Pos[0]);
            putvalue(env_ASG_DN_PbName_s_11, gDialedNumbers_PbName[0]);
            putvalue(env_ASG_DN_TelNum_s_11, gDialedNumbers_TelNumber[0]);
            putvalue(env_ASG_DN_NumType_11, gDialedNumbers_NumberType[0]);
            putvalue(env_ASG_DN_day_11, gDialedNumbers_day[0]);
            putvalue(env_ASG_DN_month_11, gDialedNumbers_month[0]);
            putvalue(env_ASG_DN_year_11, gDialedNumbers_year[0]);
            putvalue(env_ASG_DN_hour_11, gDialedNumbers_hour[0]);
            putvalue(env_ASG_DN_minute_11, gDialedNumbers_minute[0]);
            putvalue(env_ASG_DN_second_11, gDialedNumbers_second[0]);

            enableControl("ASG_Telephone_0x30 - DialedNumbers_EditCache", "env_ASG_DN_pos_11", 1);
            enableControl("ASG_Telephone_0x30 - DialedNumbers_EditCache", "env_ASG_DN_PbName_s_11", 1);
            enableControl("ASG_Telephone_0x30 - DialedNumbers_EditCache", "env_ASG_DN_TelNum_s_11", 1);
            enableControl("ASG_Telephone_0x30 - DialedNumbers_EditCache", "env_ASG_DN_NumType_11", 1);
            enableControl("ASG_Telephone_0x30 - DialedNumbers_EditCache", "env_ASG_DN_day_11", 1);
            enableControl("ASG_Telephone_0x30 - DialedNumbers_EditCache", "env_ASG_DN_month_11", 1);
            enableControl("ASG_Telephone_0x30 - DialedNumbers_EditCache", "env_ASG_DN_year_11", 1);
            enableControl("ASG_Telephone_0x30 - DialedNumbers_EditCache", "env_ASG_DN_hour_11", 1);
            enableControl("ASG_Telephone_0x30 - DialedNumbers_EditCache", "env_ASG_DN_minute_11", 1);
            enableControl("ASG_Telephone_0x30 - DialedNumbers_EditCache", "env_ASG_DN_second_11", 1);
        }

        else
        {
            putvalue(env_ASG_DN_pos_11, 0);
            putvalue(env_ASG_DN_PbName_s_11, empty_string);
            putvalue(env_ASG_DN_TelNum_s_11, empty_string);
            putvalue(env_ASG_DN_NumType_11, 0);
            putvalue(env_ASG_DN_day_11, 0);
            putvalue(env_ASG_DN_month_11, 0);
            putvalue(env_ASG_DN_year_11, 0);
            putvalue(env_ASG_DN_hour_11, 0);
            putvalue(env_ASG_DN_minute_11, 0);
            putvalue(env_ASG_DN_second_11, 0);

            enableControl("ASG_Telephone_0x30 - DialedNumbers_EditCache", "env_ASG_DN_pos_11", 0);
            enableControl("ASG_Telephone_0x30 - DialedNumbers_EditCache", "env_ASG_DN_PbName_s_11", 0);
            enableControl("ASG_Telephone_0x30 - DialedNumbers_EditCache", "env_ASG_DN_TelNum_s_11", 0);
            enableControl("ASG_Telephone_0x30 - DialedNumbers_EditCache", "env_ASG_DN_NumType_11", 0);
            enableControl("ASG_Telephone_0x30 - DialedNumbers_EditCache", "env_ASG_DN_day_11", 0);
            enableControl("ASG_Telephone_0x30 - DialedNumbers_EditCache", "env_ASG_DN_month_11", 0);
            enableControl("ASG_Telephone_0x30 - DialedNumbers_EditCache", "env_ASG_DN_year_11", 0);
            enableControl("ASG_Telephone_0x30 - DialedNumbers_EditCache", "env_ASG_DN_hour_11", 0);
            enableControl("ASG_Telephone_0x30 - DialedNumbers_EditCache", "env_ASG_DN_minute_11", 0);
            enableControl("ASG_Telephone_0x30 - DialedNumbers_EditCache", "env_ASG_DN_second_11", 0);
        }


        if(gDialedNumbers_ListEntryReceptionInformation[1])
        {
            putvalue(env_ASG_DN_pos_12, gDialedNumbers_Pos[1]);
            putvalue(env_ASG_DN_PbName_s_12, gDialedNumbers_PbName[1]);
            putvalue(env_ASG_DN_TelNum_s_12, gDialedNumbers_TelNumber[1]);
            putvalue(env_ASG_DN_NumType_12, gDialedNumbers_NumberType[1]);
            putvalue(env_ASG_DN_day_12, gDialedNumbers_day[1]);
            putvalue(env_ASG_DN_month_12, gDialedNumbers_month[1]);
            putvalue(env_ASG_DN_year_12, gDialedNumbers_year[1]);
            putvalue(env_ASG_DN_hour_12, gDialedNumbers_hour[1]);
            putvalue(env_ASG_DN_minute_12, gDialedNumbers_minute[1]);
            putvalue(env_ASG_DN_second_12, gDialedNumbers_second[1]);

            enableControl("ASG_Telephone_0x30 - DialedNumbers_EditCache", "env_ASG_DN_pos_12", 1);
            enableControl("ASG_Telephone_0x30 - DialedNumbers_EditCache", "env_ASG_DN_PbName_s_12", 1);
            enableControl("ASG_Telephone_0x30 - DialedNumbers_EditCache", "env_ASG_DN_TelNum_s_12", 1);
            enableControl("ASG_Telephone_0x30 - DialedNumbers_EditCache", "env_ASG_DN_NumType_12", 1);
            enableControl("ASG_Telephone_0x30 - DialedNumbers_EditCache", "env_ASG_DN_day_12", 1);
            enableControl("ASG_Telephone_0x30 - DialedNumbers_EditCache", "env_ASG_DN_month_12", 1);
            enableControl("ASG_Telephone_0x30 - DialedNumbers_EditCache", "env_ASG_DN_year_12", 1);
            enableControl("ASG_Telephone_0x30 - DialedNumbers_EditCache", "env_ASG_DN_hour_12", 1);
            enableControl("ASG_Telephone_0x30 - DialedNumbers_EditCache", "env_ASG_DN_minute_12", 1);
            enableControl("ASG_Telephone_0x30 - DialedNumbers_EditCache", "env_ASG_DN_second_12", 1);
        }

        else
        {
            putvalue(env_ASG_DN_pos_12, 0);
            putvalue(env_ASG_DN_PbName_s_12, empty_string);
            putvalue(env_ASG_DN_TelNum_s_12, empty_string);
            putvalue(env_ASG_DN_NumType_12, 0);
            putvalue(env_ASG_DN_day_12, 0);
            putvalue(env_ASG_DN_month_12, 0);
            putvalue(env_ASG_DN_year_12, 0);
            putvalue(env_ASG_DN_hour_12, 0);
            putvalue(env_ASG_DN_minute_12, 0);
            putvalue(env_ASG_DN_second_12, 0);

            enableControl("ASG_Telephone_0x30 - DialedNumbers_EditCache", "env_ASG_DN_pos_12", 0);
            enableControl("ASG_Telephone_0x30 - DialedNumbers_EditCache", "env_ASG_DN_PbName_s_12", 0);
            enableControl("ASG_Telephone_0x30 - DialedNumbers_EditCache", "env_ASG_DN_TelNum_s_12", 0);
            enableControl("ASG_Telephone_0x30 - DialedNumbers_EditCache", "env_ASG_DN_NumType_12", 0);
            enableControl("ASG_Telephone_0x30 - DialedNumbers_EditCache", "env_ASG_DN_day_12", 0);
            enableControl("ASG_Telephone_0x30 - DialedNumbers_EditCache", "env_ASG_DN_month_12", 0);
            enableControl("ASG_Telephone_0x30 - DialedNumbers_EditCache", "env_ASG_DN_year_12", 0);
            enableControl("ASG_Telephone_0x30 - DialedNumbers_EditCache", "env_ASG_DN_hour_12", 0);
            enableControl("ASG_Telephone_0x30 - DialedNumbers_EditCache", "env_ASG_DN_minute_12", 0);
            enableControl("ASG_Telephone_0x30 - DialedNumbers_EditCache", "env_ASG_DN_second_12", 0);
        }


        if(gDialedNumbers_ListEntryReceptionInformation[2])
        {
            putvalue(env_ASG_DN_pos_13, gDialedNumbers_Pos[2]);
            putvalue(env_ASG_DN_PbName_s_13, gDialedNumbers_PbName[2]);
            putvalue(env_ASG_DN_TelNum_s_13, gDialedNumbers_TelNumber[2]);
            putvalue(env_ASG_DN_NumType_13, gDialedNumbers_NumberType[2]);
            putvalue(env_ASG_DN_day_13, gDialedNumbers_day[2]);
            putvalue(env_ASG_DN_month_13, gDialedNumbers_month[2]);
            putvalue(env_ASG_DN_year_13, gDialedNumbers_year[2]);
            putvalue(env_ASG_DN_hour_13, gDialedNumbers_hour[2]);
            putvalue(env_ASG_DN_minute_13, gDialedNumbers_minute[2]);
            putvalue(env_ASG_DN_second_13, gDialedNumbers_second[2]);

            enableControl("ASG_Telephone_0x30 - DialedNumbers_EditCache", "env_ASG_DN_pos_13", 1);
            enableControl("ASG_Telephone_0x30 - DialedNumbers_EditCache", "env_ASG_DN_PbName_s_13", 1);
            enableControl("ASG_Telephone_0x30 - DialedNumbers_EditCache", "env_ASG_DN_TelNum_s_13", 1);
            enableControl("ASG_Telephone_0x30 - DialedNumbers_EditCache", "env_ASG_DN_NumType_13", 1);
            enableControl("ASG_Telephone_0x30 - DialedNumbers_EditCache", "env_ASG_DN_day_13", 1);
            enableControl("ASG_Telephone_0x30 - DialedNumbers_EditCache", "env_ASG_DN_month_13", 1);
            enableControl("ASG_Telephone_0x30 - DialedNumbers_EditCache", "env_ASG_DN_year_13", 1);
            enableControl("ASG_Telephone_0x30 - DialedNumbers_EditCache", "env_ASG_DN_hour_13", 1);
            enableControl("ASG_Telephone_0x30 - DialedNumbers_EditCache", "env_ASG_DN_minute_13", 1);
            enableControl("ASG_Telephone_0x30 - DialedNumbers_EditCache", "env_ASG_DN_second_13", 1);
        }

        else
        {
            putvalue(env_ASG_DN_pos_13, 0);
            putvalue(env_ASG_DN_PbName_s_13, empty_string);
            putvalue(env_ASG_DN_TelNum_s_13, empty_string);
            putvalue(env_ASG_DN_NumType_13, 0);
            putvalue(env_ASG_DN_day_13, 0);
            putvalue(env_ASG_DN_month_13, 0);
            putvalue(env_ASG_DN_year_13, 0);
            putvalue(env_ASG_DN_hour_13, 0);
            putvalue(env_ASG_DN_minute_13, 0);
            putvalue(env_ASG_DN_second_13, 0);

            enableControl("ASG_Telephone_0x30 - DialedNumbers_EditCache", "env_ASG_DN_pos_13", 0);
            enableControl("ASG_Telephone_0x30 - DialedNumbers_EditCache", "env_ASG_DN_PbName_s_13", 0);
            enableControl("ASG_Telephone_0x30 - DialedNumbers_EditCache", "env_ASG_DN_TelNum_s_13", 0);
            enableControl("ASG_Telephone_0x30 - DialedNumbers_EditCache", "env_ASG_DN_NumType_13", 0);
            enableControl("ASG_Telephone_0x30 - DialedNumbers_EditCache", "env_ASG_DN_day_13", 0);
            enableControl("ASG_Telephone_0x30 - DialedNumbers_EditCache", "env_ASG_DN_month_13", 0);
            enableControl("ASG_Telephone_0x30 - DialedNumbers_EditCache", "env_ASG_DN_year_13", 0);
            enableControl("ASG_Telephone_0x30 - DialedNumbers_EditCache", "env_ASG_DN_hour_13", 0);
            enableControl("ASG_Telephone_0x30 - DialedNumbers_EditCache", "env_ASG_DN_minute_13", 0);
            enableControl("ASG_Telephone_0x30 - DialedNumbers_EditCache", "env_ASG_DN_second_13", 0);
        }

        
        //lower cache
        if(gDialedNumbers_ListEntryReceptionInformation[3])
        {
            putvalue(env_ASG_DN_pos_21, gDialedNumbers_Pos[3]);
            putvalue(env_ASG_DN_PbName_s_21, gDialedNumbers_PbName[3]);
            putvalue(env_ASG_DN_TelNum_s_21, gDialedNumbers_TelNumber[3]);
            putvalue(env_ASG_DN_NumType_21, gDialedNumbers_NumberType[3]);
            putvalue(env_ASG_DN_day_21, gDialedNumbers_day[3]);
            putvalue(env_ASG_DN_month_21, gDialedNumbers_month[3]);
            putvalue(env_ASG_DN_year_21, gDialedNumbers_year[3]);
            putvalue(env_ASG_DN_hour_21, gDialedNumbers_hour[3]);
            putvalue(env_ASG_DN_minute_21, gDialedNumbers_minute[3]);
            putvalue(env_ASG_DN_second_21, gDialedNumbers_second[3]);

            enableControl("ASG_Telephone_0x30 - DialedNumbers_EditCache", "env_ASG_DN_pos_21", 1);
            enableControl("ASG_Telephone_0x30 - DialedNumbers_EditCache", "env_ASG_DN_PbName_s_21", 1);
            enableControl("ASG_Telephone_0x30 - DialedNumbers_EditCache", "env_ASG_DN_TelNum_s_21", 1);
            enableControl("ASG_Telephone_0x30 - DialedNumbers_EditCache", "env_ASG_DN_NumType_21", 1);
            enableControl("ASG_Telephone_0x30 - DialedNumbers_EditCache", "env_ASG_DN_day_21", 1);
            enableControl("ASG_Telephone_0x30 - DialedNumbers_EditCache", "env_ASG_DN_month_21", 1);
            enableControl("ASG_Telephone_0x30 - DialedNumbers_EditCache", "env_ASG_DN_year_21", 1);
            enableControl("ASG_Telephone_0x30 - DialedNumbers_EditCache", "env_ASG_DN_hour_21", 1);
            enableControl("ASG_Telephone_0x30 - DialedNumbers_EditCache", "env_ASG_DN_minute_21", 1);
            enableControl("ASG_Telephone_0x30 - DialedNumbers_EditCache", "env_ASG_DN_second_21", 1);
        }

        else
        {
            putvalue(env_ASG_DN_pos_21, 0);
            putvalue(env_ASG_DN_PbName_s_21, empty_string);
            putvalue(env_ASG_DN_TelNum_s_21, empty_string);
            putvalue(env_ASG_DN_NumType_21, 0);
            putvalue(env_ASG_DN_day_21, 0);
            putvalue(env_ASG_DN_month_21, 0);
            putvalue(env_ASG_DN_year_21, 0);
            putvalue(env_ASG_DN_hour_21, 0);
            putvalue(env_ASG_DN_minute_21, 0);
            putvalue(env_ASG_DN_second_21, 0);

            enableControl("ASG_Telephone_0x30 - DialedNumbers_EditCache", "env_ASG_DN_pos_21", 0);
            enableControl("ASG_Telephone_0x30 - DialedNumbers_EditCache", "env_ASG_DN_PbName_s_21", 0);
            enableControl("ASG_Telephone_0x30 - DialedNumbers_EditCache", "env_ASG_DN_TelNum_s_21", 0);
            enableControl("ASG_Telephone_0x30 - DialedNumbers_EditCache", "env_ASG_DN_NumType_21", 0);
            enableControl("ASG_Telephone_0x30 - DialedNumbers_EditCache", "env_ASG_DN_day_21", 0);
            enableControl("ASG_Telephone_0x30 - DialedNumbers_EditCache", "env_ASG_DN_month_21", 0);
            enableControl("ASG_Telephone_0x30 - DialedNumbers_EditCache", "env_ASG_DN_year_21", 0);
            enableControl("ASG_Telephone_0x30 - DialedNumbers_EditCache", "env_ASG_DN_hour_21", 0);
            enableControl("ASG_Telephone_0x30 - DialedNumbers_EditCache", "env_ASG_DN_minute_21", 0);
            enableControl("ASG_Telephone_0x30 - DialedNumbers_EditCache", "env_ASG_DN_second_21", 0);
        }


        if(gDialedNumbers_ListEntryReceptionInformation[4])
        {
            putvalue(env_ASG_DN_pos_22, gDialedNumbers_Pos[4]);
            putvalue(env_ASG_DN_PbName_s_22, gDialedNumbers_PbName[4]);
            putvalue(env_ASG_DN_TelNum_s_22, gDialedNumbers_TelNumber[4]);
            putvalue(env_ASG_DN_NumType_22, gDialedNumbers_NumberType[4]);
            putvalue(env_ASG_DN_day_22, gDialedNumbers_day[4]);
            putvalue(env_ASG_DN_month_22, gDialedNumbers_month[4]);
            putvalue(env_ASG_DN_year_22, gDialedNumbers_year[4]);
            putvalue(env_ASG_DN_hour_22, gDialedNumbers_hour[4]);
            putvalue(env_ASG_DN_minute_22, gDialedNumbers_minute[4]);
            putvalue(env_ASG_DN_second_22, gDialedNumbers_second[4]);

            enableControl("ASG_Telephone_0x30 - DialedNumbers_EditCache", "env_ASG_DN_pos_22", 1);
            enableControl("ASG_Telephone_0x30 - DialedNumbers_EditCache", "env_ASG_DN_PbName_s_22", 1);
            enableControl("ASG_Telephone_0x30 - DialedNumbers_EditCache", "env_ASG_DN_TelNum_s_22", 1);
            enableControl("ASG_Telephone_0x30 - DialedNumbers_EditCache", "env_ASG_DN_NumType_22", 1);
            enableControl("ASG_Telephone_0x30 - DialedNumbers_EditCache", "env_ASG_DN_day_22", 1);
            enableControl("ASG_Telephone_0x30 - DialedNumbers_EditCache", "env_ASG_DN_month_22", 1);
            enableControl("ASG_Telephone_0x30 - DialedNumbers_EditCache", "env_ASG_DN_year_22", 1);
            enableControl("ASG_Telephone_0x30 - DialedNumbers_EditCache", "env_ASG_DN_hour_22", 1);
            enableControl("ASG_Telephone_0x30 - DialedNumbers_EditCache", "env_ASG_DN_minute_22", 1);
            enableControl("ASG_Telephone_0x30 - DialedNumbers_EditCache", "env_ASG_DN_second_22", 1);
        }

        else
        {
            putvalue(env_ASG_DN_pos_22, 0);
            putvalue(env_ASG_DN_PbName_s_22, empty_string);
            putvalue(env_ASG_DN_TelNum_s_22, empty_string);
            putvalue(env_ASG_DN_NumType_22, 0);
            putvalue(env_ASG_DN_day_22, 0);
            putvalue(env_ASG_DN_month_22, 0);
            putvalue(env_ASG_DN_year_22, 0);
            putvalue(env_ASG_DN_hour_22, 0);
            putvalue(env_ASG_DN_minute_22, 0);
            putvalue(env_ASG_DN_second_22, 0);

            enableControl("ASG_Telephone_0x30 - DialedNumbers_EditCache", "env_ASG_DN_pos_22", 0);
            enableControl("ASG_Telephone_0x30 - DialedNumbers_EditCache", "env_ASG_DN_PbName_s_22", 0);
            enableControl("ASG_Telephone_0x30 - DialedNumbers_EditCache", "env_ASG_DN_TelNum_s_22", 0);
            enableControl("ASG_Telephone_0x30 - DialedNumbers_EditCache", "env_ASG_DN_NumType_22", 0);
            enableControl("ASG_Telephone_0x30 - DialedNumbers_EditCache", "env_ASG_DN_day_22", 0);
            enableControl("ASG_Telephone_0x30 - DialedNumbers_EditCache", "env_ASG_DN_month_22", 0);
            enableControl("ASG_Telephone_0x30 - DialedNumbers_EditCache", "env_ASG_DN_year_22", 0);
            enableControl("ASG_Telephone_0x30 - DialedNumbers_EditCache", "env_ASG_DN_hour_22", 0);
            enableControl("ASG_Telephone_0x30 - DialedNumbers_EditCache", "env_ASG_DN_minute_22", 0);
            enableControl("ASG_Telephone_0x30 - DialedNumbers_EditCache", "env_ASG_DN_second_22", 0);
        }


        if(gDialedNumbers_ListEntryReceptionInformation[5])
        {
            putvalue(env_ASG_DN_pos_23, gDialedNumbers_Pos[5]);
            putvalue(env_ASG_DN_PbName_s_23, gDialedNumbers_PbName[5]);
            putvalue(env_ASG_DN_TelNum_s_23, gDialedNumbers_TelNumber[5]);
            putvalue(env_ASG_DN_NumType_23, gDialedNumbers_NumberType[5]);
            putvalue(env_ASG_DN_day_23, gDialedNumbers_day[5]);
            putvalue(env_ASG_DN_month_23, gDialedNumbers_month[5]);
            putvalue(env_ASG_DN_year_23, gDialedNumbers_year[5]);
            putvalue(env_ASG_DN_hour_23, gDialedNumbers_hour[5]);
            putvalue(env_ASG_DN_minute_23, gDialedNumbers_minute[5]);
            putvalue(env_ASG_DN_second_23, gDialedNumbers_second[5]);

            enableControl("ASG_Telephone_0x30 - DialedNumbers_EditCache", "env_ASG_DN_pos_23", 1);
            enableControl("ASG_Telephone_0x30 - DialedNumbers_EditCache", "env_ASG_DN_PbName_s_23", 1);
            enableControl("ASG_Telephone_0x30 - DialedNumbers_EditCache", "env_ASG_DN_TelNum_s_23", 1);
            enableControl("ASG_Telephone_0x30 - DialedNumbers_EditCache", "env_ASG_DN_NumType_23", 1);
            enableControl("ASG_Telephone_0x30 - DialedNumbers_EditCache", "env_ASG_DN_day_23", 1);
            enableControl("ASG_Telephone_0x30 - DialedNumbers_EditCache", "env_ASG_DN_month_23", 1);
            enableControl("ASG_Telephone_0x30 - DialedNumbers_EditCache", "env_ASG_DN_year_23", 1);
            enableControl("ASG_Telephone_0x30 - DialedNumbers_EditCache", "env_ASG_DN_hour_23", 1);
            enableControl("ASG_Telephone_0x30 - DialedNumbers_EditCache", "env_ASG_DN_minute_23", 1);
            enableControl("ASG_Telephone_0x30 - DialedNumbers_EditCache", "env_ASG_DN_second_23", 1);
        }

        else
        {
            putvalue(env_ASG_DN_pos_23, 0);
            putvalue(env_ASG_DN_PbName_s_23, empty_string);
            putvalue(env_ASG_DN_TelNum_s_23, empty_string);
            putvalue(env_ASG_DN_NumType_23, 0);
            putvalue(env_ASG_DN_day_23, 0);
            putvalue(env_ASG_DN_month_23, 0);
            putvalue(env_ASG_DN_year_23, 0);
            putvalue(env_ASG_DN_hour_23, 0);
            putvalue(env_ASG_DN_minute_23, 0);
            putvalue(env_ASG_DN_second_23, 0);

            enableControl("ASG_Telephone_0x30 - DialedNumbers_EditCache", "env_ASG_DN_pos_23", 0);
            enableControl("ASG_Telephone_0x30 - DialedNumbers_EditCache", "env_ASG_DN_PbName_s_23", 0);
            enableControl("ASG_Telephone_0x30 - DialedNumbers_EditCache", "env_ASG_DN_TelNum_s_23", 0);
            enableControl("ASG_Telephone_0x30 - DialedNumbers_EditCache", "env_ASG_DN_NumType_23", 0);
            enableControl("ASG_Telephone_0x30 - DialedNumbers_EditCache", "env_ASG_DN_day_23", 0);
            enableControl("ASG_Telephone_0x30 - DialedNumbers_EditCache", "env_ASG_DN_month_23", 0);
            enableControl("ASG_Telephone_0x30 - DialedNumbers_EditCache", "env_ASG_DN_year_23", 0);
            enableControl("ASG_Telephone_0x30 - DialedNumbers_EditCache", "env_ASG_DN_hour_23", 0);
            enableControl("ASG_Telephone_0x30 - DialedNumbers_EditCache", "env_ASG_DN_minute_23", 0);
            enableControl("ASG_Telephone_0x30 - DialedNumbers_EditCache", "env_ASG_DN_second_23", 0);
        }
}
/*@@end*/

/*@@caplFunc:DialedNumbers_GetNextCachedElement(int,byte):*///function
int DialedNumbers_GetNextCachedElement (int currentElement,byte direction)
{
    int i=0, nextElement=0;

    switch (direction)
    {
        case TEL_DIALEDNUMBERS_DISPLAYLIST_FIND_NEXT_ELEMENT:                
                nextElement = ++currentElement;

                if (nextElement<TEL_DIALEDNUMBERS_ASGCACHE_MAX_SIZE) //start at next element, if next element is not >8
                {
                    for(i =nextElement; i<TEL_DIALEDNUMBERS_ASGCACHE_MAX_SIZE;i++)
                    {
                        if(gDialedNumbers_ListEntryReceptionInformation[i] ==TRUE)
                        {   
                            nextElement =i; 
                            i= TEL_DIALEDNUMBERS_ASGCACHE_MAX_SIZE;
                        }
                        else
                            nextElement =0;
                    }
                }
                else    //start at first element
                {
                    nextElement =0;

                    for(i =nextElement; i<TEL_DIALEDNUMBERS_ASGCACHE_MAX_SIZE;i++)
                    {
                        if(gDialedNumbers_ListEntryReceptionInformation[i] ==TRUE)
                        {   
                            nextElement =i; 
                            i =TEL_DIALEDNUMBERS_ASGCACHE_MAX_SIZE;
                        }   
                    }
                }
        break;

        case TEL_DIALEDNUMBERS_DISPLAYLIST_FIND_PREVIUOS_ELEMENT:
                nextElement = --currentElement;
                if (nextElement ==0 && gDialedNumbers_ListEntryReceptionInformation[nextElement] ==TRUE)
                    nextElement =0;
                else if (nextElement>0) 
                {
                    for(i =nextElement; i>0; i--)
                    {
                        if(gDialedNumbers_ListEntryReceptionInformation[i] ==TRUE)
                        {   
                            nextElement =i; 
                            i =0;
                        }
                        else
                            nextElement =TEL_DIALEDNUMBERS_ASGCACHE_MAX_SIZE-1;
                    }
                }    
                else    //start at last element
                {
                    nextElement =TEL_DIALEDNUMBERS_ASGCACHE_MAX_SIZE-1;

                    for(i =nextElement; i>0; i--)
                    {
                        if(gDialedNumbers_ListEntryReceptionInformation[i] ==TRUE)
                        {   
                            nextElement =i; 
                            i =0;
                        }
                        else if(gDialedNumbers_ListEntryReceptionInformation[0] ==TRUE)
                            nextElement =0;          
                    }
                }
        break;

        default:
        break;
    }
    return(nextElement);
}
/*@@end*/

/*@@caplFunc:DialedNumbers_GetNextLineInCache(int,byte):*///function
int DialedNumbers_GetNextLineInCache (int currentElement,byte direction)
{
    int i=0, nextElement=0;

    switch (direction)
    {
        case FORWARD:
                           
                if(currentElement<TEL_DIALEDNUMBERS_ASGCACHE_MAX_SIZE-1 && currentElement !=5) 
                    nextElement = ++currentElement;  
                
                else if (currentElement ==8)            
                    nextElement =0;
                else
                    nextElement =TEL_DIALEDNUMBERS_NO_NEXT_POSITION;
        break;

        case BACKWARD:
                if(currentElement<TEL_DIALEDNUMBERS_ASGCACHE_MAX_SIZE && currentElement !=0 && currentElement !=6) 
                    nextElement =--currentElement;
                
                else if (currentElement ==0)            
                    nextElement =8;
                
                else
                    nextElement =TEL_DIALEDNUMBERS_NO_NEXT_POSITION;
        break;

        default:
        break;
    }
    return(nextElement);
}
/*@@end*/

/*@@caplFunc:DialedNumbers_Indication(dword[],byte,int):*///function
DialedNumbers_Indication (dword Indication_array [], byte indication, int datalength)
{
    byte mode, direction, shift, recordaddress, indexsize, current_element, transmitpos, length, CacheElements, StartElementInCache;
    word  startelement, elements, startelement_check, Offset =0;
    int i =0, j=0;

    // Init local variables
    mode                    =0;
    direction               =0;
    shift                   =0;
    recordaddress           =0;
    startelement            =0;
    elements                =0;
    current_element         =0;
    transmitpos             =0;
    length                  =0;
    startelement_check      =0;
    StartElementInCache     =FALSE;
    CacheElements           =FALSE;

		switch (gBAP_Indication[2])
		{
			case Data_IND:
				//get data
                gDialedNumbers_ASGID =(Indication_array[3] &0xF0) /0x10;
                gDialedNumbers_TAID  =Indication_array[3] &0x0F;           

                gDialedNumbers_TotalNumListElements =Indication_array[4];
              
                /***ArrayHeader***/
                mode            =(Indication_array[5] &0xF0) /0x10;
                recordaddress   =Indication_array[5] &0x0F;
                Offset =6;
                
                // decode "mode-byte"
                shift       =mode &0x01;
                direction   =(mode &0x02)/0x02;
                transmitpos =(mode &0x04)/0x04;
                indexsize   =(mode &0x08)/0x08; 

                if (indexsize)
                {   
                    startelement =Indication_array[Offset];
                    Offset++;
                    startelement +=(Indication_array[Offset] *0x100);
                    Offset++;

                    elements =Indication_array[Offset];
                    Offset++;
                    elements +=(Indication_array[Offset] *0x100);
                    Offset++;
                }
                else
                {   
                    startelement =Indication_array[Offset];
                    Offset++;

                    elements =Indication_array[Offset];
                    Offset++;
                }           
            
                if(startelement !=0)
                {
                    for (i=0;i<TEL_DIALEDNUMBERS_ASGCACHE_MAX_SIZE;i++)
                    {
                        if(startelement ==gDialedNumbers_Pos[i])  
                            i =TEL_DIALEDNUMBERS_ASGCACHE_MAX_SIZE;              
                    }
                }

                switch (recordaddress)
                {
                    case 0: //recordaddress =0 -> complete record

                        /***startelement ==0***/                        
                        if(0==startelement && gDialedNumbers_ListHandlingType ==TEL_DIALEDNUMBERS_BUILDUPCACHE)
                        {     
                            /***find "start line" in ASG cache***/
                            if(FORWARD ==direction)
                            {    
                                if (gDialedNumbers_cacheDown)
                                {   
                                    current_element         =5; //it's the Pos of last element in ASG cache
                                    
                                    //reset "sliding window" values
                                    gDialedNumbers_cacheDown         =FALSE;
                                }
                                else
                                    current_element =startelement;
                                    
                                if (shift ==TRUE) //startelement not next element
                                    current_element =DialedNumbers_GetNextLineInCache (current_element, direction);   
                            }
                            
                            else if(BACKWARD ==direction && shift==TRUE)
                            {
                                if(gDialedNumbers_cacheUp)
                                {   
                                    current_element         =6; //it's the Pos of first element in ASG cache
                                    
                                    //reset "sliding window" values
                                        gDialedNumbers_cacheUp           =FALSE;
                                }
                                else 
                                    current_element =TEL_DIALEDNUMBERS_ASGCACHE_MAX_SIZE -1; // position of last element in array 
                            }                
                                
                            /***copy elements***/
                            if (current_element !=TEL_DIALEDNUMBERS_NO_NEXT_POSITION) 
                            {
                                for (j=0; j<elements;j++) //copy elements
                                {   
                                    //check, if elements must be cached and in case find position in array
                                    CacheElements =FALSE;
                                    for (i=0; i<TEL_DIALEDNUMBERS_ASGCACHE_MAX_SIZE; i++)
                                    {  
                                        //if element already cached, find position in ASG-cache
                                        if(indexsize ==FALSE && (transmitpos ==TRUE) && Indication_array[Offset] ==gDialedNumbers_Pos[i] && gDialedNumbers_ListEntryReceptionInformation[i] ==TRUE)
                                        {   
                                            current_element =i; 
                                            CacheElements   =TRUE;
                                        }
                                        else if((indexsize ==TRUE && (transmitpos ==TRUE) && (Indication_array[Offset] +(Indication_array[Offset+1]*0x100)) ==gDialedNumbers_Pos[i] && gDialedNumbers_ListEntryReceptionInformation[i] ==TRUE))
                                        {   
                                            current_element =i; 
                                            CacheElements   =TRUE;
                                        }
                                        //if not already cached, then store element only, if Cache is build-up!
                                        else if((gDialedNumbers_ListHandlingType !=TEL_DIALEDNUMBERS_NOCACHE))
                                            CacheElements   =TRUE;
                                    }
                                                                       
                                    if (transmitpos)
                                    {   
                                        if(CacheElements ==TRUE)
                                        {   
                                            if(indexsize)
                                            {    
                                                gDialedNumbers_Pos[current_element] =Indication_array[Offset];
                                                Offset++;
                                                gDialedNumbers_Pos[current_element] +=Indication_array[Offset] *0x100;
                                            }
                                            else
                                                gDialedNumbers_Pos[current_element] =Indication_array[Offset]; 
                                        }
                                        Offset++;
                                    }
                                    else if(CacheElements ==TRUE)
                                    {
                                        if(direction ==FORWARD && shift==FALSE)
                                            gDialedNumbers_Pos[current_element] =startelement+j;
                                        
                                        else if(direction ==FORWARD && shift==TRUE)
                                            gDialedNumbers_Pos[current_element] =startelement+j+1;

                                        else if(direction ==BACKWARD && shift==FALSE)
                                            gDialedNumbers_Pos[current_element] =startelement-j;
                                        
                                        else if((direction ==BACKWARD) && (shift==TRUE) && (startelement !=0))
                                            gDialedNumbers_Pos[current_element] =startelement-j-1;  
                                    }

                                    //PbName
                                    if(CacheElements ==TRUE)
                                    {
                                        for(i=0; i<TEL_DIALEDNUMBERS_PBNAME_LENGTH;i++) //clear
			                                gDialedNumbers_PbName[current_element][i] =0; 
                                    }
                                         
                                    length =Indication_array[Offset];
                                    Offset++;
                                    
                                    for(i=0; i<length;i++) //copy data
                                    {   
                                        if(CacheElements ==TRUE)
                                            gDialedNumbers_PbName[current_element][i] =Indication_array[Offset];
                                        Offset++;
                                    }
                                    
                                    //NumberType
                                    if(CacheElements ==TRUE)
                                    {
                                        gDialedNumbers_NumberType[current_element] =Indication_array[Offset];
                                        Offset++;
                                    }

                                    //TelNumber
                                    if(CacheElements ==TRUE)
                                    {
                                        for(i=0; i<TEL_DIALEDNUMBERS_TELNUMBER_LENGTH;i++) //clear
			                                gDialedNumbers_TelNumber[current_element][i] =0; 
                                    }
                                         
                                    length =Indication_array[Offset];
                                    Offset++;
                                    
                                    for(i=0; i<length;i++) //copy data
                                    {   
                                        if(CacheElements ==TRUE)
                                            gDialedNumbers_TelNumber[current_element][i] =Indication_array[Offset];
                                        Offset++;
                                    }
                                    
                                    //Day
                                    if(CacheElements ==TRUE)
                                    {
                                        gDialedNumbers_day[current_element] =Indication_array[Offset];
                                        Offset++;
                                    }

                                    //Month
                                    if(CacheElements ==TRUE)
                                    {
                                        gDialedNumbers_month[current_element] =Indication_array[Offset];
                                        Offset++;
                                    }

                                    //Year
                                    if(CacheElements ==TRUE)
                                    {
                                        gDialedNumbers_year[current_element] =Indication_array[Offset];
                                        Offset++;
                                    }

                                    //Hour
                                    if(CacheElements ==TRUE)
                                    {
                                        gDialedNumbers_hour[current_element] =Indication_array[Offset];
                                        Offset++;
                                    }

                                    //Minute
                                    if(CacheElements ==TRUE)
                                    {
                                        gDialedNumbers_minute[current_element] =Indication_array[Offset];
                                        Offset++;
                                    }

                                    //Second
                                    if(CacheElements ==TRUE)
                                    {
                                        gDialedNumbers_second[current_element] =Indication_array[Offset];
                                        Offset++;
                                    }
                                    
                                    if(CacheElements ==TRUE)                                    
                                        gDialedNumbers_ListEntryReceptionInformation [current_element] =TRUE;
                                                       
                                    current_element =DialedNumbers_GetNextLineInCache (current_element, direction); //go on with next element     
                                }   //copy data of current element finished
                            } //copy of elements finished       
                        } //startelement=0 ends
    
                        /***startelement !=0***/
                        else //if (((startelement !=0) && (gDialedNumbers_ListHandlingType ==TEL_DIALEDNUMBERS_BUILDUPCACHE)) || ((startelement ==0) && (gDialedNumbers_ListHandlingType !=TEL_DIALEDNUMBERS_BUILDUPCACHE))) //startelement !=0
                        {
                            //searching for valid startelement in stored list
					        for(i=0;i<TEL_DIALEDNUMBERS_ASGCACHE_MAX_SIZE;i++)
					        {
						        if(gDialedNumbers_Pos[i] ==startelement)				//found a valid element
						        {                                                                                  
                                    current_element     =i;                         //found element is valid_startelement
						            StartElementInCache =TRUE;
                                    i                   =TEL_DIALEDNUMBERS_ASGCACHE_MAX_SIZE;
                                }
					        }
                            if (StartElementInCache)
                            {   
                                if (shift ==TRUE && startelement!=0) //first array element is next element
                                    current_element =DialedNumbers_GetNextLineInCache (current_element, direction);                 
                                else if(shift ==TRUE && startelement==0 && direction ==FORWARD)
                                    current_element=5;
                                   
                                for (j=0; j<elements;j++) //copy elements
                                {
                                    if(current_element !=TEL_DIALEDNUMBERS_NO_NEXT_POSITION)
                                    {
                                        CacheElements =TRUE;
                                        //if element already exist in ASG-cache, search the position 
                                        for (i=0; i<TEL_DIALEDNUMBERS_ASGCACHE_MAX_SIZE; i++)
                                        {   
                                            if((transmitpos ==TRUE) && gDialedNumbers_ListEntryReceptionInformation[i] ==TRUE)
                                            {   
                                                startelement_check =0;
                                                if(indexsize)
                                                    startelement_check =Indication_array[Offset] +(Indication_array[Offset+1]*0x100); 
                                                else
                                                    startelement_check =Indication_array[Offset];
                                               
                                                if(startelement_check ==gDialedNumbers_Pos[i])
                                                {   
                                                    current_element =i; 
                                                    CacheElements   =TRUE;
                                                }
                                                startelement_check=0;
                                            }  
                                        }
                                    }
                                    else
                                        CacheElements =FALSE;
                                        
                                    if (transmitpos)
                                    {   
                                        if(CacheElements ==TRUE)
                                        {   
                                            if(indexsize)
                                            {    
                                                gDialedNumbers_Pos[current_element] =Indication_array[Offset];
                                                Offset++;
                                                gDialedNumbers_Pos[current_element] +=Indication_array[Offset] *0x100;
                                            }
                                            else
                                                gDialedNumbers_Pos[current_element] =Indication_array[Offset];
                                        }
                                        Offset++;
                                    }
                                    else if(CacheElements ==TRUE)
                                    {
                                        if(direction ==FORWARD && shift==FALSE)
                                            gDialedNumbers_Pos[current_element] =startelement+j;
                                        
                                        else if(direction ==FORWARD && shift==TRUE)
                                            gDialedNumbers_Pos[current_element] =startelement+j+1;

                                        else if(direction ==BACKWARD && shift==FALSE)
                                            gDialedNumbers_Pos[current_element] =startelement-j;
                                        
                                        else if((direction ==BACKWARD) && (shift==TRUE) && (startelement !=0))
                                            gDialedNumbers_Pos[current_element] =startelement-j-1;  
                                    }
                                    
                                    //PbName
                                    if(CacheElements ==TRUE)
                                    {
                                        for(i=0; i<TEL_DIALEDNUMBERS_PBNAME_LENGTH;i++) //clear
			                                gDialedNumbers_PbName[current_element][i] =0; 
                                    }
                                         
                                    length =Indication_array[Offset];
                                    Offset++;
                                    
                                    for(i=0; i<length;i++) //copy data
                                    {   
                                        if(CacheElements ==TRUE)
                                            gDialedNumbers_PbName[current_element][i] =Indication_array[Offset];
                                        Offset++;
                                    }
                                    
                                    //NumberType
                                    if(CacheElements ==TRUE)
                                    {
                                        gDialedNumbers_NumberType[current_element] =Indication_array[Offset];
                                        Offset++;
                                    }

                                    //TelNumber
                                    if(CacheElements ==TRUE)
                                    {
                                        for(i=0; i<TEL_DIALEDNUMBERS_TELNUMBER_LENGTH;i++) //clear
			                                gDialedNumbers_TelNumber[current_element][i] =0; 
                                    }
                                         
                                    length =Indication_array[Offset];
                                    Offset++;
                                    
                                    for(i=0; i<length;i++) //copy data
                                    {   
                                        if(CacheElements ==TRUE)
                                            gDialedNumbers_TelNumber[current_element][i] =Indication_array[Offset];
                                        Offset++;
                                    }
                                    
                                    //Day
                                    if(CacheElements ==TRUE)
                                    {
                                        gDialedNumbers_day[current_element] =Indication_array[Offset];
                                        Offset++;
                                    }

                                    //Month
                                    if(CacheElements ==TRUE)
                                    {
                                        gDialedNumbers_month[current_element] =Indication_array[Offset];
                                        Offset++;
                                    }

                                    //Year
                                    if(CacheElements ==TRUE)
                                    {
                                        gDialedNumbers_year[current_element] =Indication_array[Offset];
                                        Offset++;
                                    }

                                    //Hour
                                    if(CacheElements ==TRUE)
                                    {
                                        gDialedNumbers_hour[current_element] =Indication_array[Offset];
                                        Offset++;
                                    }

                                    //Minute
                                    if(CacheElements ==TRUE)
                                    {
                                        gDialedNumbers_minute[current_element] =Indication_array[Offset];
                                        Offset++;
                                    }

                                    //Second
                                    if(CacheElements ==TRUE)
                                    {
                                        gDialedNumbers_second[current_element] =Indication_array[Offset];
                                        Offset++;
                                    }
                                    
                                    if(CacheElements ==TRUE)                                   
                                        gDialedNumbers_ListEntryReceptionInformation [current_element] =TRUE;
                                    
                                    if(CacheElements ==TRUE)    
                                        current_element =DialedNumbers_GetNextLineInCache (current_element, direction); //go on with next element       
                                }   //copy data of current element finished
                            }       //copy of elements finished
                        }           //startelement !=0 ends
                        
                     break; //recordaddress =0 ends
                    
                    case 1: //recordaddress =1 -> PbName, NumberType
                        /***startelement ==0***/                        
                        if(0==startelement && gDialedNumbers_ListHandlingType ==TEL_DIALEDNUMBERS_BUILDUPCACHE)
                        {     
                            /***find "start line" in ASG cache***/
                            if(FORWARD ==direction)
                            {    
                                if (gDialedNumbers_cacheDown)
                                {   
                                    current_element         =5; //it's the Pos of last element in ASG cache
                                    
                                    //reset "sliding window" values
                                    gDialedNumbers_cacheDown         =FALSE;
                                }
                                else
                                    current_element =startelement;
                                    
                                if (shift ==TRUE) //startelement not next element
                                    current_element =DialedNumbers_GetNextLineInCache (current_element, direction);   
                            }
                            
                            else if(BACKWARD ==direction && shift==TRUE)
                            {
                                if(gDialedNumbers_cacheUp)
                                {   
                                    current_element         =6; //it's the Pos of first element in ASG cache
                                    
                                    //reset "sliding window" values
                                        gDialedNumbers_cacheUp           =FALSE;
                                }
                                else 
                                    current_element =TEL_DIALEDNUMBERS_ASGCACHE_MAX_SIZE -1; // position of last element in array 
                            }                
                                
                            /***copy elements***/
                            if (current_element !=TEL_DIALEDNUMBERS_NO_NEXT_POSITION) 
                            {
                                for (j=0; j<elements;j++) //copy elements
                                {   
                                    //check, if elements must be cached and in case find position in array
                                    CacheElements =FALSE;
                                    for (i=0; i<TEL_DIALEDNUMBERS_ASGCACHE_MAX_SIZE; i++)
                                    {  
                                        //if element already cached, find position in ASG-cache
                                        if(indexsize ==FALSE && (transmitpos ==TRUE) && Indication_array[Offset] ==gDialedNumbers_Pos[i] && gDialedNumbers_ListEntryReceptionInformation[i] ==TRUE)
                                        {   
                                            current_element =i; 
                                            CacheElements   =TRUE;
                                        }
                                        else if((indexsize ==TRUE && (transmitpos ==TRUE) && (Indication_array[Offset] +(Indication_array[Offset+1]*0x100)) ==gDialedNumbers_Pos[i] && gDialedNumbers_ListEntryReceptionInformation[i] ==TRUE))
                                        {   
                                            current_element =i; 
                                            CacheElements   =TRUE;
                                        }
                                        //if not already cached, then store element only, if Cache is build-up!
                                        else if((gDialedNumbers_ListHandlingType !=TEL_DIALEDNUMBERS_NOCACHE))
                                            CacheElements   =TRUE;
                                    }
                                                                       
                                    if (transmitpos)
                                    {   
                                        if(CacheElements ==TRUE)
                                        {   
                                            if(indexsize)
                                            {    
                                                gDialedNumbers_Pos[current_element] =Indication_array[Offset];
                                                Offset++;
                                                gDialedNumbers_Pos[current_element] +=Indication_array[Offset] *0x100;
                                            }
                                            else
                                                gDialedNumbers_Pos[current_element] =Indication_array[Offset]; 
                                        }
                                        Offset++;
                                    }
                                    else if(CacheElements ==TRUE)
                                    {
                                        if(direction ==FORWARD && shift==FALSE)
                                            gDialedNumbers_Pos[current_element] =startelement+j;
                                        
                                        else if(direction ==FORWARD && shift==TRUE)
                                            gDialedNumbers_Pos[current_element] =startelement+j+1;

                                        else if(direction ==BACKWARD && shift==FALSE)
                                            gDialedNumbers_Pos[current_element] =startelement-j;
                                        
                                        else if((direction ==BACKWARD) && (shift==TRUE) && (startelement !=0))
                                            gDialedNumbers_Pos[current_element] =startelement-j-1;  
                                    }

                                    //PbName
                                    if(CacheElements ==TRUE)
                                    {
                                        for(i=0; i<TEL_DIALEDNUMBERS_PBNAME_LENGTH;i++) //clear
			                                gDialedNumbers_PbName[current_element][i] =0; 
                                    }
                                         
                                    length =Indication_array[Offset];
                                    Offset++;
                                    
                                    for(i=0; i<length;i++) //copy data
                                    {   
                                        if(CacheElements ==TRUE)
                                            gDialedNumbers_PbName[current_element][i] =Indication_array[Offset];
                                        Offset++;
                                    }
                                    
                                    //NumberType
                                    if(CacheElements ==TRUE)
                                    {
                                        gDialedNumbers_NumberType[current_element] =Indication_array[Offset];
                                        Offset++;
                                    }
                                    
                                    if(CacheElements ==TRUE)                                    
                                        gDialedNumbers_ListEntryReceptionInformation [current_element] =TRUE;
                                                       
                                    current_element =DialedNumbers_GetNextLineInCache (current_element, direction); //go on with next element     
                                }   //copy data of current element finished
                            } //copy of elements finished       
                        } //startelement=0 ends
    
                        /***startelement !=0***/
                        else //if (((startelement !=0) && (gDialedNumbers_ListHandlingType ==TEL_DIALEDNUMBERS_BUILDUPCACHE)) || ((startelement ==0) && (gDialedNumbers_ListHandlingType !=TEL_DIALEDNUMBERS_BUILDUPCACHE))) //startelement !=0
                        {
                            //searching for valid startelement in stored list
					        for(i=0;i<TEL_DIALEDNUMBERS_ASGCACHE_MAX_SIZE;i++)
					        {
						        if(gDialedNumbers_Pos[i] ==startelement)				//found a valid element
						        {                                                                                  
                                    current_element     =i;                         //found element is valid_startelement
						            StartElementInCache =TRUE;
                                    i                   =TEL_DIALEDNUMBERS_ASGCACHE_MAX_SIZE;
                                }
					        }
                            if (StartElementInCache)
                            {   
                                if (shift ==TRUE && startelement!=0) //first array element is next element
                                    current_element =DialedNumbers_GetNextLineInCache (current_element, direction);                 
                                else if(shift ==TRUE && startelement==0 && direction ==FORWARD)
                                    current_element=5;
                                   
                                for (j=0; j<elements;j++) //copy elements
                                {
                                    if(current_element !=TEL_DIALEDNUMBERS_NO_NEXT_POSITION)
                                    {
                                        CacheElements =TRUE;
                                        //if element already exist in ASG-cache, search the position 
                                        for (i=0; i<TEL_DIALEDNUMBERS_ASGCACHE_MAX_SIZE; i++)
                                        {   
                                            if((transmitpos ==TRUE) && gDialedNumbers_ListEntryReceptionInformation[i] ==TRUE)
                                            {   
                                                startelement_check =0;
                                                if(indexsize)
                                                    startelement_check =Indication_array[Offset] +(Indication_array[Offset+1]*0x100); 
                                                else
                                                    startelement_check =Indication_array[Offset];
                                               
                                                if(startelement_check ==gDialedNumbers_Pos[i])
                                                {   
                                                    current_element =i; 
                                                    CacheElements   =TRUE;
                                                }
                                                startelement_check=0;
                                            }  
                                        }
                                    }
                                    else
                                        CacheElements =FALSE;
                                        
                                    if (transmitpos)
                                    {   
                                        if(CacheElements ==TRUE)
                                        {   
                                            if(indexsize)
                                            {    
                                                gDialedNumbers_Pos[current_element] =Indication_array[Offset];
                                                Offset++;
                                                gDialedNumbers_Pos[current_element] +=Indication_array[Offset] *0x100;
                                            }
                                            else
                                                gDialedNumbers_Pos[current_element] =Indication_array[Offset];
                                        }
                                        Offset++;
                                    }
                                    else if(CacheElements ==TRUE)
                                    {
                                        if(direction ==FORWARD && shift==FALSE)
                                            gDialedNumbers_Pos[current_element] =startelement+j;
                                        
                                        else if(direction ==FORWARD && shift==TRUE)
                                            gDialedNumbers_Pos[current_element] =startelement+j+1;

                                        else if(direction ==BACKWARD && shift==FALSE)
                                            gDialedNumbers_Pos[current_element] =startelement-j;
                                        
                                        else if((direction ==BACKWARD) && (shift==TRUE) && (startelement !=0))
                                            gDialedNumbers_Pos[current_element] =startelement-j-1;  
                                    }
                                    
                                    //PbName
                                    if(CacheElements ==TRUE)
                                    {
                                        for(i=0; i<TEL_DIALEDNUMBERS_PBNAME_LENGTH;i++) //clear
			                                gDialedNumbers_PbName[current_element][i] =0; 
                                    }
                                         
                                    length =Indication_array[Offset];
                                    Offset++;
                                    
                                    for(i=0; i<length;i++) //copy data
                                    {   
                                        if(CacheElements ==TRUE)
                                            gDialedNumbers_PbName[current_element][i] =Indication_array[Offset];
                                        Offset++;
                                    }
                                    
                                    //NumberType
                                    if(CacheElements ==TRUE)
                                    {
                                        gDialedNumbers_NumberType[current_element] =Indication_array[Offset];
                                        Offset++;
                                    }

                                    if(CacheElements ==TRUE)                                   
                                        gDialedNumbers_ListEntryReceptionInformation [current_element] =TRUE;
                                    
                                    if(CacheElements ==TRUE)    
                                        current_element =DialedNumbers_GetNextLineInCache (current_element, direction); //go on with next element       
                                }   //copy data of current element finished
                            }       //copy of elements finished
                        }
                        
                     break; //recordaddress =1 ends
                    
                    case 2: //recordaddress =2 -> TelNumber, Day, Month, Year, Hour, Minute, Second
                        /***startelement ==0***/                        
                        if(0==startelement && gDialedNumbers_ListHandlingType ==TEL_DIALEDNUMBERS_BUILDUPCACHE)
                        {     
                            /***find "start line" in ASG cache***/
                            if(FORWARD ==direction)
                            {    
                                if (gDialedNumbers_cacheDown)
                                {   
                                    current_element         =5; //it's the Pos of last element in ASG cache
                                    
                                    //reset "sliding window" values
                                    gDialedNumbers_cacheDown         =FALSE;
                                }
                                else
                                    current_element =startelement;
                                    
                                if (shift ==TRUE) //startelement not next element
                                    current_element =DialedNumbers_GetNextLineInCache (current_element, direction);   
                            }
                            
                            else if(BACKWARD ==direction && shift==TRUE)
                            {
                                if(gDialedNumbers_cacheUp)
                                {   
                                    current_element         =6; //it's the Pos of first element in ASG cache
                                    
                                    //reset "sliding window" values
                                        gDialedNumbers_cacheUp           =FALSE;
                                }
                                else 
                                    current_element =TEL_DIALEDNUMBERS_ASGCACHE_MAX_SIZE -1; // position of last element in array 
                            }                
                                
                            /***copy elements***/
                            if (current_element !=TEL_DIALEDNUMBERS_NO_NEXT_POSITION) 
                            {
                                for (j=0; j<elements;j++) //copy elements
                                {   
                                    //check, if elements must be cached and in case find position in array
                                    CacheElements =FALSE;
                                    for (i=0; i<TEL_DIALEDNUMBERS_ASGCACHE_MAX_SIZE; i++)
                                    {  
                                        //if element already cached, find position in ASG-cache
                                        if(indexsize ==FALSE && (transmitpos ==TRUE) && Indication_array[Offset] ==gDialedNumbers_Pos[i] && gDialedNumbers_ListEntryReceptionInformation[i] ==TRUE)
                                        {   
                                            current_element =i; 
                                            CacheElements   =TRUE;
                                        }
                                        else if((indexsize ==TRUE && (transmitpos ==TRUE) && (Indication_array[Offset] +(Indication_array[Offset+1]*0x100)) ==gDialedNumbers_Pos[i] && gDialedNumbers_ListEntryReceptionInformation[i] ==TRUE))
                                        {   
                                            current_element =i; 
                                            CacheElements   =TRUE;
                                        }
                                        //if not already cached, then store element only, if Cache is build-up!
                                        else if((gDialedNumbers_ListHandlingType !=TEL_DIALEDNUMBERS_NOCACHE))
                                            CacheElements   =TRUE;
                                    }
                                                                       
                                    if (transmitpos)
                                    {   
                                        if(CacheElements ==TRUE)
                                        {   
                                            if(indexsize)
                                            {    
                                                gDialedNumbers_Pos[current_element] =Indication_array[Offset];
                                                Offset++;
                                                gDialedNumbers_Pos[current_element] +=Indication_array[Offset] *0x100;
                                            }
                                            else
                                                gDialedNumbers_Pos[current_element] =Indication_array[Offset]; 
                                        }
                                        Offset++;
                                    }
                                    else if(CacheElements ==TRUE)
                                    {
                                        if(direction ==FORWARD && shift==FALSE)
                                            gDialedNumbers_Pos[current_element] =startelement+j;
                                        
                                        else if(direction ==FORWARD && shift==TRUE)
                                            gDialedNumbers_Pos[current_element] =startelement+j+1;

                                        else if(direction ==BACKWARD && shift==FALSE)
                                            gDialedNumbers_Pos[current_element] =startelement-j;
                                        
                                        else if((direction ==BACKWARD) && (shift==TRUE) && (startelement !=0))
                                            gDialedNumbers_Pos[current_element] =startelement-j-1;  
                                    }

                                    //TelNumber
                                    if(CacheElements ==TRUE)
                                    {
                                        for(i=0; i<TEL_DIALEDNUMBERS_TELNUMBER_LENGTH;i++) //clear
			                                gDialedNumbers_TelNumber[current_element][i] =0; 
                                    }
                                         
                                    length =Indication_array[Offset];
                                    Offset++;
                                    
                                    for(i=0; i<length;i++) //copy data
                                    {   
                                        if(CacheElements ==TRUE)
                                            gDialedNumbers_TelNumber[current_element][i] =Indication_array[Offset];
                                        Offset++;
                                    }
                                    
                                    //Day
                                    if(CacheElements ==TRUE)
                                    {
                                        gDialedNumbers_day[current_element] =Indication_array[Offset];
                                        Offset++;
                                    }

                                    //Month
                                    if(CacheElements ==TRUE)
                                    {
                                        gDialedNumbers_month[current_element] =Indication_array[Offset];
                                        Offset++;
                                    }

                                    //Year
                                    if(CacheElements ==TRUE)
                                    {
                                        gDialedNumbers_year[current_element] =Indication_array[Offset];
                                        Offset++;
                                    }

                                    //Hour
                                    if(CacheElements ==TRUE)
                                    {
                                        gDialedNumbers_hour[current_element] =Indication_array[Offset];
                                        Offset++;
                                    }

                                    //Minute
                                    if(CacheElements ==TRUE)
                                    {
                                        gDialedNumbers_minute[current_element] =Indication_array[Offset];
                                        Offset++;
                                    }

                                    //Second
                                    if(CacheElements ==TRUE)
                                    {
                                        gDialedNumbers_second[current_element] =Indication_array[Offset];
                                        Offset++;
                                    }
                                    
                                    if(CacheElements ==TRUE)                                    
                                        gDialedNumbers_ListEntryReceptionInformation [current_element] =TRUE;
                                                       
                                    current_element =DialedNumbers_GetNextLineInCache (current_element, direction); //go on with next element     
                                }   //copy data of current element finished
                            } //copy of elements finished       
                        } //startelement=0 ends
    
                        /***startelement !=0***/
                        else //if (((startelement !=0) && (gDialedNumbers_ListHandlingType ==TEL_DIALEDNUMBERS_BUILDUPCACHE)) || ((startelement ==0) && (gDialedNumbers_ListHandlingType !=TEL_DIALEDNUMBERS_BUILDUPCACHE))) //startelement !=0
                        {
                            //searching for valid startelement in stored list
					        for(i=0;i<TEL_DIALEDNUMBERS_ASGCACHE_MAX_SIZE;i++)
					        {
						        if(gDialedNumbers_Pos[i] ==startelement)				//found a valid element
						        {                                                                                  
                                    current_element     =i;                         //found element is valid_startelement
						            StartElementInCache =TRUE;
                                    i                   =TEL_DIALEDNUMBERS_ASGCACHE_MAX_SIZE;
                                }
					        }
                            if (StartElementInCache)
                            {   
                                if (shift ==TRUE && startelement!=0) //first array element is next element
                                    current_element =DialedNumbers_GetNextLineInCache (current_element, direction);                 
                                else if(shift ==TRUE && startelement==0 && direction ==FORWARD)
                                    current_element=5;
                                   
                                for (j=0; j<elements;j++) //copy elements
                                {
                                    if(current_element !=TEL_DIALEDNUMBERS_NO_NEXT_POSITION)
                                    {
                                        CacheElements =TRUE;
                                        //if element already exist in ASG-cache, search the position 
                                        for (i=0; i<TEL_DIALEDNUMBERS_ASGCACHE_MAX_SIZE; i++)
                                        {   
                                            if((transmitpos ==TRUE) && gDialedNumbers_ListEntryReceptionInformation[i] ==TRUE)
                                            {   
                                                startelement_check =0;
                                                if(indexsize)
                                                    startelement_check =Indication_array[Offset] +(Indication_array[Offset+1]*0x100); 
                                                else
                                                    startelement_check =Indication_array[Offset];
                                               
                                                if(startelement_check ==gDialedNumbers_Pos[i])
                                                {   
                                                    current_element =i; 
                                                    CacheElements   =TRUE;
                                                }
                                                startelement_check=0;
                                            }  
                                        }
                                    }
                                    else
                                        CacheElements =FALSE;
                                        
                                    if (transmitpos)
                                    {   
                                        if(CacheElements ==TRUE)
                                        {   
                                            if(indexsize)
                                            {    
                                                gDialedNumbers_Pos[current_element] =Indication_array[Offset];
                                                Offset++;
                                                gDialedNumbers_Pos[current_element] +=Indication_array[Offset] *0x100;
                                            }
                                            else
                                                gDialedNumbers_Pos[current_element] =Indication_array[Offset];
                                        }
                                        Offset++;
                                    }
                                    else if(CacheElements ==TRUE)
                                    {
                                        if(direction ==FORWARD && shift==FALSE)
                                            gDialedNumbers_Pos[current_element] =startelement+j;
                                        
                                        else if(direction ==FORWARD && shift==TRUE)
                                            gDialedNumbers_Pos[current_element] =startelement+j+1;

                                        else if(direction ==BACKWARD && shift==FALSE)
                                            gDialedNumbers_Pos[current_element] =startelement-j;
                                        
                                        else if((direction ==BACKWARD) && (shift==TRUE) && (startelement !=0))
                                            gDialedNumbers_Pos[current_element] =startelement-j-1;  
                                    }

                                    //TelNumber
                                    if(CacheElements ==TRUE)
                                    {
                                        for(i=0; i<TEL_DIALEDNUMBERS_TELNUMBER_LENGTH;i++) //clear
			                                gDialedNumbers_TelNumber[current_element][i] =0; 
                                    }
                                         
                                    length =Indication_array[Offset];
                                    Offset++;
                                    
                                    for(i=0; i<length;i++) //copy data
                                    {   
                                        if(CacheElements ==TRUE)
                                            gDialedNumbers_TelNumber[current_element][i] =Indication_array[Offset];
                                        Offset++;
                                    }
                                    
                                    //Day
                                    if(CacheElements ==TRUE)
                                    {
                                        gDialedNumbers_day[current_element] =Indication_array[Offset];
                                        Offset++;
                                    }

                                    //Month
                                    if(CacheElements ==TRUE)
                                    {
                                        gDialedNumbers_month[current_element] =Indication_array[Offset];
                                        Offset++;
                                    }

                                    //Year
                                    if(CacheElements ==TRUE)
                                    {
                                        gDialedNumbers_year[current_element] =Indication_array[Offset];
                                        Offset++;
                                    }

                                    //Hour
                                    if(CacheElements ==TRUE)
                                    {
                                        gDialedNumbers_hour[current_element] =Indication_array[Offset];
                                        Offset++;
                                    }

                                    //Minute
                                    if(CacheElements ==TRUE)
                                    {
                                        gDialedNumbers_minute[current_element] =Indication_array[Offset];
                                        Offset++;
                                    }

                                    //Second
                                    if(CacheElements ==TRUE)
                                    {
                                        gDialedNumbers_second[current_element] =Indication_array[Offset];
                                        Offset++;
                                    }
                                    
                                    if(CacheElements ==TRUE)                                   
                                        gDialedNumbers_ListEntryReceptionInformation [current_element] =TRUE;
                                    
                                    if(CacheElements ==TRUE)    
                                        current_element =DialedNumbers_GetNextLineInCache (current_element, direction); //go on with next element       
                                }   //copy data of current element finished
                            }       //copy of elements finished
                        }
                        
                     break; //recordaddress =2 ends
                    
                    case 15: //recordaddress =0xf -> Pos
                        /***startelement ==0***/                        
                        if(0==startelement && gDialedNumbers_ListHandlingType ==TEL_DIALEDNUMBERS_BUILDUPCACHE)
                        {     
                            /***find "start line" in ASG cache***/
                            if(FORWARD ==direction)
                            {    
                                if (gDialedNumbers_cacheDown)
                                {   
                                    current_element         =5; //it's the Pos of last element in ASG cache
                                    
                                    //reset "sliding window" values
                                    gDialedNumbers_cacheDown         =FALSE;
                                }
                                else
                                    current_element =startelement;
                                    
                                if (shift ==TRUE) //startelement not next element
                                    current_element =DialedNumbers_GetNextLineInCache (current_element, direction);   
                            }
                            
                            else if(BACKWARD ==direction && shift==TRUE)
                            {
                                if(gDialedNumbers_cacheUp)
                                {   
                                    current_element         =6; //it's the Pos of first element in ASG cache
                                    
                                    //reset "sliding window" values
                                        gDialedNumbers_cacheUp           =FALSE;
                                }
                                else 
                                    current_element =TEL_DIALEDNUMBERS_ASGCACHE_MAX_SIZE -1; // position of last element in array 
                            }                
                                
                            /***copy elements***/
                            if (current_element !=TEL_DIALEDNUMBERS_NO_NEXT_POSITION) 
                            {
                                for (j=0; j<elements;j++) //copy elements
                                {   
                                    //check, if elements must be cached and in case find position in array
                                    CacheElements =FALSE;
                                    for (i=0; i<TEL_DIALEDNUMBERS_ASGCACHE_MAX_SIZE; i++)
                                    {  
                                        //if element already cached, find position in ASG-cache
                                        if(indexsize ==FALSE && (transmitpos ==TRUE) && Indication_array[Offset] ==gDialedNumbers_Pos[i] && gDialedNumbers_ListEntryReceptionInformation[i] ==TRUE)
                                        {   
                                            current_element =i; 
                                            CacheElements   =TRUE;
                                        }
                                        else if((indexsize ==TRUE && (transmitpos ==TRUE) && (Indication_array[Offset] +(Indication_array[Offset+1]*0x100)) ==gDialedNumbers_Pos[i] && gDialedNumbers_ListEntryReceptionInformation[i] ==TRUE))
                                        {   
                                            current_element =i; 
                                            CacheElements   =TRUE;
                                        }
                                        //if not already cached, then store element only, if Cache is build-up!
                                        else if((gDialedNumbers_ListHandlingType !=TEL_DIALEDNUMBERS_NOCACHE))
                                            CacheElements   =TRUE;
                                    }
                                                                       
                                    if (transmitpos)
                                    {   
                                        if(CacheElements ==TRUE)
                                        {   
                                            if(indexsize)
                                            {    
                                                gDialedNumbers_Pos[current_element] =Indication_array[Offset];
                                                Offset++;
                                                gDialedNumbers_Pos[current_element] +=Indication_array[Offset] *0x100;
                                            }
                                            else
                                                gDialedNumbers_Pos[current_element] =Indication_array[Offset]; 
                                        }
                                        Offset++;
                                    }
                                    else if(CacheElements ==TRUE)
                                    {
                                        if(direction ==FORWARD && shift==FALSE)
                                            gDialedNumbers_Pos[current_element] =startelement+j;
                                        
                                        else if(direction ==FORWARD && shift==TRUE)
                                            gDialedNumbers_Pos[current_element] =startelement+j+1;

                                        else if(direction ==BACKWARD && shift==FALSE)
                                            gDialedNumbers_Pos[current_element] =startelement-j;
                                        
                                        else if((direction ==BACKWARD) && (shift==TRUE) && (startelement !=0))
                                            gDialedNumbers_Pos[current_element] =startelement-j-1;  
                                    }
                                    
                                    if(CacheElements ==TRUE)                                    
                                        gDialedNumbers_ListEntryReceptionInformation [current_element] =TRUE;
                                                       
                                    current_element =DialedNumbers_GetNextLineInCache (current_element, direction); //go on with next element     
                                }   //copy data of current element finished
                            } //copy of elements finished       
                        } //startelement=0 ends
    
                        /***startelement !=0***/
                        else //if (((startelement !=0) && (gDialedNumbers_ListHandlingType ==TEL_DIALEDNUMBERS_BUILDUPCACHE)) || ((startelement ==0) && (gDialedNumbers_ListHandlingType !=TEL_DIALEDNUMBERS_BUILDUPCACHE))) //startelement !=0
                        {
                            //searching for valid startelement in stored list
					        for(i=0;i<TEL_DIALEDNUMBERS_ASGCACHE_MAX_SIZE;i++)
					        {
						        if(gDialedNumbers_Pos[i] ==startelement)				//found a valid element
						        {                                                                                  
                                    current_element     =i;                         //found element is valid_startelement
						            StartElementInCache =TRUE;
                                    i                   =TEL_DIALEDNUMBERS_ASGCACHE_MAX_SIZE;
                                }
					        }
                            if (StartElementInCache)
                            {   
                                if (shift ==TRUE && startelement!=0) //first array element is next element
                                    current_element =DialedNumbers_GetNextLineInCache (current_element, direction);                 
                                else if(shift ==TRUE && startelement==0 && direction ==FORWARD)
                                    current_element=5;
                                   
                                for (j=0; j<elements;j++) //copy elements
                                {
                                    if(current_element !=TEL_DIALEDNUMBERS_NO_NEXT_POSITION)
                                    {
                                        CacheElements =TRUE;
                                        //if element already exist in ASG-cache, search the position 
                                        for (i=0; i<TEL_DIALEDNUMBERS_ASGCACHE_MAX_SIZE; i++)
                                        {   
                                            if((transmitpos ==TRUE) && gDialedNumbers_ListEntryReceptionInformation[i] ==TRUE)
                                            {   
                                                startelement_check =0;
                                                if(indexsize)
                                                    startelement_check =Indication_array[Offset] +(Indication_array[Offset+1]*0x100); 
                                                else
                                                    startelement_check =Indication_array[Offset];
                                               
                                                if(startelement_check ==gDialedNumbers_Pos[i])
                                                {   
                                                    current_element =i; 
                                                    CacheElements   =TRUE;
                                                }
                                                startelement_check=0;
                                            }  
                                        }
                                    }
                                    else
                                        CacheElements =FALSE;
                                        
                                    if (transmitpos)
                                    {   
                                        if(CacheElements ==TRUE)
                                        {   
                                            if(indexsize)
                                            {    
                                                gDialedNumbers_Pos[current_element] =Indication_array[Offset];
                                                Offset++;
                                                gDialedNumbers_Pos[current_element] +=Indication_array[Offset] *0x100;
                                            }
                                            else
                                                gDialedNumbers_Pos[current_element] =Indication_array[Offset];
                                        }
                                        Offset++;
                                    }
                                    else if(CacheElements ==TRUE)
                                    {
                                        if(direction ==FORWARD && shift==FALSE)
                                            gDialedNumbers_Pos[current_element] =startelement+j;
                                        
                                        else if(direction ==FORWARD && shift==TRUE)
                                            gDialedNumbers_Pos[current_element] =startelement+j+1;

                                        else if(direction ==BACKWARD && shift==FALSE)
                                            gDialedNumbers_Pos[current_element] =startelement-j;
                                        
                                        else if((direction ==BACKWARD) && (shift==TRUE) && (startelement !=0))
                                            gDialedNumbers_Pos[current_element] =startelement-j-1;  
                                    }
                                    
                                    
                                    if(CacheElements ==TRUE)                                   
                                        gDialedNumbers_ListEntryReceptionInformation [current_element] =TRUE;
                                    
                                    if(CacheElements ==TRUE)    
                                        current_element =DialedNumbers_GetNextLineInCache (current_element, direction); //go on with next element       
                                }   //copy data of current element finished
                            }       //copy of elements finished
                        }
                        
                     break; //recordaddress =0xf ends
                }
                                   
                //Panel
                putvalue(env_ASG_DN_ASGID, gDialedNumbers_ASGID);
                putvalue(env_ASG_DN_TAID, gDialedNumbers_TAID);
                putvalue(env_ASG_DN_TotalNumLE, gDialedNumbers_TotalNumListElements);

                gDialedNumbers_recordaddress =recordaddress;
                gDialedNumbers_transmitpos   =transmitpos;             
            
			break;
            
            case Changed_IND:
                //get data  
                /***ArrayHeader***/
                mode            =(Indication_array[3] &0xF0) /0x10;
                recordaddress   =Indication_array[3] &0x0F;
                Offset =4;
                
                // decode "mode-byte"
                shift       =mode &0x01;
                direction   =(mode &0x02)/0x02;
                transmitpos =(mode &0x04)/0x04;
                indexsize   =(mode &0x08)/0x08; 

                if (indexsize)
                {   
                    startelement =Indication_array[Offset];
                    Offset++;
                    startelement +=(Indication_array[Offset] *0x100);
                    Offset++;

                    elements =Indication_array[Offset];
                    Offset++;
                    elements +=(Indication_array[Offset] *0x100);
                    Offset++;
                }
                else
                {   
                    startelement =Indication_array[Offset];
                    Offset++;

                    elements =Indication_array[Offset];
                    Offset++;
                }           
            
                if(startelement !=0)
                {
                    for (i=0;i<TEL_DIALEDNUMBERS_ASGCACHE_MAX_SIZE;i++)
                    {
                        if(startelement ==gDialedNumbers_Pos[i])  
                            i =TEL_DIALEDNUMBERS_ASGCACHE_MAX_SIZE;              
                    }
                }                   

                if(datalength>0x8) // if ChangedArray includes data
                {
                    switch (recordaddress)
                    {
                        case 0: //recordaddress =0 -> complete record

                            /***startelement ==0***/                        
                            if(0==startelement && gDialedNumbers_ListHandlingType ==TEL_DIALEDNUMBERS_BUILDUPCACHE)
                            {     
                                /***find "start line" in ASG cache***/
                                if(FORWARD ==direction)
                                {    
                                    if (gDialedNumbers_cacheDown)
                                    {   
                                        current_element         =5; //it's the Pos of last element in ASG cache
                                    
                                        //reset "sliding window" values
                                        gDialedNumbers_cacheDown         =FALSE;
                                    }
                                    else
                                        current_element =startelement;
                                    
                                    if (shift ==TRUE) //startelement not next element
                                        current_element =DialedNumbers_GetNextLineInCache (current_element, direction);   
                                }
                            
                                else if(BACKWARD ==direction && shift==TRUE)
                                {
                                    if(gDialedNumbers_cacheUp)
                                    {   
                                        current_element         =6; //it's the Pos of first element in ASG cache
                                    
                                        //reset "sliding window" values
                                            gDialedNumbers_cacheUp           =FALSE;
                                    }
                                    else 
                                        current_element =TEL_DIALEDNUMBERS_ASGCACHE_MAX_SIZE -1; // position of last element in array 
                                }                
                                
                                /***copy elements***/
                                if (current_element !=TEL_DIALEDNUMBERS_NO_NEXT_POSITION) 
                                {
                                    for (j=0; j<elements;j++) //copy elements
                                    {   
                                        //check, if elements must be cached and in case find position in array
                                        CacheElements =FALSE;
                                        for (i=0; i<TEL_DIALEDNUMBERS_ASGCACHE_MAX_SIZE; i++)
                                        {  
                                            //if element already cached, find position in ASG-cache
                                            if(indexsize ==FALSE && (transmitpos ==TRUE) && Indication_array[Offset] ==gDialedNumbers_Pos[i] && gDialedNumbers_ListEntryReceptionInformation[i] ==TRUE)
                                            {   
                                                current_element =i; 
                                                CacheElements   =TRUE;
                                            }
                                            else if((indexsize ==TRUE && (transmitpos ==TRUE) && (Indication_array[Offset] +(Indication_array[Offset+1]*0x100)) ==gDialedNumbers_Pos[i] && gDialedNumbers_ListEntryReceptionInformation[i] ==TRUE))
                                            {   
                                                current_element =i; 
                                                CacheElements   =TRUE;
                                            }
                                            //if not already cached, then store element only, if Cache is build-up!
                                            else if((gDialedNumbers_ListHandlingType !=TEL_DIALEDNUMBERS_NOCACHE))
                                                CacheElements   =TRUE;
                                        }
                                                                       
                                        if (transmitpos)
                                        {   
                                            if(CacheElements ==TRUE)
                                            {   
                                                if(indexsize)
                                                {    
                                                    gDialedNumbers_Pos[current_element] =Indication_array[Offset];
                                                    Offset++;
                                                    gDialedNumbers_Pos[current_element] +=Indication_array[Offset] *0x100;
                                                }
                                                else
                                                    gDialedNumbers_Pos[current_element] =Indication_array[Offset]; 
                                            }
                                            Offset++;
                                        }
                                    
                                        //PbName
                                        if(CacheElements ==TRUE)
                                        {
                                            for(i=0; i<TEL_DIALEDNUMBERS_PBNAME_LENGTH;i++) //clear
			                                    gDialedNumbers_PbName[current_element][i] =0; 
                                        }
                                         
                                        length =Indication_array[Offset];
                                        Offset++;
                                    
                                        for(i=0; i<length;i++) //copy data
                                        {   
                                            if(CacheElements ==TRUE)
                                                gDialedNumbers_PbName[current_element][i] =Indication_array[Offset];
                                            Offset++;
                                        }
                                    
                                        //NumberType
                                        if(CacheElements ==TRUE)
                                        {
                                            gDialedNumbers_NumberType[current_element] =Indication_array[Offset];
                                            Offset++;
                                        }

                                        //TelNumber
                                        if(CacheElements ==TRUE)
                                        {
                                            for(i=0; i<TEL_DIALEDNUMBERS_TELNUMBER_LENGTH;i++) //clear
			                                    gDialedNumbers_TelNumber[current_element][i] =0; 
                                        }
                                         
                                        length =Indication_array[Offset];
                                        Offset++;
                                    
                                        for(i=0; i<length;i++) //copy data
                                        {   
                                            if(CacheElements ==TRUE)
                                                gDialedNumbers_TelNumber[current_element][i] =Indication_array[Offset];
                                            Offset++;
                                        }
                                    
                                        //Day
                                        if(CacheElements ==TRUE)
                                        {
                                            gDialedNumbers_day[current_element] =Indication_array[Offset];
                                            Offset++;
                                        }

                                        //Month
                                        if(CacheElements ==TRUE)
                                        {
                                            gDialedNumbers_month[current_element] =Indication_array[Offset];
                                            Offset++;
                                        }

                                        //Year
                                        if(CacheElements ==TRUE)
                                        {
                                            gDialedNumbers_year[current_element] =Indication_array[Offset];
                                            Offset++;
                                        }

                                        //Hour
                                        if(CacheElements ==TRUE)
                                        {
                                            gDialedNumbers_hour[current_element] =Indication_array[Offset];
                                            Offset++;
                                        }

                                        //Minute
                                        if(CacheElements ==TRUE)
                                        {
                                            gDialedNumbers_minute[current_element] =Indication_array[Offset];
                                            Offset++;
                                        }

                                        //Second
                                        if(CacheElements ==TRUE)
                                        {
                                            gDialedNumbers_second[current_element] =Indication_array[Offset];
                                            Offset++;
                                        }
                                    
                                        if(CacheElements ==TRUE)                                    
                                            gDialedNumbers_ListEntryReceptionInformation [current_element] =TRUE;
                                                       
                                        current_element =DialedNumbers_GetNextLineInCache (current_element, direction); //go on with next element     
                                    }   //copy data of current element finished
                                } //copy of elements finished       
                            } //startelement=0 ends
    
                            /***startelement !=0***/
                            else //if (((startelement !=0) && (gDialedNumbers_ListHandlingType ==TEL_DIALEDNUMBERS_BUILDUPCACHE)) || ((startelement ==0) && (gDialedNumbers_ListHandlingType !=TEL_DIALEDNUMBERS_BUILDUPCACHE))) //startelement !=0
                            {
                                //searching for valid startelement in stored list
					            for(i=0;i<TEL_DIALEDNUMBERS_ASGCACHE_MAX_SIZE;i++)
					            {
						            if(gDialedNumbers_Pos[i] ==startelement)				//found a valid element
						            {                                                                                  
                                        current_element     =i;                         //found element is valid_startelement
						                StartElementInCache =TRUE;
                                        i                   =TEL_DIALEDNUMBERS_ASGCACHE_MAX_SIZE;
                                    }
					            }
                                if (StartElementInCache)
                                {   
                                    if (shift ==TRUE && startelement!=0) //first array element is next element
                                        current_element =DialedNumbers_GetNextLineInCache (current_element, direction);                 
                                    else if(shift ==TRUE && startelement==0 && direction ==FORWARD)
                                        current_element=5;
                                   
                                    for (j=0; j<elements;j++) //copy elements
                                    {
                                        if(current_element !=TEL_DIALEDNUMBERS_NO_NEXT_POSITION)
                                        {
                                            CacheElements =TRUE;
                                            //if element already exist in ASG-cache, search the position 
                                            for (i=0; i<TEL_DIALEDNUMBERS_ASGCACHE_MAX_SIZE; i++)
                                            {   
                                                if((transmitpos ==TRUE) && gDialedNumbers_ListEntryReceptionInformation[i] ==TRUE)
                                                {   
                                                    startelement_check =0;
                                                    if(indexsize)
                                                        startelement_check =Indication_array[Offset] +(Indication_array[Offset+1]*0x100); 
                                                    else
                                                        startelement_check =Indication_array[Offset];
                                               
                                                    if(startelement_check ==gDialedNumbers_Pos[i])
                                                    {   
                                                        current_element =i; 
                                                        CacheElements   =TRUE;
                                                    }
                                                    startelement_check=0;
                                                }  
                                            }
                                        }
                                        else
                                            CacheElements =FALSE;
                                        
                                        if (transmitpos)
                                        {   
                                            if(CacheElements ==TRUE)
                                            {   
                                                if(indexsize)
                                                {    
                                                    gDialedNumbers_Pos[current_element] =Indication_array[Offset];
                                                    Offset++;
                                                    gDialedNumbers_Pos[current_element] +=Indication_array[Offset] *0x100;
                                                }
                                                else
                                                    gDialedNumbers_Pos[current_element] =Indication_array[Offset];
                                            }
                                            Offset++;
                                        }
                                    
                                        //PbName
                                        if(CacheElements ==TRUE)
                                        {
                                            for(i=0; i<TEL_DIALEDNUMBERS_PBNAME_LENGTH;i++) //clear
			                                    gDialedNumbers_PbName[current_element][i] =0; 
                                        }
                                         
                                        length =Indication_array[Offset];
                                        Offset++;
                                    
                                        for(i=0; i<length;i++) //copy data
                                        {   
                                            if(CacheElements ==TRUE)
                                                gDialedNumbers_PbName[current_element][i] =Indication_array[Offset];
                                            Offset++;
                                        }
                                    
                                        //NumberType
                                        if(CacheElements ==TRUE)
                                        {
                                            gDialedNumbers_NumberType[current_element] =Indication_array[Offset];
                                            Offset++;
                                        }

                                        //TelNumber
                                        if(CacheElements ==TRUE)
                                        {
                                            for(i=0; i<TEL_DIALEDNUMBERS_TELNUMBER_LENGTH;i++) //clear
			                                    gDialedNumbers_TelNumber[current_element][i] =0; 
                                        }
                                         
                                        length =Indication_array[Offset];
                                        Offset++;
                                    
                                        for(i=0; i<length;i++) //copy data
                                        {   
                                            if(CacheElements ==TRUE)
                                                gDialedNumbers_TelNumber[current_element][i] =Indication_array[Offset];
                                            Offset++;
                                        }
                                    
                                        //Day
                                        if(CacheElements ==TRUE)
                                        {
                                            gDialedNumbers_day[current_element] =Indication_array[Offset];
                                            Offset++;
                                        }

                                        //Month
                                        if(CacheElements ==TRUE)
                                        {
                                            gDialedNumbers_month[current_element] =Indication_array[Offset];
                                            Offset++;
                                        }

                                        //Year
                                        if(CacheElements ==TRUE)
                                        {
                                            gDialedNumbers_year[current_element] =Indication_array[Offset];
                                            Offset++;
                                        }

                                        //Hour
                                        if(CacheElements ==TRUE)
                                        {
                                            gDialedNumbers_hour[current_element] =Indication_array[Offset];
                                            Offset++;
                                        }

                                        //Minute
                                        if(CacheElements ==TRUE)
                                        {
                                            gDialedNumbers_minute[current_element] =Indication_array[Offset];
                                            Offset++;
                                        }

                                        //Second
                                        if(CacheElements ==TRUE)
                                        {
                                            gDialedNumbers_second[current_element] =Indication_array[Offset];
                                            Offset++;
                                        }
                                    
                                        if(CacheElements ==TRUE)                                   
                                            gDialedNumbers_ListEntryReceptionInformation [current_element] =TRUE;
                                    
                                        if(CacheElements ==TRUE)    
                                            current_element =DialedNumbers_GetNextLineInCache (current_element, direction); //go on with next element       
                                    }   //copy data of current element finished
                                }       //copy of elements finished
                            }           //startelement !=0 ends
                        
                        break; //recordaddress =0 ends
                    
                        case 1: //recordaddress =1 -> PbName, NumberType
                                /***startelement ==0***/                        
                            if(0==startelement && gDialedNumbers_ListHandlingType ==TEL_DIALEDNUMBERS_BUILDUPCACHE)
                            {     
                                /***find "start line" in ASG cache***/
                                if(FORWARD ==direction)
                                {    
                                    if (gDialedNumbers_cacheDown)
                                    {   
                                        current_element         =5; //it's the Pos of last element in ASG cache
                                    
                                        //reset "sliding window" values
                                        gDialedNumbers_cacheDown         =FALSE;
                                    }
                                    else
                                        current_element =startelement;
                                    
                                    if (shift ==TRUE) //startelement not next element
                                        current_element =DialedNumbers_GetNextLineInCache (current_element, direction);   
                                }   
                            
                                else if(BACKWARD ==direction && shift==TRUE)
                                {
                                    if(gDialedNumbers_cacheUp)
                                    {   
                                        current_element         =6; //it's the Pos of first element in ASG cache
                                    
                                        //reset "sliding window" values
                                            gDialedNumbers_cacheUp           =FALSE;
                                    }
                                    else 
                                        current_element =TEL_DIALEDNUMBERS_ASGCACHE_MAX_SIZE -1; // position of last element in array 
                                }                
                                
                                /***copy elements***/
                                if (current_element !=TEL_DIALEDNUMBERS_NO_NEXT_POSITION) 
                                {
                                    for (j=0; j<elements;j++) //copy elements
                                    {   
                                        //check, if elements must be cached and in case find position in array
                                        CacheElements =FALSE;
                                        for (i=0; i<TEL_DIALEDNUMBERS_ASGCACHE_MAX_SIZE; i++)
                                        {  
                                            //if element already cached, find position in ASG-cache
                                            if(indexsize ==FALSE && (transmitpos ==TRUE) && Indication_array[Offset] ==gDialedNumbers_Pos[i] && gDialedNumbers_ListEntryReceptionInformation[i] ==TRUE)
                                            {   
                                                current_element =i; 
                                                CacheElements   =TRUE;
                                            }
                                            else if((indexsize ==TRUE && (transmitpos ==TRUE) && (Indication_array[Offset] +(Indication_array[Offset+1]*0x100)) ==gDialedNumbers_Pos[i] && gDialedNumbers_ListEntryReceptionInformation[i] ==TRUE))
                                            {   
                                                current_element =i; 
                                                CacheElements   =TRUE;
                                            }
                                            //if not already cached, then store element only, if Cache is build-up!
                                            else if((gDialedNumbers_ListHandlingType !=TEL_DIALEDNUMBERS_NOCACHE))
                                                CacheElements   =TRUE;
                                        }
                                                                       
                                        if (transmitpos)
                                        {   
                                            if(CacheElements ==TRUE)
                                            {   
                                                if(indexsize)
                                                {    
                                                    gDialedNumbers_Pos[current_element] =Indication_array[Offset];
                                                    Offset++;
                                                    gDialedNumbers_Pos[current_element] +=Indication_array[Offset] *0x100;
                                                }
                                                else
                                                    gDialedNumbers_Pos[current_element] =Indication_array[Offset]; 
                                            }
                                            Offset++;
                                        }
                                    
                                        //PbName
                                        if(CacheElements ==TRUE)
                                        {
                                            for(i=0; i<TEL_DIALEDNUMBERS_PBNAME_LENGTH;i++) //clear
			                                    gDialedNumbers_PbName[current_element][i] =0; 
                                        }
                                         
                                        length =Indication_array[Offset];
                                        Offset++;
                                    
                                        for(i=0; i<length;i++) //copy data
                                        {   
                                            if(CacheElements ==TRUE)
                                                gDialedNumbers_PbName[current_element][i] =Indication_array[Offset];
                                            Offset++;
                                        }
                                    
                                        //NumberType
                                        if(CacheElements ==TRUE)
                                        {
                                            gDialedNumbers_NumberType[current_element] =Indication_array[Offset];
                                            Offset++;
                                        }
                                    
                                        if(CacheElements ==TRUE)                                    
                                            gDialedNumbers_ListEntryReceptionInformation [current_element] =TRUE;
                                                       
                                        current_element =DialedNumbers_GetNextLineInCache (current_element, direction); //go on with next element     
                                    }   //copy data of current element finished
                                } //copy of elements finished       
                            } //startelement=0 ends
    
                            /***startelement !=0***/
                            else //if (((startelement !=0) && (gDialedNumbers_ListHandlingType ==TEL_DIALEDNUMBERS_BUILDUPCACHE)) || ((startelement ==0) && (gDialedNumbers_ListHandlingType !=TEL_DIALEDNUMBERS_BUILDUPCACHE))) //startelement !=0
                            {
                                //searching for valid startelement in stored list
					            for(i=0;i<TEL_DIALEDNUMBERS_ASGCACHE_MAX_SIZE;i++)
					            {
						            if(gDialedNumbers_Pos[i] ==startelement)				//found a valid element
						            {                                                                                  
                                        current_element     =i;                         //found element is valid_startelement
						                StartElementInCache =TRUE;
                                        i                   =TEL_DIALEDNUMBERS_ASGCACHE_MAX_SIZE;
                                    }
					            }
                                if (StartElementInCache)
                                {   
                                    if (shift ==TRUE && startelement!=0) //first array element is next element
                                        current_element =DialedNumbers_GetNextLineInCache (current_element, direction);                 
                                    else if(shift ==TRUE && startelement==0 && direction ==FORWARD)
                                        current_element=5;
                                   
                                    for (j=0; j<elements;j++) //copy elements
                                    {
                                        if(current_element !=TEL_DIALEDNUMBERS_NO_NEXT_POSITION)
                                        {
                                            CacheElements =TRUE;
                                            //if element already exist in ASG-cache, search the position 
                                            for (i=0; i<TEL_DIALEDNUMBERS_ASGCACHE_MAX_SIZE; i++)
                                            {   
                                                if((transmitpos ==TRUE) && gDialedNumbers_ListEntryReceptionInformation[i] ==TRUE)
                                                {   
                                                    startelement_check =0;
                                                    if(indexsize)
                                                        startelement_check =Indication_array[Offset] +(Indication_array[Offset+1]*0x100); 
                                                    else
                                                        startelement_check =Indication_array[Offset];
                                               
                                                    if(startelement_check ==gDialedNumbers_Pos[i])
                                                    {   
                                                        current_element =i; 
                                                        CacheElements   =TRUE;
                                                    }
                                                    startelement_check=0;
                                                }  
                                            }
                                        }
                                        else
                                            CacheElements =FALSE;
                                        
                                        if (transmitpos)
                                        {   
                                            if(CacheElements ==TRUE)
                                            {   
                                                if(indexsize)
                                                {    
                                                    gDialedNumbers_Pos[current_element] =Indication_array[Offset];
                                                    Offset++;
                                                    gDialedNumbers_Pos[current_element] +=Indication_array[Offset] *0x100;
                                                }
                                                else
                                                    gDialedNumbers_Pos[current_element] =Indication_array[Offset];
                                            }
                                            Offset++;
                                        }
                                    
                                        //PbName
                                        if(CacheElements ==TRUE)
                                        {
                                            for(i=0; i<TEL_DIALEDNUMBERS_PBNAME_LENGTH;i++) //clear
			                                    gDialedNumbers_PbName[current_element][i] =0; 
                                        }
                                         
                                        length =Indication_array[Offset];
                                        Offset++;
                                    
                                        for(i=0; i<length;i++) //copy data
                                        {   
                                            if(CacheElements ==TRUE)
                                                gDialedNumbers_PbName[current_element][i] =Indication_array[Offset];
                                            Offset++;
                                        }
                                    
                                        //NumberType
                                        if(CacheElements ==TRUE)
                                        {
                                            gDialedNumbers_NumberType[current_element] =Indication_array[Offset];
                                            Offset++;
                                        }
                                    
                                        if(CacheElements ==TRUE)                                   
                                            gDialedNumbers_ListEntryReceptionInformation [current_element] =TRUE;
                                    
                                        if(CacheElements ==TRUE)    
                                            current_element =DialedNumbers_GetNextLineInCache (current_element, direction); //go on with next element       
                                    }   //copy data of current element finished
                                }       //copy of elements finished
                            }           //startelement !=0 ends   
                        break; //recordaddress =1 ends
                    
                        case 2: //recordaddress =2 -> TelNumber, Day, Month, Year, Hour, Minute, Second
                            /***startelement ==0***/                        
                            if(0==startelement && gDialedNumbers_ListHandlingType ==TEL_DIALEDNUMBERS_BUILDUPCACHE)
                            {     
                                /***find "start line" in ASG cache***/
                                if(FORWARD ==direction)
                                {    
                                    if (gDialedNumbers_cacheDown)
                                    {   
                                        current_element         =5; //it's the Pos of last element in ASG cache
                                    
                                        //reset "sliding window" values
                                        gDialedNumbers_cacheDown         =FALSE;
                                    }
                                    else
                                        current_element =startelement;
                                    
                                    if (shift ==TRUE) //startelement not next element
                                        current_element =DialedNumbers_GetNextLineInCache (current_element, direction);   
                                }
                            
                                else if(BACKWARD ==direction && shift==TRUE)
                                {
                                    if(gDialedNumbers_cacheUp)
                                    {   
                                        current_element         =6; //it's the Pos of first element in ASG cache
                                    
                                        //reset "sliding window" values
                                            gDialedNumbers_cacheUp           =FALSE;
                                    }
                                    else 
                                        current_element =TEL_DIALEDNUMBERS_ASGCACHE_MAX_SIZE -1; // position of last element in array 
                                }                
                                
                                /***copy elements***/
                                if (current_element !=TEL_DIALEDNUMBERS_NO_NEXT_POSITION) 
                                {
                                    for (j=0; j<elements;j++) //copy elements
                                    {   
                                        //check, if elements must be cached and in case find position in array
                                        CacheElements =FALSE;
                                        for (i=0; i<TEL_DIALEDNUMBERS_ASGCACHE_MAX_SIZE; i++)
                                        {  
                                            //if element already cached, find position in ASG-cache
                                            if(indexsize ==FALSE && (transmitpos ==TRUE) && Indication_array[Offset] ==gDialedNumbers_Pos[i] && gDialedNumbers_ListEntryReceptionInformation[i] ==TRUE)
                                            {   
                                                current_element =i; 
                                                CacheElements   =TRUE;
                                            }
                                            else if((indexsize ==TRUE && (transmitpos ==TRUE) && (Indication_array[Offset] +(Indication_array[Offset+1]*0x100)) ==gDialedNumbers_Pos[i] && gDialedNumbers_ListEntryReceptionInformation[i] ==TRUE))
                                            {   
                                                current_element =i; 
                                                CacheElements   =TRUE;
                                            }
                                            //if not already cached, then store element only, if Cache is build-up!
                                            else if((gDialedNumbers_ListHandlingType !=TEL_DIALEDNUMBERS_NOCACHE))
                                                CacheElements   =TRUE;
                                        }
                                                                       
                                        if (transmitpos)
                                        {   
                                            if(CacheElements ==TRUE)
                                            {   
                                                if(indexsize)
                                                {    
                                                    gDialedNumbers_Pos[current_element] =Indication_array[Offset];
                                                    Offset++;
                                                    gDialedNumbers_Pos[current_element] +=Indication_array[Offset] *0x100;
                                                }
                                                else
                                                    gDialedNumbers_Pos[current_element] =Indication_array[Offset]; 
                                            }
                                            Offset++;
                                        }

                                        //TelNumber
                                        if(CacheElements ==TRUE)
                                        {
                                            for(i=0; i<TEL_DIALEDNUMBERS_TELNUMBER_LENGTH;i++) //clear
			                                    gDialedNumbers_TelNumber[current_element][i] =0; 
                                        }
                                         
                                        length =Indication_array[Offset];
                                        Offset++;
                                    
                                        for(i=0; i<length;i++) //copy data
                                        {   
                                            if(CacheElements ==TRUE)
                                                gDialedNumbers_TelNumber[current_element][i] =Indication_array[Offset];
                                            Offset++;
                                        }
                                    
                                        //Day
                                        if(CacheElements ==TRUE)
                                        {
                                            gDialedNumbers_day[current_element] =Indication_array[Offset];
                                            Offset++;
                                        }

                                        //Month
                                        if(CacheElements ==TRUE)
                                        {
                                            gDialedNumbers_month[current_element] =Indication_array[Offset];
                                            Offset++;
                                        }

                                        //Year
                                        if(CacheElements ==TRUE)
                                        {
                                            gDialedNumbers_year[current_element] =Indication_array[Offset];
                                            Offset++;
                                        }

                                        //Hour
                                        if(CacheElements ==TRUE)
                                        {
                                            gDialedNumbers_hour[current_element] =Indication_array[Offset];
                                            Offset++;
                                        }

                                        //Minute
                                        if(CacheElements ==TRUE)
                                        {
                                            gDialedNumbers_minute[current_element] =Indication_array[Offset];
                                            Offset++;
                                        }

                                        //Second
                                        if(CacheElements ==TRUE)
                                        {
                                            gDialedNumbers_second[current_element] =Indication_array[Offset];
                                            Offset++;
                                        }
                                    
                                        if(CacheElements ==TRUE)                                    
                                            gDialedNumbers_ListEntryReceptionInformation [current_element] =TRUE;
                                                       
                                        current_element =DialedNumbers_GetNextLineInCache (current_element, direction); //go on with next element     
                                    }   //copy data of current element finished
                                } //copy of elements finished       
                            } //startelement=0 ends
    
                            /***startelement !=0***/
                            else //if (((startelement !=0) && (gDialedNumbers_ListHandlingType ==TEL_DIALEDNUMBERS_BUILDUPCACHE)) || ((startelement ==0) && (gDialedNumbers_ListHandlingType !=TEL_DIALEDNUMBERS_BUILDUPCACHE))) //startelement !=0
                            {
                                //searching for valid startelement in stored list
					            for(i=0;i<TEL_DIALEDNUMBERS_ASGCACHE_MAX_SIZE;i++)
					            {
						            if(gDialedNumbers_Pos[i] ==startelement)				//found a valid element
						            {                                                                                  
                                        current_element     =i;                         //found element is valid_startelement
						                StartElementInCache =TRUE;
                                        i                   =TEL_DIALEDNUMBERS_ASGCACHE_MAX_SIZE;
                                    }
					            }
                                if (StartElementInCache)
                                {   
                                    if (shift ==TRUE && startelement!=0) //first array element is next element
                                        current_element =DialedNumbers_GetNextLineInCache (current_element, direction);                 
                                    else if(shift ==TRUE && startelement==0 && direction ==FORWARD)
                                        current_element=5;
                                   
                                    for (j=0; j<elements;j++) //copy elements
                                    {
                                        if(current_element !=TEL_DIALEDNUMBERS_NO_NEXT_POSITION)
                                        {
                                            CacheElements =TRUE;
                                            //if element already exist in ASG-cache, search the position 
                                            for (i=0; i<TEL_DIALEDNUMBERS_ASGCACHE_MAX_SIZE; i++)
                                            {   
                                                if((transmitpos ==TRUE) && gDialedNumbers_ListEntryReceptionInformation[i] ==TRUE)
                                                {   
                                                    startelement_check =0;
                                                    if(indexsize)
                                                        startelement_check =Indication_array[Offset] +(Indication_array[Offset+1]*0x100); 
                                                    else
                                                        startelement_check =Indication_array[Offset];
                                               
                                                    if(startelement_check ==gDialedNumbers_Pos[i])
                                                    {   
                                                        current_element =i; 
                                                        CacheElements   =TRUE;
                                                    }
                                                    startelement_check=0;
                                                }  
                                            }
                                        }
                                        else
                                            CacheElements =FALSE;
                                        
                                        if (transmitpos)
                                        {   
                                            if(CacheElements ==TRUE)
                                            {   
                                                if(indexsize)
                                                {    
                                                    gDialedNumbers_Pos[current_element] =Indication_array[Offset];
                                                    Offset++;
                                                    gDialedNumbers_Pos[current_element] +=Indication_array[Offset] *0x100;
                                                }
                                                else
                                                    gDialedNumbers_Pos[current_element] =Indication_array[Offset];
                                            }
                                            Offset++;
                                        }
                                    
                                        //TelNumber
                                        if(CacheElements ==TRUE)
                                        {
                                            for(i=0; i<TEL_DIALEDNUMBERS_TELNUMBER_LENGTH;i++) //clear
			                                    gDialedNumbers_TelNumber[current_element][i] =0; 
                                        }
                                         
                                        length =Indication_array[Offset];
                                        Offset++;
                                    
                                        for(i=0; i<length;i++) //copy data
                                        {   
                                            if(CacheElements ==TRUE)
                                                gDialedNumbers_TelNumber[current_element][i] =Indication_array[Offset];
                                            Offset++;
                                        }
                                    
                                        //Day
                                        if(CacheElements ==TRUE)
                                        {
                                            gDialedNumbers_day[current_element] =Indication_array[Offset];
                                            Offset++;
                                        }

                                        //Month
                                        if(CacheElements ==TRUE)
                                        {
                                            gDialedNumbers_month[current_element] =Indication_array[Offset];
                                            Offset++;
                                        }

                                        //Year
                                        if(CacheElements ==TRUE)
                                        {
                                            gDialedNumbers_year[current_element] =Indication_array[Offset];
                                            Offset++;
                                        }

                                        //Hour
                                        if(CacheElements ==TRUE)
                                        {
                                            gDialedNumbers_hour[current_element] =Indication_array[Offset];
                                            Offset++;
                                        }

                                        //Minute
                                        if(CacheElements ==TRUE)
                                        {
                                            gDialedNumbers_minute[current_element] =Indication_array[Offset];
                                            Offset++;
                                        }

                                        //Second
                                        if(CacheElements ==TRUE)
                                        {
                                            gDialedNumbers_second[current_element] =Indication_array[Offset];
                                            Offset++;
                                        }
                                    
                                        if(CacheElements ==TRUE)                                   
                                            gDialedNumbers_ListEntryReceptionInformation [current_element] =TRUE;
                                    
                                        if(CacheElements ==TRUE)    
                                            current_element =DialedNumbers_GetNextLineInCache (current_element, direction); //go on with next element       
                                    }   //copy data of current element finished
                                }       //copy of elements finished
                            }           //startelement !=0 ends
                        break; //recordaddress =2 ends
                    
                        case 15: //recordaddress =0xf -> Pos
                            /***startelement ==0***/                        
                            if(0==startelement && gDialedNumbers_ListHandlingType ==TEL_DIALEDNUMBERS_BUILDUPCACHE)
                            {     
                                /***find "start line" in ASG cache***/
                                if(FORWARD ==direction)
                                {    
                                    if (gDialedNumbers_cacheDown)
                                    {   
                                        current_element         =5; //it's the Pos of last element in ASG cache
                                    
                                        //reset "sliding window" values
                                        gDialedNumbers_cacheDown         =FALSE;
                                    }
                                    else
                                        current_element =startelement;
                                    
                                    if (shift ==TRUE) //startelement not next element
                                        current_element =DialedNumbers_GetNextLineInCache (current_element, direction);   
                                }
                            
                                else if(BACKWARD ==direction && shift==TRUE)
                                {
                                    if(gDialedNumbers_cacheUp)
                                    {   
                                        current_element         =6; //it's the Pos of first element in ASG cache
                                    
                                        //reset "sliding window" values
                                            gDialedNumbers_cacheUp           =FALSE;
                                    }
                                    else 
                                        current_element =TEL_DIALEDNUMBERS_ASGCACHE_MAX_SIZE -1; // position of last element in array 
                                }                
                                
                                /***copy elements***/
                                if (current_element !=TEL_DIALEDNUMBERS_NO_NEXT_POSITION) 
                                {
                                    for (j=0; j<elements;j++) //copy elements
                                    {   
                                        //check, if elements must be cached and in case find position in array
                                        CacheElements =FALSE;
                                        for (i=0; i<TEL_DIALEDNUMBERS_ASGCACHE_MAX_SIZE; i++)
                                        {  
                                            //if element already cached, find position in ASG-cache
                                            if(indexsize ==FALSE && (transmitpos ==TRUE) && Indication_array[Offset] ==gDialedNumbers_Pos[i] && gDialedNumbers_ListEntryReceptionInformation[i] ==TRUE)
                                            {   
                                                current_element =i; 
                                                CacheElements   =TRUE;
                                            }
                                            else if((indexsize ==TRUE && (transmitpos ==TRUE) && (Indication_array[Offset] +(Indication_array[Offset+1]*0x100)) ==gDialedNumbers_Pos[i] && gDialedNumbers_ListEntryReceptionInformation[i] ==TRUE))
                                            {   
                                                current_element =i; 
                                                CacheElements   =TRUE;
                                            }
                                            //if not already cached, then store element only, if Cache is build-up!
                                            else if((gDialedNumbers_ListHandlingType !=TEL_DIALEDNUMBERS_NOCACHE))
                                                CacheElements   =TRUE;
                                        }
                                                                       
                                        if (transmitpos)
                                        {   
                                            if(CacheElements ==TRUE)
                                            {   
                                                if(indexsize)
                                                {    
                                                    gDialedNumbers_Pos[current_element] =Indication_array[Offset];
                                                    Offset++;
                                                    gDialedNumbers_Pos[current_element] +=Indication_array[Offset] *0x100;
                                                }
                                                else
                                                    gDialedNumbers_Pos[current_element] =Indication_array[Offset]; 
                                            }
                                            Offset++;
                                        }
                                    
                                        if(CacheElements ==TRUE)                                    
                                            gDialedNumbers_ListEntryReceptionInformation [current_element] =TRUE;
                                                       
                                        current_element =DialedNumbers_GetNextLineInCache (current_element, direction); //go on with next element     
                                    }   //copy data of current element finished
                                } //copy of elements finished       
                            } //startelement=0 ends
    
                            /***startelement !=0***/
                            else //if (((startelement !=0) && (gDialedNumbers_ListHandlingType ==TEL_DIALEDNUMBERS_BUILDUPCACHE)) || ((startelement ==0) && (gDialedNumbers_ListHandlingType !=TEL_DIALEDNUMBERS_BUILDUPCACHE))) //startelement !=0
                            {
                                //searching for valid startelement in stored list
					            for(i=0;i<TEL_DIALEDNUMBERS_ASGCACHE_MAX_SIZE;i++)
					            {
						            if(gDialedNumbers_Pos[i] ==startelement)				//found a valid element
						            {                                                                                  
                                        current_element     =i;                         //found element is valid_startelement
						                StartElementInCache =TRUE;
                                        i                   =TEL_DIALEDNUMBERS_ASGCACHE_MAX_SIZE;
                                    }
					            }
                                if (StartElementInCache)
                                {   
                                    if (shift ==TRUE && startelement!=0) //first array element is next element
                                        current_element =DialedNumbers_GetNextLineInCache (current_element, direction);                 
                                    else if(shift ==TRUE && startelement==0 && direction ==FORWARD)
                                        current_element=5;
                                   
                                    for (j=0; j<elements;j++) //copy elements
                                    {
                                        if(current_element !=TEL_DIALEDNUMBERS_NO_NEXT_POSITION)
                                        {
                                            CacheElements =TRUE;
                                            //if element already exist in ASG-cache, search the position 
                                            for (i=0; i<TEL_DIALEDNUMBERS_ASGCACHE_MAX_SIZE; i++)
                                            {   
                                                if((transmitpos ==TRUE) && gDialedNumbers_ListEntryReceptionInformation[i] ==TRUE)
                                                {   
                                                    startelement_check =0;
                                                    if(indexsize)
                                                        startelement_check =Indication_array[Offset] +(Indication_array[Offset+1]*0x100); 
                                                    else
                                                        startelement_check =Indication_array[Offset];
                                               
                                                    if(startelement_check ==gDialedNumbers_Pos[i])
                                                    {   
                                                        current_element =i; 
                                                        CacheElements   =TRUE;
                                                    }
                                                    startelement_check=0;
                                                }  
                                            }
                                        }
                                        else
                                            CacheElements =FALSE;
                                        
                                        if (transmitpos)
                                        {   
                                            if(CacheElements ==TRUE)
                                            {   
                                                if(indexsize)
                                                {    
                                                    gDialedNumbers_Pos[current_element] =Indication_array[Offset];
                                                    Offset++;
                                                    gDialedNumbers_Pos[current_element] +=Indication_array[Offset] *0x100;
                                                }
                                                else
                                                    gDialedNumbers_Pos[current_element] =Indication_array[Offset];
                                            }
                                            Offset++;
                                        }
                                    
                                        if(CacheElements ==TRUE)                                   
                                            gDialedNumbers_ListEntryReceptionInformation [current_element] =TRUE;
                                    
                                        if(CacheElements ==TRUE)    
                                            current_element =DialedNumbers_GetNextLineInCache (current_element, direction); //go on with next element       
                                    }   //copy data of current element finished
                                }       //copy of elements finished
                            }           //startelement !=0 ends
                        break; //recordaddress =0xf ends
                    }
                }
                                   
                gDialedNumbers_recordaddress =recordaddress;
                gDialedNumbers_transmitpos   =transmitpos;

                //send StatusArray
                transmitpos =FALSE;
                if(startelement>0xFF)
                    indexsize =TRUE;
                else
                    indexsize =FALSE;
                    
                mode    =shift +(direction*0x02) +(transmitpos*0x04) +indexsize*0x08;
                DialedNumbers_Request(DataGet_REQ, mode, recordaddress, startelement, startelement, elements);

            break;
			
            case Error_IND:
					
				if(Indication_array[3]<0x20 && Indication_array[3] !=0)				//BCL-error
					writelineEx(gError_Trace, 0, "ASG-Telephone DialedNumbers_Indication: BCL-Error: 0x%x - %s", Indication_array[3], gerror_codes_BCL [Indication_array[3]-0x10]);
				else if(Indication_array[3]<0x30)			//BPL-error
					writelineEx(gError_Trace, 0, "ASG-Telephone DialedNumbers_Indication: BPL-Error: 0x%x - %s", Indication_array[3], gerror_codes_BPL [Indication_array[3]-0x20]);				
				else if(Indication_array[3]<0x40)			//BAL-error
					writelineEx(gError_Trace, 0, "ASG-Telephone DialedNumbers_Indication: BAL-Error: 0x%x - %s", Indication_array[3], gerror_codes_BAL [Indication_array[3]-0x30]);
				else
					writelineEx(gError_Trace, 0, "ASG-Telephone DialedNumbers_Indication: Application-Error: 0x%x", Indication_array[3]);
				
		break;
		default:
			writelineEx(gError_Trace, 0,"ASG-Telefon DialedNumbers_Indication: unknown indication %x", gBAP_Indication[2]);
		break;
		}

    //for "sliding window concept"
    if(gBAP_Indication[2] !=Error_IND)
    {
        if(gDialedNumbers_TotalNumListElements<=TEL_DIALEDNUMBERS_ASGCACHE_MAX_SIZE)
            gDialedNumbers_SlidingWindow_State =TEL_DIALEDNUMBERS_SLIDINGWINDOW_NOTACTIVE;
        else
            gDialedNumbers_SlidingWindow_State =TEL_DIALEDNUMBERS_SLIDINGWINDOW_ACTIVE;

        if (gDialedNumbers_CallBackReason !=TEL_DIALEDNUMBERS_CALLBACKREASON_NOCALLBACK)
            DialedNumbers_ListHandling ();
        else
            DialedNumbers_display();
    }
}
/*@@end*/

/*@@caplFunc:DialedNumbers_ListHandling():*///function
DialedNumbers_ListHandling () //for sliding window concept, list handling and 'build-up' list...
{
    byte mode, shift, direction, transmitpos, indexsize, recordaddress, buffer_NumberType, buffer_day, buffer_month, buffer_year, buffer_hour, buffer_minute, buffer_second, buffer_ReceptionInfo;
    word requested_startelement, startelement, elements, buffer_Pos;
    char buffer_PbName[TEL_DIALEDNUMBERS_PBNAME_LENGTH], buffer_TelNumber[TEL_DIALEDNUMBERS_TELNUMBER_LENGTH];
    int i,j,k;
    
    // Init local variables. 
    mode                        =0;
    shift                       =0;
    direction                   =0;
    transmitpos                 =0;
    indexsize                   =0;
    recordaddress               =0;
    requested_startelement      =0;
    startelement                =0;
    elements                    =0;
    i                           =0;
    j                           =0;
    k                           =0;
    buffer_ReceptionInfo        =0;
    buffer_Pos                  =0;
    buffer_NumberType             =0;
    buffer_day                  =0;
    buffer_month                =0;
    buffer_year                 =0;
    buffer_hour                 =0;
    buffer_minute               =0;
    buffer_second               =0;
    
    /***build-up complete cache***/

    switch (gDialedNumbers_ListHandlingType)
    {
        case TEL_DIALEDNUMBERS_BUILDUPCACHE:
             
            switch (gDialedNumbers_cacheBuildUp)
            {   
                //cache-up  -> not used in consecutive ID AND no endless list
                case TEL_DIALEDNUMBERS_BUILDUPCACHECACHE_UP:  
                    if(gDialedNumbers_CallBackReason !=TEL_DIALEDNUMBERS_BUILDUPCACHENOCACHE && gDialedNumbers_CallBackReason !=TEL_DIALEDNUMBERS_CALLBACKREASON_CACHENEXT)
                    {
                        switch (gDialedNumbers_CallBackReason)
                        {
                            case TEL_DIALEDNUMBERS_CALLBACKREASON_CHECKCACHE:

                                    if(gDialedNumbers_ListEntryReceptionInformation[2] ==TRUE) //cache-down required?
                                    {            
                                        gDialedNumbers_cacheBuildUp      =TEL_DIALEDNUMBERS_BUILDUPCACHECACHE_DOWN;      //next step: build-up upper cache
                                        gDialedNumbers_CallBackReason    =TEL_DIALEDNUMBERS_CALLBACKREASON_CACHENEXT;    
                                        
                                        
                                        DialedNumbers_ListHandling ();
                                    }
                                    else //stop caching
                                    {   
                                        gDialedNumbers_cacheBuildUp      =TEL_DIALEDNUMBERS_BUILDUPCACHENOCACHE;  //"build-up cache" finished
                                        gDialedNumbers_ListHandlingType  =TEL_DIALEDNUMBERS_NOCACHE;              
                                        gDialedNumbers_CallBackReason    =TEL_DIALEDNUMBERS_CALLBACKREASON_NOCALLBACK; 
                                        gDialedNumbers_CursorAction      =TEL_DIALEDNUMBERS_CURSORACTION_NOTHING;
                                        
                                        putvalue(env_ASG_DN_ListOpState, empty_string);
                                        DialedNumbers_display();
                                    }
                            break;
                        }
                    }
                    else
                    {   
                        shift               =TRUE;
                        direction           =BACKWARD;
                        transmitpos         =FALSE;
                        recordaddress       =0;
                        startelement        =0;
                        
                        if(startelement>0xFF)
                            indexsize =TRUE;
                        else
                            indexsize =FALSE;

                        elements            =3;
                
                        requested_startelement  =startelement;
                        mode                    =shift +(direction*0x02) +(transmitpos*0x04) +indexsize*0x08;

                        gDialedNumbers_CallBackReason  =TEL_DIALEDNUMBERS_CALLBACKREASON_CHECKCACHE;

                        DialedNumbers_Request(DataGet_REQ, mode, recordaddress, requested_startelement, startelement, elements);
                    }
                break;
                
                //cache "window"
                case TEL_DIALEDNUMBERS_BUILDUPCACHECACHE_WINDOW: 
                    if(gDialedNumbers_CallBackReason !=TEL_DIALEDNUMBERS_BUILDUPCACHENOCACHE && gDialedNumbers_CallBackReason !=TEL_DIALEDNUMBERS_CALLBACKREASON_CACHENEXT)
                    {   
                        switch (gDialedNumbers_CallBackReason)
                        {
                            case TEL_DIALEDNUMBERS_CALLBACKREASON_CHECKCACHE:
                                                 
                                    if(gDialedNumbers_ListEntryReceptionInformation[0])
                                        gDialedNumbers_FirstElement =gDialedNumbers_Pos[0];
                                    
                                    //last element in display area?
                                    for(i=0;i<3;i++)
                                    {
                                        if(gDialedNumbers_ListEntryReceptionInformation[i] !=1)
                                        {
                                            gDialedNumbers_LastElement =gDialedNumbers_Pos[i-1];
                                            i=3;
                                        }
                                    }
                                    
                                    if(gDialedNumbers_ListEntryReceptionInformation[2] ==TRUE) //cache-down required?
                                    {            
                                        gDialedNumbers_cacheBuildUp      =TEL_DIALEDNUMBERS_BUILDUPCACHECACHE_DOWN;      //next step: build-up upper cache
                                        gDialedNumbers_CallBackReason    =TEL_DIALEDNUMBERS_CALLBACKREASON_CACHENEXT;    
                                        
                                        
                                        DialedNumbers_ListHandling ();
                                    }
                                    else //stop caching
                                    {   
                                        gDialedNumbers_cacheBuildUp      =TEL_DIALEDNUMBERS_BUILDUPCACHENOCACHE;  //"build-up cache" finished
                                        gDialedNumbers_ListHandlingType  =TEL_DIALEDNUMBERS_NOCACHE;              
                                        gDialedNumbers_CallBackReason    =TEL_DIALEDNUMBERS_CALLBACKREASON_NOCALLBACK; 
                                        gDialedNumbers_CursorAction      =TEL_DIALEDNUMBERS_CURSORACTION_NOTHING;
                                        
                                        putvalue(env_ASG_DN_ListOpState, empty_string);
                                        DialedNumbers_display();
                                    }
                                                                      
                            break;
                        }
                    }
                    else
                    { 
                        putvalue(env_ASG_DN_ListOpState, "build-up list...");
                        shift               =FALSE;
                        direction           =FORWARD;
                        transmitpos         =getvalue(env_ASG_DN_AH_PosTrans);
                        recordaddress       =0;
                        startelement        =0;
                        
                        if(startelement>0xFF)
                            indexsize =TRUE;
                        else
                            indexsize =FALSE;

                        elements            =3; 
    
                        requested_startelement  =startelement;
                        mode                    =shift +(direction*0x02) +(transmitpos*0x04) +indexsize*0x08;

                        gDialedNumbers_CallBackReason  =TEL_DIALEDNUMBERS_CALLBACKREASON_CHECKCACHE;

                        DialedNumbers_Request(DataGet_REQ, mode, recordaddress, requested_startelement, startelement, elements);
                    }
                break;
                
                //cache-down
                case TEL_DIALEDNUMBERS_BUILDUPCACHECACHE_DOWN:
                    if(gDialedNumbers_CallBackReason !=TEL_DIALEDNUMBERS_BUILDUPCACHENOCACHE && gDialedNumbers_CallBackReason !=TEL_DIALEDNUMBERS_CALLBACKREASON_CACHENEXT)
                    {
                        switch (gDialedNumbers_CallBackReason)
                        {
                            case TEL_DIALEDNUMBERS_CALLBACKREASON_CHECKCACHE:
                                    
                                    //stop caching
                                    gDialedNumbers_cacheBuildUp      =TEL_DIALEDNUMBERS_BUILDUPCACHENOCACHE;  //"build-up cache" finished
                                    gDialedNumbers_ListHandlingType  =TEL_DIALEDNUMBERS_NOCACHE;              
                                    gDialedNumbers_CallBackReason    =TEL_DIALEDNUMBERS_CALLBACKREASON_NOCALLBACK;
                                    gDialedNumbers_CursorAction      =TEL_DIALEDNUMBERS_CURSORACTION_NOTHING;
                                    
                                    gDialedNumbers_DisplayStatus     =TEL_DIALEDNUMBERS_DISPLAYLIST_REFRESH;
                                    
                                    putvalue(env_ASG_DN_ListOpState, empty_string);

                                    //last element in display area?
                                    for(i=3;i<6;i++)
                                    {
                                        if(gDialedNumbers_ListEntryReceptionInformation[i] !=1)
                                        {
                                            gDialedNumbers_LastElement =gDialedNumbers_Pos[i-1];
                                            i=6;
                                        }
                                    }

                                    DialedNumbers_display();
                            break;
                        }
                    }
                    else
                    { 
                        shift                   =TRUE;
                        direction               =FORWARD;
                        transmitpos             =getvalue(env_ASG_DN_AH_PosTrans);;
                        recordaddress           =0;
                        for(i=0;i<TEL_DIALEDNUMBERS_ASGCACHE_MAX_SIZE; i++) //find last cached element
                        {   
                            if(gDialedNumbers_ListEntryReceptionInformation[i] ==FALSE) //abort loop
                                i =TEL_DIALEDNUMBERS_ASGCACHE_MAX_SIZE; 
                            else
                                startelement    =gDialedNumbers_Pos[i];
                        }
                        
                        if(startelement>0xFF)
                            indexsize =TRUE;
                        else
                            indexsize =FALSE;
                            
                        elements                =3;                         
        
                        requested_startelement  =startelement;
                        mode                    =shift +(direction*0x02) +(transmitpos*0x04) +indexsize*0x08;

                        gDialedNumbers_CallBackReason    =TEL_DIALEDNUMBERS_CALLBACKREASON_CHECKCACHE;
                        
                        DialedNumbers_Request(DataGet_REQ, mode, recordaddress, requested_startelement, startelement, elements);
                    }
                break;

                default:
                break;
            }//build-up cache finished
        break;
        
        /********sliding-window********/
        case TEL_DIALEDNUMBERS_DOWN_CACHE: 
                    if (gDialedNumbers_CallBackReason ==TEL_DIALEDNUMBERS_CALLBACKREASON_CHECKCACHE) //check if valid data received
                    {   
                        if(gDialedNumbers_ListEntryReceptionInformation[5] ==0) //No valid data in last list pos -> last list element reached, start with element 0!  
                        {    
                            gDialedNumbers_LastElement            =gDialedNumbers_Pos[4];
                            gDialedNumbers_DownCaching_required   =FALSE;
                            gDialedNumbers_CallBackReason         =TEL_DIALEDNUMBERS_CALLBACKREASON_DISPLAYLIST;
                            
                            DialedNumbers_ListHandling ();
                        }
                        else
                        {
                            gDialedNumbers_CallBackReason =TEL_DIALEDNUMBERS_CALLBACKREASON_DISPLAYLIST;
                            DialedNumbers_ListHandling(); 
                        }
                        
                        //for cache up
                        if((gDialedNumbers_ListEntryReceptionInformation[6] ==1) && (gDialedNumbers_Pos[6] !=gDialedNumbers_FirstElement))
                        {    gDialedNumbers_UpCaching_required     =TRUE;
                            
                        }
                            
                    }
                    else if (gDialedNumbers_CallBackReason ==TEL_DIALEDNUMBERS_CALLBACKREASON_DISPLAYLIST)
                    {   
                        gDialedNumbers_ListHandlingType  =TEL_DIALEDNUMBERS_NOCACHE;
                        gDialedNumbers_cacheDown         =FALSE;
                        gDialedNumbers_DisplayStatus     =TEL_DIALEDNUMBERS_DISPLAYLIST_FIRST_ELEMENTS;
                        
                        putvalue(env_ASG_DN_ListOpState, empty_string);
                        DialedNumbers_display();

                        gDialedNumbers_DisplayStatus     =TEL_DIALEDNUMBERS_DISPLAYLIST_REFRESH;
                        gDialedNumbers_CallBackReason    =TEL_DIALEDNUMBERS_CALLBACKREASON_NOCALLBACK;
                    }
                    else
                    {   
                        putvalue(env_ASG_DN_ListOpState, "list operating...");
                                
                        shift                   =TRUE;
                        direction               =FORWARD;
                        transmitpos             =getvalue(env_ASG_DN_AH_PosTrans);;
                        recordaddress           =0;
                        
                        if(startelement>0xFF)
                            indexsize =TRUE;
                        else
                            indexsize =FALSE;

                        startelement            =gDialedNumbers_Pos[5]; //last element
                        elements                =1;
                        
                        for(i=0;i<TEL_DIALEDNUMBERS_ASGCACHE_MAX_SIZE;i++)
                        {   
                            j =i+1;
                            
                            switch (i)
                            {   
                                case 0: 
                                    //buffer data of Pos '0' (local)
                                    buffer_ReceptionInfo    =gDialedNumbers_ListEntryReceptionInformation[i];
                                    buffer_Pos              =gDialedNumbers_Pos[i];
                                    buffer_NumberType         =gDialedNumbers_NumberType[i];
                                    buffer_day              =gDialedNumbers_day[i];
                                    buffer_month            =gDialedNumbers_month[i];
                                    buffer_year             =gDialedNumbers_year[i];
                                    buffer_hour             =gDialedNumbers_hour[i];
                                    buffer_minute           =gDialedNumbers_minute[i];
                                    buffer_second           =gDialedNumbers_second[i];

                                    for (k=0; k<TEL_DIALEDNUMBERS_PBNAME_LENGTH;k++) //clear string
                                        buffer_PbName[k] =0;                                     

                                    for(k=0;k<strlen(gDialedNumbers_PbName[i]);k++) 
                                        buffer_PbName[k]=gDialedNumbers_PbName[i][k];
                                    
                                    for (k=0; k<TEL_DIALEDNUMBERS_TELNUMBER_LENGTH;k++) //clear string
                                        buffer_TelNumber[k] =0;                                     

                                    for(k=0;k<strlen(gDialedNumbers_TelNumber[i]);k++) 
                                        buffer_TelNumber[k]=gDialedNumbers_TelNumber[i][k];
                                    

                                    //copy data from Pos '1' to Pos '0'
                                    gDialedNumbers_Pos[i]             =gDialedNumbers_Pos[j]; 
                                    gDialedNumbers_NumberType[i]        =gDialedNumbers_NumberType[j];
                                    gDialedNumbers_day[i]             =gDialedNumbers_day[j];
                                    gDialedNumbers_month[i]           =gDialedNumbers_month[j];
                                    gDialedNumbers_year[i]            =gDialedNumbers_year[j];
                                    gDialedNumbers_hour[i]            =gDialedNumbers_hour[j];
                                    gDialedNumbers_minute[i]          =gDialedNumbers_minute[j];
                                    gDialedNumbers_second[i]          =gDialedNumbers_second[j];
                                
                                    for (k=0; k<TEL_DIALEDNUMBERS_PBNAME_LENGTH;k++) //clear string
                                        gDialedNumbers_PbName[i][k] =0;                                     

                                    for(k=0;k<strlen(gDialedNumbers_PbName[j]);k++) 
                                        gDialedNumbers_PbName[i][k]=gDialedNumbers_PbName[j][k];

                                    for (k=0; k<TEL_DIALEDNUMBERS_TELNUMBER_LENGTH;k++) //clear string
                                        gDialedNumbers_TelNumber[i][k] =0;                                     

                                    for(k=0;k<strlen(gDialedNumbers_TelNumber[j]);k++) 
                                        gDialedNumbers_TelNumber[i][k]=gDialedNumbers_TelNumber[j][k];

                                break;
                            
                                case 5:
                                    //clear last element in list 
                                    gDialedNumbers_ListEntryReceptionInformation[i]   =0;
                                    gDialedNumbers_Pos[i]                             =0;
                                    gDialedNumbers_NumberType[i]                        =0;
                                    gDialedNumbers_day[i]                             =0;
                                    gDialedNumbers_month[i]                           =0;
                                    gDialedNumbers_year[i]                            =0;
                                    gDialedNumbers_hour[i]                            =0;
                                    gDialedNumbers_minute[i]                          =0;
                                    gDialedNumbers_second[i]                          =0;

                                    for (k=0; k<TEL_DIALEDNUMBERS_PBNAME_LENGTH;k++) //clear string
                                        gDialedNumbers_PbName[i][k] =0;
                                    
                                    for (k=0; k<TEL_DIALEDNUMBERS_TELNUMBER_LENGTH;k++) //clear string
                                        gDialedNumbers_TelNumber[i][k] =0;
                                                                 
                                break;
                            
                                case 8: 
                                    //copy data from buffer in Pos '8'
                                    gDialedNumbers_ListEntryReceptionInformation[i]   =buffer_ReceptionInfo;
                                    gDialedNumbers_Pos[i]                             =buffer_Pos; 
                                    gDialedNumbers_NumberType[i]                        =buffer_NumberType;
                                    gDialedNumbers_day[i]                             =buffer_day;
                                    gDialedNumbers_month[i]                           =buffer_month;
                                    gDialedNumbers_year[i]                            =buffer_year;
                                    gDialedNumbers_hour[i]                            =buffer_hour;
                                    gDialedNumbers_minute[i]                          =buffer_minute;
                                    gDialedNumbers_second[i]                          =buffer_second;

                                    for (k=0; k<TEL_DIALEDNUMBERS_PBNAME_LENGTH;k++) //clear string
                                        gDialedNumbers_PbName[i][k] =0; 
                                    
                                    for(k=0;k<strlen(buffer_PbName);k++) 
                                        gDialedNumbers_PbName[i][k]=buffer_PbName[k];

                                    for (k=0; k<TEL_DIALEDNUMBERS_TELNUMBER_LENGTH;k++) //clear string
                                        gDialedNumbers_TelNumber[i][k] =0; 
                                    
                                    for(k=0;k<strlen(buffer_TelNumber);k++) 
                                        gDialedNumbers_TelNumber[i][k]=buffer_TelNumber[k];
                                    
                                break;
                                
                                default://other elements
                                    //copy element on other position
                                    gDialedNumbers_ListEntryReceptionInformation[i]   =gDialedNumbers_ListEntryReceptionInformation[j];
                                    gDialedNumbers_Pos[i]                             =gDialedNumbers_Pos[j]; 
                                    gDialedNumbers_NumberType[i]                        =gDialedNumbers_NumberType[j];
                                    gDialedNumbers_day[i]                             =gDialedNumbers_day[j];
                                    gDialedNumbers_month[i]                           =gDialedNumbers_month[j];
                                    gDialedNumbers_year[i]                            =gDialedNumbers_year[j]; 
                                    gDialedNumbers_hour[i]                            =gDialedNumbers_hour[j];
                                    gDialedNumbers_minute[i]                          =gDialedNumbers_minute[j];
                                    gDialedNumbers_second[i]                          =gDialedNumbers_second[j];
                                    
                                    for (k=0; k<TEL_DIALEDNUMBERS_PBNAME_LENGTH;k++) //clear string
                                        gDialedNumbers_PbName[i][k] =0; 
                                    
                                    for(k=0;k<strlen(gDialedNumbers_PbName[j]);k++) 
                                        gDialedNumbers_PbName[i][k]=gDialedNumbers_PbName[j][k];
                                        
                                    for (k=0; k<TEL_DIALEDNUMBERS_TELNUMBER_LENGTH;k++) //clear string
                                        gDialedNumbers_TelNumber[i][k] =0; 
                                    
                                    for(k=0;k<strlen(gDialedNumbers_TelNumber[j]);k++) 
                                        gDialedNumbers_TelNumber[i][k]=gDialedNumbers_TelNumber[j][k];        
                                break;
                            } // end of switch 'i'
                        }
                        requested_startelement  =startelement;
                        mode                    =shift +(direction*0x02) +(transmitpos*0x04) +indexsize*0x08;

                        if(gDialedNumbers_DownCaching_required)
                        {
                            DialedNumbers_Request(DataGet_REQ, mode, recordaddress, requested_startelement, startelement, elements);                        
                        
                            //to check, if valid data received
                            gDialedNumbers_CallBackReason    =TEL_DIALEDNUMBERS_CALLBACKREASON_CHECKCACHE;
                        }
                        else
                        {
                            gDialedNumbers_CallBackReason =TEL_DIALEDNUMBERS_CALLBACKREASON_DISPLAYLIST;
                            DialedNumbers_ListHandling(); 
                        }
                    }
        break;

        case TEL_DIALEDNUMBERS_UP_CACHE: 
                    if (gDialedNumbers_CallBackReason ==TEL_DIALEDNUMBERS_CALLBACKREASON_CHECKCACHE) //check if valid data received
                    {   
                        if((gDialedNumbers_ListEntryReceptionInformation[6] ==1) && (gDialedNumbers_Pos[6] ==gDialedNumbers_FirstElement)) //first element in list reached
                        {
                            gDialedNumbers_UpCaching_required     =FALSE;
                            gDialedNumbers_CallBackReason         =TEL_DIALEDNUMBERS_CALLBACKREASON_DISPLAYLIST;
                            
                            DialedNumbers_ListHandling ();
                        }
                        else if((gDialedNumbers_ListEntryReceptionInformation[6] ==1) && (gDialedNumbers_Pos[6] !=gDialedNumbers_FirstElement))
                        {
                            gDialedNumbers_UpCaching_required     =TRUE;
                            gDialedNumbers_CallBackReason         =TEL_DIALEDNUMBERS_CALLBACKREASON_DISPLAYLIST;
                            
                            DialedNumbers_ListHandling ();
                        }
                        else
                        {   
                            gDialedNumbers_CallBackReason =TEL_DIALEDNUMBERS_CALLBACKREASON_DISPLAYLIST;
                            DialedNumbers_ListHandling();
                        }
                        
                        //for cache down
                        if(gDialedNumbers_ListEntryReceptionInformation[5] ==1)
                            gDialedNumbers_DownCaching_required     =TRUE;
                                       
                    }

                    else if (gDialedNumbers_CallBackReason ==TEL_DIALEDNUMBERS_CALLBACKREASON_DISPLAYLIST)
                    {   
                        gDialedNumbers_ListHandlingType  =TEL_DIALEDNUMBERS_NOCACHE;
                        gDialedNumbers_cacheUp           =FALSE;
                        gDialedNumbers_DisplayStatus     =TEL_DIALEDNUMBERS_DISPLAYLIST_FIRST_ELEMENTS;
                        
                        putvalue(env_ASG_DN_ListOpState, empty_string);
                        DialedNumbers_display();
                        gDialedNumbers_DisplayStatus     =TEL_DIALEDNUMBERS_DISPLAYLIST_REFRESH;
                        gDialedNumbers_CallBackReason    =TEL_DIALEDNUMBERS_CALLBACKREASON_NOCALLBACK;
                    }

                    else
                    {           
                        putvalue(env_ASG_DN_ListOpState, "list operating...");

                        shift                   =TRUE;
                        direction               =BACKWARD;
                        transmitpos             =getvalue(env_ASG_DN_AH_PosTrans);;
                        recordaddress           =0;
                        startelement            =gDialedNumbers_Pos[6]; //first element
                        
                        if(startelement>0xFF)
                            indexsize =TRUE;
                        else
                            indexsize =FALSE;

                        elements                =1;
                    
                        for(i=TEL_DIALEDNUMBERS_ASGCACHE_MAX_SIZE-1;i>=0;i--)
                        {  
                            j =i-1;
                            switch (i)
                            {   
                                case 8: 
                                    //buffer data of Pos '8' (local)
                                    buffer_ReceptionInfo    =gDialedNumbers_ListEntryReceptionInformation[i];
                                    buffer_Pos              =gDialedNumbers_Pos[i];
                                    buffer_NumberType         =gDialedNumbers_NumberType[i];
                                    buffer_day              =gDialedNumbers_day[i];
                                    buffer_month            =gDialedNumbers_month[i];
                                    buffer_year             =gDialedNumbers_year[i];
                                    buffer_hour             =gDialedNumbers_hour[i];
                                    buffer_minute           =gDialedNumbers_minute[i];
                                    buffer_second           =gDialedNumbers_second[i];                          

                                    for (k=0; k<TEL_DIALEDNUMBERS_PBNAME_LENGTH;k++) //clear string
                                        buffer_PbName[k] =0;                                     

                                    for(k=0;k<strlen(gDialedNumbers_PbName[i]);k++) 
                                        buffer_PbName[k]=gDialedNumbers_PbName[i][k];

                                    for (k=0; k<TEL_DIALEDNUMBERS_TELNUMBER_LENGTH;k++) //clear string
                                        buffer_TelNumber[k] =0;                                     

                                    for(k=0;k<strlen(gDialedNumbers_TelNumber[i]);k++) 
                                        buffer_TelNumber[k]=gDialedNumbers_TelNumber[i][k];

                                    
                                    //copy data from Pos '7' to Pos '8'
                                    gDialedNumbers_ListEntryReceptionInformation[i]   =gDialedNumbers_ListEntryReceptionInformation[j];
                                    gDialedNumbers_Pos[i]                             =gDialedNumbers_Pos[j]; 
                                    gDialedNumbers_NumberType[i]                        =gDialedNumbers_NumberType[j];
                                    gDialedNumbers_day[i]                             =gDialedNumbers_day[j];
                                    gDialedNumbers_month[i]                           =gDialedNumbers_month[j];
                                    gDialedNumbers_year[i]                            =gDialedNumbers_year[j];
                                    gDialedNumbers_hour[i]                            =gDialedNumbers_hour[j];
                                    gDialedNumbers_minute[i]                          =gDialedNumbers_minute[j];
                                    gDialedNumbers_second[i]                          =gDialedNumbers_second[j];

                                    for (k=0; k<TEL_DIALEDNUMBERS_PBNAME_LENGTH;k++) //clear string
                                        gDialedNumbers_PbName[i][k] =0; 
                                    
                                    for(k=0;k<strlen(gDialedNumbers_PbName[j]);k++) 
                                        gDialedNumbers_PbName[i][k]=gDialedNumbers_PbName[j][k];
                                    
                                    for (k=0; k<TEL_DIALEDNUMBERS_TELNUMBER_LENGTH;k++) //clear string
                                        gDialedNumbers_TelNumber[i][k] =0; 
                                    
                                    for(k=0;k<strlen(gDialedNumbers_TelNumber[j]);k++) 
                                        gDialedNumbers_TelNumber[i][k]=gDialedNumbers_TelNumber[j][k];     
                                break;
                            
                                case 6: 
                                    //clear first element in list 
                                    gDialedNumbers_ListEntryReceptionInformation[i] =0;
                                    gDialedNumbers_Pos[i]                           =0;
                                    gDialedNumbers_NumberType[i]                      =0;
                                    gDialedNumbers_day[i]                           =0;
                                    gDialedNumbers_month[i]                         =0;
                                    gDialedNumbers_year[i]                          =0;
                                    gDialedNumbers_hour[i]                          =0;
                                    gDialedNumbers_minute[i]                        =0;
                                    gDialedNumbers_second[i]                        =0;
                            
                                    for (k=0; k<TEL_DIALEDNUMBERS_PBNAME_LENGTH;k++) //clear string
                                        gDialedNumbers_PbName[i][k] =0;
                                    
                                    for (k=0; k<TEL_DIALEDNUMBERS_TELNUMBER_LENGTH;k++) //clear string
                                        gDialedNumbers_TelNumber[i][k] =0;
                                                                            
                                break;
                            
                                case 0: 
                                    //copy data from buffer in Pos '0'
                                    gDialedNumbers_ListEntryReceptionInformation[i]   =buffer_ReceptionInfo;
                                    gDialedNumbers_Pos[i]                             =buffer_Pos; 
                                    gDialedNumbers_NumberType[i]                        =buffer_NumberType;
                                    gDialedNumbers_day[i]                             =buffer_day;
                                    gDialedNumbers_month[i]                           =buffer_month;
                                    gDialedNumbers_year[i]                            =buffer_year;
                                    gDialedNumbers_hour[i]                            =buffer_hour;
                                    gDialedNumbers_minute[i]                          =buffer_minute;
                                    gDialedNumbers_second[i]                          =buffer_second;

                                    for (k=0; k<TEL_DIALEDNUMBERS_PBNAME_LENGTH;k++) //clear string
                                        gDialedNumbers_PbName[i][k] =0; 
                                    
                                    for(k=0;k<strlen(buffer_PbName);k++) 
                                        gDialedNumbers_PbName[i][k]=buffer_PbName[k];

                                    for (k=0; k<TEL_DIALEDNUMBERS_TELNUMBER_LENGTH;k++) //clear string
                                        gDialedNumbers_TelNumber[i][k] =0; 
                                    
                                    for(k=0;k<strlen(buffer_TelNumber);k++) 
                                        gDialedNumbers_TelNumber[i][k]=buffer_TelNumber[k];
                                break;
                                
                                default: //other elements
                                    //copy element on other position
                                    gDialedNumbers_ListEntryReceptionInformation[i]   =gDialedNumbers_ListEntryReceptionInformation[j];
                                    gDialedNumbers_Pos[i]                             =gDialedNumbers_Pos[j]; 
                                    gDialedNumbers_NumberType[i]                        =gDialedNumbers_NumberType[j];
                                    gDialedNumbers_day[i]                             =gDialedNumbers_day[j];
                                    gDialedNumbers_month[i]                           =gDialedNumbers_month[j];
                                    gDialedNumbers_year[i]                            =gDialedNumbers_year[j];
                                    gDialedNumbers_hour[i]                            =gDialedNumbers_hour[j];
                                    gDialedNumbers_minute[i]                          =gDialedNumbers_minute[j];
                                    gDialedNumbers_second[i]                          =gDialedNumbers_second[j];

                                    for (k=0; k<TEL_DIALEDNUMBERS_PBNAME_LENGTH;k++) //clear string
                                        gDialedNumbers_PbName[i][k] =0; 
                                    
                                    for(k=0;k<strlen(gDialedNumbers_PbName[j]);k++) 
                                        gDialedNumbers_PbName[i][k]=gDialedNumbers_PbName[j][k];
                                    
                                    for (k=0; k<TEL_DIALEDNUMBERS_TELNUMBER_LENGTH;k++) //clear string
                                        gDialedNumbers_TelNumber[i][k] =0; 
                                    
                                    for(k=0;k<strlen(gDialedNumbers_TelNumber[j]);k++) 
                                        gDialedNumbers_TelNumber[i][k]=gDialedNumbers_TelNumber[j][k];
                                    
                                break;
                            } // end of switch 'i'
                        }
                        requested_startelement  =startelement;
                        mode                    =shift +(direction*0x02) +(transmitpos*0x04) +indexsize*0x08;

                        if(gDialedNumbers_UpCaching_required)
                        {
                            DialedNumbers_Request(DataGet_REQ, mode, recordaddress, requested_startelement, startelement, elements);                        
                        
                            //to check, if valid data received
                            gDialedNumbers_CallBackReason    =TEL_DIALEDNUMBERS_CALLBACKREASON_CHECKCACHE;
                        }
                        else
                        {
                            gDialedNumbers_CallBackReason =TEL_DIALEDNUMBERS_CALLBACKREASON_CHECKCACHE;
                            DialedNumbers_ListHandling(); 
                        }
                    }
        break;

        default:
        break;
    } //end of switch 'type of cache handling' 
}
/*@@end*/

/*@@caplFunc:DialedNumbers_Request(byte,byte,byte,word,word,word):*///function
DialedNumbers_Request(byte request, byte mode, byte recordaddress, word requested_startelement, word startelement, word elements)
{   
    int  i, j;
    byte Offset, shift, direction, transmitpos, current_line;
    dword requestarray [BAP_buffer_size];
    word indexsize, valid_startelement;

    // Init local variables. 
    for(i=0;i<BAP_buffer_size;i++)
	    requestarray [i]=0;
    
    indexsize   =0;
    Offset      =0;
    valid_startelement=0;

    // decode "mode-byte"
    indexsize   =(mode &0x08)/0x08; 

    // Handle request.
    requestarray[0] =LSGID_Telephone;	    //LSG-ID
	requestarray[1] =FctID_DialedNumbers;	//Fct.-ID
	requestarray[2] =request;               //request type

    switch(request)
	{
        case DataGet_REQ:              
                requestarray[3] =((gDialedNumbers_ASGID *0x10) &0xF0) +(gDialedNumbers_TAID &0x0F);

                /***ArrayHeader***/
			    requestarray[4] =((mode *0x10) &0xF0) +(recordaddress &0x0F);          
                Offset =5;

                //write("# DialedNumbers_Request Offset");
                if(indexsize)
                {
                    requestarray[Offset] =requested_startelement &0x00FF;
                    Offset++;
                    requestarray[Offset] =(requested_startelement &0xFF00) /0x100;
                    Offset++;  

                    requestarray[Offset] =elements &0x00FF;
                    Offset++;
                    requestarray[Offset] =(elements &0xFF00) /0x100;
                    Offset++;       

                    //write("# --> (indexsize) Offset = %d", Offset);
                }
                else
                {
                    requestarray[Offset] =requested_startelement;
                    Offset++;

                    requestarray[Offset] =elements;
                    Offset++;

                    //write("# --> Offset = %d", Offset);
                }
            set_status_requestbuffer (requestarray, Offset, Bap_ByteSequence);
         break;
        case DataSetGet_REQ:
                requestarray[3] =((gDialedNumbers_ASGID *0x10) &0xF0) +(gDialedNumbers_TAID &0x0F);

                /***ArrayHeader***/
			    requestarray[4] =((mode *0x10) &0xF0) +(recordaddress &0x0F);          
                Offset =5;

                if(indexsize)
                {
                    requestarray[Offset] =requested_startelement &0x00FF;
                    Offset++;
                    requestarray[Offset] =(requested_startelement &0xFF00) /0x100;
                    Offset++;  

                    requestarray[Offset] =elements &0x00FF;
                    Offset++;
                    requestarray[Offset] =(elements &0xFF00) /0x100;
                    Offset++;       
                }
                else
                {
                    requestarray[Offset] =requested_startelement;
                    Offset++;

                    requestarray[Offset] =elements;
                    Offset++;
                }

                
                // decode "mode-byte"
                shift       =mode &0x01;
                direction   =(mode &0x02)/0x02;
                transmitpos =(mode &0x04)/0x04;
                indexsize   =(mode &0x08)/0x08;
                
                //searching for valid 'current_element'
				for(i=6;i<9;i++)
				{
					if((gDialedNumbers_Pos[i] ==startelement) && (gDialedNumbers_ListEntryReceptionInformation[i] ==1))				//found a valid element
					{                                          
                        if(shift==TRUE)											//shift is set, this means starting with the next/previous element (depending on the direction-setting)
                            current_line =DialedNumbers_GetNextLineInCache(i, direction);

                        else
                            current_line =i;                              //found element is valid_startelement

						i=9;
					}
                    else
                        current_line =99;

                    if (i==8)
                        i =-1;
                        
                    if (i==5)
                        i=9;
				}

                //write("current_line = %d", current_line);
                     
                for(i=0; i<elements; i++)    
                {
                    if(current_line <TEL_DIALEDNUMBERS_ASGCACHE_MAX_SIZE) //current_element exists in ASG-array
                    {
                        //copy data
                        switch(recordaddress)
			            {
                            case 0: //complete record
                                
                                if (transmitpos) // Pos  ->Array position transmitted
                                {
                                    if (indexsize)
                                    {
                                        requestarray[Offset] =(gDialedNumbers_Pos[current_line] &0xFF);
                                        Offset++;
                                        requestarray[Offset] =((gDialedNumbers_Pos[current_line]&0xFF00) /0x100);
                                        Offset++;
                                    }
                                    else
                                    {
                                        requestarray[Offset] =gDialedNumbers_Pos[current_line];
                                        Offset++;
                                    }
                                }
                                                                                              
                                //PbName
                                requestarray[Offset] =strlen(gDialedNumbers_PbName[current_line]);
                                Offset++;
                                
                                for(j=0;j<strlen(gDialedNumbers_PbName[current_line]);j++)
                    			{
			                        requestarray[Offset] =gDialedNumbers_PbName[current_line][j];	
			                        Offset++;
			                    }
                                
                                //NumberType
                                requestarray[Offset] =gDialedNumbers_NumberType[current_line];
                                Offset++;

                                //TelNumber
                                requestarray[Offset] =strlen(gDialedNumbers_TelNumber[current_line]);
                                Offset++;
                                
                                for(j=0;j<strlen(gDialedNumbers_TelNumber[current_line]);j++)
                    			{
			                        requestarray[Offset] =gDialedNumbers_TelNumber[current_line][j];	
			                        Offset++;
			                    }

                                //Day
                                requestarray[Offset] =gDialedNumbers_day[current_line];
                                Offset++;

                                //Month
                                requestarray[Offset] =gDialedNumbers_month[current_line];
                                Offset++;

                                //Year
                                requestarray[Offset] =gDialedNumbers_year[current_line];
                                Offset++;

                                //Hour
                                requestarray[Offset] =gDialedNumbers_hour[current_line];
                                Offset++;

                                //Minute
                                requestarray[Offset] =gDialedNumbers_minute[current_line];
                                Offset++;

                                //Second
                                requestarray[Offset] =gDialedNumbers_second[current_line];
                                Offset++;    
                        
                            break;

                            case 1: //PbName, NumberType
                                if (transmitpos) // Pos  ->Array position transmitted
                                {
                                    if (indexsize)
                                    {
                                        requestarray[Offset] =(gDialedNumbers_Pos[current_line] &0xFF);
                                        Offset++;
                                        requestarray[Offset] =((gDialedNumbers_Pos[current_line]&0xFF00) /0x100);
                                        Offset++;
                                    }
                                    else
                                    {
                                        requestarray[Offset] =gDialedNumbers_Pos[current_line];
                                        Offset++;
                                    }
                                }
                                                                                              
                                //PbName
                                requestarray[Offset] =strlen(gDialedNumbers_PbName[current_line]);
                                Offset++;
                                
                                for(j=0;j<strlen(gDialedNumbers_PbName[current_line]);j++)
                    			{
			                        requestarray[Offset] =gDialedNumbers_PbName[current_line][j];	
			                        Offset++;
			                    }
                                
                                //NumberType
                                requestarray[Offset] =gDialedNumbers_NumberType[current_line];
                                Offset++; 
                                
                            break;

                            case 2: //TelNumber, Day, Month, Year, Hour, Minute, Second
                                if (transmitpos) // Pos  ->Array position transmitted
                                {
                                    if (indexsize)
                                    {
                                        requestarray[Offset] =(gDialedNumbers_Pos[current_line] &0xFF);
                                        Offset++;
                                        requestarray[Offset] =((gDialedNumbers_Pos[current_line]&0xFF00) /0x100);
                                        Offset++;
                                    }
                                    else
                                    {
                                        requestarray[Offset] =gDialedNumbers_Pos[current_line];
                                        Offset++;
                                    }
                                }
                                                                                              
                                //TelNumber
                                requestarray[Offset] =strlen(gDialedNumbers_TelNumber[current_line]);
                                Offset++;
                                
                                for(j=0;j<strlen(gDialedNumbers_TelNumber[current_line]);j++)
                    			{
			                        requestarray[Offset] =gDialedNumbers_TelNumber[current_line][j];	
			                        Offset++;
			                    }

                                //Day
                                requestarray[Offset] =gDialedNumbers_day[current_line];
                                Offset++;

                                //Month
                                requestarray[Offset] =gDialedNumbers_month[current_line];
                                Offset++;

                                //Year
                                requestarray[Offset] =gDialedNumbers_year[current_line];
                                Offset++;

                                //Hour
                                requestarray[Offset] =gDialedNumbers_hour[current_line];
                                Offset++;

                                //Minute
                                requestarray[Offset] =gDialedNumbers_minute[current_line];
                                Offset++;

                                //Second
                                requestarray[Offset] =gDialedNumbers_second[current_line];
                                Offset++;  
                             break;

                            case 15: //Pos
                                if (transmitpos) // Pos  ->Array position transmitted
                                {
                                    if (indexsize)
                                    {
                                        requestarray[Offset] =(gDialedNumbers_Pos[current_line] &0xFF);
                                        Offset++;
                                        requestarray[Offset] =((gDialedNumbers_Pos[current_line]&0xFF00) /0x100);
                                        Offset++;
                                    }
                                    else
                                    {
                                        requestarray[Offset] =gDialedNumbers_Pos[current_line];
                                        Offset++;
                                    }
                                }
                                                                                               
                             break;
                            default:
                             break;
                        }// end 'switch'
                        

                        current_line =DialedNumbers_GetNextLineInCache(current_line, direction); //next line

                    }//end 'if'
                    
                    else
                        i =elements;
                }//end 'for'

                //write("# ---> Offset = %d", Offset);

                set_status_requestbuffer (requestarray, Offset, Bap_ByteSequence);
        break;

        default:	
			writelineEx(gError_Trace, 0, "ASG-Telephone DialedNumbers_Request: invalid request %d", request);
		break;
    }
}
/*@@end*/

/*@@caplFunc:DialedNumbers_display():*///function
DialedNumbers_display()
{   
    int Element_1 =0, Element_2 =1, Element_3 =2;

    if(Power_on==gRNS_PowerOnOff && getvalue(env_ASG_DN_OnOff))
	{   
        /******'sliding window' not active******/         
        if(gDialedNumbers_DisplayStatus ==TEL_DIALEDNUMBERS_DISPLAYLIST_SEARCH_ELEMENTS)
        {
            //1. Element              
            if(gDialedNumbers_CursorAction ==TEL_DIALEDNUMBERS_CURSORACTION_DOWN)
                Element_1 =DialedNumbers_GetNextCachedElement(gDialedNumbers_LastFirstElement, TEL_DIALEDNUMBERS_DISPLAYLIST_FIND_NEXT_ELEMENT);
            
            else if(gDialedNumbers_CursorAction ==TEL_DIALEDNUMBERS_CURSORACTION_UP)            
                Element_1 =DialedNumbers_GetNextCachedElement(gDialedNumbers_LastFirstElement, TEL_DIALEDNUMBERS_DISPLAYLIST_FIND_PREVIUOS_ELEMENT);

            if(gDialedNumbers_Pos[Element_1] ==gDialedNumbers_FirstElement)
            {   
                putvalue(env_ASG_DN_ListInfo_up,"first element");
                                
                gDialedNumbers_MoveList_up_allowed =FALSE;
            }
            else
            {
                putvalue(env_ASG_DN_ListInfo_up,empty_string);
                                
                gDialedNumbers_MoveList_up_allowed =TRUE;
            }  

            //Pos
            putvalue(env_ASG_DN_pos_0, gDialedNumbers_Pos[Element_1]);               
            
            //PbName
            if (gDialedNumbers_recordaddress ==0 || gDialedNumbers_recordaddress ==1)
                putvalue(env_ASG_DN_PbName_s_0,gDialedNumbers_PbName[Element_1]);

            //NumberType
            if (gDialedNumbers_recordaddress ==0 || gDialedNumbers_recordaddress ==1) 
            {
                putvalue(env_ASG_DN_NumType_0, gDialedNumbers_NumberType[Element_1]);

                if(gDialedNumbers_NumberType[Element_1] <0x0F)
                    putvalue(env_ASG_DN_NumType_s_0,gDialedNumbers_NumberType_s[gDialedNumbers_NumberType[Element_1]]);
                else
                    putvalue(env_ASG_DN_NumType_s_0,gstring_reserved);
            }
            
            //TelNumber
            if (gDialedNumbers_recordaddress ==0 || gDialedNumbers_recordaddress ==2)
                putvalue(env_ASG_DN_TelNum_s_0,gDialedNumbers_TelNumber[Element_1]);

            //Day
            if (gDialedNumbers_recordaddress ==0 || gDialedNumbers_recordaddress ==2)
                putvalue(env_ASG_DN_day_0,gDialedNumbers_day[Element_1]);

            //Month
            if (gDialedNumbers_recordaddress ==0 || gDialedNumbers_recordaddress ==2)
                putvalue(env_ASG_DN_month_0,gDialedNumbers_month[Element_1]);
            
            //Year
            if (gDialedNumbers_recordaddress ==0 || gDialedNumbers_recordaddress ==2)
                putvalue(env_ASG_DN_year_0,gDialedNumbers_year[Element_1]);

            //Hour
            if (gDialedNumbers_recordaddress ==0 || gDialedNumbers_recordaddress ==2)
                putvalue(env_ASG_DN_hour_0,gDialedNumbers_hour[Element_1]);
            
            //Minute
            if (gDialedNumbers_recordaddress ==0 || gDialedNumbers_recordaddress ==2)
                putvalue(env_ASG_DN_minute_0,gDialedNumbers_minute[Element_1]);

            //Second
            if (gDialedNumbers_recordaddress ==0 || gDialedNumbers_recordaddress ==2)
                putvalue(env_ASG_DN_second_0,gDialedNumbers_second[Element_1]);
            
            gDialedNumbers_LastFirstElement =Element_1;
            
            
            //2. Element             
            Element_2 =DialedNumbers_GetNextCachedElement(Element_1, TEL_DIALEDNUMBERS_DISPLAYLIST_FIND_NEXT_ELEMENT);
            
            if(gDialedNumbers_Pos[Element_2] ==gDialedNumbers_LastElement)
            {   
                putvalue(env_ASG_DN_ListInfo_Cursor,"last element");
                                
                gDialedNumbers_MoveList_down_allowed =FALSE;               
            }
            else
            {
                putvalue(env_ASG_DN_ListInfo_Cursor,empty_string);
                                
                gDialedNumbers_MoveList_down_allowed =TRUE;
            } 

            //Pos
            putvalue(env_ASG_DN_pos_1, gDialedNumbers_Pos[Element_2]);               
            
            //PbName
            if (gDialedNumbers_recordaddress ==0 || gDialedNumbers_recordaddress ==1)
                putvalue(env_ASG_DN_PbName_s_1,gDialedNumbers_PbName[Element_2]);

            //NumberType
            if (gDialedNumbers_recordaddress ==0 || gDialedNumbers_recordaddress ==1) 
            {
                putvalue(env_ASG_DN_NumType_1, gDialedNumbers_NumberType[Element_2]);

                if(gDialedNumbers_NumberType[Element_2] <0x0F)
                    putvalue(env_ASG_DN_NumType_s_1,gDialedNumbers_NumberType_s[gDialedNumbers_NumberType[Element_2]]);
                else
                    putvalue(env_ASG_DN_NumType_s_1,gstring_reserved);
            }
            
            //TelNumber
            if (gDialedNumbers_recordaddress ==0 || gDialedNumbers_recordaddress ==2)
                putvalue(env_ASG_DN_TelNum_s_1,gDialedNumbers_TelNumber[Element_2]);

            //Day
            if (gDialedNumbers_recordaddress ==0 || gDialedNumbers_recordaddress ==2)
                putvalue(env_ASG_DN_day_1,gDialedNumbers_day[Element_2]);

            //Month
            if (gDialedNumbers_recordaddress ==0 || gDialedNumbers_recordaddress ==2)
                putvalue(env_ASG_DN_month_1,gDialedNumbers_month[Element_2]);
            
            //Year
            if (gDialedNumbers_recordaddress ==0 || gDialedNumbers_recordaddress ==2)
                putvalue(env_ASG_DN_year_1,gDialedNumbers_year[Element_2]);

            //Hour
            if (gDialedNumbers_recordaddress ==0 || gDialedNumbers_recordaddress ==2)
                putvalue(env_ASG_DN_hour_1,gDialedNumbers_hour[Element_2]);
            
            //Minute
            if (gDialedNumbers_recordaddress ==0 || gDialedNumbers_recordaddress ==2)
                putvalue(env_ASG_DN_minute_1,gDialedNumbers_minute[Element_2]);

            //Second
            if (gDialedNumbers_recordaddress ==0 || gDialedNumbers_recordaddress ==2)
                putvalue(env_ASG_DN_second_1,gDialedNumbers_second[Element_2]);
             
            
            //3. Element          
            Element_3 =DialedNumbers_GetNextCachedElement(Element_2, TEL_DIALEDNUMBERS_DISPLAYLIST_FIND_NEXT_ELEMENT);

            if(gDialedNumbers_Pos[Element_3] ==gDialedNumbers_LastElement)
            {   
                putvalue(env_ASG_DN_ListInfo_down,"last element");
                                
                gDialedNumbers_MoveList_down_allowed =FALSE;
            }
            else
            {
                putvalue(env_ASG_DN_ListInfo_down,empty_string);
                                
                gDialedNumbers_MoveList_down_allowed =TRUE;
            } 

            //Pos
            putvalue(env_ASG_DN_pos_2, gDialedNumbers_Pos[Element_3]);               
            
            //PbName
            if (gDialedNumbers_recordaddress ==0 || gDialedNumbers_recordaddress ==1)
                putvalue(env_ASG_DN_PbName_s_2,gDialedNumbers_PbName[Element_3]);

            //NumberType
            if (gDialedNumbers_recordaddress ==0 || gDialedNumbers_recordaddress ==1) 
            {
                putvalue(env_ASG_DN_NumType_2, gDialedNumbers_NumberType[Element_3]);

                if(gDialedNumbers_NumberType[Element_3] <0x0F)
                    putvalue(env_ASG_DN_NumType_s_2,gDialedNumbers_NumberType_s[gDialedNumbers_NumberType[Element_3]]);
                else
                    putvalue(env_ASG_DN_NumType_s_2,gstring_reserved);
            }
            
            //TelNumber
            if (gDialedNumbers_recordaddress ==0 || gDialedNumbers_recordaddress ==2)
                putvalue(env_ASG_DN_TelNum_s_2,gDialedNumbers_TelNumber[Element_3]);

            //Day
            if (gDialedNumbers_recordaddress ==0 || gDialedNumbers_recordaddress ==2)
                putvalue(env_ASG_DN_day_2,gDialedNumbers_day[Element_3]);

            //Month
            if (gDialedNumbers_recordaddress ==0 || gDialedNumbers_recordaddress ==2)
                putvalue(env_ASG_DN_month_2,gDialedNumbers_month[Element_3]);
            
            //Year
            if (gDialedNumbers_recordaddress ==0 || gDialedNumbers_recordaddress ==2)
                putvalue(env_ASG_DN_year_2,gDialedNumbers_year[Element_3]);

            //Hour
            if (gDialedNumbers_recordaddress ==0 || gDialedNumbers_recordaddress ==2)
                putvalue(env_ASG_DN_hour_2,gDialedNumbers_hour[Element_3]);
            
            //Minute
            if (gDialedNumbers_recordaddress ==0 || gDialedNumbers_recordaddress ==2)
                putvalue(env_ASG_DN_minute_2,gDialedNumbers_minute[Element_3]);

            //Second
            if (gDialedNumbers_recordaddress ==0 || gDialedNumbers_recordaddress ==2)
                putvalue(env_ASG_DN_second_2,gDialedNumbers_second[Element_3]);     
        }

        /******'sliding Window' active or 'build-up List'******/
        else if(gDialedNumbers_DisplayStatus ==TEL_DIALEDNUMBERS_DISPLAYLIST_FIRST_ELEMENTS) 
        {   
            //1. Element    
            if(gDialedNumbers_ListEntryReceptionInformation [0] ==TRUE && getvalue(env_ASG_DN_OnOff))
            {   
                Element_1 =0;

                if(gDialedNumbers_Pos[Element_1] ==gDialedNumbers_FirstElement)
                {   
                    putvalue(env_ASG_DN_ListInfo_up,"first element");
                                        
                    gDialedNumbers_MoveList_up_allowed =FALSE;
                }
                else 
                {   
                    putvalue(env_ASG_DN_ListInfo_up,empty_string);
                                        
                    gDialedNumbers_MoveList_up_allowed =TRUE;
                }
                
                
                //Pos
                putvalue(env_ASG_DN_pos_0, gDialedNumbers_Pos[Element_1]);               
            
                //PbName
                if (gDialedNumbers_recordaddress ==0 || gDialedNumbers_recordaddress ==1)
                    putvalue(env_ASG_DN_PbName_s_0,gDialedNumbers_PbName[Element_1]);

                //NumberType
                if (gDialedNumbers_recordaddress ==0 || gDialedNumbers_recordaddress ==1) 
                {
                    putvalue(env_ASG_DN_NumType_0, gDialedNumbers_NumberType[Element_1]);

                    if(gDialedNumbers_NumberType[Element_1] <0x0F)
                        putvalue(env_ASG_DN_NumType_s_0,gDialedNumbers_NumberType_s[gDialedNumbers_NumberType[Element_1]]);
                    else
                        putvalue(env_ASG_DN_NumType_s_0,gstring_reserved);
                }
            
                //TelNumber
                if (gDialedNumbers_recordaddress ==0 || gDialedNumbers_recordaddress ==2)
                    putvalue(env_ASG_DN_TelNum_s_0,gDialedNumbers_TelNumber[Element_1]);

                //Day
                if (gDialedNumbers_recordaddress ==0 || gDialedNumbers_recordaddress ==2)
                    putvalue(env_ASG_DN_day_0,gDialedNumbers_day[Element_1]);

                //Month
                if (gDialedNumbers_recordaddress ==0 || gDialedNumbers_recordaddress ==2)
                    putvalue(env_ASG_DN_month_0,gDialedNumbers_month[Element_1]);
            
                //Year
                if (gDialedNumbers_recordaddress ==0 || gDialedNumbers_recordaddress ==2)
                    putvalue(env_ASG_DN_year_0,gDialedNumbers_year[Element_1]);

                //Hour
                if (gDialedNumbers_recordaddress ==0 || gDialedNumbers_recordaddress ==2)
                    putvalue(env_ASG_DN_hour_0,gDialedNumbers_hour[Element_1]);
            
                //Minute
                if (gDialedNumbers_recordaddress ==0 || gDialedNumbers_recordaddress ==2)
                    putvalue(env_ASG_DN_minute_0,gDialedNumbers_minute[Element_1]);

                //Second
                if (gDialedNumbers_recordaddress ==0 || gDialedNumbers_recordaddress ==2)
                    putvalue(env_ASG_DN_second_0,gDialedNumbers_second[Element_1]);
            }


            //2. Element    
            if(gDialedNumbers_ListEntryReceptionInformation [1] ==TRUE && getvalue(env_ASG_DN_OnOff))
            {
                Element_2 =1;
                
                if(gDialedNumbers_Pos[Element_2] ==gDialedNumbers_LastElement)
                {   
                    putvalue(env_ASG_DN_ListInfo_Cursor,"last element");
                                        
                    gDialedNumbers_MoveList_down_allowed =FALSE;               
                }
                else
                {
                    putvalue(env_ASG_DN_ListInfo_Cursor,empty_string);
                                        
                    gDialedNumbers_MoveList_down_allowed =TRUE;
                } 

                //Pos
                putvalue(env_ASG_DN_pos_1, gDialedNumbers_Pos[Element_2]);               
            
                //PbName
                if (gDialedNumbers_recordaddress ==0 || gDialedNumbers_recordaddress ==1)
                    putvalue(env_ASG_DN_PbName_s_1,gDialedNumbers_PbName[Element_2]);

                //NumberType
                if (gDialedNumbers_recordaddress ==0 || gDialedNumbers_recordaddress ==1) 
                {
                    putvalue(env_ASG_DN_NumType_1, gDialedNumbers_NumberType[Element_2]);

                    if(gDialedNumbers_NumberType[Element_2] <0x0F)
                        putvalue(env_ASG_DN_NumType_s_1,gDialedNumbers_NumberType_s[gDialedNumbers_NumberType[Element_2]]);
                    
                    else
                        putvalue(env_ASG_DN_NumType_s_1,gstring_reserved);
                }
                
                //TelNumber
                if (gDialedNumbers_recordaddress ==0 || gDialedNumbers_recordaddress ==2)
                    putvalue(env_ASG_DN_TelNum_s_1,gDialedNumbers_TelNumber[Element_2]);

                //Day
                if (gDialedNumbers_recordaddress ==0 || gDialedNumbers_recordaddress ==2)
                    putvalue(env_ASG_DN_day_1,gDialedNumbers_day[Element_2]);

                //Month
                if (gDialedNumbers_recordaddress ==0 || gDialedNumbers_recordaddress ==2)
                    putvalue(env_ASG_DN_month_1,gDialedNumbers_month[Element_2]);
            
                //Year
                if (gDialedNumbers_recordaddress ==0 || gDialedNumbers_recordaddress ==2)
                    putvalue(env_ASG_DN_year_1,gDialedNumbers_year[Element_2]);

                //Hour
                if (gDialedNumbers_recordaddress ==0 || gDialedNumbers_recordaddress ==2)
                    putvalue(env_ASG_DN_hour_1,gDialedNumbers_hour[Element_2]);
            
                //Minute
                if (gDialedNumbers_recordaddress ==0 || gDialedNumbers_recordaddress ==2)
                    putvalue(env_ASG_DN_minute_1,gDialedNumbers_minute[Element_2]);

                //Second
                if (gDialedNumbers_recordaddress ==0 || gDialedNumbers_recordaddress ==2)
                    putvalue(env_ASG_DN_second_1,gDialedNumbers_second[Element_2]);
             }

            //3. Element    
            if(gDialedNumbers_ListEntryReceptionInformation [2] ==TRUE && getvalue(env_ASG_DN_OnOff))
            {
                Element_3 =2;
                if(gDialedNumbers_Pos[Element_3] ==gDialedNumbers_LastElement)
                {   
                    putvalue(env_ASG_DN_ListInfo_down,"last element");
                                        
                    gDialedNumbers_MoveList_down_allowed =FALSE;
                }
                
                else
                {
                    putvalue(env_ASG_DN_ListInfo_down,empty_string);
                                        
                    gDialedNumbers_MoveList_down_allowed =TRUE;
                }   

                //Pos
                putvalue(env_ASG_DN_pos_2, gDialedNumbers_Pos[Element_3]);               
            
                //PbName
                if (gDialedNumbers_recordaddress ==0 || gDialedNumbers_recordaddress ==1)
                    putvalue(env_ASG_DN_PbName_s_2,gDialedNumbers_PbName[Element_3]);

                //NumberType
                if (gDialedNumbers_recordaddress ==0 || gDialedNumbers_recordaddress ==1) 
                {
                    putvalue(env_ASG_DN_NumType_2, gDialedNumbers_NumberType[Element_3]);

                    if(gDialedNumbers_NumberType[Element_3] <0x0F)
                        putvalue(env_ASG_DN_NumType_s_2,gDialedNumbers_NumberType_s[gDialedNumbers_NumberType[Element_3]]);
                    else
                        putvalue(env_ASG_DN_NumType_s_2,gstring_reserved);
                }
            
                //TelNumber
                if (gDialedNumbers_recordaddress ==0 || gDialedNumbers_recordaddress ==2)
                    putvalue(env_ASG_DN_TelNum_s_2,gDialedNumbers_TelNumber[Element_3]);

                //Day
                if (gDialedNumbers_recordaddress ==0 || gDialedNumbers_recordaddress ==2)
                    putvalue(env_ASG_DN_day_2,gDialedNumbers_day[Element_3]);

                //Month
                if (gDialedNumbers_recordaddress ==0 || gDialedNumbers_recordaddress ==2)
                    putvalue(env_ASG_DN_month_2,gDialedNumbers_month[Element_3]);
            
                //Year
                if (gDialedNumbers_recordaddress ==0 || gDialedNumbers_recordaddress ==2)
                    putvalue(env_ASG_DN_year_2,gDialedNumbers_year[Element_3]);

                //Hour
                if (gDialedNumbers_recordaddress ==0 || gDialedNumbers_recordaddress ==2)
                    putvalue(env_ASG_DN_hour_2,gDialedNumbers_hour[Element_3]);
            
                //Minute
                if (gDialedNumbers_recordaddress ==0 || gDialedNumbers_recordaddress ==2)
                    putvalue(env_ASG_DN_minute_2,gDialedNumbers_minute[Element_3]);

                //Second
                if (gDialedNumbers_recordaddress ==0 || gDialedNumbers_recordaddress ==2)
                    putvalue(env_ASG_DN_second_2,gDialedNumbers_second[Element_3]);    
            }

            DialedNumbers_DisplayCache();
        }
        else if (gDialedNumbers_DisplayStatus ==TEL_DIALEDNUMBERS_DISPLAYLIST_REFRESH)
        {               
            //1. Element
            if(gDialedNumbers_SlidingWindow_State ==TEL_DIALEDNUMBERS_SLIDINGWINDOW_NOTACTIVE)
                Element_1 =gDialedNumbers_LastFirstElement; 
            else
                Element_1 =0;

            if(gDialedNumbers_Pos[Element_1] ==gDialedNumbers_FirstElement)
            {   
                putvalue(env_ASG_DN_ListInfo_up,"first element");
                                
                gDialedNumbers_MoveList_up_allowed =FALSE;
            }
            else 
            {
                putvalue(env_ASG_DN_ListInfo_up,empty_string);
                                
                gDialedNumbers_MoveList_up_allowed =TRUE;
                gDialedNumbers_UpCaching_required  =FALSE;
            } 

            //Pos
            putvalue(env_ASG_DN_pos_0, gDialedNumbers_Pos[Element_1]);               
            
            //PbName
            if (gDialedNumbers_recordaddress ==0 || gDialedNumbers_recordaddress ==1)
                putvalue(env_ASG_DN_PbName_s_0,gDialedNumbers_PbName[Element_1]);

            //NumberType
            if (gDialedNumbers_recordaddress ==0 || gDialedNumbers_recordaddress ==1) 
            {
                putvalue(env_ASG_DN_NumType_0, gDialedNumbers_NumberType[Element_1]);

                if(gDialedNumbers_NumberType[Element_1] <0x0F)
                    putvalue(env_ASG_DN_NumType_s_0,gDialedNumbers_NumberType_s[gDialedNumbers_NumberType[Element_1]]);
                else
                    putvalue(env_ASG_DN_NumType_s_0,gstring_reserved);
            }
            
            //TelNumber
            if (gDialedNumbers_recordaddress ==0 || gDialedNumbers_recordaddress ==2)
                putvalue(env_ASG_DN_TelNum_s_0,gDialedNumbers_TelNumber[Element_1]);

            //Day
            if (gDialedNumbers_recordaddress ==0 || gDialedNumbers_recordaddress ==2)
                putvalue(env_ASG_DN_day_0,gDialedNumbers_day[Element_1]);

            //Month
            if (gDialedNumbers_recordaddress ==0 || gDialedNumbers_recordaddress ==2)
                putvalue(env_ASG_DN_month_0,gDialedNumbers_month[Element_1]);
            
            //Year
            if (gDialedNumbers_recordaddress ==0 || gDialedNumbers_recordaddress ==2)
                putvalue(env_ASG_DN_year_0,gDialedNumbers_year[Element_1]);

            //Hour
            if (gDialedNumbers_recordaddress ==0 || gDialedNumbers_recordaddress ==2)
                putvalue(env_ASG_DN_hour_0,gDialedNumbers_hour[Element_1]);
            
            //Minute
            if (gDialedNumbers_recordaddress ==0 || gDialedNumbers_recordaddress ==2)
                putvalue(env_ASG_DN_minute_0,gDialedNumbers_minute[Element_1]);

            //Second
            if (gDialedNumbers_recordaddress ==0 || gDialedNumbers_recordaddress ==2)
                putvalue(env_ASG_DN_second_0,gDialedNumbers_second[Element_1]);
            

            //2. Element             
            if(gDialedNumbers_SlidingWindow_State ==TEL_DIALEDNUMBERS_SLIDINGWINDOW_NOTACTIVE)
                Element_2 =DialedNumbers_GetNextCachedElement(Element_1, TEL_DIALEDNUMBERS_DISPLAYLIST_FIND_NEXT_ELEMENT);
            else
                Element_2 =1;

            if(gDialedNumbers_ListEntryReceptionInformation[Element_2])
            {
                if(gDialedNumbers_Pos[Element_2] ==gDialedNumbers_LastElement)
                {   
                    putvalue(env_ASG_DN_ListInfo_Cursor,"last element");
                                        
                    gDialedNumbers_MoveList_down_allowed =FALSE;               
                }
                else
                {
                    putvalue(env_ASG_DN_ListInfo_Cursor,empty_string);
                                        
                    gDialedNumbers_MoveList_down_allowed =TRUE;
                } 

                //Pos
                putvalue(env_ASG_DN_pos_1, gDialedNumbers_Pos[Element_2]);               
            
                //PbName
                if (gDialedNumbers_recordaddress ==0 || gDialedNumbers_recordaddress ==1)
                    putvalue(env_ASG_DN_PbName_s_1,gDialedNumbers_PbName[Element_2]);

                //NumberType
                if (gDialedNumbers_recordaddress ==0 || gDialedNumbers_recordaddress ==1) 
                {
                    putvalue(env_ASG_DN_NumType_1, gDialedNumbers_NumberType[Element_2]);

                    if(gDialedNumbers_NumberType[Element_2] <0x0F)
                        putvalue(env_ASG_DN_NumType_s_1,gDialedNumbers_NumberType_s[gDialedNumbers_NumberType[Element_2]]);
                    
                    else
                        putvalue(env_ASG_DN_NumType_s_1,gstring_reserved);
                }
            
                //TelNumber
                if (gDialedNumbers_recordaddress ==0 || gDialedNumbers_recordaddress ==2)
                    putvalue(env_ASG_DN_TelNum_s_1,gDialedNumbers_TelNumber[Element_2]);

                //Day
                if (gDialedNumbers_recordaddress ==0 || gDialedNumbers_recordaddress ==2)
                    putvalue(env_ASG_DN_day_1,gDialedNumbers_day[Element_2]);

                //Month
                if (gDialedNumbers_recordaddress ==0 || gDialedNumbers_recordaddress ==2)
                    putvalue(env_ASG_DN_month_1,gDialedNumbers_month[Element_2]);
            
                //Year
                if (gDialedNumbers_recordaddress ==0 || gDialedNumbers_recordaddress ==2)
                    putvalue(env_ASG_DN_year_1,gDialedNumbers_year[Element_2]);

                //Hour
                if (gDialedNumbers_recordaddress ==0 || gDialedNumbers_recordaddress ==2)
                    putvalue(env_ASG_DN_hour_1,gDialedNumbers_hour[Element_2]);
            
                //Minute
                if (gDialedNumbers_recordaddress ==0 || gDialedNumbers_recordaddress ==2)
                    putvalue(env_ASG_DN_minute_1,gDialedNumbers_minute[Element_2]);

                //Second
                if (gDialedNumbers_recordaddress ==0 || gDialedNumbers_recordaddress ==2)
                    putvalue(env_ASG_DN_second_1,gDialedNumbers_second[Element_2]);
            }

            //3. Element          
            if(gDialedNumbers_SlidingWindow_State ==TEL_DIALEDNUMBERS_SLIDINGWINDOW_NOTACTIVE)
                Element_3 =DialedNumbers_GetNextCachedElement(Element_2, TEL_DIALEDNUMBERS_DISPLAYLIST_FIND_NEXT_ELEMENT);
            else
                Element_3 =2;

            if(gDialedNumbers_ListEntryReceptionInformation[Element_3])
            {    
                if(gDialedNumbers_Pos[Element_3] ==gDialedNumbers_LastElement)
                {   
                    putvalue(env_ASG_DN_ListInfo_down,"last element");
                                        
                    gDialedNumbers_MoveList_down_allowed =FALSE;
                }
                else
                {
                    putvalue(env_ASG_DN_ListInfo_down,empty_string);
                    
                    gDialedNumbers_MoveList_down_allowed =TRUE;
                } 

                //Pos
                putvalue(env_ASG_DN_pos_2, gDialedNumbers_Pos[Element_3]);               
            
                //PbName
                if (gDialedNumbers_recordaddress ==0 || gDialedNumbers_recordaddress ==1)
                    putvalue(env_ASG_DN_PbName_s_2,gDialedNumbers_PbName[Element_3]);

                //NumberType
                if (gDialedNumbers_recordaddress ==0 || gDialedNumbers_recordaddress ==1) 
                {
                    putvalue(env_ASG_DN_NumType_2, gDialedNumbers_NumberType[Element_3]);

                    if(gDialedNumbers_NumberType[Element_3] <0x0F)
                        putvalue(env_ASG_DN_NumType_s_2,gDialedNumbers_NumberType_s[gDialedNumbers_NumberType[Element_3]]);
                    else
                        putvalue(env_ASG_DN_NumType_s_2,gstring_reserved);
                }
            
                //TelNumber
                if (gDialedNumbers_recordaddress ==0 || gDialedNumbers_recordaddress ==2)
                    putvalue(env_ASG_DN_TelNum_s_2,gDialedNumbers_TelNumber[Element_3]);

                //Day
                if (gDialedNumbers_recordaddress ==0 || gDialedNumbers_recordaddress ==2)
                    putvalue(env_ASG_DN_day_2,gDialedNumbers_day[Element_3]);

                //Month
                if (gDialedNumbers_recordaddress ==0 || gDialedNumbers_recordaddress ==2)
                    putvalue(env_ASG_DN_month_2,gDialedNumbers_month[Element_3]);
            
                //Year
                if (gDialedNumbers_recordaddress ==0 || gDialedNumbers_recordaddress ==2)
                    putvalue(env_ASG_DN_year_2,gDialedNumbers_year[Element_3]);

                //Hour
                if (gDialedNumbers_recordaddress ==0 || gDialedNumbers_recordaddress ==2)
                    putvalue(env_ASG_DN_hour_2,gDialedNumbers_hour[Element_3]);
            
                //Minute
                if (gDialedNumbers_recordaddress ==0 || gDialedNumbers_recordaddress ==2)
                    putvalue(env_ASG_DN_minute_2,gDialedNumbers_minute[Element_3]);

                //Second
                if (gDialedNumbers_recordaddress ==0 || gDialedNumbers_recordaddress ==2)
                    putvalue(env_ASG_DN_second_2,gDialedNumbers_second[Element_3]); 
            }

            DialedNumbers_DisplayCache();
        }
    }
}
/*@@end*/

/*@@caplFunc:DialService_Indication(dword[],byte,int):*///function
DialService_Indication (dword Indication_array [], byte indication, int datalength)
{
    char i, empty_string [3];
	for(i=0;i<3;i++)
		empty_string[i]=0;

//*********
  //write("# (ASG) DialService_Indication");
//*********

    switch (indication){
	    case Processing_IND:
            //write("# --> Processing_IND ((ASG) DialService Indication)");
		break;
		case Result_IND:            		
            gDialService_Result = Indication_array[3];
            switch(gDialService_Result)
            {
                case 0x00: // successful               
                break;
                case 0x0A: // not successful - confirm emergengy call
                    write("not successful - confirm emergengy call");
                break;
            }
            putvalue(env_RNS_DialService_Result, gDialService_Result_s[gDialService_Result]);
//*********
            //write("# --> (ASG) DialService_Indication: result: %s (%x)", gDialService_Result_s[gDialService_Result], gDialService_Result);
//*********
        break;
		case Error_IND:
            if(datalength!=4)	//datalength error
			    writelineEx(gError_Trace, 0, "ASG dialservice_Indication Error_IND: BAP_datalength_error");	
       		else
				writelineEx(gError_Trace, 0, "ASG dialservice_Indication: recieved error, errorcode:0x%x", Indication_array[3]);
            putvalue(env_RNS_DialService_Result, gDialService_Result_s[0x01]);
		break;
		default:
			writelineEx(gError_Trace, 0, "ASG DialService Indication: unknown indication %d", Indication_array[3]);
		break;
	}
}
/*@@end*/

/*@@caplFunc:DialService_Request(byte,byte,byte):*///function
DialService_Request (byte request, byte service_type, byte errorcode)
{
    int offset, i;
    dword requestarray[BAP_buffer_size];

    offset = 0;

	for(i=0;i<BAP_buffer_size;i++)
		requestarray [i]=0;

//**********
    //write("# (ASG) DialService_Request");
//**********

    switch(request){
		case StartResult_REQ:
			requestarray[0] = LSGID_Telephone;	//LSG-ID
			requestarray[1] = FctID_DialService;	//Fct.-ID
			requestarray[2] = request;
			requestarray[3] = service_type; 
            //write("# --> LSGID_Telephone = 0x%x, FctID_DialService = 0x%x, request = 0x%x, service_type = 0x%x", LSGID_Telephone, FctID_DialService, request, service_type);
            offset=4;
            set_status_requestbuffer (requestarray, offset, Bap_UInt8);
        break;
        default:
			writelineEx(gError_Trace, 0, "ASG DialService_Request: unknown request %d", request);
		break;
	}
}
/*@@end*/

/*@@envVar:env_RNS_DialService:*/
on envVar env_RNS_DialService
{
    byte service_type;

    if(gRNS_PowerOnOff==Power_on && gBAP_Phone_available==BAPPhone  && getvalue(this)){
        service_type = getvalue(env_RNS_DialService_ServiceType);
        DialService_Request(StartResult_REQ, service_type, 0);
        //write("# on envVar env_RNS_DialService service_type = 0x%x", service_type);
    }
}
/*@@end*/

/*@@envVar:env_ASG_DialService_Enable:*/
on envVar env_ASG_DialService_Enable
{
    
}
/*@@end*/

/*@@envVar:env_ASG_PbSpeller_search:*/
on envVar env_ASG_PbSpeller_search
{       
    if(gRNS_PowerOnOff==Power_on && getvalue(this))
    {
        getvalue(env_ASG_PbSpeller_searchstring, gSearchString);
        gSearchMode = getvalue(env_ASG_PbSpeller_Mode);
        PbSpeller_Request(StartResult_REQ, 0);
    }
}
/*@@end*/

/*@@envVar:env_ASG_PbSpeller_panel:*/
on envVar env_ASG_PbSpeller_panel
{
    if(gRNS_PowerOnOff==Power_on && getvalue(this))
    {
        OpenPanel("ASG-Telephone_PbSpeller");
    }
}
/*@@end*/

/*@@envVar:env_ASG_ConfirmCall_Confirm:*/
on envVar env_ASG_ConfirmCall_Confirm
{
    if(gRNS_PowerOnOff==Power_on && gBAP_Phone_available==BAPPhone  && getvalue(this) && (getvalue(env_RNS_CallState_ECall_Pending) == 1))
		ConfirmEmergencyCall_Request(StartResult_REQ, ECALL_CONTROL_CONFIRM, 0);
}
/*@@end*/

/*@@caplFunc:ConfirmEmergencyCall_Request(byte,byte,byte):*///function
ConfirmEmergencyCall_Request(byte request, byte control, byte errorcode)
{
    int offset, i;
    dword requestarray[BAP_buffer_size];

//*********
    //write("# (ASG) ConfirmEmergencyCall_Request");
//*********

	offset=0;
	
	for(i=0;i<BAP_buffer_size;i++)
		requestarray [i]=0;

	switch (request){
		case StartResult_REQ:
			requestarray[0] = LSGID_Telephone;	//LSG-ID
			requestarray[1] = FctID_ConfirmEmergencyCall;	//Fct.-ID
			requestarray[2] = request;
            requestarray[3] = control;
			offset=4;
			set_status_requestbuffer(requestarray, offset, Bap_UInt8);
		break;
		default:
			writelineEx(gError_Trace, 0, "ASG ConfirmEmergencyCall_request: unknown request %d", request);
		break;
	}
}
/*@@end*/

/*@@caplFunc:ConfirmEmergencyCall_Indication(dword[],byte,int):*///function
ConfirmEmergencyCall_Indication (dword Indication_array[], byte indication, int datalength)
{
//*********
    //write("# (ASG) ConfirmEmergencyCall_Indication");
//*********

    switch (indication){
	    case Processing_IND:
		break;
		case Result_IND:  
            //write("(ASG) ConfirmEmergencyCall_Indication Result_IND");          		
            gConfirmEmergencyCall_result = Indication_array[3];
            putvalue(env_ASG_eCall_result_string, gConfirmEmergencyCall_result_s[gConfirmEmergencyCall_result]);
        break;
		case Error_IND:
            if(datalength!=4)	//datalength error
			    writelineEx(gError_Trace, 0, "ASG ConfirmEmergencyCall_Indication Error_IND: BAP_datalength_error");	
       		else
				writelineEx(gError_Trace, 0, "ASG ConfirmEmergencyCall_Indication: recieved error, errorcode:0x%x", Indication_array[3]);
            putvalue(env_ASG_eCall_result_string, gConfirmEmergencyCall_result_s[0x01]);
		break;
		default:
			writelineEx(gError_Trace, 0, "ASG ConfirmEmergencyCall Indication: unknown indication %d", Indication_array[3]);
		break;
	}
}
/*@@end*/

/*@@envVar:env_ASG_ConfirmCall_Cancel:*/
on envVar env_ASG_ConfirmCall_Cancel
{
    if(gRNS_PowerOnOff==Power_on && gBAP_Phone_available==BAPPhone  && getvalue(this) && (getvalue(env_RNS_CallState_ECall_Pending) == 1))
    {
        putvalue(env_RNS_CallState_ECall_Pending, 0);

        ConfirmEmergencyCall_Request(StartResult_REQ, ECALL_CONTROL_CANCEL, 0);
    } 
}
/*@@end*/

/*@@caplFunc:AutomaticRedial_Indication(dword[],byte,int):*///function
AutomaticRedial_Indication (dword indication_array[], byte indication, int datalength)
{
	//write("ASG: AutomaticRedial_Indication");	
    
	switch (indication){
		case Data_IND:
			if(datalength != 4)
            {
				writelineEx(gError_Trace, 0, "ASG AutomaticRedial: BAP-datalength-error");
            }
			else
            {
                gAutomaticRedialState = (indication_array[3] & 0x01);
                putvalue(env_ASG_AutomaticRedial_State, gAutomaticRedialState);                
			}
		    break;
		case Error_IND:
			if(datalength != 4)
				writelineEx(gError_Trace, 0, "ASG AutomaticRedial: BAP-datalength-error");
			else
				writelineEx(gError_Trace, 0, "ASG AutomaticRedial: recieved error, errorcode:0x%x", indication_array[3]);
		    break;
		default:
			writelineEx(gError_Trace, 0, "ASG AutomaticRedial: unknown indication %d", indication);
		    break;
    }
}
/*@@end*/

/*@@caplFunc:AutomaticRedial_Request(byte,byte):*///function
AutomaticRedial_Request(byte request, byte errorcode)
{
    int offset, i;
    dword requestarray [BAP_buffer_size];

    //write("ASG: AutomaticRedial_Request");

	offset=0;

	for(i=0;i<BAP_buffer_size;i++)
		requestarray [i]=0;
	
	switch(request){
		case DataSetGet_REQ:
			requestarray[0] = LSGID_Telephone;	//LSG-ID
			requestarray[1] = FctID_AutomaticRedial;	//Fct.-ID
			requestarray[2] = request;	
			requestarray[3] = gAutomaticRedialState;
			offset = 4;
			set_status_requestbuffer(requestarray, offset, Bap_UInt8);
		    break;
		case DataGet_REQ:
			requestarray[0] = LSGID_Telephone;	//LSG-ID
			requestarray[1] = FctID_AutomaticRedial;	//Fct.-ID
			requestarray[2] = request;
			offset = 3;
			set_status_requestbuffer (requestarray, offset, Bap_Void);
		    break;
		default:	//error
			writelineEx(gError_Trace, 0, "ASG AutomaticRedial_Request: unknown request %d", request);
		    break;
	}
}
/*@@end*/

/*@@caplFunc:GetNextListPos_Request(byte,byte):*///function
GetNextListPos_Request(byte request, byte errorcode)
{
    int i, offset;
    dword requestarray[BAP_buffer_size], length;

	offset=0;
	length=0;
	
	for(i = 0; i < BAP_buffer_size; i++)
		requestarray[i] = 0;

	switch (request){
		case StartResult_REQ:
			requestarray[0] = LSGID_Telephone;	//LSG-ID
			requestarray[1] = FctID_GetNextListPos;	//Fct.-ID
			requestarray[2] = request;
			requestarray[3] = gGetNextListPos_currentPos & 0xff;
            requestarray[4] = (gGetNextListPos_currentPos & 0xff00) >> 8; // /0x100
            requestarray[5] = gGetNextListPos_Offset & 0xff;
            requestarray[6] = (gGetNextListPos_Offset & 0xff00) >> 8;
            requestarray[7] = gGetNextListPos_ListType;
            //write("gGetNextListPos_Offset & 0xff: %d, (gGetNextListPos_Offset & 0xff00) >> 8: %d", gGetNextListPos_Offset & 0xff,  (gGetNextListPos_Offset & 0xff00) >> 8);
			offset = 8;			
			set_status_requestbuffer (requestarray, offset, Bap_ByteSequence);
            gGetNextListPos_waiting_for_result = 1;
            //write("gGetNextListPos_waiting_for_result: %d", gGetNextListPos_waiting_for_result);
		break;
		case Abort_REQ:
			requestarray[0] = LSGID_Telephone;	//LSG-ID
			requestarray[1] = FctID_GetNextListPos;	//Fct.-ID
			requestarray[2] = request;

			offset = 3;
			set_status_requestbuffer (requestarray, offset, Bap_Void);
		break;
		default:
			write("ASG GetNextListPos_Request: invalid request: %d", request);
		break;
	}
}
/*@@end*/

/*@@caplFunc:GetNextListPos_Indication(dword[],byte,int):*///function
GetNextListPos_Indication(dword indication_array[], byte indication, int datalength)
{
    byte errorcode;

	errorcode=0x00;

	switch (indication){
		case Processing_IND:
		break;
		case Result_IND:
            gGetNextListPos_waiting_for_result = 0;
            if(datalength != 10)	//datalength error 
			{
            	writelineEx(gError_Trace, 0, "ASG GetNextListPos_Indication: BAP-datalength-error");
                break;
            }
            gGetNextListPos_Result = indication_array[3];
            gGetNextListPos_currentPos = indication_array[4] + indication_array[5] * 0x100;
            gGetNextListPos_nextPos = indication_array[6] + indication_array[7] * 0x100;
            gGetNextListPos_absoluteListPos = indication_array[8] + indication_array[9] * 0x100;	
            putvalue(env_ASG_GetNextListPos_Result, gGetNextListPos_Result_s[gGetNextListPos_Result]);
            putvalue(env_ASG_GetNextListPos_absPos, gGetNextListPos_absoluteListPos);
            putvalue(env_ASG_GetNextListPos_nxtPos, gGetNextListPos_nextPos);
            //write("indication_array[8]: %d, indication_array[9]: %d, gGetNextListPos_absoluteListPos: %d", indication_array[8], indication_array[9], gGetNextListPos_absoluteListPos);
		break;
		case Error_IND:
			if(datalength!=4)	//datalength error
				writelineEx(gError_Trace, 0, "ASG GetNextListPos_Indication: BAP-datalength-error");
			else
				writelineEx(gError_Trace, 0, "ASG GetNextListPos_Indication: recieved error, errorcode:0x%x", indication_array[3]);
		break;
		default:
			writelineEx(gError_Trace, 0, "ASG GetNextListPos_Indication: unknown indication %d", indication);
		break;
	}
}
/*@@end*/

/*@@envVar:env_ASG_GetNextListPos_send:*/
on envVar env_ASG_GetNextListPos_send
{
    if(gRNS_PowerOnOff==Power_on && gBAP_Phone_available==BAPPhone  && getvalue(this))
    {
        gGetNextListPos_currentPos = getvalue(env_ASG_GetNextListPos_currPos);
        gGetNextListPos_Offset = getvalue(env_ASG_GetNextListPos_Offset);
        gGetNextListPos_ListType = 0x00; // phonebook
        GetNextListPos_Request(StartResult_REQ, 0);
    }
}
/*@@end*/

/*@@envVar:env_ASG_mute_ringtone:*/
on envVar env_ASG_mute_ringtone
{
    if(gRNS_PowerOnOff==Power_on && gBAP_Phone_available==BAPPhone && getvalue(this))
    {
        putvalue(env_RNS_RingToneMuteOnOff, 1);
    }
}
/*@@end*/

/*@@envVar:env_ASG_methods:*/
on envVar env_ASG_methods
{
    if(getvalue(this))
    {
        if(gRNS_PowerOnOff) //ASG Power on
        {
            //OpenPanel("ASG-Telephone_Properties_2");
            OpenPanel("ASG-Telephone_Methods");
        }
    }
}
/*@@end*/

/*@@envVar:env_ASG_Schalter_OnOff:*/
on envVar env_ASG_Schalter_OnOff
{
    if(getvalue(this))  //ASG Power on
    {
        putvalue(env_RNS_Power_on_off, 1);
        gASG_Schalter_OnOff = 1;
        putvalue(env_ASG_Schalter_OnOff_string,gASG_Schalter_OnOff_string[gASG_Schalter_OnOff]);
        
    }
    else                //ASG Power off
    {
        putvalue(env_RNS_Power_on_off, 0);
        gASG_Schalter_OnOff = 0;
        putvalue(env_ASG_Schalter_OnOff_string,gASG_Schalter_OnOff_string[gASG_Schalter_OnOff]);

        ClosePanel("ASG-Telephone_Properties_2");
        ClosePanel("ASG-Telephone_Properties_1");
        ClosePanel("ASG-Telephone_Methods");
        ClosePanel("ASG-Telephone_MissedCalls");
        ClosePanel("ASG-Telephone_MissedCalls(array)");
        ClosePanel("ASG-Telephone_SlidingWindow");
        ClosePanel("ASG-Telephone_Phonebook");
        ClosePanel("ASG-Telephone_Phonebook(array)");
        ClosePanel("ASG-Telephone_Phonebook_SlW");
    }
}
/*@@end*/

/*@@envVar:env_ASG_Panel_Methods:*/
on envVar env_ASG_Panel_Methods
{
    if(getvalue(this))
    {
        if(gRNS_PowerOnOff) //ASG Power on
        {
            OpenPanel("ASG-Telephone_Methods");
        }
    }    
}
/*@@end*/

/*@@envVar:env_ASG_Panel_Properties1:*/
on envVar env_ASG_Panel_Properties1
{
    if(getvalue(this))
    {
        if(gRNS_PowerOnOff) //ASG Power on
        {
            OpenPanel("ASG-Telephone_Properties_1");
        }
    } 
}
/*@@end*/

/*@@envVar:env_ASG_Panel_Properties2:*/
on envVar env_ASG_Panel_Properties2
{
    if(getvalue(this))
    {
        if(gRNS_PowerOnOff) //ASG Power on
        {
            OpenPanel("ASG-Telephone_Properties_2");
        }
    } 
}
/*@@end*/

/*@@envVar:env_ASG_Panel_Phonebook:*/
on envVar env_ASG_Panel_Phonebook
{
    if(getvalue(this))
    {
        if(gRNS_PowerOnOff) //ASG Power on
        {
            OpenPanel("ASG-Telephone_Phonebook");
        }
    } 
}
/*@@end*/

/*@@envVar:env_ASG_Panel_Phonebook_Array:*/
on envVar env_ASG_Panel_Phonebook_Array
{
    if(getvalue(this))
    {
        if(gRNS_PowerOnOff) //ASG Power on
        {
            OpenPanel("ASG-Telephone_Phonebook(array)");
        }
    } 
}
/*@@end*/

/*@@envVar:env_ASG_Panel_Phonebook_SlW:*/
on envVar env_ASG_Panel_Phonebook_SlW
{
    if(getvalue(this))
    {
        if(gRNS_PowerOnOff) //ASG Power on
        {
            OpenPanel("ASG-Telephone_Phonebook_SlW");
        }
    } 
}
/*@@end*/

/*@@envVar:env_ASG_Panel_PbSpeller:*/
on envVar env_ASG_Panel_PbSpeller
{
    if(getvalue(this))
    {
        if(gRNS_PowerOnOff) //ASG Power on
        {
            OpenPanel("ASG-Telephone_PbSpeller");
        }
    } 
}
/*@@end*/

/*@@envVar:env_ASG_Panel_CombNum_Array:*/
on envVar env_ASG_Panel_CombNum_Array
{
   if(getvalue(this))
    {
        if(gRNS_PowerOnOff) //ASG Power on
        {
            OpenPanel("ASG_Telephone_0x31 - CombinedNumbers_(array)");
        }
    }  
}
/*@@end*/

/*@@envVar:env_ASG_Panel_DialNum_Array:*/
on envVar env_ASG_Panel_DialNum_Array
{
   if(getvalue(this))
    {
        if(gRNS_PowerOnOff) //ASG Power on
        {
            OpenPanel("ASG_Telephone_0x30 - DialedNumbers_(array)");
        }
    }  
}
/*@@end*/

/*@@envVar:env_ASG_Panel_RecCalls_Array:*/
on envVar env_ASG_Panel_RecCalls_Array
{
     if(getvalue(this))
    {
        if(gRNS_PowerOnOff) //ASG Power on
        {
            OpenPanel("ASG_Telephone_0x2F - ReceivedCalls_(array)");
        }
    }    
}
/*@@end*/

/*@@envVar:env_ASG_Panel_MiCalls_Array:*/
on envVar env_ASG_Panel_MiCalls_Array
{
     if(getvalue(this))
    {
        if(gRNS_PowerOnOff) //ASG Power on
        {
            OpenPanel("ASG-Telephone_MissedCalls(array)");
        }
    }       
}
/*@@end*/

/*@@envVar:env_ASG_Panel_MiCalls:*/
on envVar env_ASG_Panel_MiCalls
{
     if(getvalue(this))
    {
        if(gRNS_PowerOnOff) //ASG Power on
        {
            OpenPanel("ASG-Telephone_MissedCalls");
        }
    }       
}
/*@@end*/

/*@@envVar:env_ASG_Panel_GetNextListPos:*/
on envVar env_ASG_Panel_GetNextListPos
{
    if(getvalue(this))
    {
        if(gRNS_PowerOnOff) //ASG Power on
        {
            OpenPanel("ASG-Telephone_GetNextListPos");
        }
    }       
}
/*@@end*/

/*@@envVar:env_ASG_Panel_SlidingWindow:*/
on envVar env_ASG_Panel_SlidingWindow
{
    if(getvalue(this))
    {
        if(gRNS_PowerOnOff) //ASG Power on
        {
            OpenPanel("ASG-Telephone_SlidingWindow");
        }
    }       
}
/*@@end*/

/*@@envVar:env_ASG_AutomaticRedial_State:*/
on envVar env_ASG_AutomaticRedial_State
{
    if(gRNS_PowerOnOff==Power_on)
    {
        if(gAutomaticRedialState != getvalue(this))
        {
            gAutomaticRedialState = getvalue(this);
            AutomaticRedial_Request(DataSetGet_REQ, 0);
            putvalue(env_ASG_AutomaticRedial_StateS, gAutomaticRedialState_String[gAutomaticRedialState]);
        }
        else
        {
            putvalue(env_ASG_AutomaticRedial_StateS, gAutomaticRedialState_String[gAutomaticRedialState]);
        }        
    }
}
/*@@end*/

/*@@envVar:env_ASG_GetNextListPos_abort:*/
on envVar env_ASG_GetNextListPos_abort
{ 
    if(gRNS_PowerOnOff==Power_on && gBAP_Phone_available==BAPPhone  && getvalue(this) && gGetNextListPos_waiting_for_result)
    {   
        //write("abort");  
        GetNextListPos_Request(Abort_REQ, 0);
    }
}
/*@@end*/

