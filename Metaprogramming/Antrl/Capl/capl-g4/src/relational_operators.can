variables
{
    int y,z;
    y = 8;
    z = 4;
    if (y == z) // test result is FALSE
    {

    }

    if (y != z) // test result is TRUE
    {

    }

    if (y <= z) // test result is FALSE
    {

    }

    if (y >= z) // test result is TRUE
    {
        
    }
}