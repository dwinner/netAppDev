/*@@var:*/
/*
Copyright ( C ) Continental AG 2012

Created by generator, do not modify

Based on Version  1.0, 12.05.10   from M.Dangelmeyr      IBD im Auftrag von EP/ESE   Daimler AG

Date of creation :  14.04.2011

Created by :                 Hans Jürgen Hipp

*/


variables
{
    const TRUE  =   0xAA;
    const FALSE =   0x00;
    const cManual = 0x00;
    const cAuto =   0xAA;

    msTimer t_DBKomTimer;      // Timer zum zyklischen Aufruf der DBKom-Task
    int c_tDBKomTimer = 20;    // msec


    // BA_DEF_ BO_  "GenMsgSendType" ENUM
    //  0 : cyclicX
    //  1 : spontanX
    //  2 : cyclicIfActiveX
    //  3 : spontanWithDelay
    //  4 : cyclicAndSpontanX
    //  5 : cyclicAndSpontanWithDelay
    //  6 : spontanWithRepitition
    //  7 : cyclicIfActiveAndSpontanWD
    //  8 : cyclicIfActiveFast
    //  9 : cyclicWithRepeatOnDemand
    //  10 : none

   // Botschaft Ctrl_C_Stat1_AR ---- Sendeart 5 cyclicAndSpontanWithDelay
   message CAN2.Ctrl_C_Stat1_AR _mCtrl_C_Stat1_AR;
   int _Ctrl_C_Stat1_AR_CycleCount = 5;
   int _Ctrl_C_Stat1_AR_Cnt;
   int _Ctrl_C_Stat1_AR_SpontanFlag = 0;
   int _Ctrl_C_Stat1_AR_MinDelay = 1;
   int _Ctrl_C_Stat1_AR_DelayCnt;
   msTimer _tCtrl_C_Stat1_AR;

    // Botschaft Ctrl_C_Stat2_AR ---- Sendeart 0 cyclic ---
    message CAN2.Ctrl_C_Stat2_AR _mCtrl_C_Stat2_AR;
    int _Ctrl_C_Stat2_AR_CycleCount = 2;
    int _Ctrl_C_Stat2_AR_Cnt;
    msTimer _tCtrl_C_Stat2_AR;

   // Botschaft Ctrl_C_Stat3_AR ---- Sendeart 5 cyclicAndSpontanWithDelay
   message CAN2.Ctrl_C_Stat3_AR _mCtrl_C_Stat3_AR;
   int _Ctrl_C_Stat3_AR_CycleCount = 5;
   int _Ctrl_C_Stat3_AR_Cnt;
   int _Ctrl_C_Stat3_AR_SpontanFlag = 0;
   int _Ctrl_C_Stat3_AR_MinDelay = 1;
   int _Ctrl_C_Stat3_AR_DelayCnt;
   msTimer _tCtrl_C_Stat3_AR;

   // Botschaft Ctrl_C_Stat_AR ---- Sendeart 5 cyclicAndSpontanWithDelay
   message CAN2.Ctrl_C_Stat_AR _mCtrl_C_Stat_AR;
   int _Ctrl_C_Stat_AR_CycleCount = 3;
   int _Ctrl_C_Stat_AR_Cnt;
   int _Ctrl_C_Stat_AR_SpontanFlag = 0;
   int _Ctrl_C_Stat_AR_MinDelay = 0;
   int _Ctrl_C_Stat_AR_DelayCnt;
   msTimer _tCtrl_C_Stat_AR;

   // Botschaft ROE_CTRL_C ---- Sendeart 1 spontanX
   message CAN2.ROE_CTRL_C _mROE_CTRL_C;
   int _ROE_CTRL_C_SpontanFlag = 0;  
   msTimer _tROE_CTRL_C;






    Timer _tDoorNMCancelTimer;
    Timer _tKeyInLockNMCancelTimer;

    char buffer[1024], stringbuffer[512];
    int bActiveHelper;    // Hilfsvariable für "Aktive Signale"

//--------------------------------------- AUTOSAR NM ------------------------------------------------

    const byte cAUTO =   0;
    const byte cMANUAL = 1;

    msTimer t_NM_Transmit;
    long  NM_Transmit_Cycle;
    msTimer t_NM_Wait_Bus_Sleep_Time;
    const c_NM_Wait_Bus_Sleep_Time = 1500;
//    msTimer t_NM_Remote_Sleep_Ind_Time;
    const c_NM_Remote_Sleep_Ind_Time = 5000;
    msTimer t_NM_Repeat_Message_Time;
    const c_NM_Repeat_Message_Time = 6000;
    msTimer t_NM_Timeout_Time;
    const c_NM_Timeout_Time = 5000;

    byte NM_Mode = 0;
    const byte cNM_Mode_Init = 0;
    const byte cNM_Mode_Sleep = 1;
    const byte cNM_Mode_Prepare_Bus_Sleep = 2;
    const byte cNM_Mode_Ready_Sleep = 3;
    const byte cNM_Mode_Normal_Operation_State = 4;
    const byte cNM_Mode_RepeatMsg = 5;

    byte boCanNM_Rx_Indication = 0;
    byte boCanNM_Tx_Confirmation = 0;
    byte boCanNM_WaitBusSleep_Timer_Expired = 0;
    byte boCanNM_RepeatMessage_Timer_Expired = 0;
    byte boCanNM_NM_Timeout_Timer_Expired = 0;
    byte boCanNM_RepeatMessage_Requested = 0;

    const word cFLDoorNMRequest =       0x0001;
    const word cFRDoorNMRequest =       0x0002;
    const word cRLDoorNMRequest =       0x0004;
    const word cRRDoorNMRequest =       0x0008;
    const word cIgnitionNMRequest =     0x0010;
    const word cManualNMRequest =       0x8000;

    const CanNmNodeId_Base =       1280; //  = 400h
    const CanNmNodeId_TPAD =         55;
    const CanNmNodeId_TGW =          56; //  =  38h
    const CanNmNodeId_DISP_RL =      57;
    const CanNmNodeId_CTRL_C =       58;
    const CanNmNodeId_DISP_C =       59;
    const CanNmNodeId_DISP_RR =      61;

    const CanNmNodeDetectionEnabled          = 0; //false
    const CanNmNodeIdEnabled                 = 1; //true
    const CanNmUserDataEnabled               = 1; //true;
    const CanNmUserDataLentgh                = 7;
    const CanNmRepeatMsgIndEnabled           = 1; //true;
    const CanNmDevErrorDetect                = 0; //false
//    const CanNmUserDataEnabled             = 1; //true
    const CanNmRemoteSleepIndEnabled         = 0; //false
    const CanNmMsgReducedtime                = 80; //ms
    const CanNmPduRxIndicationEnabled        = 0; //false
    const CanNmStateChangeIndEnabled         = 0; //false
    const CanNmImmediateTxconfEnabled        = 0;// false
    const CanNmMsgTimeoutTime                = 5000; //ms
    const CanNmPduNidPosition                = 0; //CANNM_PDU_BYTE_0;
    const CanNmPduCbvPosition                = 0xFF; //ANNM_PDU_OFF;
    const CanNmPduLength                     = 8;
    const cCanNmPassiveModeEnabled           = 0; //false
    const CanNmBusSynchronizationEnabled     = 0; //false
    const CanNmBusLoadReductionEnabled       = 1; //true
//    const CanNmRemoteSleepIndEnabled       = 0; //false
//    const CanNmNodeDetectionEnabled        = 0; //false
    const CanNmComControlEnabled             = 1; //true    

    const NmAsrCanMsgStandardCycle =          2000;
    const NmAsrCanMsgCycleOffset_TPAD =         70;
    const NmAsrCanMsgReducedTime_TPAD =       1550;
    const NmAsrCanMsgCycleOffset_TGW =           0;
    const NmAsrCanMsgReducedTime_TGW =        1560;
    const NmAsrCanMsgCycleOffset_DISP_RL =      10;
    const NmAsrCanMsgReducedTime_DISP_RL =    1570;
    const NmAsrCanMsgCycleOffset_CTRL_C =       20;
    const NmAsrCanMsgReducedTime_CTRL_C =     1580;
    const NmAsrCanMsgCycleOffset_DISP_C =       30;
    const NmAsrCanMsgReducedTime_DISP_C =     1590;
    const NmAsrCanMsgCycleOffset_DISP_RR =      50;
    const NmAsrCanMsgReducedTime_DISP_RR =    1610;

    char gECU[10] = "HU_CTRL_C";

    byte CanNmNodeId            = CanNmNodeId_CTRL_C;
    word NmNodeIdentifier       = CanNmNodeId_Base + CanNmNodeId_CTRL_C;
    word NmAsrCanMsgCycleOffset = NmAsrCanMsgCycleOffset_CTRL_C;
    word NmAsrCanMsgReducedTime = NmAsrCanMsgReducedTime_CTRL_C;
    word NmAsrCanMsgCycleTime   = 2000;
    byte NM_Repeat_Message_State_Active = 0;
    byte NM_AutomaticModeActive = 0;

    // Botschaft NM_xxx_AR --- Sendeart cyclicX --- 
      message CAN2.NM_CTRL_C_AR _mNM_xxx_AR;
    byte _mNM_xxx_Transmit_Allowed = 1;

//--------------------------------------- AUTOSAR NM ------------------------------------------------

    byte  crctable[256] = {
        0x00, 0x1D, 0x3A, 0x27, 0x74, 0x69, 0x4E, 0x53, 0xE8, 0xF5, 0xD2, 0xCF, 0x9C, 0x81, 0xA6, 0xBB,
        0xCD, 0xD0, 0xF7, 0xEA, 0xB9, 0xA4, 0x83, 0x9E, 0x25, 0x38, 0x1F, 0x02, 0x51, 0x4C, 0x6B, 0x76,
        0x87, 0x9A, 0xBD, 0xA0, 0xF3, 0xEE, 0xC9, 0xD4, 0x6F, 0x72, 0x55, 0x48, 0x1B, 0x06, 0x21, 0x3C,
        0x4A, 0x57, 0x70, 0x6D, 0x3E, 0x23, 0x04, 0x19, 0xA2, 0xBF, 0x98, 0x85, 0xD6, 0xCB, 0xEC, 0xF1,
        0x13, 0x0E, 0x29, 0x34, 0x67, 0x7A, 0x5D, 0x40, 0xFB, 0xE6, 0xC1, 0xDC, 0x8F, 0x92, 0xB5, 0xA8,
        0xDE, 0xC3, 0xE4, 0xF9, 0xAA, 0xB7, 0x90, 0x8D, 0x36, 0x2B, 0x0C, 0x11, 0x42, 0x5F, 0x78, 0x65,
        0x94, 0x89, 0xAE, 0xB3, 0xE0, 0xFD, 0xDA, 0xC7, 0x7C, 0x61, 0x46, 0x5B, 0x08, 0x15, 0x32, 0x2F,
        0x59, 0x44, 0x63, 0x7E, 0x2D, 0x30, 0x17, 0x0A, 0xB1, 0xAC, 0x8B, 0x96, 0xC5, 0xD8, 0xFF, 0xE2,
        0x26, 0x3B, 0x1C, 0x01, 0x52, 0x4F, 0x68, 0x75, 0xCE, 0xD3, 0xF4, 0xE9, 0xBA, 0xA7, 0x80, 0x9D,
        0xEB, 0xF6, 0xD1, 0xCC, 0x9F, 0x82, 0xA5, 0xB8, 0x03, 0x1E, 0x39, 0x24, 0x77, 0x6A, 0x4D, 0x50,
        0xA1, 0xBC, 0x9B, 0x86, 0xD5, 0xC8, 0xEF, 0xF2, 0x49, 0x54, 0x73, 0x6E, 0x3D, 0x20, 0x07, 0x1A,
        0x6C, 0x71, 0x56, 0x4B, 0x18, 0x05, 0x22, 0x3F, 0x84, 0x99, 0xBE, 0xA3, 0xF0, 0xED, 0xCA, 0xD7,
        0x35, 0x28, 0x0F, 0x12, 0x41, 0x5C, 0x7B, 0x66, 0xDD, 0xC0, 0xE7, 0xFA, 0xA9, 0xB4, 0x93, 0x8E,
        0xF8, 0xE5, 0xC2, 0xDF, 0x8C, 0x91, 0xB6, 0xAB, 0x10, 0x0D, 0x2A, 0x37, 0x64, 0x79, 0x5E, 0x43,
        0xB2, 0xAF, 0x88, 0x95, 0xC6, 0xDB, 0xFC, 0xE1, 0x5A, 0x47, 0x60, 0x7D, 0x2E, 0x33, 0x14, 0x09,
        0x7F, 0x62, 0x45, 0x58, 0x0B, 0x16, 0x31, 0x2C, 0x97, 0x8A, 0xAD, 0xB0, 0xE3, 0xFE, 0xD9, 0xC4
    };

    byte  crctable_profile02[256] = {
        0x00, 0x2F, 0x5E, 0x71, 0xBC, 0x93, 0xE2, 0xCD, 0x57, 0x78, 0x09, 0x26, 0xEB, 0xC4, 0xB5, 0x9A,
        0xAE, 0x81, 0xF0, 0xDF, 0x12, 0x3D, 0x4C, 0x63, 0xF9, 0xD6, 0xA7, 0x88, 0x45, 0x6A, 0x1B, 0x34,
        0x73, 0x5C, 0x2D, 0x02, 0xCF, 0xE0, 0x91, 0xBE, 0x24, 0x0B, 0x7A, 0x55, 0x98, 0xB7, 0xC6, 0xE9,
        0xDD, 0xF2, 0x83, 0xAC, 0x61, 0x4E, 0x3F, 0x10, 0x8A, 0xA5, 0xD4, 0xFB, 0x36, 0x19, 0x68, 0x47,
        0xE6, 0xC9, 0xB8, 0x97, 0x5A, 0x75, 0x04, 0x2B, 0xB1, 0x9E, 0xEF, 0xC0, 0x0D, 0x22, 0x53, 0x7C,
        0x48, 0x67, 0x16, 0x39, 0xF4, 0xDB, 0xAA, 0x85, 0x1F, 0x30, 0x41, 0x6E, 0xA3, 0x8C, 0xFD, 0xD2,
        0x95, 0xBA, 0xCB, 0xE4, 0x29, 0x06, 0x77, 0x58, 0xC2, 0xED, 0x9C, 0xB3, 0x7E, 0x51, 0x20, 0x0F,
        0x3B, 0x14, 0x65, 0x4A, 0x87, 0xA8, 0xD9, 0xF6, 0x6C, 0x43, 0x32, 0x1D, 0xD0, 0xFF, 0x8E, 0xA1,
        0xE3, 0xCC, 0xBD, 0x92, 0x5F, 0x70, 0x01, 0x2E, 0xB4, 0x9B, 0xEA, 0xC5, 0x08, 0x27, 0x56, 0x79,
        0x4D, 0x62, 0x13, 0x3C, 0xF1, 0xDE, 0xAF, 0x80, 0x1A, 0x35, 0x44, 0x6B, 0xA6, 0x89, 0xF8, 0xD7,
        0x90, 0xBF, 0xCE, 0xE1, 0x2C, 0x03, 0x72, 0x5D, 0xC7, 0xE8, 0x99, 0xB6, 0x7B, 0x54, 0x25, 0x0A,
        0x3E, 0x11, 0x60, 0x4F, 0x82, 0xAD, 0xDC, 0xF3, 0x69, 0x46, 0x37, 0x18, 0xD5, 0xFA, 0x8B, 0xA4,
        0x05, 0x2A, 0x5B, 0x74, 0xB9, 0x96, 0xE7, 0xC8, 0x52, 0x7D, 0x0C, 0x23, 0xEE, 0xC1, 0xB0, 0x9F,
        0xAB, 0x84, 0xF5, 0xDA, 0x17, 0x38, 0x49, 0x66, 0xFC, 0xD3, 0xA2, 0x8D, 0x40, 0x6F, 0x1E, 0x31,
        0x76, 0x59, 0x28, 0x07, 0xCA, 0xE5, 0x94, 0xBB, 0x21, 0x0E, 0x7F, 0x50, 0x9D, 0xB2, 0xC3, 0xEC,
        0xD8, 0xF7, 0x86, 0xA9, 0x64, 0x4B, 0x3A, 0x15, 0x8F, 0xA0, 0xD1, 0xFE, 0x33, 0x1C, 0x6D, 0x42
    };
}
/*@@end*/

/*@@startStart:Start:*/
on start
{
    putValue( HU__NM_CTRL_C_NM_Request, 0 );  // reset all requests
    _NM_Switch_NM_Mode();
    Ctrl_C_Stat1_AR_init();   // Botschaft Ctrl_C_Stat1_AR   --- Sendeart 5 cyclicAndSpontanWithDelay --- 
    Ctrl_C_Stat2_AR_init();   // Botschaft Ctrl_C_Stat2_AR   --- Sendeart 2 cyclicIfActiveX --- 
    Ctrl_C_Stat3_AR_init();   // Botschaft Ctrl_C_Stat3_AR   --- Sendeart 5 cyclicAndSpontanWithDelay --- 
    Ctrl_C_Stat_AR_init();    // Botschaft Ctrl_C_Stat_AR    --- Sendeart 5 cyclicAndSpontanWithDelay --- 
    ROE_CTRL_C_init();        // Botschaft ROE_CTRL_C        --- Sendeart 1 spontanX --- 

    putValue( HU__NM_CTRL_C_AutomaticModeActive, 0 );
    putValue( HU__NM_CTRL_C_AutomaticModeActive, 1 );
}
/*@@end*/

/*@@timer:t_DBKomTimer:*/
on Timer t_DBKomTimer
{
// *** DBKom-Sendefunktion ***
    // timer aufziehen für nächsten Zyklus
    if( getValue( HU__NM_CTRL_C_CommActive        ) /*|
       getValue( HU__NM_CTRL_C_RequestBusCom ) */  )
    {
        setTimer( t_DBKomTimer, 20 );
    }
    Ctrl_C_Stat1_AR_check_output();   // Botschaft Ctrl_C_Stat1_AR    --- Sendeart 5 cyclicAndSpontanWithDelay --- 
    Ctrl_C_Stat2_AR_check_output();   // Botschaft Ctrl_C_Stat2_AR    --- Sendeart 2 cyclicIfActiveX --- 
    Ctrl_C_Stat3_AR_check_output();   // Botschaft Ctrl_C_Stat3_AR    --- Sendeart 5 cyclicAndSpontanWithDelay --- 
    Ctrl_C_Stat_AR_check_output();    // Botschaft Ctrl_C_Stat_AR     --- Sendeart 5 cyclicAndSpontanWithDelay --- 
    ROE_CTRL_C_check_output();        // Botschaft ROE_CTRL_C         --- Sendeart 9 cyclicWithRepeatOnDemand --- 
}
/*@@end*/

/*@@busOff:BusOff:*/
on busOff
{
    resetCan();
    write("CAN has been resetted due to BUSOFF    ( coded version )");
}
/*@@end*/

/*@@msg:0x500-0x57F:*/
on message 0x500-0x57F
{
    byte Identifier;

    Identifier = this.byte( 1 );

    if( this.byte( 1 ) == CanNmNodeId )    // check, wether the received NM-Frame is an own one
    {
        boCanNM_Tx_Confirmation = TRUE;    // so it is a TX-confirmation
    }
    else
    {
        boCanNM_Rx_Indication = TRUE;     // else it is a NM-Frame from another ECU
    }
    _NM_Switch_NM_Mode();     // inform the state-mashine
}
/*@@end*/

/*@@timer:_tDoorNMCancelTimer:*/
on timer _tDoorNMCancelTimer
{
    if( getValue( HU__NM_CTRL_C_AutomaticModeActive ) == 1 )
    {
        _ReleaseCommRequest( 15 );  // all doors reset their requests
    }
}
/*@@end*/

/*@@timer:_tKeyInLockNMCancelTimer:*/
on timer _tKeyInLockNMCancelTimer
{
    if( getValue( HU__NM_CTRL_C_AutomaticModeActive ) == 1)
    {
        _ReleaseCommRequest( cIgnitionNMRequest );
    }
}
/*@@end*/

/*@@timer:t_NM_Repeat_Message_Time:*/
on timer t_NM_Repeat_Message_Time
{
    boCanNM_RepeatMessage_Timer_Expired = TRUE;
    _NM_Switch_NM_Mode();     // inform the state-mashine
}
/*@@end*/

/*@@timer:t_NM_Timeout_Time:*/
on timer t_NM_Timeout_Time
{
    boCanNM_NM_Timeout_Timer_Expired = TRUE;
    _NM_Switch_NM_Mode();     // inform the state-mashine
}
/*@@end*/

/*@@timer:t_NM_Transmit:*/
on timer t_NM_Transmit
{
    setTimer( t_NM_Transmit, NM_Transmit_Cycle );
    _mNM_xxx_AR.byte( 1 ) = CanNmNodeId;
    if( _mNM_xxx_Transmit_Allowed )
        output( _mNM_xxx_AR );
}
/*@@end*/

/*@@timer:t_NM_Wait_Bus_Sleep_Time:*/
on timer t_NM_Wait_Bus_Sleep_Time
{
    boCanNM_WaitBusSleep_Timer_Expired = TRUE;
    _NM_Switch_NM_Mode();     // inform the state-mashine
}
/*@@end*/

/*@@envVar:HU__NM_CTRL_C_AutomaticModeActive:*/
on envVar HU__NM_CTRL_C_AutomaticModeActive
{
    byte temp; // actual NM request status

    if( getValue( this ) )
    {
        EnableControl( "Hauptpanel", "EnvVar:HMI__NM_CTRL_C_Manually_Request_NM", 0 );

        temp = getValue( HU_ISw_Stat );
        write( "HU_ISw_Stat is %d", temp );
        if( temp > 1 ) // IGN not Lock
        {
            putValue( HU__NM_CTRL_C_Manually_Request_NM, 1 );
            putValue( HU__NM_CTRL_C_NM_Request, cIgnitionNMRequest );
            _NM_Switch_NM_Mode();
        }
        else
        {
            putValue( HU__NM_CTRL_C_Manually_Request_NM, 0 );
            _ReleaseCommRequest( 0xFF );  // release all requests
            _NM_Switch_NM_Mode();
        }
    }
    else
    {
        _ReleaseCommRequest( 0xFF );  // release all requests
    }
    NM_AutomaticModeActive = getValue( this );
}
/*@@end*/

/*@@envVar:HU__NM_CTRL_C_COM_Request:*/
on envVar HU__NM_CTRL_C_COM_Request
{
    byte temp;   //actual ISw_stat
    temp = getValue( this );
    if( temp == 0)
    {
        if( getValue( HU__NM_CTRL_C_AutomaticModeActive ) == 1)
        {
        cancelTimer( _tKeyInLockNMCancelTimer );
        _ReleaseCommRequest( cIgnitionNMRequest );
        setTimer( _tKeyInLockNMCancelTimer, 1 );
        }
    }
    if( temp == 1)
    {
        if( getValue( HU__NM_CTRL_C_AutomaticModeActive ) == 1)
        {
        cancelTimer( _tKeyInLockNMCancelTimer );
        _SetCommRequest( cIgnitionNMRequest );
        }
    }
}
/*@@end*/

/*@@envVar:HU__NM_CTRL_C_Manually_Request_NM:*/
on envVar HU__NM_CTRL_C_Manually_Request_NM
{
    if( getValue ( HU__NM_CTRL_C_AutomaticModeActive ) ==0 )
    {
        if( getValue( this ) )
        {
            _SetCommRequest( cManualNMRequest );
        }
        else
        {
            _ReleaseCommRequest( 0xFF );// all
        }
    }
}
/*@@end*/

/*@@caplFunc:_NM_Switch_NM_Mode():*/
_NM_Switch_NM_Mode()
{
    byte bOld_NM_Mode;
    word NM_Request_State;

    bOld_NM_Mode = NM_Mode;
    NM_Request_State = getValue( HU__NM_CTRL_C_NM_Request );
    switch( NM_Mode )
    {
        case cNM_Mode_Init:                   _NM_Init();
                                              NM_Mode = cNM_Mode_Sleep;
                                              break;
        case cNM_Mode_Sleep:                  if( boCanNM_Rx_Indication == TRUE )
                                              {
                                                  // _NM_NetworkStartIndication();   nothing to do
                                                  // _NM_PassiveStartUp();    is content of _NM_NetworkMode();
                                                  setTimer( t_NM_Transmit, NmAsrCanMsgCycleOffset );    // send NM-Frame delayed
                                                  boCanNM_Rx_Indication = FALSE;
                                                  cancelTimer( t_NM_Timeout_Time );
                                                  setTimer( t_NM_Timeout_Time, c_NM_Timeout_Time );
                                                  setTimer( t_NM_Repeat_Message_Time, c_NM_Repeat_Message_Time );
                                                  NM_Transmit_Cycle = NmAsrCanMsgStandardCycle;
                                                  _NM_NetworkMode();
                                                  NM_Mode = cNM_Mode_RepeatMsg;
                                              }
                                              if( NM_Request_State )
                                              {
                                                  setTimer( t_NM_Transmit, 1 );    //send NM-Franme immediately
                                                  NM_Transmit_Cycle = NmAsrCanMsgStandardCycle;
                                                  cancelTimer( t_NM_Timeout_Time );
                                                  setTimer( t_NM_Timeout_Time, c_NM_Timeout_Time );
                                                  setTimer( t_NM_Repeat_Message_Time, c_NM_Repeat_Message_Time );
                                                  NM_Transmit_Cycle = NmAsrCanMsgStandardCycle;
                                                  _NM_NetworkMode();
                                                  NM_Mode = cNM_Mode_RepeatMsg;
                                              }
                                              break;
        case cNM_Mode_Prepare_Bus_Sleep:      if( boCanNM_WaitBusSleep_Timer_Expired == TRUE )
                                              {
                                                  _NM_BusSleepModeInd();   // set message startup delay
                                                  NM_Mode = cNM_Mode_Sleep;
                                                  boCanNM_WaitBusSleep_Timer_Expired = FALSE;
                                              }
                                              if( boCanNM_NM_Timeout_Timer_Expired == TRUE )
                                                  boCanNM_NM_Timeout_Timer_Expired = FALSE;
                                              if( ( boCanNM_Rx_Indication == TRUE ) ||  NM_Request_State )
                                              {
                                                  boCanNM_Rx_Indication = FALSE;
                                                  if( NM_Request_State )
                                                  {
                                                      setTimer( t_NM_Transmit, 1 );    //send NM-Franme immediately
                                                  }
                                                  cancelTimer( t_NM_Timeout_Time );
                                                  setTimer( t_NM_Timeout_Time, c_NM_Timeout_Time );
                                                  setTimer( t_NM_Repeat_Message_Time, c_NM_Repeat_Message_Time );
                                                  _NM_NetworkMode();
                                                  NM_Transmit_Cycle = NmAsrCanMsgStandardCycle;
                                                  NM_Mode = cNM_Mode_RepeatMsg;
                                              }
                                              break;
        case cNM_Mode_Ready_Sleep:            if( boCanNM_Rx_Indication == TRUE )
                                              {
                                                  cancelTimer( t_NM_Timeout_Time );
                                                  setTimer( t_NM_Timeout_Time, c_NM_Timeout_Time );
                                                  boCanNM_Rx_Indication = FALSE;
                                              }
                                              if( boCanNM_Tx_Confirmation == TRUE )
                                              {
                                                  cancelTimer( t_NM_Timeout_Time );
                                                  setTimer( t_NM_Timeout_Time, c_NM_Timeout_Time );
                                                  boCanNM_Tx_Confirmation = FALSE;
                                              }
                                              if( NM_Request_State )
                                              {
                                                  setTimer( t_NM_Transmit, 1 );    //send NM-Franme immediately
                                                  cancelTimer( t_NM_Timeout_Time );
                                                  setTimer( t_NM_Timeout_Time, c_NM_Timeout_Time );
                                                  NM_Transmit_Cycle = NmAsrCanMsgReducedTime;
                                                  NM_Mode = cNM_Mode_Normal_Operation_State;
                                              }
                                              if( boCanNM_RepeatMessage_Requested == TRUE )
                                              {
                                                  setTimer( t_NM_Transmit, NmAsrCanMsgCycleOffset );    // send NM-Frame delayed
                                                  cancelTimer( t_NM_Timeout_Time );
                                                  setTimer( t_NM_Timeout_Time, c_NM_Timeout_Time );
                                                  setTimer( t_NM_Repeat_Message_Time, c_NM_Repeat_Message_Time );
                                                  NM_Transmit_Cycle = NmAsrCanMsgStandardCycle;
                                                  boCanNM_RepeatMessage_Requested = FALSE;
                                                  NM_Mode = cNM_Mode_RepeatMsg;
                                              }
                                              if( boCanNM_NM_Timeout_Timer_Expired == TRUE )
                                              {
                                                  setTimer( t_NM_Wait_Bus_Sleep_Time, c_NM_Wait_Bus_Sleep_Time );
                                                  _NM_PrepareBusSleepModeInd();    // here t_DBKonTimer is stopped
                                                  NM_Mode = cNM_Mode_Prepare_Bus_Sleep;
                                                  boCanNM_NM_Timeout_Timer_Expired = FALSE;
                                              }
                                              break;
        case cNM_Mode_Normal_Operation_State: if( boCanNM_NM_Timeout_Timer_Expired == TRUE )
                                              {
                                                  setTimer( t_NM_Timeout_Time, c_NM_Timeout_Time );
                                                  // _NM_TimeoutExeption();    // no action to be done
                                                  boCanNM_NM_Timeout_Timer_Expired = FALSE;
                                              }
                                              if( boCanNM_Rx_Indication == TRUE )
                                              {
                                                  cancelTimer( t_NM_Timeout_Time );
                                                  setTimer( t_NM_Timeout_Time, c_NM_Timeout_Time );
                                                  cancelTimer( t_NM_Transmit );
                                                  setTimer( t_NM_Transmit, NmAsrCanMsgReducedTime );
                                                  boCanNM_Rx_Indication = FALSE;
                                              }
                                              if( boCanNM_Tx_Confirmation == TRUE )
                                              {
                                                  cancelTimer( t_NM_Timeout_Time );
                                                  setTimer( t_NM_Timeout_Time, c_NM_Timeout_Time );
                                                  cancelTimer( t_NM_Transmit );
                                                  setTimer( t_NM_Transmit, NmAsrCanMsgStandardCycle );
                                                  boCanNM_Tx_Confirmation = FALSE;
                                              }
                                              if( NM_Request_State == 0 )    //no network requested
                                              {
                                                  cancelTimer( t_NM_Transmit );    // stop NM-Franme immediately
                                                  NM_Mode = cNM_Mode_Ready_Sleep;
                                              }
                                              if( boCanNM_RepeatMessage_Requested == TRUE )
                                              {
                                                  setTimer( t_NM_Transmit, NmAsrCanMsgCycleOffset );    // send NM-Frame delayed
                                                  cancelTimer( t_NM_Timeout_Time );
                                                  setTimer( t_NM_Timeout_Time, c_NM_Timeout_Time );
                                                  setTimer( t_NM_Repeat_Message_Time, c_NM_Repeat_Message_Time );
                                                  boCanNM_RepeatMessage_Requested = FALSE;
                                                  NM_Transmit_Cycle = NmAsrCanMsgStandardCycle;
                                                  NM_Mode = cNM_Mode_RepeatMsg;
                                              }
                                              break;
        case cNM_Mode_RepeatMsg:              if( boCanNM_NM_Timeout_Timer_Expired == TRUE )
                                              {
                                                  setTimer( t_NM_Timeout_Time, c_NM_Timeout_Time );
                                                  boCanNM_NM_Timeout_Timer_Expired = FALSE;
                                              }
                                              if( boCanNM_Rx_Indication == TRUE )
                                              {
                                                  cancelTimer( t_NM_Timeout_Time );
                                                  setTimer( t_NM_Timeout_Time, c_NM_Timeout_Time );
                                                  boCanNM_Rx_Indication = FALSE;
                                              }
                                              if( boCanNM_Tx_Confirmation == TRUE )
                                              {
                                                  cancelTimer( t_NM_Timeout_Time );
                                                  setTimer( t_NM_Timeout_Time, c_NM_Timeout_Time );
                                                  boCanNM_Tx_Confirmation = FALSE;
                                              }
                                              if( boCanNM_RepeatMessage_Timer_Expired == TRUE )
                                              {
                                                  boCanNM_RepeatMessage_Timer_Expired = FALSE;
                                                  if( NM_Request_State )
                                                  {
                                                      NM_Mode = cNM_Mode_Normal_Operation_State;
                                                      NM_Transmit_Cycle = NmAsrCanMsgReducedTime;
                                                  }
                                                  else
                                                  {
                                                      cancelTimer( t_NM_Transmit );    // stop NM-Franme immediately
                                                      NM_Mode = cNM_Mode_Ready_Sleep;
                                                  }
                                              }
                                              break;
    }
    if( bOld_NM_Mode != NM_Mode )
    {
        _Nm_StateChangeNotification( bOld_NM_Mode, NM_Mode );    // does the Trace
        putValue( HU__NM_CTRL_C_ActualState, NM_Mode );
    }
}
/*@@end*/

/*@@caplFunc:_NM_Init():*/
_NM_Init()
{
    NM_Transmit_Cycle = NmAsrCanMsgStandardCycle;
}
/*@@end*/

/*@@caplFunc:_NM_NetworkMode():*/
_NM_NetworkMode()
{
    setTimer( t_DBKomTimer, 1 ); //  ms     start CAN-communication immediately
    putValue( HU__NM_CTRL_C_CommActive, 1 );
}
/*@@end*/

/*@@caplFunc:_Nm_BusSleepModeInd():*/
_Nm_BusSleepModeInd()
{
//    _Trace( "_Nm_BusSleepModeInd", "Sleep Mode active");
}
/*@@end*/

/*@@caplFunc:_Nm_PrepareBusSleepModeInd():*/
void _Nm_PrepareBusSleepModeInd()
{
//    _Trace( "Nm_PrepareBusSleepModeInd", "Prepare Sleep Mode active");
    putValue( HU__NM_CTRL_C_CommActive, 0 );
    cancelTimer( t_DBKomTimer );
}
/*@@end*/

/*@@caplFunc:_Nm_StateChangeNotification(byte,byte):*/
_Nm_StateChangeNotification( byte previousState, byte currentState )
{
/*
    char line[50];

    snprintf( line, elcount(line ), "Transition from %d to %d", previousState, currentState );
    _Trace( "Nm_StateChangeNotification", "", line );
*/
}
/*@@end*/

/*@@caplFunc:_ReleaseCommRequest(word):*/
_ReleaseCommRequest( word RequestID )
{
    word temp; // actual NM request status

    temp = getValue( HU__NM_CTRL_C_NM_Request );
    temp &= ~RequestID; // reset NM request 
    putValue( HU__NM_CTRL_C_NM_Request, temp );
    _NM_Switch_NM_Mode();
}
/*@@end*/

/*@@caplFunc:_SetCommRequest(word):*/
_SetCommRequest( word RequestID )
{
    word temp; // actual NM request status

    temp = getValue( HU__NM_CTRL_C_NM_Request );
    temp |= RequestID; // set NM request 
    putValue( HU__NM_CTRL_C_NM_Request, temp );
    _NM_Switch_NM_Mode();
}
/*@@end*/

/*@@caplFunc:_TraceCall(char[],long):*/
void _TraceCall( char functionName[], long callResult )
{
    char line[100];

    if( callResult == 1 )
        snprintf( line, elcount(line ), "calling %s", functionName );
    else
        snprintf( line, elcount(line ), "call to %s failed - wrong state?", functionName );
    _Trace( "", "", line );
}
/*@@end*/

/*@@caplFunc:_Trace(char[],char[]):*/
void _Trace( char functionName[], char info[])
{
    _Trace( functionName, info, "");
}
/*@@end*/

/*@@caplFunc:_Trace(char[],char[],char[],long):*/
void _Trace( char functionName[], char info[], char verbose[], long argument )
{
    char line[100];

    snprintf( line, elcount(line ), verbose, argument );
    _Trace( functionName, info, line );
}
/*@@end*/

/*@@caplFunc:_Trace(char[],char[],char[]):*/
void _Trace( char functionName[], char info[], char verbose[])
{
  char sep[2] = "/";
  sep[0] = functionName[0] ? '/' : 0;
  if( verbose[0])
  {
    write( "[%.3f]%s%s%s: %s", timeNow()/100000.0, gECU
           , sep
           , functionName
           , verbose
           );
  } else
  {
    write( "[%.3f]%s%s%s: %s", timeNow()/100000.0, gECU
           , sep
           , functionName
           , info
           );
  }
}
/*@@end*/

/*@@caplFunc:Ctrl_C_Stat1_AR_check_output():*///function
Ctrl_C_Stat1_AR_check_output()
{
      if( !getValue( HU__STMSG_Ctrl_C_Stat1_AR ) )
    {
        // Botschaft Ctrl_C_Stat1_AR --- Sendeart 5 cyclicAndSpontanWithDelay
        if( _Ctrl_C_Stat1_AR_DelayCnt > 0) _Ctrl_C_Stat1_AR_DelayCnt--; // Mindestsendeabstand
        _Ctrl_C_Stat1_AR_Cnt--;
        if( _Ctrl_C_Stat1_AR_Cnt < 1)
        {
            if( _Ctrl_C_Stat1_AR_DelayCnt < 1 )
            {
                // Nachricht wg. abgelaufenem Zyklus ausgeben (Mindestsendeabstand eingehalten)
                output( _mCtrl_C_Stat1_AR );
                 _Ctrl_C_Stat1_AR_SpontanFlag = 0; // Spontan-Flag zurücksetzen
                _Ctrl_C_Stat1_AR_DelayCnt = _Ctrl_C_Stat1_AR_MinDelay;
            }
            else
            {
                // Spontanflag setzen damit nach Ablauf Mindestsendeabstand gesendet wird
                 _Ctrl_C_Stat1_AR_SpontanFlag = 1;
            }
            _Ctrl_C_Stat1_AR_Cnt = _Ctrl_C_Stat1_AR_CycleCount; // Zyklus-Zähler zurücksetzen
        }
        else if( _Ctrl_C_Stat1_AR_SpontanFlag )
        {
            if( _Ctrl_C_Stat1_AR_DelayCnt < 1 )
            {
                // Nachricht wg. spontaner Änderung ausgeben (Mindestsendeabstand eingehalten)
                output( _mCtrl_C_Stat1_AR );
                _Ctrl_C_Stat1_AR_SpontanFlag = 0; // Spontan-Flag zurücksetzen
                _Ctrl_C_Stat1_AR_DelayCnt = _Ctrl_C_Stat1_AR_MinDelay;
            }
        }
    }
}
/*@@end*/

/*@@caplFunc:Ctrl_C_Stat1_AR_init():*///function
Ctrl_C_Stat1_AR_init()
{    // Botschaft Ctrl_C_Stat1_AR ---- Sendeart 5 cyclicAndSpontanWithDelay
    _Ctrl_C_Stat1_AR_Cnt = 50;
    _Ctrl_C_Stat1_AR_SpontanFlag = 0;
    _Ctrl_C_Stat1_AR_DelayCnt = 1;
    _mCtrl_C_Stat1_AR.ADC_Sw_Psd_V3.phys  = getValue( HU_ADC_Sw_Psd_V3 );
    _mCtrl_C_Stat1_AR.BeltHdOvrSw_Psd_CTRL_C.phys  = getValue( HU_BeltHdOvrSw_Psd_CTRL_C );
    _mCtrl_C_Stat1_AR.CarKey_Psd_UB.phys  = getValue( HU_CarKey_Psd_UB );
    _mCtrl_C_Stat1_AR.CarKey_Psd.phys  = getValue( HU_CarKey_Psd );
    _mCtrl_C_Stat1_AR.CTRL_C_C_Psd.phys  = getValue( HU_CTRL_C_C_Psd );
    _mCtrl_C_Stat1_AR.CTRL_C_E_Psd.phys  = getValue( HU_CTRL_C_E_Psd );
    _mCtrl_C_Stat1_AR.CTRL_C_N_Psd.phys  = getValue( HU_CTRL_C_N_Psd );
    _mCtrl_C_Stat1_AR.CTRL_C_NE_Psd.phys  = getValue( HU_CTRL_C_NE_Psd );
    _mCtrl_C_Stat1_AR.CTRL_C_NW_Psd.phys  = getValue( HU_CTRL_C_NW_Psd );
    _mCtrl_C_Stat1_AR.CTRL_C_S_Psd.phys  = getValue( HU_CTRL_C_S_Psd );
    _mCtrl_C_Stat1_AR.CTRL_C_SE_Psd.phys  = getValue( HU_CTRL_C_SE_Psd );
    _mCtrl_C_Stat1_AR.CTRL_C_SW_Psd.phys  = getValue( HU_CTRL_C_SW_Psd );
    _mCtrl_C_Stat1_AR.CTRL_C_W_Psd.phys  = getValue( HU_CTRL_C_W_Psd );
    _mCtrl_C_Stat1_AR.DrvProgSelect_Sw_Psd.phys  = getValue( HU_DrvProgSelect_Sw_Psd );
    _mCtrl_C_Stat1_AR.DSR_Sw_Psd.phys  = getValue( HU_DSR_Sw_Psd );
    _mCtrl_C_Stat1_AR.ECO_Sw_Psd.phys  = getValue( HU_ECO_Sw_Psd );
    _mCtrl_C_Stat1_AR.ESP_Sw_Psd.phys  = getValue( HU_ESP_Sw_Psd );
    _mCtrl_C_Stat1_AR.HdRst_R_Sw_Psd_CTRL_C.phys  = getValue( HU_HdRst_R_Sw_Psd_CTRL_C );
    _mCtrl_C_Stat1_AR.HU_EjectSw_Psd_CTRL_C.phys  = getValue( HU_HU_EjectSw_Psd_CTRL_C );
    _mCtrl_C_Stat1_AR.MediaKey_Psd_UB.phys  = getValue( HU_MediaKey_Psd_UB );
    _mCtrl_C_Stat1_AR.MediaKey_Psd.phys  = getValue( HU_MediaKey_Psd );
    _mCtrl_C_Stat1_AR.MenuKey_Psd_UB.phys  = getValue( HU_MenuKey_Psd_UB );
    _mCtrl_C_Stat1_AR.MenuKey_Psd.phys  = getValue( HU_MenuKey_Psd );
    _mCtrl_C_Stat1_AR.MuteKey_Psd_UB.phys  = getValue( HU_MuteKey_Psd_UB );
    _mCtrl_C_Stat1_AR.MuteKey_Psd.phys  = getValue( HU_MuteKey_Psd );
    _mCtrl_C_Stat1_AR.NaviKey_Psd_UB.phys  = getValue( HU_NaviKey_Psd_UB );
    _mCtrl_C_Stat1_AR.NaviKey_Psd.phys  = getValue( HU_NaviKey_Psd );
    _mCtrl_C_Stat1_AR.OffroadScreenSw_Psd.phys  = getValue( HU_OffroadScreenSw_Psd );
    _mCtrl_C_Stat1_AR.OnKey_Psd_UB.phys  = getValue( HU_OnKey_Psd_UB );
    _mCtrl_C_Stat1_AR.OnKey_Psd.phys  = getValue( HU_OnKey_Psd );
    _mCtrl_C_Stat1_AR.ParkSw_Psd_CTRL_C.phys  = getValue( HU_ParkSw_Psd_CTRL_C );
    _mCtrl_C_Stat1_AR.PhoneKey_Psd_UB.phys  = getValue( HU_PhoneKey_Psd_UB );
    _mCtrl_C_Stat1_AR.PhoneKey_Psd.phys  = getValue( HU_PhoneKey_Psd );
    _mCtrl_C_Stat1_AR.PlugInHyb_OprtnMdSw_Psd.phys  = getValue( HU_PlugInHyb_OprtnMdSw_Psd );
    _mCtrl_C_Stat1_AR.RadioKey_Psd_UB.phys  = getValue( HU_RadioKey_Psd_UB );
    _mCtrl_C_Stat1_AR.RadioKey_Psd.phys  = getValue( HU_RadioKey_Psd );
    _mCtrl_C_Stat1_AR.RB_R_Sw_Psd_CTRL_C.phys  = getValue( HU_RB_R_Sw_Psd_CTRL_C );
    _mCtrl_C_Stat1_AR.ReturnKey_Psd_UB.phys  = getValue( HU_ReturnKey_Psd_UB );
    _mCtrl_C_Stat1_AR.ReturnKey_Psd.phys  = getValue( HU_ReturnKey_Psd );
    _mCtrl_C_Stat1_AR.SeatKey_Psd_UB.phys  = getValue( HU_SeatKey_Psd_UB );
    _mCtrl_C_Stat1_AR.SeatKey_Psd.phys  = getValue( HU_SeatKey_Psd );
    _mCtrl_C_Stat1_AR.SuspLvlAdjSw_Psd.phys  = getValue( HU_SuspLvlAdjSw_Psd );
    _mCtrl_C_Stat1_AR.VehDrvProg_M_Sw_Psd.phys  = getValue( HU_VehDrvProg_M_Sw_Psd );
    _mCtrl_C_Stat1_AR.VehDrvProgSw_Psd.phys  = getValue( HU_VehDrvProgSw_Psd );
    _mCtrl_C_Stat1_AR.Vol_Rq_CTRL_C_V1.phys  = getValue( HU_Vol_Rq_CTRL_C_V1 );
}
/*@@end*/

/*@@timer:_tCtrl_C_Stat1_AR:*/
on timer _tCtrl_C_Stat1_AR
{
    putValue( HU__STMSG_Ctrl_C_Stat1_AR, 0 );
}
/*@@end*/

/*@@envVar:HU__STMSG_Ctrl_C_Stat1_AR:*/
on EnvVar HU__STMSG_Ctrl_C_Stat1_AR
{
    long tDelay;
    if( getValue( this ) == 2 )
    {
        tDelay = getValue( HU__STMSGT_Ctrl_C_Stat1_AR );
        if( tDelay > 0)    
            setTimer( _tCtrl_C_Stat1_AR, tDelay );
        else
            putValue( HU__STMSG_Ctrl_C_Stat1_AR, 0 );
    }
}
/*@@end*/

/*@@envVar:HU_ADC_Sw_Psd_V3:*/
on EnvVar HU_ADC_Sw_Psd_V3
{
    _mCtrl_C_Stat1_AR.ADC_Sw_Psd_V3.phys = getValue(this);
    _Ctrl_C_Stat1_AR_SpontanFlag = 1;
}
/*@@end*/

/*@@envVar:HU_BeltHdOvrSw_Psd_CTRL_C:*/
on EnvVar HU_BeltHdOvrSw_Psd_CTRL_C
{
    _mCtrl_C_Stat1_AR.BeltHdOvrSw_Psd_CTRL_C.phys = getValue(this);
    _Ctrl_C_Stat1_AR_SpontanFlag = 1;
}
/*@@end*/

/*@@envVar:HU_CarKey_Psd_UB:*/
on EnvVar HU_CarKey_Psd_UB
{
    _mCtrl_C_Stat1_AR.CarKey_Psd_UB.phys = getValue(this);
    _Ctrl_C_Stat1_AR_SpontanFlag = 1;
}
/*@@end*/

/*@@envVar:HU_CarKey_Psd:*/
on EnvVar HU_CarKey_Psd
{
    _mCtrl_C_Stat1_AR.CarKey_Psd.phys = getValue(this);
    _Ctrl_C_Stat1_AR_SpontanFlag = 1;
}
/*@@end*/

/*@@envVar:HU_CTRL_C_C_Psd:*/
on EnvVar HU_CTRL_C_C_Psd
{
    _mCtrl_C_Stat1_AR.CTRL_C_C_Psd.phys = getValue(this);
    _Ctrl_C_Stat1_AR_SpontanFlag = 1;
}
/*@@end*/

/*@@envVar:HU_CTRL_C_E_Psd:*/
on EnvVar HU_CTRL_C_E_Psd
{
    _mCtrl_C_Stat1_AR.CTRL_C_E_Psd.phys = getValue(this);
    _Ctrl_C_Stat1_AR_SpontanFlag = 1;
}
/*@@end*/

/*@@envVar:HU_CTRL_C_N_Psd:*/
on EnvVar HU_CTRL_C_N_Psd
{
    _mCtrl_C_Stat1_AR.CTRL_C_N_Psd.phys = getValue(this);
    _Ctrl_C_Stat1_AR_SpontanFlag = 1;
}
/*@@end*/

/*@@envVar:HU_CTRL_C_NE_Psd:*/
on EnvVar HU_CTRL_C_NE_Psd
{
    _mCtrl_C_Stat1_AR.CTRL_C_NE_Psd.phys = getValue(this);
    _Ctrl_C_Stat1_AR_SpontanFlag = 1;
}
/*@@end*/

/*@@envVar:HU_CTRL_C_NW_Psd:*/
on EnvVar HU_CTRL_C_NW_Psd
{
    _mCtrl_C_Stat1_AR.CTRL_C_NW_Psd.phys = getValue(this);
    _Ctrl_C_Stat1_AR_SpontanFlag = 1;
}
/*@@end*/

/*@@envVar:HU_CTRL_C_S_Psd:*/
on EnvVar HU_CTRL_C_S_Psd
{
    _mCtrl_C_Stat1_AR.CTRL_C_S_Psd.phys = getValue(this);
    _Ctrl_C_Stat1_AR_SpontanFlag = 1;
}
/*@@end*/

/*@@envVar:HU_CTRL_C_SE_Psd:*/
on EnvVar HU_CTRL_C_SE_Psd
{
    _mCtrl_C_Stat1_AR.CTRL_C_SE_Psd.phys = getValue(this);
    _Ctrl_C_Stat1_AR_SpontanFlag = 1;
}
/*@@end*/

/*@@envVar:HU_CTRL_C_SW_Psd:*/
on EnvVar HU_CTRL_C_SW_Psd
{
    _mCtrl_C_Stat1_AR.CTRL_C_SW_Psd.phys = getValue(this);
    _Ctrl_C_Stat1_AR_SpontanFlag = 1;
}
/*@@end*/

/*@@envVar:HU_CTRL_C_W_Psd:*/
on EnvVar HU_CTRL_C_W_Psd
{
    _mCtrl_C_Stat1_AR.CTRL_C_W_Psd.phys = getValue(this);
    _Ctrl_C_Stat1_AR_SpontanFlag = 1;
}
/*@@end*/

/*@@envVar:HU_DrvProgSelect_Sw_Psd:*/
on EnvVar HU_DrvProgSelect_Sw_Psd
{
    _mCtrl_C_Stat1_AR.DrvProgSelect_Sw_Psd.phys = getValue(this);
    _Ctrl_C_Stat1_AR_SpontanFlag = 1;
}
/*@@end*/

/*@@envVar:HU_DSR_Sw_Psd:*/
on EnvVar HU_DSR_Sw_Psd
{
    _mCtrl_C_Stat1_AR.DSR_Sw_Psd.phys = getValue(this);
    _Ctrl_C_Stat1_AR_SpontanFlag = 1;
}
/*@@end*/

/*@@envVar:HU_ECO_Sw_Psd:*/
on EnvVar HU_ECO_Sw_Psd
{
    _mCtrl_C_Stat1_AR.ECO_Sw_Psd.phys = getValue(this);
    _Ctrl_C_Stat1_AR_SpontanFlag = 1;
}
/*@@end*/

/*@@envVar:HU_ESP_Sw_Psd:*/
on EnvVar HU_ESP_Sw_Psd
{
    _mCtrl_C_Stat1_AR.ESP_Sw_Psd.phys = getValue(this);
    _Ctrl_C_Stat1_AR_SpontanFlag = 1;
}
/*@@end*/

/*@@envVar:HU_HdRst_R_Sw_Psd_CTRL_C:*/
on EnvVar HU_HdRst_R_Sw_Psd_CTRL_C
{
    _mCtrl_C_Stat1_AR.HdRst_R_Sw_Psd_CTRL_C.phys = getValue(this);
    _Ctrl_C_Stat1_AR_SpontanFlag = 1;
}
/*@@end*/

/*@@envVar:HU_HU_EjectSw_Psd_CTRL_C:*/
on EnvVar HU_HU_EjectSw_Psd_CTRL_C
{
    _mCtrl_C_Stat1_AR.HU_EjectSw_Psd_CTRL_C.phys = getValue(this);
    _Ctrl_C_Stat1_AR_SpontanFlag = 1;
}
/*@@end*/

/*@@envVar:HU_MediaKey_Psd_UB:*/
on EnvVar HU_MediaKey_Psd_UB
{
    _mCtrl_C_Stat1_AR.MediaKey_Psd_UB.phys = getValue(this);
    _Ctrl_C_Stat1_AR_SpontanFlag = 1;
}
/*@@end*/

/*@@envVar:HU_MediaKey_Psd:*/
on EnvVar HU_MediaKey_Psd
{
    _mCtrl_C_Stat1_AR.MediaKey_Psd.phys = getValue(this);
    _Ctrl_C_Stat1_AR_SpontanFlag = 1;
}
/*@@end*/

/*@@envVar:HU_MenuKey_Psd_UB:*/
on EnvVar HU_MenuKey_Psd_UB
{
    _mCtrl_C_Stat1_AR.MenuKey_Psd_UB.phys = getValue(this);
    _Ctrl_C_Stat1_AR_SpontanFlag = 1;
}
/*@@end*/

/*@@envVar:HU_MenuKey_Psd:*/
on EnvVar HU_MenuKey_Psd
{
    _mCtrl_C_Stat1_AR.MenuKey_Psd.phys = getValue(this);
    _Ctrl_C_Stat1_AR_SpontanFlag = 1;
}
/*@@end*/

/*@@envVar:HU_MuteKey_Psd_UB:*/
on EnvVar HU_MuteKey_Psd_UB
{
    _mCtrl_C_Stat1_AR.MuteKey_Psd_UB.phys = getValue(this);
    _Ctrl_C_Stat1_AR_SpontanFlag = 1;
}
/*@@end*/

/*@@envVar:HU_MuteKey_Psd:*/
on EnvVar HU_MuteKey_Psd
{
    _mCtrl_C_Stat1_AR.MuteKey_Psd.phys = getValue(this);
    _Ctrl_C_Stat1_AR_SpontanFlag = 1;
}
/*@@end*/

/*@@envVar:HU_NaviKey_Psd_UB:*/
on EnvVar HU_NaviKey_Psd_UB
{
    _mCtrl_C_Stat1_AR.NaviKey_Psd_UB.phys = getValue(this);
    _Ctrl_C_Stat1_AR_SpontanFlag = 1;
}
/*@@end*/

/*@@envVar:HU_NaviKey_Psd:*/
on EnvVar HU_NaviKey_Psd
{
    _mCtrl_C_Stat1_AR.NaviKey_Psd.phys = getValue(this);
    _Ctrl_C_Stat1_AR_SpontanFlag = 1;
}
/*@@end*/

/*@@envVar:HU_OffroadScreenSw_Psd:*/
on EnvVar HU_OffroadScreenSw_Psd
{
    _mCtrl_C_Stat1_AR.OffroadScreenSw_Psd.phys = getValue(this);
    _Ctrl_C_Stat1_AR_SpontanFlag = 1;
}
/*@@end*/

/*@@envVar:HU_OnKey_Psd_UB:*/
on EnvVar HU_OnKey_Psd_UB
{
    _mCtrl_C_Stat1_AR.OnKey_Psd_UB.phys = getValue(this);
    _Ctrl_C_Stat1_AR_SpontanFlag = 1;
}
/*@@end*/

/*@@envVar:HU_OnKey_Psd:*/
on EnvVar HU_OnKey_Psd
{
    _mCtrl_C_Stat1_AR.OnKey_Psd.phys = getValue(this);
    _Ctrl_C_Stat1_AR_SpontanFlag = 1;
}
/*@@end*/

/*@@envVar:HU_ParkSw_Psd_CTRL_C:*/
on EnvVar HU_ParkSw_Psd_CTRL_C
{
    _mCtrl_C_Stat1_AR.ParkSw_Psd_CTRL_C.phys = getValue(this);
    _Ctrl_C_Stat1_AR_SpontanFlag = 1;
}
/*@@end*/

/*@@envVar:HU_PhoneKey_Psd_UB:*/
on EnvVar HU_PhoneKey_Psd_UB
{
    _mCtrl_C_Stat1_AR.PhoneKey_Psd_UB.phys = getValue(this);
    _Ctrl_C_Stat1_AR_SpontanFlag = 1;
}
/*@@end*/

/*@@envVar:HU_PhoneKey_Psd:*/
on EnvVar HU_PhoneKey_Psd
{
    _mCtrl_C_Stat1_AR.PhoneKey_Psd.phys = getValue(this);
    _Ctrl_C_Stat1_AR_SpontanFlag = 1;
}
/*@@end*/

/*@@envVar:HU_PlugInHyb_OprtnMdSw_Psd:*/
on EnvVar HU_PlugInHyb_OprtnMdSw_Psd
{
    _mCtrl_C_Stat1_AR.PlugInHyb_OprtnMdSw_Psd.phys = getValue(this);
    _Ctrl_C_Stat1_AR_SpontanFlag = 1;
}
/*@@end*/

/*@@envVar:HU_RadioKey_Psd_UB:*/
on EnvVar HU_RadioKey_Psd_UB
{
    _mCtrl_C_Stat1_AR.RadioKey_Psd_UB.phys = getValue(this);
    _Ctrl_C_Stat1_AR_SpontanFlag = 1;
}
/*@@end*/

/*@@envVar:HU_RadioKey_Psd:*/
on EnvVar HU_RadioKey_Psd
{
    _mCtrl_C_Stat1_AR.RadioKey_Psd.phys = getValue(this);
    _Ctrl_C_Stat1_AR_SpontanFlag = 1;
}
/*@@end*/

/*@@envVar:HU_RB_R_Sw_Psd_CTRL_C:*/
on EnvVar HU_RB_R_Sw_Psd_CTRL_C
{
    _mCtrl_C_Stat1_AR.RB_R_Sw_Psd_CTRL_C.phys = getValue(this);
    _Ctrl_C_Stat1_AR_SpontanFlag = 1;
}
/*@@end*/

/*@@envVar:HU_ReturnKey_Psd_UB:*/
on EnvVar HU_ReturnKey_Psd_UB
{
    _mCtrl_C_Stat1_AR.ReturnKey_Psd_UB.phys = getValue(this);
    _Ctrl_C_Stat1_AR_SpontanFlag = 1;
}
/*@@end*/

/*@@envVar:HU_ReturnKey_Psd:*/
on EnvVar HU_ReturnKey_Psd
{
    _mCtrl_C_Stat1_AR.ReturnKey_Psd.phys = getValue(this);
    _Ctrl_C_Stat1_AR_SpontanFlag = 1;
}
/*@@end*/

/*@@envVar:HU_SeatKey_Psd_UB:*/
on EnvVar HU_SeatKey_Psd_UB
{
    _mCtrl_C_Stat1_AR.SeatKey_Psd_UB.phys = getValue(this);
    _Ctrl_C_Stat1_AR_SpontanFlag = 1;
}
/*@@end*/

/*@@envVar:HU_SeatKey_Psd:*/
on EnvVar HU_SeatKey_Psd
{
    _mCtrl_C_Stat1_AR.SeatKey_Psd.phys = getValue(this);
    _Ctrl_C_Stat1_AR_SpontanFlag = 1;
}
/*@@end*/

/*@@envVar:HU_SuspLvlAdjSw_Psd:*/
on EnvVar HU_SuspLvlAdjSw_Psd
{
    _mCtrl_C_Stat1_AR.SuspLvlAdjSw_Psd.phys = getValue(this);
    _Ctrl_C_Stat1_AR_SpontanFlag = 1;
}
/*@@end*/

/*@@envVar:HU_VehDrvProg_M_Sw_Psd:*/
on EnvVar HU_VehDrvProg_M_Sw_Psd
{
    _mCtrl_C_Stat1_AR.VehDrvProg_M_Sw_Psd.phys = getValue(this);
    _Ctrl_C_Stat1_AR_SpontanFlag = 1;
}
/*@@end*/

/*@@envVar:HU_VehDrvProgSw_Psd:*/
on EnvVar HU_VehDrvProgSw_Psd
{
    _mCtrl_C_Stat1_AR.VehDrvProgSw_Psd.phys = getValue(this);
    _Ctrl_C_Stat1_AR_SpontanFlag = 1;
}
/*@@end*/

/*@@envVar:HU_Vol_Rq_CTRL_C_V1:*/
on EnvVar HU_Vol_Rq_CTRL_C_V1
{
    _mCtrl_C_Stat1_AR.Vol_Rq_CTRL_C_V1.phys = getValue(this);
    _Ctrl_C_Stat1_AR_SpontanFlag = 1;
}
/*@@end*/

/*@@caplFunc:Ctrl_C_Stat2_AR_check_output():*///function
Ctrl_C_Stat2_AR_check_output()
{
      if( !getValue( HU__STMSG_Ctrl_C_Stat2_AR ))
    {
        // Botschaft Ctrl_C_Stat2_AR --- Sendeart 2 cyclicIfActive --- Beginn DBKOM-Bewertung
        if( getValue( HU__STMSP_Ctrl_C_Stat2_AR ) )
            _Ctrl_C_Stat2_AR_Cnt--;
        if( _Ctrl_C_Stat2_AR_Cnt < 1)
        {
            // Zyklus abgelaufen, Nachricht senden
            output( _mCtrl_C_Stat2_AR );
            if( ( _mCtrl_C_Stat2_AR.byte(0) + 
                  _mCtrl_C_Stat2_AR.byte(1) +
                  _mCtrl_C_Stat2_AR.byte(2) +
                  _mCtrl_C_Stat2_AR.byte(3) +
                  _mCtrl_C_Stat2_AR.byte(4) +
                  _mCtrl_C_Stat2_AR.byte(5)   ) == 0 )
                putValue( HU__STMSP_Ctrl_C_Stat2_AR, 0 );  
            _Ctrl_C_Stat2_AR_Cnt = _Ctrl_C_Stat2_AR_CycleCount;
        }
    }
}
/*@@end*/

/*@@caplFunc:Ctrl_C_Stat2_AR_init():*///function
Ctrl_C_Stat2_AR_init()
{    // Botschaft Ctrl_C_Stat2_AR ---- Sendeart 0 cyclic
    _Ctrl_C_Stat2_AR_Cnt = 2;
    /* sofort */ _mCtrl_C_Stat2_AR.NumPadKey0_Psd.phys     = getValue( HU_NumPadKey0_Psd );
    /* sofort */ _mCtrl_C_Stat2_AR.NumPadKey1_Psd.phys     = getValue( HU_NumPadKey1_Psd );
    /* sofort */ _mCtrl_C_Stat2_AR.NumPadKey2_Psd.phys     = getValue( HU_NumPadKey2_Psd );
    /* sofort */ _mCtrl_C_Stat2_AR.NumPadKey3_Psd.phys     = getValue( HU_NumPadKey3_Psd );
    /* sofort */ _mCtrl_C_Stat2_AR.NumPadKey4_Psd.phys     = getValue( HU_NumPadKey4_Psd );
    /* sofort */ _mCtrl_C_Stat2_AR.NumPadKey5_Psd.phys     = getValue( HU_NumPadKey5_Psd );
    /* sofort */ _mCtrl_C_Stat2_AR.NumPadKey6_Psd.phys     = getValue( HU_NumPadKey6_Psd );
    /* sofort */ _mCtrl_C_Stat2_AR.NumPadKey7_Psd.phys     = getValue( HU_NumPadKey7_Psd );
    /* sofort */ _mCtrl_C_Stat2_AR.NumPadKey8_Psd.phys     = getValue( HU_NumPadKey8_Psd );
    /* sofort */ _mCtrl_C_Stat2_AR.NumPadKey9_Psd.phys     = getValue( HU_NumPadKey9_Psd );
    /* sofort */ _mCtrl_C_Stat2_AR.NumPadKeyClr_Psd.phys     = getValue( HU_NumPadKeyClr_Psd );
    /* sofort */ _mCtrl_C_Stat2_AR.NumPadKeyEnd_Psd.phys     = getValue( HU_NumPadKeyEnd_Psd );
    /* sofort */ _mCtrl_C_Stat2_AR.NumPadKeyFav_Psd.phys     = getValue( HU_NumPadKeyFav_Psd );
    /* sofort */ _mCtrl_C_Stat2_AR.NumPadKeyPound_Psd.phys     = getValue( HU_NumPadKeyPound_Psd );
    /* sofort */ _mCtrl_C_Stat2_AR.NumPadKeySend_Psd.phys     = getValue( HU_NumPadKeySend_Psd );
    /* sofort */ _mCtrl_C_Stat2_AR.NumPadKeyStar_Psd.phys     = getValue( HU_NumPadKeyStar_Psd );
    /* sofort */ _mCtrl_C_Stat2_AR.TPAD_KeyBkGrndAudio_Psd.phys     = getValue( HU_TPAD_KeyBkGrndAudio_Psd );
    /* sofort */ _mCtrl_C_Stat2_AR.TPAD_KeyMenu_Psd.phys     = getValue( HU_TPAD_KeyMenu_Psd );
    /* sofort */ _mCtrl_C_Stat2_AR.TPAD_KeyReturn_Psd.phys     = getValue( HU_TPAD_KeyReturn_Psd );
    /* sofort */ _mCtrl_C_Stat2_AR.TPAD_SensArea_Psd.phys     = getValue( HU_TPAD_SensArea_Psd );
}
/*@@end*/

/*@@timer:_tCtrl_C_Stat2_AR:*/
on timer _tCtrl_C_Stat2_AR
{
    putValue( HU__STMSG_Ctrl_C_Stat2_AR, 0 );
}
/*@@end*/

/*@@envVar:HU__STMSG_Ctrl_C_Stat2_AR:*/
on EnvVar HU__STMSG_Ctrl_C_Stat2_AR
{
    long tDelay;
    if( getValue( this ) == 2 )
    {
        tDelay = getValue( HU__STMSGT_Ctrl_C_Stat2_AR );
        if( tDelay > 0)    
            setTimer( _tCtrl_C_Stat2_AR, tDelay );
        else
            putValue( HU__STMSG_Ctrl_C_Stat2_AR, 0 );
    }
}
/*@@end*/

/*@@envVar:HU_NumPadKey0_Psd:*/
on EnvVar HU_NumPadKey0_Psd
{
    _mCtrl_C_Stat2_AR.NumPadKey0_Psd.phys = getValue(this);
    if( getValue(this) > 0 )
        putValue( HU__STMSP_Ctrl_C_Stat2_AR, 1 );
}
/*@@end*/

/*@@envVar:HU_NumPadKey1_Psd:*/
on EnvVar HU_NumPadKey1_Psd
{
    _mCtrl_C_Stat2_AR.NumPadKey1_Psd.phys = getValue(this);
    if( getValue(this) > 0 )
        putValue( HU__STMSP_Ctrl_C_Stat2_AR, 1 );
}
/*@@end*/

/*@@envVar:HU_NumPadKey2_Psd:*/
on EnvVar HU_NumPadKey2_Psd
{
    _mCtrl_C_Stat2_AR.NumPadKey2_Psd.phys = getValue(this);
    if( getValue(this) > 0 )
        putValue( HU__STMSP_Ctrl_C_Stat2_AR, 1 );
}
/*@@end*/

/*@@envVar:HU_NumPadKey3_Psd:*/
on EnvVar HU_NumPadKey3_Psd
{
    _mCtrl_C_Stat2_AR.NumPadKey3_Psd.phys = getValue(this);
    if( getValue(this) > 0 )
        putValue( HU__STMSP_Ctrl_C_Stat2_AR, 1 );
}
/*@@end*/

/*@@envVar:HU_NumPadKey4_Psd:*/
on EnvVar HU_NumPadKey4_Psd
{
    _mCtrl_C_Stat2_AR.NumPadKey4_Psd.phys = getValue(this);
    if( getValue(this) > 0 )
        putValue( HU__STMSP_Ctrl_C_Stat2_AR, 1 );
}
/*@@end*/

/*@@envVar:HU_NumPadKey5_Psd:*/
on EnvVar HU_NumPadKey5_Psd
{
    _mCtrl_C_Stat2_AR.NumPadKey5_Psd.phys = getValue(this);
    if( getValue(this) > 0 )
        putValue( HU__STMSP_Ctrl_C_Stat2_AR, 1 );
}
/*@@end*/

/*@@envVar:HU_NumPadKey6_Psd:*/
on EnvVar HU_NumPadKey6_Psd
{
    _mCtrl_C_Stat2_AR.NumPadKey6_Psd.phys = getValue(this);
    if( getValue(this) > 0 )
        putValue( HU__STMSP_Ctrl_C_Stat2_AR, 1 );
}
/*@@end*/

/*@@envVar:HU_NumPadKey7_Psd:*/
on EnvVar HU_NumPadKey7_Psd
{
    _mCtrl_C_Stat2_AR.NumPadKey7_Psd.phys = getValue(this);
    if( getValue(this) > 0 )
        putValue( HU__STMSP_Ctrl_C_Stat2_AR, 1 );
}
/*@@end*/

/*@@envVar:HU_NumPadKey8_Psd:*/
on EnvVar HU_NumPadKey8_Psd
{
    _mCtrl_C_Stat2_AR.NumPadKey8_Psd.phys = getValue(this);
    if( getValue(this) > 0 )
        putValue( HU__STMSP_Ctrl_C_Stat2_AR, 1 );
}
/*@@end*/

/*@@envVar:HU_NumPadKey9_Psd:*/
on EnvVar HU_NumPadKey9_Psd
{
    _mCtrl_C_Stat2_AR.NumPadKey9_Psd.phys = getValue(this);
    if( getValue(this) > 0 )
        putValue( HU__STMSP_Ctrl_C_Stat2_AR, 1 );
}
/*@@end*/

/*@@envVar:HU_NumPadKeyClr_Psd:*/
on EnvVar HU_NumPadKeyClr_Psd
{
    _mCtrl_C_Stat2_AR.NumPadKeyClr_Psd.phys = getValue(this);
    if( getValue(this) > 0 )
        putValue( HU__STMSP_Ctrl_C_Stat2_AR, 1 );
}
/*@@end*/

/*@@envVar:HU_NumPadKeyEnd_Psd:*/
on EnvVar HU_NumPadKeyEnd_Psd
{
    _mCtrl_C_Stat2_AR.NumPadKeyEnd_Psd.phys = getValue(this);
    if( getValue(this) > 0 )
        putValue( HU__STMSP_Ctrl_C_Stat2_AR, 1 );
}
/*@@end*/

/*@@envVar:HU_NumPadKeyFav_Psd:*/
on EnvVar HU_NumPadKeyFav_Psd
{
    _mCtrl_C_Stat2_AR.NumPadKeyFav_Psd.phys = getValue(this);
    if( getValue(this) > 0 )
        putValue( HU__STMSP_Ctrl_C_Stat2_AR, 1 );
}
/*@@end*/

/*@@envVar:HU_NumPadKeyPound_Psd:*/
on EnvVar HU_NumPadKeyPound_Psd
{
    _mCtrl_C_Stat2_AR.NumPadKeyPound_Psd.phys = getValue(this);
    if( getValue(this) > 0 )
        putValue( HU__STMSP_Ctrl_C_Stat2_AR, 1 );
}
/*@@end*/

/*@@envVar:HU_NumPadKeySend_Psd:*/
on EnvVar HU_NumPadKeySend_Psd
{
    _mCtrl_C_Stat2_AR.NumPadKeySend_Psd.phys = getValue(this);
    if( getValue(this) > 0 )
        putValue( HU__STMSP_Ctrl_C_Stat2_AR, 1 );
}
/*@@end*/

/*@@envVar:HU_NumPadKeyStar_Psd:*/
on EnvVar HU_NumPadKeyStar_Psd
{
    _mCtrl_C_Stat2_AR.NumPadKeyStar_Psd.phys = getValue(this);
    if( getValue(this) > 0 )
        putValue( HU__STMSP_Ctrl_C_Stat2_AR, 1 );
}
/*@@end*/

/*@@envVar:HU_TPAD_KeyBkGrndAudio_Psd:*/
on EnvVar HU_TPAD_KeyBkGrndAudio_Psd
{
    _mCtrl_C_Stat2_AR.TPAD_KeyBkGrndAudio_Psd.phys = getValue(this);
    if( getValue(this) > 0 )
        putValue( HU__STMSP_Ctrl_C_Stat2_AR, 1 );
}
/*@@end*/

/*@@envVar:HU_TPAD_KeyMenu_Psd:*/
on EnvVar HU_TPAD_KeyMenu_Psd
{
    _mCtrl_C_Stat2_AR.TPAD_KeyMenu_Psd.phys = getValue(this);
    if( getValue(this) > 0 )
        putValue( HU__STMSP_Ctrl_C_Stat2_AR, 1 );
}
/*@@end*/

/*@@envVar:HU_TPAD_KeyReturn_Psd:*/
on EnvVar HU_TPAD_KeyReturn_Psd
{
    _mCtrl_C_Stat2_AR.TPAD_KeyReturn_Psd.phys = getValue(this);
    if( getValue(this) > 0 )
        putValue( HU__STMSP_Ctrl_C_Stat2_AR, 1 );
}
/*@@end*/

/*@@envVar:HU_TPAD_SensArea_Psd:*/
on EnvVar HU_TPAD_SensArea_Psd
{
    _mCtrl_C_Stat2_AR.TPAD_SensArea_Psd.phys = getValue(this);
    if( getValue(this) > 0 )
        putValue( HU__STMSP_Ctrl_C_Stat2_AR, 1 );
}
/*@@end*/

/*@@caplFunc:Ctrl_C_Stat3_AR_check_output():*///function
Ctrl_C_Stat3_AR_check_output()
{
      if( !getValue( HU__STMSG_Ctrl_C_Stat3_AR ) )
    {
        // Botschaft Ctrl_C_Stat3_AR --- Sendeart 5 cyclicAndSpontanWithDelay
        if( _Ctrl_C_Stat3_AR_DelayCnt > 0) _Ctrl_C_Stat3_AR_DelayCnt--; // Mindestsendeabstand
        _Ctrl_C_Stat3_AR_Cnt--;
        if( _Ctrl_C_Stat3_AR_Cnt < 1)
        {
            if( _Ctrl_C_Stat3_AR_DelayCnt < 1 )
            {
                // Nachricht wg. abgelaufenem Zyklus ausgeben (Mindestsendeabstand eingehalten)
                output( _mCtrl_C_Stat3_AR );
                 _Ctrl_C_Stat3_AR_SpontanFlag = 0; // Spontan-Flag zurücksetzen
                _Ctrl_C_Stat3_AR_DelayCnt = _Ctrl_C_Stat3_AR_MinDelay;
            }
            else
            {
                // Spontanflag setzen damit nach Ablauf Mindestsendeabstand gesendet wird
                 _Ctrl_C_Stat3_AR_SpontanFlag = 1;
            }
            _Ctrl_C_Stat3_AR_Cnt = _Ctrl_C_Stat3_AR_CycleCount; // Zyklus-Zähler zurücksetzen
        }
        else if( _Ctrl_C_Stat3_AR_SpontanFlag )
        {
            if( _Ctrl_C_Stat3_AR_DelayCnt < 1 )
            {
                // Nachricht wg. spontaner Änderung ausgeben (Mindestsendeabstand eingehalten)
                output( _mCtrl_C_Stat3_AR );
                _Ctrl_C_Stat3_AR_SpontanFlag = 0; // Spontan-Flag zurücksetzen
                _Ctrl_C_Stat3_AR_DelayCnt = _Ctrl_C_Stat3_AR_MinDelay;
            }
        }
    }
}
/*@@end*/

/*@@caplFunc:Ctrl_C_Stat3_AR_init():*///function
Ctrl_C_Stat3_AR_init()
{    // Botschaft Ctrl_C_Stat3_AR ---- Sendeart 5 cyclicAndSpontanWithDelay
    _Ctrl_C_Stat3_AR_Cnt = 5;
    _Ctrl_C_Stat3_AR_SpontanFlag = 0;
    _Ctrl_C_Stat3_AR_DelayCnt = 4;
    _mCtrl_C_Stat3_AR.Fav1_Sw_Psd.phys = getValue( HU_Fav1_Sw_Psd );
    _mCtrl_C_Stat3_AR.Fav2_Sw_Psd.phys = getValue( HU_Fav2_Sw_Psd );
    _mCtrl_C_Stat3_AR.KeyBkGrndAudio_Psd.phys = getValue( HU_KeyBkGrndAudio_Psd );
    _mCtrl_C_Stat3_AR.MenuFav_Sw_Psd.phys = getValue( HU_MenuFav_Sw_Psd );
}
/*@@end*/

/*@@timer:_tCtrl_C_Stat3_AR:*/
on timer _tCtrl_C_Stat3_AR
{
    putValue( HU__STMSG_Ctrl_C_Stat3_AR, 0 );
}
/*@@end*/

/*@@envVar:HU__STMSG_Ctrl_C_Stat3_AR:*/
on EnvVar HU__STMSG_Ctrl_C_Stat3_AR
{
    long tDelay;
    if( getValue( this ) == 2 )
    {
        tDelay = getValue( HU__STMSGT_Ctrl_C_Stat3_AR );
        if( tDelay > 0)    
            setTimer( _tCtrl_C_Stat3_AR, tDelay );
        else
            putValue( HU__STMSG_Ctrl_C_Stat3_AR, 0 );
    }
}
/*@@end*/

/*@@envVar:HU_Fav1_Sw_Psd:*/
on EnvVar HU_Fav1_Sw_Psd
{
    _mCtrl_C_Stat3_AR.Fav1_Sw_Psd.phys = getValue(this);
    _Ctrl_C_Stat3_AR_SpontanFlag = 1;
}
/*@@end*/

/*@@envVar:HU_Fav2_Sw_Psd:*/
on EnvVar HU_Fav2_Sw_Psd
{
    _mCtrl_C_Stat3_AR.Fav2_Sw_Psd.phys = getValue(this);
    _Ctrl_C_Stat3_AR_SpontanFlag = 1;
}
/*@@end*/

/*@@envVar:HU_KeyBkGrndAudio_Psd:*/
on EnvVar HU_KeyBkGrndAudio_Psd
{
    _mCtrl_C_Stat3_AR.KeyBkGrndAudio_Psd.phys = getValue(this);
    _Ctrl_C_Stat3_AR_SpontanFlag = 1;
}
/*@@end*/

/*@@envVar:HU_MenuFav_Sw_Psd:*/
on EnvVar HU_MenuFav_Sw_Psd
{
    _mCtrl_C_Stat3_AR.MenuFav_Sw_Psd.phys = getValue(this);
    _Ctrl_C_Stat3_AR_SpontanFlag = 1;
}
/*@@end*/

/*@@caplFunc:Ctrl_C_Stat_AR_check_output():*///function
Ctrl_C_Stat_AR_check_output()
{
      if( !getValue(HU__STMSG_Ctrl_C_Stat_AR ))
    {
        // Botschaft Ctrl_C_Stat_AR --- Sendeart 5 cyclicAndSpontanWithDelay --- Beginn DBKOM-Bewertung
        if( _Ctrl_C_Stat_AR_DelayCnt > 0) _Ctrl_C_Stat_AR_DelayCnt--; // Mindestsendeabstand
        _Ctrl_C_Stat_AR_Cnt--;
        if( _Ctrl_C_Stat_AR_Cnt < 1)
        {
            if( _Ctrl_C_Stat_AR_DelayCnt < 1)
            {
                // Nachricht wg. abgelaufenem Zyklus ausgeben (Mindestsendeabstand eingehalten)
                output( _mCtrl_C_Stat_AR );
                 _Ctrl_C_Stat_AR_SpontanFlag = 0; // Spontan-Flag zurücksetzen
                _Ctrl_C_Stat_AR_DelayCnt = _Ctrl_C_Stat_AR_MinDelay;
            }
            else
            {
                // Spontanflag setzen damit nach Ablauf Mindestsendeabstand gesendet wird
                 _Ctrl_C_Stat_AR_SpontanFlag = 1;
            }
            _Ctrl_C_Stat_AR_Cnt = _Ctrl_C_Stat_AR_CycleCount; // Zyklus-Zähler zurücksetzen
        }
        else if( _Ctrl_C_Stat_AR_SpontanFlag)
        {
            if( _Ctrl_C_Stat_AR_DelayCnt < 1)
            {
                // Nachricht wg. spontaner Änderung ausgeben (Mindestsendeabstand eingehalten)
                output(_mCtrl_C_Stat_AR );
                _Ctrl_C_Stat_AR_SpontanFlag = 0; // Spontan-Flag zurücksetzen
                _Ctrl_C_Stat_AR_DelayCnt = _Ctrl_C_Stat_AR_MinDelay;
            }
        }
    }
}
/*@@end*/

/*@@caplFunc:Ctrl_C_Stat_AR_init():*///function
Ctrl_C_Stat_AR_init()
{    // Botschaft Ctrl_C_A4_AR ---- Sendeart 5 cyclicAndSpontanWithDelay ---- Beginn Initialisierung
    _Ctrl_C_Stat_AR_Cnt = 50;
    _Ctrl_C_Stat_AR_SpontanFlag = 0;
    _Ctrl_C_Stat_AR_DelayCnt = 1;
    _mCtrl_C_Stat_AR.CTRL_C_Stat_Id.phys  = getValue( HU_CTRL_C_Stat_Id );
    _mCtrl_C_Stat_AR.Detents_Stat.phys  = getValue( HU_Detents_Stat );
    _mCtrl_C_Stat_AR.Local_Posn_Rq.phys  = getValue( HU_Local_Posn_Rq );
    _mCtrl_C_Stat_AR.StartPosn_Stat.phys  = getValue( HU_StartPosn_Stat );
}
/*@@end*/

/*@@timer:_tCtrl_C_Stat_AR:*/
on timer _tCtrl_C_Stat_AR
{
    putValue( HU__STMSG_Ctrl_C_Stat_AR, 0 );
}
/*@@end*/

/*@@envVar:HU__STMSG_Ctrl_C_Stat_AR:*/
on EnvVar HU__STMSG_Ctrl_C_Stat_AR
{
    long tDelay;
    if( getValue( this ) == 2 )
    {
        tDelay = getValue( HU__STMSGT_Ctrl_C_Stat_AR );
        if( tDelay > 0)    
            setTimer( _tCtrl_C_Stat_AR, tDelay );
        else
            putValue( HU__STMSG_Ctrl_C_Stat_AR, 0 );
    }
}
/*@@end*/

/*@@envVar:HU_CTRL_C_Stat_Id:*/
on EnvVar HU_CTRL_C_Stat_Id
{
    _mCtrl_C_Stat_AR.CTRL_C_Stat_Id.phys = getValue(this);
    _Ctrl_C_Stat_AR_SpontanFlag = 1;
}
/*@@end*/

/*@@envVar:HU_Detents_Stat:*/
on EnvVar HU_Detents_Stat
{
    _mCtrl_C_Stat_AR.Detents_Stat.phys = getValue(this);
    _Ctrl_C_Stat_AR_SpontanFlag = 1;
}
/*@@end*/

/*@@envVar:HU_Local_Posn_Rq:*/
on EnvVar HU_Local_Posn_Rq
{
    _mCtrl_C_Stat_AR.Local_Posn_Rq.phys = getValue(this);
    _Ctrl_C_Stat_AR_SpontanFlag = 1;
}
/*@@end*/

/*@@envVar:HU_StartPosn_Stat:*/
on EnvVar HU_StartPosn_Stat
{
    _mCtrl_C_Stat_AR.StartPosn_Stat.phys = getValue(this);
    _Ctrl_C_Stat_AR_SpontanFlag = 1;
}
/*@@end*/

/*@@caplFunc:ROE_CTRL_C_check_output():*///function
ROE_CTRL_C_check_output()
{
      if( !getValue( HU__STMSG_ROE_CTRL_C ))
    {
        // Botschaft ROE_CTRL_C --- Sendeart 1 spontanX --- Beginn DBKOM-Bewertung
        if(  _ROE_CTRL_C_SpontanFlag )
        {
            // Nachricht wg. spontaner Änderung ausgeben
            output(_mROE_CTRL_C );
            // Spontan-Flag zurücksetzen
             _ROE_CTRL_C_SpontanFlag = 0;
        }
    }
}
/*@@end*/

/*@@caplFunc:ROE_CTRL_C_init():*///function
ROE_CTRL_C_init()
{
    // Botschaft ROE_CTRL_C ---- Sendeart 1 spontanX ---- Beginn Initialisierung
    _ROE_CTRL_C_SpontanFlag = 0;
    _mROE_CTRL_C.ROE_DTC_CTRL_C.phys = getValue( HU_ROE_DTC_CTRL_C );
    _mROE_CTRL_C.ROE_DTC_Stat_CTRL_C.phys = getValue( HU_ROE_DTC_Stat_CTRL_C );
    _mROE_CTRL_C.ROE_Header_CTRL_C.phys = getValue( HU_ROE_Header_CTRL_C );
}
/*@@end*/

/*@@timer:_tROE_CTRL_C:*/
on timer _tROE_CTRL_C
{
    putValue( HU__STMSG_ROE_CTRL_C, 0 );
}
/*@@end*/

/*@@envVar:HU__STMSG_ROE_CTRL_C:*/
on EnvVar HU__STMSG_ROE_CTRL_C
{
    long tDelay;
    if( getValue( this ) == 2 )
    {
        tDelay = getValue( HU__STMSGT_ROE_CTRL_C );
        if( tDelay > 0)    
            setTimer( _tROE_CTRL_C, tDelay );
        else
            putValue( HU__STMSG_ROE_CTRL_C, 0 );
    }
}
/*@@end*/

/*@@envVar:HU_ROE_DTC_CTRL_C:*/
on EnvVar HU_ROE_DTC_CTRL_C
{
    _mROE_CTRL_C.ROE_DTC_CTRL_C.phys = getValue(this);
    _ROE_CTRL_C_SpontanFlag = 1;
}
/*@@end*/

/*@@envVar:HU_ROE_DTC_Stat_CTRL_C:*/
on EnvVar HU_ROE_DTC_Stat_CTRL_C
{
    _mROE_CTRL_C.ROE_DTC_Stat_CTRL_C.phys = getValue(this);
    _ROE_CTRL_C_SpontanFlag = 1;
}
/*@@end*/

/*@@envVar:HU_ROE_Header_CTRL_C:*/
on EnvVar HU_ROE_Header_CTRL_C
{
    _mROE_CTRL_C.ROE_Header_CTRL_C.phys = getValue(this);
    _ROE_CTRL_C_SpontanFlag = 1;
}
/*@@end*/

