/*@!Encoding:1252*/

//////// Ethernet ////////

on EnvVar EnvSI_CAB_V10_CAB_01_Ethernet
{
  check_CAB_Ethernet();
}

on EnvVar EnvSI_CAB_V10_CAB_02_Ethernet
{
  check_CAB_Ethernet();
}

on EnvVar EnvSI_CAB_V10_CAB_03_Ethernet
{
  check_CAB_Ethernet();
}

on EnvVar EnvSI_CAB_V10_CAB_04_Ethernet
{
  check_CAB_Ethernet();
}

on EnvVar EnvSI_CAB_V10_CAB_05_Ethernet
{
  check_CAB_Ethernet();
}

on EnvVar EnvSI_CAB_V10_CAB_06_Ethernet
{
  check_CAB_Ethernet();
}

on EnvVar EnvSI_CAB_V10_CAB_07_Ethernet
{
  check_CAB_Ethernet();
}

on EnvVar EnvSI_CAB_V10_CAB_08_Ethernet
{
  check_CAB_Ethernet();
}

on EnvVar EnvSI_CAB_V10_CAB_09_Ethernet
{
  check_CAB_Ethernet();
}

on EnvVar EnvSI_CAB_V10_CAB_11_Ethernet
{
  check_CAB_Ethernet();
}

on EnvVar EnvSI_CAB_V10_CAB_13_Ethernet
{
  check_CAB_Ethernet();
}

on EnvVar EnvSI_CAB_V10_CAB_14_Ethernet
{
  check_CAB_Ethernet();
}

on EnvVar EnvSI_CAB_V10_CAB_15_Ethernet
{
  check_CAB_Ethernet();
}

on EnvVar EnvSI_CAB_V10_CAB_16_Ethernet
{
  check_CAB_Ethernet();
}

on EnvVar EnvSI_CAB_V10_CAB_17_Ethernet
{
  check_CAB_Ethernet();
}

check_CAB_Ethernet()
{
  long CAB_val;
  
  CAB_val = @EnvSI_CAB_V10_CAB_01_Ethernet * 1 + @EnvSI_CAB_V10_CAB_02_Ethernet * 2 + @EnvSI_CAB_V10_CAB_03_Ethernet * 4 + @EnvSI_CAB_V10_CAB_04_Ethernet * 8 + @EnvSI_CAB_V10_CAB_05_Ethernet * 16 + @EnvSI_CAB_V10_CAB_06_Ethernet * 32 + @EnvSI_CAB_V10_CAB_07_Ethernet * 64 + @EnvSI_CAB_V10_CAB_08_Ethernet * 128 + @EnvSI_CAB_V10_CAB_09_Ethernet * 256 + @EnvSI_CAB_V10_CAB_11_Ethernet * 1024 + @EnvSI_CAB_V10_CAB_13_Ethernet * 4096 + @EnvSI_CAB_V10_CAB_14_Ethernet * 8192 + @EnvSI_CAB_V10_CAB_15_Ethernet * 16384 + @EnvSI_CAB_V10_CAB_16_Ethernet * 32768 + @EnvSI_CAB_V10_CAB_17_Ethernet * 65536;
    
  $SI_CAB_V10_XIX_Systeminfo_01_XIX_E3V_VLAN_Infotainment = CAB_val;
}