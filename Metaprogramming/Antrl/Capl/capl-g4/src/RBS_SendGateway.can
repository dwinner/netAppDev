/*@!Encoding:1252*/
includes
{
    #include "messages\message_ACC_12.cin"
    #include "messages\message_Airbag_01.cin"
    #include "messages\message_ESP_30.cin"
    #include "messages\message_GNSS_07.cin"
    #include "messages\message_PSD_06.cin"
//    #include "messages\message_Quersperre_04.cin"   only available in FPK-Entry
    #include "messages\message_TSK_08.cin"
    #include "messages\message_VZE_05.cin"
    #include "messages\message_WBA_03.cin"
}

variables
{
    const int KCAN__MSGDLC_UPDOWN_NoChange = 0;
    const int KCAN__MSGDLC_UPDOWN_Up       = 1;
    const int KCAN__MSGDLC_UPDOWN_Down     = 2;

    const int KCAN__MSGDLC_CTRL_Default   = 0;
    const int KCAN__MSGDLC_CTRL_Once      = 1;
    const int KCAN__MSGDLC_CTRL_Permanent = 2;

    const int KCAN_E2E_State_Inactive = 0;
    const int KCAN_E2E_State_Active   = 1;
    const int KCAN_E2E_State_Armed    = 2;

    message   ACC_13 _mACC_13;
    msTimer _tACC_13;
    msTimer _totACC_13;

    message   ACC_14 _mACC_14;
    msTimer _tACC_14;
    msTimer _totACC_14;

    message   ACC_20 _mACC_20;
    msTimer _tACC_20;
    msTimer _totACC_20;

    message   ACC_21 _mACC_21;
    msTimer _tACC_21;
    msTimer _totACC_21;

    message   AGA_01 _mAGA_01;
    msTimer _tAGA_01;
    msTimer _totAGA_01;
    byte _s_pdu_codeAGA_01[16] = { 0xdf,0xdf,0xdf,0xdf,0xdf,0xdf,0xdf,0xdf,0xdf,0xdf,0xdf,0xdf,0xdf,0xdf,0xdf,0xdf };

    message   Airbag_02 _mAirbag_02;
    msTimer _tAirbag_02;
    msTimer _totAirbag_02;

    message   Airbag_04 _mAirbag_04;
    msTimer _tAirbag_04;
    msTimer _totAirbag_04;

    message   Airbag_06 _mAirbag_06;
    msTimer _tAirbag_06;
    msTimer _totAirbag_06;

    message  APS_Master _mAPS_Master;
    msTimer _tAPS_Master;
    msTimer _totAPS_Master;

    message   ARA_Status_01 _mARA_Status_01;
    msTimer _tARA_Status_01;
    msTimer _totARA_Status_01;

    message   AWV_02 _mAWV_02;
    msTimer _tAWV_02;
    msTimer _totAWV_02;

    message   BEM_02 _mBEM_02;
    msTimer _tBEM_02;
    msTimer _totBEM_02;

    message   BEM_06 _mBEM_06;
    msTimer _tBEM_06;
    msTimer _totBEM_06;
    byte _s_pdu_codeBEM_06[16] = { 0x54,0xaf,0x8a,0xfb,0x0d,0x87,0x6a,0x0f,0x47,0x78,0x31,0x4f,0x35,0x28,0x82,0x6d};

    message   BMS_05 _mBMS_05;
    msTimer _tBMS_05;
    msTimer _totBMS_05;

    message   BMS_06 _mBMS_06;
    msTimer _tBMS_06;
    msTimer _totBMS_06;

    message   BMS_07 _mBMS_07;
    msTimer _tBMS_07;
    msTimer _totBMS_07;
    byte _s_pdu_codeBMS_07[16] = { 0x43,0x43,0x43,0x43,0x43,0x43,0x43,0x43,0x43,0x43,0x43,0x43,0x43,0x43,0x43,0x43 };

    message   BMS_20 _mBMS_20;
    msTimer _tBMS_20;
    msTimer _totBMS_20;

    message   BMS_25 _mBMS_25;
    msTimer _tBMS_25;
    msTimer _totBMS_25;

    message   Charisma_01 _mCharisma_01;
    msTimer _tCharisma_01;
    msTimer _totCharisma_01;
    msTimer _tinhCharisma_01;
    byte _bsiCharisma_01 = 0; // send inhibited
    byte _bsaiCharisma_01 = 0; // send after inhibited

    message   Charisma_03 _mCharisma_03;
    msTimer _tCharisma_03;
    msTimer _totCharisma_03;
    msTimer _tinhCharisma_03;
    byte _bsiCharisma_03 = 0; // send inhibited
    byte _bsaiCharisma_03 = 0; // send after inhibited

    message   Daempfer_01 _mDaempfer_01;
    msTimer _tDaempfer_01;
    msTimer _totDaempfer_01;
    byte _s_pdu_codeDaempfer_01[16] = { 0x95,0x95,0x95,0x95,0x95,0x95,0x95,0x95,0x95,0x95,0x95,0x95,0x95,0x95,0x95,0x95 };

  ///  message Daempfer_04 _mDaempfer_04;
 //   msTimer _tDaempfer_04;
 //   msTimer _totDaempfer_04;

    message   DCDC_02 _mDCDC_02;
    msTimer _tDCDC_02;
    msTimer _totDCDC_02;

//    message   DEV_Kombi_RX1 _mDEV_Kombi_RX1;
    //msTimer _tDEV_Kombi_RX1;
    //msTimer _totDEV_Kombi_RX1;

    message   Diagnose_01 _mDiagnose_01;
    msTimer _tDiagnose_01;
    msTimer _totDiagnose_01;

//  message   EA_02  ID: 496 --- Sendeart 0 cyclicX ---
    message   EA_02 _mEA_02;
    int      _EA_02_Timebase;
    int      _EA_02_CycleCount;
    int      _EA_02_StartDelay;
    int      _EA_02_MinDelay;
    int      _EA_02_Cnt;
    int      _EA_02_SpontanFlag;
    int      _EA_02_DelayCnt;

    byte     _EA_02_DLC;
    int      _EA_02_CRC_ErrorCounter;
    int      _EA_02_SQC_RepeatedCounter;
    int      _EA_02_MsgDropCounter;
    byte     _EA_02_S_PDU_Code[16] = { 0x2f, 0x3c, 0x22, 0x60, 0x18, 0xeb, 0x63, 0x76, 0xc5, 0x91, 0x0f, 0x27, 0x34, 0x04, 0x7f, 0x02 };

    msTimer    _tEA_02;
    msTimer  _totEA_02;
    msTimer _tinhEA_02;
    byte     _bsiEA_02 = 0; // send inhibited
    byte    _bsaiEA_02 = 0; // send after inhibited

  //  message eCall_AuthTime_Req _meCall_AuthTime_Req;
 //   msTimer _teCall_AuthTime_Req;
 //   msTimer _toteCall_AuthTime_Req;

    message   EM1_HYB_13 _mEM1_HYB_13;
    msTimer _tEM1_HYB_13;
    msTimer _totEM1_HYB_13;

    message   EM2_HYB_13 _mEM2_HYB_13;
    msTimer _tEM2_HYB_13;
    msTimer _totEM2_HYB_13;
    msTimer _tinhEM2_HYB_13;
    byte _bsiEM2_HYB_13 = 0; // send inhibited
    byte _bsaiEM2_HYB_13 = 0; // send after inhibited

    message   EPB_03 _mEPB_03;
    msTimer _tEPB_03;
    msTimer _totEPB_03;
    byte _s_pdu_codeEPB_03[16] ={0xe7,0x1f,0xa2,0xc2,0x76,0x25,0x1a,0x30,0xb7,0xc8,0xe8,0xe9,0x15,0x28,0x08,0x75};

    message   ESP_02 _mESP_02;
    msTimer _tESP_02;
    msTimer _totESP_02;
    byte _s_pdu_codeESP_02[16] = { 0xAA,0xAA,0xAA,0xAA,0xAA,0xAA,0xAA,0xAA,0xAA,0xAA,0xAA,0xAA,0xAA,0xAA,0xAA,0xAA };

    message   ESP_10 _mESP_10;
    msTimer _tESP_10;
    msTimer _totESP_10;
    byte _s_pdu_codeESP_10[16] = { 0xaa,0xaa,0xaa,0xaa,0xaa,0xaa,0xaa,0xaa,0xaa,0xaa,0xaa,0xaa,0xaa,0xaa,0xaa,0xaa };

    message   ESP_19 _mESP_19;
    msTimer _tESP_19;
    msTimer _totESP_19;

    message   ESP_20 _mESP_20;
    msTimer _tESP_20;
    msTimer _totESP_20;
    byte _s_pdu_codeESP_20[16] = { 0xaa,0xaa,0xaa,0xaa,0xaa,0xaa,0xaa,0xaa,0xaa,0xaa,0xaa,0xaa,0xaa,0xaa,0xaa,0xaa };

    message   ESP_21 _mESP_21;
    msTimer _tESP_21;
    msTimer _totESP_21;
    byte _s_pdu_codeESP_21[16] = { 0xb4,0xef,0xf8,0x49,0x1e,0xe5,0xc2,0xc0,0x97,0x19,0x3c,0xc9,0xf1,0x98,0xd6,0x61 };

    message   ESP_24 _mESP_24;
    msTimer _tESP_24;
    msTimer _totESP_24;
    byte _s_pdu_codeESP_24[16] = { 0x67,0x8a,0xae,0x22,0x4d,0xd0,0x51,0x80,0x5c,0xb9,0xce,0x1e,0xdf,0x02,0x2d,0xd4 };

    message   eTM_01 _meTM_01;
    msTimer _teTM_01;
    msTimer _toteTM_01;

    message   FDR_04 _mFDR_04;
    msTimer _tFDR_04;
    msTimer _totFDR_04;

    message   FLA_01 _mFLA_01;
    msTimer _tFLA_01;
    msTimer _totFLA_01;

    message   FoD_01 _mFoD_01;
    msTimer _tFoD_01;
    msTimer _totFoD_01;
    msTimer _tinhFoD_01;
    byte _bsiFoD_01 = 0; // send inhibited
    byte _bsaiFoD_01 = 0; // send after inhibited

    message   Gateway_71 _mGateway_71;
    msTimer _tGateway_71;
    msTimer _totGateway_71;

    message   Gateway_73 _mGateway_73;
    msTimer _tGateway_73;
    msTimer _totGateway_73;

    message   Gateway_77 _mGateway_77;
    msTimer _tGateway_77;
    msTimer _totGateway_77;

    message   Gateway_78 _mGateway_78;
    msTimer _tGateway_78;
    msTimer _totGateway_78;

    message   GNSS_01 _mGNSS_01;
    msTimer _tGNSS_01;
    msTimer _totGNSS_01;

    message   GNSS_02 _mGNSS_02;
    msTimer _tGNSS_02;
    msTimer _totGNSS_02;

    message   GNSS_03 _mGNSS_03;
    msTimer _tGNSS_03;
    msTimer _totGNSS_03;

    message   GNSS_05 _mGNSS_05;
    msTimer _tGNSS_05;
    msTimer _totGNSS_05;
    int     eGNSS_Nachrichtenpaket_ID5=0;
// UTC vars
    long eGNSS_UTC_Zeit_counter=0;
    int  eGNSS_UTC_Zeit_secound=0;
    int  eGNSS_UTC_Zeit_minute=0;
    int  eGNSS_UTC_Zeit_hour=0;
    int  eGNSS_UTC_Zeit_day;
    int  eGNSS_UTC_Zeit_year;
    int  eGNSS_UTC_Zeit_newvalues=0;
    int  eGNSS_UTC_Zeit_newsecound=0;
    int  eGNSS_UTC_Zeit_newminute=0;
    int  eGNSS_UTC_Zeit_newhour=0;
    int  eGNSS_UTC_Zeit_newday;
    int  eGNSS_UTC_Zeit_newyear;
    long eGNSS_UTC_Zeit_newvalue;

    message   GRA_ACC_01 _mGRA_ACC_01;
  //  msTimer _tGRA_ACC_01;
 //   msTimer _totGRA_ACC_01;
    byte _s_pdu_codeGRA_ACC_01[16] = { 0x67,0x8a,0xae,0x22,0x4d,0xd0,0x51,0x80,0x5c,0xb9,0xce,0x1e,0xdf,0x02,0x2d,0xd4 };

    message   HLR_02 _mHLR_02;
//    msTimer _tHLR_02;
//    msTimer _totHLR_02;

    message   HVEM_02 _mHVEM_02;
 //   msTimer _tHVEM_02;
 //   msTimer _totHVEM_02;

    message   HVEM_04 _mHVEM_04;
    msTimer _tHVEM_04;
    msTimer _totHVEM_04;

    message   HVK_01 _mHVK_01;
    msTimer _tHVK_01;
    msTimer _totHVK_01;
//    msTimer _tinhHVK_01;
//    byte _bsiHVK_01 = 0; // send inhibited
//    byte _bsaiHVK_01 = 0; // send after inhibited

    message   HVLM_05 _mHVLM_05;
    msTimer _tHVLM_05;
    msTimer _totHVLM_05;

    message   HVLM_10 _mHVLM_10;
    msTimer _tHVLM_10;
    msTimer _totHVLM_10;

 //   message   Kamera_Status _mKamera_Status;
    msTimer _tKamera_Status;
    msTimer _totKamera_Status;

 //   message   KN_Gateway _mKN_Gateway;
    msTimer _tKN_Gateway;
    msTimer _totKN_Gateway;

    message   KS_Kombi_Req _mKS_Kombi_Req;
    msTimer _tKS_Kombi_Req;
    msTimer _totKS_Kombi_Req;

 //   message   LAPP_SM_01 _mLAPP_SM_01;
    msTimer _tLAPP_SM_01;
    msTimer _totLAPP_SM_01;

 //   message   LCM_Feh_LM_L _mLCM_Feh_LM_L;
    msTimer _tLCM_Feh_LM_L;
    msTimer _totLCM_Feh_LM_L;

//    message   LCM_Feh_LM_R _mLCM_Feh_LM_R;
    msTimer _tLCM_Feh_LM_R;
    msTimer _totLCM_Feh_LM_R;

 //   message   LCM_Sta_LM_L _mLCM_Sta_LM_L;
    msTimer _tLCM_Sta_LM_L;
    msTimer _totLCM_Sta_LM_L;

 //   message   LCM_Sta_LM_R _mLCM_Sta_LM_R;
    msTimer _tLCM_Sta_LM_R;
    msTimer _totLCM_Sta_LM_R;

    message   LDW_02 _mLDW_02;
    msTimer _tLDW_02;
    msTimer _totLDW_02;
    msTimer _tinhLDW_02;
    byte _bsiLDW_02 = 0; // send inhibited
    byte _bsaiLDW_02 = 0; // send after inhibited

  //  message   LED_Feh_LM_L_03 _mLED_Feh_LM_L_03;
    msTimer _tLED_Feh_LM_L_03;
    msTimer _totLED_Feh_LM_L_03;


 //   message   LED_Feh_LM_R_03 _mLED_Feh_LM_R_03;
    msTimer _tLED_Feh_LM_R_03;
    msTimer _totLED_Feh_LM_R_03;


    message   LH_EPS_01 _mLH_EPS_01;
    msTimer _tLH_EPS_01;
    msTimer _totLH_EPS_01;

    byte _s_pdu_codeLH_EPS_01[16] = { 0x29,0x29,0x29,0x29,0x29,0x29,0x29,0x29,0x29,0x29,0x29,0x29,0x29,0x29,0x29,0x29 };

    message   LoGeWa_03 _mLoGeWa_03;
    msTimer _tLoGeWa_03;
    msTimer _totLoGeWa_03;

  //  message   LSH_01 _mLSH_01;
    msTimer _tLSH_01;
    msTimer _totLSH_01;

    message   LSH_02 _mLSH_02;
    msTimer _tLSH_02;
    msTimer _totLSH_02;

    message   LWR_AFS_01 _mLWR_AFS_01;
    msTimer _tLWR_AFS_01;
    msTimer _totLWR_AFS_01;

    message   MainUnit_01 _mMainUnit_01;
    msTimer _tMainUnit_01;
    msTimer _totMainUnit_01;

    message   MFL_Tasten_Kon_01 _mMFL_Tasten_Kon_01;
    msTimer _tMFL_Tasten_Kon_01;
    msTimer _totMFL_Tasten_Kon_01;

    message   Motor_04 _mMotor_04;
    msTimer _tMotor_04;
    msTimer _totMotor_04;

    message   Motor_07 _mMotor_07;
    msTimer _tMotor_07;
    msTimer _totMotor_07;

    message   Motor_09 _mMotor_09;
    msTimer _tMotor_09;
    msTimer _totMotor_09;

    message   Motor_14 _mMotor_14;
    msTimer _tMotor_14;
    msTimer _totMotor_14;
    msTimer _tinhMotor_14;
    byte _bsiMotor_14 = 0; // send inhibited
    byte _bsaiMotor_14 = 0; // send after inhibited

  //  message   Motor_16 _mMotor_16;
    msTimer _tMotor_16;
    msTimer _totMotor_16;

    message   Motor_18 _mMotor_18;
    msTimer _tMotor_18;
    msTimer _totMotor_18;

    message Motor_23 _mMotor_23;
    msTimer _tMotor_23;
    msTimer _totMotor_23;

    message Motor_25 _mMotor_25;
    msTimer _tMotor_25;
    msTimer _totMotor_25;

    message Motor_26 _mMotor_26;
    msTimer _tMotor_26;
    msTimer _totMotor_26;

    message Motor_29 _mMotor_29;
    msTimer _tMotor_29;
    msTimer _totMotor_29;

    message   Motor_31 _mMotor_31;
    msTimer _tMotor_31;
    msTimer _totMotor_31;

    message   Motor_35 _mMotor_35;
    msTimer _tMotor_35;
    msTimer _totMotor_35;
    msTimer _tinhMotor_35;
    byte _bsiMotor_35 = 0; // send inhibited
    byte _bsaiMotor_35 = 0; // send after inhibited

    message Motor_36 _mMotor_36;
    msTimer _tMotor_36;
    msTimer _totMotor_36;

    message Motor_41 _mMotor_41;
    msTimer _tMotor_41;
    msTimer _totMotor_41;

    message Motor_Code_01 _mMotor_Code_01;
    msTimer _tMotor_Code_01;
    msTimer _totMotor_Code_01;
    byte _s_pdu_codeMotor_Code_01[16] = { 0x47,0x47,0x47,0x47,0x47,0x47,0x47,0x47,0x47,0x47,0x47,0x47,0x47,0x47,0x47,0x47 };

    message Motor_EV_01 _mMotor_EV_01;
    msTimer _tMotor_EV_01;
    msTimer _totMotor_EV_01;

    message Motor_EV_03 _mMotor_EV_03;
    msTimer _tMotor_EV_03;
    msTimer _totMotor_EV_03;

    message Motor_Gas_01 _mMotor_Gas_01;
    msTimer _tMotor_Gas_01;
    msTimer _totMotor_Gas_01;

    message Motor_Hybrid_03 _mMotor_Hybrid_03;
    msTimer _tMotor_Hybrid_03;
    msTimer _totMotor_Hybrid_03;

    message Motor_Hybrid_06 _mMotor_Hybrid_06;
    msTimer _tMotor_Hybrid_06;
    msTimer _totMotor_Hybrid_06;

    message MSG_HYB_30 _mMSG_HYB_30;
    msTimer _tMSG_HYB_30;
    msTimer _totMSG_HYB_30;
    byte _s_pdu_codeMSG_HYB_30[16] = { 0x47,0x47,0x47,0x47,0x47,0x47,0x47,0x47,0x47,0x47,0x47,0x47,0x47,0x47,0x47,0x47 };

    message MVK_01 _mMVK_01;
    msTimer _tMVK_01;
    msTimer _totMVK_01;
    byte _s_pdu_codeMVK_01[16] = { 0x03,0x63,0x3E,0x04,0xF9,0xB4,0x4F,0x32,0x25,0x56,0x1E,0xC1,0x83,0xFA,0x31,0x97 };

    message NavData_01 _mNavData_01;
    msTimer _tNavData_01;
    msTimer _totNavData_01;

    message NavData_02 _mNavData_02;
    msTimer _tNavData_02;
    msTimer _totNavData_02;

    message NavPos_01 _mNavPos_01;
    msTimer _tNavPos_01;
    msTimer _totNavPos_01;

    message NMH_Gateway _mNMH_Gateway;
    msTimer _tNMH_Gateway;
    msTimer _totNMH_Gateway;

    message OBD_01 _mOBD_01;
    msTimer _tOBD_01;
    msTimer _totOBD_01;

    message OBDC_Funktionaler_Req_All _mOBDC_Funktionaler_Req_All;
    msTimer _tOBDC_Funktionaler_Req_All;
    msTimer _totOBDC_Funktionaler_Req_All;
/*
OBDC_Kombi_Req

OCU_WFS_Anfrage
*/
    message Parkhilfe_04 _mParkhilfe_04;
    msTimer _tParkhilfe_04;
    msTimer _totParkhilfe_04;
/*
Personalisierung_02
*/
    message PLA_Status_02 _mPLA_Status_02;
    msTimer _tPLA_Status_02; //cycle
    msTimer _totPLA_Status_02; //timeout

    message PreCrash_02 _mPreCrash_02;
    msTimer _tPreCrash_02;
    msTimer _totPreCrash_02;

    message PSD_04 _mPSD_04;
    msTimer _tPSD_04; //cycle
    msTimer _totPSD_04; //timeout

    message PSD_05 _mPSD_05;
    msTimer _tPSD_05; //cycle
    msTimer _totPSD_05; //timeout

    message Radio_01 _mRadio_01;
    msTimer _tRadio_01;
    msTimer _totRadio_01;

    message RDK_02 _mRDK_02;
    msTimer _tRDK_02;
    msTimer _totRDK_02;

    message Reichweite_01 _mReichweite_01;
    msTimer _tReichweite_01;
    msTimer _totReichweite_01;

    message Reichweite_02 _mReichweite_02;
    msTimer _tReichweite_02;
    msTimer _totReichweite_02;

    message Reichweite_03 _mReichweite_03;
    msTimer _tReichweite_03;
    msTimer _totReichweite_03;

    message RKA_01 _mRKA_01;
    msTimer _tRKA_01;
    msTimer _totRKA_01;

    message SOK_NoAuthenticTime_01 _mSOK_NoAuthenticTime_01;
    msTimer _tSOK_NoAuthenticTime_01;
    msTimer _totSOK_NoAuthenticTime_01;
/*
STH_01

STH_02

STSG_HFS_01
*/
    message SWA_01 _mSWA_01;
    msTimer _tSWA_01;
    msTimer _totSWA_01;
    byte _s_pdu_codeSWA_01[16] = { 0x0c,0x0c,0x0c,0x0c,0x0c,0x0c,0x0c,0x0c,0x0c,0x0c,0x0c,0x0c,0x0c,0x0c,0x0c,0x0c };

    message Systeminfo_01 _mSysteminfo_01;
    msTimer _tSysteminfo_01;
    msTimer _totSysteminfo_01;
    msTimer _tinhSysteminfo_01;
    byte _bsiSysteminfo_01 = 0; // send inhibited
    byte _bsaiSysteminfo_01 = 0; // send after inhibited

    message TA_01 _mTA_01;
    msTimer _tTA_01;
    msTimer _totTA_01;

 /*
Telefon_01
*/
    message TM_01 _mTM_01;
    msTimer _tTM_01;
    msTimer _totTM_01;

    message TSK_07 _mTSK_07;
    msTimer _tTSK_07;
    msTimer _totTSK_07;
    byte _s_pdu_codeTSK_07[16] = { 0x78,0x68,0x3a,0x31,0x16,0x08,0x4f,0xde,0xf7,0x35,0x19,0xe6,0x28,0x2f,0x59,0x82 };
/*
VMM_01

*/
    message Waehlhebel_05 _mWaehlhebel_05;
    msTimer _tWaehlhebel_05;
    msTimer _totWaehlhebel_05;

    message WIV_01 _mWIV_01;
    msTimer _tWIV_01;
    msTimer _totWIV_01;
    msTimer _tinhWIV_01;
    byte _bsiWIV_01 = 0; // send inhibited
    byte _bsaiWIV_01 = 0; // send after inhibited

    message Zentralrechner_03 _mZentralrechner_03;
    msTimer _tZentralrechner_03;
    msTimer _totZentralrechner_03;

 long gTiming;
 long gAnzID;
 byte gValuesSet;

  //MR 78520
  msTimer _tKl15Test;
  msTimer _tKL15TestAirbag_01;
  msTimer _tKL15TestEPB_03;
  msTimer _tKL15TestBEM_06;
  msTimer _tKL15TestESP_24;
  msTimer _tKL15TestLH_EPS_01;
  msTimer _tKL15TestTSK_07;
  msTimer _tKL15TestBMS_07;
  msTimer _tKL15TestTSG_FT_02;
  msTimer _tKL15TestSMLS_01;
  msTimer _tKL15TestESP_21;
  msTimer _tKL15TestAGA_01;
  msTimer _tKL15TestESP_30;
  msTimer _tKL15TestMVK_01;
  msTimer _tKL15TestWBA_03;

    byte _CRC8[256] = { 0x00, 0x2f, 0x5e, 0x71, 0xbc, 0x93, 0xe2, 0xcd, 0x57, 0x78, 0x09, 0x26, 0xeb, 0xc4, 0xb5, 0x9a,
                        0xae, 0x81, 0xf0, 0xdf, 0x12, 0x3d, 0x4c, 0x63, 0xf9, 0xd6, 0xa7, 0x88, 0x45, 0x6a, 0x1b, 0x34,
                        0x73, 0x5c, 0x2d, 0x02, 0xcf, 0xe0, 0x91, 0xbe, 0x24, 0x0b, 0x7a, 0x55, 0x98, 0xb7, 0xc6, 0xe9,
                        0xdd, 0xf2, 0x83, 0xac, 0x61, 0x4e, 0x3f, 0x10, 0x8a, 0xa5, 0xd4, 0xfb, 0x36, 0x19, 0x68, 0x47,
                        0xe6, 0xc9, 0xb8, 0x97, 0x5a, 0x75, 0x04, 0x2b, 0xb1, 0x9e, 0xef, 0xc0, 0x0d, 0x22, 0x53, 0x7c,
                        0x48, 0x67, 0x16, 0x39, 0xf4, 0xdb, 0xaa, 0x85, 0x1f, 0x30, 0x41, 0x6e, 0xa3, 0x8c, 0xfd, 0xd2,
                        0x95, 0xba, 0xcb, 0xe4, 0x29, 0x06, 0x77, 0x58, 0xc2, 0xed, 0x9c, 0xb3, 0x7e, 0x51, 0x20, 0x0f,
                        0x3b, 0x14, 0x65, 0x4a, 0x87, 0xa8, 0xd9, 0xf6, 0x6c, 0x43, 0x32, 0x1d, 0xd0, 0xff, 0x8e, 0xa1,
                        0xe3, 0xcc, 0xbd, 0x92, 0x5f, 0x70, 0x01, 0x2e, 0xb4, 0x9b, 0xea, 0xc5, 0x08, 0x27, 0x56, 0x79,
                        0x4d, 0x62, 0x13, 0x3c, 0xf1, 0xde, 0xaf, 0x80, 0x1a, 0x35, 0x44, 0x6b, 0xa6, 0x89, 0xf8, 0xd7,
                        0x90, 0xbf, 0xce, 0xe1, 0x2c, 0x03, 0x72, 0x5d, 0xc7, 0xe8, 0x99, 0xb6, 0x7b, 0x54, 0x25, 0x0a,
                        0x3e, 0x11, 0x60, 0x4f, 0x82, 0xad, 0xdc, 0xf3, 0x69, 0x46, 0x37, 0x18, 0xd5, 0xfa, 0x8b, 0xa4,
                        0x05, 0x2a, 0x5b, 0x74, 0xb9, 0x96, 0xe7, 0xc8, 0x52, 0x7d, 0x0c, 0x23, 0xee, 0xc1, 0xb0, 0x9f,
                        0xab, 0x84, 0xf5, 0xda, 0x17, 0x38, 0x49, 0x66, 0xfc, 0xd3, 0xa2, 0x8d, 0x40, 0x6f, 0x1e, 0x31,
                        0x76, 0x59, 0x28, 0x07, 0xca, 0xe5, 0x94, 0xbb, 0x21, 0x0e, 0x7f, 0x50, 0x9d, 0xb2, 0xc3, 0xec,
                        0xd8, 0xf7, 0x86, 0xa9, 0x64, 0x4b, 0x3a, 0x15, 0x8f, 0xa0, 0xd1, 0xfe, 0x33, 0x1c, 0x6d, 0x42 };
}

float round (float value, float step)
{
    //conflict with CANeasy
    //return _floor(value / step + 0.5) * step;
    long factor;
    double val1, val2;
    factor= value/step;
    val1=step*factor;
    val2=value-val1;
    if(abs(val2)>=(step/2))
        factor+= (val2>0?1:-1);
    return (factor * step);
}

on envVar eSendEnabled
{
    if( getValue( eSendEnabled ) && getValue( eSendACC_12 ))  sendACC_12();
    if( getValue( eSendEnabled ) && getValue( eSendACC_13 ))  sendACC_13();
    if( getValue( eSendEnabled ) && getValue( eSendACC_14 ))  sendACC_14();
    if( getValue( eSendEnabled ) && getValue( eSendACC_20 ))  sendACC_20();
    if( getValue( eSendEnabled ) && getValue( eSendACC_21 ))  sendACC_21();
    if( getValue( eSendEnabled ) && getValue( eSendAGA_01 ))  sendAGA_01();
    if( getValue( eSendEnabled ) && getValue( eSendAirbag_01 ))  sendAirbag_01();
    if( getValue( eSendEnabled ) && getValue( eSendAirbag_02 ))  sendAirbag_02();
    if( getValue( eSendEnabled ) && getValue( eSendAirbag_04 ))  sendAirbag_04();
    if( getValue( eSendEnabled ) && getValue( eSendAirbag_06 ))  sendAirbag_06();
    if( getValue( eSendEnabled ) && getValue( eSendAPS_Master ))  sendAPS_Master();
    if( getValue( eSendEnabled ) && getValue( eSendARA_Status_01 ))  sendARA_Status_01();
    //AuthTime_eCall_Resp
    if( getValue( eSendEnabled ) && getValue( eSendAWV_02 ))  sendAWV_02();
    if( getValue( eSendEnabled ) && getValue( eSendBEM_02 ))  sendBEM_02();
    if( getValue( eSendEnabled ) && getValue( eSendBEM_06 ))  sendBEM_06();
    if( getValue( eSendEnabled ) && getValue( eSendBMS_05 ))  sendBMS_05();
    if( getValue( eSendEnabled ) && getValue( eSendBMS_05 ))  sendBMS_05();
    if( getValue( eSendEnabled ) && getValue( eSendBMS_06 ))  sendBMS_06();
    if( getValue( eSendEnabled ) && getValue( eSendBMS_07 ))  sendBMS_07();
    if( getValue( eSendEnabled ) && getValue( eSendBMS_20 ))  sendBMS_20();
    if( getValue( eSendEnabled ) && getValue( eSendBMS_25 ))  sendBMS_25();
  //  if( getValue( eSendEnabled ) && getValue( eSendCharisma_01 ))  sendCharisma_01();
    if( getValue( eSendEnabled ) && getValue( eSendCharisma_03 ))  sendCharisma_03();
    if( getValue( eSendEnabled ) && getValue( eSendDaempfer_01 ))  sendDaempfer_01();
    if( getValue( eSendEnabled ) && getValue( eSendDCDC_02 ))  sendDCDC_02();
    if( getValue( eSendEnabled ) && getValue( eSendDEV_Kombi_RX1 ))  sendDEV_Kombi_RX1();
    if( getValue( eSendEnabled ) && getValue( eSendDiagnose_01 ))  sendDiagnose_01();
    if( getValue( eSendEnabled ) && getValue( eSendEA_02 ))  sendEA_02();
    //eCall_AuthTime_Req
    if( getValue( eSendEnabled ) && getValue( eSendEM1_HYB_13 ))  sendEM1_HYB_13();
    if( getValue( eSendEnabled ) && getValue( eSendEM2_HYB_13 ))  sendEM2_HYB_13();
    if( getValue( eSendEnabled ) && getValue( eSendEPB_03 ))  sendEPB_03();
    if( getValue( eSendEnabled ) && getValue( eSendESP_02 ))  sendESP_02();
    if( getValue( eSendEnabled ) && getValue( eSendESP_10 ))  sendESP_10();
    if( getValue( eSendEnabled ) && getValue( eSendESP_19 ))  sendESP_19();
    if( getValue( eSendEnabled ) && getValue( eSendESP_20 ))  sendESP_20();
    if( getValue( eSendEnabled ) && getValue( eSendESP_21 ))  sendESP_21();
    if( getValue( eSendEnabled ) && getValue( eSendESP_24 ))  sendESP_24();
    if( getValue( eSendEnabled ) && getValue( eSendESP_30 ))  sendESP_30();
 //   if( getValue( eSendEnabled ) && getValue( eSendeTM_01 ))  sendeTM_01();
//    if( getValue( eSendEnabled ) && getValue( eSendFDR_04 ))  sendFDR_04();
//    if( getValue( eSendEnabled ) && getValue( eSendFLA_01 ))  sendFLA_01();
    if( getValue( eSendEnabled ) && getValue( eSendFoD_01 ))  sendFoD_01();
//  FoD_BCM1_Req
    if( getValue( eSendEnabled ) && getValue( eSendGateway_71 ))  sendGateway_71();
    if( getValue( eSendEnabled ) && getValue( eSendGateway_73 ))  sendGateway_73();
    if( getValue( eSendEnabled ) && getValue( eSendGateway_77 ))  sendGateway_77();
    if( getValue( eSendEnabled ) && getValue( eSendGateway_78 ))  sendGateway_78();
    //Gateway_AuthTime_Req
    if( getValue( eSendEnabled ) && getValue( eSendGNSS_01 ))  sendGNSS_01();
    if( getValue( eSendEnabled ) && getValue( eSendGNSS_02 ))  sendGNSS_02();
    if( getValue( eSendEnabled ) && getValue( eSendGNSS_03 ))  sendGNSS_03();
    if( getValue( eSendEnabled ) && getValue( eSendGNSS_05 ))  sendGNSS_05();
    if( getValue( eSendEnabled ) && getValue( eSendGNSS_07 ))  sendGNSS_07();
    //GSG_WFS_Anfrage
    //HLR_02
//    if( getValue( eSendEnabled ) && getValue( eSendHVEM_02 ))  sendHVEM_02();
    if( getValue( eSendEnabled ) && getValue( eSendHVEM_04 ))  sendHVEM_04();
    if( getValue( eSendEnabled ) && getValue( eSendHVK_01 ))   sendHVK_01();
    if( getValue( eSendEnabled ) && getValue( eSendHVLM_05 ))  sendHVLM_05();
    //HVLM_10
    //Info_El_AuthTime_Req
    //IPA_02
    if( getValue( eSendEnabled ) && getValue( eSendISO_Funktionaler_Req_All ))  sendISO_Funktionaler_Req_All();
    if( getValue( eSendEnabled ) && getValue( eSendISO_Kombi_Req ))  sendISO_Kombi_Req();
    //Kamera_Status
    //KN_Gateway
    //KS_BCM1_Req
    if( getValue( eSendEnabled ) && getValue( eSendKS_Kombi_Req ))  sendKS_Kombi_Req();
    //KS_MFG_Req
    //LAPP_SM_01
    //LCM_Feh_LM_L
    //LCM_Feh_LM_R
    //LCM_Sta_LM_L
    //LCM_Sta_LM_R
    if( getValue( eSendEnabled ) && getValue( eSendLDW_02 ))  sendLDW_02();
    //LED_Feh_LM_L_03
    //LED_Feh_LM_R_03
    if( getValue( eSendEnabled ) && getValue( eSendLH_EPS_01 ))  sendLH_EPS_01();
    //LSH_01
    if( getValue( eSendEnabled ) && getValue( eSendLSH_02 ))  sendLSH_02();
    if( getValue( eSendEnabled ) && getValue( eSendLWR_AFS_01 ))  sendLWR_AFS_01();
    if( getValue( eSendEnabled ) && getValue( eSendMainUnit_01 ))  sendMainUnit_01();
    if( getValue( eSendEnabled ) && getValue( eSendMFL_Tasten_Kon_01 ))  sendMFL_Tasten_Kon_01();
    if( getValue( eSendEnabled ) && getValue( eSendMotor_04 ))  sendMotor_04();
    if( getValue( eSendEnabled ) && getValue( eSendMotor_07 ))  sendMotor_07();
    if( getValue( eSendEnabled ) && getValue( eSendMotor_09 ))  sendMotor_09();
    if( getValue( eSendEnabled ) && getValue( eSendMotor_14 ))  sendMotor_14();
    //Motor_16
    if( getValue( eSendEnabled ) && getValue( eSendMotor_18 ))  sendMotor_18();
    if( getValue( eSendEnabled ) && getValue( eSendMotor_23 ))  sendMotor_23();
    if( getValue( eSendEnabled ) && getValue( eSendMotor_25 ))  sendMotor_25();
    if( getValue( eSendEnabled ) && getValue( eSendMotor_26 ))  sendMotor_26();
    if( getValue( eSendEnabled ) && getValue( eSendMotor_29 ))  sendMotor_29();
    if( getValue( eSendEnabled ) && getValue( eSendMotor_31 ))  sendMotor_31();
    if( getValue( eSendEnabled ) && getValue( eSendMotor_35 ))  sendMotor_35();
    if( getValue( eSendEnabled ) && getValue( eSendMotor_36 ))  sendMotor_36();
    if( getValue( eSendEnabled ) && getValue( eSendMotor_41 ))  sendMotor_41();
    if( getValue( eSendEnabled ) && getValue( eSendMotor_Code_01 ))  sendMotor_Code_01();
    if( getValue( eSendEnabled ) && getValue( eSendMotor_EV_01 ))  sendMotor_EV_01();
    if( getValue( eSendEnabled ) && getValue( eSendMotor_EV_03 ))  sendMotor_EV_03();
    if( getValue( eSendEnabled ) && getValue( eSendMotor_Gas_01 ))  sendMotor_Gas_01();
    if( getValue( eSendEnabled ) && getValue( eSendMotor_Hybrid_03 ))  sendMotor_Hybrid_03();
    if( getValue( eSendEnabled ) && getValue( eSendMotor_Hybrid_06 ))  sendMotor_Hybrid_06();
    if( getValue( eSendEnabled ) && getValue( eSendMSG_HYB_30 ))  sendMSG_HYB_30();
    //
    //MSG1_WFS_Anfrage
    //MSG2_WFS_Anfrage
    //MSG3_WFS_Anfrage
    //MSG4_WFS_Anfrage
    if( getValue( eSendEnabled ) && getValue( eSendMVK_01 ))  sendMVK_01();
    //NavData_01
    //NavData_02
    if( getValue( eSendEnabled ) && getValue( eSendNavPos_01 ))  sendNavPos_01();
    if( getValue( eSendEnabled ) && getValue( eSendNMH_Gateway ))  sendNMH_Gateway();
  //  if( getValue( eSendEnabled ) && getValue( eSendNMH_STSG_HBFS ))  sendNMH_STSG_HBFS();
  //  if( getValue( eSendEnabled ) && getValue( eSendNMH_STSG_HFS ))  sendNMH_STSG_HFS();
    if( getValue( eSendEnabled ) && getValue( eSendOBDC_Funktionaler_Req_All ))  sendOBDC_Funktionaler_Req_All();
    //OBD_01
    //OCU_WFS_Anfrage
    if( getValue( eSendEnabled ) && getValue( eSendParkhilfe_04 ))  sendParkhilfe_04();
    //Personalisierung_02
    if( getValue( eSendEnabled ) && getValue( eSendPLA_Status_02 ))  sendPLA_Status_02();
    if( getValue( eSendEnabled ) && getValue( eSendPreCrash_02 ))  sendPreCrash_02();
    //PSD_04
    //PSD_05
    if( getValue( eSendEnabled ) && getValue( eSendPSD_06 ))  sendPSD_06();
  //  if( getValue( eSendEnabled ) && getValue( eSendQuersperre_04 ))  sendQuersperre_04();     only available in FPK-Entry
    //Radio_01
    //RCTA_01
    if( getValue( eSendEnabled ) && getValue( eSendRDK_02 ))  sendRDK_02();
    //Rear_View_01
    if( getValue( eSendEnabled ) && getValue( eSendReichweite_01 ))  sendReichweite_01();
    if( getValue( eSendEnabled ) && getValue( eSendReichweite_02 ))  sendReichweite_02();
    //Reichweite_03
    if( getValue( eSendEnabled ) && getValue( eSendRKA_01 ))  sendRKA_01();
    if( getValue( eSendEnabled ) && getValue( eSendSOK_NoAuthenticTime_01 ))  sendSOK_NoAuthenticTime_01();
    //SOK_Zeit_BCM_Signatur_Resp_01
    //SOK_Zeit_BCM_Zeit_Resp_01
    //SOK_Zeit_DDA_Signatur_Resp_01
    //SOK_Zeit_DDA_Zeit_Resp_01
    //SOK_Zeit_Klima_Signatur_Resp_01
    //SOK_Zeit_Klima_Zeit_Resp_01
    //SOK_Zeit_Kombi_Signatur_Resp_01
    //SOK_Zeit_Kombi_Zeit_Resp_01
//    if( getValue( eSendEnabled ) && getValue( eSendSTH_01 ))  sendSTH_01();
//    if( getValue( eSendEnabled ) && getValue( eSendSTH_02 ))  sendSTH_02();
    if( getValue( eSendEnabled ) && getValue( eSendSWA_01 ))  sendSWA_01();
//    if( getValue( eSendEnabled ) && getValue( eSendSWA_02 ))  sendSWA_02();
    if( getValue( eSendEnabled ) && getValue( eSendSysteminfo_01 ))  sendSysteminfo_01();
    if( getValue( eSendEnabled ) && getValue( eSendTA_01 ))  sendTA_01();
    //Telefon_01
//    if( getValue( eSendEnabled ) && getValue( eSendTM_01 ))  sendTM_01();
    if( getValue( eSendEnabled ) && getValue( eSendTSK_07 ))  sendTSK_07();
    if( getValue( eSendEnabled ) && getValue( eSendTSK_08 ))  sendTSK_08();
    //VMM_01
    if( getValue( eSendEnabled ) && getValue( eSendVZE_05 ))  sendVZE_05();
    if( getValue( eSendEnabled ) && getValue( eSendWaehlhebel_05 ))  sendWaehlhebel_05();
    if( getValue( eSendEnabled ) && getValue( eSendWBA_03 ))  sendWBA_03();
    if( getValue( eSendEnabled ) && getValue( eSendWFS_Transponder_Req_02 ))  sendWFS_Transponder_Req_02();   //BCM  !!!!!!!!!
    if( getValue( eSendEnabled ) && getValue( eSendWIV_01 ))  sendWIV_01();
    if( getValue( eSendEnabled ) && getValue( eSendZentralrechner_03 ))  sendZentralrechner_03();
}

on Start
{
    ACC_12_LoadDefaultValues();
    Airbag_01_loadDefaultValues();
    ESP_30_LoadDefaultValues();
    GNSS_07_LoadDefaultValues();
    PSD_06_LoadDefaultValues();
  //  Quersperre_04_LoadDefaultValues();   only available in FPK-Entry
    TSK_08_LoadDefaultValues();
    VZE_05_LoadDefaultValues();
    WBA_03_loadDefaultValues();

    //FOR MOTOR_GAS_01 message
    enableControl("Motor_Gas_01","Fuellstand_LPG_m1",0);
    enableControl("Motor_Gas_01","Fuellungsgrad_LPG_m1",0);
    enableControl("Motor_Gas_01", "Tankvolumen_LPG",0);
    enableControl("Motor_Gas_01","LPG_Ueberlauf_m1",0);

    enableControl("Motor_Gas_01","CNG_Ueberlauf_m0",1);
    enableControl("Motor_Gas_01","Tankmasse_CNG",1);

    //IssueList #124
    putValue( eMO_Ges_calcConsumption_button, 0x01);
    putValue( eMO_Recu_calcConsumption_button, 0x01);

}

on envVar eLoadSettings
{
    ACC_12_readEnvVars( "RBS.ini" );
    Airbag_01_readEnvVars( "RBS.ini" );
    ESP_30_readEnvVars( "RBS.ini" );
    GNSS_07_readEnvVars( "RBS.ini" );
    PSD_06_readEnvVars( "RBS.ini" );
  //  Quersperre_04_readEnvVars( "RBS.ini" );   only available in FPK-Entry
    TSK_08_readEnvVars( "RBS.ini" );
    VZE_05_readEnvVars( "RBS.ini" );
    WBA_03_readEnvVars( "RBS.ini" );
}

on envVar eSaveSettings
{
    ACC_12_saveEnvVars( "RBS.ini" );
    Airbag_01_saveEnvVars( "RBS.ini" );
    ESP_30_saveEnvVars( "RBS.ini" );
    GNSS_07_saveEnvVars( "RBS.ini"  );
    PSD_06_saveEnvVars( "RBS.ini" );
  //  Quersperre_04_saveEnvVars( "RBS.ini" );   only available in FPK-Entry
    TSK_08_saveEnvVars( "RBS.ini" );
    VZE_05_saveEnvVars( "RBS.ini" );
    WBA_03_saveEnvVars( "RBS.ini" );
}

// ACC_12 begin
// moved to message_ACC_12.cin
// ACC_12 end

on Timer _tACC_13
{
    if( getValue( eTACC_13 ) <= 0)  putValue( eSendACC_13, 0 );
    if( ( getValue( eSendEnabled ) && getValue( eSendACC_13 )) || getValue( eDlcOnceACC_13 ))  sendACC_13();
}

on envVar eSendACC_13
{
    if( getValue( eSendEnabled ) && getValue( eSendACC_13 ))  sendACC_13();
}

on envVar eTimeoutACC_13
{
    cancelTimer( _tACC_13 );
    cancelTimer( _totACC_13 );
    if( getValue( this ))
        setTimer( _totACC_13, ( getValue( eSendEnabled ) && getValue( eSendACC_13 ) && ( getValue( eTOTACC_13 ) > 0)) ? getValue( eTOTACC_13 ) : 1 );
    else
        if( getValue( eSendEnabled ) && getValue( eSendACC_13 ))  sendACC_13();
}

on Timer _totACC_13
{
    putValue( eTimeoutACC_13, 0 );
}

on envVar eDlcOnceACC_13
{
    if( getValue( eDlcOnceACC_13 ) && !( getValue( eSendEnabled ) && getValue( eSendACC_13 )))  setTimer( _tACC_13, 1 );
}

void sendACC_13()
{
    if( getValue( eChangeACC_13 ))
    {
        if( getValue( eDlcOnceACC_13 ) || getValue( eDlcWrongACC_13 ))
        {
            putValue( eDlcOnceACC_13, 0 );
            _mACC_13.DLC = getValue( eDlcACC_13 );
        }
        else
        {
            _mACC_13.DLC = 8;
        }
    }
    else
    {
        _mACC_13.DLC = 8;
    }

    output( _mACC_13 );
    cancelTimer( _tACC_13 );
    if( getValue( eTACC_13 ) > 0)  setTimer( _tACC_13, getValue( eTACC_13 ) );  else  setTimer( _tACC_13, 1 );
}

ACC_13Changed()
{
}

on envVar eACC_Einheit_maxSetzgeschwS
{
    putValue( KCAN_ACC_Einheit_maxSetzgeschw, getValue( this ) );
}

on envVar KCAN_ACC_Einheit_maxSetzgeschw
{
    _mACC_13.ACC_Einheit_maxSetzgeschw.phys = getValue( this );
    ACC_13Changed();
}

on envVar eACC_ENG_TexteS
{
    putValue( KCAN_ACC_ENG_Texte, getValue( this ) );
}

on envVar KCAN_ACC_ENG_Texte
{
    _mACC_13.ACC_ENG_Texte.phys = getValue( this );
    ACC_13Changed();
}

on envVar eACC_KurvenassistentS
{
    putValue( KCAN_ACC_Kurvenassistent, getValue( this ) );
}

on envVar KCAN_ACC_Kurvenassistent
{
    _mACC_13.ACC_Kurvenassistent.phys = getValue( this );
    ACC_13Changed();
}

on envVar eACC_maxRegelgeschwS
{
    //check boundaries
	  if(getValue( this ) < 0)
    {
        putValue(this, 0);
    }

    if(getValue( this ) > 81.6)
    {
        putValue(this, 81.6);
    }

    putValue( KCAN_ACC_maxRegelgeschw_INT, (int)(getValue( this )/0.32) );
}

on envVar KCAN_ACC_maxRegelgeschw
{
    putValue( eACC_maxRegelgeschwS, getValue( this ));
}

on envVar KCAN_ACC_maxRegelgeschw_INT
{
    _mACC_13.ACC_maxRegelgeschw = getValue( this ); //use raw integer values to avoid issue with rounding / GVJ-72395
    putValue(KCAN_ACC_maxRegelgeschw, getValue( this ) * 0.32);
    ACC_13Changed();
}

on envVar eACC_maxSetzgeschwS
{
    putValue( KCAN_ACC_maxSetzgeschw, getValue( this ) );
}

on envVar KCAN_ACC_maxSetzgeschw
{
    _mACC_13.ACC_maxSetzgeschw.phys = getValue( this );
    ACC_13Changed();
}

on envVar eACC_minRegelgeschwS
{
    //check boundaries
    if(getValue( this ) < 0)
    {
      putValue(this, 0);
    }

    if(getValue( this ) > 81.6)
    {
      putValue(this, 81.6);
    }
    putValue( KCAN_ACC_minRegelgeschw_INT, (int)(getValue( this )/0.32) );
}

on envVar KCAN_ACC_minRegelgeschw
{
    putValue( eACC_minRegelgeschwS, getValue( this ));
}

on envVar KCAN_ACC_minRegelgeschw_INT
{
    _mACC_13.ACC_minRegelgeschw = getValue( this ); //use raw integer values to avoid issue with rounding / GVJ-72395
    putValue(KCAN_ACC_minRegelgeschw, getValue( this ) * 0.32);
    ACC_13Changed();
}

on envVar eACC_RegelgeschwS
{
    //check boundaries
    if(getValue( this ) < 0)
    {
        putValue(this, 0);
    }

    if(getValue( this ) > 327.36)
    {
        putValue(this, 327.36);
    }
    putValue( KCAN_ACC_Regelgeschw_INT, (int)(getValue( this )/0.32) );
}

on envVar KCAN_ACC_Regelgeschw
{
    putValue( eACC_RegelgeschwS, getValue( this ));
}

on envVar KCAN_ACC_Regelgeschw_INT
{
    _mACC_13.ACC_Regelgeschw = getValue( this ); //use raw integer values to avoid issue with rounding / GVJ-72395
    putValue(KCAN_ACC_Regelgeschw, getValue( this ) * 0.32);
    ACC_13Changed();
}

on envVar eACC_RUVS
{
    putValue( KCAN_ACC_RUV, getValue( this ) );
}

on envVar KCAN_ACC_RUV
{
    _mACC_13.ACC_RUV.phys = getValue( this );
    ACC_13Changed();
}

on envVar eACC_Status_GRA_ModusS
{
    putValue( KCAN_ACC_Status_GRA_Modus, getValue( this ) );
}

on envVar KCAN_ACC_Status_GRA_Modus
{
    _mACC_13.ACC_Status_GRA_Modus.phys = getValue( this );
    ACC_13Changed();
}

on envVar eACC_TachokranzS
{
    putValue( KCAN_ACC_Tachokranz, getValue( this ) );
}

on envVar KCAN_ACC_Tachokranz
{
    _mACC_13.ACC_Tachokranz.phys = getValue( this );
    ACC_13Changed();
}

on envVar eACC_Tempolimit_EinheitS
{
    putValue( KCAN_ACC_Tempolimit_Einheit, getValue( this ) );
}

on envVar KCAN_ACC_Tempolimit_Einheit
{
    _mACC_13.ACC_Tempolimit_Einheit.phys = getValue( this );
    ACC_13Changed();
}

on envVar eACC_Tempolimitassistent_02S
{
    putValue( KCAN_ACC_Tempolimitassistent_02, getValue( this ) );
}

on envVar KCAN_ACC_Tempolimitassistent_02
{
    _mACC_13.ACC_Tempolimitassistent_02.phys = getValue( this );
    ACC_13Changed();
}

on envVar eACC_Typ_TachokranzS
{
    putValue( KCAN_ACC_Typ_Tachokranz, getValue( this ) );
}

on envVar KCAN_ACC_Typ_Tachokranz
{
    _mACC_13.ACC_Typ_Tachokranz.phys = getValue( this );
    ACC_13Changed();
}

on envVar eACC_Typ_Tachokranz_untenS
{
    putValue( KCAN_ACC_Typ_Tachokranz_unten, getValue( this ) );
}

on envVar KCAN_ACC_Typ_Tachokranz_unten
{
    _mACC_13.ACC_Typ_Tachokranz_unten.phys = getValue( this );
    ACC_13Changed();
}

on Timer _tACC_14
{
    if( getValue( eTACC_14 ) <= 0)  putValue( eSendACC_14, 0 );
    if( ( getValue( eSendEnabled ) && getValue( eSendACC_14 )) || getValue( eDlcOnceACC_14 ))  sendACC_14();
}

on envVar eSendACC_14
{
    if( getValue( eSendEnabled ) && getValue( eSendACC_14 ))  sendACC_14();
}

on envVar eTimeoutACC_14
{
    cancelTimer( _tACC_14 );
    cancelTimer( _totACC_14 );
    if( getValue( this ))
        setTimer( _totACC_14, ( getValue( eSendEnabled ) && getValue( eSendACC_14 ) && ( getValue( eTOTACC_14 ) > 0)) ? getValue( eTOTACC_14 ) : 1 );
    else
        if( getValue( eSendEnabled ) && getValue( eSendACC_14 ))  sendACC_14();
}

on Timer _totACC_14
{
    putValue( eTimeoutACC_14, 0 );
}

on envVar eDlcOnceACC_14
{
    if( getValue( eDlcOnceACC_14 ) && !( getValue( eSendEnabled ) && getValue( eSendACC_14 )))  setTimer( _tACC_14, 1 );
}

void sendACC_14()
{
    if( getValue( eChangeACC_14 ))
    {
        if( getValue( eDlcOnceACC_14 ) || getValue( eDlcWrongACC_14 ))
        {
            putValue( eDlcOnceACC_14, 0 );
            _mACC_14.DLC = getValue( eDlcACC_14 );
        }
        else
        {
            _mACC_14.DLC = 8;
        }
    }
    else
    {
        _mACC_14.DLC = 8;
    }
    output( _mACC_14 );
    cancelTimer( _tACC_14 );
    if( getValue( eTACC_14 ) > 0)  setTimer( _tACC_14, getValue( eTACC_14 ) );  else  setTimer( _tACC_14, 1 );
}

ACC_14Changed()
{
}

on envVar KCAN_AbstWarn_LRR_FAS_Fkt_Status
{
    _mACC_14.AbstWarn_LRR_FAS_Fkt_Status.phys = getValue( this );
    ACC_14Changed();
}

on envVar KCAN_ACA_Hinweistexte
{
    _mACC_14.ACA_Hinweistexte.phys = getValue( this );
    ACC_14Changed();
}

on envVar KCAN_ACA_Querfuehrung_Texte
{
    _mACC_14.ACA_Querfuehrung_Texte.phys = getValue( this );
    ACC_14Changed();
}

on envVar eACC_Abstand_AbstandswarnerS
{
    putValue( KCAN_ACC_Abstand_Abstandswarner, getValue( this ) );
}

on envVar KCAN_ACC_Abstand_Abstandswarner
{
    _mACC_14.ACC_Abstand_Abstandswarner.phys = getValue( this );
    ACC_14Changed();
}

on envVar eACC_Akustik_03S
{
    putValue( KCAN_ACC_Akustik_03, getValue( this ) );
}

on envVar KCAN_ACC_Akustik_03
{
    _mACC_14.ACC_Akustik_03.phys = getValue( this );
    ACC_14Changed();
}

on envVar KCAN_ACC_Einheit_Abstandswarner
{
    _mACC_14.ACC_Einheit_Abstandswarner.phys = getValue( this );
    ACC_14Changed();
}

on envVar eACC_FoD_StatusS
{
    putValue( KCAN_ACC_FoD_Status, getValue( this ) );
}

on envVar KCAN_ACC_FoD_Status
{
    _mACC_14.ACC_FoD_Status.phys = getValue( this );
    ACC_14Changed();
}

on envVar eACC_Geschw_ZielfahrzeugS
{
    putValue( KCAN_ACC_Geschw_Zielfahrzeug, getValue( this ) );
}

on envVar KCAN_ACC_Geschw_Zielfahrzeug
{
    _mACC_14.ACC_Geschw_Zielfahrzeug.phys = getValue( this );
    ACC_14Changed();
}

on envVar KCAN_ACC_STA_Text
{
    _mACC_14.ACC_STA_Text.phys = getValue( this );
    ACC_14Changed();
}

on envVar eACC_Status_AnzeigeS
{
    putValue( KCAN_ACC_Status_Anzeige, getValue( this ) );
}

on envVar KCAN_ACC_Status_Anzeige
{
    _mACC_14.ACC_Status_Anzeige.phys = getValue( this );
    ACC_14Changed();
}

on envVar KCAN_ACC_Status_Stauende
{
    _mACC_14.ACC_Status_Stauende.phys = getValue( this );
    ACC_14Changed();
}

on envVar eACC_Texte_02S
{
    putValue( KCAN_ACC_Texte_02, getValue( this ) );
}

on envVar KCAN_ACC_Texte_02
{
    _mACC_14.ACC_Texte_02.phys = getValue( this );
    ACC_14Changed();
}

on envVar eACC_Texte_AbstandswarnerS
{
    putValue( KCAN_ACC_Texte_Abstandswarner, getValue( this ) );
}

on envVar KCAN_ACC_Texte_Abstandswarner
{
    _mACC_14.ACC_Texte_Abstandswarner.phys = getValue( this );
    ACC_14Changed();
}

on envVar eACC_Texte_SekundaeranzS
{
    putValue( KCAN_ACC_Texte_Sekundaeranz, getValue( this ) );
}

on envVar KCAN_ACC_Texte_Sekundaeranz
{
    _mACC_14.ACC_Texte_Sekundaeranz.phys = getValue( this );
    ACC_14Changed();
}

on envVar KCAN_ACC_Vorz_Abstandswarner
{
    _mACC_14.ACC_Vorz_Abstandswarner.phys = getValue( this );
    ACC_14Changed();
}

on envVar eACC_Zeitluecke_AbstandswarnerS
{
    putValue( KCAN_ACC_Zeitluecke_Abstandswarner, getValue( this ) );
}

on envVar KCAN_ACC_Zeitluecke_Abstandswarner
{
    _mACC_14.ACC_Zeitluecke_Abstandswarner.phys = getValue( this );
    ACC_14Changed();
}

on envVar KCAN_FAS_Licht_Anf
{
    _mACC_14.FAS_Licht_Anf.phys = getValue( this );
    ACC_14Changed();
}

on envVar KCAN_STA_Texte
{
    _mACC_14.STA_Texte.phys = getValue( this );
    ACC_14Changed();
}

on envVar KCAN_STA_Zusatzanz
{
    _mACC_14.STA_Zusatzanz.phys = getValue( this );
    ACC_14Changed();
}

on Timer _tACC_20
{
    if( getValue( eTACC_20 ) <= 0)  putValue( eSendACC_20, 0 );
    if( ( getValue( eSendEnabled ) && getValue( eSendACC_20 )) || getValue( eDlcOnceACC_20 ))  sendACC_20();
}

on envVar eSendACC_20
{
    if( getValue( eSendEnabled ) && getValue( eSendACC_20 ))  sendACC_20();
}

on envVar eTimeoutACC_20
{
    cancelTimer( _tACC_20 );
    cancelTimer( _totACC_20 );
    if( getValue( this ))
        setTimer( _totACC_20, ( getValue( eSendEnabled ) && getValue( eSendACC_20 ) && ( getValue( eTOTACC_20 ) > 0)) ? getValue( eTOTACC_20 ) : 1 );
    else
        if( getValue( eSendEnabled ) && getValue( eSendACC_20 ))  sendACC_20();
}

on Timer _totACC_20
{
    putValue( eTimeoutACC_20, 0 );
}

on envVar eDlcOnceACC_20
{
    if( getValue( eDlcOnceACC_20 ) && !( getValue( eSendEnabled ) && getValue( eSendACC_20 )))  setTimer( _tACC_20, 1 );
}

void sendACC_20()
{
    if( getValue( eChangeACC_20 ))
    {
        if( getValue( eDlcOnceACC_20 ) || getValue( eDlcWrongACC_20 ))
        {
            putValue( eDlcOnceACC_20, 0 );
            _mACC_20.DLC = getValue( eDlcACC_20 );
        }
        else
        {
            _mACC_20.DLC = 8;
        }
    }
    else
    {
        _mACC_20.DLC = 8;
    }

    output( _mACC_20 );
    cancelTimer( _tACC_20 );
    if( getValue( eTACC_20 ) > 0)  setTimer( _tACC_20, getValue( eTACC_20 ) );  else  setTimer( _tACC_20, 1 );
}

ACC_20Changed()
{
}

on envVar eACC_Abstand_LNSS
{
    putValue( KCAN_ACC_Abstand_LNS, getValue( this ) );
}

on envVar KCAN_ACC_Abstand_LNS
{
    _mACC_20.ACC_Abstand_LNS.phys = getValue( this );
    ACC_20Changed();
}

on envVar eACC_Abstand_RNSS
{
    putValue( KCAN_ACC_Abstand_RNS, getValue( this ) );
}

on envVar KCAN_ACC_Abstand_RNS
{
    _mACC_20.ACC_Abstand_RNS.phys = getValue( this );
    ACC_20Changed();
}

on envVar eACC_Abstand_WZOS
{
    putValue( KCAN_ACC_Abstand_WZO, getValue( this ) );
}

on envVar KCAN_ACC_Abstand_WZO
{
    _mACC_20.ACC_Abstand_WZO.phys = getValue( this );
    ACC_20Changed();
}

on envVar eACC_Anzeige_MaximalabstandS
{
    putValue( KCAN_ACC_Anzeige_Maximalabstand, getValue( this ) );
}

on envVar KCAN_ACC_Anzeige_Maximalabstand
{
    _mACC_20.ACC_Anzeige_Maximalabstand.phys = getValue( this );
    ACC_20Changed();
}

on envVar eACC_Anzeige_ObjektregelungS
{
    putValue( KCAN_ACC_Anzeige_Objektregelung, getValue( this ) );
}

on envVar KCAN_ACC_Anzeige_Objektregelung
{
    _mACC_20.ACC_Anzeige_Objektregelung.phys = getValue( this );
    ACC_20Changed();
}

on envVar eACC_StatusiconS
{
    putValue( KCAN_ACC_Statusicon, getValue( this ) );
}

on envVar KCAN_ACC_Statusicon
{
    _mACC_20.ACC_Statusicon.phys = getValue( this );
    ACC_20Changed();
}

on envVar eACC_Typ_LNSS
{
    putValue( KCAN_ACC_Typ_LNS, getValue( this ) );
}

on envVar KCAN_ACC_Typ_LNS
{
    _mACC_20.ACC_Typ_LNS.phys = getValue( this );
    ACC_20Changed();
}

on envVar eACC_Typ_RNSS
{
    putValue( KCAN_ACC_Typ_RNS, getValue( this ) );
}

on envVar KCAN_ACC_Typ_RNS
{
    _mACC_20.ACC_Typ_RNS.phys = getValue( this );
    ACC_20Changed();
}

on envVar eACC_Typ_WZOS
{
    putValue( KCAN_ACC_Typ_WZO, getValue( this ) );
}

on envVar KCAN_ACC_Typ_WZO
{
    _mACC_20.ACC_Typ_WZO.phys = getValue( this );
    ACC_20Changed();
}

on Timer _tACC_21
{
    if( getValue( eTACC_21 ) <= 0)  putValue( eSendACC_21, 0 );
    if( ( getValue( eSendEnabled ) && getValue( eSendACC_21 )) || getValue( eDlcOnceACC_21 ))  sendACC_21();
}

on envVar eSendACC_21
{
    if( getValue( eSendEnabled ) && getValue( eSendACC_21 ))  sendACC_21();
}

on envVar eTimeoutACC_21
{
    cancelTimer( _tACC_21 );
    cancelTimer( _totACC_21 );
    if( getValue( this ))
        setTimer( _totACC_21, ( getValue( eSendEnabled ) && getValue( eSendACC_21 ) && ( getValue( eTOTACC_21 ) > 0)) ? getValue( eTOTACC_21 ) : 1 );
    else
        if( getValue( eSendEnabled ) && getValue( eSendACC_21 ))  sendACC_21();
}

on Timer _totACC_21
{
    putValue( eTimeoutACC_21, 0 );
}

on envVar eDlcOnceACC_21
{
    if( getValue( eDlcOnceACC_21 ) && !( getValue( eSendEnabled ) && getValue( eSendACC_21 )))  setTimer( _tACC_21, 1 );
}

void sendACC_21()
{
    if( getValue( eChangeACC_21 ))
    {
        if( getValue( eDlcOnceACC_21 ) || getValue( eDlcWrongACC_21 ))
        {
            putValue( eDlcOnceACC_21, 0 );
            _mACC_21.DLC = getValue( eDlcACC_21 );
        }
        else
        {
            _mACC_21.DLC = 8;
        }
    }
    else
    {
        _mACC_21.DLC = 8;
    }

    output( _mACC_21 );
    cancelTimer( _tACC_21 );
    if( getValue( eTACC_21 ) > 0)  setTimer( _tACC_21, getValue( eTACC_21 ) );  else  setTimer( _tACC_21, 1 );
}

ACC_21Changed()
{
}

on envVar eACC_Sollabstand_1S
{
    putValue( KCAN_ACC_Sollabstand_1, getValue( this ) );
}

on envVar KCAN_ACC_Sollabstand_1
{
    _mACC_21.ACC_Sollabstand_1.phys = getValue( this );
    ACC_21Changed();
}

on envVar eACC_Sollabstand_2S
{
    putValue( KCAN_ACC_Sollabstand_2, getValue( this ) );
}

on envVar KCAN_ACC_Sollabstand_2
{
    _mACC_21.ACC_Sollabstand_2.phys = getValue( this );
    ACC_21Changed();
}

on envVar eACC_Sollabstand_3S
{
    putValue( KCAN_ACC_Sollabstand_3, getValue( this ) );
}

on envVar KCAN_ACC_Sollabstand_3
{
    _mACC_21.ACC_Sollabstand_3.phys = getValue( this );
    ACC_21Changed();
}

on envVar eACC_Sollabstand_4S
{
    putValue( KCAN_ACC_Sollabstand_4, getValue( this ) );
}

on envVar KCAN_ACC_Sollabstand_4
{
    _mACC_21.ACC_Sollabstand_4.phys = getValue( this );
    ACC_21Changed();
}

on envVar eACC_Sollabstand_5S
{
    putValue( KCAN_ACC_Sollabstand_5, getValue( this ) );
}

on envVar KCAN_ACC_Sollabstand_5
{
    _mACC_21.ACC_Sollabstand_5.phys = getValue( this );
    ACC_21Changed();
}

on envVar eACC_Texte_Sekundaeranz_02S
{
    putValue( KCAN_ACC_Texte_Sekundaeranz_02, getValue( this ) );
}

on envVar KCAN_ACC_Texte_Sekundaeranz_02
{
    _mACC_21.ACC_Texte_Sekundaeranz_02.phys = getValue( this );
    ACC_21Changed();
}

on Timer _tAGA_01
{
    if( getValue( eTAGA_01 ) <= 0)  putValue( eSendAGA_01, 0 );
    if( ( getValue( eSendEnabled ) && getValue( eSendAGA_01 )) || getValue( eDlcOnceAGA_01 ))  sendAGA_01();
}

on envVar eSendAGA_01
{
    if( getValue( eSendEnabled ) && getValue( eSendAGA_01 ))  sendAGA_01();
}

on envVar eTimeoutAGA_01
{
    cancelTimer( _tAGA_01 );
    cancelTimer( _totAGA_01 );
    if( getValue( this ))
        setTimer( _totAGA_01, ( getValue( eSendEnabled ) && getValue( eSendAGA_01 ) && ( getValue( eTOTAGA_01 ) > 0)) ? getValue( eTOTAGA_01 ) : 1 );
    else
        if( getValue( eSendEnabled ) && getValue( eSendAGA_01 ))  sendAGA_01();
}

on Timer _totAGA_01
{
    putValue( eTimeoutAGA_01, 0 );
}

on envVar eDlcOnceAGA_01
{
    if( getValue( eDlcOnceAGA_01 ) && !( getValue( eSendEnabled ) && getValue( eSendAGA_01 )))  setTimer( _tAGA_01, 1 );
}

void sendAGA_01()
{
    if( getValue( eChangeAGA_01 ))
    {
        if( getValue( eDlcOnceAGA_01 ) || getValue( eDlcWrongAGA_01 ))
        {
            putValue( eDlcOnceAGA_01, 0 );
            _mAGA_01.DLC = getValue( eDlcAGA_01 );
        }
        else
        {
            _mAGA_01.DLC = 8;
        }
    }
    else
    {
        _mAGA_01.DLC = 8;
    }

    {
        output( _mAGA_01 );
    }

    cancelTimer( _tAGA_01 );
    if( getValue( eTAGA_01 ) > 0)  setTimer( _tAGA_01, getValue( eTAGA_01 ) );  else  setTimer( _tAGA_01, 1 );
}

AGA_01Changed()
{
}

on envVar eAGA_Charisma_FahrPrS
{
    putValue( KCAN_AGA_Charisma_FahrPr, getValue( this ) );
}

on envVar KCAN_AGA_Charisma_FahrPr
{
    _mAGA_01.AGA_Charisma_FahrPr.phys = getValue( this );
    AGA_01Changed();
}

on envVar eAGA_Charisma_StatusS
{
    putValue( KCAN_AGA_Charisma_Status, getValue( this ) );
}

on envVar KCAN_AGA_Charisma_Status
{
    _mAGA_01.AGA_Charisma_Status.phys = getValue( this );
    AGA_01Changed();
}

on envVar eAGA_ohne_FunktionS
{
    putValue( KCAN_AGA_ohne_Funktion, getValue( this ) );
}

on envVar KCAN_AGA_ohne_Funktion
{
    _mAGA_01.AGA_ohne_Funktion.phys = getValue( this );
    AGA_01Changed();
}

on envVar eAGA_TexteS
{
    putValue( KCAN_AGA_Texte, getValue( this ) );
}

on envVar KCAN_AGA_Texte
{
    _mAGA_01.AGA_Texte.phys = getValue( this );
    AGA_01Changed();
}

on envVar eAGA_Verstaerker_MuteS
{
    putValue( KCAN_AGA_Verstaerker_Mute, getValue( this ) );
}

on envVar KCAN_AGA_Verstaerker_Mute
{
    _mAGA_01.AGA_Verstaerker_Mute.phys = getValue( this );
    AGA_01Changed();
}

on envVar KCAN_E_Sound_verbaut
{
    _mAGA_01.E_Sound_verbaut.phys = getValue( this );
    AGA_01Changed();
}

on timer _tKL15TestAGA_01
{
    if( getValue( eKL15TimeoutAGA_01 ))
    {
        putValue( eSendAGA_01, 1 );
    }
}

on Timer _tAirbag_02
{
    if( getValue( eTAirbag_02 ) <= 0)  putValue( eSendAirbag_02, 0 );
    if( ( getValue( eSendEnabled ) && getValue( eSendAirbag_02 )) || getValue( eDlcOnceAirbag_02 ))  sendAirbag_02();
}

on envVar eSendAirbag_02
{
    if( getValue( eSendEnabled ) && getValue( eSendAirbag_02 ))  sendAirbag_02();
}

on envVar eTimeoutAirbag_02
{
    cancelTimer( _tAirbag_02 );
    cancelTimer( _totAirbag_02 );
    if( getValue( this ))
        setTimer( _totAirbag_02, ( getValue( eSendEnabled ) && getValue( eSendAirbag_02 ) && ( getValue( eTOTAirbag_02 ) > 0)) ? getValue( eTOTAirbag_02 ) : 1 );
    else
        if( getValue( eSendEnabled ) && getValue( eSendAirbag_02 ))  sendAirbag_02();
}

on Timer _totAirbag_02
{
    putValue( eTimeoutAirbag_02, 0 );
}

on envVar eDlcOnceAirbag_02
{
    if( getValue( eDlcOnceAirbag_02 ) && !( getValue( eSendEnabled ) && getValue( eSendAirbag_02 )))  setTimer( _tAirbag_02, 1 );
}

void sendAirbag_02()
{
    if( getValue( eChangeAirbag_02))
    {
        if( getValue( eDlcOnceAirbag_02 ) || getValue( eDlcWrongAirbag_02 ))
        {
            putValue( eDlcOnceAirbag_02, 0 );
            _mAirbag_02.DLC = getValue( eDlcAirbag_02 );
        }
        else
        {
                    _mAirbag_02.DLC = 8;
                }
    }
    else
    {
        _mAirbag_02.DLC = 8;
    }
    {
        output( _mAirbag_02 );
    }

    cancelTimer( _tAirbag_02 );
    if( getValue( eTAirbag_02 ) > 0)  setTimer( _tAirbag_02, getValue( eTAirbag_02 ) );  else  setTimer( _tAirbag_02, 1 );
}

Airbag_02Changed()
{
}

on envVar KCAN_AB_Abschaltanf_SIH_BF
{
    _mAirbag_02.AB_Abschaltanf_SIH_BF.phys = getValue( this );
    Airbag_02Changed();
}

on envVar KCAN_AB_Anforderung_eCall
{
    _mAirbag_02.AB_Anforderung_eCall.phys = getValue( this );
    Airbag_02Changed();
}

on envVar KCAN_AB_Anforderung_USM
{
    _mAirbag_02.AB_Anforderung_USM.phys = getValue( this );
    Airbag_02Changed();
}

on envVar KCAN_AB_Anprall_FGS
{
    _mAirbag_02.AB_Anprall_FGS.phys = getValue( this );
    Airbag_02Changed();
}

on envVar KCAN_AB_Anprall_Front_Beifahrer
{
    _mAirbag_02.AB_Anprall_Front_Beifahrer.phys = getValue( this );
    Airbag_02Changed();
}

on envVar KCAN_AB_Anprall_Front_Fahrer
{
    _mAirbag_02.AB_Anprall_Front_Fahrer.phys = getValue( this );
    Airbag_02Changed();
}

on envVar KCAN_AB_Anprall_Heck_Beifahrer
{
    _mAirbag_02.AB_Anprall_Heck_Beifahrer.phys = getValue( this );
    Airbag_02Changed();
}

on envVar KCAN_AB_Anprall_Heck_Fahrer
{
    _mAirbag_02.AB_Anprall_Heck_Fahrer.phys = getValue( this );
    Airbag_02Changed();
}

on envVar KCAN_AB_Anprall_Rollover
{
    _mAirbag_02.AB_Anprall_Rollover.phys = getValue( this );
    Airbag_02Changed();
}

on envVar KCAN_AB_Anprall_Seite_Beifahrer
{
    _mAirbag_02.AB_Anprall_Seite_Beifahrer.phys = getValue( this );
    Airbag_02Changed();
}

on envVar KCAN_AB_Anprall_Seite_Fahrer
{
    _mAirbag_02.AB_Anprall_Seite_Fahrer.phys = getValue( this );
    Airbag_02Changed();
}

on envVar eAB_Belegung_VBS
{
    putValue( KCAN_AB_Belegung_VB, getValue( this ) );
}

on envVar KCAN_AB_Belegung_VB
{
    _mAirbag_02.AB_Belegung_VB.phys = getValue( this );
    Airbag_02Changed();
}

on envVar KCAN_AB_Crashschwere
{
    _mAirbag_02.AB_Crashschwere.phys = getValue( this );
    Airbag_02Changed();
}

on envVar eAB_Gurtschloss_BFS
{
    putValue( KCAN_AB_Gurtschloss_BF, getValue( this ) );
}

on envVar KCAN_AB_Gurtschloss_BF
{
    _mAirbag_02.AB_Gurtschloss_BF.phys = getValue( this );
    Airbag_02Changed();
}

on envVar eAB_Gurtschloss_FAS
{
    putValue( KCAN_AB_Gurtschloss_FA, getValue( this ) );
}

on envVar KCAN_AB_Gurtschloss_FA
{
    _mAirbag_02.AB_Gurtschloss_FA.phys = getValue( this );
    Airbag_02Changed();
}

on envVar eAB_Gurtschloss_Reihe2_BFS
{
    putValue( KCAN_AB_Gurtschloss_Reihe2_BF, getValue( this ) );
}

on envVar KCAN_AB_Gurtschloss_Reihe2_BF
{
    _mAirbag_02.AB_Gurtschloss_Reihe2_BF.phys = getValue( this );
    Airbag_02Changed();
}

on envVar eAB_Gurtschloss_Reihe2_FAS
{
    putValue( KCAN_AB_Gurtschloss_Reihe2_FA, getValue( this ) );
}

on envVar KCAN_AB_Gurtschloss_Reihe2_FA
{
    _mAirbag_02.AB_Gurtschloss_Reihe2_FA.phys = getValue( this );
    Airbag_02Changed();
}

on envVar eAB_Gurtschloss_Reihe2_MIS
{
    putValue( KCAN_AB_Gurtschloss_Reihe2_MI, getValue( this ) );
}

on envVar KCAN_AB_Gurtschloss_Reihe2_MI
{
    _mAirbag_02.AB_Gurtschloss_Reihe2_MI.phys = getValue( this );
    Airbag_02Changed();
}

on envVar eAB_Gurtschloss_Reihe3_BFS
{
    putValue( KCAN_AB_Gurtschloss_Reihe3_BF, getValue( this ) );
}

on envVar KCAN_AB_Gurtschloss_Reihe3_BF
{
    _mAirbag_02.AB_Gurtschloss_Reihe3_BF.phys = getValue( this );
    Airbag_02Changed();
}

on envVar eAB_Gurtschloss_Reihe3_FAS
{
    putValue( KCAN_AB_Gurtschloss_Reihe3_FA, getValue( this ) );
}

on envVar KCAN_AB_Gurtschloss_Reihe3_FA
{
    _mAirbag_02.AB_Gurtschloss_Reihe3_FA.phys = getValue( this );
    Airbag_02Changed();
}

on envVar eAB_Gurtschloss_Reihe3_MIS
{
    putValue( KCAN_AB_Gurtschloss_Reihe3_MI, getValue( this ) );
}

on envVar KCAN_AB_Gurtschloss_Reihe3_MI
{
    _mAirbag_02.AB_Gurtschloss_Reihe3_MI.phys = getValue( this );
    Airbag_02Changed();
}

on envVar eAB_Sitzpos_Sens_BFS
{
    putValue( KCAN_AB_Sitzpos_Sens_BF, getValue( this ) );
}

on envVar KCAN_AB_Sitzpos_Sens_BF
{
    _mAirbag_02.AB_Sitzpos_Sens_BF.phys = getValue( this );
    Airbag_02Changed();
}

on envVar eAB_Sitzpos_Sens_FAS
{
    putValue( KCAN_AB_Sitzpos_Sens_FA, getValue( this ) );
}

on envVar KCAN_AB_Sitzpos_Sens_FA
{
    _mAirbag_02.AB_Sitzpos_Sens_FA.phys = getValue( this );
    Airbag_02Changed();
}

on envVar KCAN_AB_Wickelklappung_Reihe2_BF
{
    _mAirbag_02.AB_Wickelklappung_Reihe2_BF.phys = getValue( this );
    Airbag_02Changed();
}

on envVar KCAN_AB_Wickelklappung_Reihe2_FA
{
    _mAirbag_02.AB_Wickelklappung_Reihe2_FA.phys = getValue( this );
    Airbag_02Changed();
}

on envVar KCAN_AB_Wickelklappung_Reihe2_MI
{
    _mAirbag_02.AB_Wickelklappung_Reihe2_MI.phys = getValue( this );
    Airbag_02Changed();
}

on envVar KCAN_LoGeWa_Event_Kombiwarnung
{
    _mAirbag_02.LoGeWa_Event_Kombiwarnung.phys = getValue( this );
    Airbag_02Changed();
}

on envVar KCAN_SC_PAO_OFF_Anf
{
    _mAirbag_02.SC_PAO_OFF_Anf.phys = getValue( this );
    Airbag_02Changed();
}

on envVar KCAN_SC_PAO_ON_Anf
{
    _mAirbag_02.SC_PAO_ON_Anf.phys = getValue( this );
    Airbag_02Changed();
}

on envVar KCAN_SC_PAO_Schriftzug_Anf
{
    _mAirbag_02.SC_PAO_Schriftzug_Anf.phys = getValue( this );
    Airbag_02Changed();
}

on Timer _tAirbag_04
{
    if( getValue( eTAirbag_04 ) <= 0)  putValue( eSendAirbag_04, 0 );
    if( ( getValue( eSendEnabled ) && getValue( eSendAirbag_04 )) || getValue( eDlcOnceAirbag_04 ))  sendAirbag_04();
}

on envVar eSendAirbag_04
{
    if( getValue( eSendEnabled ) && getValue( eSendAirbag_04 ))  sendAirbag_04();
}

on envVar eTimeoutAirbag_04
{
    cancelTimer( _tAirbag_04 );
    cancelTimer( _totAirbag_04 );
    if( getValue( this ))
        setTimer( _totAirbag_04, ( getValue( eSendEnabled ) && getValue( eSendAirbag_04 ) && ( getValue( eTOTAirbag_04 ) > 0)) ? getValue( eTOTAirbag_04 ) : 1 );
    else
        if( getValue( eSendEnabled ) && getValue( eSendAirbag_04 ))  sendAirbag_04();
}

on Timer _totAirbag_04
{
    putValue( eTimeoutAirbag_04, 0 );
}

on envVar eDlcOnceAirbag_04
{
    if( getValue( eDlcOnceAirbag_04 ) && !( getValue( eSendEnabled ) && getValue( eSendAirbag_04 )))  setTimer( _tAirbag_04, 1 );
}

void sendAirbag_04()
{
    if( getValue( eChangeAirbag_04))
    {
        if( getValue( eDlcOnceAirbag_04 ) || getValue( eDlcWrongAirbag_04 ))
        {
            putValue( eDlcOnceAirbag_04, 0 );
            _mAirbag_04.DLC = getValue( eDlcAirbag_04 );
        }
        else
        {
            _mAirbag_04.DLC = 8;
        }
    }
    else
    {
        _mAirbag_04.DLC = 8;
    }

    output( _mAirbag_04 );
    cancelTimer( _tAirbag_04 );
    if( getValue( eTAirbag_04 ) > 0)  setTimer( _tAirbag_04, getValue( eTAirbag_04 ) );  else  setTimer( _tAirbag_04, 1 );
}

Airbag_04Changed()
{
}

on envVar eAB_Gurtwarn_Reihe2_BFS
{
    putValue( KCAN_AB_Gurtwarn_Reihe2_BF, getValue( this ) );
}

on envVar KCAN_AB_Gurtwarn_Reihe2_BF
{
    _mAirbag_04.AB_Gurtwarn_Reihe2_BF.phys = getValue( this );
    Airbag_04Changed();
}

on envVar eAB_Gurtwarn_Reihe2_FAS
{
    putValue( KCAN_AB_Gurtwarn_Reihe2_FA, getValue( this ) );
}

on envVar KCAN_AB_Gurtwarn_Reihe2_FA
{
    _mAirbag_04.AB_Gurtwarn_Reihe2_FA.phys = getValue( this );
    Airbag_04Changed();
}

on envVar eAB_Gurtwarn_Reihe2_MIS
{
    putValue( KCAN_AB_Gurtwarn_Reihe2_MI, getValue( this ) );
}

on envVar KCAN_AB_Gurtwarn_Reihe2_MI
{
    _mAirbag_04.AB_Gurtwarn_Reihe2_MI.phys = getValue( this );
    Airbag_04Changed();
}

on envVar eAB_Gurtwarn_Reihe3_BFS
{
    putValue( KCAN_AB_Gurtwarn_Reihe3_BF, getValue( this ) );
}

on envVar KCAN_AB_Gurtwarn_Reihe3_BF
{
    _mAirbag_04.AB_Gurtwarn_Reihe3_BF.phys = getValue( this );
    Airbag_04Changed();
}

on envVar eAB_Gurtwarn_Reihe3_FAS
{
    putValue( KCAN_AB_Gurtwarn_Reihe3_FA, getValue( this ) );
}

on envVar KCAN_AB_Gurtwarn_Reihe3_FA
{
    _mAirbag_04.AB_Gurtwarn_Reihe3_FA.phys = getValue( this );
    Airbag_04Changed();
}

on envVar eAB_Gurtwarn_Reihe3_MIS
{
    putValue( KCAN_AB_Gurtwarn_Reihe3_MI, getValue( this ) );
}

on envVar KCAN_AB_Gurtwarn_Reihe3_MI
{
    _mAirbag_04.AB_Gurtwarn_Reihe3_MI.phys = getValue( this );
    Airbag_04Changed();
}

on envVar eAB_Gurtwarn_Reihe4_BFS
{
    putValue( KCAN_AB_Gurtwarn_Reihe4_BF, getValue( this ) );
}

on envVar KCAN_AB_Gurtwarn_Reihe4_BF
{
    _mAirbag_04.AB_Gurtwarn_Reihe4_BF.phys = getValue( this );
    Airbag_04Changed();
}

on envVar eAB_Gurtwarn_Reihe4_FAS
{
    putValue( KCAN_AB_Gurtwarn_Reihe4_FA, getValue( this ) );
}

on envVar KCAN_AB_Gurtwarn_Reihe4_FA
{
    _mAirbag_04.AB_Gurtwarn_Reihe4_FA.phys = getValue( this );
    Airbag_04Changed();
}

on envVar eAB_Gurtwarn_Reihe4_MIS
{
    putValue( KCAN_AB_Gurtwarn_Reihe4_MI, getValue( this ) );
}

on envVar KCAN_AB_Gurtwarn_Reihe4_MI
{
    _mAirbag_04.AB_Gurtwarn_Reihe4_MI.phys = getValue( this );
    Airbag_04Changed();
}

on envVar eAB_SBR_hinten_verbauS
{
    putValue( KCAN_AB_SBR_hinten_verbau, getValue( this ) );
}

on envVar KCAN_AB_SBR_hinten_verbau
{
    _mAirbag_04.AB_SBR_hinten_verbau.phys = getValue( this );
    Airbag_04Changed();
}

on envVar eAbstWarn_MV_FAS_Fkt_StatusS
{
    putValue( KCAN_AbstWarn_MV_FAS_Fkt_Status, getValue( this ) );
}

on envVar KCAN_AbstWarn_MV_FAS_Fkt_Status
{
    _mAirbag_04.AbstWarn_MV_FAS_Fkt_Status.phys = getValue( this );
    Airbag_04Changed();
}

on envVar eAWV_Einstellung_System_ASGS
{
    putValue( KCAN_AWV_Einstellung_System_ASG, getValue( this ) );
}

on envVar KCAN_AWV_Einstellung_System_ASG
{
    _mAirbag_04.AWV_Einstellung_System_ASG.phys = getValue( this );
    Airbag_04Changed();
}

on envVar eAWV_Einstellung_Warnung_ASGS
{
    putValue( KCAN_AWV_Einstellung_Warnung_ASG, getValue( this ) );
}

on envVar KCAN_AWV_Einstellung_Warnung_ASG
{
    _mAirbag_04.AWV_Einstellung_Warnung_ASG.phys = getValue( this );
    Airbag_04Changed();
}

on envVar eLGI_FAS_Fkt_StatusS
{
    putValue( KCAN_LGI_FAS_Fkt_Status, getValue( this ) );
}

on envVar KCAN_LGI_FAS_Fkt_Status
{
    _mAirbag_04.LGI_FAS_Fkt_Status.phys = getValue( this );
    Airbag_04Changed();
}

on envVar ePreCrash_FAS_Fkt_StatusS
{
    putValue( KCAN_PreCrash_FAS_Fkt_Status, getValue( this ) );
}

on envVar KCAN_PreCrash_FAS_Fkt_Status
{
    _mAirbag_04.PreCrash_FAS_Fkt_Status.phys = getValue( this );
    Airbag_04Changed();
}

on envVar eSC_PreSense_Modus_System_KASS
{
    putValue( KCAN_SC_PreSense_Modus_System_KAS, getValue( this ) );
}

on envVar KCAN_SC_PreSense_Modus_System_KAS
{
    _mAirbag_04.SC_PreSense_Modus_System_KAS.phys = getValue( this );
    Airbag_04Changed();
}

on envVar eSC_PreSense_Modus_System_MVS
{
    putValue( KCAN_SC_PreSense_Modus_System_MV, getValue( this ) );
}

on envVar KCAN_SC_PreSense_Modus_System_MV
{
    _mAirbag_04.SC_PreSense_Modus_System_MV.phys = getValue( this );
    Airbag_04Changed();
}

on envVar eSC_PreSense_Modus_System_NVS
{
    putValue( KCAN_SC_PreSense_Modus_System_NV, getValue( this ) );
}

on envVar KCAN_SC_PreSense_Modus_System_NV
{
    _mAirbag_04.SC_PreSense_Modus_System_NV.phys = getValue( this );
    Airbag_04Changed();
}

on envVar eSC_PreSense_Modus_Warnung_MVS
{
    putValue( KCAN_SC_PreSense_Modus_Warnung_MV, getValue( this ) );
}

on envVar KCAN_SC_PreSense_Modus_Warnung_MV
{
    _mAirbag_04.SC_PreSense_Modus_Warnung_MV.phys = getValue( this );
    Airbag_04Changed();
}

on envVar eSC_PreSense_Modus_Warnung_NVS
{
    putValue( KCAN_SC_PreSense_Modus_Warnung_NV, getValue( this ) );
}

on envVar KCAN_SC_PreSense_Modus_Warnung_NV
{
    _mAirbag_04.SC_PreSense_Modus_Warnung_NV.phys = getValue( this );
    Airbag_04Changed();
}

on envVar eWarnBrems_Charisma_FahrPrS
{
    putValue( KCAN_WarnBrems_Charisma_FahrPr, getValue( this ) );
}

on envVar KCAN_WarnBrems_Charisma_FahrPr
{
    _mAirbag_04.WarnBrems_Charisma_FahrPr.phys = getValue( this );
    Airbag_04Changed();
}

on envVar eWarnBrems_Charisma_StatusS
{
    putValue( KCAN_WarnBrems_Charisma_Status, getValue( this ) );
}

on envVar KCAN_WarnBrems_Charisma_Status
{
    _mAirbag_04.WarnBrems_Charisma_Status.phys = getValue( this );
    Airbag_04Changed();
}

on Timer _tAirbag_06
{
    if( getValue( eTAirbag_06 ) <= 0)  putValue( eSendAirbag_06, 0 );
    if( ( getValue( eSendEnabled ) && getValue( eSendAirbag_06 )) || getValue( eDlcOnceAirbag_06 ))  sendAirbag_06();
}

on envVar eSendAirbag_06
{
    if( getValue( eSendEnabled ) && getValue( eSendAirbag_06 ))  sendAirbag_06();
}

on envVar eTimeoutAirbag_06
{
    cancelTimer( _tAirbag_06 );
    cancelTimer( _totAirbag_06 );
    if( getValue( this ))
        setTimer( _totAirbag_06, ( getValue( eSendEnabled ) && getValue( eSendAirbag_06 ) && ( getValue( eTOTAirbag_06 ) > 0)) ? getValue( eTOTAirbag_06 ) : 1 );
    else
        if( getValue( eSendEnabled ) && getValue( eSendAirbag_06 ))  sendAirbag_06();
}

on Timer _totAirbag_06
{
    putValue( eTimeoutAirbag_06, 0 );
}

on envVar eDlcOnceAirbag_06
{
    if( getValue( eDlcOnceAirbag_06 ) && !( getValue( eSendEnabled ) && getValue( eSendAirbag_06 )))  setTimer( _tAirbag_06, 1 );
}

void sendAirbag_06()
{
    if( getValue( eChangeAirbag_06 ))
    {
        if( getValue( eDlcOnceAirbag_06 ) || getValue( eDlcWrongAirbag_06 ))
        {
            putValue( eDlcOnceAirbag_06, 0 );
            _mAirbag_06.DLC = getValue( eDlcAirbag_06 );
        }
        else
        {
            _mAirbag_06.DLC = 8;
        }
    }
    else
    {
        _mAirbag_06.DLC = 8;
    }

    output( _mAirbag_06 );
    cancelTimer( _tAirbag_06 );
    if( getValue( eTAirbag_06 ) > 0)  setTimer( _tAirbag_06, getValue( eTAirbag_06 ) );  else  setTimer( _tAirbag_06, 1 );
}

Airbag_06Changed()
{
}

on envVar eAB_Gurtschloss_Reihe4_BFS
{
    putValue( KCAN_AB_Gurtschloss_Reihe4_BF, getValue( this ) );
}

on envVar KCAN_AB_Gurtschloss_Reihe4_BF
{
    _mAirbag_06.AB_Gurtschloss_Reihe4_BF.phys = getValue( this );
    Airbag_06Changed();
}

on envVar eAB_Gurtschloss_Reihe4_FAS
{
    putValue( KCAN_AB_Gurtschloss_Reihe4_FA, getValue( this ) );
}

on envVar KCAN_AB_Gurtschloss_Reihe4_FA
{
    _mAirbag_06.AB_Gurtschloss_Reihe4_FA.phys = getValue( this );
    Airbag_06Changed();
}

on envVar eAB_Gurtschloss_Reihe4_MIS
{
    putValue( KCAN_AB_Gurtschloss_Reihe4_MI, getValue( this ) );
}

on envVar KCAN_AB_Gurtschloss_Reihe4_MI
{
    _mAirbag_06.AB_Gurtschloss_Reihe4_MI.phys = getValue( this );
    Airbag_06Changed();
}

on Timer _tAPS_Master
{
    if( getValue( eTAPS_Master ) <= 0)  putValue( eSendAPS_Master, 0 );
    if( ( getValue( eSendEnabled ) && getValue( eSendAPS_Master )) || getValue( eDlcOnceAPS_Master ))  sendAPS_Master();
}

on envVar eSendAPS_Master
{
    if( getValue( eSendEnabled ) && getValue( eSendAPS_Master ))  sendAPS_Master();
}

on envVar eTimeoutAPS_Master
{
    cancelTimer( _tAPS_Master );
    cancelTimer( _totAPS_Master );
    if( getValue( this ))
        setTimer( _totAPS_Master, ( getValue( eSendEnabled ) && getValue( eSendAPS_Master ) && ( getValue( eTOTAPS_Master ) > 0)) ? getValue( eTOTAPS_Master ) : 1 );
    else
        if( getValue( eSendEnabled ) && getValue( eSendAPS_Master ))  sendAPS_Master();
}

on Timer _totAPS_Master
{
    putValue( eTimeoutAPS_Master, 0 );
}

on envVar eDlcOnceAPS_Master
{
    if( getValue( eDlcOnceAPS_Master ) && !( getValue( eSendEnabled ) && getValue( eSendAPS_Master )))  setTimer( _tAPS_Master, 1 );
}

void sendAPS_Master()
{
    if( getValue( eChangeAPS_Master ))
    {
        if( getValue( eDlcOnceAPS_Master ) || getValue( eDlcWrongAPS_Master ))
        {
            putValue( eDlcOnceAPS_Master, 0 );
            _mAPS_Master.DLC = getValue( eDlcAPS_Master );
        }
        else
        {
            _mAPS_Master.DLC = 8;
        }
    }
    else
    {
        _mAPS_Master.DLC = 8;
    }

    output( _mAPS_Master );
    cancelTimer( _tAPS_Master );
    if( getValue( eTAPS_Master ) > 0)  setTimer( _tAPS_Master, getValue( eTAPS_Master ) );  else  setTimer( _tAPS_Master, 1 );
}

APS_MasterChanged()
{
}

on envVar KCAN_APS_Master_Sendestatus
{
    _mAPS_Master.APS_Master_Sendestatus.phys = getValue( this );
    APS_MasterChanged();
}

on envVar KCAN_CRC_US_ACC
{
    _mAPS_Master.US_ACC_BZ.phys = getValue( this );
    APS_MasterChanged();
}

on envVar KCAN_SQC_US_ACC
{
    _mAPS_Master.US_ACC_CRC.phys = getValue( this );
    APS_MasterChanged();
}

on envVar KCAN_US_blindness_detected
{
    _mAPS_Master.US_blindness_detected.phys = getValue( this );
    APS_MasterChanged();
}

on envVar KCAN_US_Freie_Weglaenge_Front
{
    _mAPS_Master.US_Freie_Weglaenge_Front.phys = getValue( this );
    APS_MasterChanged();
}

on envVar KCAN_US_Freie_Weglaenge_Front_Typ
{
    _mAPS_Master.US_Freie_Weglaenge_Front_Typ.phys = getValue( this );
    APS_MasterChanged();
}

on envVar KCAN_US_Freie_Weglaenge_Heck
{
    _mAPS_Master.US_Freie_Weglaenge_Heck.phys = getValue( this );
    APS_MasterChanged();
}

on envVar KCAN_US_Freie_Weglaenge_Heck_Typ
{
    _mAPS_Master.US_Freie_Weglaenge_Heck_Typ.phys = getValue( this );
    APS_MasterChanged();
}

on envVar KCAN_US_Freisicht_nio
{
    _mAPS_Master.US_Freisicht_nio.phys = getValue( this );
    APS_MasterChanged();
}

on envVar KCAN_US_relevante_Nichtverfuegbarkeit
{
    _mAPS_Master.US_relevante_Nichtverfuegbarkeit.phys = getValue( this );
    APS_MasterChanged();
}

on envVar KCAN_US_relevanter_Fehler
{
    _mAPS_Master.US_relevanter_Fehler.phys = getValue( this );
    APS_MasterChanged();
}

on envVar KCAN_US_Sende_Modus
{
    _mAPS_Master.US_Sende_Modus.phys = getValue( this );
    APS_MasterChanged();
}

on envVar KCAN_US_Sende_Modus_hinten
{
    _mAPS_Master.US_Sende_Modus_hinten.phys = getValue( this );
    APS_MasterChanged();
}

on Timer _tARA_Status_01
{
    if( getValue( eTARA_Status_01 ) <= 0)  putValue( eSendARA_Status_01, 0 );
    if( ( getValue( eSendEnabled ) && getValue( eSendARA_Status_01 )) || getValue( eDlcOnceARA_Status_01 ))  sendARA_Status_01();
}

on envVar eSendARA_Status_01
{
    if( getValue( eSendEnabled ) && getValue( eSendARA_Status_01 ))  sendARA_Status_01();
}

on envVar eTimeoutARA_Status_01
{
    cancelTimer( _tARA_Status_01 );
    cancelTimer( _totARA_Status_01 );
    if( getValue( this ))
        setTimer( _totARA_Status_01, ( getValue( eSendEnabled ) && getValue( eSendARA_Status_01 ) && ( getValue( eTOTARA_Status_01 ) > 0)) ? getValue( eTOTARA_Status_01 ) : 1 );
    else
        if( getValue( eSendEnabled ) && getValue( eSendARA_Status_01 ))  sendARA_Status_01();
}

on Timer _totARA_Status_01
{
    putValue( eTimeoutARA_Status_01, 0 );
}

on envVar eDlcOnceARA_Status_01
{
    if( getValue( eDlcOnceARA_Status_01 ) && !( getValue( eSendEnabled ) && getValue( eSendARA_Status_01 )))  setTimer( _tARA_Status_01, 1 );
}

void sendARA_Status_01()
{
    if( getValue( eChangeARA_Status_01))
    {
        if( getValue( eDlcOnceARA_Status_01 ) || getValue( eDlcWrongARA_Status_01 ))
        {
            putValue( eDlcOnceARA_Status_01, 0 );
            _mARA_Status_01.DLC = getValue( eDlcARA_Status_01 );
        }
        else
        {
            _mARA_Status_01.DLC = 8;
        }
    }
    else
    {
        _mARA_Status_01.DLC = 8;
    }

    output( _mARA_Status_01 );
    cancelTimer( _tARA_Status_01 );
    if( getValue( eTARA_Status_01 ) > 0)  setTimer( _tARA_Status_01, getValue( eTARA_Status_01 ) );  else  setTimer( _tARA_Status_01, 1 );
}

ARA_Status_01Changed()
{
}

on envVar eARA_Aktiver_GrafikmodusS
{
    putValue( KCAN_ARA_Aktiver_Grafikmodus, getValue( this ) );
}

on envVar KCAN_ARA_Aktiver_Grafikmodus
{
    _mARA_Status_01.ARA_Aktiver_Grafikmodus.phys = getValue( this );
    ARA_Status_01Changed();
}

on envVar KCAN_ARA_Anf_Meldungen
{
    _mARA_Status_01.ARA_Anf_Meldungen.phys = getValue( this );
    ARA_Status_01Changed();
}

on envVar eARA_BremsfussS
{
    putValue( KCAN_ARA_Bremsfuss, getValue( this ) );
}

on envVar KCAN_ARA_Bremsfuss
{
    _mARA_Status_01.ARA_Bremsfuss.phys = getValue( this );
    ARA_Status_01Changed();
}

on envVar eARA_Deaktivierung_sperrenS
{
    putValue( KCAN_ARA_Deaktivierung_sperren, getValue( this ) );
}

on envVar KCAN_ARA_Deaktivierung_sperren
{
    _mARA_Status_01.ARA_Deaktivierung_sperren.phys = getValue( this );
    ARA_Status_01Changed();
}

on envVar eARA_Knickwinkel_IstS
{
    putValue( KCAN_ARA_Knickwinkel_Ist, getValue( this ) );
}

on envVar KCAN_ARA_Knickwinkel_Ist
{
    _mARA_Status_01.ARA_Knickwinkel_Ist.phys = getValue( this );
    ARA_Status_01Changed();
}

on envVar eARA_Knickwinkel_KomfortS
{
    putValue( KCAN_ARA_Knickwinkel_Komfort, getValue( this ) );
}

on envVar KCAN_ARA_Knickwinkel_Komfort
{
    _mARA_Status_01.ARA_Knickwinkel_Komfort.phys = getValue( this );
    ARA_Status_01Changed();
}

on envVar eARA_Knickwinkel_konfidenzS
{
    putValue( KCAN_ARA_Knickwinkel_konfidenz, getValue( this ) );
}

on envVar KCAN_ARA_Knickwinkel_konfidenz
{
    _mARA_Status_01.ARA_Knickwinkel_konfidenz.phys = getValue( this );
    ARA_Status_01Changed();
}

on envVar eARA_Knickwinkel_MaxS
{
    putValue( KCAN_ARA_Knickwinkel_Max, getValue( this ) );
}

on envVar KCAN_ARA_Knickwinkel_Max
{
    _mARA_Status_01.ARA_Knickwinkel_Max.phys = getValue( this );
    ARA_Status_01Changed();
}

on envVar eARA_Knickwinkel_SollS
{
    putValue( KCAN_ARA_Knickwinkel_Soll, getValue( this ) );
}

on envVar KCAN_ARA_Knickwinkel_Soll
{
    _mARA_Status_01.ARA_Knickwinkel_Soll.phys = getValue( this );
    ARA_Status_01Changed();
}

on envVar eARA_ModusS
{
    putValue( KCAN_ARA_Modus, getValue( this ) );
}

on envVar KCAN_ARA_Modus
{
    _mARA_Status_01.ARA_Modus.phys = getValue( this );
    ARA_Status_01Changed();
}

on envVar eARA_Modus_AnfS
{
    putValue( KCAN_ARA_Modus_Anf, getValue( this ) );
}

on envVar KCAN_ARA_Modus_Anf
{
    _mARA_Status_01.ARA_Modus_Anf.phys = getValue( this );
    ARA_Status_01Changed();
}

on envVar eARA_Sensor_AktivierungS
{
    putValue( KCAN_ARA_Sensor_Aktivierung, getValue( this ) );
}

on envVar KCAN_ARA_Sensor_Aktivierung
{
    _mARA_Status_01.ARA_Sensor_Aktivierung.phys = getValue( this );
    ARA_Status_01Changed();
}

on envVar eARA_StatusS
{
    putValue( KCAN_ARA_Status, getValue( this ) );
}

on envVar KCAN_ARA_Status
{
    _mARA_Status_01.ARA_Status.phys = getValue( this );
    ARA_Status_01Changed();
}

on envVar eARA_TexteS
{
    putValue( KCAN_ARA_Texte, getValue( this ) );
}

on envVar KCAN_ARA_Texte
{
    _mARA_Status_01.ARA_Texte.phys = getValue( this );
    ARA_Status_01Changed();
}

on Timer _tAWV_02
{
    if( getValue( eTAWV_02 ) <= 0)  putValue( eSendAWV_02, 0 );
    if( ( getValue( eSendEnabled ) && getValue( eSendAWV_02 )) || getValue( eDlcOnceAWV_02 ))  sendAWV_02();
}

on envVar eSendAWV_02
{
    if( getValue( eSendEnabled ) && getValue( eSendAWV_02 ))  sendAWV_02();
}

on envVar eTimeoutAWV_02
{
    cancelTimer( _tAWV_02 );
    cancelTimer( _totAWV_02 );
    if( getValue( this ))
        setTimer( _totAWV_02, ( getValue( eSendEnabled ) && getValue( eSendAWV_02 ) && ( getValue( eTOTAWV_02 ) > 0)) ? getValue( eTOTAWV_02 ) : 1 );
    else
        if( getValue( eSendEnabled ) && getValue( eSendAWV_02 ))  sendAWV_02();
}

on Timer _totAWV_02
{
    putValue( eTimeoutAWV_02, 0 );
}

on envVar eDlcOnceAWV_02
{
    if( getValue( eDlcOnceAWV_02 ) && !( getValue( eSendEnabled ) && getValue( eSendAWV_02 )))  setTimer( _tAWV_02, 1 );
}

void sendAWV_02()
{
    if( getValue( eChangeAWV_02))
    {
        if( getValue( eDlcOnceAWV_02 ) || getValue( eDlcWrongAWV_02 ))
        {
            putValue( eDlcOnceAWV_02, 0 );
            _mAWV_02.DLC = getValue( eDlcAWV_02 );
        }
        else
        {
            _mAWV_02.DLC = 8;
        }
    }
    else
    {
        _mAWV_02.DLC = 8;
    }

    output( _mAWV_02 );
    cancelTimer( _tAWV_02 );
    if( getValue( eTAWV_02 ) > 0)  setTimer( _tAWV_02, getValue( eTAWV_02 ) );  else  setTimer( _tAWV_02, 1 );
}

AWV_02Changed()
{
}

on envVar eAWV_AW_AbstandS
{
    putValue( KCAN_AWV_AW_Abstand, getValue( this ) );
}

on envVar KCAN_AWV_AW_Abstand
{
    _mAWV_02.AWV_AW_Abstand.phys = getValue( this );
    AWV_02Changed();
}

on envVar eAWV_AW_TexteS
{
    putValue( KCAN_AWV_AW_Texte, getValue( this ) );
}

on envVar KCAN_AWV_AW_Texte
{
    _mAWV_02.AWV_AW_Texte.phys = getValue( this );
    AWV_02Changed();
}

on envVar eAWV_AW_Texte_ZusatzanzeigeS
{
    putValue( KCAN_AWV_AW_Texte_Zusatzanzeige, getValue( this ) );
}

on envVar KCAN_AWV_AW_Texte_Zusatzanzeige
{
    _mAWV_02.AWV_AW_Texte_Zusatzanzeige.phys = getValue( this );
    AWV_02Changed();
}

on envVar eAWV_AW_ZeitlueckeS
{
    putValue( KCAN_AWV_AW_Zeitluecke, getValue( this ) );
}

on envVar KCAN_AWV_AW_Zeitluecke
{
    _mAWV_02.AWV_AW_Zeitluecke.phys = getValue( this );
    AWV_02Changed();
}

on envVar eAWV_Einstellung_System_FSGS
{
    putValue( KCAN_AWV_Einstellung_System_FSG, getValue( this ) );
}

on envVar KCAN_AWV_Einstellung_System_FSG
{
    _mAWV_02.AWV_Einstellung_System_FSG.phys = getValue( this );
    AWV_02Changed();
}

on envVar eAWV_Einstellung_Warnung_FSGS
{
    putValue( KCAN_AWV_Einstellung_Warnung_FSG, getValue( this ) );
}

on envVar KCAN_AWV_Einstellung_Warnung_FSG
{
    _mAWV_02.AWV_Einstellung_Warnung_FSG.phys = getValue( this );
    AWV_02Changed();
}

on envVar KCAN_AWV_Kamera_Objekt_ID
{
    _mAWV_02.AWV_Kamera_Objekt_ID.phys = getValue( this );
    AWV_02Changed();
}

on envVar eAWV_LED_LeisteS
{
    putValue( KCAN_AWV_LED_Leiste, getValue( this ) );
}

on envVar KCAN_AWV_LED_Leiste
{
    _mAWV_02.AWV_LED_Leiste.phys = getValue( this );
    AWV_02Changed();
}

on envVar eAWV_PriowarnungS
{
    putValue( KCAN_AWV_Priowarnung, getValue( this ) );
}

on envVar KCAN_AWV_Priowarnung
{
    _mAWV_02.AWV_Priowarnung.phys = getValue( this );
    AWV_02Changed();
}

on envVar eAWV_Status_AnzeigeS
{
    putValue( KCAN_AWV_Status_Anzeige, getValue( this ) );
}

on envVar KCAN_AWV_Status_Anzeige
{
    _mAWV_02.AWV_Status_Anzeige.phys = getValue( this );
    AWV_02Changed();
}

on envVar eAWV_TexteS
{
    putValue( KCAN_AWV_Texte, getValue( this ) );
}

on envVar KCAN_AWV_Texte
{
    _mAWV_02.AWV_Texte.phys = getValue( this );
    AWV_02Changed();
}

on envVar eAWV_WarnlevelS
{
    putValue( KCAN_AWV_Warnlevel, getValue( this ) );
}

on envVar KCAN_AWV_Warnlevel
{
    _mAWV_02.AWV_Warnlevel.phys = getValue( this );
    AWV_02Changed();
}

on envVar eAWV_WarnungS
{
    putValue( KCAN_AWV_Warnung, getValue( this ) );
}

on envVar KCAN_AWV_Warnung
{
    _mAWV_02.AWV_Warnung.phys = getValue( this );
    AWV_02Changed();
}

on Timer _tBEM_02
{
    if( getValue( eTBEM_02 ) <= 0)  putValue( eSendBEM_02, 0 );
    if( ( getValue( eSendEnabled ) && getValue( eSendBEM_02 )) || getValue( eDlcOnceBEM_02 ))  sendBEM_02();
}

on envVar eSendBEM_02
{
    if( getValue( eSendEnabled ) && getValue( eSendBEM_02 ))  sendBEM_02();
}

on envVar eTimeoutBEM_02
{
    cancelTimer( _tBEM_02 );
    cancelTimer( _totBEM_02 );
    if( getValue( this ))
        setTimer( _totBEM_02, ( getValue( eSendEnabled ) && getValue( eSendBEM_02 ) && ( getValue( eTOTBEM_02 ) > 0)) ? getValue( eTOTBEM_02 ) : 1 );
    else
        if( getValue( eSendEnabled ) && getValue( eSendBEM_02 ))  sendBEM_02();
}

on Timer _totBEM_02
{
    putValue( eTimeoutBEM_02, 0 );
}

on envVar eDlcOnceBEM_02
{
    if( getValue( eDlcOnceBEM_02 ) && !( getValue( eSendEnabled ) && getValue( eSendBEM_02 )))  setTimer( _tBEM_02, 1 );
}

void sendBEM_02()
{
    if( getValue( eChangeBEM_02 ))
    {
        if( getValue( eDlcOnceBEM_02 ) || getValue( eDlcWrongBEM_02 ))
        {
            putValue( eDlcOnceBEM_02, 0 );
            _mBEM_02.DLC = getValue( eDlcBEM_02 );
        }
        else
        {
            _mBEM_02.DLC = 8;
        }
    }
    else
    {
        _mBEM_02.DLC = 8;
    }

    output( _mBEM_02 );
    cancelTimer( _tBEM_02 );
    if( getValue( eTBEM_02 ) > 0)  setTimer( _tBEM_02, getValue( eTBEM_02 ) );  else  setTimer( _tBEM_02, 1 );
}

BEM_02Changed()
{
}

on envVar eBEM_02_AbschaltstufenS
{
    putValue( KCAN_BEM_02_Abschaltstufen, getValue( this ) );
}

on envVar KCAN_BEM_02_Abschaltstufen
{
    _mBEM_02.BEM_02_Abschaltstufen.phys = getValue( this );
    BEM_02Changed();
}

on envVar KCAN_BEM_Anf_KL15_schalten
{
    _mBEM_02.BEM_Anf_KL15_schalten.phys = getValue( this );
    BEM_02Changed();
}

on envVar eBEM_Batt_AbS
{
    putValue( KCAN_BEM_Batt_Ab, getValue( this ) );
}

on envVar KCAN_BEM_Batt_Ab
{
    _mBEM_02.BEM_Batt_Ab.phys = getValue( this );
    BEM_02Changed();
}

on envVar eBEM_BatteriediagnoseS
{
    putValue( KCAN_BEM_Batteriediagnose, getValue( this ) );
}

on envVar KCAN_BEM_Batteriediagnose
{
    _mBEM_02.BEM_Batteriediagnose.phys = getValue( this );
    BEM_02Changed();
}

on envVar eBEM_DFMS
{
    putValue( KCAN_BEM_DFM, getValue( this ) );
}

on envVar KCAN_BEM_DFM
{
    _mBEM_02.BEM_DFM.phys = getValue( this );
    BEM_02Changed();
}

on envVar eBEM_EMLIN_ungueltigS
{
    putValue( KCAN_BEM_EMLIN_ungueltig, getValue( this ) );
}

on envVar KCAN_BEM_EMLIN_ungueltig
{
    _mBEM_02.BEM_EMLIN_ungueltig.phys = getValue( this );
    BEM_02Changed();
}

on envVar eBEM_GeneratordiagnoseS
{
    putValue( KCAN_BEM_Generatordiagnose, getValue( this ) );
}

on envVar KCAN_BEM_Generatordiagnose
{
    _mBEM_02.BEM_Generatordiagnose.phys = getValue( this );
    BEM_02Changed();
}

on envVar eBEM_HL_KontingentierungS
{
    putValue( KCAN_BEM_HL_Kontingentierung, getValue( this ) );
}

on envVar KCAN_BEM_HL_Kontingentierung
{
    _mBEM_02.BEM_HL_Kontingentierung.phys = getValue( this );
    BEM_02Changed();
}

on envVar eBEM_HL_Regelung_StatusS
{
    putValue( KCAN_BEM_HL_Regelung_Status, getValue( this ) );
}

on envVar KCAN_BEM_HL_Regelung_Status
{
    _mBEM_02.BEM_HL_Regelung_Status.phys = getValue( this );
    BEM_02Changed();
}

on envVar eBEM_LadezustandS
{
    putValue( KCAN_BEM_Ladezustand, getValue( this ) );
}

on envVar KCAN_BEM_Ladezustand
{
    _mBEM_02.BEM_Ladezustand.phys = getValue( this );
    BEM_02Changed();
}

on envVar eBEM_MMI_VorwarnungS
{
    putValue( KCAN_BEM_MMI_Vorwarnung, getValue( this ) );
}

on envVar KCAN_BEM_MMI_Vorwarnung
{
    _mBEM_02.BEM_MMI_Vorwarnung.phys = getValue( this );
    BEM_02Changed();
}

on envVar eBEM_Red_InnengeblaeseS
{
    putValue( KCAN_BEM_Red_Innengeblaese, getValue( this ) );
}

on envVar KCAN_BEM_Red_Innengeblaese
{
    _mBEM_02.BEM_Red_Innengeblaese.phys = getValue( this );
    BEM_02Changed();
}

on envVar eBEM_REK_aktivS
{
    putValue( KCAN_BEM_REK_aktiv, getValue( this ) );
}

on envVar KCAN_BEM_REK_aktiv
{
    _mBEM_02.BEM_REK_aktiv.phys = getValue( this );
    BEM_02Changed();
}

on envVar eBEM_STH_EinschaltverbotS
{
    putValue( KCAN_BEM_STH_Einschaltverbot, getValue( this ) );
}

on envVar KCAN_BEM_STH_Einschaltverbot
{
    _mBEM_02.BEM_STH_Einschaltverbot.phys = getValue( this );
    BEM_02Changed();
}

on envVar eBEM_STH_ZielzeitS
{
    putValue( KCAN_BEM_STH_Zielzeit, getValue( this ) );
}

on envVar KCAN_BEM_STH_Zielzeit
{
    _mBEM_02.BEM_STH_Zielzeit.phys = getValue( this );
    BEM_02Changed();
}

on envVar eBEM_UBDMS
{
    putValue( KCAN_BEM_UBDM, getValue( this ) );
}

on envVar KCAN_BEM_UBDM
{
    _mBEM_02.BEM_UBDM.phys = getValue( this );
    BEM_02Changed();
}

on envVar eBEM_UGenSollS
{
    putValue( KCAN_BEM_UGenSoll, getValue( this ) );
}

on envVar KCAN_BEM_UGenSoll
{
    _mBEM_02.BEM_UGenSoll.phys = getValue( this );
    BEM_02Changed();
}

on envVar KCAN_MIB_Stromsparmodus
{
    _mBEM_02.MIB_Stromsparmodus.phys = getValue( this );
    BEM_02Changed();
}

on envVar KCAN_NVEM_Anf_SD_schalten
{
    _mBEM_02.NVEM_Anf_SD_schalten.phys = getValue( this );
    BEM_02Changed();
}

on envVar eNVEM_Batterie_ServiceS
{
    putValue( KCAN_NVEM_Batterie_Service, getValue( this ) );
}

on envVar KCAN_NVEM_Batterie_Service
{
    _mBEM_02.NVEM_Batterie_Service.phys = getValue( this );
    BEM_02Changed();
}

on envVar KCAN_NVEM_Freigabe_OnlineUpdate
{
    _mBEM_02.NVEM_Freigabe_OnlineUpdate.phys = getValue( this );
    BEM_02Changed();
}

on envVar KCAN_NVEM_Freigabe_ZusBatt_Laden
{
    _mBEM_02.NVEM_Freigabe_ZusBatt_Laden.phys = getValue( this );
    BEM_02Changed();
}

on envVar KCAN_NVEM_Verbraucherabsch_Anz
{
    _mBEM_02.NVEM_Verbraucherabsch_Anz.phys = getValue( this );
    BEM_02Changed();
}

on Timer _tBEM_06
{
    if( getValue( eTBEM_06 ) <= 0)  putValue( eSendBEM_06, 0 );
    if( ( getValue( eSendEnabled ) && getValue( eSendBEM_06 )) || getValue( eDlcOnceBEM_06 ))  sendBEM_06();
}

on envVar eSendBEM_06
{
    if( getValue( eSendEnabled ) && getValue( eSendBEM_06 ))  sendBEM_06();
}

on envVar eTimeoutBEM_06
{
    cancelTimer( _tBEM_06 );
    cancelTimer( _totBEM_06 );
    if( getValue( this ))
        setTimer( _totBEM_06, ( getValue( eSendEnabled ) && getValue( eSendBEM_06 ) && ( getValue( eTOTBEM_06 ) > 0)) ? getValue( eTOTBEM_06 ) : 1 );
    else
        if( getValue( eSendEnabled ) && getValue( eSendBEM_06 ))  sendBEM_06();
}

on Timer _totBEM_06
{
    putValue( eTimeoutBEM_06, 0 );
}

on envVar eDlcOnceBEM_06
{
    if( getValue( eDlcOnceBEM_06 ) && !( getValue( eSendEnabled ) && getValue( eSendBEM_06 )))  setTimer( _tBEM_06, 1 );
}

void sendBEM_06()
{
    byte crc;
    dword bz;
    int hw;
    byte dlc;

    if( getValue( eChangeBEM_06 ))
    {
        if( getValue( eDlcOnceBEM_06 ) || getValue( eDlcWrongBEM_06 ))
        {
            putValue( eDlcOnceBEM_06, 0 );
            _mBEM_06.DLC = getValue( eDlcBEM_06 );
        }
        else
        {
            if( getValue( eBEM_06_ChngDLCEnabled ))
            {
                dlc = getValue( eBEM_06_ChngDLCData );
                if(dlc>0)
                {
                    dlc--;
                    putValue( eBEM_06_ChngDLCData, dlc );
                    _mBEM_06.DLC = getValue( eDlcBEM_06 );
                }
                else
                {
                    putValue( eBEM_06_ChngDLCData, 0 );
                    _mBEM_06.DLC = 8;
                }
            }
            else
            {
              _mBEM_06.DLC = 8;
            }
        }
        if( getValue( eBEM_06_BZS_SingleJumpEnabled ))
        {
            putValue( eBEM_06_BZS_SingleJumpEnabled,0);
            _mBEM_06.BEM_06_BZ=(_mBEM_06.BEM_06_BZ + getValue( eBEM_06_BZS_SingleJumpData))&0xf;
        }
        if( getValue( eBEM_06_BZS_ResetJumpEnabled ))
        {

            if( getValue( eBEM_06_BZS_ResetJumpData)==_mBEM_06.BEM_06_BZ)
            {
                putValue( eBEM_06_BZS_ResetJumpEnabled,0);
                _mBEM_06.BEM_06_BZ=0;
                putValue( eBEM_06_BZS,15);
            }
        }
        crc = getCRC8( _mBEM_06, _s_pdu_codeBEM_06 );
        if( getValue( eBEM_06_CRC_FalseEnabled ))
        {
            crc=~crc;
            hw = getValue( eBEM_06_CRC_FalseData );
            if( hw )
            {
                hw--;
                putValue( eBEM_06_CRC_FalseData, hw );
            }
            if( hw == 0 )
            {
                putValue( eBEM_06_CRC_FalseEnabled,0);
            }
        }
        _mBEM_06.BEM_06_CRC = crc ^ (1 - getValue( eCrcBEM_06 ));

        if( getValue( eBZBEM_06 ))
        {
            bz = getValue( eBEM_06_BZS );
            bz = bz + getValue( eBZStepBEM_06 );
            putValue( eBEM_06_BZS, bz % 16 );
        }
    }
    else
    {
        _mBEM_06.DLC = 8;

        crc = getCRC8( _mBEM_06, _s_pdu_codeBEM_06 );
        _mBEM_06.BEM_06_CRC = crc ^ (1 - getValue( eCrcBEM_06 ));

        bz = getValue( eBEM_06_BZS ) + 1;
        putValue( eBEM_06_BZS, bz % 16 );
    }

    if( getValue( eBEM_06_NoMsgEnabled ))
    {
        hw = getValue( eBEM_06_NoMsgEnabledData );
        if( hw )
        {
            hw--;
            putValue( eBEM_06_NoMsgEnabledData, hw );
        }
        if( hw == 0 )
        {
            putValue( eBEM_06_NoMsgEnabled,0);
        }
    }
    else
    {
        output( _mBEM_06 );
    }

    cancelTimer( _tBEM_06 );
    if( getValue( eTBEM_06 ) > 0)  setTimer( _tBEM_06, getValue( eTBEM_06 ) );  else  setTimer( _tBEM_06, 1 );
}

BEM_06Changed()
{
}

on envVar eBEM_06_BZS
{
    putValue( KCAN_BEM_06_BZ, getValue( this ) );
}

on envVar KCAN_BEM_06_BZ
{
    _mBEM_06.BEM_06_BZ.phys = getValue( this );
    BEM_06Changed();
}

on envVar eBEM_06_CRCS
{
    putValue( KCAN_BEM_06_CRC, getValue( this ) );
}

on envVar KCAN_BEM_06_CRC
{
    _mBEM_06.BEM_06_CRC.phys = getValue( this );
    BEM_06Changed();
}

on envVar eNVEM_BordnetzdiagnoseS
{
    putValue( KCAN_NVEM_Bordnetzdiagnose, getValue( this ) );
}

on envVar KCAN_NVEM_Bordnetzdiagnose
{
    _mBEM_06.NVEM_Bordnetzdiagnose.phys = getValue( this );
    BEM_06Changed();
}

on envVar KCAN_NVEM_Energie_Klima_Vorgabe
{
    _mBEM_06.NVEM_Energie_Klima_Vorgabe.phys = getValue( this );
    BEM_06Changed();
}

on envVar KCAN_NVEM_Last_Anf
{
    _mBEM_06.NVEM_Last_Anf.phys = getValue( this );
    BEM_06Changed();
}

on envVar KCAN_NVEM_PTC_Sollstufe
{
    _mBEM_06.NVEM_PTC_Sollstufe.phys = getValue( this );
    BEM_06Changed();
}

on envVar KCAN_NVEM_Red_KomfortVerbrauch
{
    _mBEM_06.NVEM_Red_KomfortVerbrauch.phys = getValue( this );
    BEM_06Changed();
}

on envVar KCAN_NVEM_STH_ZielzeitLang
{
    _mBEM_06.NVEM_STH_ZielzeitLang.phys = getValue( this );
    BEM_06Changed();
}

on Timer _tBMS_05
{
    if( getValue( eTBMS_05 ) <= 0)  putValue( eSendBMS_05, 0 );
    if( ( getValue( eSendEnabled ) && getValue( eSendBMS_05 )) || getValue( eDlcOnceBMS_05 ))  sendBMS_05();
}

on envVar eSendBMS_05
{
    if( getValue( eSendEnabled ) && getValue( eSendBMS_05 ))  sendBMS_05();
}

on envVar eTimeoutBMS_05
{
    cancelTimer( _tBMS_05 );
    cancelTimer( _totBMS_05 );
    if( getValue( this ))
        setTimer( _totBMS_05, ( getValue( eSendEnabled ) && getValue( eSendBMS_05 ) && ( getValue( eTOTBMS_05 ) > 0)) ? getValue( eTOTBMS_05 ) : 1 );
    else
        if( getValue( eSendEnabled ) && getValue( eSendBMS_05 ))  sendBMS_05();
}

on Timer _totBMS_05
{
    putValue( eTimeoutBMS_05, 0 );
}

on envVar eDlcOnceBMS_05
{
    if( getValue( eDlcOnceBMS_05 ) && !( getValue( eSendEnabled ) && getValue( eSendBMS_05 )))  setTimer( _tBMS_05, 1 );
}

void sendBMS_05()
{

    if( getValue( eBMS_Rekuperation_calcConsumption_button)==0x01)
    {
      calculateConsumption_BMS_Recuperation();
    }
    if( getValue( eBMS_Verbrauch_calcConsumption_button)==0x01)
    {
      calculateConsumption_BMS();
    }

    if( getValue( eChangeBMS_05 ))
    {
        if( getValue( eDlcOnceBMS_05 ) || getValue( eDlcWrongBMS_05 ))
        {
            putValue( eDlcOnceBMS_05, 0 );
            _mBMS_05.DLC = getValue( eDlcBMS_05 );
        }
        else
        {
            _mBMS_05.DLC = 8;
        }
    }
    else
    {
        _mBMS_05.DLC = 8;
    }

    output( _mBMS_05 );
    cancelTimer( _tBMS_05 );
    if( getValue( eTBMS_05 ) > 0)  setTimer( _tBMS_05, getValue( eTBMS_05 ) );  else  setTimer( _tBMS_05, 1 );
}

BMS_05Changed()
{
}

on envVar KCAN_BMS_As_Entladezaehler
{
    _mBMS_05.BMS_As_Entladezaehler.phys = getValue( this );
    BMS_05Changed();
}

on envVar KCAN_BMS_As_Entladezaehler_Ueberlauf
{
    _mBMS_05.BMS_As_Entladezaehler_Ueberlauf.phys = getValue( this );
    BMS_05Changed();
}

on envVar eBMS_RekuperationS
{
    putValue( KCAN_BMS_Rekuperation, getValue( this ) );
}

on envVar KCAN_BMS_Rekuperation
{
    _mBMS_05.BMS_Rekuperation.phys = getValue( this );
    BMS_05Changed();
}

on envVar eBMS_Rekuperation_UeberlaufS
{
    putValue( KCAN_BMS_Rekuperation_Ueberlauf, getValue( this ) );
}

on envVar KCAN_BMS_Rekuperation_Ueberlauf
{
    _mBMS_05.BMS_Rekuperation_Ueberlauf.phys = getValue( this );
    BMS_05Changed();
}

on envVar eBMS_VerbrauchS
{
    putValue( KCAN_BMS_Verbrauch, getValue( this ) );
}

on envVar KCAN_BMS_Verbrauch
{
    _mBMS_05.BMS_Verbrauch.phys = getValue( this );
    BMS_05Changed();
}

on envVar eBMS_Verbrauch_UeberlaufS
{
    putValue( KCAN_BMS_Verbrauch_Ueberlauf, getValue( this ) );
}

on envVar KCAN_BMS_Verbrauch_Ueberlauf
{
    _mBMS_05.BMS_Verbrauch_Ueberlauf.phys = getValue( this );
    BMS_05Changed();
}

on Timer _tBMS_06
{
    if( getValue( eTBMS_06 ) <= 0)  putValue( eSendBMS_06, 0 );
    if( ( getValue( eSendEnabled ) && getValue( eSendBMS_06 )) || getValue( eDlcOnceBMS_06 ))  sendBMS_06();
}

on envVar eSendBMS_06
{
    if( getValue( eSendEnabled ) && getValue( eSendBMS_06 ))  sendBMS_06();
}

on envVar eTimeoutBMS_06
{
    cancelTimer( _tBMS_06 );
    cancelTimer( _totBMS_06 );
    if( getValue( this ))
        setTimer( _totBMS_06, ( getValue( eSendEnabled ) && getValue( eSendBMS_06 ) && ( getValue( eTOTBMS_06 ) > 0)) ? getValue( eTOTBMS_06 ) : 1 );
    else
        if( getValue( eSendEnabled ) && getValue( eSendBMS_06 ))  sendBMS_06();
}

on Timer _totBMS_06
{
    putValue( eTimeoutBMS_06, 0 );
}

on envVar eDlcOnceBMS_06
{
    if( getValue( eDlcOnceBMS_06 ) && !( getValue( eSendEnabled ) && getValue( eSendBMS_06 )))  setTimer( _tBMS_06, 1 );
}

void sendBMS_06()
{
    if( getValue( eChangeBMS_06 ))
    {
        if( getValue( eDlcOnceBMS_06 ) || getValue( eDlcWrongBMS_06 ))
        {
            putValue( eDlcOnceBMS_06, 0 );
            _mBMS_06.DLC = getValue( eDlcBMS_06 );
        }
        else
        {
            _mBMS_06.DLC = 8;
        }
    }
    else
    {
        _mBMS_06.DLC = 8;
    }

    output( _mBMS_06 );
    cancelTimer( _tBMS_06 );
    if( getValue( eTBMS_06 ) > 0)  setTimer( _tBMS_06, getValue( eTBMS_06 ) );  else  setTimer( _tBMS_06, 1 );
}

BMS_06Changed()
{
}

on envVar KCAN_BMS_Fehler_NTKreis_BMS_06
{
    _mBMS_06.BMS_Fehler_NTKreis.phys = getValue( this );
    BMS_06Changed();
}

on envVar KCAN_BMS_Fehlerstatus_EWP
{
    _mBMS_06.BMS_Fehlerstatus_EWP.phys = getValue( this );
    BMS_06Changed();
}

on envVar KCAN_BMS_IstRuecklaufTemperatur_02
{
    _mBMS_06.BMS_IstRuecklaufTemperatur_02.phys = getValue( this );
    BMS_06Changed();
}

on envVar KCAN_BMS_IstVorlaufTemperatur
{
    _mBMS_06.BMS_IstVorlaufTemperatur.phys = getValue( this );
    BMS_06Changed();
}

on envVar KCAN_BMS_Notfallkuehlung
{
    _mBMS_06.BMS_Notfallkuehlung.phys = getValue( this );
    BMS_06Changed();
}

on envVar KCAN_BMS_Soll_PWM_Pumpe
{
    _mBMS_06.BMS_Soll_PWM_Pumpe.phys = getValue( this );
    BMS_06Changed();
}

on envVar KCAN_BMS_SollVolumenstrom
{
    _mBMS_06.BMS_SollVolumenstrom.phys = getValue( this );
    BMS_06Changed();
}

on envVar KCAN_BMS_SollVorlauftemperatur_BMS_06
{
    _mBMS_06.BMS_SollVorlauftemperatur.phys = getValue( this );
    BMS_06Changed();
}

on envVar KCAN_BMS_Status_Ventil
{
    _mBMS_06.BMS_Status_Ventil.phys = getValue( this );
    BMS_06Changed();
}

on envVar KCAN_BMS_Temp_Epsilon
{
    _mBMS_06.BMS_Temp_Epsilon.phys = getValue( this );
    BMS_06Changed();
}

on envVar KCAN_BMS_Temperatur_BMS_06
{
    _mBMS_06.BMS_Temperatur.phys = getValue( this );
    BMS_06Changed();
}

on envVar KCAN_BMS_Temperierung_Anf_BMS_06
{
    _mBMS_06.BMS_Temperierung_Anf.phys = getValue( this );
    BMS_06Changed();
}

on Timer _tBMS_07
{
    if( getValue( eTBMS_07 ) <= 0)  putValue( eSendBMS_07, 0 );
    if( ( getValue( eSendEnabled ) && getValue( eSendBMS_07 )) || getValue( eDlcOnceBMS_07 ))  sendBMS_07();
}

on envVar eSendBMS_07
{
    if( getValue( eSendEnabled ) && getValue( eSendBMS_07 ))  sendBMS_07();
}

on envVar eTimeoutBMS_07
{
    cancelTimer( _tBMS_07 );
    cancelTimer( _totBMS_07 );
    if( getValue( this ))
        setTimer( _totBMS_07, ( getValue( eSendEnabled ) && getValue( eSendBMS_07 ) && ( getValue( eTOTBMS_07 ) > 0)) ? getValue( eTOTBMS_07 ) : 1 );
    else
        if( getValue( eSendEnabled ) && getValue( eSendBMS_07 ))  sendBMS_07();
}

on Timer _totBMS_07
{
    putValue( eTimeoutBMS_07, 0 );
}

on envVar eDlcOnceBMS_07
{
    if( getValue( eDlcOnceBMS_07 ) && !( getValue( eSendEnabled ) && getValue( eSendBMS_07 )))  setTimer( _tBMS_07, 1 );
}

void sendBMS_07()
{
    byte crc;
    dword bz;
    int hw;
    byte dlc;

    if( getValue( eChangeBMS_07))
    {
        if( getValue( eDlcOnceBMS_07 ) || getValue( eDlcWrongBMS_07 ))
        {
            putValue( eDlcOnceBMS_07, 0 );
            _mBMS_07.DLC = getValue( eDlcBMS_07 );
        }
        else
        {
            if( getValue( eBMS_07_ChngDLCEnabled ))
            {
                dlc = getValue( eBMS_07_ChngDLCData );
                if(dlc>0)
                {
                    dlc--;
                    putValue( eBMS_07_ChngDLCData, dlc );
                    _mBMS_07.DLC = getValue( eDlcBMS_07 );
                }
                else
                {
                    putValue( eBMS_07_ChngDLCData, 0 );
                    _mBMS_07.DLC = 8;
                }
            }
            else
            {
                _mBMS_07.DLC = 8;
            }
        }
        if( getValue( eBMS_07_BZS_SingleJumpEnabled ))
        {
            putValue( eBMS_07_BZS_SingleJumpEnabled,0);
            _mBMS_07.BMS_07_BZ=(_mBMS_07.BMS_07_BZ + getValue( eBMS_07_BZS_SingleJumpData))&0xf;
        }
        if( getValue( eBMS_07_BZS_ResetJumpEnabled ))
        {

            if( getValue( eBMS_07_BZS_ResetJumpData)==_mBMS_07.BMS_07_BZ)
            {
                putValue( eBMS_07_BZS_ResetJumpEnabled,0);
                _mBMS_07.BMS_07_BZ=0;
                putValue( eBMS_07_BZS,15);
            }
        }
        crc = getCRC8( _mBMS_07, _s_pdu_codeBMS_07 );
        if( getValue( eBMS_07_CRC_FalseEnabled ))
        {

            crc=~crc;
            hw = getValue( eBMS_07_CRC_FalseData );
            if( hw )
            {
                hw--;
                putValue( eBMS_07_CRC_FalseData, hw );
            }
            if( hw == 0 )
            {
                putValue( eBMS_07_CRC_FalseEnabled,0);
            }

        }
        _mBMS_07.BMS_07_CRC = crc ^ (1 - getValue( eCrcBMS_07 ));

        if( getValue( eBZBMS_07 ))
        {
            bz = getValue( eBMS_07_BZS );
            bz = bz + getValue( eBZStepBMS_07 );
            putValue( eBMS_07_BZS, bz % 16 );
        }
    }
    else
    {
        _mBMS_07.DLC = 8;

        crc = getCRC8( _mBMS_07, _s_pdu_codeBMS_07 );
        _mBMS_07.BMS_07_CRC = crc ^ (1 - getValue( eCrcBMS_07 ));

        bz = getValue( eBMS_07_BZS ) + 1;
        putValue( eBMS_07_BZS, bz % 16 );
    }

    if( getValue( eBMS_07_NoMsgEnabled ))
    {
        hw = getValue( eBMS_07_NoMsgEnabledData );
        if( hw )
        {
            hw--;
            putValue( eBMS_07_NoMsgEnabledData, hw );
        }
        if( hw == 0 )
        {
            putValue( eBMS_07_NoMsgEnabled, 0 );
        }
    }
    else
    {
        output( _mBMS_07 );
    }

    cancelTimer( _tBMS_07 );
    if( getValue( eTBMS_07 ) > 0)  setTimer( _tBMS_07, getValue( eTBMS_07 ) );  else  setTimer( _tBMS_07, 1 );
}

BMS_07Changed()
{
}

on envVar eBMS_07_BZS
{
    putValue( KCAN_BMS_07_BZ, getValue( this ) );
}

on envVar KCAN_BMS_07_BZ
{
    _mBMS_07.BMS_07_BZ.phys = getValue( this );
    BMS_07Changed();
}

on envVar eBMS_07_CRCS
{
    putValue( KCAN_BMS_07_CRC, getValue( this ) );
}

on envVar KCAN_BMS_07_CRC
{
    if( getValue( eBMS_07_CRC_ON) == 0x00 )
        _mBMS_07.BMS_07_CRC.phys = getValue( this );
    BMS_07Changed();
}

on envVar eBMS_Ausgleichsladung_AnfS
{
    putValue( KCAN_BMS_Ausgleichsladung_Anf, getValue( this ) );
}

on envVar KCAN_BMS_Ausgleichsladung_Anf
{
    _mBMS_07.BMS_Ausgleichsladung_Anf.phys = getValue( this );
    BMS_07Changed();
}

on envVar KCAN_BMS_Balancing_Aktiv
{
    _mBMS_07.BMS_Balancing_Aktiv.phys = getValue( this );
    BMS_07Changed();
}

on envVar KCAN_BMS_Batteriediagnose
{
    _mBMS_07.BMS_Batteriediagnose.phys = getValue( this );
    BMS_07Changed();
}

on envVar eBMS_EnergieinhaltS
{
    putValue( KCAN_BMS_Energieinhalt, getValue( this ) );
}

on envVar KCAN_BMS_Energieinhalt
{
    _mBMS_07.BMS_Energieinhalt.phys = getValue( this );
    BMS_07Changed();
}

on envVar eBMS_Gesamtst_SpgfreiheitS
{
    putValue( KCAN_BMS_Gesamtst_Spgfreiheit, getValue( this ) );
}

on envVar KCAN_BMS_Gesamtst_Spgfreiheit
{
    _mBMS_07.BMS_Gesamtst_Spgfreiheit.phys = getValue( this );
    BMS_07Changed();
}

on envVar eBMS_Ladevorgang_aktivS
{
    putValue( KCAN_BMS_Ladevorgang_aktiv, getValue( this ) );
}

on envVar KCAN_BMS_Ladevorgang_aktiv
{
    _mBMS_07.BMS_Ladevorgang_aktiv.phys = getValue( this );
    BMS_07Changed();
}

on envVar eBMS_MaxEnergieinhaltS
{
    putValue( KCAN_BMS_MaxEnergieinhalt, getValue( this ) );
}

on envVar KCAN_BMS_MaxEnergieinhalt
{
    _mBMS_07.BMS_MaxEnergieinhalt.phys = getValue( this );
    BMS_07Changed();
}

on envVar KCAN_BMS_RIso_Ext
{
    _mBMS_07.BMS_RIso_Ext.phys = getValue( this );
    BMS_07Changed();
}

on envVar eBMS_Warnanzeige_AnfS
{
    putValue( KCAN_BMS_Warnanzeige_Anf, getValue( this ) );
}

on envVar KCAN_BMS_Warnanzeige_Anf
{
    _mBMS_07.BMS_Warnanzeige_Anf.phys = getValue( this );
    BMS_07Changed();
}

on Timer _tBMS_20
{
    if( getValue( eTBMS_20 ) <= 0)  putValue( eSendBMS_20, 0 );
    if( ( getValue( eSendEnabled ) && getValue( eSendBMS_20 )) || getValue( eDlcOnceBMS_20 ))  sendBMS_20();
}

on envVar eSendBMS_20
{
    if( getValue( eSendEnabled ) && getValue( eSendBMS_20 ))  sendBMS_20();
}

on envVar eTimeoutBMS_20
{
    cancelTimer( _tBMS_20 );
    cancelTimer( _totBMS_20 );
    if( getValue( this ))
        setTimer( _totBMS_20, ( getValue( eSendEnabled ) && getValue( eSendBMS_20 ) && ( getValue( eTOTBMS_20 ) > 0)) ? getValue( eTOTBMS_20 ) : 1 );
    else
        if( getValue( eSendEnabled ) && getValue( eSendBMS_20 ))  sendBMS_20();
}

on Timer _totBMS_20
{
    putValue( eTimeoutBMS_20, 0 );
}

on envVar eDlcOnceBMS_20
{
    if( getValue( eDlcOnceBMS_20 ) && !( getValue( eSendEnabled ) && getValue( eSendBMS_20 )))  setTimer( _tBMS_20, 1 );
}

void sendBMS_20()
{
    if( getValue( eChangeBMS_20 ))
    {
        if( getValue( eDlcOnceBMS_20 ) || getValue( eDlcWrongBMS_20 ))
        {
            putValue( eDlcOnceBMS_20, 0 );
            _mBMS_20.DLC = getValue( eDlcBMS_20 );
        }
        else
        {
            _mBMS_20.DLC = 8;
        }
    }
    else
    {
        _mBMS_20.DLC = 8;
    }

    output( _mBMS_20 );
    cancelTimer( _tBMS_20 );
    if( getValue( eTBMS_20 ) > 0)  setTimer( _tBMS_20, getValue( eTBMS_20 ) );  else  setTimer( _tBMS_20, 1 );
}

BMS_20Changed()
{
}

on envVar KCAN_BMS_20_BZ
{
    _mBMS_20.BMS_20_BZ.phys = getValue( this );
    BMS_20Changed();
}

on envVar KCAN_BMS_20_CRC
{
    _mBMS_20.BMS_20_CRC.phys = getValue( this );
    BMS_20Changed();
}

on envVar KCAN_BMS_ErwGrenzen_aktiv
{
    _mBMS_20.BMS_ErwGrenzen_aktiv.phys = getValue( this );
    BMS_20Changed();
}

on envVar KCAN_BMS_Fehler_HVBattAbschaltung
{
    _mBMS_20.BMS_Fehler_HVBattAbschaltung.phys = getValue( this );
    BMS_20Changed();
}

on envVar KCAN_BMS_Fehler_HVBattAbschaltung_Anf
{
    _mBMS_20.BMS_Fehler_HVBattAbschaltung_Anf.phys = getValue( this );
    BMS_20Changed();
}

on envVar KCAN_BMS_Fehler_Leistungsred
{
    _mBMS_20.BMS_Fehler_Leistungsred.phys = getValue( this );
    BMS_20Changed();
}

on envVar KCAN_BMS_Fehler_Notabschaltung_Crash
{
    _mBMS_20.BMS_Fehler_Notabschaltung_Crash.phys = getValue( this );
    BMS_20Changed();
}

on envVar KCAN_BMS_Fehlerstatus_HV_Schuetze
{
    _mBMS_20.BMS_Fehlerstatus_HV_Schuetze.phys = getValue( this );
    BMS_20Changed();
}

on envVar KCAN_BMS_HVIL_Status
{
    _mBMS_20.BMS_HVIL_Status.phys = getValue( this );
    BMS_20Changed();
}

on envVar KCAN_BMS_IstModus
{
    _mBMS_20.BMS_IstModus.phys = getValue( this );
    BMS_20Changed();
}

on envVar KCAN_BMS_Spannung
{
    _mBMS_20.BMS_Spannung.phys = getValue( this );
    BMS_20Changed();
}

on envVar KCAN_BMS_Spannung_Zwischenkreis
{
    _mBMS_20.BMS_Spannung_Zwischenkreis.phys = getValue( this );
    BMS_20Changed();
}

on envVar KCAN_BMS_Strom
{
    _mBMS_20.BMS_Strom.phys = getValue( this );
    BMS_20Changed();
}

on Timer _tBMS_25
{
    if( getValue( eTBMS_25 ) <= 0)  putValue( eSendBMS_25, 0 );
    if( ( getValue( eSendEnabled ) && getValue( eSendBMS_25 )) || getValue( eDlcOnceBMS_25 ))  sendBMS_25();
}

on envVar eSendBMS_25
{
    if( getValue( eSendEnabled ) && getValue( eSendBMS_25 ))  sendBMS_25();
}

on envVar eTimeoutBMS_25
{
    cancelTimer( _tBMS_25 );
    cancelTimer( _totBMS_25 );
    if( getValue( this ))
        setTimer( _totBMS_25, ( getValue( eSendEnabled ) && getValue( eSendBMS_25 ) && ( getValue( eTOTBMS_25 ) > 0)) ? getValue( eTOTBMS_25 ) : 1 );
    else
        if( getValue( eSendEnabled ) && getValue( eSendBMS_25 ))  sendBMS_25();
}

on Timer _totBMS_25
{
    putValue( eTimeoutBMS_25, 0 );
}

on envVar eDlcOnceBMS_25
{
    if( getValue( eDlcOnceBMS_25 ) && !( getValue( eSendEnabled ) && getValue( eSendBMS_25 )))  setTimer( _tBMS_25, 1 );
}

void sendBMS_25()
{
    if( getValue( eChangeBMS_25 ))
    {
        if( getValue( eDlcOnceBMS_25 ) || getValue( eDlcWrongBMS_25 ))
        {
            putValue( eDlcOnceBMS_25, 0 );
            _mBMS_25.DLC = getValue( eDlcBMS_25 );
        }
        else
        {
            _mBMS_25.DLC = 8;
        }
    }
    else
    {
        _mBMS_25.DLC = 8;
    }

    output( _mBMS_25 );
    cancelTimer( _tBMS_25 );
    if( getValue( eTBMS_25 ) > 0)  setTimer( _tBMS_25, getValue( eTBMS_25 ) );  else  setTimer( _tBMS_25, 1 );
}

BMS_25Changed()
{
}

on envVar KCAN_BMS_BattHeizung_VerbautStatus
{
    _mBMS_25.BMS_BattHeizung_VerbautStatus.phys = getValue( this );
    BMS_25Changed();
}

on envVar KCAN_BMS_Fehler_NTKreis
{
    _mBMS_25.BMS_Fehler_NTKreis.phys = getValue( this );
    BMS_25Changed();
}

on envVar KCAN_BMS_Pumpe1_Ansteuerung
{
    _mBMS_25.BMS_Pumpe1_Ansteuerung.phys = getValue( this );
    BMS_25Changed();
}

on envVar KCAN_BMS_Pumpe2_Ansteuerung
{
    _mBMS_25.BMS_Pumpe2_Ansteuerung.phys = getValue( this );
    BMS_25Changed();
}

on envVar KCAN_BMS_RuecklaufTemperatur
{
    _mBMS_25.BMS_RuecklaufTemperatur.phys = getValue( this );
    BMS_25Changed();
}

on envVar KCAN_BMS_SollVorlauftemperatur
{
    _mBMS_25.BMS_SollVorlauftemperatur.phys = getValue( this );
    BMS_25Changed();
}

on envVar KCAN_BMS_Status_Ventil1
{
    _mBMS_25.BMS_Status_Ventil1.phys = getValue( this );
    BMS_25Changed();
}

on envVar KCAN_BMS_Status_Ventil2
{
    _mBMS_25.BMS_Status_Ventil2.phys = getValue( this );
    BMS_25Changed();
}

on envVar KCAN_BMS_Temperatur
{
    _mBMS_25.BMS_Temperatur.phys = getValue( this );
    BMS_25Changed();
}

on envVar KCAN_BMS_Temperierung_Anf
{
    _mBMS_25.BMS_Temperierung_Anf.phys = getValue( this );
    BMS_25Changed();
}

on envVar KCAN_BMS_VorlaufTemperatur
{
    _mBMS_25.BMS_VorlaufTemperatur.phys = getValue( this );
    BMS_25Changed();
}

on Timer _tCharisma_01
{
}

on Timer _totCharisma_01
{
}

on Timer _tinhCharisma_01
{
    _bsiCharisma_01 = 0;
    if( _bsaiCharisma_01 && getValue( eSendEnabled ))  sendCharisma_01();
}

void sendCharisma_01()
{
}

Charisma_01Changed()
{
}

on Timer _tCharisma_03
{
    if( getValue( eTCharisma_03 ) <= 0)  putValue( eSendCharisma_03, 0 );
    if( ( getValue( eSendEnabled ) && getValue( eSendCharisma_03 )) || getValue( eDlcOnceCharisma_03 ))  sendCharisma_03();
}

on envVar eSendCharisma_03
{
    if( getValue( eSendEnabled ) && getValue( eSendCharisma_03 ))  sendCharisma_03();
}

on envVar eTimeoutCharisma_03
{
    cancelTimer( _tCharisma_03 );
    cancelTimer( _totCharisma_03 );
    if( getValue( this ))
        setTimer( _totCharisma_03, ( getValue( eSendEnabled ) && getValue( eSendCharisma_03 ) && ( getValue( eTOTCharisma_03 ) > 0)) ? getValue( eTOTCharisma_03 ) : 1 );
    else
        if( getValue( eSendEnabled ) && getValue( eSendCharisma_03 ))  sendCharisma_03();
}

on Timer _totCharisma_03
{
    putValue( eTimeoutCharisma_03, 0 );
}

on envVar eDlcOnceCharisma_03
{
    if( getValue( eDlcOnceCharisma_03 ) && !( getValue( eSendEnabled ) && getValue( eSendCharisma_03 )))  setTimer( _tCharisma_03, 1 );
}

on Timer _tinhCharisma_03
{
    _bsiCharisma_03 = 0;
    if( _bsaiCharisma_03 && getValue( eSendEnabled ))  sendCharisma_03();
}

void sendCharisma_03()
{
    if( getValue( eChangeCharisma_03))
    {
        if( getValue( eDlcOnceCharisma_03 ) || getValue( eDlcWrongCharisma_03 ))
        {
            putValue( eDlcOnceCharisma_03, 0 );
            _mCharisma_03.DLC = getValue( eDlcCharisma_03 );
        }
        else
        {
            _mCharisma_03.DLC = 8;
        }
    }
    else
    {
        _mCharisma_03.DLC = 8;
    }

    output( _mCharisma_03 );

    cancelTimer( _tCharisma_03 );
    if( getValue( eTCharisma_03 ) > 0)  setTimer( _tCharisma_03, getValue( eTCharisma_03 ) );  else  setTimer( _tCharisma_03, 1 );
    _bsaiCharisma_03 = 0;
    _bsiCharisma_03 = 1;
    cancelTimer( _tinhCharisma_03 );  setTimer( _tinhCharisma_03, 20 );
}

Charisma_03Changed()
{
    if( getValue( eSendEnabled ) && getValue( eSendCharisma_03 ))
        if( _bsiCharisma_03)
            _bsaiCharisma_03 = 1;
        else
            sendCharisma_03();
}

on envVar eCHA_Charge_LEDS
{
    putValue( KCAN_CHA_Charge_LED, getValue( this ) );
}

on envVar KCAN_CHA_Charge_LED
{
    _mCharisma_03.CHA_Charge_LED.phys = getValue( this );
    Charisma_03Changed();
}

on envVar KCAN_CHA_Charisma_Taste2_LED
{
    _mCharisma_03.CHA_Charisma_Taste2_LED.phys = getValue( this );
    Charisma_03Changed();
}

on envVar eCHA_Current_ModeS
{
    putValue( KCAN_CHA_Current_Mode, getValue( this ) );
}

on envVar KCAN_CHA_Current_Mode
{
    _mCharisma_03.CHA_Current_Mode.phys = getValue( this );
    Charisma_03Changed();
}

on envVar KCAN_CHA_Current_Mode_BMA
{
    _mCharisma_03.CHA_Current_Mode_BMA.phys = getValue( this );
    Charisma_03Changed();
}

on envVar eCHA_Current_Mode_FPAS
{
    putValue( KCAN_CHA_Current_Mode_FPA, getValue( this ) );
}

on envVar KCAN_CHA_Current_Mode_FPA
{
    _mCharisma_03.CHA_Current_Mode_FPA.phys = getValue( this );
    Charisma_03Changed();
}

on envVar eCHA_Eco_Charisma_LEDS
{
    putValue( KCAN_CHA_Eco_Charisma_LED, getValue( this ) );
}

on envVar KCAN_CHA_Eco_Charisma_LED
{
    _mCharisma_03.CHA_Eco_Charisma_LED.phys = getValue( this );
    Charisma_03Changed();
}

on envVar KCAN_CHA_EV_LED
{
    _mCharisma_03.CHA_EV_LED.phys = getValue( this );
    Charisma_03Changed();
}

on envVar KCAN_CHA_Fahrer_Umschaltung_Charisma_03
{
    _mCharisma_03.CHA_Fahrer_Umschaltung.phys = getValue( this );
    Charisma_03Changed();
}

on envVar eCHA_Kombi_TexteS
{
    putValue( KCAN_CHA_Kombi_Texte, getValue( this ) );
}

on envVar KCAN_CHA_Kombi_Texte
{
    _mCharisma_03.CHA_Kombi_Texte.phys = getValue( this );
    Charisma_03Changed();
}

on envVar eCHA_Kombi_Texte_02S
{
    putValue( KCAN_CHA_Kombi_Texte_02, getValue( this ) );
}

on envVar KCAN_CHA_Kombi_Texte_02
{
    _mCharisma_03.CHA_Kombi_Texte_02.phys = getValue( this );
    Charisma_03Changed();
}

on envVar eCHA_Offroad_LEDS
{
    putValue( KCAN_CHA_Offroad_LED, getValue( this ) );
}

on envVar KCAN_CHA_Offroad_LED
{
    _mCharisma_03.CHA_Offroad_LED.phys = getValue( this );
    Charisma_03Changed();
}

on envVar eCHA_Ziel_FahrPr_03_01S
{
    putValue( KCAN_CHA_Ziel_FahrPr_03_01, getValue( this ) );
}

on envVar KCAN_CHA_Ziel_FahrPr_03_01
{
    _mCharisma_03.CHA_Ziel_FahrPr_03_01.phys = getValue( this );
    Charisma_03Changed();
}

on envVar eCHA_Ziel_FahrPr_03_02S
{
    putValue( KCAN_CHA_Ziel_FahrPr_03_02, getValue( this ) );
}

on envVar KCAN_CHA_Ziel_FahrPr_03_02
{
    _mCharisma_03.CHA_Ziel_FahrPr_03_02.phys = getValue( this );
    Charisma_03Changed();
}

on envVar eCHA_Ziel_FahrPr_AMBS
{
    putValue( KCAN_CHA_Ziel_FahrPr_AMB, getValue( this ) );
}

on envVar KCAN_CHA_Ziel_FahrPr_AMB
{
    _mCharisma_03.CHA_Ziel_FahrPr_AMB.phys = getValue( this );
    Charisma_03Changed();
}

on envVar KCAN_CHA_Ziel_FahrPr_HSP
{
    _mCharisma_03.CHA_Ziel_FahrPr_HSP.phys = getValue( this );
    Charisma_03Changed();
}

on envVar eCHA_Ziel_FahrPr_IVBS
{
    putValue( KCAN_CHA_Ziel_FahrPr_IVB, getValue( this ) );
}

on envVar KCAN_CHA_Ziel_FahrPr_IVB
{
    _mCharisma_03.CHA_Ziel_FahrPr_IVB.phys = getValue( this );
    Charisma_03Changed();
}

on envVar eCHA_Ziel_FahrPr_KLS
{
    putValue( KCAN_CHA_Ziel_FahrPr_KL, getValue( this ) );
}

on envVar KCAN_CHA_Ziel_FahrPr_KL
{
    _mCharisma_03.CHA_Ziel_FahrPr_KL.phys = getValue( this );
    Charisma_03Changed();
}

on envVar KCAN_CHA_Ziel_FahrPr_RWB
{
    _mCharisma_03.CHA_Ziel_FahrPr_RWB.phys = getValue( this );
    Charisma_03Changed();
}

on Timer _tDaempfer_01
{
    if( getValue( eTDaempfer_01 ) <= 0)  putValue( eSendDaempfer_01, 0 );
    if( ( getValue( eSendEnabled ) && getValue( eSendDaempfer_01 )) || getValue( eDlcOnceDaempfer_01 ))  sendDaempfer_01();
}

on envVar eSendDaempfer_01
{
    if( getValue( eSendEnabled ) && getValue( eSendDaempfer_01 ))  sendDaempfer_01();
}

on envVar eTimeoutDaempfer_01
{
    cancelTimer( _tDaempfer_01 );
    cancelTimer( _totDaempfer_01 );
    if( getValue( this ))
        setTimer( _totDaempfer_01, ( getValue( eSendEnabled ) && getValue( eSendDaempfer_01 ) && ( getValue( eTOTDaempfer_01 ) > 0)) ? getValue( eTOTDaempfer_01 ) : 1 );
    else
        if( getValue( eSendEnabled ) && getValue( eSendDaempfer_01 ))  sendDaempfer_01();
}

on Timer _totDaempfer_01
{
    putValue( eTimeoutDaempfer_01, 0 );
}

on envVar eDlcOnceDaempfer_01
{
    if( getValue( eDlcOnceDaempfer_01 ) && !( getValue( eSendEnabled ) && getValue( eSendDaempfer_01 )))  setTimer( _tDaempfer_01, 1 );
}

void sendDaempfer_01()
{
    byte crc;
    dword bz;

    if( getValue( eChangeDaempfer_01 ))
    {
        if( getValue( eDlcOnceDaempfer_01 ) || getValue( eDlcWrongDaempfer_01 ))
        {
            putValue( eDlcOnceDaempfer_01, 0 );
            _mDaempfer_01.DLC = getValue( eDlcDaempfer_01 );
        }
        else
        {
            _mDaempfer_01.DLC = 8;
        }
    }
    else
    {
        _mDaempfer_01.DLC = 8;
    }

    output( _mDaempfer_01 );
    cancelTimer( _tDaempfer_01 );
    if( getValue( eTDaempfer_01 ) > 0)  setTimer( _tDaempfer_01, getValue( eTDaempfer_01 ) );  else  setTimer( _tDaempfer_01, 1 );
}

Daempfer_01Changed()
{
}

on envVar eDR_Gelbe_WarnlampeS
{
    putValue( KCAN_DR_Gelbe_Warnlampe, getValue( this ) );
}

on envVar KCAN_DR_Gelbe_Warnlampe
{
    _mDaempfer_01.DR_Gelbe_Warnlampe.phys = getValue( this );
    Daempfer_01Changed();
}

on Timer _tDCDC_02
{
    if( getValue( eTDCDC_02 ) <= 0)  putValue( eSendDCDC_02, 0 );
    if( ( getValue( eSendEnabled ) && getValue( eSendDCDC_02 )) || getValue( eDlcOnceDCDC_02 ))  sendDCDC_02();
}

on envVar eSendDCDC_02
{
    if( getValue( eSendEnabled ) && getValue( eSendDCDC_02 ))  sendDCDC_02();
}

on envVar eTimeoutDCDC_02
{
    cancelTimer( _tDCDC_02 );
    cancelTimer( _totDCDC_02 );
    if( getValue( this ))
        setTimer( _totDCDC_02, ( getValue( eSendEnabled ) && getValue( eSendDCDC_02 ) && ( getValue( eTOTDCDC_02 ) > 0)) ? getValue( eTOTDCDC_02 ) : 1 );
    else
        if( getValue( eSendEnabled ) && getValue( eSendDCDC_02 ))  sendDCDC_02();
}

on Timer _totDCDC_02
{
    putValue( eTimeoutDCDC_02, 0 );
}

on envVar eDlcOnceDCDC_02
{
    if( getValue( eDlcOnceDCDC_02 ) && !( getValue( eSendEnabled ) && getValue( eSendDCDC_02 )))  setTimer( _tDCDC_02, 1 );
}

void sendDCDC_02()
{
    if( getValue( eDC_calcConsumption_button)==0x01)
    {
      calculateConsumption_DC();
    }

    if( getValue( eChangeDCDC_02 ))
    {
        if( getValue( eDlcOnceDCDC_02 ) || getValue( eDlcWrongDCDC_02 ))
        {
            putValue( eDlcOnceDCDC_02, 0 );
            _mDCDC_02.DLC = getValue( eDlcDCDC_02 );
        }
        else
        {
            _mDCDC_02.DLC = 8;
        }
    }
    else
    {
        _mDCDC_02.DLC = 8;
    }

    output( _mDCDC_02 );
    cancelTimer( _tDCDC_02 );
    if( getValue( eTDCDC_02 ) > 0)  setTimer( _tDCDC_02, getValue( eTDCDC_02 ) );  else  setTimer( _tDCDC_02, 1 );
}

DCDC_02Changed()
{
}

on envVar KCAN_DCDC_02_BZ
{
    _mDCDC_02.DCDC_02_BZ.phys = getValue( this );
    DCDC_02Changed();
}

on envVar KCAN_DCDC_02_CRC
{
    _mDCDC_02.DCDC_02_CRC.phys = getValue( this );
    DCDC_02Changed();
}

on envVar eDC_HYB_AuslastungsgradS
{
    putValue( KCAN_DC_HYB_Auslastungsgrad, getValue( this ) );
}

on envVar KCAN_DC_HYB_Auslastungsgrad
{
    _mDCDC_02.DC_HYB_Auslastungsgrad.phys = getValue( this );
    DCDC_02Changed();
}

on envVar KCAN_DC_ReserveStrom_NV
{
    _mDCDC_02.DC_ReserveStrom_NV.phys = getValue( this );
    DCDC_02Changed();
}

on envVar eDC_VerbrauchS
{
    putValue( KCAN_DC_Verbrauch, getValue( this ) );
}

on envVar KCAN_DC_Verbrauch
{
    _mDCDC_02.DC_Verbrauch.phys = getValue( this );
    DCDC_02Changed();
}

on envVar eDC_Verbrauch_UeberlaufS
{
    putValue( KCAN_DC_Verbrauch_Ueberlauf, getValue( this ) );
}

on envVar KCAN_DC_Verbrauch_Ueberlauf
{
    _mDCDC_02.DC_Verbrauch_Ueberlauf.phys = getValue( this );
    DCDC_02Changed();
}

on envVar KCAN_DC_Verlustleistung
{
    _mDCDC_02.DC_Verlustleistung.phys = getValue( this );
    DCDC_02Changed();
}

/*on Timer _tDEV_Kombi_RX1
{
  if( getValue( eTDEV_Kombi_RX1 ) <= 0)  putValue( eSendDEV_Kombi_RX1, 0 );
  if( ( getValue( eSendEnabled ) && getValue( eSendDEV_Kombi_RX1 )) || getValue( eDlcOnceDEV_Kombi_RX1 ))  sendDEV_Kombi_RX1();
}

on Timer _totDEV_Kombi_RX1
{
  putValue( eTimeoutDEV_Kombi_RX1, 0 );
}
*/
on envVar eSendDEV_Kombi_RX1
{
  if( getValue( eSendEnabled ) && getValue( eSendDEV_Kombi_RX1 ))  sendDEV_Kombi_RX1();}

on envVar eTimeoutDEV_Kombi_RX1
{
//  cancelTimer( _tDEV_Kombi_RX1 );
//  cancelTimer( _totDEV_Kombi_RX1 );
//  if( getValue( this ))
//    setTimer( _totDEV_Kombi_RX1, ( getValue( eSendEnabled ) && getValue( eSendDEV_Kombi_RX1 ) && ( getValue( eTOTDEV_Kombi_RX1 ) > 0)) ? getValue( eTOTDEV_Kombi_RX1 ) : 1 );
//  else
//    if( getValue( eSendEnabled ) && getValue( eSendDEV_Kombi_RX1 ))  sendDEV_Kombi_RX1();
}

on envVar eDlcOnceDEV_Kombi_RX1
{
//  if( getValue( eDlcOnceDEV_Kombi_RX1 ) && !( getValue( eSendEnabled ) && getValue( eSendDEV_Kombi_RX1 )))  setTimer( _tDEV_Kombi_RX1, 1 );
}

void sendDEV_Kombi_RX1()
{
/*  if( getValue( eChangeDEV_Kombi_RX1))
  {
    if( getValue( eDlcOnceDEV_Kombi_RX1 ) || getValue( eDlcWrongDEV_Kombi_RX1 ))
    {
        putValue( eDlcOnceDEV_Kombi_RX1, 0 );
        _mDEV_Kombi_RX1.DLC = getValue( eDlcDEV_Kombi_RX1 );
    }
    else
    {
         _mDEV_Kombi_RX1.DLC = 8;
    }
  }
  else
  {
    _mDEV_Kombi_RX1.DLC = 8;
  }

  output( _mDEV_Kombi_RX1 );
  cancelTimer( _tDEV_Kombi_RX1 );
  if( getValue( eTDEV_Kombi_RX1 ) > 0)  setTimer( _tDEV_Kombi_RX1, getValue( eTDEV_Kombi_RX1 ) );  else  setTimer( _tDEV_Kombi_RX1, 1 );*/
}

/*
on envVar eTG_Guete_Geber_1
{
    _mDEV_Kombi_RX1.TG_Guete_Geber_1 = getValue( this );
    if( getValue( eSendEnabled) && getValue (eSendDEV_Kombi_RX1))
    {
        output (_mDEV_Kombi_RX1);
    }
}

on envVar eTG_Guete_Geber_2
{
    _mDEV_Kombi_RX1.TG_Guete_Geber_2 = getValue( this );
    if( getValue( eSendEnabled) && getValue (eSendDEV_Kombi_RX1))
    {
        output (_mDEV_Kombi_RX1);
    }
}

on envVar eTG_Guete_Geber_3
{
    _mDEV_Kombi_RX1.TG_Guete_Geber_3 = getValue( this );
    if( getValue( eSendEnabled) && getValue( eSendDEV_Kombi_RX1))
    {
        output (_mDEV_Kombi_RX1);
    }
}

on envVar eTG_Guete_Geber_4
{
    _mDEV_Kombi_RX1.TG_Guete_Geber_4 = getValue( this );
    if( getValue( eSendEnabled) && getValue( eSendDEV_Kombi_RX1))
    {
        output (_mDEV_Kombi_RX1);
    }
}
*/
/*on envVar eTG_Geber_1
{
    _mDEV_Kombi_RX1.TG_Geber_1 = getValue( this );
    if( getValue( eSendEnabled) && getValue( eSendDEV_Kombi_RX1))
    {
        output (_mDEV_Kombi_RX1);
    }
}

on envVar eTG_Geber_2
{
    _mDEV_Kombi_RX1.TG_Geber_2 = getValue( this );
    if( getValue( eSendEnabled) && getValue( eSendDEV_Kombi_RX1))
    {
        output (_mDEV_Kombi_RX1);
    }
}

on envVar eTG_Geber_3
{
    _mDEV_Kombi_RX1.TG_Geber_3 = getValue( this );
    if( getValue( eSendEnabled) && getValue( eSendDEV_Kombi_RX1))
    {
        output (_mDEV_Kombi_RX1);
    }
}

on envVar eTG_Geber_4
{
    _mDEV_Kombi_RX1.TG_Geber_4 = getValue( this );
    if( getValue( eSendEnabled) && getValue( eSendDEV_Kombi_RX1))
    {
        output (_mDEV_Kombi_RX1);
    }
}*/

on Timer _tDiagnose_01
{
    if( getValue( eTDiagnose_01 ) <= 0)  putValue( eSendDiagnose_01, 0 );
    if( ( getValue( eSendEnabled ) && getValue( eSendDiagnose_01 )) || getValue( eDlcOnceDiagnose_01 ))  sendDiagnose_01();
}

on envVar eSendDiagnose_01
{
    if( getValue( eSendEnabled ) && getValue( eSendDiagnose_01 ))  sendDiagnose_01();
}

on envVar eTimeoutDiagnose_01
{
    cancelTimer( _tDiagnose_01 );
    cancelTimer( _totDiagnose_01 );
    if( getValue( this ))
        setTimer( _totDiagnose_01, ( getValue( eSendEnabled ) && getValue( eSendDiagnose_01 ) && ( getValue( eTOTDiagnose_01 ) > 0)) ? getValue( eTOTDiagnose_01 ) : 1 );
    else
        if( getValue( eSendEnabled ) && getValue( eSendDiagnose_01 ))  sendDiagnose_01();
}

on Timer _totDiagnose_01
{
    putValue( eTimeoutDiagnose_01, 0 );
}

on envVar eDlcOnceDiagnose_01
{
    if( getValue( eDlcOnceDiagnose_01 ) && !( getValue( eSendEnabled ) && getValue( eSendDiagnose_01 )))  setTimer( _tDiagnose_01, 1 );
}

void sendDiagnose_01()
{
    if( getValue( eChangeDiagnose_01 ))
    {
        if( getValue( eDlcOnceDiagnose_01 ) || getValue( eDlcWrongDiagnose_01 ))
        {
            putValue( eDlcOnceDiagnose_01, 0 );
            _mDiagnose_01.DLC = getValue( eDlcDiagnose_01 );
        }
        else
        {
            _mDiagnose_01.DLC = 8;
        }
    }
    else
    {
        _mDiagnose_01.DLC = 8;
    }

    output( _mDiagnose_01 );
    cancelTimer( _tDiagnose_01 );
    if( getValue( eTDiagnose_01 ) > 0)  setTimer( _tDiagnose_01, getValue( eTDiagnose_01 ) );  else  setTimer( _tDiagnose_01, 1 );
}

Diagnose_01Changed()
{
}

on envVar eDGN_VerlernzaehlerS
{
    putValue( KCAN_DGN_Verlernzaehler, getValue( this ) );
}

on envVar KCAN_DGN_Verlernzaehler
{
    _mDiagnose_01.DGN_Verlernzaehler.phys = getValue( this );
    Diagnose_01Changed();
}

on envVar eKBI_Kilometerstand_1S
{
    putValue( KCAN_KBI_Kilometerstand, getValue( this ) );
}

on envVar KCAN_KBI_Kilometerstand
{
    _mDiagnose_01.KBI_Kilometerstand.phys = getValue( this );
    Diagnose_01Changed();
}

on envVar eKombi_02_altS
{
    putValue( KCAN_Kombi_02_alt, getValue( this ) );
}

on envVar KCAN_Kombi_02_alt
{
    _mDiagnose_01.Kombi_02_alt.phys = getValue( this );
    Diagnose_01Changed();
}

on envVar eUH_Jahr_1S
{
    putValue( KCAN_UH_Jahr, getValue( this ) );
}

on envVar KCAN_UH_Jahr
{
    _mDiagnose_01.UH_Jahr.phys = getValue( this );
    Diagnose_01Changed();
}

on envVar eUH_Minute_1S
{
    putValue( KCAN_UH_Minute, getValue( this ) );
}

on envVar KCAN_UH_Minute
{
    _mDiagnose_01.UH_Minute.phys = getValue( this );
    Diagnose_01Changed();
}

on envVar eUH_Monat_1S
{
    putValue( KCAN_UH_Monat, getValue( this ) );
}

on envVar KCAN_UH_Monat
{
    _mDiagnose_01.UH_Monat.phys = getValue( this );
    Diagnose_01Changed();
}

on envVar eUH_Sekunde_1S
{
    putValue( KCAN_UH_Sekunde, getValue( this ) );
}

on envVar KCAN_UH_Sekunde
{
    _mDiagnose_01.UH_Sekunde.phys = getValue( this );
    Diagnose_01Changed();
}

on envVar eUH_Stunde_1S
{
    putValue( KCAN_UH_Stunde, getValue( this ) );
}

on envVar KCAN_UH_Stunde
{
    _mDiagnose_01.UH_Stunde.phys = getValue( this );
    Diagnose_01Changed();
}

on envVar eUH_Tag_1S
{
    putValue( KCAN_UH_Tag, getValue( this ) );
}

on envVar KCAN_UH_Tag
{
    _mDiagnose_01.UH_Tag.phys = getValue( this );
    Diagnose_01Changed();
}

on envVar eUhrzeit_01_altS
{
    putValue( KCAN_Uhrzeit_01_alt, getValue( this ) );
}

on envVar KCAN_Uhrzeit_01_alt
{
    _mDiagnose_01.Uhrzeit_01_alt.phys = getValue( this );
    Diagnose_01Changed();
}

on envVar KCAN_Vehicle_Driving_Cycle
{
    _mDiagnose_01.Vehicle_Driving_Cycle.phys = getValue( this );
    Diagnose_01Changed();
}

on Timer _tEA_02
{
    if( getValue( eTEA_02 ) <= 0)  putValue( eSendEA_02, 0 );
    if( ( getValue( eSendEnabled ) && getValue( eSendEA_02 )) || getValue( eDlcOnceEA_02 ))  sendEA_02();
}

on envVar eSendEA_02
{
    if( getValue( eSendEnabled ) && getValue( eSendEA_02 ))  sendEA_02();
    if( getValue( this )== 2) putValue(eTimeoutEA_02,1);
}

on envVar eTimeoutEA_02
{
    cancelTimer( _tEA_02 );
    cancelTimer( _totEA_02 );
    if( getValue( this ))
        setTimer( _totEA_02, ( getValue( eSendEnabled ) && getValue( eSendEA_02 ) && ( getValue( eTOTEA_02 ) > 0)) ? getValue( eTOTEA_02 ) : 1 );
    else
        if( getValue( eSendEnabled ) && getValue( eSendEA_02 ))  sendEA_02();
}

on Timer _totEA_02
{
    putValue( eTimeoutEA_02, 0 );
    putValue(eSendEA_02,1);
}

on envVar eDlcOnceEA_02
{
    if( getValue( eDlcOnceEA_02 ) && !( getValue( eSendEnabled ) && getValue( eSendEA_02 )))  setTimer( _tEA_02, 1 );
}

on Timer _tinhEA_02
{
    _bsiEA_02 = 0;
    if( _bsaiEA_02 && getValue( eSendEnabled ))  sendEA_02();
}

void sendEA_02()
{
    byte crc;
    dword bz;
    int hw;
    byte dlc;

    if( getValue( eChangeEA_02))
    {
        if( getValue( eDlcOnceEA_02 ) || getValue( eDlcWrongEA_02 ))
        {
            putValue( eDlcOnceEA_02, 0 );
            _mEA_02.DLC = getValue( eDlcEA_02 );
        }
        else
        {
            if( getValue( eEA_02_ChngDLCEnabled ))
            {
                dlc = getValue( eEA_02_ChngDLCData );
                if( dlc > 0 )
                {
                    dlc--;
                    putValue( eEA_02_ChngDLCData, dlc );
                    _mEA_02.DLC = getValue( eDlcEA_02 );
                }
                else
                {
                    putValue( eEA_02_ChngDLCData, 0 );
                    _mEA_02.DLC = 8;
                }
            }
            else
            {
                _mEA_02.DLC = 8;
            }
        }
          if( getValue( eEA_02_BZS_SingleJumpEnabled ))
        {
            putValue( eEA_02_BZS_SingleJumpEnabled, 0 );
            _mEA_02.EA_02_BZ = ( _mEA_02.EA_02_BZ + getValue( eEA_02_BZS_SingleJumpData ))& 0xf;
        }
        if( getValue( eEA_02_BZS_ResetJumpEnabled ))
        {

            if( getValue( eEA_02_BZS_ResetJumpData ) == _mEA_02.EA_02_BZ )
            {
                putValue( eEA_02_BZS_ResetJumpEnabled, 0 );
                _mEA_02.EA_02_BZ = 0;
                putValue( eEA_02_BZS, 15 );
            }
        }
        crc = getCRC8( _mEA_02, _EA_02_S_PDU_Code );
        if( getValue( eEA_02_CRC_FalseEnabled ))
        {

            crc= ~ crc;
            hw = getValue( eEA_02_CRC_FalseData );
            if( hw )
            {
                hw--;
                putValue( eEA_02_CRC_FalseData, hw );
            }
            if( hw == 0 )
            {
                putValue( eEA_02_CRC_FalseEnabled, 0 );
            }

        }
        putvalue(eEA_02_CRCS, crc ^ (1 - getValue( eCrcEA_02 )));

        if( getValue( eBZEA_02 ))
        {
            bz = getValue( eEA_02_BZS );
            bz = bz + getValue( eBZStepEA_02 );
            putValue( eEA_02_BZS, bz % 16 );
        }
    }
    else
    {
        _mEA_02.DLC = 8;

        crc = getCRC8( _mEA_02, _EA_02_S_PDU_Code );
        putvalue(eEA_02_CRCS, crc ^ (1 - getValue( eCrcEA_02 )));

        bz = getValue( eEA_02_BZS ) + 1;
        putValue( eEA_02_BZS, bz % 16 );
    }

    if( getValue( eEA_02_NoMsgEnabled ))
    {
        hw = getValue( eEA_02_NoMsgEnabledData );
        if( hw )
        {
            hw--;
            putValue( eEA_02_NoMsgEnabledData, hw );
        }
        if( hw == 0 )
        {
            putValue( eEA_02_NoMsgEnabled, 0 );
        }
    }
    else
    {
        output( _mEA_02 );
    }

    cancelTimer( _tEA_02 );
    if( getValue( eTEA_02 ) > 0)  setTimer( _tEA_02, getValue( eTEA_02 ) );  else  setTimer( _tEA_02, 1 );
    _bsaiEA_02 = 0;
    _bsiEA_02 = 1;
    cancelTimer( _tinhEA_02 );  setTimer( _tinhEA_02, 10 );
}

EA_02Changed()
{
    if( getValue( eSendEnabled ) && getValue( eSendEA_02 ))
        if( _bsiEA_02 )
            _bsaiEA_02 = 1;
        else
            sendEA_02();
}

on envVar eEA_02_CRCS
{
    _mEA_02.EA_02_CRC.phys = getValue( this );
}

on envVar eEA_02_BZS
{
    _mEA_02.EA_02_BZ.phys = getValue( this );
}

on envVar KCAN_ACF_Lampe_Hands_Off
{
    _mEA_02.ACF_Lampe_Hands_Off.phys = getValue( this );
    EA_02Changed();
}

on envVar KCAN_EA_Blinken
{
    _mEA_02.EA_Blinken.phys = getValue( this );
    EA_02Changed();
}

on envVar KCAN_EA_Bremslichtblinken
{
    _mEA_02.EA_Bremslichtblinken.phys = getValue( this );
    EA_02Changed();
}

on envVar KCAN_EA_eCall_Anf
{
    _mEA_02.EA_eCall_Anf.phys = getValue( this );
    EA_02Changed();
}

on envVar KCAN_EA_Fahrzeughupe_Anf
{
    _mEA_02.EA_Fahrzeughupe_Anf.phys = getValue( this );
    EA_02Changed();
}

on envVar KCAN_EA_Infotainment_Anf
{
    _mEA_02.EA_Infotainment_Anf.phys = getValue( this );
    EA_02Changed();
}

on envVar KCAN_EA_Innenraumlicht_Anf
{
    _mEA_02.EA_Innenraumlicht_Anf.phys = getValue( this );
    EA_02Changed();
}

on envVar KCAN_EA_Texte
{
    _mEA_02.EA_Texte.phys = getValue( this );
    EA_02Changed();
}

on envVar KCAN_EA_Tueren_Anf
{
    _mEA_02.EA_Tueren_Anf.phys = getValue( this );
    EA_02Changed();
}

on envVar KCAN_EA_Warnlevel
{
    _mEA_02.EA_Warnlevel.phys = getValue( this );
    EA_02Changed();
}

on envVar KCAN_STP_Primaeranz
{
    _mEA_02.STP_Primaeranz.phys = getValue( this );
    EA_02Changed();
}

on envVar KCAN_zFAS_Warnblinken
{
    _mEA_02.zFAS_Warnblinken.phys = getValue( this );
    EA_02Changed();
}

on Timer _tEM1_HYB_13
{
    if( getValue( eTEM1_HYB_13 ) <= 0)  putValue( eSendEM1_HYB_13, 0 );
    if( ( getValue( eSendEnabled ) && getValue( eSendEM1_HYB_13 )) || getValue( eDlcOnceEM1_HYB_13 ))  sendEM1_HYB_13();
}

on envVar eSendEM1_HYB_13
{
    if( getValue( eSendEnabled ) && getValue( eSendEM1_HYB_13 ))  sendEM1_HYB_13();
}

on envVar eTimeoutEM1_HYB_13
{
    cancelTimer( _tEM1_HYB_13 );
    cancelTimer( _totEM1_HYB_13 );
    if( getValue( this ))
        setTimer( _totEM1_HYB_13, ( getValue( eSendEnabled ) && getValue( eSendEM1_HYB_13 ) && ( getValue( eTOTEM1_HYB_13 ) > 0)) ? getValue( eTOTEM1_HYB_13 ) : 1 );
    else
        if( getValue( eSendEnabled ) && getValue( eSendEM1_HYB_13 ))  sendEM1_HYB_13();
}

on Timer _totEM1_HYB_13
{
    putValue( eTimeoutEM1_HYB_13, 0 );
}

on envVar eDlcOnceEM1_HYB_13
{
    if( getValue( eDlcOnceEM1_HYB_13 ) && !( getValue( eSendEnabled ) && getValue( eSendEM1_HYB_13 )))  setTimer( _tEM1_HYB_13, 1 );
}

void sendEM1_HYB_13()
{
    if( getValue( eChangeEM1_HYB_13))
    {
        if( getValue( eDlcOnceEM1_HYB_13 ) || getValue( eDlcWrongEM1_HYB_13 ))
        {
            putValue( eDlcOnceEM1_HYB_13, 0 );
            _mEM1_HYB_13.DLC = getValue( eDlcEM1_HYB_13 );
        }
        else
        {
            _mEM1_HYB_13.DLC = 8;
        }
    }
    else
    {
        _mEM1_HYB_13.DLC = 8;
    }

    output( _mEM1_HYB_13 );
    cancelTimer( _tEM1_HYB_13 );
    if( getValue( eTEM1_HYB_13 ) > 0)  setTimer( _tEM1_HYB_13, getValue( eTEM1_HYB_13 ) );  else  setTimer( _tEM1_HYB_13, 1 );
}

EM1_HYB_13Changed()
{
}

on envVar KCAN_EM1_Abregelung_Temperatur
{
    _mEM1_HYB_13.EM1_Abregelung_Temperatur.phys = getValue( this );
    EM1_HYB_13Changed();
}

on envVar KCAN_EM1_AnlernenElMotor_Anf
{
    _mEM1_HYB_13.EM1_AnlernenElMotor_Anf.phys = getValue( this );
    EM1_HYB_13Changed();
}

on envVar KCAN_EM1_AR_aktiv
{
    _mEM1_HYB_13.EM1_AR_aktiv.phys = getValue( this );
    EM1_HYB_13Changed();
}

on envVar KCAN_EM1_Eta_Sys
{
    _mEM1_HYB_13.EM1_Eta_Sys.phys = getValue( this );
    EM1_HYB_13Changed();
}

on envVar KCAN_EM1_Fehler_ElAntriebFreilauf_Anf
{
    _mEM1_HYB_13.EM1_Fehler_ElAntriebFreilauf_Anf.phys = getValue( this );
    EM1_HYB_13Changed();
}

on envVar KCAN_EM1_Freigabe_Info_WFS
{
    _mEM1_HYB_13.EM1_Freigabe_Info_WFS.phys = getValue( this );
    EM1_HYB_13Changed();
}

on envVar KCAN_EM1_Freigabe_Verfallsinfo_WFS
{
    _mEM1_HYB_13.EM1_Freigabe_Verfallsinfo_WFS.phys = getValue( this );
    EM1_HYB_13Changed();
}

on envVar KCAN_EM1_HV_betriebsbereit
{
    _mEM1_HYB_13.EM1_HV_betriebsbereit.phys = getValue( this );
    EM1_HYB_13Changed();
}

on envVar KCAN_EM1_IstStrom
{
    _mEM1_HYB_13.EM1_IstStrom.phys = getValue( this );
    EM1_HYB_13Changed();
}

on envVar KCAN_EM1_Moment_HVVerbraucher
{
    _mEM1_HYB_13.EM1_Moment_HVVerbraucher.phys = getValue( this );
    EM1_HYB_13Changed();
}

on envVar KCAN_EM1_Parken_WFS_Status
{
    _mEM1_HYB_13.EM1_Parken_WFS_Status.phys = getValue( this );
    EM1_HYB_13Changed();
}

on envVar KCAN_EM1_Sperr_Info_WFS
{
    _mEM1_HYB_13.EM1_Sperr_Info_WFS.phys = getValue( this );
    EM1_HYB_13Changed();
}

on envVar eLE_Kuehlmittel_SensorS
{
    putValue( KCAN_LE_Kuehlmittel_Sensor, getValue( this ) );
}

on envVar KCAN_LE_Kuehlmittel_Sensor
{
    _mEM1_HYB_13.LE_Kuehlmittel_Sensor.phys = getValue( this );
    EM1_HYB_13Changed();
}

on Timer _tEM2_HYB_13
{
    if( getValue( eTEM2_HYB_13 ) <= 0)  putValue( eSendEM2_HYB_13, 0 );
    if( ( getValue( eSendEnabled ) && getValue( eSendEM2_HYB_13 )) || getValue( eDlcOnceEM2_HYB_13 ))  sendEM2_HYB_13();
}

on envVar eSendEM2_HYB_13
{
    if( getValue( eSendEnabled ) && getValue( eSendEM2_HYB_13 ))  sendEM2_HYB_13();
}

on envVar eTimeoutEM2_HYB_13
{
    cancelTimer( _tEM2_HYB_13 );
    cancelTimer( _totEM2_HYB_13 );
    if( getValue( this ))
        setTimer( _totEM2_HYB_13, ( getValue( eSendEnabled ) && getValue( eSendEM2_HYB_13 ) && ( getValue( eTOTEM2_HYB_13 ) > 0)) ? getValue( eTOTEM2_HYB_13 ) : 1 );
    else
        if( getValue( eSendEnabled ) && getValue( eSendEM2_HYB_13 ))  sendEM2_HYB_13();
}

on Timer _totEM2_HYB_13
{
    putValue( eTimeoutEM2_HYB_13, 0 );
}

on envVar eDlcOnceEM2_HYB_13
{
    if( getValue( eDlcOnceEM2_HYB_13 ) && !( getValue( eSendEnabled ) && getValue( eSendEM2_HYB_13 )))  setTimer( _tEM2_HYB_13, 1 );
}

on Timer _tinhEM2_HYB_13
{
    _bsiEM2_HYB_13 = 0;
    if( _bsaiEM2_HYB_13 && getValue( eSendEnabled ))  sendEM2_HYB_13();
}

void sendEM2_HYB_13()
{
    if( getValue( eChangeEM2_HYB_13))
    {
        if( getValue( eDlcOnceEM2_HYB_13 ) || getValue( eDlcWrongEM2_HYB_13 ))
        {
            putValue( eDlcOnceEM2_HYB_13, 0 );
            _mEM2_HYB_13.DLC = getValue( eDlcEM2_HYB_13 );
        }
        else
        {
            _mEM2_HYB_13.DLC = 8;
        }
    }
    else
    {
        _mEM2_HYB_13.DLC = 8;
    }

    output( _mEM2_HYB_13 );
    cancelTimer( _tEM2_HYB_13 );
    if( getValue( eTEM2_HYB_13 ) > 0)  setTimer( _tEM2_HYB_13, getValue( eTEM2_HYB_13 ) );  else  setTimer( _tEM2_HYB_13, 1 );
    _bsaiEM2_HYB_13 = 0;
    _bsiEM2_HYB_13 = 1;
    cancelTimer( _tinhEM2_HYB_13 );  setTimer( _tinhEM2_HYB_13, 100 );
}

EM2_HYB_13Changed()
{
    if( getValue( eSendEnabled ) && getValue( eSendEM2_HYB_13 ))
        if( _bsiEM2_HYB_13)
            _bsaiEM2_HYB_13 = 1;
        else
            sendEM2_HYB_13();
}

on envVar KCAN_EM2_Abregelung_Temperatur
{
    _mEM2_HYB_13.EM2_Abregelung_Temperatur.phys = getValue( this );
    EM2_HYB_13Changed();
}

on envVar KCAN_EM2_AnlernenElMotor_Anf
{
    _mEM2_HYB_13.EM2_AnlernenElMotor_Anf.phys = getValue( this );
    EM2_HYB_13Changed();
}

on envVar KCAN_EM2_AR_aktiv
{
    _mEM2_HYB_13.EM2_AR_aktiv.phys = getValue( this );
    EM2_HYB_13Changed();
}

on envVar KCAN_EM2_Eta_Sys
{
    _mEM2_HYB_13.EM2_Eta_Sys.phys = getValue( this );
    EM2_HYB_13Changed();
}

on envVar KCAN_EM2_Fehler_ElAntriebFreilauf_Anf
{
    _mEM2_HYB_13.EM2_Fehler_ElAntriebFreilauf_Anf.phys = getValue( this );
    EM2_HYB_13Changed();
}

on envVar KCAN_EM2_Freigabe_Info_WFS
{
    _mEM2_HYB_13.EM2_Freigabe_Info_WFS.phys = getValue( this );
    EM2_HYB_13Changed();
}

on envVar KCAN_EM2_Freigabe_Verfallsinfo_WFS
{
    _mEM2_HYB_13.EM2_Freigabe_Verfallsinfo_WFS.phys = getValue( this );
    EM2_HYB_13Changed();
}

on envVar KCAN_EM2_HV_betriebsbereit
{
    _mEM2_HYB_13.EM2_HV_betriebsbereit.phys = getValue( this );
    EM2_HYB_13Changed();
}

on envVar KCAN_EM2_IstStrom
{
    _mEM2_HYB_13.EM2_IstStrom.phys = getValue( this );
    EM2_HYB_13Changed();
}

on envVar KCAN_EM2_Parken_WFS_Status
{
    _mEM2_HYB_13.EM2_Parken_WFS_Status.phys = getValue( this );
    EM2_HYB_13Changed();
}

on envVar KCAN_EM2_Sperr_Info_WFS
{
    _mEM2_HYB_13.EM2_Sperr_Info_WFS.phys = getValue( this );
    EM2_HYB_13Changed();
}

on Timer _tEPB_03
{
    if( getValue( eTEPB_03 ) <= 0)  putValue( eSendEPB_03, 0 );
    if( ( getValue( eSendEnabled ) && getValue( eSendEPB_03 )) || getValue( eDlcOnceEPB_03 ))  sendEPB_03();
}

on envVar eSendEPB_03
{
    if( getValue( eSendEnabled ) && getValue( eSendEPB_03 ))  sendEPB_03();
}

on envVar eTimeoutEPB_03
{
    cancelTimer( _tEPB_03 );
    cancelTimer( _totEPB_03 );
    if( getValue( this ))
        setTimer( _totEPB_03, ( getValue( eSendEnabled ) && getValue( eSendEPB_03 ) && ( getValue( eTOTEPB_03 ) > 0)) ? getValue( eTOTEPB_03 ) : 1 );
    else
        if( getValue( eSendEnabled ) && getValue( eSendEPB_03 ))  sendEPB_03();
}

on Timer _totEPB_03
{
    putValue( eTimeoutEPB_03, 0 );
}

on envVar eDlcOnceEPB_03
{
    if( getValue( eDlcOnceEPB_03 ) && !( getValue( eSendEnabled ) && getValue( eSendEPB_03 )))  setTimer( _tEPB_03, 1 );
}

void sendEPB_03()
{
    byte crc;
    dword bz;
    int hw;
    byte dlc;

    if( getValue( eChangeEPB_03))
    {
        if( getValue( eDlcOnceEPB_03 ) || getValue( eDlcWrongEPB_03 ))
        {
            putValue( eDlcOnceEPB_03, 0 );
            _mEPB_03.DLC = getValue( eDlcEPB_03 );
        }
        else
        {
            if( getValue( eEPB_03_ChngDLCEnabled ))
            {
                dlc = getValue( eEPB_03_ChngDLCData );
                if(dlc>0)
                {
                    dlc--;
                    putValue( eEPB_03_ChngDLCData, dlc );
                    _mEPB_03.DLC = getValue( eDlcEPB_03 );
                }
                else
                {
                    putValue( eEPB_03_ChngDLCData, 0 );
                    _mEPB_03.DLC = 8;
                }
            }
            else
            {
                _mEPB_03.DLC = 8;
            }
        }
        if( getValue( eEPB_03_BZS_SingleJumpEnabled ))
        {
            putValue( eEPB_03_BZS_SingleJumpEnabled, 0 );
            _mEPB_03.EPB_03_BZ = ( _mEPB_03.EPB_03_BZ + getValue( eEPB_03_BZS_SingleJumpData )) & 0xf;
        }
        if( getValue( eEPB_03_BZS_ResetJumpEnabled ))
        {
            if( getValue( eEPB_03_BZS_ResetJumpData ) == _mEPB_03.EPB_03_BZ )
            {
                putValue( eEPB_03_BZS_ResetJumpEnabled, 0 );
                _mEPB_03.EPB_03_BZ = 0;
                putValue( eEPB_03_BZS, 15 );
            }
        }
        crc = getCRC8( _mEPB_03, _s_pdu_codeEPB_03 );
        if( getValue( eEPB_03_CRC_FalseEnabled ))
        {
            crc =~ crc;
            hw = getValue( eEPB_03_CRC_FalseData );
            if( hw )
            {
                hw--;
                putValue( eEPB_03_CRC_FalseData, hw );
            }
            if( hw == 0 )
            {
                putValue( eEPB_03_CRC_FalseEnabled, 0 );
            }

        }
        _mEPB_03.EPB_03_CRC = crc ^ ( 1 - getValue( eCrcEPB_03 ));

        if( getValue( eBZEPB_03 ))
        {
            bz = getValue( eEPB_03_BZS );
            bz = bz + getValue( eBZStepEPB_03 );
            putValue( eEPB_03_BZS, bz % 16 );
        }
    }
    else
    {
        _mEPB_03.DLC = 8;

        crc = getCRC8( _mEPB_03, _s_pdu_codeEPB_03 );
        _mEPB_03.EPB_03_CRC = crc ^ (1 - getValue( eCrcEPB_03 ));

        bz = getValue( eEPB_03_BZS ) + 1;
        putValue( eEPB_03_BZS, bz % 16 );
    }

    if( getValue( eEPB_03_NoMsgEnabled ))
    {
        hw = getValue( eEPB_03_NoMsgEnabledData );
        if( hw )
        {
            hw--;
            putValue( eEPB_03_NoMsgEnabledData, hw );
        }
        if( hw == 0 )
        {
            putValue( eEPB_03_NoMsgEnabled, 0 );
        }
    }
    else
    {
        output( _mEPB_03 );
    }

    cancelTimer( _tEPB_03 );
    if( getValue( eTEPB_03 ) > 0)  setTimer( _tEPB_03, getValue( eTEPB_03 ) );  else  setTimer( _tEPB_03, 1 );
}

EPB_03Changed()
{
}

on envVar eEPB_03_BZS
{
    _mEPB_03.EPB_03_BZ.phys = getValue( this );
    EPB_03Changed();
}

on envVar eEPB_03_CRCS
{
    _mEPB_03.EPB_03_CRC.phys = getValue( this );
    EPB_03Changed();
}

on envVar eEPB_Autohold_StandbyanzeigeS
{
    putValue( KCAN_EPB_Autohold_Standbyanzeige, getValue( this ) );
}

on envVar KCAN_EPB_Autohold_Standbyanzeige
{
    _mEPB_03.EPB_Autohold_Standbyanzeige.phys = getValue( this );
    EPB_03Changed();
}

on envVar eEPB_Autoholdlampe_02S
{
    putValue( KCAN_EPB_Autoholdlampe_02, getValue( this ) );
}

on envVar KCAN_EPB_Autoholdlampe_02
{
    _mEPB_03.EPB_Autoholdlampe_02.phys = getValue( this );
    EPB_03Changed();
}

on envVar eEPB_Fehlermeldungen_02S
{
    putValue( KCAN_EPB_Fehlermeldungen_02, getValue( this ) );
}

on envVar KCAN_EPB_Fehlermeldungen_02
{
    _mEPB_03.EPB_Fehlermeldungen_02.phys = getValue( this );
    EPB_03Changed();
}

on envVar eEPB_Funktionslampe_02S
{
    putValue( KCAN_EPB_Funktionslampe_02, getValue( this ) );
}

on envVar KCAN_EPB_Funktionslampe_02
{
    _mEPB_03.EPB_Funktionslampe_02.phys = getValue( this );
    EPB_03Changed();
}

on envVar eEPB_Texte_02S
{
    putValue( KCAN_EPB_Texte_02, getValue( this ) );
}

on envVar KCAN_EPB_Texte_02
{
    _mEPB_03.EPB_Texte_02.phys = getValue( this );
    EPB_03Changed();
}

on Timer _tESP_02
{
    if( getValue( eTESP_02 ) <= 0)  putValue( eSendESP_02, 0 );
    if( ( getValue( eSendEnabled ) && getValue( eSendESP_02 )) || getValue( eDlcOnceESP_02 ))  sendESP_02();
}

on envVar eSendESP_02
{
    if( getValue( eSendEnabled ) && getValue( eSendESP_02 ))  sendESP_02();
}

on envVar eTimeoutESP_02
{
    cancelTimer( _tESP_02 );
    cancelTimer( _totESP_02 );
    if( getValue( this ))
        setTimer( _totESP_02, ( getValue( eSendEnabled ) && getValue( eSendESP_02 ) && ( getValue( eTOTESP_02 ) > 0)) ? getValue( eTOTESP_02 ) : 1 );
    else
        if( getValue( eSendEnabled ) && getValue( eSendESP_02 ))  sendESP_02();
}

on Timer _totESP_02
{
    putValue( eTimeoutESP_02, 0 );
}

on envVar eDlcOnceESP_02
{
    if( getValue( eDlcOnceESP_02 ) && !( getValue( eSendEnabled ) && getValue( eSendESP_02 )))  setTimer( _tESP_02, 1 );
}

void sendESP_02()
{
    if( getValue( eChangeESP_02 ))
    {
        if( getValue( eDlcOnceESP_02 ) || getValue( eDlcWrongESP_02 ))
        {
            putValue( eDlcOnceESP_02, 0 );
            _mESP_02.DLC = getValue( eDlcESP_02 );
        }
        else
        {
            _mESP_02.DLC = 8;
        }
    }
    else
    {
        _mESP_02.DLC = 8;
    }

    output( _mESP_02 );

    cancelTimer( _tESP_02 );
    if( getValue( eTESP_02 ) > 0)  setTimer( _tESP_02, getValue( eTESP_02 ) );  else  setTimer( _tESP_02, 1 );
}

ESP_02Changed()
{
}

on envVar KCAN_ESC_Motorstartverzoegerung
{
    _mESP_02.ESC_Motorstartverzoegerung.phys = getValue( this );
    ESP_02Changed();
}

on envVar KCAN_ESC_SeitenwindAssistent_Eingriff
{
    _mESP_02.ESC_SeitenwindAssistent_Eingriff.phys = getValue( this );
    ESP_02Changed();
}

on envVar KCAN_ESC_Unterdruckmangel_erkannt
{
    _mESP_02.ESC_Unterdruckmangel_erkannt.phys = getValue( this );
    ESP_02Changed();
}

on envVar KCAN_ESP_Anschleppstart_Freigabe
{
    _mESP_02.ESP_Anschleppstart_Freigabe.phys = getValue( this );
    ESP_02Changed();
}

on envVar eESP_GierrateS
{
    putValue( KCAN_ESP_Gierrate, getValue( this ) );
}

on envVar KCAN_ESP_Gierrate
{
    _mESP_02.ESP_Gierrate.phys = getValue( this );
    ESP_02Changed();
}

on envVar eESP_LaengsbeschlS
{
    putValue( KCAN_ESP_Laengsbeschl, getValue( this ) );
}

on envVar KCAN_ESP_Laengsbeschl
{
    _mESP_02.ESP_Laengsbeschl.phys = getValue( this );
    ESP_02Changed();
}

on envVar eESP_NotbremsanzeigeS
{
    putValue( KCAN_ESP_Notbremsanzeige, getValue( this ) );
}

on envVar KCAN_ESP_Notbremsanzeige
{
    _mESP_02.ESP_Notbremsanzeige.phys = getValue( this );
    ESP_02Changed();
}

on envVar eESP_PLA_AbbruchS
{
    putValue( KCAN_ESP_PLA_Abbruch, getValue( this ) );
}

on envVar KCAN_ESP_PLA_Abbruch
{
    _mESP_02.ESP_PLA_Abbruch.phys = getValue( this );
    ESP_02Changed();
}

on envVar eESP_QBit_GierrateS
{
    putValue( KCAN_ESP_QBit_Gierrate, getValue( this ) );
}

on envVar KCAN_ESP_QBit_Gierrate
{
    _mESP_02.ESP_QBit_Gierrate.phys = getValue( this );
    ESP_02Changed();
}

on envVar eESP_QBit_LaengsbeschlS
{
    putValue( KCAN_ESP_QBit_Laengsbeschl, getValue( this ) );
}

on envVar KCAN_ESP_QBit_Laengsbeschl
{
    _mESP_02.ESP_QBit_Laengsbeschl.phys = getValue( this );
    ESP_02Changed();
}

on envVar eESP_QBit_QuerbS
{
    putValue( KCAN_ESP_QBit_Querb, getValue( this ) );
}

on envVar KCAN_ESP_QBit_Querb
{
    _mESP_02.ESP_QBit_Querb.phys = getValue( this );
    ESP_02Changed();
}

on envVar eESP_QuerbeschleunigungS
{
    putValue( KCAN_ESP_Querbeschleunigung, getValue( this ) );
}

on envVar KCAN_ESP_Querbeschleunigung
{
    _mESP_02.ESP_Querbeschleunigung.phys = getValue( this );

    if( getValue( eESP_QuerbeschleunigungS ) == 1.28 )
        putValue( eESP_Querbeschleunigung255, 1 );
    else
        putValue( eESP_Querbeschleunigung255, 0 );

    if( getValue( eESP_Querbeschleunigung255 ) == 0x01 )
    {
        _mESP_02.ESP_Querbeschleunigung = 0xFF;
    }
    ESP_02Changed();
}

on envVar eESP_SpannungsAnfS
{
    putValue( KCAN_ESP_SpannungsAnf, getValue( this ) );
}

on envVar KCAN_ESP_SpannungsAnf
{
    _mESP_02.ESP_SpannungsAnf.phys = getValue( this );
    ESP_02Changed();
}

on envVar eESP_Status_ESP_PLAS
{
    putValue( KCAN_ESP_Status_ESP_PLA, getValue( this ) );
}

on envVar KCAN_ESP_Status_ESP_PLA
{
    _mESP_02.ESP_Status_ESP_PLA.phys = getValue( this );
    ESP_02Changed();
}

on envVar eESP_VZ_GierrateS
{
    putValue( KCAN_ESP_VZ_Gierrate, getValue( this ) );
}

on envVar KCAN_ESP_VZ_Gierrate
{
    _mESP_02.ESP_VZ_Gierrate.phys = getValue( this );
    ESP_02Changed();
}

on Timer _tESP_10
{
    if( getValue( eTESP_10 ) <= 0)  putValue( eSendESP_10, 0 );
    if( ( getValue( eSendEnabled ) && getValue( eSendESP_10 )) || getValue( eDlcOnceESP_10 ))  sendESP_10();
}

on envVar eSendESP_10
{
    if( getValue( eSendEnabled ) && getValue( eSendESP_10 ))  sendESP_10();
}

on envVar eTimeoutESP_10
{
    cancelTimer( _tESP_10 );
    cancelTimer( _totESP_10 );
    if( getValue( this ))
        setTimer( _totESP_10, ( getValue( eSendEnabled ) && getValue( eSendESP_10 ) && ( getValue( eTOTESP_10 ) > 0)) ? getValue( eTOTESP_10 ) : 1 );
    else
        if( getValue( eSendEnabled ) && getValue( eSendESP_10 ))  sendESP_10();
}

on Timer _totESP_10
{
    putValue( eTimeoutESP_10, 0 );
}

on envVar eDlcOnceESP_10
{
    if( getValue( eDlcOnceESP_10 ) && !( getValue( eSendEnabled ) && getValue( eSendESP_10 )))  setTimer( _tESP_10, 1 );
}

void sendESP_10()
{
    if( getValue( eChangeESP_10 ))
    {
        if( getValue( eDlcOnceESP_10 ) || getValue( eDlcWrongESP_10 ))
        {
            putValue( eDlcOnceESP_10, 0 );
            _mESP_10.DLC = getValue( eDlcESP_10 );
        }
        else
        {
            _mESP_10.DLC = 8;
        }
    }
    else
    {
        _mESP_10.DLC = 8;
    }

    output( _mESP_10 );
    cancelTimer( _tESP_10 );
    if( getValue( eTESP_10 ) > 0)  setTimer( _tESP_10, getValue( eTESP_10 ) );  else  setTimer( _tESP_10, 1 );
}

ESP_10Changed()
{
}

on envVar KCAN_ESP_10_BZ
{
    _mESP_10.ESP_10_BZ.phys = getValue( this );
    ESP_10Changed();
}

on envVar KCAN_ESP_10_CRC
{
    _mESP_10.ESP_10_CRC.phys = getValue( this );
    ESP_10Changed();
}

on envVar KCAN_ESP_HL_Fahrtrichtung
{
    _mESP_10.ESP_HL_Fahrtrichtung.phys = getValue( this );
    ESP_10Changed();
}

on envVar KCAN_ESP_HR_Fahrtrichtung
{
    _mESP_10.ESP_HR_Fahrtrichtung.phys = getValue( this );
    ESP_10Changed();
}

on envVar KCAN_ESP_QBit_Wegimpuls_HL
{
    _mESP_10.ESP_QBit_Wegimpuls_HL.phys = getValue( this );
    ESP_10Changed();
}

on envVar KCAN_ESP_QBit_Wegimpuls_HR
{
    _mESP_10.ESP_QBit_Wegimpuls_HR.phys = getValue( this );
    ESP_10Changed();
}

on envVar KCAN_ESP_QBit_Wegimpuls_VL
{
    _mESP_10.ESP_QBit_Wegimpuls_VL.phys = getValue( this );
    ESP_10Changed();
}

on envVar KCAN_ESP_QBit_Wegimpuls_VR
{
    _mESP_10.ESP_QBit_Wegimpuls_VR.phys = getValue( this );
    ESP_10Changed();
}

on envVar KCAN_ESP_VL_Fahrtrichtung
{
    _mESP_10.ESP_VL_Fahrtrichtung.phys = getValue( this );
    ESP_10Changed();
}

on envVar KCAN_ESP_VR_Fahrtrichtung
{
    _mESP_10.ESP_VR_Fahrtrichtung.phys = getValue( this );
    ESP_10Changed();
}

on envVar KCAN_ESP_Wegimpuls_HL
{
    _mESP_10.ESP_Wegimpuls_HL.phys = getValue( this );
    ESP_10Changed();
}

on envVar KCAN_ESP_Wegimpuls_HR
{
    _mESP_10.ESP_Wegimpuls_HR.phys = getValue( this );
    ESP_10Changed();
}

on envVar KCAN_ESP_Wegimpuls_VL
{
    _mESP_10.ESP_Wegimpuls_VL.phys = getValue( this );
    ESP_10Changed();
}

on envVar KCAN_ESP_Wegimpuls_VR
{
    _mESP_10.ESP_Wegimpuls_VR.phys = getValue( this );
    ESP_10Changed();
}

on Timer _tESP_19
{
    if( getValue( eTESP_19 ) <= 0)  putValue( eSendESP_19, 0 );
    if( ( getValue( eSendEnabled ) && getValue( eSendESP_19 )) || getValue( eDlcOnceESP_19 ))  sendESP_19();
}

on envVar eSendESP_19
{
    if( getValue( eSendEnabled ) && getValue( eSendESP_19 ))  sendESP_19();
}

on envVar eTimeoutESP_19
{
    cancelTimer( _tESP_19 );
    cancelTimer( _totESP_19 );
    if( getValue( this ))
        setTimer( _totESP_19, ( getValue( eSendEnabled ) && getValue( eSendESP_19 ) && ( getValue( eTOTESP_19 ) > 0)) ? getValue( eTOTESP_19 ) : 1 );
    else
        if( getValue( eSendEnabled ) && getValue( eSendESP_19 ))  sendESP_19();
}

on Timer _totESP_19
{
    putValue( eTimeoutESP_19, 0 );
}

on envVar eDlcOnceESP_19
{
    if( getValue( eDlcOnceESP_19 ) && !( getValue( eSendEnabled ) && getValue( eSendESP_19 )))  setTimer( _tESP_19, 1 );
}

void sendESP_19()
{
    if( getValue( eChangeESP_19 ))
    {
        if( getValue( eDlcOnceESP_19 ) || getValue( eDlcWrongESP_19 ))
        {
            putValue( eDlcOnceESP_19, 0 );
            _mESP_19.DLC = getValue( eDlcESP_19 );
        }
        else
        {
            _mESP_19.DLC = 8;
        }
    }
    else
    {
        _mESP_19.DLC = 8;
    }

    output( _mESP_19 );
    cancelTimer( _tESP_19 );
    if( getValue( eTESP_19 ) > 0)  setTimer( _tESP_19, getValue( eTESP_19 ) );  else  setTimer( _tESP_19, 1 );
}

ESP_19Changed()
{
}

on envVar KCAN_ESP_HL_Radgeschw_02
{
    _mESP_19.ESP_HL_Radgeschw_02.phys = getValue( this );
    ESP_19Changed();
}

on envVar KCAN_ESP_HR_Radgeschw_02
{
    _mESP_19.ESP_HR_Radgeschw_02.phys = getValue( this );
    ESP_19Changed();
}

on envVar KCAN_ESP_VL_Radgeschw_02
{
    _mESP_19.ESP_VL_Radgeschw_02.phys = getValue( this );
    ESP_19Changed();
}

on envVar KCAN_ESP_VR_Radgeschw_02
{
    _mESP_19.ESP_VR_Radgeschw_02.phys = getValue( this );
    ESP_19Changed();
}

on Timer _tESP_20
{
    if( getValue( eTESP_20 ) <= 0)  putValue( eSendESP_20, 0 );
    if( ( getValue( eSendEnabled ) && getValue( eSendESP_20 )) || getValue( eDlcOnceESP_20 ))  sendESP_20();
}

on envVar eSendESP_20
{
    if( getValue( eSendEnabled ) && getValue( eSendESP_20 ))  sendESP_20();
}

on envVar eTimeoutESP_20
{
    cancelTimer( _tESP_20 );
    cancelTimer( _totESP_20 );
    if( getValue( this ))
        setTimer( _totESP_20, ( getValue( eSendEnabled ) && getValue( eSendESP_20 ) && ( getValue( eTOTESP_20 ) > 0)) ? getValue( eTOTESP_20 ) : 1 );
    else
        if( getValue( eSendEnabled ) && getValue( eSendESP_20 ))  sendESP_20();
}

on Timer _totESP_20
{
    putValue( eTimeoutESP_20, 0 );
}

on envVar eDlcOnceESP_20
{
    if( getValue( eDlcOnceESP_20 ) && !( getValue( eSendEnabled ) && getValue( eSendESP_20 )))  setTimer( _tESP_20, 1 );
}

void sendESP_20()
{
    if( getValue( eChangeESP_20))
    {
        if( getValue( eDlcOnceESP_20 ) || getValue( eDlcWrongESP_20 ))
        {
            putValue( eDlcOnceESP_20, 0 );
            _mESP_20.DLC = getValue( eDlcESP_20 );
        }
        else
        {
                    _mESP_20.DLC = 8;
        }
    }
    else
    {
        _mESP_20.DLC = 8;
    }
    {
        output( _mESP_20 );
    }

    cancelTimer( _tESP_20 );
    if( getValue( eTESP_20 ) > 0)  setTimer( _tESP_20, getValue( eTESP_20 ) );  else  setTimer( _tESP_20, 1 );
}

ESP_20Changed()
{
}

on envVar KCAN_BR_QBit_Reifenumfang
{
    _mESP_20.BR_QBit_Reifenumfang.phys = getValue( this );
    ESP_20Changed();
}

on envVar KCAN_BR_Reifenumfang
{
    _mESP_20.BR_Reifenumfang.phys = getValue( this );
    ESP_20Changed();
}

on envVar eBR_SystemartS
{
    putValue( KCAN_BR_Systemart, getValue( this ) );
}

on envVar KCAN_BR_Systemart
{
    _mESP_20.BR_Systemart.phys = getValue( this );
    ESP_20Changed();
}

on envVar KCAN_ESP_Charisma_FahrPr
{
    _mESP_20.ESP_Charisma_FahrPr.phys = getValue( this );
    ESP_20Changed();
}

on envVar KCAN_ESP_Charisma_Status
{
    _mESP_20.ESP_Charisma_Status.phys = getValue( this );
    ESP_20Changed();
}

on envVar KCAN_ESP_Dachrelingsensor
{
    _mESP_20.ESP_Dachrelingsensor.phys = getValue( this );
    ESP_20Changed();
}

on envVar KCAN_ESP_SpannungsAnf_02
{
    _mESP_20.ESP_SpannungsAnf_02.phys = getValue( this );
    ESP_20Changed();
}

on envVar KCAN_ESP_Stoppverbot_Anz_01
{
    _mESP_20.ESP_Stoppverbot_Anz_01.phys = getValue( this );
    ESP_20Changed();
}

on envVar KCAN_ESP_Stoppverbot_Anz_02
{
    _mESP_20.ESP_Stoppverbot_Anz_02.phys = getValue( this );
    ESP_20Changed();
}

on envVar KCAN_ESP_Stoppverbot_Anz_03
{
    _mESP_20.ESP_Stoppverbot_Anz_03.phys = getValue( this );
    ESP_20Changed();
}

on envVar KCAN_ESP_Stoppverbot_Anz_04
{
    _mESP_20.ESP_Stoppverbot_Anz_04.phys = getValue( this );
    ESP_20Changed();
}

on envVar KCAN_ESP_Stoppverbot_Anz_05
{
    _mESP_20.ESP_Stoppverbot_Anz_05.phys = getValue( this );
    ESP_20Changed();
}

on envVar KCAN_ESP_Stoppverbot_Anz_06
{
    _mESP_20.ESP_Stoppverbot_Anz_06.phys = getValue( this );
    ESP_20Changed();
}

on envVar KCAN_ESP_Stoppverbot_Anz_07
{
    _mESP_20.ESP_Stoppverbot_Anz_07.phys = getValue( this );
    ESP_20Changed();
}

on envVar KCAN_ESP_Stoppverbot_Anz_08
{
    _mESP_20.ESP_Stoppverbot_Anz_08.phys = getValue( this );
    ESP_20Changed();
}

on envVar KCAN_ESP_Stoppverbot_Anz_Std
{
    _mESP_20.ESP_Stoppverbot_Anz_Std.phys = getValue( this );
    ESP_20Changed();
}

on envVar KCAN_ESP_Wiederstart_Anz_01
{
    _mESP_20.ESP_Wiederstart_Anz_01.phys = getValue( this );
    ESP_20Changed();
}

on envVar KCAN_ESP_Wiederstart_Anz_02
{
    _mESP_20.ESP_Wiederstart_Anz_02.phys = getValue( this );
    ESP_20Changed();
}

on envVar KCAN_ESP_Wiederstart_Anz_03
{
    _mESP_20.ESP_Wiederstart_Anz_03.phys = getValue( this );
    ESP_20Changed();
}

on envVar KCAN_ESP_Wiederstart_Anz_04
{
    _mESP_20.ESP_Wiederstart_Anz_04.phys = getValue( this );
    ESP_20Changed();
}

on envVar eESP_ZaehnezahlS
{
    putValue( KCAN_ESP_Zaehnezahl, getValue( this ) );
}

on envVar KCAN_ESP_Zaehnezahl
{
    _mESP_20.ESP_Zaehnezahl.phys = getValue( this );
    ESP_20Changed();
}

on envVar KCAN_HDC_Charisma_FahrPr
{
    _mESP_20.HDC_Charisma_FahrPr.phys = getValue( this );
    ESP_20Changed();
}

on envVar KCAN_HDC_Charisma_Status
{
    _mESP_20.HDC_Charisma_Status.phys = getValue( this );
    ESP_20Changed();
}

on Timer _tESP_21
{
    if( getValue( eTESP_21 ) <= 0)  putValue( eSendESP_21, 0 );
    if( ( getValue( eSendEnabled ) && getValue( eSendESP_21 )) || getValue( eDlcOnceESP_21 ))  sendESP_21();
}

on envVar eSendESP_21
{
    if( getValue( eSendEnabled ) && getValue( eSendESP_21 ))  sendESP_21();
}

on envVar eTimeoutESP_21
{
    cancelTimer( _tESP_21 );
    cancelTimer( _totESP_21 );
    if( getValue( this ))
        setTimer( _totESP_21, ( getValue( eSendEnabled ) && getValue( eSendESP_21 ) && ( getValue( eTOTESP_21 ) > 0)) ? getValue( eTOTESP_21 ) : 1 );
    else
        if( getValue( eSendEnabled ) && getValue( eSendESP_21 ))  sendESP_21();
}

on Timer _totESP_21
{
    putValue( eTimeoutESP_21, 0 );
}

on envVar eDlcOnceESP_21
{
    if( getValue( eDlcOnceESP_21 ) && !( getValue( eSendEnabled ) && getValue( eSendESP_21 )))  setTimer( _tESP_21, 1 );
}

void sendESP_21()
{
    byte crc;
    dword bz;
    int hw;
    byte dlc;

    if( getValue( eChangeESP_21 ))
    {
        if( getValue( eDlcOnceESP_21 ) || getValue( eDlcWrongESP_21 ))
        {
            putValue( eDlcOnceESP_21, 0 );
            _mESP_21.DLC = getValue( eDlcESP_21 );
        }
        else
        {
            if( getValue( eESP_21_ChngDLCEnabled ))
            {
                dlc = getValue( eESP_21_ChngDLCData );
                if(dlc>0)
                {
                    dlc--;
                    putValue( eESP_21_ChngDLCData, dlc );
                    _mESP_21.DLC = getValue( eDlcESP_21 );
                }
                else
                {
                    putValue( eESP_21_ChngDLCData, 0 );
                    _mESP_21.DLC = 8;
                }
            }
            else
            {
                _mESP_21.DLC = 8;
            }
        }
        if( getValue( eESP_21_BZS_SingleJumpEnabled ))
        {
            putValue( eESP_21_BZS_SingleJumpEnabled, 0 );
            _mESP_21.ESP_21_BZ=(_mESP_21.ESP_21_BZ + getValue( eESP_21_BZS_SingleJumpData))&0xf;
        }
        if( getValue( eESP_21_BZS_ResetJumpEnabled ))
        {
            if( getValue( eESP_21_BZS_ResetJumpData ) == _mESP_21.ESP_21_BZ )
            {
                putValue( eESP_21_BZS_ResetJumpEnabled, 0 );
                _mESP_21.ESP_21_BZ=0;
                putValue( eESP_21_BZS, 15 );
            }
        }
        crc = getCRC8( _mESP_21, _s_pdu_codeESP_21 );
        if( getValue( eESP_21_CRC_FalseEnabled ))
        {
            crc=~crc;
            hw = getValue( eESP_21_CRC_FalseData );
            if( hw )
            {
                hw--;
                putValue( eESP_21_CRC_FalseData, hw );
            }
            if( hw == 0 )
            {
                putValue( eESP_21_CRC_FalseEnabled, 0 );
            }
        }
        _mESP_21.ESP_21_CRC = crc ^ (1 - getValue( eCrcESP_21 ));

        if( getValue( eBZESP_21 ))
        {
            bz = getValue( eESP_21_BZS );
            bz = bz + getValue( eBZStepESP_21 );
            putValue( eESP_21_BZS, bz % 16 );
        }
    }
    else
    {
        _mESP_21.DLC = 8;

        crc = getCRC8( _mESP_21, _s_pdu_codeESP_21 );
        _mESP_21.ESP_21_CRC = crc ^ (1 - getValue( eCrcESP_21 ));

        bz = getValue( eESP_21_BZS ) + 1;
        putValue( eESP_21_BZS, bz % 16 );
    }

    if( getValue( eESP_21_NoMsgEnabled ))
    {
        hw = getValue( eESP_21_NoMsgEnabledData );
        if( hw )
        {
            hw--;
            putValue( eESP_21_NoMsgEnabledData, hw );
        }
        if( hw == 0 )
        {
            putValue( eESP_21_NoMsgEnabled, 0);
        }
    }
    else
    {
        output( _mESP_21 );
    }

    cancelTimer( _tESP_21 );
    if( getValue( eTESP_21 ) > 0)  setTimer( _tESP_21, getValue( eTESP_21 ) );  else  setTimer( _tESP_21, 1 );
}

ESP_21Changed()
{
}

on envVar eESP_21_BZS
{
    putValue( KCAN_ESP_21_BZ, getValue( this ) );
}

on envVar KCAN_ESP_21_BZ
{
    _mESP_21.ESP_21_BZ.phys = getValue( this );
 //   ESP_21Changed();
}

on envVar KCAN_ESP_21_CRC
{
    _mESP_21.ESP_21_CRC.phys = getValue( this );
 //   ESP_21Changed();
}

on envVar KCAN_ABS_Bremsung
{
    _mESP_21.ABS_Bremsung.phys = getValue( this );
    ESP_21Changed();
}

on envVar KCAN_ASR_Anf
{
    _mESP_21.ASR_Anf.phys = getValue( this );
    ESP_21Changed();
}

on envVar KCAN_ASR_Schalteingriff
{
    _mESP_21.ASR_Schalteingriff.phys = getValue( this );
    ESP_21Changed();
}

on envVar KCAN_ASR_Tastung_passiv
{
    _mESP_21.ASR_Tastung_passiv.phys = getValue( this );
    ESP_21Changed();
}

on envVar KCAN_BR_Eingriffsmoment
{
    _mESP_21.BR_Eingriffsmoment.phys = getValue( this );
    ESP_21Changed();
}

on envVar KCAN_EBV_Eingriff
{
    _mESP_21.EBV_Eingriff.phys = getValue( this );
    ESP_21Changed();
}

on envVar KCAN_EDS_Eingriff
{
    _mESP_21.EDS_Eingriff.phys = getValue( this );
    ESP_21Changed();
}

on envVar KCAN_ESC_Reku_Freigabe
{
    _mESP_21.ESC_Reku_Freigabe.phys = getValue( this );
    ESP_21Changed();
}

on envVar KCAN_ESC_v_Signal_Qualifier_High_Low
{
    _mESP_21.ESC_v_Signal_Qualifier_High_Low.phys = getValue( this );
    ESP_21Changed();
}

on envVar eESP_Anhaltevorgang_ACC_aktiv
{
    putValue( KCAN_ESP_Anhaltevorgang_ACC_aktiv, getValue( this ) );
}

on envVar KCAN_ESP_Anhaltevorgang_ACC_aktiv
{
    _mESP_21.ESP_Anhaltevorgang_ACC_aktiv.phys = getValue( this );
    ESP_21Changed();
}

on envVar KCAN_ESP_ASP
{
    _mESP_21.ESP_ASP.phys = getValue( this );
    ESP_21Changed();
}

on envVar KCAN_ESP_AWV3_Brems_aktiv
{
    _mESP_21.ESP_AWV3_Brems_aktiv.phys = getValue( this );
    ESP_21Changed();
}

on envVar KCAN_ESP_Diagnose
{
    _mESP_21.ESP_Diagnose.phys = getValue( this );
    ESP_21Changed();
}

on envVar KCAN_ESP_Eingriff
{
    _mESP_21.ESP_Eingriff.phys = getValue( this );
    ESP_21Changed();
}

on envVar KCAN_ESP_Haltebestaetigung
{
    _mESP_21.ESP_Haltebestaetigung.phys = getValue( this );
    ESP_21Changed();
}

on envVar KCAN_ESP_MKB_Abbruch_Geschw
{
    _mESP_21.ESP_MKB_Abbruch_Geschw.phys = getValue( this );
    ESP_21Changed();
}

on envVar KCAN_ESP_PLA_Bremseingriff
{
    _mESP_21.ESP_PLA_Bremseingriff.phys = getValue( this );
    ESP_21Changed();
}

on envVar KCAN_ESP_QBit_v_Signal
{
    _mESP_21.ESP_QBit_v_Signal.phys = getValue( this );
    ESP_21Changed();
}

on envVar KCAN_ESP_Systemstatus
{
    _mESP_21.ESP_Systemstatus.phys = getValue( this );
    ESP_21Changed();
}

on envVar KCAN_ESP_Tastung_passiv
{
    _mESP_21.ESP_Tastung_passiv.phys = getValue( this );
    ESP_21Changed();
}

on envVar eESP_v_Signal
{
    putValue( KCAN_ESP_v_Signal, getValue( this ) );
}

on envVar KCAN_ESP_v_Signal
{
    _mESP_21.ESP_v_Signal.phys = getValue( this );
    ESP_21Changed();
}

on envVar KCAN_ESP_Vorsteuerung
{
    _mESP_21.ESP_Vorsteuerung.phys = getValue( this );
    ESP_21Changed();
}

on envVar KCAN_MSR_Anf
{
    _mESP_21.MSR_Anf.phys = getValue( this );
    ESP_21Changed();
}

on envVar KCAN_OBD_QBit_Schlechtweg
{
    _mESP_21.OBD_QBit_Schlechtweg.phys = getValue( this );
    ESP_21Changed();
}

on envVar KCAN_OBD_Schlechtweg
{
    _mESP_21.OBD_Schlechtweg.phys = getValue( this );
    ESP_21Changed();
}

on Timer _tESP_24
{
    if( getValue( eTESP_24 ) <= 0)  putValue( eSendESP_24, 0 );
    if( ( getValue( eSendEnabled ) && getValue( eSendESP_24 )) || getValue( eDlcOnceESP_24 ))  sendESP_24();
}

on envVar eSendESP_24
{
    if( getValue( eSendEnabled ) && getValue( eSendESP_24 ))  sendESP_24();
}

on envVar eTimeoutESP_24
{
    cancelTimer( _tESP_24 );
    cancelTimer( _totESP_24 );
    if( getValue( this ))
        setTimer( _totESP_24, ( getValue( eSendEnabled ) && getValue( eSendESP_24 ) && ( getValue( eTOTESP_24 ) > 0)) ? getValue( eTOTESP_24 ) : 1 );
    else
        if( getValue( eSendEnabled ) && getValue( eSendESP_24 ))  sendESP_24();
}

on Timer _totESP_24
{
    putValue( eTimeoutESP_24, 0 );
}

on envVar eDlcOnceESP_24
{
    if( getValue( eDlcOnceESP_24 ) && !( getValue( eSendEnabled ) && getValue( eSendESP_24 )))  setTimer( _tESP_24, 1 );
}

void sendESP_24()
{
    byte crc;
    dword bz;
    int hw;
    byte dlc;
	
	float Umdrehungen_1s;
    float Umdrehungen_tUpdate;
    float Wegimpuls_einzeln;
    float Wegimpuls_ges;

    calculateSpeed();
	//  if( @Timeout_Wegimpuls == 0)
    {
        if( getValue( KCAN_ESP_Zaehnezahl ) != 0 && getValue( KCAN_ESP_m_Raddrehz ) <= 32639 )
        {    
            Umdrehungen_1s = getValue( KCAN_ESP_m_Raddrehz );                                                             // Anzahl der Umdrehungen in 1s (Frequenz)
            Umdrehungen_tUpdate = Umdrehungen_1s / 1000 * getValue( KCAN__STMSGCT_ESP_24 ); // Anzahl der Umdrehungen pro Updatezyklus
            Wegimpuls_einzeln = Umdrehungen_tUpdate * getValue( KCAN_ESP_Zaehnezahl ) * 2;                               // Berechnung der einzelnen Wegimpulse
            Wegimpuls_ges = Wegimpuls_ges + Wegimpuls_einzeln; // Aufsummierung der Wegimpulse
            // Ãœberlaufbit setzen & Wert ruecksetzen (Rest behalten)
            if( Wegimpuls_ges > 2048 )
            {
                putValue( KCAN_ESP_Wegimp_Ueberlauf, 1 );
                Wegimpuls_ges = Wegimpuls_ges - 2048;
            }
            putValue( KCAN_ESP_Wegimp_VA, Wegimpuls_ges ); //writelineex(4,0,"Wegimpuls_ges: %f",Wegimpuls_ges);
            _mESP_24.ESP_Wegimp_VA.phys = Wegimpuls_ges;

        }
    }

    if( getValue( eChangeESP_24 ))
    {
        if( getValue( eDlcOnceESP_24 ) || getValue( eDlcWrongESP_24 ))
        {
            putValue( eDlcOnceESP_24, 0 );
            _mESP_24.DLC = getValue( eDlcESP_24 );
        }
        else
        {
            if( getValue( eESP_24_ChngDLCEnabled ))
            {
                dlc = getValue( eESP_24_ChngDLCData );
                if(dlc>0)
                {
                    dlc--;
                    putValue( eESP_24_ChngDLCData, dlc );
                    _mESP_24.DLC = getValue( eDlcESP_24 );
                }
                else
                {
                    putValue( eESP_24_ChngDLCData, 0 );
                    _mESP_24.DLC = 8;
                }
            }
            else
            {
                _mESP_24.DLC = 8;
            }
        }
        if( getValue( eESP_24_BZS_SingleJumpEnabled ))
        {
            putValue( eESP_24_BZS_SingleJumpEnabled, 0 );
            _mESP_24.ESP_24_BZ=(_mESP_24.ESP_24_BZ + getValue( eESP_24_BZS_SingleJumpData))&0xf;
        }
        if( getValue( eESP_24_BZS_ResetJumpEnabled ))
        {
            if( getValue( eESP_24_BZS_ResetJumpData ) == _mESP_24.ESP_24_BZ )
            {
                putValue( eESP_24_BZS_ResetJumpEnabled, 0 );
                _mESP_24.ESP_24_BZ=0;
                putValue( eESP_24_BZS,15);
            }
        }
        crc = getCRC8( _mESP_24, _s_pdu_codeESP_24 );
        if( getValue( eESP_24_CRC_FalseEnabled ))
        {
            crc=~crc;
            hw = getValue( eESP_24_CRC_FalseData );
            if( hw )
            {
                hw--;
                putValue( eESP_24_CRC_FalseData, hw );
            }
            if( hw == 0 )
            {
                putValue( eESP_24_CRC_FalseEnabled, 0 );
            }
        }
        _mESP_24.ESP_24_CRC = crc ^ (1 - getValue( eCrcESP_24 ));

        if( getValue( eBZESP_24 ))
        {
            bz = getValue( eESP_24_BZS );
            bz = bz + getValue( eBZStepESP_24 );
            putValue( eESP_24_BZS, bz % 16 );
        }
    }
    else
    {
         _mESP_24.DLC = 8;

         crc = getCRC8( _mESP_24, _s_pdu_codeESP_24 );
         _mESP_24.ESP_24_CRC = crc ^ (1 - getValue( eCrcESP_24 ));

         bz = getValue( eESP_24_BZS ) + 1;
         putValue( eESP_24_BZS, bz % 16 );
    }

    if( getValue( eESP_24_NoMsgEnabled ))
    {
        hw = getValue( eESP_24_NoMsgEnabledData );
        if( hw )
        {
            hw--;
            putValue( eESP_24_NoMsgEnabledData, hw );
        }
        if( hw == 0 )
        {
            putValue( eESP_24_NoMsgEnabled, 0 );
        }
    }
    else
    {
        output( _mESP_24 );
    }

    cancelTimer( _tESP_24 );
    if( getValue( eTESP_24 ) > 0)  setTimer( _tESP_24, getValue( eTESP_24 ) );  else  setTimer( _tESP_24, 1 );
}

ESP_24Changed()
{
}

on envVar eESP_24_BZS
{
    putValue( KCAN_ESP_24_BZ, getValue( this ) );
}

on envVar KCAN_ESP_24_BZ
{
    _mESP_24.ESP_24_BZ.phys = getValue( this );
    ESP_24Changed();
}

on envVar eESP_24_CRCS
{
    putValue( KCAN_ESP_24_CRC, getValue( this ) );
}

on envVar KCAN_ESP_24_CRC
{
    _mESP_24.ESP_24_CRC.phys = getValue( this );
    ESP_24Changed();
}

on envVar eABS_LampeS
{
    putValue( KCAN_ABS_Lampe, getValue( this ) );
}

on envVar KCAN_ABS_Lampe
{
    _mESP_24.ABS_Lampe.phys = getValue( this );
    ESP_24Changed();
}

on envVar eBK_Lampe_02S
{
    putValue( KCAN_BK_Lampe_02, getValue( this ) );
}

on envVar KCAN_BK_Lampe_02
{
    _mESP_24.BK_Lampe_02.phys = getValue( this );
    ESP_24Changed();
}

on envVar eESP_BKV_WarnungS
{
    putValue( KCAN_ESP_BKV_Warnung, getValue( this ) );
}

on envVar KCAN_ESP_BKV_Warnung
{
    _mESP_24.ESP_BKV_Warnung.phys = getValue( this );
    ESP_24Changed();
}

on envVar eESP_Fehlerstatus_WegimpS
{
    putValue( KCAN_ESP_Fehlerstatus_Wegimp, getValue( this ) );
}

on envVar KCAN_ESP_Fehlerstatus_Wegimp
{
    _mESP_24.ESP_Fehlerstatus_Wegimp.phys = getValue( this );
    ESP_24Changed();
}

on envVar eESP_HDC_FktLampeS
{
    putValue( KCAN_ESP_HDC_FktLampe, getValue( this ) );
}

on envVar KCAN_ESP_HDC_FktLampe
{
    _mESP_24.ESP_HDC_FktLampe.phys = getValue( this );
    ESP_24Changed();
}

on envVar eESP_HDC_RegelgeschwS
{
    putValue( KCAN_ESP_HDC_Regelgeschw, getValue( this ) );
}

on envVar KCAN_ESP_HDC_Regelgeschw
{
    _mESP_24.ESP_HDC_Regelgeschw.phys = getValue( this );
    ESP_24Changed();
}

on envVar eESP_LampeS
{
    putValue( KCAN_ESP_Lampe, getValue( this ) );
}

on envVar KCAN_ESP_Lampe
{
    _mESP_24.ESP_Lampe.phys = getValue( this );
    ESP_24Changed();
}

on envVar eESP_m_RaddrehzS
{
  //  putValue( KCAN_ESP_m_Raddrehz, getValue( this ) );
}

on envVar KCAN_ESP_m_Raddrehz
{
    _mESP_24.ESP_m_Raddrehz.phys = getValue( this );
    ESP_24Changed();
}

on envVar eESP_MeldungenS
{
    putValue( KCAN_ESP_Meldungen, getValue( this ) );
}

on envVar KCAN_ESP_Meldungen
{
    _mESP_24.ESP_Meldungen.phys = getValue( this );
    ESP_24Changed();
}

on envVar eESP_Off_LampeS
{
    putValue( KCAN_ESP_Off_Lampe, getValue( this ) );
}

on envVar KCAN_ESP_Off_Lampe
{
    _mESP_24.ESP_Off_Lampe.phys = getValue( this );
    ESP_24Changed();
}

on envVar eESP_QBit_Wegimp_VAS
{
    putValue( KCAN_ESP_QBit_Wegimp_VA, getValue( this ) );
}

on envVar KCAN_ESP_QBit_Wegimp_VA
{
    _mESP_24.ESP_QBit_Wegimp_VA.phys = getValue( this );
    ESP_24Changed();
}

on envVar eESP_Textanzeigen_03S
{
    putValue( KCAN_ESP_Textanzeigen_03, getValue( this ) );
}

on envVar KCAN_ESP_Textanzeigen_03
{
    _mESP_24.ESP_Textanzeigen_03.phys = getValue( this );
    ESP_24Changed();
}

on envVar eESP_Wegimp_UeberlaufS
{
    putValue( KCAN_ESP_Wegimp_Ueberlauf, getValue( this ) );
}

on envVar KCAN_ESP_Wegimp_Ueberlauf
{
    _mESP_24.ESP_Wegimp_Ueberlauf.phys = getValue( this );
    ESP_24Changed();
}

on envVar eESP_Wegimp_VAS
{
    putValue( KCAN_ESP_Wegimp_VA, getValue( this ) );
}

on envVar KCAN_ESP_Wegimp_VA
{
    _mESP_24.ESP_Wegimp_VA.phys = getValue( this );
    ESP_24Changed();
}

on envVar eTC_LampeS
{
    putValue( KCAN_TC_Lampe, getValue( this ) );
}

on envVar KCAN_TC_Lampe
{
    _mESP_24.TC_Lampe.phys = getValue( this );
    ESP_24Changed();
}

// ESP_30 begin
// moved to message_ESP_30.cin
// ESP_30 end

on Timer _teTM_01
{
}

on Timer _toteTM_01
{
}

eTM_01Changed()
{
}

on Timer _tFDR_04
{
}

on Timer _totFDR_04
{
}

FDR_04Changed()
{
}

on Timer _tFLA_01
{
}

on Timer _totFLA_01
{
}

FLA_01Changed()
{
}

on Timer _tFoD_01
{
    if( getValue( eTFoD_01 ) <= 0)  putValue( eSendFoD_01, 0 );
    if( ( getValue( eSendEnabled ) && getValue( eSendFoD_01 )) || getValue( eDlcOnceFoD_01 ))  sendFoD_01();
}

on envVar eSendFoD_01
{
    if( getValue( eSendEnabled ) && getValue( eSendFoD_01 ))  sendFoD_01();
}

on envVar eTimeoutFoD_01
{
    cancelTimer( _tFoD_01 );
    cancelTimer( _totFoD_01 );
    if( getValue( this ))
        setTimer( _totFoD_01, ( getValue( eSendEnabled ) && getValue( eSendFoD_01 ) && ( getValue( eTOTFoD_01 ) > 0)) ? getValue( eTOTFoD_01 ) : 1 );
    else
        if( getValue( eSendEnabled ) && getValue( eSendFoD_01 ))  sendFoD_01();
}

on Timer _totFoD_01
{
    putValue( eTimeoutFoD_01, 0 );
}

on envVar eDlcOnceFoD_01
{
    if( getValue( eDlcOnceFoD_01 ) && !( getValue( eSendEnabled ) && getValue( eSendFoD_01 )))  setTimer( _tFoD_01, 1 );
}

on Timer _tinhFoD_01
{
    _bsiFoD_01 = 0;
    if( _bsaiFoD_01 && getValue( eSendEnabled ))  sendFoD_01();
}

void sendFoD_01()
{
    if( getValue( eChangeFoD_01))
    {
        if( getValue( eDlcOnceFoD_01 ) || getValue( eDlcWrongFoD_01 ))
        {
            putValue( eDlcOnceFoD_01, 0 );
            _mFoD_01.DLC = getValue( eDlcFoD_01 );
        }
        else
        {
            _mFoD_01.DLC = 8;
        }
    }
    else
    {
        _mFoD_01.DLC = 8;
    }

    output( _mFoD_01 );
    cancelTimer( _tFoD_01 );
    if( getValue( eTFoD_01 ) > 0)  setTimer( _tFoD_01, getValue( eTFoD_01 ) );  else  setTimer( _tFoD_01, 1 );
    _bsaiFoD_01 = 0;
    _bsiFoD_01 = 1;
    cancelTimer( _tinhFoD_01 );  setTimer( _tinhFoD_01, 100 );
}

FoD_01Changed()
{
    if( getValue( eSendEnabled ) && getValue( eSendFoD_01 ))
        if( _bsiFoD_01)
            _bsaiFoD_01 = 1;
        else
            sendFoD_01();
}

on envVar KCAN_FoD_Transmission_Info
{
    _mFoD_01.FoD_Transmission_Info.phys = getValue( this );
    FoD_01Changed();
}

on envVar KCAN_GRA_FoD_Status
{
    _mFoD_01.GRA_FoD_Status.phys = getValue( this );
    FoD_01Changed();
}

on Timer _tGateway_71
{
    if( getValue( eTGateway_71 ) <= 0)  putValue( eSendGateway_71, 0 );
    if( ( getValue( eSendEnabled ) && getValue( eSendGateway_71 )) || getValue( eDlcOnceGateway_71 ))  sendGateway_71();
}

on envVar eSendGateway_71
{
    if( getValue( eSendEnabled ) && getValue( eSendGateway_71 ))  sendGateway_71();
}

on envVar eTimeoutGateway_71
{
    cancelTimer( _tGateway_71 );
    cancelTimer( _totGateway_71 );
    if( getValue( this ))
        setTimer( _totGateway_71, ( getValue( eSendEnabled ) && getValue( eSendGateway_71 ) && ( getValue( eTOTGateway_71 ) > 0)) ? getValue( eTOTGateway_71 ) : 1 );
    else
        if( getValue( eSendEnabled ) && getValue( eSendGateway_71 ))  sendGateway_71();
}

on Timer _totGateway_71
{
    putValue( eTimeoutGateway_71, 0 );
}

on envVar eDlcOnceGateway_71
{
    if( getValue( eDlcOnceGateway_71 ) && !( getValue( eSendEnabled ) && getValue( eSendGateway_71 )))  setTimer( _tGateway_71, 1 );
}

void sendGateway_71()
{
    if( getValue( eChangeGateway_71))
    {
        if( getValue( eDlcOnceGateway_71 ) || getValue( eDlcWrongGateway_71 ))
        {
            putValue( eDlcOnceGateway_71, 0 );
            _mGateway_71.DLC = getValue( eDlcGateway_71 );
        }
        else
        {
            _mGateway_71.DLC = 8;
        }
    }
    else
    {
        _mGateway_71.DLC = 8;
    }

    output( _mGateway_71 );
    cancelTimer( _tGateway_71 );
    if( getValue( eTGateway_71 ) > 0)  setTimer( _tGateway_71, getValue( eTGateway_71 ) );  else  setTimer( _tGateway_71, 1 );
}

Gateway_71Changed()
{
}

on envVar KCAN_ABS_Bremsung_Gateway_71
{
    _mGateway_71.ABS_Bremsung.phys = getValue( this );
    Gateway_71Changed();
}

on envVar KCAN_ECD_Bremslicht
{
    _mGateway_71.ECD_Bremslicht.phys = getValue( this );
    Gateway_71Changed();
}

on envVar KCAN_EPB_01_alt
{
    _mGateway_71.EPB_01_alt.phys = getValue( this );
    Gateway_71Changed();
}

on envVar KCAN_EPB_Pedalweg_Kuppl
{
    _mGateway_71.EPB_Pedalweg_Kuppl.phys = getValue( this );
    Gateway_71Changed();
}

on envVar KCAN_EPB_QBit_Pedalweg_Kuppl
{
    _mGateway_71.EPB_QBit_Pedalweg_Kuppl.phys = getValue( this );
    Gateway_71Changed();
}

on envVar KCAN_EPB_Status
{
    _mGateway_71.EPB_Status.phys = getValue( this );
    Gateway_71Changed();
}

on envVar KCAN_ESP_05_alt
{
    _mGateway_71.ESP_05_alt.phys = getValue( this );
    Gateway_71Changed();
}

on envVar KCAN_ESP_21_alt
{
    _mGateway_71.ESP_21_alt.phys = getValue( this );
    Gateway_71Changed();
}

on envVar KCAN_ESP_Eingriff_Gateway_71
{
    _mGateway_71.ESP_Eingriff.phys = getValue( this );
    Gateway_71Changed();
}

on envVar KCAN_ESP_HDC_Standby
{
    _mGateway_71.ESP_HDC_Standby.phys = getValue( this );
    Gateway_71Changed();
}

on envVar KCAN_ESP_MKB_Abbruch_Geschw_Gateway_71
{
    _mGateway_71.ESP_MKB_Abbruch_Geschw.phys = getValue( this );
    Gateway_71Changed();
}

on envVar KCAN_ESP_QBit_v_Signal_Gateway_71
{
    _mGateway_71.ESP_QBit_v_Signal.phys = getValue( this );
    Gateway_71Changed();
}

on envVar KCAN_ESP_v_Signal_Gateway_71
{
    _mGateway_71.ESP_v_Signal.phys = getValue( this );
    Gateway_71Changed();
}

on envVar KCAN_Kamera_FSH_aktiv
{
    _mGateway_71.Kamera_FSH_aktiv.phys = getValue( this );
    Gateway_71Changed();
}

on envVar KCAN_Kamera_Status_alt
{
    _mGateway_71.Kamera_Status_alt.phys = getValue( this );
    Gateway_71Changed();
}

on envVar KCAN_LWI_01_alt
{
    _mGateway_71.LWI_01_alt.phys = getValue( this );
    Gateway_71Changed();
}

on envVar eLWI_LenkradwinkelS
{
    putValue( KCAN_LWI_Lenkradwinkel, getValue( this ) );
}

on envVar KCAN_LWI_Lenkradwinkel
{
    _mGateway_71.LWI_Lenkradwinkel.phys = getValue( this );
    Gateway_71Changed();
}

on envVar KCAN_LWI_QBit_Lenkradwinkel
{
    _mGateway_71.LWI_QBit_Lenkradwinkel.phys = getValue( this );
    Gateway_71Changed();
}

on envVar KCAN_LWI_Sensorstatus
{
    _mGateway_71.LWI_Sensorstatus.phys = getValue( this );
    Gateway_71Changed();
}

on envVar eLWI_VZ_LenkradwinkelS
{
    putValue( KCAN_LWI_VZ_Lenkradwinkel, getValue( this ) );
}

on envVar KCAN_LWI_VZ_Lenkradwinkel
{
    _mGateway_71.LWI_VZ_Lenkradwinkel.phys = getValue( this );
    Gateway_71Changed();
}

on envVar KCAN_Parkhilfe_01_alt
{
    _mGateway_71.Parkhilfe_01_alt.phys = getValue( this );
    Gateway_71Changed();
}

on envVar KCAN_PH_Anf_Audioabsenkung
{
    _mGateway_71.PH_Anf_Audioabsenkung.phys = getValue( this );
    Gateway_71Changed();
}

on envVar KCAN_PH_Systemzustand
{
    _mGateway_71.PH_Systemzustand.phys = getValue( this );
    Gateway_71Changed();
}

on envVar KCAN_PH_Taster
{
    _mGateway_71.PH_Taster.phys = getValue( this );
    Gateway_71Changed();
}

on envVar KCAN_PLA_Anf_Aufschaltung_RVC
{
    _mGateway_71.PLA_Anf_Aufschaltung_RVC.phys = getValue( this );
    Gateway_71Changed();
}

on Timer _tGateway_73
{
    if( getValue( eTGateway_73 ) <= 0)  putValue( eSendGateway_73, 0 );
    if( ( getValue( eSendEnabled ) && getValue( eSendGateway_73 )) || getValue( eDlcOnceGateway_73 ))  sendGateway_73();
}

on envVar eSendGateway_73
{
    if( getValue( eSendEnabled ) && getValue( eSendGateway_73 ))  sendGateway_73();
}

on envVar eTimeoutGateway_73
{
    cancelTimer( _tGateway_73 );
    cancelTimer( _totGateway_73 );
    if( getValue( this ))
        setTimer( _totGateway_73, ( getValue( eSendEnabled ) && getValue( eSendGateway_73 ) && ( getValue( eTOTGateway_73 ) > 0)) ? getValue( eTOTGateway_73 ) : 1 );
    else
        if( getValue( eSendEnabled ) && getValue( eSendGateway_73 ))  sendGateway_73();
}

on Timer _totGateway_73
{
    putValue( eTimeoutGateway_73, 0 );
}

on envVar eDlcOnceGateway_73
{
    if( getValue( eDlcOnceGateway_73 ) && !( getValue( eSendEnabled ) && getValue( eSendGateway_73 )))  setTimer( _tGateway_73, 1 );
}

void sendGateway_73()
{
    if( getValue( eChangeGateway_73))
    {
        if( getValue( eDlcOnceGateway_73 ) || getValue( eDlcWrongGateway_73 ))
        {
            putValue( eDlcOnceGateway_73, 0 );
            _mGateway_73.DLC = getValue( eDlcGateway_73 );
        }
        else
        {
            _mGateway_73.DLC = 8;
        }
    }
    else
    {
        _mGateway_73.DLC = 8;
    }

    output( _mGateway_73 );
    cancelTimer( _tGateway_73 );
    if( getValue( eTGateway_73 ) > 0)  setTimer( _tGateway_73, getValue( eTGateway_73 ) );  else  setTimer( _tGateway_73, 1 );
}

Gateway_73Changed()
{
}

on envVar KCAN_ACC_18_alt
{
    _mGateway_73.ACC_18_alt.phys = getValue( this );
    Gateway_73Changed();
}

on envVar KCAN_ACC_Status_ACC
{
    _mGateway_73.ACC_Status_ACC.phys = getValue( this );
    Gateway_73Changed();
}

on envVar KCAN_EPB_Status_02
{
    _mGateway_73.EPB_Status_02.phys = getValue( this );
    Gateway_73Changed();
}

on envVar eESP_07_altS
{
    putValue( KCAN_ESP_07_alt, getValue( this ) );
}

on envVar KCAN_ESP_07_alt
{
    _mGateway_73.ESP_07_alt.phys = getValue( this );
    Gateway_73Changed();
}

on envVar KCAN_ESP_50_alt
{
    _mGateway_73.ESP_50_alt.phys = getValue( this );
    Gateway_73Changed();
}

on envVar eESP_Rollenmodus_DeaktivierenS
{
    putValue( KCAN_ESP_Rollenmodus_Deaktivieren, getValue( this ) );
}

on envVar KCAN_ESP_Rollenmodus_Deaktivieren
{
    _mGateway_73.ESP_Rollenmodus_Deaktivieren.phys = getValue( this );
    Gateway_73Changed();
}

on envVar eGE_FahrstufeS
{
    putValue( KCAN_GE_Fahrstufe, getValue( this ) );
}

on envVar KCAN_GE_Fahrstufe
{
    _mGateway_73.GE_Fahrstufe.phys = getValue( this );
    Gateway_73Changed();
}

on envVar KCAN_GE_Freilauf_Status
{
    _mGateway_73.GE_Freilauf_Status.phys = getValue( this );
    Gateway_73Changed();
}

on envVar eGE_NotlaufS
{
    putValue( KCAN_GE_Notlauf, getValue( this ) );
}

on envVar KCAN_GE_Notlauf
{
    _mGateway_73.GE_Notlauf.phys = getValue( this );
    Gateway_73Changed();
}

on envVar KCAN_GE_Sperr_Info_WFS
{
    _mGateway_73.GE_Sperr_Info_WFS.phys = getValue( this );
    Gateway_73Changed();
}

on envVar KCAN_GE_Ursache_Fahrstufe_N
{
    _mGateway_73.GE_Ursache_Fahrstufe_N.phys = getValue( this );
    Gateway_73Changed();
}

on envVar KCAN_GE_Veto_Rollfaehigkeit
{
    _mGateway_73.GE_Veto_Rollfaehigkeit.phys = getValue( this );
    Gateway_73Changed();
}

on envVar eGetriebe_11_altS
{
    putValue( KCAN_Getriebe_11_alt, getValue( this ) );
}

on envVar KCAN_Getriebe_11_alt
{
    _mGateway_73.Getriebe_11_alt.phys = getValue( this );
    Gateway_73Changed();
}

on envVar eGetriebe_13_altS
{
    putValue( KCAN_Getriebe_13_alt, getValue( this ) );
}

on envVar KCAN_Getriebe_13_alt
{
    _mGateway_73.Getriebe_13_alt.phys = getValue( this );
    Gateway_73Changed();
}

on envVar eGetriebe_14_altS
{
    putValue( KCAN_Getriebe_14_alt, getValue( this ) );
}

on envVar KCAN_Getriebe_14_alt
{
    _mGateway_73.Getriebe_14_alt.phys = getValue( this );
    Gateway_73Changed();
}

on envVar KCAN_Getriebe_17_alt
{
    _mGateway_73.Getriebe_17_alt.phys = getValue( this );
    Gateway_73Changed();
}

on envVar eMKE_Stufe
{
    putValue( KCAN_MKE_Stufe, getValue( this ) );
}

on envVar KCAN_MKE_Stufe
{
    _mGateway_73.MKE_Stufe.phys = getValue( this );
    Gateway_73Changed();
}

on envVar eMKE_TexteS
{
    putValue( KCAN_MKE_Texte, getValue( this ) );
}

on envVar KCAN_MKE_Texte
{
    _mGateway_73.MKE_Texte.phys = getValue( this );
    Gateway_73Changed();
}

on envVar eMO_Drehzahl_01S
{
    putValue( KCAN_MO_Drehzahl_01, getValue( this ) );
}

on envVar KCAN_MO_Drehzahl_01
{
    _mGateway_73.MO_Drehzahl_01.phys = getValue( this );
    Gateway_73Changed();
}

on envVar eMO_QBit_Drehzahl_01S
{
    putValue( KCAN_MO_QBit_Drehzahl_01, getValue( this ) );
}

on envVar KCAN_MO_QBit_Drehzahl_01
{
    _mGateway_73.MO_QBit_Drehzahl_01.phys = getValue( this );
    Gateway_73Changed();
}

on envVar eMotor_12_altS
{
    putValue( KCAN_Motor_12_alt, getValue( this ) );
}

on envVar KCAN_Motor_12_alt
{
    _mGateway_73.Motor_12_alt.phys = getValue( this );
    Gateway_73Changed();
}

on envVar eTSK_06_altS
{
    putValue( KCAN_TSK_06_alt, getValue( this ) );
}

on envVar KCAN_TSK_06_alt
{
    _mGateway_73.TSK_06_alt.phys = getValue( this );
    Gateway_73Changed();
}

on envVar eTSK_Hauptschalter_GRA_ACCS
{
    putValue( KCAN_TSK_Hauptschalter_GRA_ACC, getValue( this ) );
}

on envVar KCAN_TSK_Hauptschalter_GRA_ACC
{
    _mGateway_73.TSK_Hauptschalter_GRA_ACC.phys = getValue( this );
    Gateway_73Changed();
}

on Timer _tGateway_77
{
    if( getValue( eTGateway_77 ) <= 0)  putValue( eSendGateway_77, 0 );
    if( ( getValue( eSendEnabled ) && getValue( eSendGateway_77 )) || getValue( eDlcOnceGateway_77 ))  sendGateway_77();
}

on envVar eSendGateway_77
{
    if( getValue( eSendEnabled ) && getValue( eSendGateway_77 ))  sendGateway_77();
}

on envVar eTimeoutGateway_77
{
    cancelTimer( _tGateway_77 );
    cancelTimer( _totGateway_77 );
    if( getValue( this ))
        setTimer( _totGateway_77, ( getValue( eSendEnabled ) && getValue( eSendGateway_77 ) && ( getValue( eTOTGateway_77 ) > 0)) ? getValue( eTOTGateway_77 ) : 1 );
    else
        if( getValue( eSendEnabled ) && getValue( eSendGateway_77 ))  sendGateway_77();
}

on Timer _totGateway_77
{
    putValue( eTimeoutGateway_77, 0 );
}

on envVar eDlcOnceGateway_77
{
    if( getValue( eDlcOnceGateway_77 ) && !( getValue( eSendEnabled ) && getValue( eSendGateway_77 )))  setTimer( _tGateway_77, 1 );
}

void sendGateway_77()
{
    if( getValue( eChangeGateway_77))
    {
        if( getValue( eDlcOnceGateway_77 ) || getValue( eDlcWrongGateway_77 ))
        {
            putValue( eDlcOnceGateway_77, 0 );
            _mGateway_77.DLC = getValue( eDlcGateway_77 );
        }
        else
        {
            _mGateway_77.DLC = 8;
        }
    }
    else
    {
        _mGateway_77.DLC = 8;
    }

    output( _mGateway_77 );
    cancelTimer( _tGateway_77 );
    if( getValue( eTGateway_77 ) > 0)  setTimer( _tGateway_77, getValue( eTGateway_77 ) );  else  setTimer( _tGateway_77, 1 );
}

Gateway_77Changed()
{
}

on envVar KCAN_AWV_03_alt
{
    _mGateway_77.AWV_03_alt.phys = getValue( this );
    Gateway_77Changed();
}

on envVar KCAN_AWV_Verz_Anf
{
    _mGateway_77.AWV_Verz_Anf.phys = getValue( this );
    Gateway_77Changed();
}

on envVar KCAN_AWV_Verz_Freigabe
{
    _mGateway_77.AWV_Verz_Freigabe.phys = getValue( this );
    Gateway_77Changed();
}

on envVar KCAN_AWV_Zielobjekttyp
{
    _mGateway_77.AWV_Zielobjekttyp.phys = getValue( this );
    Gateway_77Changed();
}

on envVar KCAN_Bel_DiETa_Mode
{
    _mGateway_77.Bel_DiETa_Mode.phys = getValue( this );
    Gateway_77Changed();
}

on envVar KCAN_EBKV_03_alt
{
    _mGateway_77.EBKV_03_alt.phys = getValue( this );
    Gateway_77Changed();
}

on envVar KCAN_EBKV_Fahrer_bremst
{
    _mGateway_77.EBKV_Fahrer_bremst.phys = getValue( this );
    Gateway_77Changed();
}

on envVar KCAN_ESP_05_alt_Gateway_77
{
    _mGateway_77.ESP_05_alt.phys = getValue( this );
    Gateway_77Changed();
}

on envVar KCAN_ESP_Bremsdruck
{
    _mGateway_77.ESP_Bremsdruck.phys = getValue( this );
    Gateway_77Changed();
}

on envVar eGE_SumpftemperaturS
{
    putValue( KCAN_GE_Sumpftemperatur, getValue( this ) );
}

on envVar KCAN_GE_Sumpftemperatur
{
    _mGateway_77.GE_Sumpftemperatur.phys = getValue( this );
    Gateway_77Changed();
}

on envVar KCAN_Getriebe_14_alt_Gateway_77
{
    _mGateway_77.Getriebe_14_alt.phys = getValue( this );
    Gateway_77Changed();
}

on envVar KCAN_MO_Fahrpedalrohwert_01
{
    _mGateway_77.MO_Fahrpedalrohwert_01.phys = getValue( this );
    Gateway_77Changed();
}

on envVar KCAN_MO_Mom_Ist_Summe
{
    _mGateway_77.MO_Mom_Ist_Summe.phys = getValue( this );
    Gateway_77Changed();
}

on envVar KCAN_Motor_11_alt
{
    _mGateway_77.Motor_11_alt.phys = getValue( this );
    Gateway_77Changed();
}

on envVar KCAN_Motor_20_alt
{
    _mGateway_77.Motor_20_alt.phys = getValue( this );
    Gateway_77Changed();
}

on envVar KCAN_PaCo_DiETa_LED
{
    _mGateway_77.PaCo_DiETa_LED.phys = getValue( this );
    Gateway_77Changed();
}

on envVar KCAN_RTM_Warnstatus
{
    _mGateway_77.RTM_Warnstatus.phys = getValue( this );
    Gateway_77Changed();
}

on Timer _tGateway_78
{
    if( getValue( eTGateway_78 ) <= 0)  putValue( eSendGateway_78, 0 );
    if( ( getValue( eSendEnabled ) && getValue( eSendGateway_78 )) || getValue( eDlcOnceGateway_78 ))  sendGateway_78();
}

on envVar eSendGateway_78
{
    if( getValue( eSendEnabled ) && getValue( eSendGateway_78 ))  sendGateway_78();
}

on envVar eTimeoutGateway_78
{
    cancelTimer( _tGateway_78 );
    cancelTimer( _totGateway_78 );
    if( getValue( this ))
        setTimer( _totGateway_78, ( getValue( eSendEnabled ) && getValue( eSendGateway_78 ) && ( getValue( eTOTGateway_78 ) > 0)) ? getValue( eTOTGateway_78 ) : 1 );
    else
        if( getValue( eSendEnabled ) && getValue( eSendGateway_78 ))  sendGateway_78();
}

on Timer _totGateway_78
{
    putValue( eTimeoutGateway_78, 0 );
}

on envVar eDlcOnceGateway_78
{
    if( getValue( eDlcOnceGateway_78 ) && !( getValue( eSendEnabled ) && getValue( eSendGateway_78 )))  setTimer( _tGateway_78, 1 );
}

void sendGateway_78()
{
    if( getValue( eChangeGateway_78))
    {
        if( getValue( eDlcOnceGateway_78 ) || getValue( eDlcWrongGateway_78 ))
        {
            putValue( eDlcOnceGateway_78, 0 );
            _mGateway_78.DLC = getValue( eDlcGateway_78 );
        }
        else
        {
            _mGateway_78.DLC = 8;
        }
    }
    else
    {
        _mGateway_78.DLC = 8;
    }
    output( _mGateway_78 );
    cancelTimer( _tGateway_78 );
    if( getValue( eTGateway_78 ) > 0)  setTimer( _tGateway_78, getValue( eTGateway_78 ) );  else  setTimer( _tGateway_78, 1 );
}

Gateway_78Changed()
{
}

on envVar KCAN_Areaview_01_alt
{
    _mGateway_78.Areaview_01_alt.phys = getValue( this );
    Gateway_78Changed();
}

on envVar KCAN_AV_Umfeldbeleuchtung_Anf
{
    _mGateway_78.AV_Umfeldbeleuchtung_Anf.phys = getValue( this );
    Gateway_78Changed();
}

on envVar KCAN_EBKV_03_alt_Gateway_78
{
    _mGateway_78.EBKV_03_alt.phys = getValue( this );
    Gateway_78Changed();
}

on envVar KCAN_EBKV_Fahrer_bremst_Gateway_78
{
    _mGateway_78.EBKV_Fahrer_bremst.phys = getValue( this );
    Gateway_78Changed();
}

on envVar KCAN_EBKV_QBit_Fahrer_bremst
{
    _mGateway_78.EBKV_QBit_Fahrer_bremst.phys = getValue( this );
    Gateway_78Changed();
}

on envVar eEFF_Verbrauch_STH
{
    putValue( KCAN_EFF_Verbrauch_STH, getValue( this ) );
}

on envVar KCAN_EFF_Verbrauch_STH
{
    _mGateway_78.EFF_Verbrauch_STH.phys = getValue( this );
    Gateway_78Changed();
}

on envVar KCAN_EPS_Lastinfo
{
    _mGateway_78.EPS_Lastinfo.phys = getValue( this );
    Gateway_78Changed();
}

on envVar KCAN_ESP_50_alt_Gateway_78
{
    _mGateway_78.ESP_50_alt.phys = getValue( this );
    Gateway_78Changed();
}

on envVar KCAN_ESP_Bremsdruck_Gateway_78
{
    _mGateway_78.ESP_Bremsdruck.phys = getValue( this );
    Gateway_78Changed();
}

on envVar KCAN_ESP_QBit_Bremsdruck
{
    _mGateway_78.ESP_QBit_Bremsdruck.phys = getValue( this );
    Gateway_78Changed();
}

on envVar KCAN_LH_EPS_02_alt
{
    _mGateway_78.LH_EPS_02_alt.phys = getValue( this );
    Gateway_78Changed();
}

on envVar KCAN_LIN_2_alt
{
    _mGateway_78.LIN_2_alt.phys = getValue( this );
    Gateway_78Changed();
}

on envVar KCAN_LR_HZG_01_alt
{
    _mGateway_78.LR_HZG_01_alt.phys = getValue( this );
    Gateway_78Changed();
}

on envVar KCAN_LR_HZG_Konfiguration
{
    _mGateway_78.LR_HZG_Konfiguration.phys = getValue( this );
    Gateway_78Changed();
}

on envVar KCAN_LR_HZG_Taster_on_off
{
    _mGateway_78.LR_HZG_Taster_on_off.phys = getValue( this );
    Gateway_78Changed();
}

on envVar KCAN_LR_HZG_Temp_Sensor
{
    _mGateway_78.LR_HZG_Temp_Sensor.phys = getValue( this );
    Gateway_78Changed();
}

on envVar KCAN_MFL_Signalhorn
{
    _mGateway_78.MFL_Signalhorn.phys = getValue( this );
    Gateway_78Changed();
}

on envVar KCAN_MO_Fahrpedalrohwert_01_Gateway_78
{
    _mGateway_78.MO_Fahrpedalrohwert_01.phys = getValue( this );
    Gateway_78Changed();
}

on envVar KCAN_MO_QBit_Fahrpedalwerte_01
{
    _mGateway_78.MO_QBit_Fahrpedalwerte_01.phys = getValue( this );
    Gateway_78Changed();
}

on envVar KCAN_MO_temporaere_Fahrerabwesenheit
{
    _mGateway_78.MO_temporaere_Fahrerabwesenheit.phys = getValue( this );
    Gateway_78Changed();
}

on envVar KCAN_Motor_20_alt_Gateway_78
{
    _mGateway_78.Motor_20_alt.phys = getValue( this );
    Gateway_78Changed();
}

on envVar KCAN_Parkhilfe_01_alt_Gateway_78
{
    _mGateway_78.Parkhilfe_01_alt.phys = getValue( this );
    Gateway_78Changed();
}

on envVar ePH_StoermeldungS
{
    putValue( KCAN_PH_Stoermeldung, getValue( this ) );
}

on envVar KCAN_PH_Stoermeldung
{
    _mGateway_78.PH_Stoermeldung.phys = getValue( this );
    Gateway_78Changed();
}

on Timer _tGNSS_01
{
    if( getValue( eTGNSS_01 ) <= 0)  putValue( eSendGNSS_01, 0 );
    if( ( getValue( eSendEnabled ) && getValue( eSendGNSS_01 )) || getValue( eDlcOnceGNSS_01 ))  sendGNSS_01();
}

on envVar eSendGNSS_01
{
    if( getValue( eSendEnabled ) && getValue( eSendGNSS_01 ))  sendGNSS_01();
}

on envVar eTimeoutGNSS_01
{
    cancelTimer( _tGNSS_01 );
    cancelTimer( _totGNSS_01 );
    if( getValue( this ))
        setTimer( _totGNSS_01, ( getValue( eSendEnabled ) && getValue( eSendGNSS_01 ) && ( getValue( eTOTGNSS_01 ) > 0)) ? getValue( eTOTGNSS_01 ) : 1 );
    else
        if( getValue( eSendEnabled ) && getValue( eSendGNSS_01 ))  sendGNSS_01();
}

on Timer _totGNSS_01
{
    putValue( eTimeoutGNSS_01, 0 );
}

on envVar eDlcOnceGNSS_01
{
    if( getValue( eDlcOnceGNSS_01 ) && !( getValue( eSendEnabled ) && getValue( eSendGNSS_01 )))  setTimer( _tGNSS_01, 1 );
}

void sendGNSS_01()
{
    if( getValue( eChangeGNSS_01 ))
    {
        if( getValue( eDlcOnceGNSS_01 ) || getValue( eDlcWrongGNSS_01 ))
        {
            putValue( eDlcOnceGNSS_01, 0 );
            _mGNSS_01.DLC = getValue( eDlcGNSS_01 );
        }
        else
        {
            _mGNSS_01.DLC = 8;
        }
    }
    else
    {
        _mGNSS_01.DLC = 8;
    }

    output( _mGNSS_01 );
    cancelTimer( _tGNSS_01 );
    if( getValue( eTGNSS_01 ) > 0)  setTimer( _tGNSS_01, getValue( eTGNSS_01 ) );  else  setTimer( _tGNSS_01, 1 );
}

GNSS_01Changed()
{
}

on envVar KCAN_GNSS_Breite_Ortung
{
    _mGNSS_01.GNSS_Breite_Ortung.phys = getValue( this );
    GNSS_01Changed();
}

on envVar KCAN_GNSS_Fehlerzustand
{
    _mGNSS_01.GNSS_Fehlerzustand.phys = getValue( this );
    GNSS_01Changed();
}

on envVar KCAN_GNSS_Laenge_Ortung
{
    _mGNSS_01.GNSS_Laenge_Ortung.phys = getValue( this );
    GNSS_01Changed();
}

on envVar KCAN_GNSS_Nachrichtenpaket_ID1
{
    _mGNSS_01.GNSS_Nachrichtenpaket_ID1.phys = getValue( this );
    GNSS_01Changed();
}

on envVar KCAN_GNSS_Ortung_FIX_Typ
{
    _mGNSS_01.GNSS_Ortung_FIX_Typ.phys = getValue( this );
    GNSS_01Changed();
}

on envVar KCAN_GNSS_Richtung_Breite_Ortung
{
    _mGNSS_01.GNSS_Richtung_Breite_Ortung.phys = getValue( this );
    GNSS_01Changed();
}

on envVar KCAN_GNSS_Richtung_Laenge_Ortung
{
    _mGNSS_01.GNSS_Richtung_Laenge_Ortung.phys = getValue( this );
    GNSS_01Changed();
}

on Timer _tGNSS_02
{
    if( getValue( eTGNSS_02 ) <= 0)  putValue( eSendGNSS_02, 0 );
    if( ( getValue( eSendEnabled ) && getValue( eSendGNSS_02 )) || getValue( eDlcOnceGNSS_02 ))  sendGNSS_02();
}

on envVar eSendGNSS_02
{
    if( getValue( eSendEnabled ) && getValue( eSendGNSS_02 ))  sendGNSS_02();
}

on envVar eTimeoutGNSS_02
{
    cancelTimer( _tGNSS_02 );
    cancelTimer( _totGNSS_02 );
    if( getValue( this ))
        setTimer( _totGNSS_02, ( getValue( eSendEnabled ) && getValue( eSendGNSS_02 ) && ( getValue( eTOTGNSS_02 ) > 0)) ? getValue( eTOTGNSS_02 ) : 1 );
    else
        if( getValue( eSendEnabled ) && getValue( eSendGNSS_02 ))  sendGNSS_02();
}

on Timer _totGNSS_02
{
    putValue( eTimeoutGNSS_02, 0 );
}

on envVar eDlcOnceGNSS_02
{
    if( getValue( eDlcOnceGNSS_02 ) && !( getValue( eSendEnabled ) && getValue( eSendGNSS_02 )))  setTimer( _tGNSS_02, 1 );
}

void sendGNSS_02()
{
    if( getValue( eChangeGNSS_02 ))
    {
        if( getValue( eDlcOnceGNSS_02 ) || getValue( eDlcWrongGNSS_02 ))
        {
            putValue( eDlcOnceGNSS_02, 0 );
            _mGNSS_02.DLC = getValue( eDlcGNSS_02 );
        }
        else
        {
            _mGNSS_02.DLC = 8;
        }
    }
    else
    {
        _mGNSS_02.DLC = 8;
    }
    output( _mGNSS_02 );
    cancelTimer( _tGNSS_02 );
    if( getValue( eTGNSS_02 ) > 0)  setTimer( _tGNSS_02, getValue( eTGNSS_02 ) );  else  setTimer( _tGNSS_02, 1 );
}

GNSS_02Changed()
{
}

on envVar KCAN_GNSS_Nachrichtenpaket_ID2
{
    _mGNSS_02.GNSS_Nachrichtenpaket_ID2.phys = getValue( this );
    GNSS_02Changed();
}

on envVar eGNSS_Ortung_2D_Geschw_ue_GrundS
{
    putValue( KCAN_GNSS_Ortung_2D_Geschw_ue_Grund, getValue( this ) );
}

on envVar KCAN_GNSS_Ortung_2D_Geschw_ue_Grund
{
    _mGNSS_02.GNSS_Ortung_2D_Geschw_ue_Grund.phys = getValue( this );
    GNSS_02Changed();
}

on envVar KCAN_GNSS_Ortung_Ausrichtung
{
    _mGNSS_02.GNSS_Ortung_Ausrichtung.phys = getValue( this );
    GNSS_02Changed();
}

on envVar KCAN_GNSS_Ortung_Latenz
{
    _mGNSS_02.GNSS_Ortung_Latenz.phys = getValue( this );
    GNSS_02Changed();
}

on envVar KCAN_GNSS_Ortung_Noerdliche_Geschw
{
    _mGNSS_02.GNSS_Ortung_Noerdliche_Geschw.phys = getValue( this );
    GNSS_02Changed();
}

on envVar KCAN_GNSS_Ortung_Oestliche_Geschw
{
    _mGNSS_02.GNSS_Ortung_Oestliche_Geschw.phys = getValue( this );
    GNSS_02Changed();
}

on envVar KCAN_GNSS_Ortung_Vertikale_Geschw
{
    _mGNSS_02.GNSS_Ortung_Vertikale_Geschw.phys = getValue( this );
    GNSS_02Changed();
}

on Timer _tGNSS_03
{
    if( getValue( eTGNSS_03 ) <= 0)  putValue( eSendGNSS_03, 0 );
    if( ( getValue( eSendEnabled ) && getValue( eSendGNSS_03 )) || getValue( eDlcOnceGNSS_03 ))  sendGNSS_03();
}

on envVar eSendGNSS_03
{
    if( getValue( eSendEnabled ) && getValue( eSendGNSS_03 ))  sendGNSS_03();
}

on envVar eTimeoutGNSS_03
{
    cancelTimer( _tGNSS_03 );
    cancelTimer( _totGNSS_03 );
    if( getValue( this ))
        setTimer( _totGNSS_03, ( getValue( eSendEnabled ) && getValue( eSendGNSS_03 ) && ( getValue( eTOTGNSS_03 ) > 0)) ? getValue( eTOTGNSS_03 ) : 1 );
    else
        if( getValue( eSendEnabled ) && getValue( eSendGNSS_03 ))  sendGNSS_03();
}

on Timer _totGNSS_03
{
    putValue( eTimeoutGNSS_03, 0 );
}

on envVar eDlcOnceGNSS_03
{
    if( getValue( eDlcOnceGNSS_03 ) && !( getValue( eSendEnabled ) && getValue( eSendGNSS_03 )))  setTimer( _tGNSS_03, 1 );
}

void sendGNSS_03()
{
    if( getValue( eChangeGNSS_03 ))
    {
        if( getValue( eDlcOnceGNSS_03 ) || getValue( eDlcWrongGNSS_03 ))
        {
            putValue( eDlcOnceGNSS_03, 0 );
            _mGNSS_03.DLC = getValue( eDlcGNSS_03 );
        }
        else
        {
            _mGNSS_03.DLC = 8;
        }
    }
    else
    {
        _mGNSS_03.DLC = 8;
    }
    output( _mGNSS_03 );
    cancelTimer( _tGNSS_03 );
    if( getValue( eTGNSS_03 ) > 0)  setTimer( _tGNSS_03, getValue( eTGNSS_03 ) );  else  setTimer( _tGNSS_03, 1 );
}

GNSS_03Changed()
{
}

on envVar KCAN_GNSS_Nachrichtenpaket_ID3
{
    _mGNSS_03.GNSS_Nachrichtenpaket_ID3.phys = getValue( this );
    GNSS_03Changed();
}

on envVar KCAN_GNSS_Ortung_GDOP
{
    _mGNSS_03.GNSS_Ortung_GDOP.phys = getValue( this );
    GNSS_03Changed();
}

on envVar KCAN_GNSS_Ortung_Guete_Ausrichtung
{
    _mGNSS_03.GNSS_Ortung_Guete_Ausrichtung.phys = getValue( this );
    GNSS_03Changed();
}

on envVar eGNSS_Ortung_Guete_GeschwindigkS
{
    putValue( KCAN_GNSS_Ortung_Guete_Geschwindigk, getValue( this ) );
}

on envVar KCAN_GNSS_Ortung_Guete_Geschwindigk
{
    _mGNSS_03.GNSS_Ortung_Guete_Geschwindigk.phys = getValue( this );
    GNSS_03Changed();
}

on envVar KCAN_GNSS_Ortung_Guete_horizontal
{
    _mGNSS_03.GNSS_Ortung_Guete_horizontal.phys = getValue( this );
    GNSS_03Changed();
}

on envVar KCAN_GNSS_Ortung_Guete_vertikal
{
    _mGNSS_03.GNSS_Ortung_Guete_vertikal.phys = getValue( this );
    GNSS_03Changed();
}

on envVar KCAN_GNSS_Ortung_HDOP
{
    _mGNSS_03.GNSS_Ortung_HDOP.phys = getValue( this );
    GNSS_03Changed();
}

on envVar KCAN_GNSS_Ortung_PDOP
{
    _mGNSS_03.GNSS_Ortung_PDOP.phys = getValue( this );
    GNSS_03Changed();
}

on envVar KCAN_GNSS_Ortung_VDOP
{
    _mGNSS_03.GNSS_Ortung_VDOP.phys = getValue( this );
    GNSS_03Changed();
}

on Timer _tGNSS_05
{
    if( getValue( eTGNSS_05 ) <= 0)  putValue( eSendGNSS_05, 0 );
    if( ( getValue( eSendEnabled ) && getValue( eSendGNSS_05 )) || getValue( eDlcOnceGNSS_05 ))  sendGNSS_05();
}

on envVar eSendGNSS_05
{
    if( getValue( eSendEnabled ) && getValue( eSendGNSS_05 ))  sendGNSS_05();
    if( getValue( this )== 2) putValue(eTimeoutGNSS_05,1);
}

on envVar eTimeoutGNSS_05
{
    cancelTimer( _tGNSS_05 );
    cancelTimer( _totGNSS_05 );
    if( getValue( this ))
        setTimer( _totGNSS_05, ( getValue( eSendEnabled ) && getValue( eSendGNSS_05 ) && ( getValue( eTOTGNSS_05 ) > 0)) ? getValue( eTOTGNSS_05 ) : 1 );
    else
        if( getValue( eSendEnabled ) && getValue( eSendGNSS_05 ))  sendGNSS_05();
}

on Timer _totGNSS_05
{
    putValue( eTimeoutGNSS_05, 0 );
    putValue( eSendGNSS_05, 1 );
}

on envVar eDlcOnceGNSS_05
{
    if( getValue( eDlcOnceGNSS_05 ) && !( getValue( eSendEnabled ) && getValue( eSendGNSS_05 )))  setTimer( _tGNSS_05, 1 );
}

void sendGNSS_05()
{
    eGNSS_UTC_Zeit_counter=getValue(KCAN_GNSS_UTC_Zeit)+1;

    if(getValue(eGNSS_Nachrichtenpaket_ID5_stop)==0)
    {
        eGNSS_Nachrichtenpaket_ID5=eGNSS_Nachrichtenpaket_ID5+1;
        if( eGNSS_Nachrichtenpaket_ID5 <= 3)
        {
            eGNSS_Nachrichtenpaket_ID5=eGNSS_Nachrichtenpaket_ID5;
        }
        else eGNSS_Nachrichtenpaket_ID5 = 0;
    }

    if( getValue( eChangeGNSS_05 ))
    {
        if( getValue( eDlcOnceGNSS_05 ) || getValue( eDlcWrongGNSS_05 ))
        {
            putValue( eDlcOnceGNSS_05, 0 );
            _mGNSS_05.DLC = getValue( eDlcGNSS_05 );
        }
        else
        {
            _mGNSS_05.DLC = 8;
        }
    }
    else
    {
        _mGNSS_05.DLC = 8;
    }

    putValue( KCAN_GNSS_UTC_Zeit, eGNSS_UTC_Zeit_counter);
    putValue( KCAN_GNSS_Nachrichtenpaket_ID5, eGNSS_Nachrichtenpaket_ID5);
    //write("counter_min: %d",eGNSS_UTC_Zeit_minute);
    //write("counter_h: %d",eGNSS_UTC_Zeit_hour);
    output( _mGNSS_05 );
    cancelTimer( _tGNSS_05 );
    if( getValue( eTGNSS_05 ) > 0)  setTimer( _tGNSS_05, getValue( eTGNSS_05 ) );  else  setTimer( _tGNSS_05, 1 );
}

GNSS_05Changed()
{
}

void UTC_calc()
{
    eGNSS_UTC_Zeit_secound=eGNSS_UTC_Zeit_counter%60;                   putValue( eGNSS_UTC_Zeit_secoundS, eGNSS_UTC_Zeit_secound);
    eGNSS_UTC_Zeit_minute=(eGNSS_UTC_Zeit_counter/60)%60;               putValue( eGNSS_UTC_Zeit_minuteS, eGNSS_UTC_Zeit_minute);
    eGNSS_UTC_Zeit_hour=(eGNSS_UTC_Zeit_counter/(60*60))%24;            putValue( eGNSS_UTC_Zeit_hourS, eGNSS_UTC_Zeit_hour);
    eGNSS_UTC_Zeit_day=(eGNSS_UTC_Zeit_counter/(60*60*24))%365;         putValue( eGNSS_UTC_Zeit_dayS, eGNSS_UTC_Zeit_day);
    eGNSS_UTC_Zeit_year=eGNSS_UTC_Zeit_counter/(60*60*24*365);          putValue( eGNSS_UTC_Zeit_yearS, eGNSS_UTC_Zeit_year);
}

on envVar eGNSS_UTC_calculationS
{
    if (getValue(this)==1)
    {
        eGNSS_UTC_Zeit_newvalue=(getValue(eGNSS_UTC_Zeit_newyearS)*365*24*60*60)+ (getValue(eGNSS_UTC_Zeit_newdayS)*24*60*60)+ (getValue(eGNSS_UTC_Zeit_newhourS)*60*60)+ (getValue(eGNSS_UTC_Zeit_newminuteS)*60)+ getValue(eGNSS_UTC_Zeit_newsecoundS);
        putValue(KCAN_GNSS_UTC_Zeit, eGNSS_UTC_Zeit_newvalue);
        write("eGNSS_UTC_Zeit_newvalue= %d",eGNSS_UTC_Zeit_newvalue);
    }
}

on envVar KCAN_GNSS_Empfaenger_Status
{
    _mGNSS_05.GNSS_Empfaenger_Status.phys = getValue( this );
    GNSS_05Changed();
}

on envVar KCAN_GNSS_Empfangbare_Satelliten
{
    _mGNSS_05.GNSS_Empfangbare_Satelliten.phys = getValue( this );
    GNSS_05Changed();
}

on envVar KCAN_GNSS_Genutzte_Satelliten
{
    _mGNSS_05.GNSS_Genutzte_Satelliten.phys = getValue( this );
    GNSS_05Changed();
}

on envVar KCAN_GNSS_GLONASS_in_Nutzung
{
    _mGNSS_05.GNSS_GLONASS_in_Nutzung.phys = getValue( this );
    GNSS_05Changed();
}

on envVar KCAN_GNSS_GPS_in_Nutzung
{
    _mGNSS_05.GNSS_GPS_in_Nutzung.phys = getValue( this );
    GNSS_05Changed();
}

on envVar KCAN_GNSS_Nachrichtenpaket_ID5
{
    _mGNSS_05.GNSS_Nachrichtenpaket_ID5.phys = getValue( this );
    GNSS_05Changed();
}

on envVar KCAN_GNSS_Sichtbare_Satelliten
{
    _mGNSS_05.GNSS_Sichtbare_Satelliten.phys = getValue( this );
    GNSS_05Changed();
}

on envVar KCAN_GNSS_UTC_Zeit
{
    UTC_calc();
    _mGNSS_05.GNSS_UTC_Zeit.phys = getValue( this );
    GNSS_05Changed();
}


// GNSS_07 begin
// moved to message_GNSS_07.cin
// GNSS_07 end

on Timer _tHVEM_04
{
    if( getValue( eTHVEM_04 ) <= 0)  putValue( eSendHVEM_04, 0 );
    if( ( getValue( eSendEnabled ) && getValue( eSendHVEM_04 )) || getValue( eDlcOnceHVEM_04 ))  sendHVEM_04();
}

on envVar eSendHVEM_04
{
    if( getValue( eSendEnabled ) && getValue( eSendHVEM_04 ))  sendHVEM_04();
}

on envVar eTimeoutHVEM_04
{
    cancelTimer( _tHVEM_04 );
    cancelTimer( _totHVEM_04 );
    if( getValue( this ))
        setTimer( _totHVEM_04, ( getValue( eSendEnabled ) && getValue( eSendHVEM_04 ) && ( getValue( eTOTHVEM_04 ) > 0)) ? getValue( eTOTHVEM_04 ) : 1 );
    else
        if( getValue( eSendEnabled ) && getValue( eSendHVEM_04 ))  sendHVEM_04();
}

on Timer _totHVEM_04
{
    putValue( eTimeoutHVEM_04, 0 );
}

on envVar eDlcOnceHVEM_04
{
    if( getValue( eDlcOnceHVEM_04 ) && !( getValue( eSendEnabled ) && getValue( eSendHVEM_04 )))  setTimer( _tHVEM_04, 1 );
}

void sendHVEM_04()
{
    if( getValue( eChangeHVEM_04))
    {
        if( getValue( eDlcOnceHVEM_04 ) || getValue( eDlcWrongHVEM_04 ))
        {
            putValue( eDlcOnceHVEM_04, 0 );
            _mHVEM_04.DLC = getValue( eDlcHVEM_04 );
        }
        else
        {
            _mHVEM_04.DLC = 8;
        }
    }
    else
    {
        _mHVEM_04.DLC = 8;
    }
    output( _mHVEM_04 );
    cancelTimer( _tHVEM_04 );
    if( getValue( eTHVEM_04 ) > 0)  setTimer( _tHVEM_04, getValue( eTHVEM_04 ) );  else  setTimer( _tHVEM_04, 1 );
}

HVEM_04Changed()
{
}

on envVar KCAN_HVEM_Abschaltstatus
{
    _mHVEM_04.HVEM_Abschaltstatus.phys = getValue( this );
    HVEM_04Changed();
}

on envVar eHVEM_Anf_ReichweiteNVS
{
    putValue( KCAN_HVEM_Anf_ReichweiteNV, getValue( this ) );
}

on envVar KCAN_HVEM_Anf_ReichweiteNV
{
    _mHVEM_04.HVEM_Anf_ReichweiteNV.phys = getValue( this );
    HVEM_04Changed();
}

on envVar KCAN_HVEM_DCDC_Freigabe
{
    _mHVEM_04.HVEM_DCDC_Freigabe.phys = getValue( this );
    HVEM_04Changed();
}

on envVar KCAN_HVEM_FreigabeKlimatisierung
{
    _mHVEM_04.HVEM_FreigabeKlimatisierung.phys = getValue( this );
    HVEM_04Changed();
}

on envVar eHVEM_HV_AnfS
{
    putValue( KCAN_HVEM_HV_Anf, getValue( this ) );
}

on envVar KCAN_HVEM_HV_Anf
{
    _mHVEM_04.HVEM_HV_Anf.phys = getValue( this );
    HVEM_04Changed();
}

on envVar eHVEM_KlimaMaxHVStromS
{
    putValue( KCAN_HVEM_KlimaMaxHVStrom, getValue( this ) );
}

on envVar KCAN_HVEM_KlimaMaxHVStrom
{
    _mHVEM_04.HVEM_KlimaMaxHVStrom.phys = getValue( this );
    HVEM_04Changed();
}

on envVar KCAN_HVEM_LadeklappenVerr_Anf
{
    _mHVEM_04.HVEM_LadeklappenVerr_Anf.phys = getValue( this );
    HVEM_04Changed();
}

on envVar KCAN_HVEM_Ladesteckerentr_Anf
{
    _mHVEM_04.HVEM_Ladesteckerentr_Anf.phys = getValue( this );
    HVEM_04Changed();
}

on envVar KCAN_HVEM_Leistung_Bat_Kond_Vorgabe
{
    _mHVEM_04.HVEM_Leistung_Bat_Kond_Vorgabe.phys = getValue( this );
    HVEM_04Changed();
}

on envVar eHVEM_LeistungsAnfS
{
    putValue( KCAN_HVEM_LeistungsAnf, getValue( this ) );
}

on envVar KCAN_HVEM_LeistungsAnf
{
    _mHVEM_04.HVEM_LeistungsAnf.phys = getValue( this );
    HVEM_04Changed();
}

on envVar KCAN_HVEM_Max_VK_Betriebsdauer
{
    _mHVEM_04.HVEM_Max_VK_Betriebsdauer.phys = getValue( this );
    HVEM_04Changed();
}

on envVar eHVEM_Nachlad_StatusS
{
    putValue( KCAN_HVEM_Nachlad_Status, getValue( this ) );
}

on envVar KCAN_HVEM_Nachlad_Status
{
    _mHVEM_04.HVEM_Nachlad_Status.phys = getValue( this );
    HVEM_04Changed();
}

on envVar eHVEM_Nachladen_AnfS
{
    putValue( KCAN_HVEM_Nachladen_Anf, getValue( this ) );
}

on envVar KCAN_HVEM_Nachladen_Anf
{
    _mHVEM_04.HVEM_Nachladen_Anf.phys = getValue( this );
    HVEM_04Changed();
}

on envVar eHVEM_NVLeistungEmpfS
{
    putValue( KCAN_HVEM_NVLeistungEmpf, getValue( this ) );
}

on envVar KCAN_HVEM_NVLeistungEmpf
{
    _mHVEM_04.HVEM_NVLeistungEmpf.phys = getValue( this );
    HVEM_04Changed();
}

on envVar eHVEM_Text_1S
{
    putValue( KCAN_HVEM_Text_1, getValue( this ) );
}

on envVar KCAN_HVEM_Text_1
{
    _mHVEM_04.HVEM_Text_1.phys = getValue( this );
    HVEM_04Changed();
}

on Timer _tHVK_01
{
    if( getValue( eTHVK_01 ) <= 0)  putValue( eSendHVK_01, 0 );
    if( ( getValue( eSendEnabled ) && getValue( eSendHVK_01 )) || getValue( eDlcOnceHVK_01 ))  sendHVK_01();
}

on envVar eSendHVK_01
{
    if( getValue( eSendEnabled ) && getValue( eSendHVK_01 ))  sendHVK_01();
}

on envVar eTimeoutHVK_01
{
    cancelTimer( _tHVK_01 );
    cancelTimer( _totHVK_01 );
    if( getValue( this ))
        setTimer( _totHVK_01, ( getValue( eSendEnabled ) && getValue( eSendHVK_01 ) && ( getValue( eTOTHVK_01 ) > 0)) ? getValue( eTOTHVK_01 ) : 1 );
    else
        if( getValue( eSendEnabled ) && getValue( eSendHVK_01 ))  sendHVK_01();
}

on Timer _totHVK_01
{
    putValue( eTimeoutHVK_01, 0 );
}

on envVar eDlcOnceHVK_01
{
    if( getValue( eDlcOnceHVK_01 ) && !( getValue( eSendEnabled ) && getValue( eSendHVK_01 )))  setTimer( _tHVK_01, 1 );
}

void sendHVK_01()
{
    if( getValue( eChangeHVK_01))
    {
        if( getValue( eDlcOnceHVK_01 ) || getValue( eDlcWrongHVK_01 ))
        {
            putValue( eDlcOnceHVK_01, 0 );
            _mHVK_01.DLC = getValue( eDlcHVK_01 );
        }
        else
        {
                    _mHVK_01.DLC = 8;
                }
    }
    else
    {
        _mHVK_01.DLC = 8;
    }
    {
        output( _mHVK_01 );
    }

    cancelTimer( _tHVK_01 );
    if( getValue( eTHVK_01 ) > 0)  setTimer( _tHVK_01, getValue( eTHVK_01 ) );  else  setTimer( _tHVK_01, 1 );
}

HVK_01Changed()
{
}

on envVar eHV_Bordnetz_aktivS_HVK_01
{
    putValue( KCAN_HV_Bordnetz_aktiv_HVK_01, getValue( this ) );
}

on envVar KCAN_HV_Bordnetz_aktiv_HVK_01
{
    _mHVK_01.HV_Bordnetz_aktiv.phys = getValue( this );
    HVK_01Changed();
}

on envVar KCAN_HV_Bordnetz_Fehler_HVK_01
{
    _mHVK_01.HV_Bordnetz_Fehler.phys = getValue( this );
    HVK_01Changed();
}

on envVar KCAN_HVK_AktiveEntladung_Anf
{
    _mHVK_01.HVK_AktiveEntladung_Anf.phys = getValue( this );
    HVK_01Changed();
}

on envVar KCAN_HVK_BMS_Sollmodus
{
    _mHVK_01.HVK_BMS_Sollmodus.phys = getValue( this );
    HVK_01Changed();
}

on envVar KCAN_HVK_DCDC_Sollmodus
{
    _mHVK_01.HVK_DCDC_Sollmodus.phys = getValue( this );
    HVK_01Changed();
}

on envVar KCAN_HVK_EKK_Sollmodus
{
    _mHVK_01.HVK_EKK_Sollmodus.phys = getValue( this );
    HVK_01Changed();
}

on envVar eHVK_Gesamtst_SpgfreiheitS
{
    putValue( KCAN_HVK_Gesamtst_Spgfreiheit, getValue( this ) );
}

on envVar KCAN_HVK_Gesamtst_Spgfreiheit
{
    _mHVK_01.HVK_Gesamtst_Spgfreiheit.phys = getValue( this );
    HVK_01Changed();
}

on envVar KCAN_HVK_HV_Netz_Warnungen
{
    _mHVK_01.HVK_HV_Netz_Warnungen.phys = getValue( this );
    HVK_01Changed();
}

on envVar KCAN_HVK_HVEM_Freigabe
{
    _mHVK_01.HVK_HVEM_Freigabe.phys = getValue( this );
    HVK_01Changed();
}

on envVar KCAN_HVK_HVLM_Sollmodus
{
    _mHVK_01.HVK_HVLM_Sollmodus.phys = getValue( this );
    HVK_01Changed();
}

on envVar KCAN_HVK_HVPTC_Sollmodus
{
    _mHVK_01.HVK_HVPTC_Sollmodus.phys = getValue( this );
    HVK_01Changed();
}

on envVar KCAN_HVK_Iso_Messung_Start
{
    _mHVK_01.HVK_Iso_Messung_Start.phys = getValue( this );
    HVK_01Changed();
}

on envVar KCAN_HVK_Istmodus_Anf
{
    _mHVK_01.HVK_Istmodus_Anf.phys = getValue( this );
    HVK_01Changed();
}

on envVar KCAN_HVK_Ladebereit
{
    _mHVK_01.HVK_Ladebereit.phys = getValue( this );
    HVK_01Changed();
}

on envVar KCAN_HVK_Notabschaltung_Anf
{
    _mHVK_01.HVK_Notabschaltung_Anf.phys = getValue( this );
    HVK_01Changed();
}

on envVar KCAN_HVK_PPulsFreigabe
{
    _mHVK_01.HVK_PPulsFreigabe.phys = getValue( this );
    HVK_01Changed();
}

on envVar KCAN_HVK_TN1_Sollmodus
{
    _mHVK_01.HVK_TN1_Sollmodus.phys = getValue( this );
    HVK_01Changed();
}

on envVar KCAN_HVK_Vorladung_aktiv
{
    _mHVK_01.HVK_Vorladung_aktiv.phys = getValue( this );
    HVK_01Changed();
}

on Timer _tHVLM_05
{
    if( getValue( eTHVLM_05 ) <= 0)  putValue( eSendHVLM_05, 0 );
    if( ( getValue( eSendEnabled ) && getValue( eSendHVLM_05 )) || getValue( eDlcOnceHVLM_05 ))  sendHVLM_05();
}

on envVar eSendHVLM_05
{
    if( getValue( eSendEnabled ) && getValue( eSendHVLM_05 ))  sendHVLM_05();
}

on envVar eTimeoutHVLM_05
{
    cancelTimer( _tHVLM_05 );
    cancelTimer( _totHVLM_05 );
    if( getValue( this ))
        setTimer( _totHVLM_05, ( getValue( eSendEnabled ) && getValue( eSendHVLM_05 ) && ( getValue( eTOTHVLM_05 ) > 0)) ? getValue( eTOTHVLM_05 ) : 1 );
    else
        if( getValue( eSendEnabled ) && getValue( eSendHVLM_05 ))  sendHVLM_05();
}

on Timer _totHVLM_05
{
    putValue( eTimeoutHVLM_05, 0 );
}

on envVar eDlcOnceHVLM_05
{
    if( getValue( eDlcOnceHVLM_05 ) && !( getValue( eSendEnabled ) && getValue( eSendHVLM_05 )))  setTimer( _tHVLM_05, 1 );
}

void sendHVLM_05()
{
    if( getValue( eChangeHVLM_05))
    {
        if( getValue( eDlcOnceHVLM_05 ) || getValue( eDlcWrongHVLM_05 ))
        {
            putValue( eDlcOnceHVLM_05, 0 );
            _mHVLM_05.DLC = getValue( eDlcHVLM_05 );
        }
        else
        {
            _mHVLM_05.DLC = 8;
        }
    }
    else
    {
        _mHVLM_05.DLC = 8;
    }

    output( _mHVLM_05 );
    cancelTimer( _tHVLM_05 );
    if( getValue( eTHVLM_05 ) > 0)  setTimer( _tHVLM_05, getValue( eTHVLM_05 ) );  else  setTimer( _tHVLM_05, 1 );
}

HVLM_05Changed()
{
}

on envVar eHVLM_AnzeigetexteS
{
    putValue( KCAN_HVLM_Anzeigetexte, getValue( this ) );
}

on envVar KCAN_HVLM_Anzeigetexte
{
    _mHVLM_05.HVLM_Anzeigetexte.phys = getValue( this );
    HVLM_05Changed();
}

on envVar KCAN_HVLM_Bat_Konditionierung_Anf
{
    _mHVLM_05.HVLM_Bat_Konditionierung_Anf.phys = getValue( this );
    HVLM_05Changed();
}

on envVar eHVLM_Bat_laden_aktivS
{
    putValue( KCAN_HVLM_Bat_laden_aktiv, getValue( this ) );
}

on envVar KCAN_HVLM_Bat_laden_aktiv
{
    _mHVLM_05.HVLM_Bat_laden_aktiv.phys = getValue( this );
    HVLM_05Changed();
}

on envVar KCAN_HVLM_Fehler_Ladestecker
{
    _mHVLM_05.HVLM_Fehler_Ladestecker.phys = getValue( this );
    HVLM_05Changed();
}

on envVar KCAN_HVLM_Fehler_Verriegelung
{
    _mHVLM_05.HVLM_Fehler_Verriegelung.phys = getValue( this );
    HVLM_05Changed();
}

on envVar KCAN_HVLM_FSH_Anf
{
    _mHVLM_05.HVLM_FSH_Anf.phys = getValue( this );
    HVLM_05Changed();
}

on envVar KCAN_HVLM_HSH_Anf
{
    _mHVLM_05.HVLM_HSH_Anf.phys = getValue( this );
    HVLM_05Changed();
}

on envVar KCAN_HVLM_HV_Anf
{
    _mHVLM_05.HVLM_HV_Anf.phys = getValue( this );
    HVLM_05Changed();
}

on envVar KCAN_HVLM_HVEM_MaxLeistung
{
    _mHVLM_05.HVLM_HVEM_MaxLeistung.phys = getValue( this );
    HVLM_05Changed();
}

on envVar eHVLM_Klima_TempS
{
    putValue( KCAN_HVLM_Klima_Temp, getValue( this ) );
}

on envVar KCAN_HVLM_Klima_Temp
{
    _mHVLM_05.HVLM_Klima_Temp.phys = getValue( this );
    HVLM_05Changed();
}

on envVar eHVLM_LadeartS
{
    putValue( KCAN_HVLM_Ladeart, getValue( this ) );
}

on envVar KCAN_HVLM_Ladeart
{
    _mHVLM_05.HVLM_Ladeart.phys = getValue( this );
    HVLM_05Changed();
}

on envVar eHVLM_Lademodus_HV_BatS
{
    putValue( KCAN_HVLM_Lademodus_HV_Bat, getValue( this ) );
}

on envVar KCAN_HVLM_Lademodus_HV_Bat
{
    _mHVLM_05.HVLM_Lademodus_HV_Bat.phys = getValue( this );
    HVLM_05Changed();
}

on envVar eHVLM_LadesystemhinweiseS
{
    putValue( KCAN_HVLM_Ladesystemhinweise, getValue( this ) );
}

on envVar KCAN_HVLM_Ladesystemhinweise
{
    _mHVLM_05.HVLM_Ladesystemhinweise.phys = getValue( this );
    HVLM_05Changed();
}

on envVar eHVLM_Langzeit_LadenS
{
    putValue( KCAN_HVLM_Langzeit_Laden, getValue( this ) );
}

on envVar KCAN_HVLM_Langzeit_Laden
{
    _mHVLM_05.HVLM_Langzeit_Laden.phys = getValue( this );
    HVLM_05Changed();
}

on envVar eHVLM_Restladezeit_HV_Bat_02S
{
    putValue( KCAN_HVLM_Restladezeit_HV_Bat_02, getValue( this ) );
}

on envVar KCAN_HVLM_Restladezeit_HV_Bat_02
{
    _mHVLM_05.HVLM_Restladezeit_HV_Bat_02.phys = getValue( this );
    HVLM_05Changed();
}

on envVar KCAN_HVLM_Standklima_Timer_Status
{
    _mHVLM_05.HVLM_Standklima_Timer_Status.phys = getValue( this );
    HVLM_05Changed();
}

on envVar KCAN_HVLM_Status_Netz
{
    _mHVLM_05.HVLM_Status_Netz.phys = getValue( this );
    HVLM_05Changed();
}

on envVar eHVLM_Stecker_StatusS
{
    putValue( KCAN_HVLM_Stecker_Status, getValue( this ) );
}

on envVar KCAN_HVLM_Stecker_Status
{
    _mHVLM_05.HVLM_Stecker_Status.phys = getValue( this );
    HVLM_05Changed();
}

on envVar eHVLM_VK_AnfS
{
    putValue( KCAN_HVLM_VK_Anf, getValue( this ) );
}

on envVar KCAN_HVLM_VK_Anf
{
    _mHVLM_05.HVLM_VK_Anf.phys = getValue( this );
    HVLM_05Changed();
}

on envVar KCAN_HVLM_VK_Modus
{
    _mHVLM_05.HVLM_VK_Modus.phys = getValue( this );
    HVLM_05Changed();
}

on envVar KCAN_HVLM_VK_STH_Einsatz
{
    _mHVLM_05.HVLM_VK_STH_Einsatz.phys = getValue( this );
    HVLM_05Changed();
}

on Timer _tKS_Kombi_Req
{
    if( getValue( eTKS_Kombi_Req ) <= 0)  putValue( eSendKS_Kombi_Req, 0 );
    if( ( getValue( eSendEnabled ) && getValue( eSendKS_Kombi_Req )) || getValue( eDlcOnceKS_Kombi_Req ))  sendKS_Kombi_Req();
}

on envVar eSendKS_Kombi_Req
{
    if( getValue( eSendEnabled ) && getValue( eSendKS_Kombi_Req ))  sendKS_Kombi_Req();
}

on envVar eTimeoutKS_Kombi_Req
{
    cancelTimer( _tKS_Kombi_Req );
    cancelTimer( _totKS_Kombi_Req );
    if( getValue( this ))
        setTimer( _totKS_Kombi_Req, ( getValue( eSendEnabled ) && getValue( eSendKS_Kombi_Req ) && ( getValue( eTOTKS_Kombi_Req ) > 0)) ? getValue( eTOTKS_Kombi_Req ) : 1 );
    else
        if( getValue( eSendEnabled ) && getValue( eSendKS_Kombi_Req ))  sendKS_Kombi_Req();
}

on Timer _totKS_Kombi_Req
{
    putValue( eTimeoutKS_Kombi_Req, 0 );
}

on envVar eDlcOnceKS_Kombi_Req
{
    if( getValue( eDlcOnceKS_Kombi_Req ) && !( getValue( eSendEnabled ) && getValue( eSendKS_Kombi_Req )))  setTimer( _tKS_Kombi_Req, 1 );
}

void sendKS_Kombi_Req()
{
    if( getValue( eChangeKS_Kombi_Req ))
    {
        if( getValue( eDlcOnceKS_Kombi_Req ) || getValue( eDlcWrongKS_Kombi_Req ))
        {
            putValue( eDlcOnceKS_Kombi_Req, 0 );
            _mKS_Kombi_Req.DLC = getValue( eDlcKS_Kombi_Req );
        }
        else
        {
            _mKS_Kombi_Req.DLC = 8;
        }
    }
    else
    {
        _mKS_Kombi_Req.DLC = 8;
    }

    output( _mKS_Kombi_Req );
    cancelTimer( _tKS_Kombi_Req );
    if( getValue( eTKS_Kombi_Req ) > 0)  setTimer( _tKS_Kombi_Req, getValue( eTKS_Kombi_Req ) );  else  setTimer( _tKS_Kombi_Req, 1 );
}

on envVar eKS_Kombi_Req_DataS
{
    _mKS_Kombi_Req.KS_Kombi_Req_Data.phys = getValue( this );
}

on Timer _tLDW_02
{
    if( getValue( eTLDW_02 ) <= 0)  putValue( eSendLDW_02, 0 );
    if( ( getValue( eSendEnabled ) && getValue( eSendLDW_02 )) || getValue( eDlcOnceLDW_02 ))  sendLDW_02();
}

on envVar eSendLDW_02
{
    if( getValue( eSendEnabled ) && getValue( eSendLDW_02 ))  sendLDW_02();
}

on envVar eTimeoutLDW_02
{
    cancelTimer( _tLDW_02 );
    cancelTimer( _totLDW_02 );
    if( getValue( this ))
        setTimer( _totLDW_02, ( getValue( eSendEnabled ) && getValue( eSendLDW_02 ) && ( getValue( eTOTLDW_02 ) > 0)) ? getValue( eTOTLDW_02 ) : 1 );
    else
        if( getValue( eSendEnabled ) && getValue( eSendLDW_02 ))  sendLDW_02();
}

on Timer _totLDW_02
{
    putValue( eTimeoutLDW_02, 0 );
}

on envVar eDlcOnceLDW_02
{
    if( getValue( eDlcOnceLDW_02 ) && !( getValue( eSendEnabled ) && getValue( eSendLDW_02 )))  setTimer( _tLDW_02, 1 );
}

on Timer _tinhLDW_02
{
    _bsiLDW_02 = 0;
    if( _bsaiLDW_02 && getValue( eSendEnabled ))  sendLDW_02();
}

void sendLDW_02()
{
    if( getValue( eChangeLDW_02))
    {
        if( getValue( eDlcOnceLDW_02 ) || getValue( eDlcWrongLDW_02 ))
        {
            putValue( eDlcOnceLDW_02, 0 );
            _mLDW_02.DLC = getValue( eDlcLDW_02 );
        }
        else
        {
            _mLDW_02.DLC = 8;
        }
    }
    else
    {
        _mLDW_02.DLC = 8;
    }

    output( _mLDW_02 );
    cancelTimer( _tLDW_02 );
    if( getValue( eTLDW_02 ) > 0)  setTimer( _tLDW_02, getValue( eTLDW_02 ) );  else  setTimer( _tLDW_02, 1 );
    _bsaiLDW_02 = 0;
    _bsiLDW_02 = 1;
    cancelTimer( _tinhLDW_02 );  setTimer( _tinhLDW_02, 20 );
}

LDW_02Changed()
{
    if( getValue( eSendEnabled ) && getValue( eSendLDW_02 ))
        if( _bsiLDW_02 )
            _bsaiLDW_02 = 1;
        else
            sendLDW_02();
}

on envVar KCAN_aLDW_FoD_Status
{
    _mLDW_02.aLDW_FoD_Status.phys = getValue( this );
    LDW_02Changed();
}

on envVar KCAN_HC_Uss_Anforderung
{
    _mLDW_02.HC_Uss_Anforderung.phys = getValue( this );
    LDW_02Changed();
}

on envVar eLDW_DLCS
{
    putValue( KCAN_LDW_DLC, getValue( this ) );
}

on envVar KCAN_LDW_DLC
{
    _mLDW_02.LDW_DLC.phys = getValue( this );
    LDW_02Changed();
}

on envVar KCAN_LDW_Frueh_Spaet
{
    _mLDW_02.LDW_Frueh_Spaet.phys = getValue( this );
    LDW_02Changed();
}

on envVar eLDW_GongS
{
    putValue( KCAN_LDW_Gong, getValue( this ) );
}

on envVar KCAN_LDW_Gong
{
    _mLDW_02.LDW_Gong.phys = getValue( this );
    LDW_02Changed();
}

on envVar eLDW_Lernmodus_seitenabhaengigS
{
    putValue( KCAN_LDW_Lernmodus_seitenabhaengig, getValue( this ) );
}

on envVar KCAN_LDW_Lernmodus_seitenabhaengig
{
    _mLDW_02.LDW_Lernmodus_seitenabhaengig.phys = getValue( this );
    LDW_02Changed();
}

on envVar eLDW_Seite_DLCTLCS
{
    putValue( KCAN_LDW_Seite_DLCTLC, getValue( this ) );
}

on envVar KCAN_LDW_Seite_DLCTLC
{
    _mLDW_02.LDW_Seite_DLCTLC.phys = getValue( this );
    LDW_02Changed();
}

on envVar eLDW_Status_LED_gelbS
{
    putValue( KCAN_LDW_Status_LED_gelb, getValue( this ) );
}

on envVar KCAN_LDW_Status_LED_gelb
{
    _mLDW_02.LDW_Status_LED_gelb.phys = getValue( this );
    LDW_02Changed();
}

on envVar eLDW_Status_LED_gruenS
{
    putValue( KCAN_LDW_Status_LED_gruen, getValue( this ) );
}

on envVar KCAN_LDW_Status_LED_gruen
{
    _mLDW_02.LDW_Status_LED_gruen.phys = getValue( this );
    LDW_02Changed();
}

on envVar eLDW_TexteS
{
    putValue( KCAN_LDW_Texte, getValue( this ) );
}

on envVar KCAN_LDW_Texte
{
    _mLDW_02.LDW_Texte.phys = getValue( this );
    LDW_02Changed();
}

on envVar eLDW_TLCS
{
    putValue( KCAN_LDW_TLC, getValue( this ) );
}

on envVar KCAN_LDW_TLC
{
    _mLDW_02.LDW_TLC.phys = getValue( this );
    LDW_02Changed();
}

on Timer _tLH_EPS_01
{
    if( getValue( eTLH_EPS_01 ) <= 0)  putValue( eSendLH_EPS_01, 0 );
    if( ( getValue( eSendEnabled ) && getValue( eSendLH_EPS_01 )) || getValue( eDlcOnceLH_EPS_01 ))  sendLH_EPS_01();
}

on envVar eSendLH_EPS_01
{
    if( getValue( eSendEnabled ) && getValue( eSendLH_EPS_01 ))  sendLH_EPS_01();
}

on envVar eTimeoutLH_EPS_01
{
    cancelTimer( _tLH_EPS_01 );
    cancelTimer( _totLH_EPS_01 );
    if( getValue( this ))
        setTimer( _totLH_EPS_01, ( getValue( eSendEnabled ) && getValue( eSendLH_EPS_01 ) && ( getValue( eTOTLH_EPS_01 ) > 0)) ? getValue( eTOTLH_EPS_01 ) : 1 );
    else
        if( getValue( eSendEnabled ) && getValue( eSendLH_EPS_01 ))  sendLH_EPS_01();
}

on Timer _totLH_EPS_01
{
    putValue( eTimeoutLH_EPS_01, 0 );
}

on envVar eDlcOnceLH_EPS_01
{
    if( getValue( eDlcOnceLH_EPS_01 ) && !( getValue( eSendEnabled ) && getValue( eSendLH_EPS_01 )))  setTimer( _tLH_EPS_01, 1 );
}

void sendLH_EPS_01()
{
    byte crc;
    dword bz;
    int hw;
    byte dlc;

    if( getValue( eChangeLH_EPS_01 ))
    {
        if( getValue( eDlcOnceLH_EPS_01 ) || getValue( eDlcWrongLH_EPS_01 ))
        {
            putValue( eDlcOnceLH_EPS_01, 0 );
            _mLH_EPS_01.DLC = getValue( eDlcLH_EPS_01 );
        }
        else
        {
            if( getValue( eLH_EPS_01_ChngDLCEnabled ))
            {
                dlc = getValue( eLH_EPS_01_ChngDLCData );
                if(dlc>0)
                {
                    dlc--;
                    putValue( eLH_EPS_01_ChngDLCData, dlc );
                    _mLH_EPS_01.DLC = getValue( eDlcLH_EPS_01 );
                }
                else
                {
                    putValue( eLH_EPS_01_ChngDLCData, 0 );
                    _mLH_EPS_01.DLC = 8;
                }
            }
            else
            {
                _mLH_EPS_01.DLC = 8;
            }
        }
        if( getValue( eLH_EPS_01_BZS_SingleJumpEnabled ))
        {
            putValue( eLH_EPS_01_BZS_SingleJumpEnabled, 0 );
            _mLH_EPS_01.EPS_01_BZ = ( _mLH_EPS_01.EPS_01_BZ + getValue( eLH_EPS_01_BZS_SingleJumpData ) ) & 0xf;
        }
        if( getValue( eLH_EPS_01_BZS_ResetJumpEnabled ))
        {
            if( getValue( eLH_EPS_01_BZS_ResetJumpData)==_mLH_EPS_01.EPS_01_BZ)
            {
                putValue( eLH_EPS_01_BZS_ResetJumpEnabled, 0 );
                _mLH_EPS_01.EPS_01_BZ=0;
                putValue( eEPS_01_BZS,15);
            }
        }
        crc = getCRC8( _mLH_EPS_01, _s_pdu_codeLH_EPS_01 );
        if( getValue( eLH_EPS_01_CRC_FalseEnabled ))
        {
            crc=~crc;
            hw = getValue( eLH_EPS_01_CRC_FalseData );
            if( hw )
            {
                hw--;
                putValue( eLH_EPS_01_CRC_FalseData, hw );
            }
            if( hw == 0 )
            {
                putValue( eLH_EPS_01_CRC_FalseEnabled, 0 );
            }
        }
        _mLH_EPS_01.EPS_01_CRC = crc ^ (1 - getValue( eCrcLH_EPS_01 ));

        if( getValue( eBZLH_EPS_01 ))
        {
            bz = getValue( eEPS_01_BZS );
            bz = bz + getValue( eBZStepLH_EPS_01 );
            putValue( eEPS_01_BZS, bz % 16 );
        }
    }
    else
    {
        _mLH_EPS_01.DLC =  8;

        crc = getCRC8( _mLH_EPS_01, _s_pdu_codeLH_EPS_01 );
        _mLH_EPS_01.EPS_01_CRC = crc ^ (1 - getValue( eCrcLH_EPS_01 ));

        bz = getValue( eEPS_01_BZS ) + 1;
        putValue( eEPS_01_BZS, bz % 16 );
    }

    if( getValue( eLH_EPS_01_NoMsgEnabled ))
    {
        hw = getValue( eLH_EPS_01_NoMsgEnabledData );
        if( hw )
        {
            hw--;
            putValue( eLH_EPS_01_NoMsgEnabledData, hw );
        }
        if( hw == 0 )
        {
            putValue( eLH_EPS_01_NoMsgEnabled, 0 );
        }
    }
    else
    {
        output( _mLH_EPS_01 );
    }

    cancelTimer( _tLH_EPS_01 );
    if( getValue( eTLH_EPS_01 ) > 0)  setTimer( _tLH_EPS_01, getValue( eTLH_EPS_01 ) );  else  setTimer( _tLH_EPS_01, 1 );
}

LH_EPS_01Changed()
{
}

on envVar eEPS_01_BZS
{
    _mLH_EPS_01.EPS_01_BZ.phys = getValue( this );
    LH_EPS_01Changed();
}

on envVar eEPS_AkustiksignalS
{
    putValue( KCAN_EPS_Akustiksignal, getValue( this ) );
}

on envVar KCAN_EPS_Akustiksignal
{
    _mLH_EPS_01.EPS_Akustiksignal.phys = getValue( this );
    LH_EPS_01Changed();
}

on envVar eEPS_Anf_KLS
{
    putValue( KCAN_EPS_Anf_KL, getValue( this ) );
}

on envVar KCAN_EPS_Anf_KL
{
    _mLH_EPS_01.EPS_Anf_KL.phys = getValue( this );
    LH_EPS_01Changed();
}

on envVar KCAN_EPS_ARA_Status
{
    _mLH_EPS_01.EPS_ARA_Status.phys = getValue( this );
    LH_EPS_01Changed();
}

on envVar eEPS_Charisma_FahrPrS
{
    putValue( KCAN_EPS_Charisma_FahrPr, getValue( this ) );
}

on envVar KCAN_EPS_Charisma_FahrPr
{
    _mLH_EPS_01.EPS_Charisma_FahrPr.phys = getValue( this );
    LH_EPS_01Changed();
}

on envVar eEPS_Charisma_StatusS
{
    putValue( KCAN_EPS_Charisma_Status, getValue( this ) );
}

on envVar KCAN_EPS_Charisma_Status
{
    _mLH_EPS_01.EPS_Charisma_Status.phys = getValue( this );
    LH_EPS_01Changed();
}

on envVar KCAN_EPS_Endanschlag
{
    _mLH_EPS_01.EPS_Endanschlag.phys = getValue( this );
    LH_EPS_01Changed();
}

on envVar eEPS_FehlerlampeS
{
    putValue( KCAN_EPS_Fehlerlampe, getValue( this ) );
}

on envVar KCAN_EPS_Fehlerlampe
{
    _mLH_EPS_01.EPS_Fehlerlampe.phys = getValue( this );
    LH_EPS_01Changed();
}

on envVar eEPS_LenkerpositionS
{
    putValue( KCAN_EPS_Lenkerposition, getValue( this ) );
}

on envVar KCAN_EPS_Lenkerposition
{
    _mLH_EPS_01.EPS_Lenkerposition.phys = getValue( this );
    LH_EPS_01Changed();
}

on envVar eEPS_PLA_AbbruchS
{
    putValue( KCAN_EPS_PLA_Abbruch, getValue( this ) );
}

on envVar KCAN_EPS_PLA_Abbruch
{
    _mLH_EPS_01.EPS_PLA_Abbruch.phys = getValue( this );
    LH_EPS_01Changed();
}

on envVar eEPS_PLA_FehlerS
{
    putValue( KCAN_EPS_PLA_Fehler, getValue( this ) );
}

on envVar KCAN_EPS_PLA_Fehler
{
    _mLH_EPS_01.EPS_PLA_Fehler.phys = getValue( this );
    LH_EPS_01Changed();
}

on envVar eEPS_PLA_StatusS
{
    putValue( KCAN_EPS_PLA_Status, getValue( this ) );
}

on envVar KCAN_EPS_PLA_Status
{
    _mLH_EPS_01.EPS_PLA_Status.phys = getValue( this );
    LH_EPS_01Changed();
}

on envVar KCAN_EPS_SpannungsAnf
{
    _mLH_EPS_01.EPS_SpannungsAnf.phys = getValue( this );
    LH_EPS_01Changed();
}

on envVar eEPS_WarnungenS
{
    putValue( KCAN_EPS_Warnungen, getValue( this ) );
}

on envVar KCAN_EPS_Warnungen
{
    _mLH_EPS_01.EPS_Warnungen.phys = getValue( this );
    LH_EPS_01Changed();
}

on Timer _tLSH_02
{
    if( getValue( eTLSH_02 ) <= 0)  putValue( eSendLSH_02, 0 );
    if( ( getValue( eSendEnabled ) && getValue( eSendLSH_02 )) || getValue( eDlcOnceLSH_02 ))  sendLSH_02();
}

on envVar eSendLSH_02
{
    if( getValue( eSendEnabled ) && getValue( eSendLSH_02 ))  sendLSH_02();
}

on envVar eTimeoutLSH_02
{
    cancelTimer( _tLSH_02 );
    cancelTimer( _totLSH_02 );
    if( getValue( this ))
        setTimer( _totLSH_02, ( getValue( eSendEnabled ) && getValue( eSendLSH_02 ) && ( getValue( eTOTLSH_02 ) > 0)) ? getValue( eTOTLSH_02 ) : 1 );
    else
        if( getValue( eSendEnabled ) && getValue( eSendLSH_02 ))  sendLSH_02();
}

on Timer _totLSH_02
{
    putValue( eTimeoutLSH_02, 0 );
}

on envVar eDlcOnceLSH_02
{
    if( getValue( eDlcOnceLSH_02 ) && !( getValue( eSendEnabled ) && getValue( eSendLSH_02 )))  setTimer( _tLSH_02, 1 );
}

void calculate_LSH_consumption ()
{
    dword consumption;
    dword oldAccu;
    dword newAccu;

    consumption = (dword)( getValue( eLSH_Consumption) / 3.6 * getValue( eTLSH_02) + 0.5);
    oldAccu = getValue( eLSH_KVSS );
    newAccu = (oldAccu + consumption) & 0x1FFF;
    putValue( eLSH_KVSS, newAccu );

    if( newAccu < oldAccu)  putValue( eLSH_KVS_UeberlaufS, 1 );
}

void sendLSH_02()
{
    calculate_LSH_consumption();
    if( getValue( eChangeLSH_02 ))
    {
        if( getValue( eDlcOnceLSH_02 ) || getValue( eDlcWrongLSH_02 ))
        {
            putValue( eDlcOnceLSH_02, 0 );
            _mLSH_02.DLC = getValue( eDlcLSH_02 );
        }
        else
        {
            _mLSH_02.DLC = 8;
        }
    }
    else
    {
        _mLSH_02.DLC = 8;
    }
    output( _mLSH_02 );
    cancelTimer( _tLSH_02 );
    if( getValue( eTLSH_02 ) > 0)  setTimer( _tLSH_02, getValue( eTLSH_02 ) );  else  setTimer( _tLSH_02, 1 );
}

LSH_02Changed()
{
}

on envVar KCAN_LSH_Fehlerstatus
{
    _mLSH_02.LSH_Fehlerstatus.phys = getValue( this );
    LSH_02Changed();
}

on envVar eLSH_HeizleistungS
{
    putValue( KCAN_LSH_Heizleistung, getValue( this ) );
}

on envVar KCAN_LSH_Heizleistung
{
    _mLSH_02.LSH_Heizleistung.phys = getValue( this );
    LSH_02Changed();
}

on envVar KCAN_LSH_KL_DBetr_Anf
{
    _mLSH_02.LSH_KL_DBetr_Anf.phys = getValue( this );
    LSH_02Changed();
}

on envVar eLSH_KVSS
{
    putValue( KCAN_LSH_KVS, getValue( this ) );
}

on envVar KCAN_LSH_KVS
{
    _mLSH_02.LSH_KVS.phys = getValue( this );
    LSH_02Changed();
}

on envVar eLSH_KVS_UeberlaufS
{
    putValue( KCAN_LSH_KVS_Ueberlauf, getValue( this ) );
}

on envVar KCAN_LSH_KVS_Ueberlauf
{
    _mLSH_02.LSH_KVS_Ueberlauf.phys = getValue( this );
    LSH_02Changed();
}

on envVar KCAN_LSH_Zuheizen
{
    _mLSH_02.LSH_Zuheizen.phys = getValue( this );
    LSH_02Changed();
}

on Timer _tMainUnit_01
{
    if( getValue( eTMainUnit_01 ) <= 0)  putValue( eSendMainUnit_01, 0 );
    if( ( getValue( eSendEnabled ) && getValue( eSendMainUnit_01 )) || getValue( eDlcOnceMainUnit_01 ))  sendMainUnit_01();
}

on envVar eSendMainUnit_01
{
    if( getValue( eSendEnabled ) && getValue( eSendMainUnit_01 ))  sendMainUnit_01();
    if( getValue( this )== 2) putValue(eTimeoutMainUnit_01,1);
}

on envVar eTimeoutMainUnit_01
{
    cancelTimer( _tMainUnit_01 );
    cancelTimer( _totMainUnit_01 );
    if( getValue( this ))
        setTimer( _totMainUnit_01, ( getValue( eSendEnabled ) && getValue( eSendMainUnit_01 ) && ( getValue( eTOTMainUnit_01 ) > 0)) ? getValue( eTOTMainUnit_01 ) : 1 );
    else
        if( getValue( eSendEnabled ) && getValue( eSendMainUnit_01 ))  sendMainUnit_01();
}

on Timer _totMainUnit_01
{
    putValue( eTimeoutMainUnit_01, 0 );
    putValue(eSendMainUnit_01,1);
}

on envVar eDlcOnceMainUnit_01
{
    if( getValue( eDlcOnceMainUnit_01 ) && !( getValue( eSendEnabled ) && getValue( eSendMainUnit_01 )))  setTimer( _tMainUnit_01, 1 );
}

void sendMainUnit_01()
{
    if( getValue( eChangeMainUnit_01))
    {
        if( getValue( eDlcOnceMainUnit_01 ) || getValue( eDlcWrongMainUnit_01 ))
        {
            putValue( eDlcOnceMainUnit_01, 0 );
            _mMainUnit_01.DLC = getValue( eDlcMainUnit_01 );
        }
        else
        {
            _mMainUnit_01.DLC = 8;
        }
    }
    else
    {
        _mMainUnit_01.DLC = 8;
    }
    output( _mMainUnit_01 );
    cancelTimer( _tMainUnit_01 );
    if( getValue( eTMainUnit_01 ) > 0)  setTimer( _tMainUnit_01, getValue( eTMainUnit_01 ) );  else  setTimer( _tMainUnit_01, 1 );
}

MainUnit_01Changed()
{
}

on envVar KCAN_DSSS_Warning
{
    _mMainUnit_01.DSSS_Warning.phys = getValue( this );
    MainUnit_01Changed();
}

on envVar KCAN_MIB_ASW_Diagnose
{
    _mMainUnit_01.MIB_ASW_Diagnose.phys = getValue( this );
    MainUnit_01Changed();
}

on envVar KCAN_MIB_Tongenerator_PH_verfuegbar
{
    _mMainUnit_01.MIB_Tongenerator_PH_verfuegbar.phys = getValue( this );
    MainUnit_01Changed();
}

on envVar KCAN_MMI_Counter_Bedienevent
{
    _mMainUnit_01.MMI_Counter_Bedienevent.phys = getValue( this );
    MainUnit_01Changed();
}

on envVar KCAN_MMI_Gurt_Mic_ref
{
    _mMainUnit_01.MMI_Gurt_Mic_ref.phys = getValue( this );
    MainUnit_01Changed();
}

on envVar KCAN_MMI_SDS_aktiv
{
    _mMainUnit_01.MMI_SDS_aktiv.phys = getValue( this );
    MainUnit_01Changed();
}

on envVar KCAN_MMI_Telefon_aktiv
{
    _mMainUnit_01.MMI_Telefon_aktiv.phys = getValue( this );
    MainUnit_01Changed();
}

on envVar KCAN_MU_SecondDisplay
{
    _mMainUnit_01.MU_SecondDisplay.phys = getValue( this );
    MainUnit_01Changed();
}

on envVar KCAN_MU_Update_Time
{
    _mMainUnit_01.MU_Update_Time.phys = getValue( this );
    MainUnit_01Changed();
}

on envVar KCAN_Nav_FoD_Status
{
    _mMainUnit_01.Nav_FoD_Status.phys = getValue( this );
    MainUnit_01Changed();
}

on envVar KCAN_ZR_AppConnect_Zustand
{
    _mMainUnit_01.ZR_AppConnect_Zustand.phys = getValue( this );
    MainUnit_01Changed();
}

on envVar KCAN_ZR_Kindersicherung_RSE
{
    _mMainUnit_01.ZR_Kindersicherung_RSE.phys = getValue( this );
    MainUnit_01Changed();
}

on envVar KCAN_ZR_Lichter_Tag
{
    _mMainUnit_01.ZR_Lichter_Tag.phys = getValue( this );
    MainUnit_01Changed();
}

on envVar KCAN_ZR_LoGeWa_Event_Kombiwarnung
{
    _mMainUnit_01.ZR_LoGeWa_Event_Kombiwarnung.phys = getValue( this );
    MainUnit_01Changed();
}

on envVar KCAN_ZR_Parken_Sondermodus
{
    _mMainUnit_01.ZR_Parken_Sondermodus.phys = getValue( this );
    MainUnit_01Changed();
}

on envVar KCAN_ZR_RSE_aktivieren
{
    _mMainUnit_01.ZR_RSE_aktivieren.phys = getValue( this );
    MainUnit_01Changed();
}

on Timer _tMFL_Tasten_Kon_01
{
    if( getValue( eTMFL_Tasten_Kon_01 ) <= 0)  putValue( eSendMFL_Tasten_Kon_01, 0 );
    if( ( getValue( eSendEnabled ) && getValue( eSendMFL_Tasten_Kon_01 )) || getValue( eDlcOnceMFL_Tasten_Kon_01 ))  sendMFL_Tasten_Kon_01();
}

on envVar eSendMFL_Tasten_Kon_01
{
    if( getValue( eSendEnabled ) && getValue( eSendMFL_Tasten_Kon_01 ))  sendMFL_Tasten_Kon_01();
}

on envVar eTimeoutMFL_Tasten_Kon_01
{
    cancelTimer( _tMFL_Tasten_Kon_01 );
    cancelTimer( _totMFL_Tasten_Kon_01 );
    if( getValue( this ))
        setTimer( _totMFL_Tasten_Kon_01, ( getValue( eSendEnabled ) && getValue( eSendMFL_Tasten_Kon_01 ) && ( getValue( eTOTMFL_Tasten_Kon_01 ) > 0)) ? getValue( eTOTMFL_Tasten_Kon_01 ) : 1 );
    else
        if( getValue( eSendEnabled ) && getValue( eSendMFL_Tasten_Kon_01 ))  sendMFL_Tasten_Kon_01();
}

on Timer _totMFL_Tasten_Kon_01
{
    putValue( eTimeoutMFL_Tasten_Kon_01, 0 );
}

on envVar eDlcOnceMFL_Tasten_Kon_01
{
    if( getValue( eDlcOnceMFL_Tasten_Kon_01 ) && !( getValue( eSendEnabled ) && getValue( eSendMFL_Tasten_Kon_01 )))  setTimer( _tMFL_Tasten_Kon_01, 1 );
}

void sendMFL_Tasten_Kon_01()
{
    if( getValue( eChangeMFL_Tasten_Kon_01))
    {
        if( getValue( eDlcOnceMFL_Tasten_Kon_01 ) || getValue( eDlcWrongMFL_Tasten_Kon_01 ))
        {
            putValue( eDlcOnceMFL_Tasten_Kon_01, 0 );
            _mMFL_Tasten_Kon_01.DLC = getValue( eDlcMFL_Tasten_Kon_01 );
        }
        else
        {
            _mMFL_Tasten_Kon_01.DLC = 4;
        }
    }
    else
    {
        _mMFL_Tasten_Kon_01.DLC = 4;
    }
    if( getValue( eMFL_LSS_switch) == 1)
    {
        output( _mMFL_Tasten_Kon_01 );
    }
    cancelTimer( _tMFL_Tasten_Kon_01 );
    if( getValue( eTMFL_Tasten_Kon_01 ) > 0)  setTimer( _tMFL_Tasten_Kon_01, getValue( eTMFL_Tasten_Kon_01 ) );  else  setTimer( _tMFL_Tasten_Kon_01, 1 );
}

on envVar eSendAtOnceMFL_Tasten_Kon_01
{
    if( getValue( this ) && getValue( eSendMfl ) && getValue( eSendEnabled ))
    {
        sendMFL_Tasten_Kon_01();
        putValue( this, 0 );
    }
}

MFL_Tasten_Kon_01Changed()
{
//  if( getValue( eSendEnabled ) && getValue( eSendMFL_Tasten_Kon_01 ))  sendMFL_Tasten_Kon_01();
}

on envVar eMFL_Eventcode_1S
{
    putValue( KCAN_MFL_Eventcode_1, getValue( this ) );
}

on envVar KCAN_MFL_Eventcode_1
{
    _mMFL_Tasten_Kon_01.MFL_Eventcode_1.phys = getValue( this );
    MFL_Tasten_Kon_01Changed();
}

on envVar eMFL_Eventcode_2S
{
    putValue( KCAN_MFL_Eventcode_2, getValue( this ) );
}

on envVar KCAN_MFL_Eventcode_2
{
    _mMFL_Tasten_Kon_01.MFL_Eventcode_2.phys = getValue( this );
    MFL_Tasten_Kon_01Changed();
}

on envVar eMFL_MarkeS
{
    putValue( KCAN_MFL_Marke, getValue( this ) );
}

on envVar KCAN_MFL_Marke
{
    _mMFL_Tasten_Kon_01.MFL_Marke.phys = getValue( this );
    MFL_Tasten_Kon_01Changed();
}

on envVar eMFL_Tastencode_1S
{
    putValue( KCAN_MFL_Tastencode_1, getValue( this ) );
}

on envVar KCAN_MFL_Tastencode_1
{
    _mMFL_Tasten_Kon_01.MFL_Tastencode_1.phys = getValue( this );
    MFL_Tasten_Kon_01Changed();
}

on envVar eMFL_Tastencode_2S
{
    putValue( KCAN_MFL_Tastencode_2, getValue( this ) );
}

on envVar KCAN_MFL_Tastencode_2
{
    _mMFL_Tasten_Kon_01.MFL_Tastencode_2.phys = getValue( this );
    MFL_Tasten_Kon_01Changed();
}

on envVar eMFL_VarianteS
{
    putValue( KCAN_MFL_Variante, getValue( this ) );
}

on envVar KCAN_MFL_Variante
{
    _mMFL_Tasten_Kon_01.MFL_Variante.phys = getValue( this );
    MFL_Tasten_Kon_01Changed();
}

on Timer _tMotor_04
{
    if( getValue( eTMotor_04 ) <= 0)  putValue( eSendMotor_04, 0 );
    if( ( getValue( eSendEnabled ) && getValue( eSendMotor_04 )) || getValue( eDlcOnceMotor_04 ))  sendMotor_04();
}

on envVar eSendMotor_04
{
    if( getValue( eSendEnabled ) && getValue( eSendMotor_04 ))  sendMotor_04();
}

on envVar eTimeoutMotor_04
{
    cancelTimer( _tMotor_04 );
    cancelTimer( _totMotor_04 );
    if( getValue( this ))
        setTimer( _totMotor_04, ( getValue( eSendEnabled ) && getValue( eSendMotor_04 ) && ( getValue( eTOTMotor_04 ) > 0)) ? getValue( eTOTMotor_04 ) : 1 );
    else
        if( getValue( eSendEnabled ) && getValue( eSendMotor_04 ))  sendMotor_04();
}

on Timer _totMotor_04
{
    putValue( eTimeoutMotor_04, 0 );
}

on envVar eDlcOnceMotor_04
{
    if( getValue( eDlcOnceMotor_04 ) && !( getValue( eSendEnabled ) && getValue( eSendMotor_04 )))  setTimer( _tMotor_04, 1 );
}

void sendMotor_04()
{
    calculateConsumption();

    if( getValue( eChangeMotor_04 ))
    {
        if( getValue( eDlcOnceMotor_04 ) || getValue( eDlcWrongMotor_04 ))
        {
            putValue( eDlcOnceMotor_04, 0 );
            _mMotor_04.DLC = getValue( eDlcMotor_04 );
        }
        else
        {
            _mMotor_04.DLC = 8;
        }
    }
    else
    {
        _mMotor_04.DLC = 8;
    }
    output( _mMotor_04 );
    cancelTimer( _tMotor_04 );
    if( getValue( eTMotor_04 ) > 0)  setTimer( _tMotor_04, getValue( eTMotor_04 ) );  else  setTimer( _tMotor_04, 1 );
}

Motor_04Changed()
{
}

void calculateConsumption()
{
    dword consumption;
    dword oldAccu;
    dword newAccu;
    //IssueList #137 - Changes from Valentin Daicu 09.11.2012
    if((getvalue(env_GasConsumption_Correlation) == 1) && (( getValue( eMO_KraftstoffartS) == 2 ) || ( getValue( eMO_KraftstoffartS) == 3 )))
    {   if( getvalue(eMO_akt_Betrieb)==0)
            consumption = (dword)( getValue( eConsumption ) / 3.6 /*µl/ms*/ * getValue( eTMotor_04 ) + 0.5);
        else
            consumption = 0;
    }
    else
        consumption = (dword)( getValue( eConsumption ) / 3.6 /*µl/ms*/ * getValue( eTMotor_04 ) + 0.5);

    oldAccu = getValue( eMO_KVSS );
    newAccu = ( oldAccu + consumption ) & 0x7FFF;
    putValue( eMO_KVSS, newAccu );
    if( newAccu < oldAccu )  putValue( eMO_KVS_UeberlaufS, 1 );
}

on envVar eMO_AnzeigedrehzS
{
    putValue( KCAN_MO_Anzeigedrehz, getValue( this ) );
}

on envVar KCAN_MO_Anzeigedrehz
{
    _mMotor_04.MO_Anzeigedrehz.phys = getValue( this );
    Motor_04Changed();
}

on envVar eMO_Effizienzmodus
{
    putValue( KCAN_MO_Effizienzmodus, getValue( this ) );
}

on envVar KCAN_MO_Effizienzmodus
{
    _mMotor_04.MO_Effizienzmodus.phys = getValue( this );
    Motor_04Changed();
}

on envVar eMO_Fehler_OeldrucksensorS
{
    putValue( KCAN_MO_Fehler_Oeldrucksensor, getValue( this ) );
}

on envVar KCAN_MO_Fehler_Oeldrucksensor
{
    _mMotor_04.MO_Fehler_Oeldrucksensor.phys = getValue( this );
    Motor_04Changed();
}

on envVar eMO_IstgangS
{
    putValue( KCAN_MO_Istgang, getValue( this ) );
}

on envVar KCAN_MO_Istgang
{
    _mMotor_04.MO_Istgang.phys = getValue( this );
    Motor_04Changed();
}

on envVar eMO_KVSS
{
    putValue( KCAN_MO_KVS, getValue( this ) );
}

on envVar KCAN_MO_KVS
{
    _mMotor_04.MO_KVS.phys = getValue( this );
    Motor_04Changed();
}

on envVar eMO_KVS_UeberlaufS
{
    putValue( KCAN_MO_KVS_Ueberlauf, getValue( this ) );
}

on envVar KCAN_MO_KVS_Ueberlauf
{
    _mMotor_04.MO_KVS_Ueberlauf.phys = getValue( this );
    Motor_04Changed();
}

on envVar eMO_LadedruckS
{
    putValue( KCAN_MO_Ladedruck, getValue( this ) );
}

on envVar KCAN_MO_Ladedruck
{
    _mMotor_04.MO_Ladedruck.phys = getValue( this ) + 0.001;
    Motor_04Changed();
}

on envVar eMO_OeldruckS
{
    putValue( KCAN_MO_Oeldruck, getValue( this ) );
}

on envVar KCAN_MO_Oeldruck
{
    _mMotor_04.MO_Oeldruck.phys = getValue( this );
    Motor_04Changed();
}

on envVar eMO_rel_LadedruckS
{
    putValue( KCAN_MO_rel_Ladedruck, getValue( this ) );
}

on envVar KCAN_MO_rel_Ladedruck
{
    _mMotor_04.MO_rel_Ladedruck.phys = getValue( this );
    Motor_04Changed();
}

on envVar eMO_Schaltempf_verfbarS
{
    putValue( KCAN_MO_Schaltempf_verfbar, getValue( this ) );
}

on envVar KCAN_MO_Schaltempf_verfbar
{
    _mMotor_04.MO_Schaltempf_verfbar.phys = getValue( this );
    Motor_04Changed();
}

on envVar eMO_SollgangS
{
    putValue( KCAN_MO_Sollgang, getValue( this ) );
}

on envVar KCAN_MO_Sollgang
{
    _mMotor_04.MO_Sollgang.phys = getValue( this );
    Motor_04Changed();
}

on Timer _tMotor_07
{
    if( getValue( eTMotor_07 ) <= 0)  putValue( eSendMotor_07, 0 );
    if( ( getValue( eSendEnabled ) && getValue( eSendMotor_07 )) || getValue( eDlcOnceMotor_07 ))  sendMotor_07();
}

on envVar eSendMotor_07
{
    if( getValue( eSendEnabled ) && getValue( eSendMotor_07 ))  sendMotor_07();
}

on envVar eTimeoutMotor_07
{
    cancelTimer( _tMotor_07 );
    cancelTimer( _totMotor_07 );
    if( getValue( this ))
        setTimer( _totMotor_07, ( getValue( eSendEnabled ) && getValue( eSendMotor_07 ) && ( getValue( eTOTMotor_07 ) > 0)) ? getValue( eTOTMotor_07 ) : 1 );
    else
        if( getValue( eSendEnabled ) && getValue( eSendMotor_07 ))  sendMotor_07();
}

on Timer _totMotor_07
{
    putValue( eTimeoutMotor_07, 0 );
}

on envVar eDlcOnceMotor_07
{
    if( getValue( eDlcOnceMotor_07 ) && !( getValue( eSendEnabled ) && getValue( eSendMotor_07 )))  setTimer( _tMotor_07, 1 );
}

void sendMotor_07()
{
    if( getValue( eChangeMotor_07 ))
    {
        if( getValue( eDlcOnceMotor_07 ) || getValue( eDlcWrongMotor_07 ))
        {
            putValue( eDlcOnceMotor_07, 0 );
            _mMotor_07.DLC = getValue( eDlcMotor_07 );
        }
        else
        {
            _mMotor_07.DLC = 8;
        }
    }
    else
    {
        _mMotor_07.DLC = 8;
    }
    output( _mMotor_07 );
    cancelTimer( _tMotor_07 );
    if( getValue( eTMotor_07 ) > 0)  setTimer( _tMotor_07, getValue( eTMotor_07 ) );  else  setTimer( _tMotor_07, 1 );
}

Motor_07Changed()
{
}

on envVar eMO_Absperrventil_oeffnenS
{
    putValue( KCAN_MO_Absperrventil_oeffnen, getValue( this ) );
}

on envVar KCAN_MO_Absperrventil_oeffnen
{
    _mMotor_07.MO_Absperrventil_oeffnen.phys = getValue( this );
    Motor_07Changed();
}

on envVar eMO_aktives_GetriebeheizenS
{
    putValue( KCAN_MO_aktives_Getriebeheizen, getValue( this ) );
}

on envVar KCAN_MO_aktives_Getriebeheizen
{
    _mMotor_07.MO_aktives_Getriebeheizen.phys = getValue( this );
    Motor_07Changed();
}

on envVar eMO_Ansaugluft_TempS
{
    putValue( KCAN_MO_Ansaugluft_Temp, getValue( this ) );
}

on envVar KCAN_MO_Ansaugluft_Temp
{
    _mMotor_07.MO_Ansaugluft_Temp.phys = getValue( this );
    Motor_07Changed();
}

on envVar eMO_Getriebe_kuehlenS
{
    putValue( KCAN_MO_Getriebe_kuehlen, getValue( this ) );
}

on envVar KCAN_MO_Getriebe_kuehlen
{
    _mMotor_07.MO_Getriebe_kuehlen.phys = getValue( this );
    Motor_07Changed();
}

on envVar eMO_HeizungspumpenansteuerungS
{
    putValue( KCAN_MO_Heizungspumpenansteuerung, getValue( this ) );
}

on envVar KCAN_MO_Heizungspumpenansteuerung
{
    _mMotor_07.MO_Heizungspumpenansteuerung.phys = getValue( this );
    Motor_07Changed();
}

on envVar eMO_HoeheninfoS
{
    putValue( KCAN_MO_Hoeheninfo, getValue( this ) );
}

on envVar KCAN_MO_Hoeheninfo
{
    _mMotor_07.MO_Hoeheninfo.phys = getValue( this );
    Motor_07Changed();
}

on envVar eMO_HYB_Fehler_HV_NetzS
{
    putValue( KCAN_MO_HYB_Fehler_HV_Netz, getValue( this ) );
}

on envVar KCAN_MO_HYB_Fehler_HV_Netz
{
    _mMotor_07.MO_HYB_Fehler_HV_Netz.phys = getValue( this );
    Motor_07Changed();
}

on envVar eMO_KennfeldkS
{
    putValue( KCAN_MO_Kennfeldk, getValue( this ) );
}

on envVar KCAN_MO_Kennfeldk
{
    _mMotor_07.MO_Kennfeldk.phys = getValue( this );
    Motor_07Changed();
}

on envVar KCAN_MO_KL15_Abschaltempfehlung
{
    _mMotor_07.MO_KL15_Abschaltempfehlung.phys = getValue( this );
    Motor_07Changed();
}

on envVar eMO_Kuehlmittel_TempS
{
    putValue( KCAN_MO_Kuehlmittel_Temp, getValue( this ) );
}

on envVar KCAN_MO_Kuehlmittel_Temp
{
    _mMotor_07.MO_Kuehlmittel_Temp.phys = getValue( this );
    Motor_07Changed();
}

on envVar eMO_Mom_Traegheit_02S
{
    putValue( KCAN_MO_Mom_Traegheit_02, getValue( this ) );
}

on envVar KCAN_MO_Mom_Traegheit_02
{
    _mMotor_07.MO_Mom_Traegheit_02.phys = getValue( this );
    Motor_07Changed();
}

on envVar eMO_Nachlaufzeit_HeizungspumpeS
{
    putValue( KCAN_MO_Nachlaufzeit_Heizungspumpe, getValue( this ) );
}

on envVar KCAN_MO_Nachlaufzeit_Heizungspumpe
{
    _mMotor_07.MO_Nachlaufzeit_Heizungspumpe.phys = getValue( this );
    Motor_07Changed();
}

on envVar eMO_Oel_TempS
{
    putValue( KCAN_MO_Oel_Temp, getValue( this ) );
}

on envVar KCAN_MO_Oel_Temp
{
    _mMotor_07.MO_Oel_Temp.phys = getValue( this );
    Motor_07Changed();
}

on envVar eMO_QBit_Ansaugluft_TempS
{
    putValue( KCAN_MO_QBit_Ansaugluft_Temp, getValue( this ) );
}

on envVar KCAN_MO_QBit_Ansaugluft_Temp
{
    _mMotor_07.MO_QBit_Ansaugluft_Temp.phys = getValue( this );
    Motor_07Changed();
}

on envVar KCAN_MO_QBit_Hoeheninfo
{
    _mMotor_07.MO_QBit_Hoeheninfo.phys = getValue( this );
    Motor_07Changed();
}

on envVar eMO_QBit_Kuehlmittel_TempS
{
    putValue( KCAN_MO_QBit_Kuehlmittel_Temp, getValue( this ) );
}

on envVar KCAN_MO_QBit_Kuehlmittel_Temp
{
    _mMotor_07.MO_QBit_Kuehlmittel_Temp.phys = getValue( this );
    Motor_07Changed();
}

on envVar eMO_QBit_Oel_TempS
{
    putValue( KCAN_MO_QBit_Oel_Temp, getValue( this ) );
}

on envVar KCAN_MO_QBit_Oel_Temp
{
    _mMotor_07.MO_QBit_Oel_Temp.phys = getValue( this );
    Motor_07Changed();
}

on envVar eMO_SpannungsAnfS
{
    putValue( KCAN_MO_SpannungsAnf, getValue( this ) );
}

on envVar KCAN_MO_SpannungsAnf
{
    _mMotor_07.MO_SpannungsAnf.phys = getValue( this );
    Motor_07Changed();
}

on envVar KCAN_MO_Versionsinfo_02
{
    _mMotor_07.MO_Versionsinfo_02.phys = getValue( this );
    Motor_07Changed();
}

on Timer _tMotor_09
{
    if( getValue( eTMotor_09 ) <= 0)  putValue( eSendMotor_09, 0 );
    if( ( getValue( eSendEnabled ) && getValue( eSendMotor_09 )) || getValue( eDlcOnceMotor_09 ))  sendMotor_09();
}

on envVar eSendMotor_09
{
    if( getValue( eSendEnabled ) && getValue( eSendMotor_09 ))  sendMotor_09();
}

on envVar eTimeoutMotor_09
{
    cancelTimer( _tMotor_09 );
    cancelTimer( _totMotor_09 );
    if( getValue( this ))
        setTimer( _totMotor_09, ( getValue( eSendEnabled ) && getValue( eSendMotor_09 ) && ( getValue( eTOTMotor_09 ) > 0)) ? getValue( eTOTMotor_09 ) : 1 );
    else
        if( getValue( eSendEnabled ) && getValue( eSendMotor_09 ))  sendMotor_09();
}

on Timer _totMotor_09
{
    putValue( eTimeoutMotor_09, 0 );
}

on envVar eDlcOnceMotor_09
{
    if( getValue( eDlcOnceMotor_09 ) && !( getValue( eSendEnabled ) && getValue( eSendMotor_09 )))  setTimer( _tMotor_09, 1 );
}

void sendMotor_09()
{
    if( getValue( eChangeMotor_09 ))
    {
        if( getValue( eDlcOnceMotor_09 ) || getValue( eDlcWrongMotor_09 ))
        {
            putValue( eDlcOnceMotor_09, 0 );
            _mMotor_09.DLC = getValue( eDlcMotor_09 );
        }
        else
        {
            _mMotor_09.DLC = 8;
        }
    }
    else
    {
        _mMotor_09.DLC = 8;
    }
    output( _mMotor_09 );

    putValue( eMO_MKB_MUXS, ( getValue( eMO_MKB_MUXS ) + 1) % 4 );  // automatic roll through all 4 MUX-values

    cancelTimer( _tMotor_09 );
    if( getValue( eTMotor_09 ) > 0)  setTimer( _tMotor_09, getValue( eTMotor_09 ) );  else  setTimer( _tMotor_09, 1 );
}

Motor_09Changed()
{
}

on envVar eMO_CO2_FaktorS
{
    putValue( KCAN_MO_CO2_Faktor, getValue( this ) );
}

on envVar KCAN_MO_CO2_Faktor
{
    _mMotor_09.MO_CO2_Faktor.phys = getValue( this );
    Motor_09Changed();
}

on envVar eMO_E85_SensorS
{
    putValue( KCAN_MO_E85_Sensor, getValue( this ) );
}

on envVar KCAN_MO_E85_Sensor
{
    _mMotor_09.MO_E85_Sensor.phys = getValue( this );
    Motor_09Changed();
}

on envVar KCAN_MO_Ethanol_Spuelhinweis
{
    _mMotor_09.MO_Ethanol_Spuelhinweis.phys = getValue( this );
    Motor_09Changed();
}

on envVar eMO_ITM_Kuehlmittel_TempS
{
    putValue( KCAN_MO_ITM_Kuehlmittel_Temp, getValue( this ) );
}

on envVar KCAN_MO_ITM_Kuehlmittel_Temp
{
    _mMotor_09.MO_ITM_Kuehlmittel_Temp.phys = getValue( this );
    Motor_09Changed();
}

on envVar KCAN_MO_ITM_Kuehlmittel_Temp_Step
{
    float rawValue;

    rawValue = getValue( this );
    putValue( KCAN_MO_ITM_Kuehlmittel_Temp, ( rawValue + 48 ) / 0.75 );
}

on envVar eMO_Kraftstofffilter_WasserS
{
    putValue( KCAN_MO_Kraftstofffilter_Wasser, getValue( this ) );
}

on envVar KCAN_MO_Kraftstofffilter_Wasser
{
    _mMotor_09.MO_Kraftstofffilter_Wasser.phys = getValue( this );
    Motor_09Changed();
}

on envVar eMO_MKB_MUXS
{
    putValue( KCAN_MO_MKB_MUX, getValue( this ) );
}

on envVar KCAN_MO_MKB_MUX
{
    _mMotor_09.MO_MKB_MUX.phys = getValue( this );
    switch( _mMotor_09.MO_MKB_MUX )
    {
        case 0: _mMotor_09.MO_MKB_01 = getValue( eMO_MKB_01S ); break;
        case 1: _mMotor_09.MO_MKB_02 = getValue( eMO_MKB_02S ); break;
        case 2: _mMotor_09.MO_MKB_03 = getValue( eMO_MKB_03S ); break;
        case 3: _mMotor_09.MO_MKB_04 = getValue( eMO_MKB_04S ); break;
    }
    Motor_09Changed();
}

on envVar eMO_MKB_01S
{
    putValue( KCAN_MO_MKB_01, getValue( this ) );
}

on envVar KCAN_MO_MKB_01
{
    if( _mMotor_09.MO_MKB_MUX == 0)
    {
        _mMotor_09.MO_MKB_01.phys = getValue( this );
        Motor_09Changed();
    }
}

on envVar eMO_MKB_02S
{
    putValue( KCAN_MO_MKB_02, getValue( this ) );
}

on envVar KCAN_MO_MKB_02
{
    if( _mMotor_09.MO_MKB_MUX == 1)
    {
        _mMotor_09.MO_MKB_02.phys = getValue( this );
        Motor_09Changed();
    }
}

on envVar eMO_MKB_03S
{
    putValue( KCAN_MO_MKB_03, getValue( this ) );
}

on envVar KCAN_MO_MKB_03
{
    if( _mMotor_09.MO_MKB_MUX == 2)
    {
        _mMotor_09.MO_MKB_03.phys = getValue( this );
        Motor_09Changed();
    }
}

on envVar eMO_MKB_04S
{
    putValue( KCAN_MO_MKB_04, getValue( this ) );
}

on envVar KCAN_MO_MKB_04
{
    if( _mMotor_09.MO_MKB_MUX == 3)
    {
        _mMotor_09.MO_MKB_04.phys = getValue( this );
        Motor_09Changed();
    }
}

on envVar eSCR_AkustikS
{
    putValue( KCAN_SCR_Akustik, getValue( this ) );
}

on envVar KCAN_SCR_Akustik
{
    _mMotor_09.SCR_Akustik.phys = getValue( this );
    Motor_09Changed();
}

on envVar eSCR_Anz_MotorstartsS
{
    putValue( KCAN_SCR_Anz_Motorstarts, getValue( this ) );
}

on envVar KCAN_SCR_Anz_Motorstarts
{
    _mMotor_09.SCR_Anz_Motorstarts.phys = getValue( this );
    Motor_09Changed();
}

on envVar eSCR_Inducement_StrategieS
{
    putValue( KCAN_SCR_Inducement_Strategie, getValue( this ) );
}

on envVar KCAN_SCR_Inducement_Strategie
{
    _mMotor_09.SCR_Inducement_Strategie.phys = getValue( this );
    Motor_09Changed();
}

on envVar eSCR_ReichweiteS
{
    putValue( KCAN_SCR_Reichweite, getValue( this ) );
}

on envVar KCAN_SCR_Reichweite
{
    _mMotor_09.SCR_Reichweite.phys = getValue( this );
    Motor_09Changed();
}

on envVar eSCR_SystemfehlerS
{
    putValue( KCAN_SCR_Systemfehler, getValue( this ) );
}

on envVar KCAN_SCR_Systemfehler
{
    _mMotor_09.SCR_Systemfehler.phys = getValue( this );
    Motor_09Changed();
}

on envVar eSCR_TextS
{
    putValue( KCAN_SCR_Text, getValue( this ) );
}

on envVar KCAN_SCR_Text
{
    _mMotor_09.SCR_Text.phys = getValue( this );
    Motor_09Changed();
}

on envVar eSCR_Verbaut
{
    putValue( KCAN_SCR_verbaut, getValue( this ) );
}

on envVar KCAN_SCR_verbaut
{
    _mMotor_09.SCR_verbaut.phys = getValue( this );
    Motor_09Changed();
}

on envVar eSCR_Warnstufe_1S
{
    putValue( KCAN_SCR_Warnstufe_1, getValue( this ) );
}

on envVar KCAN_SCR_Warnstufe_1
{
    _mMotor_09.SCR_Warnstufe_1.phys = getValue( this );
    Motor_09Changed();
}

on envVar eSCR_Warnstufe_2S
{
    putValue( KCAN_SCR_Warnstufe_2, getValue( this ) );
}

on envVar KCAN_SCR_Warnstufe_2
{
    _mMotor_09.SCR_Warnstufe_2.phys = getValue( this );
    Motor_09Changed();
}

on Timer _tMotor_14
{
    if( getValue( eTMotor_14 ) <= 0)  putValue( eSendMotor_14, 0 );
    if( ( getValue( eSendEnabled ) && getValue( eSendMotor_14 )) || getValue( eDlcOnceMotor_14 ))  sendMotor_14();
}

on envVar eSendMotor_14
{
    if( getValue( eSendEnabled ) && getValue( eSendMotor_14 ))  sendMotor_14();
}

on envVar eTimeoutMotor_14
{
    cancelTimer( _tMotor_14 );
    cancelTimer( _totMotor_14 );
    if( getValue( this ))
        setTimer( _totMotor_14, ( getValue( eSendEnabled ) && getValue( eSendMotor_14 ) && ( getValue( eTOTMotor_14 ) > 0)) ? getValue( eTOTMotor_14 ) : 1 );
    else
        if( getValue( eSendEnabled ) && getValue( eSendMotor_14 ))  sendMotor_14();
}

on Timer _totMotor_14
{
    putValue( eTimeoutMotor_14, 0 );
}

on envVar eDlcOnceMotor_14
{
    if( getValue( eDlcOnceMotor_14 ) && !( getValue( eSendEnabled ) && getValue( eSendMotor_14 )))  setTimer( _tMotor_14, 1 );
}

on Timer _tinhMotor_14
{
    _bsiMotor_14 = 0;
    if( _bsaiMotor_14 && getValue( eSendEnabled ))  sendMotor_14();
}

void sendMotor_14()
{
    byte crc;
    dword bz;
    int hw;
    byte dlc;

    if( getValue( eChangeMotor_14))
    {
        if( getValue( eDlcOnceMotor_14 ) || getValue( eDlcWrongMotor_14 ))
        {
            putValue( eDlcOnceMotor_14, 0 );
            _mMotor_14.DLC = getValue( eDlcMotor_14 );
        }
        else
        {
            _mMotor_14.DLC = 8;
        }
    }
    else
    {
        _mMotor_14.DLC = 8;
    }
    {
        output( _mMotor_14 );
    }

    cancelTimer( _tMotor_14 );
    if( getValue( eTMotor_14 ) > 0)  setTimer( _tMotor_14, getValue( eTMotor_14 ) );  else  setTimer( _tMotor_14, 1 );
    _bsaiMotor_14 = 0;
    _bsiMotor_14 = 1;
    cancelTimer( _tinhMotor_14 );  setTimer( _tinhMotor_14, 10 );
}

Motor_14Changed()
{
    if( getValue( eSendEnabled ) && getValue( eSendMotor_14 ))
        if( _bsiMotor_14 )
            _bsaiMotor_14 = 1;
        else
            sendMotor_14();
}

on envVar eMO_Aussp_AnlassS
{
    putValue( KCAN_MO_Aussp_Anlass, getValue( this ) );
}

on envVar KCAN_MO_Aussp_Anlass
{
    _mMotor_14.MO_Aussp_Anlass.phys = getValue( this );
    Motor_14Changed();
}

on envVar eMO_BKV_UnterdruckwarnungS
{
    putValue( KCAN_MO_BKV_Unterdruckwarnung, getValue( this ) );
}

on envVar KCAN_MO_BKV_Unterdruckwarnung
{
    _mMotor_14.MO_BKV_Unterdruckwarnung.phys = getValue( this );
    Motor_14Changed();
}

on envVar eMO_BLSS
{
    putValue( KCAN_MO_BLS, getValue( this ) );
}

on envVar KCAN_MO_BLS
{
    _mMotor_14.MO_BLS.phys = getValue( this );
    Motor_14Changed();
}

on envVar KCAN_MO_BMS_NV_Anf_stuetzen
{
    _mMotor_14.MO_BMS_NV_Anf_stuetzen.phys = getValue( this );
    Motor_14Changed();
}

on envVar eMO_EKlKomLeiRedS
{
    putValue( KCAN_MO_EKlKomLeiRed, getValue( this ) );
}

on envVar KCAN_MO_EKlKomLeiRed
{
    _mMotor_14.MO_EKlKomLeiRed.phys = getValue( this );
    Motor_14Changed();
}

on envVar eMO_Ext_E_Fahrt_aktivS
{
    putValue( KCAN_MO_Ext_E_Fahrt_aktiv, getValue( this ) );
}

on envVar KCAN_MO_Ext_E_Fahrt_aktiv
{
    _mMotor_14.MO_Ext_E_Fahrt_aktiv.phys = getValue( this );
    Motor_14Changed();
}

on envVar eMO_Fahrer_bremstS
{
    putValue( KCAN_MO_Fahrer_bremst, getValue( this ) );
}

on envVar KCAN_MO_Fahrer_bremst
{
    _mMotor_14.MO_Fahrer_bremst.phys = getValue( this );
    Motor_14Changed();
}

on envVar KCAN_MO_FMAus_aktiv
{
    _mMotor_14.MO_FMAus_aktiv.phys = getValue( this );
    Motor_14Changed();
}

on envVar KCAN_MO_FMAus_Startvariante
{
    _mMotor_14.MO_FMAus_Startvariante.phys = getValue( this );
    Motor_14Changed();
}

on envVar eMO_Freig_AnlassS
{
    putValue( KCAN_MO_Freig_Anlass, getValue( this ) );
}

on envVar KCAN_MO_Freig_Anlass
{
    _mMotor_14.MO_Freig_Anlass.phys = getValue( this );
    Motor_14Changed();
}

on envVar eMO_Freig_RekuS
{
    putValue( KCAN_MO_Freig_Reku, getValue( this ) );
}

on envVar KCAN_MO_Freig_Reku
{
    _mMotor_14.MO_Freig_Reku.phys = getValue( this );
    Motor_14Changed();
}

on envVar eMO_Freigabe_SegelnS
{
    putValue( KCAN_MO_Freigabe_Segeln, getValue( this ) );
}

on envVar KCAN_MO_Freigabe_Segeln
{
    _mMotor_14.MO_Freigabe_Segeln.phys = getValue( this );
    Motor_14Changed();
}

on envVar eMO_GangpositionS
{
    putValue( KCAN_MO_Gangposition, getValue( this ) );
}

on envVar KCAN_MO_Gangposition
{
    _mMotor_14.MO_Gangposition.phys = getValue( this );
    Motor_14Changed();
}

on envVar eMO_Handshake_STHS
{
    putValue( KCAN_MO_Handshake_STH, getValue( this ) );
}

on envVar KCAN_MO_Handshake_STH
{
    _mMotor_14.MO_Handshake_STH.phys = getValue( this );
    Motor_14Changed();
}

on envVar eMO_HYB_FahrbereitschaftS
{
    putValue( KCAN_MO_HYB_Fahrbereitschaft, getValue( this ) );
}

on envVar KCAN_MO_HYB_Fahrbereitschaft
{
    _mMotor_14.MO_HYB_Fahrbereitschaft.phys = getValue( this );
    Motor_14Changed();
}

on envVar eMO_HYB_VM_aktivS
{
    putValue( KCAN_MO_HYB_VM_aktiv, getValue( this ) );
}

on envVar KCAN_MO_HYB_VM_aktiv
{
    _mMotor_14.MO_HYB_VM_aktiv.phys = getValue( this );
    Motor_14Changed();
}

on envVar eMO_InterlockS
{
    putValue( KCAN_MO_Interlock, getValue( this ) );
}

on envVar KCAN_MO_Interlock
{
    _mMotor_14.MO_Interlock.phys = getValue( this );
    Motor_14Changed();
}

on envVar eMO_KickdownS
{
    putValue( KCAN_MO_Kickdown, getValue( this ) );
}

on envVar KCAN_MO_Kickdown
{
    _mMotor_14.MO_Kickdown.phys = getValue( this );
    Motor_14Changed();
}

on envVar eMO_Kl_50S
{
    putValue( KCAN_MO_Kl_50, getValue( this ) );
}

on envVar KCAN_MO_Kl_50
{
    _mMotor_14.MO_Kl_50.phys = getValue( this );
    Motor_14Changed();
}

on envVar eMO_Kl_75S
{
    putValue( KCAN_MO_Kl_75, getValue( this ) );
}

on envVar KCAN_MO_Kl_75
{
    _mMotor_14.MO_Kl_75.phys = getValue( this );
    Motor_14Changed();
}

on envVar eMO_Klima_EingrS
{
    putValue( KCAN_MO_Klima_Eingr, getValue( this ) );
}

on envVar KCAN_MO_Klima_Eingr
{
    _mMotor_14.MO_Klima_Eingr.phys = getValue( this );
    Motor_14Changed();
}

on envVar eMO_Konsistenz_BremspedS
{
    putValue( KCAN_MO_Konsistenz_Bremsped, getValue( this ) );
}

on envVar KCAN_MO_Konsistenz_Bremsped
{
    _mMotor_14.MO_Konsistenz_Bremsped.phys = getValue( this );
    Motor_14Changed();
}

on envVar eMO_Kuppl_schalterS
{
    putValue( KCAN_MO_Kuppl_schalter, getValue( this ) );
}

on envVar KCAN_MO_Kuppl_schalter
{
    _mMotor_14.MO_Kuppl_schalter.phys = getValue( this );
    Motor_14Changed();
}

on envVar eMO_Motor_laeuftS
{
    putValue( KCAN_MO_Motor_laeuft, getValue( this ) );
}

on envVar KCAN_MO_Motor_laeuft
{
    _mMotor_14.MO_Motor_laeuft.phys = getValue( this );
    Motor_14Changed();
}

on envVar KCAN_MO_PTC_Status
{
    _mMotor_14.MO_PTC_Status.phys = getValue( this );
    Motor_14Changed();
}

on envVar eMO_QBit_Fahrer_bremstS
{
    putValue( KCAN_MO_QBit_Fahrer_bremst, getValue( this ) );
}

on envVar KCAN_MO_QBit_Fahrer_bremst
{
    _mMotor_14.MO_QBit_Fahrer_bremst.phys = getValue( this );
    Motor_14Changed();
}

on envVar KCAN_MO_QBit_Gangposition
{
    _mMotor_14.MO_QBit_Gangposition.phys = getValue( this );
    Motor_14Changed();
}

on envVar KCAN_MO_QBit_KL_75
{
    _mMotor_14.MO_QBit_KL_75.phys = getValue( this );
    Motor_14Changed();
}

on envVar KCAN_MO_Remotestart_Betrieb
{
    _mMotor_14.MO_Remotestart_Betrieb.phys = getValue( this );
    Motor_14Changed();
}

on envVar KCAN_MO_Remotestart_moeglich
{
    _mMotor_14.MO_Remotestart_moeglich.phys = getValue( this );
    Motor_14Changed();
}

on envVar KCAN_MO_Signalquelle_Gangposition
{
    _mMotor_14.MO_Signalquelle_Gangposition.phys = getValue( this );
    Motor_14Changed();
}

on envVar eMO_StartStopp_FahrerwunschS
{
    putValue( KCAN_MO_StartStopp_Fahrerwunsch, getValue( this ) );
}

on envVar KCAN_MO_StartStopp_Fahrerwunsch
{
    _mMotor_14.MO_StartStopp_Fahrerwunsch.phys = getValue( this );
    Motor_14Changed();
}

on envVar eMO_StartStopp_MotorstoppS
{
    putValue( KCAN_MO_StartStopp_Motorstopp, getValue( this ) );
}

on envVar KCAN_MO_StartStopp_Motorstopp
{
    _mMotor_14.MO_StartStopp_Motorstopp.phys = getValue( this );
    Motor_14Changed();
}

on envVar eMO_StartStopp_StatusS
{
    putValue( KCAN_MO_StartStopp_Status, getValue( this ) );
}

on envVar KCAN_MO_StartStopp_Status
{
    _mMotor_14.MO_StartStopp_Status.phys = getValue( this );
    Motor_14Changed();
}

on envVar eMO_StartStopp_WiederstartS
{
    putValue( KCAN_MO_StartStopp_Wiederstart, getValue( this ) );
}

on envVar KCAN_MO_StartStopp_Wiederstart
{
    _mMotor_14.MO_StartStopp_Wiederstart.phys = getValue( this );
    Motor_14Changed();
}

on envVar KCAN_MO_StartVorauss_erfuellt
{
    _mMotor_14.MO_StartVorauss_erfuellt.phys = getValue( this );
    Motor_14Changed();
}

on envVar eMO_Timeout_ESPS
{
    putValue( KCAN_MO_Timeout_ESP, getValue( this ) );
}

on envVar KCAN_MO_Timeout_ESP
{
    _mMotor_14.MO_Timeout_ESP.phys = getValue( this );
    Motor_14Changed();
}

on envVar KCAN_MO_Zylinderabschaltung
{
    _mMotor_14.MO_Zylinderabschaltung.phys = getValue( this );
    Motor_14Changed();
}

on Timer _tMotor_18
{
    if( getValue( eTMotor_18 ) <= 0)  putValue( eSendMotor_18, 0 );
    if( ( getValue( eSendEnabled ) && getValue( eSendMotor_18 )) || getValue( eDlcOnceMotor_18 ))  sendMotor_18();
}

on envVar eSendMotor_18
{
    if( getValue( eSendEnabled ) && getValue( eSendMotor_18 ))  sendMotor_18();
}

on envVar eTimeoutMotor_18
{
    cancelTimer( _tMotor_18 );
    cancelTimer( _totMotor_18 );
    if( getValue( this ))
        setTimer( _totMotor_18, ( getValue( eSendEnabled ) && getValue( eSendMotor_18 ) && ( getValue( eTOTMotor_18 ) > 0)) ? getValue( eTOTMotor_18 ) : 1 );
    else
        if( getValue( eSendEnabled ) && getValue( eSendMotor_18 ))  sendMotor_18();
}

on Timer _totMotor_18
{
    putValue( eTimeoutMotor_18, 0 );
}

on envVar eDlcOnceMotor_18
{
    if( getValue( eDlcOnceMotor_18 ) && !( getValue( eSendEnabled ) && getValue( eSendMotor_18 )))  setTimer( _tMotor_18, 1 );
}

void sendMotor_18()
{
    if( getValue( eChangeMotor_18))
    {
        if( getValue( eDlcOnceMotor_18 ) || getValue( eDlcWrongMotor_18 ))
        {
            putValue( eDlcOnceMotor_18, 0 );
            _mMotor_18.DLC = getValue( eDlcMotor_18 );
        }
        else
        {
            _mMotor_18.DLC = 8;
        }
    }
    else
    {
        _mMotor_18.DLC = 8;
    }
    output( _mMotor_18 );
    cancelTimer( _tMotor_18 );
    if( getValue( eTMotor_18 ) > 0)  setTimer( _tMotor_18, getValue( eTMotor_18 ) );  else  setTimer( _tMotor_18, 1 );
}

Motor_18Changed()
{
}

on envVar KCAN_MO_Abstellzeit
{
    _mMotor_18.MO_Abstellzeit.phys = getValue( this );
    Motor_18Changed();
}

on envVar KCAN_MO_Abstellzeit_Status
{
    _mMotor_18.MO_Abstellzeit_Status.phys = getValue( this );
    Motor_18Changed();
}

on envVar KCAN_MO_ANC_Kennfeld_Anf
{
    _mMotor_18.MO_ANC_Kennfeld_Anf.phys = getValue( this );
    Motor_18Changed();
}

on envVar KCAN_MO_Anzahl_Abgesch_Zyl
{
    _mMotor_18.MO_Anzahl_Abgesch_Zyl.phys = getValue( this );
    Motor_18Changed();
}

on envVar KCAN_MO_Bremslicht_Reku
{
    _mMotor_18.MO_Bremslicht_Reku.phys = getValue( this );
    Motor_18Changed();
}

on envVar eMO_Drehzahl_WarnungS
{
    putValue( KCAN_MO_Drehzahl_Warnung, getValue( this ) );
}

on envVar KCAN_MO_Drehzahl_Warnung
{
    _mMotor_18.MO_Drehzahl_Warnung.phys = getValue( this );
    Motor_18Changed();
}

on envVar eMO_EPCLS
{
    putValue( KCAN_MO_EPCL, getValue( this ) );
}

on envVar KCAN_MO_EPCL
{
    _mMotor_18.MO_EPCL.phys = getValue( this );
    Motor_18Changed();
}

on envVar eMO_Ethanol_BS_Texte
{
    putValue( KCAN_MO_Ethanol_BS_Texte, getValue( this ) );
}

on envVar KCAN_MO_Ethanol_BS_Texte
{
    _mMotor_18.MO_Ethanol_BS_Texte.phys = getValue( this );
    Motor_18Changed();
}

on envVar eMO_FahrzeugtypS
{
    putValue( KCAN_MO_Fahrzeugtyp, getValue( this ) );
}

on envVar KCAN_MO_Fahrzeugtyp
{
    _mMotor_18.MO_Fahrzeugtyp.phys = getValue( this );
    Motor_18Changed();
}

on envVar KCAN_MO_Fehler_Zylabsch
{
    _mMotor_18.MO_Fehler_Zylabsch.phys = getValue( this );
    Motor_18Changed();
}

on envVar eMO_Hybrid_StartStopp_LED
{
    putValue( KCAN_MO_Hybrid_StartStopp_LED, getValue( this ) );
}

on envVar KCAN_MO_Hybrid_StartStopp_LED
{
    _mMotor_18.MO_Hybrid_StartStopp_LED.phys = getValue( this );
    Motor_18Changed();
}

on envVar eMO_max_LadedruckS
{
    putValue( KCAN_MO_max_Ladedruck, getValue( this ) );
}

on envVar KCAN_MO_max_Ladedruck
{
    _mMotor_18.MO_max_Ladedruck.phys = getValue( this );
    Motor_18Changed();
}

on envVar KCAN_MO_NMAX_Schaltanzeige
{
    _mMotor_18.MO_NMAX_Schaltanzeige.phys = getValue( this );
    Motor_18Changed();
}

on envVar eMO_obere_DrehzahlgrenzeS
{
    putValue( KCAN_MO_obere_Drehzahlgrenze, getValue( this ) );
}

on envVar KCAN_MO_obere_Drehzahlgrenze
{
    _mMotor_18.MO_obere_Drehzahlgrenze.phys = getValue( this );
    Motor_18Changed();
}

on envVar eMO_StartStopp_PopUpS
{
    putValue( KCAN_MO_StartStopp_PopUp, getValue( this ) );
}

on envVar KCAN_MO_StartStopp_PopUp
{
    _mMotor_18.MO_StartStopp_PopUp.phys = getValue( this );
    Motor_18Changed();
}

on envVar KCAN_MO_Zylabsch_Texte
{
    _mMotor_18.MO_Zylabsch_Texte.phys = getValue( this );
    Motor_18Changed();
}

on envVar eMO_Zylabsch_Texte_02
{
    putValue( KCAN_MO_Zylabsch_Texte_02, getValue( this ) );
}

on envVar KCAN_MO_Zylabsch_Texte_02
{
    _mMotor_18.MO_Zylabsch_Texte_02.phys = getValue( this );
    Motor_18Changed();
}

on envVar KCAN_MO1_Freigabe_Info_WFS
{
    _mMotor_18.MO1_Freigabe_Info_WFS.phys = getValue( this );
    Motor_18Changed();
}

on envVar KCAN_MO1_Freigabe_Verfallsinfo_WFS
{
    _mMotor_18.MO1_Freigabe_Verfallsinfo_WFS.phys = getValue( this );
    Motor_18Changed();
}

on envVar KCAN_MO1_Sperr_Info_WFS
{
    _mMotor_18.MO1_Sperr_Info_WFS.phys = getValue( this );
    Motor_18Changed();
}

on Timer _tMotor_23
{
    if( getValue( eTMotor_23 ) <= 0)  putValue( eSendMotor_23, 0 );
    if( ( getValue( eSendEnabled ) && getValue( eSendMotor_23 )) || getValue( eDlcOnceMotor_23 ))  sendMotor_23();
}

on envVar eSendMotor_23
{
    if( getValue( eSendEnabled ) && getValue( eSendMotor_23 ))  sendMotor_23();
}

on envVar eTimeoutMotor_23
{
    cancelTimer( _tMotor_23 );
    cancelTimer( _totMotor_23 );
    if( getValue( this ))
        setTimer( _totMotor_23, ( getValue( eSendEnabled ) && getValue( eSendMotor_23 ) && ( getValue( eTOTMotor_23 ) > 0)) ? getValue( eTOTMotor_23 ) : 1 );
    else
        if( getValue( eSendEnabled ) && getValue( eSendMotor_23 ))  sendMotor_23();
}

on Timer _totMotor_23
{
    putValue( eTimeoutMotor_23, 0 );
}

on envVar eDlcOnceMotor_23
{
    if( getValue( eDlcOnceMotor_23 ) && !( getValue( eSendEnabled ) && getValue( eSendMotor_23 )))  setTimer( _tMotor_23, 1 );
}

void sendMotor_23()
{
    if( getValue( eChangeMotor_23 ))
    {
        if( getValue( eDlcOnceMotor_23 ) || getValue( eDlcWrongMotor_23 ))
        {
            putValue( eDlcOnceMotor_23, 0 );
            _mMotor_23.DLC = getValue( eDlcMotor_23 );
        }
        else
        {
            _mMotor_23.DLC = 8;
        }
    }
    else
    {
        _mMotor_23.DLC = 8;
    }

    output( _mMotor_23 );
    cancelTimer( _tMotor_23 );
    if( getValue( eTMotor_23 ) > 0)  setTimer( _tMotor_23, getValue( eTMotor_23 ) );  else  setTimer( _tMotor_23, 1 );
}

Motor_23Changed()
{
}

on envVar eMO_Antriebsstrang_Warnung_HSS
{
    putValue( KCAN_MO_Antriebsstrang_Warnung_HS, getValue( this ) );
}

on envVar KCAN_MO_Antriebsstrang_Warnung_HS
{
    _mMotor_23.MO_Antriebsstrang_Warnung_HS.phys = getValue( this );
    Motor_23Changed();
}

on envVar eMO_Anzeige_BetriebsmodusS
{
    putValue( KCAN_MO_Anzeige_Betriebsmodus, getValue( this ) );
}

on envVar KCAN_MO_Anzeige_Betriebsmodus
{
    _mMotor_23.MO_Anzeige_Betriebsmodus.phys = getValue( this );
    Motor_23Changed();
}

on envVar KCAN_MO_Anzeige_Fahrbereitschaft
{
    _mMotor_23.MO_Anzeige_Fahrbereitschaft.phys = getValue( this );
    Motor_23Changed();
}

on envVar eMO_Anzeige_RekuperationS
{
    putValue( KCAN_MO_Anzeige_Rekuperation, getValue( this ) );
}

on envVar KCAN_MO_Anzeige_Rekuperation
{
    _mMotor_23.MO_Anzeige_Rekuperation.phys = getValue( this );
    Motor_23Changed();
}

on envVar eMO_Anzeige_Verbrauch_oES
{
    putValue( KCAN_MO_Anzeige_Verbrauch_oE, getValue( this ) );
}

on envVar KCAN_MO_Anzeige_Verbrauch_oE
{
    _mMotor_23.MO_Anzeige_Verbrauch_oE.phys = getValue( this );
    Motor_23Changed();
}

on envVar KCAN_MO_Boost_aktiv
{
    _mMotor_23.MO_Boost_aktiv.phys = getValue( this );
    Motor_23Changed();
}

on envVar KCAN_MO_Boost_verfuegbar
{
    _mMotor_23.MO_Boost_verfuegbar.phys = getValue( this );
    Motor_23Changed();
}

on envVar KCAN_MO_Overboost
{
    _mMotor_23.MO_Overboost.phys = getValue( this );
    Motor_23Changed();
}

on envVar KCAN_PEA_Abschalttexte
{
    _mMotor_23.PEA_Abschalttexte.phys = getValue( this );
    Motor_23Changed();
}

on envVar KCAN_PEA_Ereignisanzeige
{
    _mMotor_23.PEA_Ereignisanzeige.phys = getValue( this );
    Motor_23Changed();
}

on envVar KCAN_PEA_Ereignisanzeige_temporaer
{
    _mMotor_23.PEA_Ereignisanzeige_temporaer.phys = getValue( this );
    Motor_23Changed();
}

on envVar KCAN_PEA_Fortschrittsanzeige
{
    _mMotor_23.PEA_Fortschrittsanzeige.phys = getValue( this );
    Motor_23Changed();
}

on envVar KCAN_PEA_Hinweis
{
    _mMotor_23.PEA_Hinweis.phys = getValue( this );
    Motor_23Changed();
}

on envVar KCAN_PEA_Zielgeschw
{
    _mMotor_23.PEA_Zielgeschw.phys = getValue( this );
    Motor_23Changed();
}

on envVar KCAN_PEA_Zielgeschw_Einheit
{
    _mMotor_23.PEA_Zielgeschw_Einheit.phys = getValue( this );
    Motor_23Changed();
}

on Timer _tMotor_25
{
    if( getValue( eTMotor_25 ) <= 0)  putValue( eSendMotor_25, 0 );
    if( ( getValue( eSendEnabled ) && getValue( eSendMotor_25 )) || getValue( eDlcOnceMotor_25 ))  sendMotor_25();
}

on envVar eSendMotor_25
{
    if( getValue( eSendEnabled ) && getValue( eSendMotor_25 ))  sendMotor_25();
}

on envVar eTimeoutMotor_25
{
    cancelTimer( _tMotor_25 );
    cancelTimer( _totMotor_25 );
    if( getValue( this ))
        setTimer( _totMotor_25, ( getValue( eSendEnabled ) && getValue( eSendMotor_25 ) && ( getValue( eTOTMotor_25 ) > 0)) ? getValue( eTOTMotor_25 ) : 1 );
    else
        if( getValue( eSendEnabled ) && getValue( eSendMotor_25 ))  sendMotor_25();
}

on Timer _totMotor_25
{
    putValue( eTimeoutMotor_25, 0 );
}

on envVar eDlcOnceMotor_25
{
    if( getValue( eDlcOnceMotor_25 ) && !( getValue( eSendEnabled ) && getValue( eSendMotor_25 )))  setTimer( _tMotor_25, 1 );
}

void sendMotor_25()
{
    if( getValue( eChangeMotor_25 ))
    {
        if( getValue( eDlcOnceMotor_25 ) || getValue( eDlcWrongMotor_25 ))
        {
            putValue( eDlcOnceMotor_25, 0 );
            _mMotor_25.DLC = getValue( eDlcMotor_25 );
        }
        else
        {
            _mMotor_25.DLC = 8;
        }
    }
    else
    {
        _mMotor_25.DLC = 8;
    }

    output( _mMotor_25 );
    cancelTimer( _tMotor_25 );
    if( getValue( eTMotor_25 ) > 0)  setTimer( _tMotor_25, getValue( eTMotor_25 ) );  else  setTimer( _tMotor_25, 1 );
}

Motor_25Changed()
{
}

on envVar eMO_Anzeige_Drehmoment_MaxS
{
    putValue( KCAN_MO_Anzeige_Drehmoment_Max, getValue( this ) );
}

on envVar KCAN_MO_Anzeige_Drehmoment_Max
{
    _mMotor_25.MO_Anzeige_Drehmoment_Max.phys = getValue( this );
    Motor_25Changed();
}

on envVar eMO_Anzeige_Leistung_MaxS
{
    putValue( KCAN_MO_Anzeige_Leistung_Max, getValue( this ) );
}

on envVar KCAN_MO_Anzeige_Leistung_Max
{
    _mMotor_25.MO_Anzeige_Leistung_Max.phys = getValue( this );
    Motor_25Changed();
}

on envVar KCAN_MO_IstLeistung_EKAT
{
    _mMotor_25.MO_IstLeistung_EKAT.phys = getValue( this );
    Motor_25Changed();
}

on Timer _tMotor_26
{
    if( getValue( eTMotor_26 ) <= 0)  putValue( eSendMotor_26, 0 );
    if( ( getValue( eSendEnabled ) && getValue( eSendMotor_26 )) || getValue( eDlcOnceMotor_26 ))  sendMotor_26();
}

on envVar eSendMotor_26
{
    if( getValue( eSendEnabled ) && getValue( eSendMotor_26 ))  sendMotor_26();
}

on envVar eTimeoutMotor_26
{
    cancelTimer( _tMotor_26 );
    cancelTimer( _totMotor_26 );
    if( getValue( this ))
        setTimer( _totMotor_26, ( getValue( eSendEnabled ) && getValue( eSendMotor_26 ) && ( getValue( eTOTMotor_26 ) > 0)) ? getValue( eTOTMotor_26 ) : 1 );
    else
        if( getValue( eSendEnabled ) && getValue( eSendMotor_26 ))  sendMotor_26();
}

on Timer _totMotor_26
{
    putValue( eTimeoutMotor_26, 0 );
}

on envVar eDlcOnceMotor_26
{
    if( getValue( eDlcOnceMotor_26 ) && !( getValue( eSendEnabled ) && getValue( eSendMotor_26 )))  setTimer( _tMotor_26, 1 );
}

void sendMotor_26()
{
    if( getValue( eChangeMotor_26 ))
    {
        if( getValue( eDlcOnceMotor_26 ) || getValue( eDlcWrongMotor_26 ))
        {
            putValue( eDlcOnceMotor_26, 0 );
            _mMotor_26.DLC = getValue( eDlcMotor_26 );
        }
        else
        {
            _mMotor_26.DLC = 8;
        }
    }
    else
    {
        _mMotor_26.DLC = 8;
    }

    output( _mMotor_26 );

    putValue( eMO_Kuehlerluefter_MUXS, ( getValue( eMO_Kuehlerluefter_MUXS ) + 1) % 2 );  // automatic MUX-changer

    cancelTimer( _tMotor_26 );
    if( getValue( eTMotor_26 ) > 0)  setTimer( _tMotor_26, getValue( eTMotor_26 ) );  else  setTimer( _tMotor_26, 1 );
}

Motor_26Changed()
{
}

on envVar eMO_E_ModeS
{
    putValue( KCAN_MO_E_Mode, getValue( this ) );
}

on envVar KCAN_MO_E_Mode
{
    _mMotor_26.MO_E_Mode.phys = getValue( this );
    Motor_26Changed();
}

on envVar eMO_E_TexteS
{
    putValue( KCAN_MO_E_Texte, getValue( this ) );
}

on envVar KCAN_MO_E_Texte
{
    _mMotor_26.MO_E_Texte.phys = getValue( this );
    Motor_26Changed();
}

on envVar eMO_E_WarnungenS
{
    putValue( KCAN_MO_E_Warnungen, getValue( this ) );
}

on envVar KCAN_MO_E_Warnungen
{
    _mMotor_26.MO_E_Warnungen.phys = getValue( this );
    Motor_26Changed();
}

on envVar eMO_EFLEX_LampeS
{
    putValue( KCAN_MO_EFLEX_Lampe, getValue( this ) );
}

on envVar KCAN_MO_EFLEX_Lampe
{
    _mMotor_26.MO_EFLEX_Lampe.phys = getValue( this );
    Motor_26Changed();
}

on envVar eMO_HeissleuchteS
{
    putValue( KCAN_MO_Heissleuchte, getValue( this ) );
}

on envVar KCAN_MO_Heissleuchte
{
    _mMotor_26.MO_Heissleuchte.phys = getValue( this );
    Motor_26Changed();
}

on envVar eMO_ITM_Warnung_PumpeS
{
    putValue( KCAN_MO_ITM_Warnung_Pumpe, getValue( this ) );
}

on envVar KCAN_MO_ITM_Warnung_Pumpe
{
    _mMotor_26.MO_ITM_Warnung_Pumpe.phys = getValue( this );
    Motor_26Changed();
}

on envVar eMO_KJS_nicht_bereitS
{
    putValue( KCAN_MO_KJS_nicht_bereit, getValue( this ) );
}

on envVar KCAN_MO_KJS_nicht_bereit
{
    _mMotor_26.MO_KJS_nicht_bereit.phys = getValue( this );
    Motor_26Changed();
}

on envVar eMO_Kuehlerluefter_MUXS
{
    putValue( KCAN_MO_Kuehlerluefter_MUX, getValue( this ) );
}

on envVar KCAN_MO_Kuehlerluefter_MUX
{
    _mMotor_26.MO_Kuehlerluefter_MUX.phys = getValue( this );
    if( _mMotor_26.MO_Kuehlerluefter_MUX == 0 )
        _mMotor_26.MO_Kuehlerluefter_1 = getValue( eMO_Kuehlerluefter_1S );
    else
        _mMotor_26.MO_Kuehlerluefter_2 = getValue( eMO_Kuehlerluefter_2S );
    Motor_26Changed();
}

on envVar eMO_Kuehlerluefter_1S
{
    putValue( KCAN_MO_Kuehlerluefter_1, getValue( this ) );
}

on envVar KCAN_MO_Kuehlerluefter_1
{
    if( _mMotor_26.MO_Kuehlerluefter_MUX == 0 )
    {
        _mMotor_26.MO_Kuehlerluefter_1.phys = getValue( this );
        Motor_26Changed();
    }
}

on envVar eMO_Kuehlerluefter_2S
{
    putValue( KCAN_MO_Kuehlerluefter_2, getValue( this ) );
}

on envVar KCAN_MO_Kuehlerluefter_2
{
    if( _mMotor_26.MO_Kuehlerluefter_MUX == 1 )
    {
        _mMotor_26.MO_Kuehlerluefter_2.phys = getValue( this );
        Motor_26Changed();
    }
}

on envVar eMO_OBD2_LampeS
{
    putValue( KCAN_MO_OBD2_Lampe, getValue( this ) );
}

on envVar KCAN_MO_OBD2_Lampe
{
    _mMotor_26.MO_OBD2_Lampe.phys = getValue( this );
    Motor_26Changed();
}

on envVar eMO_Oelwarnung_maxS
{
    putValue( KCAN_MO_Oelwarnung_max, getValue( this ) );
}

on envVar KCAN_MO_Oelwarnung_max
{
    _mMotor_26.MO_Oelwarnung_max.phys = getValue( this );
    Motor_26Changed();
}

on envVar eMO_Partikel_LampeS
{
    putValue( KCAN_MO_Partikel_Lampe, getValue( this ) );
}

on envVar KCAN_MO_Partikel_Lampe
{
    _mMotor_26.MO_Partikel_Lampe.phys = getValue( this );
    Motor_26Changed();
}

on envVar eMO_RedFahrleistung_Lampe
{
    putValue( KCAN_MO_RedFahrleistung_Lampe, getValue( this ) );
}

on envVar KCAN_MO_RedFahrleistung_Lampe
{
    _mMotor_26.MO_RedFahrleistung_Lampe.phys = getValue( this );
    Motor_26Changed();
}

on envVar eMO_SystemlampeS
{
    putValue( KCAN_MO_Systemlampe, getValue( this ) );
}

on envVar KCAN_MO_Systemlampe
{
    _mMotor_26.MO_Systemlampe.phys = getValue( this );
    Motor_26Changed();
}

on envVar KCAN_MO_Tankdeckel_Lampe
{
    _mMotor_26.MO_Tankdeckel_Lampe.phys = getValue( this );
    Motor_26Changed();
}

on envVar eMO_Text_MotorstartS
{
    putValue( KCAN_MO_Text_Motorstart, getValue( this ) );
}

on envVar KCAN_MO_Text_Motorstart
{
    _mMotor_26.MO_Text_Motorstart.phys = getValue( this );
    Motor_26Changed();
}

on envVar eMO_Text_Partikelfil_RegS
{
    putValue( KCAN_MO_Text_Partikelfil_Reg, getValue( this ) );
}

on envVar KCAN_MO_Text_Partikelfil_Reg
{
    _mMotor_26.MO_Text_Partikelfil_Reg.phys = getValue( this );
    Motor_26Changed();
}

on envVar eMO_Text_TankdeckelwarnS
{
    putValue( KCAN_MO_Text_Tankdeckelwarn, getValue( this ) );
}

on envVar KCAN_MO_Text_Tankdeckelwarn
{
    _mMotor_26.MO_Text_Tankdeckelwarn.phys = getValue( this );
    Motor_26Changed();
}

on envVar eMO_Vorglueh_LampeS
{
    putValue( KCAN_MO_Vorglueh_Lampe, getValue( this ) );
}

on envVar KCAN_MO_Vorglueh_Lampe
{
    _mMotor_26.MO_Vorglueh_Lampe.phys = getValue( this );
    Motor_26Changed();
}

on envVar eMO_Zustand_HWPS
{
    putValue( KCAN_MO_Zustand_HWP, getValue( this ) );
}

on envVar KCAN_MO_Zustand_HWP
{
    _mMotor_26.MO_Zustand_HWP.phys = getValue( this );
    Motor_26Changed();
}

on envVar eOLEV_Oelstand_nicht_vorhandenS
{
    putValue( KCAN_OLEV_Oelstand_nicht_vorhanden, getValue( this ) );
}

on envVar KCAN_OLEV_Oelstand_nicht_vorhanden
{
    _mMotor_26.OLEV_Oelstand_nicht_vorhanden.phys = getValue( this );
    Motor_26Changed();
}

on envVar eOLEV_SystemstoerungS
{
    putValue( KCAN_OLEV_Systemstoerung, getValue( this ) );
}

on envVar KCAN_OLEV_Systemstoerung
{
    _mMotor_26.OLEV_Systemstoerung.phys = getValue( this );
    Motor_26Changed();
}

on envVar eWIV_Anzeige_aktivS
{
    putValue( KCAN_WIV_Anzeige_aktiv, getValue( this ) );
}

on envVar KCAN_WIV_Anzeige_aktiv
{
    _mMotor_26.WIV_Anzeige_aktiv.phys = getValue( this );
    Motor_26Changed();
}

on envVar eWIV_laufender_MotorS
{
    putValue( KCAN_WIV_laufender_Motor, getValue( this ) );
}

on envVar KCAN_WIV_laufender_Motor
{
    _mMotor_26.WIV_laufender_Motor.phys = getValue( this );
    Motor_26Changed();
}

on envVar eWIV_nachfuellanzeige_einS
{
    putValue( KCAN_WIV_nachfuellanzeige_ein, getValue( this ) );
}

on envVar KCAN_WIV_nachfuellanzeige_ein
{
    _mMotor_26.WIV_nachfuellanzeige_ein.phys = getValue( this );
    Motor_26Changed();
}

on envVar eWIV_nicht_betriebswarmS
{
    putValue( KCAN_WIV_nicht_betriebswarm, getValue( this ) );
}

on envVar KCAN_WIV_nicht_betriebswarm
{
    _mMotor_26.WIV_nicht_betriebswarm.phys = getValue( this );
    Motor_26Changed();
}

on envVar eWIV_Oeldr_Warn_MotorS
{
    putValue( KCAN_WIV_Oeldr_Warn_Motor, getValue( this ) );
}

on envVar KCAN_WIV_Oeldr_Warn_Motor
{
    _mMotor_26.WIV_Oeldr_Warn_Motor.phys = getValue( this );
    Motor_26Changed();
}

on envVar KCAN_WIV_Oeldyn_avl
{
    _mMotor_26.WIV_Oeldyn_avl.phys = getValue( this );
    Motor_26Changed();
}

on envVar eWIV_OelmengeS
{
    putValue( KCAN_WIV_Oelmenge, getValue( this ) );
}

on envVar KCAN_WIV_Oelmenge
{
    _mMotor_26.WIV_Oelmenge.phys = getValue( this );
    Motor_26Changed();
}

on envVar eWIV_Oelmin_WarnS
{
    putValue( KCAN_WIV_Oelmin_Warn, getValue( this ) );
}

on envVar KCAN_WIV_Oelmin_Warn
{
    _mMotor_26.WIV_Oelmin_Warn.phys = getValue( this );
    Motor_26Changed();
}

on envVar eWIV_OelstandS
{
    putValue( KCAN_WIV_Oelstand, getValue( this ) );
}

on envVar KCAN_WIV_Oelstand
{
    _mMotor_26.WIV_Oelstand.phys = getValue( this );
    Motor_26Changed();
}

on envVar eWIV_Oelstand_nicht_vorhandenS
{
    putValue( KCAN_WIV_Oelstand_nicht_vorhanden, getValue( this ) );
}

on envVar KCAN_WIV_Oelstand_nicht_vorhanden
{
    _mMotor_26.WIV_Oelstand_nicht_vorhanden.phys = getValue( this );
    Motor_26Changed();
}

on envVar eWIV_Oelsystem_aktivS
{
    putValue( KCAN_WIV_Oelsystem_aktiv, getValue( this ) );
}

on envVar KCAN_WIV_Oelsystem_aktiv
{
    _mMotor_26.WIV_Oelsystem_aktiv.phys = getValue( this );
    Motor_26Changed();
}

on envVar eWIV_SchieflageS
{
    putValue( KCAN_WIV_Schieflage, getValue( this ) );
}

on envVar KCAN_WIV_Schieflage
{
    _mMotor_26.WIV_Schieflage.phys = getValue( this );
    Motor_26Changed();
}

on envVar eWIV_SensorfehlerS
{
    putValue( KCAN_WIV_Sensorfehler, getValue( this ) );
}

on envVar KCAN_WIV_Sensorfehler
{
    _mMotor_26.WIV_Sensorfehler.phys = getValue( this );
    Motor_26Changed();
}

on envVar eWIV_Ueberfuell_deaktivS
{
    putValue( KCAN_WIV_Ueberfuell_deaktiv, getValue( this ) );
}

on envVar KCAN_WIV_Ueberfuell_deaktiv
{
    _mMotor_26.WIV_Ueberfuell_deaktiv.phys = getValue( this );
    Motor_26Changed();
}

on envVar eWIV_Ueberfuell_WarnS
{
    putValue( KCAN_WIV_Ueberfuell_Warn, getValue( this ) );
}

on envVar KCAN_WIV_Ueberfuell_Warn
{
    _mMotor_26.WIV_Ueberfuell_Warn.phys = getValue( this );
    Motor_26Changed();
}

on envVar eWIV_Unterfuell_WarnS
{
    putValue( KCAN_WIV_Unterfuell_Warn, getValue( this ) );
}

on envVar KCAN_WIV_Unterfuell_Warn
{
    _mMotor_26.WIV_Unterfuell_Warn.phys = getValue( this );
    Motor_26Changed();
}

on Timer _tMotor_29
{
    if( getValue( eTMotor_29 ) <= 0)  putValue( eSendMotor_29, 0 );
    if( ( getValue( eSendEnabled ) && getValue( eSendMotor_29 )) || getValue( eDlcOnceMotor_29 ))  sendMotor_29();
}

on envVar eSendMotor_29
{
    if( getValue( eSendEnabled ) && getValue( eSendMotor_29 ))  sendMotor_29();
}

on envVar eTimeoutMotor_29
{
    cancelTimer( _tMotor_29 );
    cancelTimer( _totMotor_29 );
    if( getValue( this ))
        setTimer( _totMotor_29, ( getValue( eSendEnabled ) && getValue( eSendMotor_29 ) && ( getValue( eTOTMotor_29 ) > 0)) ? getValue( eTOTMotor_29 ) : 1 );
    else
        if( getValue( eSendEnabled ) && getValue( eSendMotor_29 ))  sendMotor_29();
}

on Timer _totMotor_29
{
    putValue( eTimeoutMotor_29, 0 );
}

on envVar eDlcOnceMotor_29
{
    if( getValue( eDlcOnceMotor_29 ) && !( getValue( eSendEnabled ) && getValue( eSendMotor_29 )))  setTimer( _tMotor_29, 1 );
}

void sendMotor_29()
{
    if( getValue( eChangeMotor_29 ))
    {
        if( getValue( eDlcOnceMotor_29 ) || getValue( eDlcWrongMotor_29 ))
        {
            putValue( eDlcOnceMotor_29, 0 );
            _mMotor_29.DLC = getValue( eDlcMotor_29 );
        }
        else
        {
            _mMotor_29.DLC = 8;
        }
    }
    else
    {
        _mMotor_29.DLC = 8;
    }

    output( _mMotor_29 );
    cancelTimer( _tMotor_29 );
    if( getValue( eTMotor_29 ) > 0)  setTimer( _tMotor_29, getValue( eTMotor_29 ) );  else  setTimer( _tMotor_29, 1 );
}

Motor_29Changed()
{
}

on envVar eMO_Anzeige_DrehmomentS
{
    putValue( KCAN_MO_Anzeige_Drehmoment, getValue( this ) );
}

on envVar KCAN_MO_Anzeige_Drehmoment
{
    _mMotor_29.MO_Anzeige_Drehmoment.phys = getValue( this );
    Motor_29Changed();
}

on envVar eMO_Anzeige_LeistungS
{
    putValue( KCAN_MO_Anzeige_Leistung, getValue( this ) );
}

on envVar KCAN_MO_Anzeige_Leistung
{
    _mMotor_29.MO_Anzeige_Leistung.phys = getValue( this );
    Motor_29Changed();
}

on envVar eMO_Anzeige_Verbr_EinheitS
{
    putValue( KCAN_MO_Anzeige_Verbr_Einheit, getValue( this ) );
}

on envVar KCAN_MO_Anzeige_Verbr_Einheit
{
    _mMotor_29.MO_Anzeige_Verbr_Einheit.phys = getValue( this );
    Motor_29Changed();
}

on envVar KCAN_MO_Hochschaltdrehz
{
    _mMotor_29.MO_Hochschaltdrehz.phys = getValue( this );
    Motor_29Changed();
}

on envVar eMO_Schaltblitz_AnzS
{
    putValue( KCAN_MO_Schaltblitz_Anz, getValue( this ) );
}

on envVar KCAN_MO_Schaltblitz_Anz
{
    _mMotor_29.MO_Schaltblitz_Anz.phys = getValue( this );
    Motor_29Changed();
}

on Timer _tMotor_31
{
    if( getValue( eTMotor_31 ) <= 0)  putValue( eSendMotor_31, 0 );
    if( ( getValue( eSendEnabled ) && getValue( eSendMotor_31 )) || getValue( eDlcOnceMotor_31 ))  sendMotor_31();
}

on envVar eSendMotor_31
{
    if( getValue( eSendEnabled ) && getValue( eSendMotor_31 ))  sendMotor_31();
}

on envVar eTimeoutMotor_31
{
    cancelTimer( _tMotor_31 );
    cancelTimer( _totMotor_31 );
    if( getValue( this ))
        setTimer( _totMotor_31, ( getValue( eSendEnabled ) && getValue( eSendMotor_31 ) && ( getValue( eTOTMotor_31 ) > 0)) ? getValue( eTOTMotor_31 ) : 1 );
    else
        if( getValue( eSendEnabled ) && getValue( eSendMotor_31 ))  sendMotor_31();
}

on Timer _totMotor_31
{
    putValue( eTimeoutMotor_31, 0 );
}

on envVar eDlcOnceMotor_31
{
    if( getValue( eDlcOnceMotor_31 ) && !( getValue( eSendEnabled ) && getValue( eSendMotor_31 )))  setTimer( _tMotor_31, 1 );
}

void sendMotor_31()
{
    if( getValue( eChangeMotor_31 ))
    {
        if( getValue( eDlcOnceMotor_31 ) || getValue( eDlcWrongMotor_31 ))
        {
            putValue( eDlcOnceMotor_31, 0 );
            _mMotor_31.DLC = getValue( eDlcMotor_31 );
        }
        else
        {
            _mMotor_31.DLC = 8;
        }
    }
    else
    {
        _mMotor_31.DLC = 8;
    }

    output( _mMotor_31 );
    cancelTimer( _tMotor_31 );
    if( getValue( eTMotor_31 ) > 0)  setTimer( _tMotor_31, getValue( eTMotor_31 ) );  else  setTimer( _tMotor_31, 1 );
}

Motor_31Changed()
{
}

on envVar KCAN_FWS_Koeffizient_2
{
    _mMotor_31.FWS_Koeffizient_2.phys = getValue( this );
    Motor_31Changed();
}

on envVar KCAN_FWS_QBit_Koeffizient_2
{
    _mMotor_31.FWS_QBit_Koeffizient_2.phys = getValue( this );
    Motor_31Changed();
}

on envVar KCAN_MO_Fahrzeugabstellzeit
{
    _mMotor_31.MO_Fahrzeugabstellzeit.phys = getValue( this );
    Motor_31Changed();
}

on envVar KCAN_MO_Fahrzeugabstellzeit_Status
{
    _mMotor_31.MO_Fahrzeugabstellzeit_Status.phys = getValue( this );
    Motor_31Changed();
}

on envVar KCAN_MO_HV_Auszeit
{
    _mMotor_31.MO_HV_Auszeit.phys = getValue( this );
    Motor_31Changed();
}

on envVar KCAN_MO_HV_Auszeit_Status
{
    _mMotor_31.MO_HV_Auszeit_Status.phys = getValue( this );
    Motor_31Changed();
}

on envVar KCAN_MO_Verbau_StartSys_EM_HV
{
    _mMotor_31.MO_Verbau_StartSys_EM_HV.phys = getValue( this );
    Motor_31Changed();
}

on envVar eMO_Verbau_StartSys_EM_MVS
{
    putValue( KCAN_MO_Verbau_StartSys_EM_MV, getValue( this ) );
}

on envVar KCAN_MO_Verbau_StartSys_EM_MV
{
    _mMotor_31.MO_Verbau_StartSys_EM_MV.phys = getValue( this );
    Motor_31Changed();
}

on envVar eMO_Verbau_StartSys_Q_DiodeS
{
    putValue( KCAN_MO_Verbau_StartSys_Q_Diode, getValue( this ) );
}

on envVar KCAN_MO_Verbau_StartSys_Q_Diode
{
    _mMotor_31.MO_Verbau_StartSys_Q_Diode.phys = getValue( this );
    Motor_31Changed();
}

on envVar KCAN_MO_Verbau_StartSys_Ritzelstarter
{
    _mMotor_31.MO_Verbau_StartSys_Ritzelstarter.phys = getValue( this );
    Motor_31Changed();
}

on envVar eMO_Verbau_StartSys_RSG_MVS
{
    putValue( KCAN_MO_Verbau_StartSys_RSG_MV, getValue( this ) );
}

on envVar KCAN_MO_Verbau_StartSys_RSG_MV
{
    _mMotor_31.MO_Verbau_StartSys_RSG_MV.phys = getValue( this );
    Motor_31Changed();
}

on envVar eMO_Verbau_StartSys_RSG_NVS
{
    putValue( KCAN_MO_Verbau_StartSys_RSG_NV, getValue( this ) );
}

on envVar KCAN_MO_Verbau_StartSys_RSG_NV
{
    _mMotor_31.MO_Verbau_StartSys_RSG_NV.phys = getValue( this );
    Motor_31Changed();
}

on envVar KCAN_MO_Ziel_SoC_Fremdladung
{
    _mMotor_31.MO_Ziel_SoC_Fremdladung.phys = getValue( this );
    Motor_31Changed();
}

on Timer _tMotor_35
{
    if( getValue( eTMotor_35 ) <= 0)  putValue( eSendMotor_35, 0 );
    if( ( getValue( eSendEnabled ) && getValue( eSendMotor_35 )) || getValue( eDlcOnceMotor_35 ))  sendMotor_35();
}

on envVar eSendMotor_35
{
    if( getValue( eSendEnabled ) && getValue( eSendMotor_35 ))  sendMotor_35();
}

on envVar eTimeoutMotor_35
{
    cancelTimer( _tMotor_35 );
    cancelTimer( _totMotor_35 );
    if( getValue( this ))
        setTimer( _totMotor_35, ( getValue( eSendEnabled ) && getValue( eSendMotor_35 ) && ( getValue( eTOTMotor_35 ) > 0)) ? getValue( eTOTMotor_35 ) : 1 );
    else
        if( getValue( eSendEnabled ) && getValue( eSendMotor_35 ))  sendMotor_35();
}

on Timer _totMotor_35
{
    putValue( eTimeoutMotor_35, 0 );
}

on envVar eDlcOnceMotor_35
{
    if( getValue( eDlcOnceMotor_35 ) && !( getValue( eSendEnabled ) && getValue( eSendMotor_35 )))  setTimer( _tMotor_35, 1 );
}

on Timer _tinhMotor_35
{
    _bsiMotor_35 = 0;
    if( _bsaiMotor_35 && getValue( eSendEnabled ))  sendMotor_35();
}

void sendMotor_35()
{
    if( getValue( eChangeMotor_35))
    {
        if( getValue( eDlcOnceMotor_35 ) || getValue( eDlcWrongMotor_35 ))
        {
            putValue( eDlcOnceMotor_35, 0 );
            _mMotor_35.DLC = getValue( eDlcMotor_35 );
        }
        else
        {
            _mMotor_35.DLC = 8;
        }
    }
    else
    {
        _mMotor_35.DLC = 8;
    }

    output( _mMotor_35 );
    cancelTimer( _tMotor_35 );
    if( getValue( eTMotor_35 ) > 0)  setTimer( _tMotor_35, getValue( eTMotor_35 ) );  else  setTimer( _tMotor_35, 1 );
    _bsaiMotor_35 = 0;
    _bsiMotor_35 = 1;
    cancelTimer( _tinhMotor_35 );  setTimer( _tinhMotor_35, 100 );
}

Motor_35Changed()
{
}

on envVar KCAN_MO_EBoost_verf_praed
{
    _mMotor_35.MO_EBoost_verf_praed.phys = getValue( this );
    Motor_35Changed();
}

on envVar KCAN_MO_eLaunch_verf
{
    _mMotor_35.MO_eLaunch_verf.phys = getValue( this );
    Motor_35Changed();
}

on envVar KCAN_MO_Fahrbereitschaft
{
    _mMotor_35.MO_Fahrbereitschaft.phys = getValue( this );
    Motor_35Changed();
}

on envVar KCAN_MO_Freilauf_Info
{
    _mMotor_35.MO_Freilauf_Info.phys = getValue( this );
    Motor_35Changed();
}

on envVar KCAN_MO_Freilauf_Status
{
    _mMotor_35.MO_Freilauf_Status.phys = getValue( this );
    Motor_35Changed();
}

on envVar KCAN_MO_Freilauf_Typ
{
    _mMotor_35.MO_Freilauf_Typ.phys = getValue( this );
    Motor_35Changed();
}

on envVar KCAN_MO_Heckspoiler_Anf
{
    _mMotor_35.MO_Heckspoiler_Anf.phys = getValue( this );
    Motor_35Changed();
}

on envVar KCAN_MO_Krit_Heckobjekt
{
    _mMotor_35.MO_Krit_Heckobjekt.phys = getValue( this );
    Motor_35Changed();
}

on envVar KCAN_MO_NGS_Gangpos
{
    _mMotor_35.MO_NGS_Gangpos.phys = getValue( this );
    Motor_35Changed();
}

on envVar KCAN_MO_Positionierung_aktiv
{
    _mMotor_35.MO_Positionierung_aktiv.phys = getValue( this );
    Motor_35Changed();
}

on envVar KCAN_MO_Startwunsch
{
    _mMotor_35.MO_Startwunsch.phys = getValue( this );
    Motor_35Changed();
}

on Timer _tMotor_36
{
    if( getValue( eTMotor_36 ) <= 0)  putValue( eSendMotor_36, 0 );
    if( ( getValue( eSendEnabled ) && getValue( eSendMotor_36 )) || getValue( eDlcOnceMotor_36 ))  sendMotor_36();
}

on envVar eSendMotor_36
{
    if( getValue( eSendEnabled ) && getValue( eSendMotor_36 ))  sendMotor_36();
}

on envVar eTimeoutMotor_36
{
    cancelTimer( _tMotor_36 );
    cancelTimer( _totMotor_36 );
    if( getValue( this ))
        setTimer( _totMotor_36, ( getValue( eSendEnabled ) && getValue( eSendMotor_36 ) && ( getValue( eTOTMotor_36 ) > 0)) ? getValue( eTOTMotor_36 ) : 1 );
    else
        if( getValue( eSendEnabled ) && getValue( eSendMotor_36 ))  sendMotor_36();
}

on Timer _totMotor_36
{
    putValue( eTimeoutMotor_36, 0 );
}

on envVar eDlcOnceMotor_36
{
    if( getValue( eDlcOnceMotor_36 ) && !( getValue( eSendEnabled ) && getValue( eSendMotor_36 )))  setTimer( _tMotor_36, 1 );
}

void sendMotor_36()
{
    if( getValue( eChangeMotor_36 ))
    {
        if( getValue( eDlcOnceMotor_36 ) || getValue( eDlcWrongMotor_36 ))
        {
            putValue( eDlcOnceMotor_36, 0 );
            _mMotor_36.DLC = getValue( eDlcMotor_36 );
        }
        else
        {
            _mMotor_36.DLC = 8;
        }
    }
    else
    {
        _mMotor_36.DLC = 8;
    }

    output( _mMotor_36 );
    cancelTimer( _tMotor_36 );
    if( getValue( eTMotor_36 ) > 0)  setTimer( _tMotor_36, getValue( eTMotor_36 ) );  else  setTimer( _tMotor_36, 1 );
}

Motor_36Changed()
{
}

on envVar eSCR_EinheitS
{
    putValue( KCAN_SCR_Einheit, getValue( this ) );
}

on envVar KCAN_SCR_Einheit
{
    _mMotor_36.SCR_Einheit.phys = getValue( this );
    Motor_36Changed();
}

on envVar eSCR_FuellstandS
{
    putValue( KCAN_SCR_Fuellstand, getValue( this ) );
}

on envVar KCAN_SCR_Fuellstand
{
    _mMotor_36.SCR_Fuellstand.phys = getValue( this );
    Motor_36Changed();
}

on envVar eSCR_Nachfuellmenge_EinheitS
{
    putValue( KCAN_SCR_Nachfuellmenge_Einheit, getValue( this ) );
}

on envVar KCAN_SCR_Nachfuellmenge_Einheit
{
    _mMotor_36.SCR_Nachfuellmenge_Einheit.phys = getValue( this );
    Motor_36Changed();
}

on envVar eSCR_Nachfuellmenge_maxS
{
    putValue( KCAN_SCR_Nachfuellmenge_max, getValue( this ) );
}

on envVar KCAN_SCR_Nachfuellmenge_max
{
    _mMotor_36.SCR_Nachfuellmenge_max.phys = getValue( this );
    Motor_36Changed();
}

on envVar eSCR_Nachfuellmenge_minS
{
    putValue( KCAN_SCR_Nachfuellmenge_min, getValue( this ) );
}

on envVar KCAN_SCR_Nachfuellmenge_min
{
    _mMotor_36.SCR_Nachfuellmenge_min.phys = getValue( this );
    Motor_36Changed();
}

on envVar eSCR_RestreichweiteS
{
    putValue( KCAN_SCR_Restreichweite, getValue( this ) );
}

on envVar KCAN_SCR_Restreichweite
{
    _mMotor_36.SCR_Restreichweite.phys = getValue( this );
    Motor_36Changed();
}

on envVar eSCR_RetriggersignalS
{
    putValue( KCAN_SCR_Retriggersignal, getValue( this ) );
}

on envVar KCAN_SCR_Retriggersignal
{
    _mMotor_36.SCR_Retriggersignal.phys = getValue( this );
    Motor_36Changed();
}

on envVar eSCR_TankvolumenS
{
    putValue( KCAN_SCR_Tankvolumen, getValue( this ) );
}

on envVar KCAN_SCR_Tankvolumen
{
    _mMotor_36.SCR_Tankvolumen.phys = getValue( this );
    Motor_36Changed();
}

on envVar eSCR_ZustandS
{
    putValue( KCAN_SCR_Zustand, getValue( this ) );
}

on envVar KCAN_SCR_Zustand
{
    _mMotor_36.SCR_Zustand.phys = getValue( this );
    Motor_36Changed();
}

on Timer _tMotor_41
{
    if( getValue( eTMotor_41 ) <= 0)  putValue( eSendMotor_41, 0 );
    if( ( getValue( eSendEnabled ) && getValue( eSendMotor_41 )) || getValue( eDlcOnceMotor_41 ))  sendMotor_41();
}

on envVar eSendMotor_41
{
    if( getValue( eSendEnabled ) && getValue( eSendMotor_41 ))  sendMotor_41();
}

on envVar eTimeoutMotor_41
{
    cancelTimer( _tMotor_41 );
    cancelTimer( _totMotor_41 );
    if( getValue( this ))
        setTimer( _totMotor_41, ( getValue( eSendEnabled ) && getValue( eSendMotor_41 ) && ( getValue( eTOTMotor_41 ) > 0)) ? getValue( eTOTMotor_41 ) : 1 );
    else
        if( getValue( eSendEnabled ) && getValue( eSendMotor_41 ))  sendMotor_41();
}

on Timer _totMotor_41
{
    putValue( eTimeoutMotor_41, 0 );
}

on envVar eDlcOnceMotor_41
{
    if( getValue( eDlcOnceMotor_41 ) && !( getValue( eSendEnabled ) && getValue( eSendMotor_41 )))  setTimer( _tMotor_41, 1 );
}

void sendMotor_41()
{
    if( getValue( eChangeMotor_41))
    {
        if( getValue( eDlcOnceMotor_41 ) || getValue( eDlcWrongMotor_41 ))
        {
            putValue( eDlcOnceMotor_41, 0 );
            _mMotor_41.DLC = getValue( eDlcMotor_41 );
        }
        else
        {
            _mMotor_41.DLC = 8;
        }
    }
    else
    {
        _mMotor_41.DLC = 8;
    }

    output( _mMotor_41 );
    cancelTimer( _tMotor_41 );
    if( getValue( eTMotor_41 ) > 0)  setTimer( _tMotor_41, getValue( eTMotor_41 ) );  else  setTimer( _tMotor_41, 1 );
}

Motor_41Changed()
{
}

on envVar KCAN_MO_ADR_Status
{
    _mMotor_41.MO_ADR_Status.phys = getValue( this );
    Motor_41Changed();
}

on envVar eMO_AGA_Sound_TexteS
{
    putValue( KCAN_MO_AGA_Sound_Texte, getValue( this ) );
}

on envVar KCAN_MO_AGA_Sound_Texte
{
    _mMotor_41.MO_AGA_Sound_Texte.phys = getValue( this );
    Motor_41Changed();
}

on envVar KCAN_MO_Anz_Kuehlerluefter
{
    _mMotor_41.MO_Anz_Kuehlerluefter.phys = getValue( this );
    Motor_41Changed();
}

on envVar eMO_Anzeige_FMAus_TextS
{
    putValue( KCAN_MO_Anzeige_FMAus_Text, getValue( this ) );
}

on envVar KCAN_MO_Anzeige_FMAus_Text
{
    _mMotor_41.MO_Anzeige_FMAus_Text.phys = getValue( this );
    Motor_41Changed();
}

on envVar eMO_Anzeige_StSt_SymbolS
{
    putValue( KCAN_MO_Anzeige_StSt_Symbol, getValue( this ) );
}

on envVar KCAN_MO_Anzeige_StSt_Symbol
{
    _mMotor_41.MO_Anzeige_StSt_Symbol.phys = getValue( this );
    Motor_41Changed();
}

on envVar KCAN_MO_Anzeige_StSt_Text
{
    _mMotor_41.MO_Anzeige_StSt_Text.phys = getValue( this );
    Motor_41Changed();
}

on envVar KCAN_MO_Rekuperationsstufe
{
    _mMotor_41.MO_Rekuperationsstufe.phys = getValue( this );
    Motor_41Changed();
}

on envVar KCAN_MO_SREG_Beladung
{
    _mMotor_41.MO_SREG_Beladung.phys = getValue( this );
    Motor_41Changed();
}

on envVar KCAN_MO_SREG_Status
{
    _mMotor_41.MO_SREG_Status.phys = getValue( this );
    Motor_41Changed();
}

on envVar KCAN_MO_VREG_Status
{
    _mMotor_41.MO_VREG_Status.phys = getValue( this );
    Motor_41Changed();
}

on envVar KCAN_PEA_Texte
{
    _mMotor_41.PEA_Texte.phys = getValue( this );
    Motor_41Changed();
}

on envVar eTSK_Einheit_vMax_FahrerInfoS
{
    putValue( KCAN_TSK_Einheit_vMax_FahrerInfo, getValue( this ) );
}

on envVar KCAN_TSK_Einheit_vMax_FahrerInfo
{
    _mMotor_41.TSK_Einheit_vMax_FahrerInfo.phys = getValue( this );
    Motor_41Changed();
}

on envVar eTSK_Status_vMax_FahrerInfoS
{
    putValue( KCAN_TSK_Status_vMax_FahrerInfo, getValue( this ) );
}

on envVar KCAN_TSK_Status_vMax_FahrerInfo
{
    _mMotor_41.TSK_Status_vMax_FahrerInfo.phys = getValue( this );
    Motor_41Changed();
}

on envVar KCAN_TSK_Ueberstimmt_vMax_FahrerInfo
{
    _mMotor_41.TSK_Ueberstimmt_vMax_FahrerInfo.phys = getValue( this );
    Motor_41Changed();
}

on envVar eTSK_vMax_FahrerInfoS
{
    putValue( KCAN_TSK_vMax_FahrerInfo, getValue( this ) );
}

on envVar KCAN_TSK_vMax_FahrerInfo
{
    _mMotor_41.TSK_vMax_FahrerInfo.phys = getValue( this );
    Motor_41Changed();
}

on Timer _tMotor_Code_01
{
    if( getValue( eTMotor_Code_01 ) <= 0)  putValue( eSendMotor_Code_01, 0 );
    if( ( getValue( eSendEnabled ) && getValue( eSendMotor_Code_01 )) || getValue( eDlcOnceMotor_Code_01 ))  sendMotor_Code_01();
}

on envVar eSendMotor_Code_01
{
    if( getValue( eSendEnabled ) && getValue( eSendMotor_Code_01 ))  sendMotor_Code_01();
}

on envVar eTimeoutMotor_Code_01
{
    cancelTimer( _tMotor_Code_01 );
    cancelTimer( _totMotor_Code_01 );
    if( getValue( this ))
        setTimer( _totMotor_Code_01, ( getValue( eSendEnabled ) && getValue( eSendMotor_Code_01 ) && ( getValue( eTOTMotor_Code_01 ) > 0)) ? getValue( eTOTMotor_Code_01 ) : 1 );
    else
        if( getValue( eSendEnabled ) && getValue( eSendMotor_Code_01 ))  sendMotor_Code_01();
}

on Timer _totMotor_Code_01
{
    putValue( eTimeoutMotor_Code_01, 0 );
}

on envVar eDlcOnceMotor_Code_01
{
    if( getValue( eDlcOnceMotor_Code_01 ) && !( getValue( eSendEnabled ) && getValue( eSendMotor_Code_01 )))  setTimer( _tMotor_Code_01, 1 );
}

void sendMotor_Code_01()
{
    byte crc;
    dword bz;

    if( getValue( eChangeMotor_Code_01 ))
    {
        if( getValue( eDlcOnceMotor_Code_01 ) || getValue( eDlcWrongMotor_Code_01 ))
        {
            putValue( eDlcOnceMotor_Code_01, 0 );
            _mMotor_Code_01.DLC = getValue( eDlcMotor_Code_01 );
        }
        else
        {
            _mMotor_Code_01.DLC = 8;
        }

        crc = getCRC8( _mMotor_Code_01, _s_pdu_codeMotor_Code_01 );
        _mMotor_Code_01.Motor_Code_01_CRC = crc ^ (1 - getValue( eCrcMotor_Code_01 ));

        if( getValue( eBZMotor_Code_01 ))
        {
            bz = getValue( eMotor_Code_01_BZS );
            bz = bz + getValue( eBZStepMotor_Code_01 );
            putValue( eMotor_Code_01_BZS, bz % 16 );
        }
    }
    else
    {
        _mMotor_Code_01.DLC = 8;

        crc = getCRC8( _mMotor_Code_01, _s_pdu_codeMotor_Code_01 );
        _mMotor_Code_01.Motor_Code_01_CRC = crc ^ (1 - getValue( eCrcMotor_Code_01 ));

        bz = getValue( eMotor_Code_01_BZS ) + 1;
        putValue( eMotor_Code_01_BZS, bz % 16 );
    }

    output( _mMotor_Code_01 );

    cancelTimer( _tMotor_Code_01 );
    if( getValue( eTMotor_Code_01 ) > 0)  setTimer( _tMotor_Code_01, getValue( eTMotor_Code_01 ) );  else  setTimer( _tMotor_Code_01, 1 );
}

Motor_Code_01Changed()
{
}

on envVar eMotor_Code_01_BZS
{
    putValue( KCAN_Motor_Code_01_BZ, getValue( this ) );
}

on envVar KCAN_Motor_Code_01_BZ
{
    _mMotor_Code_01.Motor_Code_01_BZ.phys = getValue( this );
}

on envVar eMO_AnsaugsystemS
{
    putValue( KCAN_MO_Ansaugsystem, getValue( this ) );
}

on envVar KCAN_MO_Ansaugsystem
{
    _mMotor_Code_01.MO_Ansaugsystem.phys = getValue( this );
    Motor_Code_01Changed();
}

on envVar eMO_Anzahl_ZylS
{
    putValue( KCAN_MO_Anzahl_Zyl, getValue( this ) );
}

on envVar KCAN_MO_Anzahl_Zyl
{
    _mMotor_Code_01.MO_Anzahl_Zyl.phys = getValue( this );
    Motor_Code_01Changed();
}

on envVar eMO_Anzeige_StSt_gueltigS
{
    putValue( KCAN_MO_Anzeige_StSt_gueltig, getValue( this ) );
}

on envVar KCAN_MO_Anzeige_StSt_gueltig
{
    _mMotor_Code_01.MO_Anzeige_StSt_gueltig.phys = getValue( this );
    Motor_Code_01Changed();
}

on envVar eMO_CodeS
{
    putValue( KCAN_MO_Code, getValue( this ) );
}

on envVar KCAN_MO_Code
{
    _mMotor_Code_01.MO_Code.phys = getValue( this );
    Motor_Code_01Changed();
}

on envVar eMO_DPF_verbautS
{
    putValue( KCAN_MO_DPF_verbaut, getValue( this ) );
}

on envVar KCAN_MO_DPF_verbaut
{
    _mMotor_Code_01.MO_DPF_verbaut.phys = getValue( this );
    Motor_Code_01Changed();
}

on envVar eMO_Faktor_Momente_02S
{
    putValue( KCAN_MO_Faktor_Momente_02, getValue( this ) );
}

on envVar KCAN_MO_Faktor_Momente_02
{
    _mMotor_Code_01.MO_Faktor_Momente_02.phys = getValue( this );
    Motor_Code_01Changed();
}

on envVar eMO_Getriebe_CodeS
{
    putValue( KCAN_MO_Getriebe_Code, getValue( this ) );
}

on envVar KCAN_MO_Getriebe_Code
{
    _mMotor_Code_01.MO_Getriebe_Code.phys = getValue( this );
    Motor_Code_01Changed();
}

on envVar eMO_HubraumS
{
    putValue( KCAN_MO_Hubraum, getValue( this ) );
}

on envVar KCAN_MO_Hubraum
{
    _mMotor_Code_01.MO_Hubraum.phys = getValue( this );
    Motor_Code_01Changed();
}

on envVar eMO_HybridfahrzeugS
{
    putValue( KCAN_MO_Hybridfahrzeug, getValue( this ) );
}

on envVar KCAN_MO_Hybridfahrzeug
{
    _mMotor_Code_01.MO_Hybridfahrzeug.phys = getValue( this );
    Motor_Code_01Changed();
}

on envVar eMO_KraftstoffartS
{
    putValue( KCAN_MO_Kraftstoffart, getValue( this ) );
}

on envVar KCAN_MO_Kraftstoffart
{
    _mMotor_Code_01.MO_Kraftstoffart.phys = getValue( this );
    Motor_Code_01Changed();
}

on envVar eMO_LeistungS
{
    putValue( KCAN_MO_Leistung, getValue( this ) );
}

on envVar KCAN_MO_Leistung
{
    _mMotor_Code_01.MO_Leistung.phys = getValue( this );
    Motor_Code_01Changed();
}

on envVar KCAN_MO_OBD_Typ
{
    _mMotor_Code_01.MO_OBD_Typ.phys = getValue( this );
    Motor_Code_01Changed();
}

on envVar eMO_StartStopp_CodiertS
{
    putValue( KCAN_MO_StartStopp_Codiert, getValue( this ) );
}

on envVar KCAN_MO_StartStopp_Codiert
{
    _mMotor_Code_01.MO_StartStopp_Codiert.phys = getValue( this );
    Motor_Code_01Changed();
}

on envVar KCAN_MO_TSK_MFL_G3_Unterstuetzung
{
    _mMotor_Code_01.MO_TSK_MFL_G3_Unterstuetzung.phys = getValue( this );
    Motor_Code_01Changed();
}

on envVar eTSK_CodierungS
{
    putValue( KCAN_TSK_Codierung, getValue( this ) );
}

on envVar KCAN_TSK_Codierung
{
    _mMotor_Code_01.TSK_Codierung.phys = getValue( this );
    Motor_Code_01Changed();
}

on Timer _tMotor_EV_01
{
    if( getValue( eTMotor_EV_01 ) <= 0)  putValue( eSendMotor_EV_01, 0 );
    if( ( getValue( eSendEnabled ) && getValue( eSendMotor_EV_01 )) || getValue( eDlcOnceMotor_EV_01 ))  sendMotor_EV_01();
}

on envVar eSendMotor_EV_01
{
    if( getValue( eSendEnabled ) && getValue( eSendMotor_EV_01 ))  sendMotor_EV_01();
}

on envVar eTimeoutMotor_EV_01
{
    cancelTimer( _tMotor_EV_01 );
    cancelTimer( _totMotor_EV_01 );
    if( getValue( this ))
        setTimer( _totMotor_EV_01, ( getValue( eSendEnabled ) && getValue( eSendMotor_EV_01 ) && ( getValue( eTOTMotor_EV_01 ) > 0)) ? getValue( eTOTMotor_EV_01 ) : 1 );
    else
        if( getValue( eSendEnabled ) && getValue( eSendMotor_EV_01 ))  sendMotor_EV_01();
}

on Timer _totMotor_EV_01
{
    putValue( eTimeoutMotor_EV_01, 0 );
}

on envVar eDlcOnceMotor_EV_01
{
    if( getValue( eDlcOnceMotor_EV_01 ) && !( getValue( eSendEnabled ) && getValue( eSendMotor_EV_01 )))  setTimer( _tMotor_EV_01, 1 );
}

void sendMotor_EV_01()
{
    if( getValue( eChangeMotor_EV_01 ))
    {
        if( getValue( eDlcOnceMotor_EV_01 ) || getValue( eDlcWrongMotor_EV_01 ))
        {
            putValue( eDlcOnceMotor_EV_01, 0 );
            _mMotor_EV_01.DLC = getValue( eDlcMotor_EV_01 );
        }
        else
        {
                    _mMotor_EV_01.DLC = 8;
        }
    }
    else
    {
        _mMotor_EV_01.DLC = 8;
    }
    {
        output( _mMotor_EV_01 );
    }

    cancelTimer( _tMotor_EV_01 );
    if( getValue( eTMotor_EV_01 ) > 0)  setTimer( _tMotor_EV_01, getValue( eTMotor_EV_01 ) );  else  setTimer( _tMotor_EV_01, 1 );
}

Motor_EV_01Changed()
{
}

on envVar KCAN_EV_Rekuperationsstufe
{
    _mMotor_EV_01.EV_Rekuperationsstufe.phys = getValue( this );
    Motor_EV_01Changed();
}

on envVar KCAN_HV_Bordnetz_aktiv
{
    _mMotor_EV_01.HV_Bordnetz_aktiv.phys = getValue( this );
    Motor_EV_01Changed();
}

on envVar KCAN_HV_Bordnetz_Fehler
{
    _mMotor_EV_01.HV_Bordnetz_Fehler.phys = getValue( this );
    Motor_EV_01Changed();
}

on envVar KCAN_MO_Drehzahl_VM
{
    _mMotor_EV_01.MO_Drehzahl_VM.phys = getValue( this );
    Motor_EV_01Changed();
}

on envVar KCAN_MO_Fehler_Notabschaltung_Klima
{
    _mMotor_EV_01.MO_Fehler_Notabschaltung_Klima.phys = getValue( this );
    Motor_EV_01Changed();
}

on envVar KCAN_MO_Fehler_NTKreis
{
    _mMotor_EV_01.MO_Fehler_NTKreis.phys = getValue( this );
    Motor_EV_01Changed();
}

on envVar KCAN_MO_HVEM_Eskalation_Motor_EV_01
{
    _mMotor_EV_01.MO_HVEM_Eskalation.phys = getValue( this );
    Motor_EV_01Changed();
}

on envVar KCAN_MO_HVEM_MaxLeistung_Motor_EV_01
{
    _mMotor_EV_01.MO_HVEM_MaxLeistung.phys = getValue( this );
    Motor_EV_01Changed();
}

on envVar KCAN_MO_KLE_FStatus
{
    _mMotor_EV_01.MO_KLE_FStatus.phys = getValue( this );
    Motor_EV_01Changed();
}

on envVar eMO_Tankbereitschaft_StatusS
{
    putValue( KCAN_MO_Tankbereitschaft_Status, getValue( this ) );
}

on envVar KCAN_MO_Tankbereitschaft_Status
{
    _mMotor_EV_01.MO_Tankbereitschaft_Status.phys = getValue( this );
    Motor_EV_01Changed();
}

on envVar KCAN_MO_Tankklappensteuerung
{
    _mMotor_EV_01.MO_Tankklappensteuerung.phys = getValue( this );
    Motor_EV_01Changed();
}

on envVar eMO_WaehlposS
{
    putValue( KCAN_MO_Waehlpos, getValue( this ) );
}

on envVar KCAN_MO_Waehlpos
{
    _mMotor_EV_01.MO_Waehlpos.phys = getValue( this );
    Motor_EV_01Changed();
}

on envVar eMO_WH_TexteS
{
    putValue( KCAN_MO_WH_Texte, getValue( this ) );
}

on envVar KCAN_MO_WH_Texte
{
    _mMotor_EV_01.MO_WH_Texte.phys = getValue( this );
    Motor_EV_01Changed();
}

on Timer _tMotor_EV_03
{
    if( getValue( eTMotor_EV_03 ) <= 0)  putValue( eSendMotor_EV_03, 0 );
    if( ( getValue( eSendEnabled ) && getValue( eSendMotor_EV_03 )) || getValue( eDlcOnceMotor_EV_03 ))  sendMotor_EV_03();
}

on envVar eSendMotor_EV_03
{
    if( getValue( eSendEnabled ) && getValue( eSendMotor_EV_03 ))  sendMotor_EV_03();
}

on envVar eTimeoutMotor_EV_03
{
    cancelTimer( _tMotor_EV_03 );
    cancelTimer( _totMotor_EV_03 );
    if( getValue( this ))
        setTimer( _totMotor_EV_03, ( getValue( eSendEnabled ) && getValue( eSendMotor_EV_03 ) && ( getValue( eTOTMotor_EV_03 ) > 0)) ? getValue( eTOTMotor_EV_03 ) : 1 );
    else
        if( getValue( eSendEnabled ) && getValue( eSendMotor_EV_03 ))  sendMotor_EV_03();
}

on Timer _totMotor_EV_03
{
    putValue( eTimeoutMotor_EV_03, 0 );
}

on envVar eDlcOnceMotor_EV_03
{
    if( getValue( eDlcOnceMotor_EV_03 ) && !( getValue( eSendEnabled ) && getValue( eSendMotor_EV_03 )))  setTimer( _tMotor_EV_03, 1 );
}

void sendMotor_EV_03()
{
    if( getValue( eMO_Ges_calcConsumption_button)==0x01) //IssueList #124
        calculateConsumption_EM();

    if( getValue( eMO_Recu_calcConsumption_button)==0x01)  //IssueList #124
        calculateConsumption_EM_Recuperation();

    if( getValue( eChangeMotor_EV_03 ))
    {
        if( getValue( eDlcOnceMotor_EV_03 ) || getValue( eDlcWrongMotor_EV_03 ))
        {
            putValue( eDlcOnceMotor_EV_03, 0 );
            _mMotor_EV_03.DLC = getValue( eDlcMotor_EV_03 );
        }
        else
        {
            _mMotor_EV_03.DLC = 8;
        }
    }
    else
    {
        _mMotor_EV_03.DLC = 8;
    }

    output( _mMotor_EV_03 );
    cancelTimer( _tMotor_EV_03 );
    if( getValue( eTMotor_EV_03 ) > 0)  setTimer( _tMotor_EV_03, getValue( eTMotor_EV_03 ) );  else  setTimer( _tMotor_EV_03, 1 );
}

Motor_EV_03Changed()
{
}

on envVar eMO_Rekuperation_EM_Ges_UeberlaufS
{
    putValue( KCAN_MO_Rekuperation_EM_Ges_Ueberlauf, getValue( this ) );
}

on envVar KCAN_MO_Rekuperation_EM_Ges_Ueberlauf
{
    _mMotor_EV_03.MO_Rekuperation_EM_Ges_Ueberlauf.phys = getValue( this );
    Motor_EV_03Changed();
}

on envVar eMO_Rekuperation_Ges_EMS
{
    putValue( KCAN_MO_Rekuperation_Ges_EM, getValue( this ) );
}

on envVar KCAN_MO_Rekuperation_Ges_EM
{
    _mMotor_EV_03.MO_Rekuperation_Ges_EM.phys = getValue( this );
    Motor_EV_03Changed();
}

on envVar eMO_Verbrauch_EM_GesS
{
    putValue( KCAN_MO_Verbrauch_EM_Ges, getValue( this ) );
}

on envVar KCAN_MO_Verbrauch_EM_Ges
{
    _mMotor_EV_03.MO_Verbrauch_EM_Ges.phys = getValue( this );
    Motor_EV_03Changed();
}

on envVar eMO_Verbrauch_EM_Ges_UeberlaufS
{
    putValue( KCAN_MO_Verbrauch_EM_Ges_Ueberlauf, getValue( this ) );
}

on envVar KCAN_MO_Verbrauch_EM_Ges_Ueberlauf
{
    _mMotor_EV_03.MO_Verbrauch_EM_Ges_Ueberlauf.phys = getValue( this );
    Motor_EV_03Changed();
}

on Timer _tMotor_Gas_01
{
    _mMotor_Gas_01.MO_akt_Betrieb = getValue (eMO_akt_Betrieb);
    if( getValue( eTMotor_Gas_01 ) <= 0)  putValue( eSendMotor_Gas_01, 0 );
    if( ( getValue( eSendEnabled ) && getValue( eSendMotor_Gas_01 )) || getValue( eDlcOnceMotor_Gas_01 ))  sendMotor_Gas_01();
}

on envVar eSendMotor_Gas_01
{
    if( getValue( eSendEnabled ) && getValue( eSendMotor_Gas_01 ))  sendMotor_Gas_01();
}

on envVar eTimeoutMotor_Gas_01
{
    cancelTimer( _tMotor_Gas_01 );
    cancelTimer( _totMotor_Gas_01 );
    if( getValue( this ))
        setTimer( _totMotor_Gas_01, ( getValue( eSendEnabled ) && getValue( eSendMotor_Gas_01 ) && ( getValue( eTOTMotor_Gas_01 ) > 0)) ? getValue( eTOTMotor_Gas_01 ) : 1 );
    else
        if( getValue( eSendEnabled ) && getValue( eSendMotor_Gas_01 ))  sendMotor_Gas_01();
}

on Timer _totMotor_Gas_01
{
    putValue( eTimeoutMotor_Gas_01, 0 );
}

on envVar eDlcOnceMotor_Gas_01
{
    if( getValue( eDlcOnceMotor_Gas_01 ) && !( getValue( eSendEnabled ) && getValue( eSendMotor_Gas_01 )))  setTimer( _tMotor_Gas_01, 1 );
}

void sendMotor_Gas_01()
{
    calculateMotorGasConsumption();

    if( getValue( eChangeMotor_Gas_01 ))
    {
        if( getValue( eDlcOnceMotor_Gas_01 ) || getValue( eDlcWrongMotor_Gas_01 ))
        {
            putValue( eDlcOnceMotor_Gas_01, 0 );
            _mMotor_Gas_01.DLC = getValue( eDlcMotor_Gas_01 );
        }
        else
        {
            _mMotor_Gas_01.DLC = 8;
        }
    }
    else
    {
        _mMotor_Gas_01.DLC = 8;
    }

    output( _mMotor_Gas_01 );
    cancelTimer( _tMotor_Gas_01 );
    if( getValue( eTMotor_Gas_01 ) > 0)  setTimer( _tMotor_Gas_01, getValue( eTMotor_Gas_01 ) );  else  setTimer( _tMotor_Gas_01, 1 );
}

void calculateMotorGasConsumption()
{
    dword consumption;
    dword oldAccu;
    dword newAccu;

    //IssueList #137 - Changes from Valentin Daicu 09.11.2012
    if((getvalue(env_GasConsumption_Correlation)==1) && (( getValue( eMO_KraftstoffartS) == 2 ) || ( getValue( eMO_KraftstoffartS) == 3 )))
    {
        if( getvalue(eMO_akt_Betrieb)==1)  // is 1
            consumption = (dword)( getValue( eGasConsumption ) / 3.6 /*µl/ms*/ * getValue( eTMotor_Gas_01 ) + 0.5);
        else
            consumption = 0;
    }
    else
        consumption = (dword)( getValue( eGasConsumption ) / 3.6 /*µl/ms*/ * getValue( eTMotor_Gas_01 ) + 0.5);

    if( getValue( eMO_CNG_LPG))
    {
        oldAccu = getValue( eMO_Verbrauch_LPG );
    }
    else
    {
        oldAccu = getValue( eMO_Verbrauch_CNG );
    }
    newAccu = (oldAccu + consumption) & 0x7FFF;

    if( getValue( eMO_CNG_LPG))
    {
        putValue( eMO_Verbrauch_LPG, newAccu );
    }
    else
    {
        putValue( eMO_Verbrauch_CNG, newAccu );
    }
}

Motor_Gas_01Changed()
{
}

on envVar eMO_akt_Betrieb
{
    putValue( KCAN_MO_akt_Betrieb, getValue( this ) );
}

on envVar KCAN_MO_akt_Betrieb
{
    _mMotor_Gas_01.MO_akt_Betrieb.phys = getValue( this );
    Motor_Gas_01Changed();
}

on envVar eMO_AnzeigeGasbetrieb
{
    putValue( KCAN_MO_AnzeigeGasbetrieb, getValue( this ) );
}

on envVar KCAN_MO_AnzeigeGasbetrieb
{
    _mMotor_Gas_01.MO_AnzeigeGasbetrieb.phys = getValue( this );
    Motor_Gas_01Changed();
}

on envVar eMO_CNG_LPG
{
    putValue( KCAN_MO_CNG_LPG, getValue( this ) );
}

on envVar KCAN_MO_CNG_LPG
{
    _mMotor_Gas_01.MO_CNG_LPG.phys = getValue( this );

    if( getValue(this)==1)
    {
    enableControl("Motor_Gas_01","Fuellstand_LPG_m1",1);
    enableControl("Motor_Gas_01","Fuellungsgrad_LPG_m1",1);
    enableControl("Motor_Gas_01", "Tankvolumen_LPG",1);
    enableControl("Motor_Gas_01","LPG_Ueberlauf_m1",1);
    enableControl("Motor_Gas_01","EnvVar:eMO_LPG_Tankstopp",1);

    putValue( eMO_CNG_Ueberlauf_m0,0);
    putValue( eMO_Tankmasse_CNG,0);
    putValue( eMO_Fuellungsgrad_CNG,0);
    putValue( eMO_CNG_Tankstopp_m0,0);
    enableControl("Motor_Gas_01","CNG_Ueberlauf_m0",0);
    enableControl("Motor_Gas_01","Tankmasse_CNG",0);
    enableControl("Motor_Gas_01","Fuellungsgrad_CNG",0);
    enableControl("Motor_Gas_01","EnvVar:eMO_CNG_Tankstopp",0);


    }
    else
    {
    putValue(eMO_Fuellstand_LPG_m1,0);
    putValue(eMO_Fuellungsgrad_LPG_m1,0);
    putValue(eMO_Tankvolumen_LPG,0);
    putValue(eMO_LPG_Ueberlauf_m1,0);
    putValue(eMO_LPG_Tankstopp,0);

    enableControl("Motor_Gas_01","Fuellstand_LPG_m1",0);
    enableControl("Motor_Gas_01","Fuellungsgrad_LPG_m1",0);
    enableControl("Motor_Gas_01", "Tankvolumen_LPG",0);
    enableControl("Motor_Gas_01","LPG_Ueberlauf_m1",0);
    enableControl("Motor_Gas_01","EnvVar:eMO_LPG_Tankstopp",0);


    enableControl("Motor_Gas_01","CNG_Ueberlauf_m0",1);
    enableControl("Motor_Gas_01","Tankmasse_CNG",1);
    enableControl("Motor_Gas_01","Fuellungsgrad_CNG",1);
    enableControl("Motor_Gas_01","EnvVar:eMO_CNG_Tankstopp",1);

    }
    Motor_Gas_01Changed();
}

on envVar eMO_CNG_Tankstopp_m0
{
    putValue( KCAN_MO_CNG_Tankstopp, getValue( this ) );
}

on envVar KCAN_MO_CNG_Tankstopp
{
    _mMotor_Gas_01.MO_CNG_Tankstopp.phys = getValue( this );
    Motor_Gas_01Changed();
}

on envVar eMO_CNG_Ueberlauf_m0
{
    putValue( KCAN_MO_CNG_Ueberlauf, getValue( this ) );
}

on envVar KCAN_MO_CNG_Ueberlauf
{
    _mMotor_Gas_01.MO_CNG_Ueberlauf.phys = getValue( this );
    Motor_Gas_01Changed();
}

on envVar eMO_Erdgasqualitaet
{
    putValue( KCAN_MO_Erdgasqualitaet, getValue( this ) );
}

on envVar KCAN_MO_Erdgasqualitaet
{
    _mMotor_Gas_01.MO_Erdgasqualitaet.phys = getValue( this );
    Motor_Gas_01Changed();
}

on EnvVar eMO_Fuellstand_LPG_m1
{
  _mMotor_Gas_01.MO_Fuellstand_LPG.phys= getValue(this);
}

on envVar eMO_Fuellungsgrad_CNG
{
    putValue( KCAN_MO_Fuellungsgrad_CNG, getValue( this ) );
}

on envVar KCAN_MO_Fuellungsgrad_CNG
{
    _mMotor_Gas_01.MO_Fuellungsgrad_CNG.phys = getValue( this );
    Motor_Gas_01Changed();
}

on EnvVar eMO_Fuellungsgrad_LPG_m1
{
  _mMotor_Gas_01.MO_Fuellungsgrad_LPG.phys= getValue(this);
}

on EnvVar eMO_LPG_Ueberlauf_m1
{
  _mMotor_Gas_01.MO_LPG_Ueberlauf.phys= getValue(this);
}

on envVar eMO_LPG_Tankstopp
{
    _mMotor_Gas_01.MO_LPG_Tankstopp = getValue (this);
}

on envVar eMO_Tankmasse_CNG
{
    putValue( KCAN_MO_Tankmasse_CNG, getValue( this ) );
}

on envVar KCAN_MO_Tankmasse_CNG
{
    _mMotor_Gas_01.MO_Tankmasse_CNG.phys = getValue( this );
    Motor_Gas_01Changed();
}

on EnvVar eMO_Tankvolumen_LPG
{
  _mMotor_Gas_01.MO_Tankvolumen_LPG.phys= getValue(this);
}

on envVar eMO_Verbrauch_CNG
{
    putValue( KCAN_MO_Verbrauch_CNG, getValue( this ) );
}

on envVar KCAN_MO_Verbrauch_CNG
{
    _mMotor_Gas_01.MO_Verbrauch_CNG.phys = getValue( this );
    Motor_Gas_01Changed();
}

on envVar eMO_Verbrauch_LPG
{
    _mMotor_Gas_01.MO_Verbrauch_LPG = getValue (this);
}

on envVar eMO_Verbrauchsaequivalent
{
    putValue( KCAN_MO_Verbrauchsaequivalent, getValue( this ) );
}

on envVar KCAN_MO_Verbrauchsaequivalent
{
    _mMotor_Gas_01.MO_Verbrauchsaequivalent.phys = getValue( this );
    Motor_Gas_01Changed();
}

on Timer _tMotor_Hybrid_03
{
    if( getValue( eTMotor_Hybrid_03 ) <= 0)  putValue( eSendMotor_Hybrid_03, 0 );
    if( ( getValue( eSendEnabled ) && getValue( eSendMotor_Hybrid_03 )) || getValue( eDlcOnceMotor_Hybrid_03 ))  sendMotor_Hybrid_03();
}

on envVar eSendMotor_Hybrid_03
{
    if( getValue( eSendEnabled ) && getValue( eSendMotor_Hybrid_03 ))  sendMotor_Hybrid_03();
}

on envVar eTimeoutMotor_Hybrid_03
{
    cancelTimer( _tMotor_Hybrid_03 );
    cancelTimer( _totMotor_Hybrid_03 );
    if( getValue( this ))
        setTimer( _totMotor_Hybrid_03, ( getValue( eSendEnabled ) && getValue( eSendMotor_Hybrid_03 ) && ( getValue( eTOTMotor_Hybrid_03 ) > 0)) ? getValue( eTOTMotor_Hybrid_03 ) : 1 );
    else
        if( getValue( eSendEnabled ) && getValue( eSendMotor_Hybrid_03 ))  sendMotor_Hybrid_03();
}

on Timer _totMotor_Hybrid_03
{
    putValue( eTimeoutMotor_Hybrid_03, 0 );
}

on envVar eDlcOnceMotor_Hybrid_03
{
    if( getValue( eDlcOnceMotor_Hybrid_03 ) && !( getValue( eSendEnabled ) && getValue( eSendMotor_Hybrid_03 )))  setTimer( _tMotor_Hybrid_03, 1 );
}

void sendMotor_Hybrid_03()
{
    if( getValue( eChangeMotor_Hybrid_03 ))
    {
        if( getValue( eDlcOnceMotor_Hybrid_03 ) || getValue( eDlcWrongMotor_Hybrid_03 ))
        {
            putValue( eDlcOnceMotor_Hybrid_03, 0 );
            _mMotor_Hybrid_03.DLC = getValue( eDlcMotor_Hybrid_03 );
        }
        else
        {
            _mMotor_Hybrid_03.DLC = 8;
        }
    }
    else
    {
        _mMotor_Hybrid_03.DLC = 8;
    }

    output( _mMotor_Hybrid_03 );
    cancelTimer( _tMotor_Hybrid_03 );
    if( getValue( eTMotor_Hybrid_03 ) > 0)  setTimer( _tMotor_Hybrid_03, getValue( eTMotor_Hybrid_03 ) );  else  setTimer( _tMotor_Hybrid_03, 1 );
}

Motor_Hybrid_03Changed()
{
}

on envVar eLadezustand_02S
{
    putValue( KCAN_Ladezustand_02, getValue( this ) );
}

on envVar KCAN_Ladezustand_02
{
    _mMotor_Hybrid_03.Ladezustand_02.phys = getValue( this );
    Motor_Hybrid_03Changed();
}

on envVar eMO_ePerformanceS
{
    putValue( KCAN_MO_ePerformance, getValue( this ) );
}

on envVar KCAN_MO_ePerformance
{
    _mMotor_Hybrid_03.MO_ePerformance.phys = getValue( this );
    Motor_Hybrid_03Changed();
}

on envVar eMO_ePowermeterS
{
    putValue( KCAN_MO_ePowermeter, getValue( this ) );
}

on envVar KCAN_MO_ePowermeter
{
    _mMotor_Hybrid_03.MO_ePowermeter.phys = getValue( this );
    Motor_Hybrid_03Changed();
}

on envVar eMO_PowermeterS
{
    putValue( KCAN_MO_Powermeter, getValue( this ) );
}

on envVar KCAN_MO_Powermeter
{
    _mMotor_Hybrid_03.MO_Powermeter.phys = getValue( this );
    Motor_Hybrid_03Changed();
}

on envVar eMO_Powermeter_Elm_02S
{
    putValue( KCAN_MO_Powermeter_Elm_02, getValue( this ) );
}

on envVar KCAN_MO_Powermeter_Elm_02
{
    _mMotor_Hybrid_03.MO_Powermeter_Elm_02.phys = getValue( this );
    Motor_Hybrid_03Changed();
}

on envVar eMO_Zust_AntriebS
{
    putValue( KCAN_MO_Zust_Antrieb, getValue( this ) );
}

on envVar KCAN_MO_Zust_Antrieb
{
    _mMotor_Hybrid_03.MO_Zust_Antrieb.phys = getValue( this );
    Motor_Hybrid_03Changed();
}

on envVar eMO_Zust_BetriebsstrategieS
{
    putValue( KCAN_MO_Zust_Betriebsstrategie, getValue( this ) );
}

on envVar KCAN_MO_Zust_Betriebsstrategie
{
    _mMotor_Hybrid_03.MO_Zust_Betriebsstrategie.phys = getValue( this );
    Motor_Hybrid_03Changed();
}

on Timer _tMotor_Hybrid_06
{
    if( getValue( eTMotor_Hybrid_06 ) <= 0)  putValue( eSendMotor_Hybrid_06, 0 );
    if( ( getValue( eSendEnabled ) && getValue( eSendMotor_Hybrid_06 )) || getValue( eDlcOnceMotor_Hybrid_06 ))  sendMotor_Hybrid_06();
}

on envVar eSendMotor_Hybrid_06
{
    if( getValue( eSendEnabled ) && getValue( eSendMotor_Hybrid_06 ))  sendMotor_Hybrid_06();
}

on envVar eTimeoutMotor_Hybrid_06
{
    cancelTimer( _tMotor_Hybrid_06 );
    cancelTimer( _totMotor_Hybrid_06 );
    if( getValue( this ))
        setTimer( _totMotor_Hybrid_06, ( getValue( eSendEnabled ) && getValue( eSendMotor_Hybrid_06 ) && ( getValue( eTOTMotor_Hybrid_06 ) > 0)) ? getValue( eTOTMotor_Hybrid_06 ) : 1 );
    else
        if( getValue( eSendEnabled ) && getValue( eSendMotor_Hybrid_06 ))  sendMotor_Hybrid_06();
}

on Timer _totMotor_Hybrid_06
{
    putValue( eTimeoutMotor_Hybrid_06, 0 );
}

on envVar eDlcOnceMotor_Hybrid_06
{
    if( getValue( eDlcOnceMotor_Hybrid_06 ) && !( getValue( eSendEnabled ) && getValue( eSendMotor_Hybrid_06 )))  setTimer( _tMotor_Hybrid_06, 1 );
}

void sendMotor_Hybrid_06()
{
    if( getValue( eChangeMotor_Hybrid_06))
    {
        if( getValue( eDlcOnceMotor_Hybrid_06 ) || getValue( eDlcWrongMotor_Hybrid_06 ))
        {
            putValue( eDlcOnceMotor_Hybrid_06, 0 );
            _mMotor_Hybrid_06.DLC = getValue( eDlcMotor_Hybrid_06 );
        }
        else
        {
            _mMotor_Hybrid_06.DLC = 8;
        }
    }
    else
    {
        _mMotor_Hybrid_06.DLC = 8;
    }

    output( _mMotor_Hybrid_06 );
    cancelTimer( _tMotor_Hybrid_06 );
    if( getValue( eTMotor_Hybrid_06 ) > 0)  setTimer( _tMotor_Hybrid_06, getValue( eTMotor_Hybrid_06 ) );  else  setTimer( _tMotor_Hybrid_06, 1 );
}

Motor_Hybrid_06Changed()
{
}

on envVar eMO_Powermeter_Charge_GrenzeS
{
    putValue( KCAN_MO_Powermeter_Charge_Grenze, getValue( this ) );
}

on envVar KCAN_MO_Powermeter_Charge_Grenze
{
    _mMotor_Hybrid_06.MO_Powermeter_Charge_Grenze.phys = getValue( this );
    Motor_Hybrid_06Changed();
}

on envVar eMo_Powermeter_GrenzeS
{
    putValue( KCAN_Mo_Powermeter_Grenze, getValue( this ) );
}

on envVar KCAN_Mo_Powermeter_Grenze
{
    _mMotor_Hybrid_06.Mo_Powermeter_Grenze.phys = getValue( this );
    Motor_Hybrid_06Changed();
}

on envVar eMO_Powermeter_Grenze_strategischS
{
    putValue( KCAN_MO_Powermeter_Grenze_strategisch, getValue( this ) );
}

on envVar KCAN_MO_Powermeter_Grenze_strategisch
{
    _mMotor_Hybrid_06.MO_Powermeter_Grenze_strategisch.phys = getValue( this );
    Motor_Hybrid_06Changed();
}

on envVar KCAN_MO_Powermeter_Inszenierung_aktiv
{
    _mMotor_Hybrid_06.MO_Powermeter_Inszenierung_aktiv.phys = getValue( this );
    Motor_Hybrid_06Changed();
}

on envVar eMO_Powermeter_obere_E_GrenzeS
{
    putValue( KCAN_MO_Powermeter_obere_E_Grenze, getValue( this ) );
}

on envVar KCAN_MO_Powermeter_obere_E_Grenze
{
    _mMotor_Hybrid_06.MO_Powermeter_obere_E_Grenze.phys = getValue( this );
    Motor_Hybrid_06Changed();
}

on envVar eMO_Powermeter_untere_E_GrenzeS
{
    putValue( KCAN_MO_Powermeter_untere_E_Grenze, getValue( this ) );
}

on envVar KCAN_MO_Powermeter_untere_E_Grenze
{
    _mMotor_Hybrid_06.MO_Powermeter_untere_E_Grenze.phys = getValue( this );
    Motor_Hybrid_06Changed();
}

on envVar KCAN_MO_Text_Aktivierung_Antrieb
{
    _mMotor_Hybrid_06.MO_Text_Aktivierung_Antrieb.phys = getValue( this );
    Motor_Hybrid_06Changed();
}

on Timer _tMSG_HYB_30
{
    if( getValue( eTMSG_HYB_30 ) <= 0)  putValue( eSendMSG_HYB_30, 0 );
    if( ( getValue( eSendEnabled ) && getValue( eSendMSG_HYB_30 )) || getValue( eDlcOnceMSG_HYB_30 ))  sendMSG_HYB_30();
}

on envVar eSendMSG_HYB_30
{
    if( getValue( eSendEnabled ) && getValue( eSendMSG_HYB_30 ))  sendMSG_HYB_30();
}

on envVar eTimeoutMSG_HYB_30
{
    cancelTimer( _tMSG_HYB_30 );
    cancelTimer( _totMSG_HYB_30 );
    if( getValue( this ))
        setTimer( _totMSG_HYB_30, ( getValue( eSendEnabled ) && getValue( eSendMSG_HYB_30 ) && ( getValue( eTOTMSG_HYB_30 ) > 0)) ? getValue( eTOTMSG_HYB_30 ) : 1 );
    else
        if( getValue( eSendEnabled ) && getValue( eSendMSG_HYB_30 ))  sendMSG_HYB_30();
}

on Timer _totMSG_HYB_30
{
    putValue( eTimeoutMSG_HYB_30, 0 );
}

on envVar eDlcOnceMSG_HYB_30
{
    if( getValue( eDlcOnceMSG_HYB_30 ) && !( getValue( eSendEnabled ) && getValue( eSendMSG_HYB_30 )))  setTimer( _tMSG_HYB_30, 1 );
}

void sendMSG_HYB_30()
{
    byte crc;
    dword bz;
    int hw;
    byte dlc;

    if( getValue( eChangeMSG_HYB_30))
    {
        if( getValue( eDlcOnceMSG_HYB_30 ) || getValue( eDlcWrongMSG_HYB_30 ))
        {
            putValue( eDlcOnceMSG_HYB_30, 0 );
            _mMSG_HYB_30.DLC = getValue( eDlcMSG_HYB_30 );
        }
        else
        {
      /*      if( getValue( eMSG_HYB_30_ChngDLCEnabled ))
            {
                dlc = getValue( eMSG_HYB_30_ChngDLCData );
                if(dlc>0)
                {
                    dlc--;
                    putValue( eMSG_HYB_30_ChngDLCData, dlc );
                    _mMSG_HYB_30.DLC = getValue( eDlcMSG_HYB_30 );
                }
                else
                {
                    putValue( eMSG_HYB_30_ChngDLCData, 0 );
                    _mMSG_HYB_30.DLC = 8;
                }
            }
            else
            {*/
                _mMSG_HYB_30.DLC = 8;
       /*     }  	*/
        }
  /*  if( getValue( eMSG_HYB_30_BZS_SingleJumpEnabled ))
    {
        putValue( eMSG_HYB_30_BZS_SingleJumpEnabled,0 );
        _mMSG_HYB_30.MSG_HYB_30_BZ = (_mMSG_HYB_30.MSG_HYB_30_BZ + getValue( eMSG_HYB_30_BZS_SingleJumpData )) & 0xf;
    }*/
   /* if( getValue( eMSG_HYB_30_BZS_ResetJumpEnabled ))
    {
        if( getValue( eMSG_HYB_30_BZS_ResetJumpData ) == _mMSG_HYB_30.MSG_HYB_30_BZ)
        {
            putValue( eMSG_HYB_30_BZS_ResetJumpEnabled,0 );
            _mMSG_HYB_30.MSG_HYB_30_BZ = 0;
            putValue( eMSG_HYB_30_BZS, 15 );
        }
    }*/
    crc = getCRC8( _mMSG_HYB_30, _s_pdu_codeMSG_HYB_30 );
  /*  if( getValue( eMSG_HYB_30_CRC_FalseEnabled ))
    {

        crc = ~crc;
        hw = getValue( eMSG_HYB_30_CRC_FalseData );
        if( hw )
        {
            hw--;
            putValue( eMSG_HYB_30_CRC_FalseData,hw );
        }
        if( hw == 0 )
        {
            putValue( eMSG_HYB_30_CRC_FalseEnabled,0 );
        }

    }*/
 //   _mMSG_HYB_30.MSG_HYB_30_CRC = crc ^ (1 - getValue( eCrcMSG_HYB_30 ));

 /*   if( getValue( eBZMSG_HYB_30 ))
    {
        bz = getValue( eMSG_HYB_30_BZS );
        bz = bz + getValue( eBZStepMSG_HYB_30 );
        putValue( eMSG_HYB_30_BZS, bz % 16 );
    }*/
    }
    else
    {
        _mMSG_HYB_30.DLC = 8;

        crc = getCRC8( _mMSG_HYB_30, _s_pdu_codeMSG_HYB_30 );
  //      _mMSG_HYB_30.MSG_HYB_30_CRC = crc ^ (1 - getValue( eCrcMSG_HYB_30 ));

  //      bz = getValue( eMSG_HYB_30_BZS ) + 1;
  //      putValue( eMSG_HYB_30_BZS, bz % 16 );
    }

 /*   if( getValue( eMSG_HYB_30_NoMsgEnabled ))
    {
        hw = getValue( eMSG_HYB_30_NoMsgEnabledData );
        if( hw )
        {
            hw--;
            putValue( eMSG_HYB_30_NoMsgEnabledData,hw );
        }
        if( hw == 0 )
        {
            putValue( eMSG_HYB_30_NoMsgEnabled,0 );
        }
    }
    else*/
    {
        output( _mMSG_HYB_30 );
    }

    cancelTimer( _tMSG_HYB_30 );
    if( getValue( eTMSG_HYB_30 ) > 0)  setTimer( _tMSG_HYB_30, getValue( eTMSG_HYB_30 ) );  else  setTimer( _tMSG_HYB_30, 1 );
}

MSG_HYB_30Changed()
{
}

on envVar KCAN_MSG_HYB_30_BZ
{
    _mMSG_HYB_30.MSG_HYB_30_BZ = getValue( this );
}

on envVar KCAN_MSG_HYB_30_CRC
{
   // if( getValue( eMSG_HYB_30_CRC_ON) == 0x00 )
        _mMSG_HYB_30.MSG_HYB_30_CRC = getValue( this );
}

on envVar KCAN_MO_EMG_Sollmodus
{
    _mMSG_HYB_30.MO_EMG_Sollmodus.phys = getValue( this );
    MSG_HYB_30Changed();
}

on envVar KCAN_MO_ErwGrenzen_Anf
{
    _mMSG_HYB_30.MO_ErwGrenzen_Anf.phys = getValue( this );
    MSG_HYB_30Changed();
}

on envVar KCAN_MO_Fehler_Notentladung_Anf
{
    _mMSG_HYB_30.MO_Fehler_Notentladung_Anf.phys = getValue( this );
    MSG_HYB_30Changed();
}

on envVar KCAN_MO_HVEM_Eskalation
{
    _mMSG_HYB_30.MO_HVEM_Eskalation.phys = getValue( this );
    MSG_HYB_30Changed();
}

on envVar KCAN_MO_HVEM_MaxLeistung
{
    _mMSG_HYB_30.MO_HVEM_MaxLeistung.phys = getValue( this );
    MSG_HYB_30Changed();
}

on envVar KCAN_MO_HVK_AntriebFehlerstatus
{
    _mMSG_HYB_30.MO_HVK_AntriebFehlerstatus.phys = getValue( this );
    MSG_HYB_30Changed();
}

on envVar KCAN_MO_HVK_AntriebZustand
{
    _mMSG_HYB_30.MO_HVK_AntriebZustand.phys = getValue( this );
    MSG_HYB_30Changed();
}

on envVar KCAN_MO_HVK_EmFehlerstatus
{
    _mMSG_HYB_30.MO_HVK_EmFehlerstatus.phys = getValue( this );
    MSG_HYB_30Changed();
}

on envVar KCAN_MO_HVK_EmIstzustand
{
    _mMSG_HYB_30.MO_HVK_EmIstzustand.phys = getValue( this );
    MSG_HYB_30Changed();
}

on envVar KCAN_MO_MVK_AntriebFehlerstatus
{
    _mMSG_HYB_30.MO_MVK_AntriebFehlerstatus.phys = getValue( this );
    MSG_HYB_30Changed();
}

on envVar KCAN_MO_MVK_AntriebZustand
{
    _mMSG_HYB_30.MO_MVK_AntriebZustand.phys = getValue( this );
    MSG_HYB_30Changed();
}

on envVar KCAN_MO_MVK_Bordnetz_Anf
{
    _mMSG_HYB_30.MO_MVK_Bordnetz_Anf.phys = getValue( this );
    MSG_HYB_30Changed();
}

on envVar KCAN_MO_MVK_EmFehlerstatus
{
    _mMSG_HYB_30.MO_MVK_EmFehlerstatus.phys = getValue( this );
    MSG_HYB_30Changed();
}

on envVar KCAN_MO_MVK_EmIstzustand
{
    _mMSG_HYB_30.MO_MVK_EmIstzustand.phys = getValue( this );
    MSG_HYB_30Changed();
}

on Timer _tMVK_01
{
    if( getValue( eTMVK_01 ) <= 0)  putValue( eSendMVK_01, 0 );
    if( ( getValue( eSendEnabled ) && getValue( eSendMVK_01 )) || getValue( eDlcOnceMVK_01 ))  sendMVK_01();
}

on envVar eSendMVK_01
{
    if( getValue( eSendEnabled ) && getValue( eSendMVK_01 ))  sendMVK_01();
}

on envVar eTimeoutMVK_01
{
    cancelTimer( _tMVK_01 );
    cancelTimer( _totMVK_01 );
    if( getValue( this ))
        setTimer( _totMVK_01, ( getValue( eSendEnabled ) && getValue( eSendMVK_01 ) && ( getValue( eTOTMVK_01 ) > 0)) ? getValue( eTOTMVK_01 ) : 1 );
    else
        if( getValue( eSendEnabled ) && getValue( eSendMVK_01 ))  sendMVK_01();
}

on Timer _totMVK_01
{
    putValue( eTimeoutMVK_01, 0 );
}

on envVar eDlcOnceMVK_01
{
    if( getValue( eDlcOnceMVK_01 ) && !( getValue( eSendEnabled ) && getValue( eSendMVK_01 )))  setTimer( _tMVK_01, 1 );
}

void sendMVK_01()
{
    byte crc;
    dword bz;
    int hw;
    byte dlc;

    if( getValue( eChangeMVK_01 ))
    {
        if( getValue( eDlcOnceMVK_01 ) || getValue( eDlcWrongMVK_01 ))
        {
            putValue( eDlcOnceMVK_01, 0 );
            _mMVK_01.DLC = getValue( eDlcMVK_01 );
        }
        else
        {
            if( getValue( eMVK_01_ChngDLCEnabled ))
            {
                dlc = getValue( eMVK_01_ChngDLCData );
                if(dlc>0)
                {
                    dlc--;
                    putValue( eMVK_01_ChngDLCData, dlc );
                    _mMVK_01.DLC = getValue( eDlcMVK_01 );
                }
                else
                {
                    putValue( eMVK_01_ChngDLCData, 0 );
                    _mMVK_01.DLC = 8;
                }
            }
            else
            {
                _mMVK_01.DLC = 8;
            }
        }
        if( getValue( eMVK_01_BZS_SingleJumpEnabled ))
        {
            putValue( eMVK_01_BZS_SingleJumpEnabled, 0 );
            _mMVK_01.MVK_01_BZ=(_mMVK_01.MVK_01_BZ + getValue( eMVK_01_BZS_SingleJumpData))&0xf;
        }
        if( getValue( eMVK_01_BZS_ResetJumpEnabled ))
        {
            if( getValue( eMVK_01_BZS_ResetJumpData ) == _mMVK_01.MVK_01_BZ )
            {
                putValue( eMVK_01_BZS_ResetJumpEnabled, 0 );
                _mMVK_01.MVK_01_BZ=0;
                putValue( eMVK_01_BZS,15);
            }
        }
        crc = getCRC8( _mMVK_01, _s_pdu_codeMVK_01 );
        if( getValue( eMVK_01_CRC_FalseEnabled ))
        {
            crc=~crc;
            hw = getValue( eMVK_01_CRC_FalseData );
            if( hw )
            {
                hw--;
                putValue( eMVK_01_CRC_FalseData, hw );
            }
            if( hw == 0 )
            {
                putValue( eMVK_01_CRC_FalseEnabled, 0 );
            }
        }
        _mMVK_01.MVK_01_CRC = crc ^ (1 - getValue( eCrcMVK_01 ));

        if( getValue( eBZMVK_01 ))
        {
            bz = getValue( eMVK_01_BZS );
            bz = bz + getValue( eBZStepMVK_01 );
            putValue( eMVK_01_BZS, bz % 16 );
        }
    }
    else
    {
        _mMVK_01.DLC = 8;

         crc = getCRC8( _mMVK_01, _s_pdu_codeMVK_01 );
         _mMVK_01.MVK_01_CRC = crc ^ (1 - getValue( eCrcMVK_01 ));

         bz = getValue( eMVK_01_BZS ) + 1;
         putValue( eMVK_01_BZS, bz % 16 );
    }

    if( getValue( eMVK_01_NoMsgEnabled ))
    {
        hw = getValue( eMVK_01_NoMsgEnabledData );
        if( hw )
        {
            hw--;
            putValue( eMVK_01_NoMsgEnabledData, hw );
        }
        if( hw == 0 )
        {
            putValue( eMVK_01_NoMsgEnabled, 0 );
        }
    }
    else
    {
        output( _mMVK_01 );
    }

    cancelTimer( _tMVK_01 );
    if( getValue( eTMVK_01 ) > 0)  setTimer( _tMVK_01, getValue( eTMVK_01 ) );  else  setTimer( _tMVK_01, 1 );
}

MVK_01Changed()
{
}

on envVar eMVK_01_BZS
{
    putValue( KCAN_MVK_01_BZ, getValue( this ) );
}

on envVar KCAN_MVK_01_BZ
{
    _mMVK_01.MVK_01_BZ.phys = getValue( this );
    MVK_01Changed();
}

on envVar eMVK_01_CRCS
{
    putValue( KCAN_MVK_01_CRC, getValue( this ) );
}

on envVar KCAN_MVK_01_CRC
{
    if( getValue( eMVK_01_CRC_ON ) == 0x00 )
    {
        _mMVK_01.MVK_01_CRC.phys = getValue( this );
        MVK_01Changed();
    }
}

on envVar KCAN_MV_Bordnetz_aktiv
{
    _mMVK_01.MV_Bordnetz_aktiv.phys = getValue( this );
    MVK_01Changed();
}

on envVar KCAN_MV_Bordnetz_Fehler
{
    _mMVK_01.MV_Bordnetz_Fehler.phys = getValue( this );
    MVK_01Changed();
}

on envVar KCAN_MVK_BMS_Sollmodus
{
    _mMVK_01.MVK_BMS_Sollmodus.phys = getValue( this );
    MVK_01Changed();
}

on envVar KCAN_MVK_BOOST_Sollmodus
{
    _mMVK_01.MVK_BOOST_Sollmodus.phys = getValue( this );
    MVK_01Changed();
}

on envVar KCAN_MVK_DCDC_Sollmodus
{
    _mMVK_01.MVK_DCDC_Sollmodus.phys = getValue( this );
    MVK_01Changed();
}

on envVar KCAN_MVK_DCDC_Sollmodus_02
{
    _mMVK_01.MVK_DCDC_Sollmodus_02.phys = getValue( this );
    MVK_01Changed();
}

on envVar KCAN_MVK_eABC_Sollmodus
{
    _mMVK_01.MVK_eABC_Sollmodus.phys = getValue( this );
    MVK_01Changed();
}

on envVar KCAN_MVK_eAWS_Sollmodus
{
    _mMVK_01.MVK_eAWS_Sollmodus.phys = getValue( this );
    MVK_01Changed();
}

on envVar KCAN_MVK_Istmodus_Anf
{
    _mMVK_01.MVK_Istmodus_Anf.phys = getValue( this );
    MVK_01Changed();
}

on envVar KCAN_MVK_MO_EmSollzustand
{
    _mMVK_01.MVK_MO_EmSollzustand.phys = getValue( this );
    MVK_01Changed();
}

on envVar eMVK_MV_Netz_WarnungenS
{
    putValue( KCAN_MVK_MV_Netz_Warnungen, getValue( this ) );
}

on envVar KCAN_MVK_MV_Netz_Warnungen
{
    _mMVK_01.MVK_MV_Netz_Warnungen.phys = getValue( this );
    MVK_01Changed();
}

on envVar KCAN_MVK_MVPTC_Sollmodus
{
    _mMVK_01.MVK_MVPTC_Sollmodus.phys = getValue( this );
    MVK_01Changed();
}

on Timer _tNavData_01
{
    if( getValue( eTNavData_01 ) <= 0)  putValue( eSendNavData_01, 0 );
    if( ( getValue( eSendEnabled ) && getValue( eSendNavData_01 )) || getValue( eDlcOnceNavData_01 ))  sendNavData_01();
}

on envVar eSendNavData_01
{
    if( getValue( eSendEnabled ) && getValue( eSendNavData_01 ))  sendNavData_01();
}

on envVar eTimeoutNavData_01
{
    cancelTimer( _tNavData_01 );
    cancelTimer( _totNavData_01 );
    if( getValue( this ))
        setTimer( _totNavData_01, ( getValue( eSendEnabled ) && getValue( eSendNavData_01 ) && ( getValue( eTOTNavData_01 ) > 0)) ? getValue( eTOTNavData_01 ) : 1 );
    else
        if( getValue( eSendEnabled ) && getValue( eSendNavData_01 ))  sendNavData_01();
}

on Timer _totNavData_01
{
    putValue( eTimeoutNavData_01, 0 );
}

on envVar eDlcOnceNavData_01
{
    if( getValue( eDlcOnceNavData_01 ) && !( getValue( eSendEnabled ) && getValue( eSendNavData_01 )))  setTimer( _tNavData_01, 1 );
}

void sendNavData_01()
{
    if( getValue( eChangeNavData_01 ))
    {
        if( getValue( eDlcOnceNavData_01 ) || getValue( eDlcWrongNavData_01 ))
        {
            putValue( eDlcOnceNavData_01, 0 );
            _mNavData_01.DLC = getValue( eDlcNavData_01 );
        }
        else
        {
            _mNavData_01.DLC = 8;
        }
    }
    else
    {
        _mNavData_01.DLC = 8;
    }

    output( _mNavData_01 );
    cancelTimer( _tNavData_01 );
    if( getValue( eTNavData_01 ) > 0)  setTimer( _tNavData_01, getValue( eTNavData_01 ) );  else  setTimer( _tNavData_01, 1 );
}

NavData_01Changed()
{
}

on envVar KCAN_ND_GDOP
{
    _mNavData_01.ND_GDOP.phys = getValue( this );
    NavData_01Changed();
}

on envVar KCAN_ND_HDOP
{
    _mNavData_01.ND_HDOP.phys = getValue( this );
    NavData_01Changed();
}

on envVar KCAN_ND_Heading
{
    _mNavData_01.ND_Heading.phys = getValue( this );
    NavData_01Changed();
}

on envVar KCAN_ND_Init
{
    _mNavData_01.ND_Init.phys = getValue( this );
    NavData_01Changed();
}

on envVar KCAN_ND_PDOP
{
    _mNavData_01.ND_PDOP.phys = getValue( this );
    NavData_01Changed();
}

on envVar KCAN_ND_TDOP
{
    _mNavData_01.ND_TDOP.phys = getValue( this );
    NavData_01Changed();
}

on envVar KCAN_ND_VDOP
{
    _mNavData_01.ND_VDOP.phys = getValue( this );
    NavData_01Changed();
}

on Timer _tNavData_02
{
    if( getValue( eTNavData_02 ) <= 0)  putValue( eSendNavData_02, 0 );
    if( ( getValue( eSendEnabled ) && getValue( eSendNavData_02 )) || getValue( eDlcOnceNavData_02 ))  sendNavData_02();
}

on envVar eSendNavData_02
{
    if( getValue( eSendEnabled ) && getValue( eSendNavData_02 ))  sendNavData_02();
}

on envVar eTimeoutNavData_02
{
    cancelTimer( _tNavData_02 );
    cancelTimer( _totNavData_02 );
    if( getValue( this ))
        setTimer( _totNavData_02, ( getValue( eSendEnabled ) && getValue( eSendNavData_02 ) && ( getValue( eTOTNavData_02 ) > 0)) ? getValue( eTOTNavData_02 ) : 1 );
    else
        if( getValue( eSendEnabled ) && getValue( eSendNavData_02 ))  sendNavData_02();
}

on Timer _totNavData_02
{
    putValue( eTimeoutNavData_02, 0 );
}

on envVar eDlcOnceNavData_02
{
    if( getValue( eDlcOnceNavData_02 ) && !( getValue( eSendEnabled ) && getValue( eSendNavData_02 )))  setTimer( _tNavData_02, 1 );
}

void sendNavData_02()
{
    if( getValue( eChangeNavData_02 ))
    {
        if( getValue( eDlcOnceNavData_02 ) || getValue( eDlcWrongNavData_02 ))
        {
            putValue( eDlcOnceNavData_02, 0 );
            _mNavData_02.DLC = getValue( eDlcNavData_02 );
        }
        else
        {
            _mNavData_02.DLC = 8;
        }
    }
    else
    {
        _mNavData_02.DLC = 8;
    }

    output( _mNavData_02 );
    cancelTimer( _tNavData_02 );
    if( getValue( eTNavData_02 ) > 0)  setTimer( _tNavData_02, getValue( eTNavData_02 ) );  else  setTimer( _tNavData_02, 1 );
}

NavData_02Changed()
{
}

on envVar KCAN_ND_SatInUse
{
    _mNavData_02.ND_SatInUse.phys = getValue( this );
    NavData_02Changed();
}

on envVar KCAN_ND_SatInView
{
    _mNavData_02.ND_SatInView.phys = getValue( this );
    NavData_02Changed();
}

on envVar KCAN_ND_UTC
{
    _mNavData_02.ND_UTC.phys = getValue( this );
    NavData_02Changed();
}

on envVar KCAN_NP_Altitude
{
    _mNavData_02.NP_Altitude.phys = getValue( this );
    NavData_02Changed();
}

on envVar KCAN_POS_Guete_horizontal
{
    _mNavData_02.POS_Guete_horizontal.phys = getValue( this );
    NavData_02Changed();
}

on envVar KCAN_POS_Guete_horizontal_verfuegbar
{
    _mNavData_02.POS_Guete_horizontal_verfuegbar.phys = getValue( this );
    NavData_02Changed();
}

on Timer _tNavPos_01
{
    if( getValue( eTNavPos_01 ) <= 0)  putValue( eSendNavPos_01, 0 );
    if( ( getValue( eSendEnabled ) && getValue( eSendNavPos_01 )) || getValue( eDlcOnceNavPos_01 ))  sendNavPos_01();
}

on envVar eSendNavPos_01
{
    if( getValue( eSendEnabled ) && getValue( eSendNavPos_01 ))  sendNavPos_01();
}

on envVar eTimeoutNavPos_01
{
    cancelTimer( _tNavPos_01 );
    cancelTimer( _totNavPos_01 );
    if( getValue( this ))
        setTimer( _totNavPos_01, ( getValue( eSendEnabled ) && getValue( eSendNavPos_01 ) && ( getValue( eTOTNavPos_01 ) > 0)) ? getValue( eTOTNavPos_01 ) : 1 );
    else
        if( getValue( eSendEnabled ) && getValue( eSendNavPos_01 ))  sendNavPos_01();
}

on Timer _totNavPos_01
{
    putValue( eTimeoutNavPos_01, 0 );
}

on envVar eDlcOnceNavPos_01
{
    if( getValue( eDlcOnceNavPos_01 ) && !( getValue( eSendEnabled ) && getValue( eSendNavPos_01 )))  setTimer( _tNavPos_01, 1 );
}

void sendNavPos_01()
{
    if( getValue( eChangeNavPos_01 ))
    {
        if( getValue( eDlcOnceNavPos_01 ) || getValue( eDlcWrongNavPos_01 ))
        {
            putValue( eDlcOnceNavPos_01, 0 );
            _mNavPos_01.DLC = getValue( eDlcNavPos_01 );
        }
        else
        {
            _mNavPos_01.DLC = 8;
        }
    }
    else
    {
        _mNavPos_01.DLC = 8;
    }

    output( _mNavPos_01 );
    cancelTimer( _tNavPos_01 );
    if( getValue( eTNavPos_01 ) > 0)  setTimer( _tNavPos_01, getValue( eTNavPos_01 ) );  else  setTimer( _tNavPos_01, 1 );
}

NavPos_01Changed()
{
}

on envVar eNP_FixS
{
    putValue( KCAN_NP_Fix, getValue( this ) );
}

on envVar KCAN_NP_Fix
{
    _mNavPos_01.NP_Fix.phys = getValue( this );
    NavPos_01Changed();
}

on envVar eNP_LatDegreeS
{
    putValue( KCAN_NP_LatDegree, getValue( this ) );
}

on envVar KCAN_NP_LatDegree
{
    _mNavPos_01.NP_LatDegree.phys = getValue( this );
    NavPos_01Changed();
}

on envVar eNP_LatDirectionS
{
    putValue( KCAN_NP_LatDirection, getValue( this ) );
}

on envVar KCAN_NP_LatDirection
{
    _mNavPos_01.NP_LatDirection.phys = getValue( this );
    NavPos_01Changed();
}

on envVar eNP_LongDegreeS
{
    putValue( KCAN_NP_LongDegree, getValue( this ) );
}

on envVar KCAN_NP_LongDegree
{
    _mNavPos_01.NP_LongDegree.phys = getValue( this );
    NavPos_01Changed();
}

on envVar eNP_LongDirectionS
{
    putValue( KCAN_NP_LongDirection, getValue( this ) );
}

on envVar KCAN_NP_LongDirection
{
    _mNavPos_01.NP_LongDirection.phys = getValue( this );
    NavPos_01Changed();
}

on envVar KCAN_NP_Sat
{
    _mNavPos_01.NP_Sat.phys = getValue( this );
    NavPos_01Changed();
}

on Timer _tParkhilfe_04
{
    if( getValue( eTParkhilfe_04 ) <= 0)  putValue( eSendParkhilfe_04, 0 );
    if( ( getValue( eSendEnabled ) && getValue( eSendParkhilfe_04 )) || getValue( eDlcOnceParkhilfe_04 ))  sendParkhilfe_04();
}

on envVar eSendParkhilfe_04
{
    if( getValue( eSendEnabled ) && getValue( eSendParkhilfe_04 ))  sendParkhilfe_04();
}

on envVar eTimeoutParkhilfe_04
{
    cancelTimer( _tParkhilfe_04 );
    cancelTimer( _totParkhilfe_04 );
    if( getValue( this ))
        setTimer( _totParkhilfe_04, ( getValue( eSendEnabled ) && getValue( eSendParkhilfe_04 ) && ( getValue( eTOTParkhilfe_04 ) > 0)) ? getValue( eTOTParkhilfe_04 ) : 1 );
    else
        if( getValue( eSendEnabled ) && getValue( eSendParkhilfe_04 ))  sendParkhilfe_04();
}

on Timer _totParkhilfe_04
{
    putValue( eTimeoutParkhilfe_04, 0 );
}

on envVar eDlcOnceParkhilfe_04
{
    if( getValue( eDlcOnceParkhilfe_04 ) && !( getValue( eSendEnabled ) && getValue( eSendParkhilfe_04 )))  setTimer( _tParkhilfe_04, 1 );
}

void sendParkhilfe_04()
{
    if( getValue( eChangeParkhilfe_04))
    {
        if( getValue( eDlcOnceParkhilfe_04 ) || getValue( eDlcWrongParkhilfe_04 ))
        {
            putValue( eDlcOnceParkhilfe_04, 0 );
            _mParkhilfe_04.DLC = getValue( eDlcParkhilfe_04 );
        }
        else
        {
            _mParkhilfe_04.DLC = 8;
        }
    }
    else
    {
        _mParkhilfe_04.DLC = 8;
    }

    output( _mParkhilfe_04 );
    cancelTimer( _tParkhilfe_04 );
    if( getValue( eTParkhilfe_04 ) > 0)  setTimer( _tParkhilfe_04, getValue( eTParkhilfe_04 ) );  else  setTimer( _tParkhilfe_04, 1 );
}

Parkhilfe_04Changed()
{
}

on envVar ePH_VerschmutzungsmeldungS
{
    _mParkhilfe_04.PH_Verschmutzungsmeldung.phys = getValue( this );
    Parkhilfe_04Changed();
}

on envVar ePH_WAH_MeldungS
{
    _mParkhilfe_04.PH_WAH_Meldung.phys = getValue( this );
    Parkhilfe_04Changed();
}

on Timer _tPLA_Status_02
{
    if( getValue( eTPLA_Status_02 ) <= 0)  putValue( eSendPLA_Status_02, 0 );
    if( ( getValue( eSendEnabled ) && getValue( eSendPLA_Status_02 )) || getValue( eDlcOncePLA_Status_02 ))  sendPLA_Status_02();
}

on envVar eSendPLA_Status_02
{
    if( getValue( eSendEnabled ) && getValue( eSendPLA_Status_02 ))  sendPLA_Status_02();
}

on envVar eTimeoutPLA_Status_02
{
    cancelTimer( _tPLA_Status_02 );
    cancelTimer( _totPLA_Status_02 );
    if( getValue( this ))
        setTimer( _totPLA_Status_02, ( getValue( eSendEnabled ) && getValue( eSendPLA_Status_02 ) && ( getValue( eTOTPLA_Status_02 ) > 0)) ? getValue( eTOTPLA_Status_02 ) : 1 );
    else
        if( getValue( eSendEnabled ) && getValue( eSendPLA_Status_02 ))  sendPLA_Status_02();
}

on Timer _totPLA_Status_02
{
    putValue( eTimeoutPLA_Status_02, 0 );
}

on envVar eDlcOncePLA_Status_02
{
    if( getValue( eDlcOncePLA_Status_02 ) && !( getValue( eSendEnabled ) && getValue( eSendPLA_Status_02 )))  setTimer( _tPLA_Status_02, 1 );
}

void sendPLA_Status_02()
{
    if( getValue( eChangePLA_Status_02 ))
    {
        if( getValue( eDlcOncePLA_Status_02 ) || getValue( eDlcWrongPLA_Status_02 ))
        {
            putValue( eDlcOncePLA_Status_02, 0 );
            _mPLA_Status_02.DLC = getValue( eDlcPLA_Status_02 );
        }
        else
        {
            _mPLA_Status_02.DLC = 8;
        }
    }
    else
    {
        _mPLA_Status_02.DLC = 8;
    }

    output( _mPLA_Status_02 );
    cancelTimer( _tPLA_Status_02 );
    if( getValue( eTPLA_Status_02 ) > 0)  setTimer( _tPLA_Status_02, getValue( eTPLA_Status_02 ) );  else  setTimer( _tPLA_Status_02, 1 );
}

PLA_Status_02Changed()
{
}

on envVar ePLA_Abstand_zur_ParklueckeS
{
    putValue( KCAN_PLA_Abstand_zur_Parkluecke, getValue( this ) );
}

on envVar KCAN_PLA_Abstand_zur_Parkluecke
{
    _mPLA_Status_02.PLA_Abstand_zur_Parkluecke.phys = getValue( this );
    PLA_Status_02Changed();
}

on envVar ePLA_Anf_Akustik
{
    putValue( KCAN_PLA_Anf_Akustik, getValue( this ) );
}

on envVar KCAN_PLA_Anf_Akustik
{
    _mPLA_Status_02.PLA_Anf_Akustik.phys = getValue( this );
    PLA_Status_02Changed();
}

on envVar ePLA_Anf_Anzeige_Bremsfuss
{
    putValue( KCAN_PLA_Anf_Anzeige_Bremsfuss, getValue( this ) );
}

on envVar KCAN_PLA_Anf_Anzeige_Bremsfuss
{
    _mPLA_Status_02.PLA_Anf_Anzeige_Bremsfuss.phys = getValue( this );
    PLA_Status_02Changed();
}

on envVar ePLA_Anf_Anzeige_MiniS
{
    putValue( KCAN_PLA_Anf_Anzeige_Mini, getValue( this ) );
}

on envVar KCAN_PLA_Anf_Anzeige_Mini
{
    _mPLA_Status_02.PLA_Anf_Anzeige_Mini.phys = getValue( this );
    PLA_Status_02Changed();
}

on envVar ePLA_Anf_Anzeige_Schwellpfeil
{
    putValue( KCAN_PLA_Anf_Anzeige_Schwellpfeil, getValue( this ) );
}

on envVar KCAN_PLA_Anf_Anzeige_Schwellpfeil
{
    _mPLA_Status_02.PLA_Anf_Anzeige_Schwellpfeil.phys = getValue( this );
    PLA_Status_02Changed();
}

on envVar ePLA_Anf_Anzeigemodus
{
    putValue( KCAN_PLA_Anf_Anzeigemodus, getValue( this ) );
}

on envVar KCAN_PLA_Anf_Anzeigemodus
{
    _mPLA_Status_02.PLA_Anf_Anzeigemodus.phys = getValue( this );
    PLA_Status_02Changed();
}

on envVar KCAN_PLA_Anf_Funktionsdisclaimer
{
    _mPLA_Status_02.PLA_Anf_Funktionsdisclaimer.phys = getValue( this );
    PLA_Status_02Changed();
}

on envVar ePLA_Anf_Meldungen
{
    putValue( KCAN_PLA_Anf_Meldungen, getValue( this ) );
}

on envVar KCAN_PLA_Anf_Meldungen
{
    _mPLA_Status_02.PLA_Anf_Meldungen.phys = getValue( this );
    PLA_Status_02Changed();
}

on envVar KCAN_PLA_Anforderung_HMS
{
    _mPLA_Status_02.PLA_Anforderung_HMS.phys = getValue( this );
    PLA_Status_02Changed();
}

on envVar ePLA_Anzahl_Segmente_SchwellpfeilS
{
    putValue( KCAN_PLA_Anzahl_Segmente_Schwellpfeil, getValue( this ) );
}

on envVar KCAN_PLA_Anzahl_Segmente_Schwellpfeil
{
    _mPLA_Status_02.PLA_Anzahl_Segmente_Schwellpfeil.phys = getValue( this );
    PLA_Status_02Changed();
}

on envVar ePLA_Fortschritt_bis_ZugendeS
{
    putValue( KCAN_PLA_Fortschritt_bis_Zugende, getValue( this ) );
}

on envVar KCAN_PLA_Fortschritt_bis_Zugende
{
    _mPLA_Status_02.PLA_Fortschritt_bis_Zugende.phys = getValue( this );
    PLA_Status_02Changed();
}

on envVar ePLA_Mini_ModusS
{
    putValue( KCAN_PLA_Mini_Modus, getValue( this ) );
}

on envVar KCAN_PLA_Mini_Modus
{
    _mPLA_Status_02.PLA_Mini_Modus.phys = getValue( this );
    PLA_Status_02Changed();
}

on envVar ePLA_Status_Aktive_SeiteS
{
    putValue( KCAN_PLA_Status_Aktive_Seite, getValue( this ) );
}

on envVar KCAN_PLA_Status_Aktive_Seite
{
    _mPLA_Status_02.PLA_Status_Aktive_Seite.phys = getValue( this );
    PLA_Status_02Changed();
}

on envVar ePLA_Status_beenden_Mini
{
    putValue( KCAN_PLA_Status_beenden_Mini, getValue( this ) );
}

on envVar KCAN_PLA_Status_beenden_Mini
{
    _mPLA_Status_02.PLA_Status_beenden_Mini.phys = getValue( this );
    PLA_Status_02Changed();
}

on envVar ePLA_Status_Funktion
{
    putValue( KCAN_PLA_Status_Funktion, getValue( this ) );
}

on envVar KCAN_PLA_Status_Funktion
{
    _mPLA_Status_02.PLA_Status_Funktion.phys = getValue( this );
    PLA_Status_02Changed();
}

on envVar KCAN_PLA_Status_Laengsparken_Mini
{
    _mPLA_Status_02.PLA_Status_Laengsparken_Mini.phys = getValue( this );
    PLA_Status_02Changed();
}

on envVar ePLA_Status_QP_Rueckw_Mini
{
    putValue( KCAN_PLA_Status_QP_Rueckw_Mini, getValue( this ) );
}

on envVar KCAN_PLA_Status_QP_Rueckw_Mini
{
    _mPLA_Status_02.PLA_Status_QP_Rueckw_Mini.phys = getValue( this );
    PLA_Status_02Changed();
}

on envVar ePLA_Status_QP_Vorw_Mini
{
    putValue( KCAN_PLA_Status_QP_Vorw_Mini, getValue( this ) );
}

on envVar KCAN_PLA_Status_QP_Vorw_Mini
{
    _mPLA_Status_02.PLA_Status_QP_Vorw_Mini.phys = getValue( this );
    PLA_Status_02Changed();
}

on Timer _tPreCrash_02
{
    if( getValue( eTPreCrash_02 ) <= 0)  putValue( eSendPreCrash_02, 0 );
    if( ( getValue( eSendEnabled ) && getValue( eSendPreCrash_02 )) || getValue( eDlcOncePreCrash_02 ))  sendPreCrash_02();
}

on envVar eSendPreCrash_02
{
    if( getValue( eSendEnabled ) && getValue( eSendPreCrash_02 ))  sendPreCrash_02();
}

on envVar eTimeoutPreCrash_02
{
    cancelTimer( _tPreCrash_02 );
    cancelTimer( _totPreCrash_02 );
    if( getValue( this ))
        setTimer( _totPreCrash_02, ( getValue( eSendEnabled ) && getValue( eSendPreCrash_02 ) && ( getValue( eTOTPreCrash_02 ) > 0)) ? getValue( eTOTPreCrash_02 ) : 1 );
    else
        if( getValue( eSendEnabled ) && getValue( eSendPreCrash_02 ))  sendPreCrash_02();
}

on Timer _totPreCrash_02
{
    putValue( eTimeoutPreCrash_02, 0 );
}

on envVar eDlcOncePreCrash_02
{
    if( getValue( eDlcOncePreCrash_02 ) && !( getValue( eSendEnabled ) && getValue( eSendPreCrash_02 )))  setTimer( _tPreCrash_02, 1 );
}

void sendPreCrash_02()
{
    if( getValue( eChangePreCrash_02))
    {
        if( getValue( eDlcOncePreCrash_02 ) || getValue( eDlcWrongPreCrash_02 ))
        {
            putValue( eDlcOncePreCrash_02, 0 );
            _mPreCrash_02.DLC = getValue( eDlcPreCrash_02 );
        }
        else
        {
            _mPreCrash_02.DLC = 8;
        }
    }
    else
    {
        _mPreCrash_02.DLC = 8;
    }

    output( _mPreCrash_02 );
    cancelTimer( _tPreCrash_02 );
    if( getValue( eTPreCrash_02 ) > 0)  setTimer( _tPreCrash_02, getValue( eTPreCrash_02 ) );  else  setTimer( _tPreCrash_02, 1 );
}

PreCrash_02Changed()
{
}

on envVar KCAN_PreCrash_Anforderung_AFR
{
    _mPreCrash_02.PreCrash_Anforderung_AFR.phys = getValue( this );
    PreCrash_02Changed();
}

on envVar KCAN_PreCrash_BFS_KSV_verfahren
{
    _mPreCrash_02.PreCrash_BFS_KSV_verfahren.phys = getValue( this );
    PreCrash_02Changed();
}

on envVar KCAN_PreCrash_BFS_Laengsverstellung
{
    _mPreCrash_02.PreCrash_BFS_Laengsverstellung.phys = getValue( this );
    PreCrash_02Changed();
}

on envVar KCAN_PreCrash_BFS_Pneumatik_ansteuern
{
    _mPreCrash_02.PreCrash_BFS_Pneumatik_ansteuern.phys = getValue( this );
    PreCrash_02Changed();
}

on envVar KCAN_PreCrash_BFS_Sitzlehne_verfahren
{
    _mPreCrash_02.PreCrash_BFS_Sitzlehne_verfahren.phys = getValue( this );
    PreCrash_02Changed();
}

on envVar KCAN_PreCrash_Blinken
{
    _mPreCrash_02.PreCrash_Blinken.phys = getValue( this );
    PreCrash_02Changed();
}

on envVar KCAN_PreCrash_Charisma_FahrPr
{
    _mPreCrash_02.PreCrash_Charisma_FahrPr.phys = getValue( this );
    PreCrash_02Changed();
}

on envVar KCAN_PreCrash_Charisma_Status
{
    _mPreCrash_02.PreCrash_Charisma_Status.phys = getValue( this );
    PreCrash_02Changed();
}

on envVar KCAN_PreCrash_Fenster_schliessen
{
    _mPreCrash_02.PreCrash_Fenster_schliessen.phys = getValue( this );
    PreCrash_02Changed();
}

on envVar KCAN_PreCrash_Fo_KSV_verfahren
{
    _mPreCrash_02.PreCrash_Fo_KSV_verfahren.phys = getValue( this );
    PreCrash_02Changed();
}

on envVar KCAN_PreCrash_Fo_Pneumatik_ansteuern
{
    _mPreCrash_02.PreCrash_Fo_Pneumatik_ansteuern.phys = getValue( this );
    PreCrash_02Changed();
}

on envVar KCAN_PreCrash_Fo_Sitzlehne_verfahren
{
    _mPreCrash_02.PreCrash_Fo_Sitzlehne_verfahren.phys = getValue( this );
    PreCrash_02Changed();
}

on envVar KCAN_PreCrash_FS_KSV_verfahren
{
    _mPreCrash_02.PreCrash_FS_KSV_verfahren.phys = getValue( this );
    PreCrash_02Changed();
}

on envVar KCAN_PreCrash_FS_Laengsverstellung
{
    _mPreCrash_02.PreCrash_FS_Laengsverstellung.phys = getValue( this );
    PreCrash_02Changed();
}

on envVar KCAN_PreCrash_FS_Pneumatik_ansteuern
{
    _mPreCrash_02.PreCrash_FS_Pneumatik_ansteuern.phys = getValue( this );
    PreCrash_02Changed();
}

on envVar KCAN_PreCrash_FS_Sitzlehne_verfahren
{
    _mPreCrash_02.PreCrash_FS_Sitzlehne_verfahren.phys = getValue( this );
    PreCrash_02Changed();
}

on envVar KCAN_PreCrash_Schiebedach_schliessen
{
    _mPreCrash_02.PreCrash_Schiebedach_schliessen.phys = getValue( this );
    PreCrash_02Changed();
}

on envVar KCAN_PreCrash_Tueren_Verriegeln
{
    _mPreCrash_02.PreCrash_Tueren_Verriegeln.phys = getValue( this );
    PreCrash_02Changed();
}

on envVar KCAN_SC_PreCrash_LED
{
    _mPreCrash_02.SC_PreCrash_LED.phys = getValue( this );
    PreCrash_02Changed();
}

on envVar eSC_PreCrash_TexteS
{
    putValue( KCAN_SC_PreCrash_Texte, getValue( this ) );
}

on envVar KCAN_SC_PreCrash_Texte
{
    _mPreCrash_02.SC_PreCrash_Texte.phys = getValue( this );
    PreCrash_02Changed();
}

on envVar eSC_PreCrash_WarnungS
{
    putValue( KCAN_SC_PreCrash_Warnung, getValue( this ) );
}

on envVar KCAN_SC_PreCrash_Warnung
{
    _mPreCrash_02.SC_PreCrash_Warnung.phys = getValue( this );
    PreCrash_02Changed();
}

on envVar KCAN_SC_PreSense_FCWP
{
    _mPreCrash_02.SC_PreSense_FCWP.phys = getValue( this );
    PreCrash_02Changed();
}

// PSD_06

on Timer _tReichweite_01
{
    if( getValue( eTReichweite_01 ) <= 0)  putValue( eSendReichweite_01, 0 );
    if( ( getValue( eSendEnabled ) && getValue( eSendReichweite_01 )) || getValue( eDlcOnceReichweite_01 ))  sendReichweite_01();
}

on envVar eSendReichweite_01
{
    if( getValue( eSendEnabled ) && getValue( eSendReichweite_01 ))  sendReichweite_01();
}

on envVar eTimeoutReichweite_01
{
    cancelTimer( _tReichweite_01 );
    cancelTimer( _totReichweite_01 );
    if( getValue( this ))
        setTimer( _totReichweite_01, ( getValue( eSendEnabled ) && getValue( eSendReichweite_01 ) && ( getValue( eTOTReichweite_01 ) > 0)) ? getValue( eTOTReichweite_01 ) : 1 );
    else
        if( getValue( eSendEnabled ) && getValue( eSendReichweite_01 ))  sendReichweite_01();
}

on Timer _totReichweite_01
{
    putValue( eTimeoutReichweite_01, 0 );
}

on envVar eDlcOnceReichweite_01
{
    if( getValue( eDlcOnceReichweite_01 ) && !( getValue( eSendEnabled ) && getValue( eSendReichweite_01 )))  setTimer( _tReichweite_01, 1 );
}

void sendReichweite_01()
{
    if( getValue( eChangeReichweite_01 ))
    {
        if( getValue( eDlcOnceReichweite_01 ) || getValue( eDlcWrongReichweite_01 ))
        {
            putValue( eDlcOnceReichweite_01, 0 );
            _mReichweite_01.DLC = getValue( eDlcReichweite_01 );
        }
        else
        {
            _mReichweite_01.DLC = 8;
        }
    }
    else
    {
        _mReichweite_01.DLC = 8;
    }

    output( _mReichweite_01 );
    cancelTimer( _tReichweite_01 );
    if( getValue( eTReichweite_01 ) > 0)  setTimer( _tReichweite_01, getValue( eTReichweite_01 ) );  else  setTimer( _tReichweite_01, 1 );
}

Reichweite_01Changed()
{
}

on envVar eRW_Gesamt_ReichweiteS
{
    putValue( KCAN_RW_Gesamt_Reichweite, getValue( this ) );
}

on envVar KCAN_RW_Gesamt_Reichweite
{
    _mReichweite_01.RW_Gesamt_Reichweite.phys = getValue( this );
    Reichweite_01Changed();
}

on envVar KCAN_RW_Gesamt_Reichweite_Max_Anzeige
{
    _mReichweite_01.RW_Gesamt_Reichweite_Max_Anzeige.phys = getValue( this );
    Reichweite_01Changed();
}

on envVar eRW_Prim_Reichweitenv_EinheitS
{
    putValue( KCAN_RW_Prim_Reichweitenv_Einheit, getValue( this ) );
}

on envVar KCAN_RW_Prim_Reichweitenv_Einheit
{
    _mReichweite_01.RW_Prim_Reichweitenv_Einheit.phys = getValue( this );
    Reichweite_01Changed();
}

on envVar eRW_Prim_ReichweitenverbrauchS
{
    putValue( KCAN_RW_Prim_Reichweitenverbrauch, getValue( this ) );
}

on envVar KCAN_RW_Prim_Reichweitenverbrauch
{
    _mReichweite_01.RW_Prim_Reichweitenverbrauch.phys = getValue( this );
    Reichweite_01Changed();
}

on envVar eRW_Primaer_ReichweiteS
{
    putValue( KCAN_RW_Primaer_Reichweite, getValue( this ) );
}

on envVar KCAN_RW_Primaer_Reichweite
{
    _mReichweite_01.RW_Primaer_Reichweite.phys = getValue( this );
    Reichweite_01Changed();
}

on envVar KCAN_RW_Reservewarnung_2_aktiv
{
    _mReichweite_01.RW_Reservewarnung_2_aktiv.phys = getValue( this );
    Reichweite_01Changed();
}

on envVar eRW_RWDS_LastprofilS
{
    putValue( KCAN_RW_RWDS_Lastprofil, getValue( this ) );
}

on envVar KCAN_RW_RWDS_Lastprofil
{
    _mReichweite_01.RW_RWDS_Lastprofil.phys = getValue( this );
    Reichweite_01Changed();
}

on Timer _tReichweite_02
{
    if( getValue( eTReichweite_02 ) <= 0)  putValue( eSendReichweite_02, 0 );
    if( ( getValue( eSendEnabled ) && getValue( eSendReichweite_02 )) || getValue( eDlcOnceReichweite_02 ))  sendReichweite_02();
}

on envVar eSendReichweite_02
{
    if( getValue( eSendEnabled ) && getValue( eSendReichweite_02 ))  sendReichweite_02();
}

on envVar eTimeoutReichweite_02
{
    cancelTimer( _tReichweite_02 );
    cancelTimer( _totReichweite_02 );
    if( getValue( this ))
        setTimer( _totReichweite_02, ( getValue( eSendEnabled ) && getValue( eSendReichweite_02 ) && ( getValue( eTOTReichweite_02 ) > 0)) ? getValue( eTOTReichweite_02 ) : 1 );
    else
        if( getValue( eSendEnabled ) && getValue( eSendReichweite_02 ))  sendReichweite_02();
}

on Timer _totReichweite_02
{
    putValue( eTimeoutReichweite_02, 0 );
}

on envVar eDlcOnceReichweite_02
{
    if( getValue( eDlcOnceReichweite_02 ) && !( getValue( eSendEnabled ) && getValue( eSendReichweite_02 )))  setTimer( _tReichweite_02, 1 );
}

void sendReichweite_02()
{
    if( getValue( eChangeReichweite_02))
    {
        if( getValue( eDlcOnceReichweite_02 ) || getValue( eDlcWrongReichweite_02 ))
        {
            putValue( eDlcOnceReichweite_02, 0 );
            _mReichweite_02.DLC = getValue( eDlcReichweite_02 );
        }
        else
        {
            _mReichweite_02.DLC = 8;
        }
    }
    else
    {
        _mReichweite_02.DLC = 8;
    }

    output( _mReichweite_02 );
    cancelTimer( _tReichweite_02 );
    if( getValue( eTReichweite_02 ) > 0)  setTimer( _tReichweite_02, getValue( eTReichweite_02 ) );  else  setTimer( _tReichweite_02, 1 );
}

Reichweite_02Changed()
{
}

on envVar eRW_Gesamt_Reichweite_Anzeige
{
    putValue( KCAN_RW_Gesamt_Reichweite_Anzeige, getValue( this ) );
}

on envVar KCAN_RW_Gesamt_Reichweite_Anzeige
{
    _mReichweite_02.RW_Gesamt_Reichweite_Anzeige.phys = getValue( this );
    Reichweite_02Changed();
}

on envVar eRW_Primaer_Reichweite_Anzeige
{
    putValue( KCAN_RW_Primaer_Reichweite_Anzeige, getValue( this ) );
}

on envVar KCAN_RW_Primaer_Reichweite_Anzeige
{
    _mReichweite_02.RW_Primaer_Reichweite_Anzeige.phys = getValue( this );
    Reichweite_02Changed();
}

on envVar eRW_Reichweite_Einheit_Anzeige
{
    putValue( KCAN_RW_Reichweite_Einheit_Anzeige, getValue( this ) );
}

on envVar KCAN_RW_Reichweite_Einheit_Anzeige
{
    _mReichweite_02.RW_Reichweite_Einheit_Anzeige.phys = getValue( this );
    Reichweite_02Changed();
}

on envVar eRW_Reservewarnung_aktivS
{
    putValue( KCAN_RW_Reservewarnung_aktiv, getValue( this ) );
}

on envVar KCAN_RW_Reservewarnung_aktiv
{
    _mReichweite_02.RW_Reservewarnung_aktiv.phys = getValue( this );
    Reichweite_02Changed();
}

on envVar eRW_Sek_Reichweitenv_EinheitS
{
    putValue( KCAN_RW_Sek_Reichweitenv_Einheit, getValue( this ) );
}

on envVar KCAN_RW_Sek_Reichweitenv_Einheit
{
    _mReichweite_02.RW_Sek_Reichweitenv_Einheit.phys = getValue( this );
    Reichweite_02Changed();
}

on envVar eRW_Sek_ReichweitenverbrauchS
{
    putValue( KCAN_RW_Sek_Reichweitenverbrauch, getValue( this ) );
}

on envVar KCAN_RW_Sek_Reichweitenverbrauch
{
    _mReichweite_02.RW_Sek_Reichweitenverbrauch.phys = getValue( this );
    Reichweite_02Changed();
}

on envVar eRW_Sekundaer_ReichweiteS
{
    putValue( KCAN_RW_Sekundaer_Reichweite, getValue( this ) );
}

on envVar KCAN_RW_Sekundaer_Reichweite
{
    _mReichweite_02.RW_Sekundaer_Reichweite.phys = getValue( this );
    Reichweite_02Changed();
}

on envVar eRW_Sekundaer_Reichweite_Anzeige
{
    putValue( KCAN_RW_Sekundaer_Reichweite_Anzeige, getValue( this ) );
}

on envVar KCAN_RW_Sekundaer_Reichweite_Anzeige
{
    _mReichweite_02.RW_Sekundaer_Reichweite_Anzeige.phys = getValue( this );
    Reichweite_02Changed();
}

on envVar KCAN_RW_Tendenz
{
    _mReichweite_02.RW_Tendenz.phys = getValue( this );
    Reichweite_02Changed();
}

on envVar eRW_TexteS
{
	switch (getValue( eRW_TexteS ))
    {
        case  0: putValue( eRW_TexteT, "kein_Text" ); break;
        case  1: putValue( eRW_TexteT, "Text_1" ); break;
        case  2: putValue( eRW_TexteT, "Text_2" ); break;
        case  3: putValue( eRW_TexteT, "Text_3" ); break;        
        default: putValue( eRW_TexteT, "!?!" );
    }
    putValue( KCAN_RW_Texte, getValue( this ) );
}

on envVar KCAN_RW_Texte
{
    _mReichweite_02.RW_Texte.phys = getValue( this );
    Reichweite_02Changed();
}

on Timer _tReichweite_03
{
    if( getValue( eTReichweite_03 ) <= 0)  putValue( eSendReichweite_03, 0 );
    if( ( getValue( eSendEnabled ) && getValue( eSendReichweite_03 )) || getValue( eDlcOnceReichweite_03 ))  sendReichweite_03();
}

on envVar eSendReichweite_03
{
    if( getValue( eSendEnabled ) && getValue( eSendReichweite_03 ))  sendReichweite_03();
}

on envVar eTimeoutReichweite_03
{
    cancelTimer( _tReichweite_03 );
    cancelTimer( _totReichweite_03 );
    if( getValue( this ))
        setTimer( _totReichweite_03, ( getValue( eSendEnabled ) && getValue( eSendReichweite_03 ) && ( getValue( eTOTReichweite_03 ) > 0)) ? getValue( eTOTReichweite_03 ) : 1 );
    else
        if( getValue( eSendEnabled ) && getValue( eSendReichweite_03 ))  sendReichweite_03();
}

on Timer _totReichweite_03
{
    putValue( eTimeoutReichweite_03, 0 );
}

on envVar eDlcOnceReichweite_03
{
    if( getValue( eDlcOnceReichweite_03 ) && !( getValue( eSendEnabled ) && getValue( eSendReichweite_03 )))  setTimer( _tReichweite_03, 1 );
}

void sendReichweite_03()
{
    if( getValue( eChangeReichweite_03 ))
    {
        if( getValue( eDlcOnceReichweite_03 ) || getValue( eDlcWrongReichweite_03 ))
        {
            putValue( eDlcOnceReichweite_03, 0 );
            _mReichweite_03.DLC = getValue( eDlcReichweite_03 );
        }
        else
        {
            _mReichweite_03.DLC = 8;
        }
    }
    else
    {
        _mReichweite_03.DLC = 8;
    }

    output( _mReichweite_03 );
    cancelTimer( _tReichweite_03 );
    if( getValue( eTReichweite_03 ) > 0)  setTimer( _tReichweite_03, getValue( eTReichweite_03 ) );  else  setTimer( _tReichweite_03, 1 );
}

Reichweite_03Changed()
{
}

on envVar KCAN_RW_Prim_rRWB_aktiv
{
    _mReichweite_03.RW_Prim_rRWB_aktiv.phys = getValue( this );
    Reichweite_03Changed();
}

on envVar KCAN_RW_Prim_rRWB_Reichw_Anz
{
    _mReichweite_03.RW_Prim_rRWB_Reichw_Anz.phys = getValue( this );
    Reichweite_03Changed();
}

on envVar KCAN_RW_Prim_rRWB_Reichw_Gesamt_Anz
{
    _mReichweite_03.RW_Prim_rRWB_Reichw_Gesamt_Anz.phys = getValue( this );
    Reichweite_03Changed();
}

on envVar KCAN_RW_Prim_rRWB_Reichw_Max_Ges_Anz
{
    _mReichweite_03.RW_Prim_rRWB_Reichw_Max_Ges_Anz.phys = getValue( this );
    Reichweite_03Changed();
}

on envVar KCAN_RW_Prim_rRWB_Reichw_Rest_E_Anz
{
    _mReichweite_03.RW_Prim_rRWB_Reichw_Rest_E_Anz.phys = getValue( this );
    Reichweite_03Changed();
}

on envVar KCAN_RW_Prim_statische_Reichw_Anz
{
    _mReichweite_03.RW_Prim_statische_Reichw_Anz.phys = getValue( this );
    Reichweite_03Changed();
}

on Timer _tRKA_01
{
    if( getValue( eTRKA_01 ) <= 0)  putValue( eSendRKA_01, 0 );
    if( ( getValue( eSendEnabled ) && getValue( eSendRKA_01 )) || getValue( eDlcOnceRKA_01 ))  sendRKA_01();
}

on envVar eSendRKA_01
{
    if( getValue( eSendEnabled ) && getValue( eSendRKA_01 ))  sendRKA_01();
}

on envVar eTimeoutRKA_01
{
    cancelTimer( _tRKA_01 );
    cancelTimer( _totRKA_01 );
    if( getValue( this ))
        setTimer( _totRKA_01, ( getValue( eSendEnabled ) && getValue( eSendRKA_01 ) && ( getValue( eTOTRKA_01 ) > 0)) ? getValue( eTOTRKA_01 ) : 1 );
    else
        if( getValue( eSendEnabled ) && getValue( eSendRKA_01 ))  sendRKA_01();
}

on Timer _totRKA_01
{
    putValue( eTimeoutRKA_01, 0 );
}

on envVar eDlcOnceRKA_01
{
    if( getValue( eDlcOnceRKA_01 ) && !( getValue( eSendEnabled ) && getValue( eSendRKA_01 )))  setTimer( _tRKA_01, 1 );
}

void sendRKA_01()
{
    if( getValue( eChangeRKA_01 ))
    {
        if( getValue( eDlcOnceRKA_01 ) || getValue( eDlcWrongRKA_01 ))
        {
            putValue( eDlcOnceRKA_01, 0 );
            _mRKA_01.DLC = getValue( eDlcRKA_01 );
        }
        else
        {
            _mRKA_01.DLC = 4;
        }
    }
    else
    {
        _mRKA_01.DLC = 4;
    }

    output( _mRKA_01 );
    cancelTimer( _tRKA_01 );
    if( getValue( eTRKA_01 ) > 0)  setTimer( _tRKA_01, getValue( eTRKA_01 ) );  else  setTimer( _tRKA_01, 1 );
}

RKA_01Changed()
{
}

on envVar eRKA_FMVSS138_LampeS
{
    putValue( KCAN_RKA_FMVSS138_Lampe, getValue( this ) );
}

on envVar KCAN_RKA_FMVSS138_Lampe
{
    _mRKA_01.RKA_FMVSS138_Lampe.phys = getValue( this );
    RKA_01Changed();
}

on envVar eRKA_FMVSS138_MILS
{
    putValue( KCAN_RKA_FMVSS138_MIL, getValue( this ) );
}

on envVar KCAN_RKA_FMVSS138_MIL
{
    _mRKA_01.RKA_FMVSS138_MIL.phys = getValue( this );
    RKA_01Changed();
}

on envVar KCAN_RKA_Reifentyp
{
    _mRKA_01.RKA_Reifentyp.phys = getValue( this );
    RKA_01Changed();
}

on envVar eRKA_Warnungen_02S
{
    putValue( KCAN_RKA_Warnungen_02, getValue( this ) );
}

on envVar KCAN_RKA_Warnungen_02
{
    _mRKA_01.RKA_Warnungen_02.phys = getValue( this );
    RKA_01Changed();
}

on Timer _tSOK_NoAuthenticTime_01
{
    if( getValue( eTSOK_NoAuthenticTime_01 ) <= 0)  putValue( eSendSOK_NoAuthenticTime_01, 0 );
    if( ( getValue( eSendEnabled ) && getValue( eSendSOK_NoAuthenticTime_01 )) || getValue( eDlcOnceSOK_NoAuthenticTime_01 ))  sendSOK_NoAuthenticTime_01();
}

on envVar eSendSOK_NoAuthenticTime_01
{
    if( getValue( eSendEnabled ) && getValue( eSendSOK_NoAuthenticTime_01 ))  sendSOK_NoAuthenticTime_01();
}

on envVar eTimeoutSOK_NoAuthenticTime_01
{
    cancelTimer( _tSOK_NoAuthenticTime_01 );
    cancelTimer( _totSOK_NoAuthenticTime_01 );
    if( getValue( this ))
        setTimer( _totSOK_NoAuthenticTime_01, ( getValue( eSendEnabled ) && getValue( eSendSOK_NoAuthenticTime_01 ) && ( getValue( eTOTSOK_NoAuthenticTime_01 ) > 0)) ? getValue( eTOTSOK_NoAuthenticTime_01 ) : 1 );
    else
        if( getValue( eSendEnabled ) && getValue( eSendSOK_NoAuthenticTime_01 ))  sendSOK_NoAuthenticTime_01();
}

on Timer _totSOK_NoAuthenticTime_01
{
    putValue( eTimeoutSOK_NoAuthenticTime_01, 0 );
}

on envVar eDlcOnceSOK_NoAuthenticTime_01
{
    if( getValue( eDlcOnceSOK_NoAuthenticTime_01 ) && !( getValue( eSendEnabled ) && getValue( eSendSOK_NoAuthenticTime_01 )))  setTimer( _tSOK_NoAuthenticTime_01, 1 );
}

void sendSOK_NoAuthenticTime_01()
{
    if( getValue( eChangeSOK_NoAuthenticTime_01 ))
    {
        if( getValue( eDlcOnceSOK_NoAuthenticTime_01 ) || getValue( eDlcWrongSOK_NoAuthenticTime_01 ))
        {
            putValue( eDlcOnceSOK_NoAuthenticTime_01, 0 );
            _mSOK_NoAuthenticTime_01.DLC = getValue( eDlcSOK_NoAuthenticTime_01 );
        }
        else
        {
            _mSOK_NoAuthenticTime_01.DLC = 8;
        }
    }
    else
    {
        _mSOK_NoAuthenticTime_01.DLC = 8;
    }

    output( _mSOK_NoAuthenticTime_01 );
    cancelTimer( _tSOK_NoAuthenticTime_01 );
    if( getValue( eTSOK_NoAuthenticTime_01 ) > 0)  setTimer( _tSOK_NoAuthenticTime_01, getValue( eTSOK_NoAuthenticTime_01 ) );  else  setTimer( _tSOK_NoAuthenticTime_01, 1 );
}

SOK_NoAuthenticTime_01Changed()
{
}

on envVar eSOK_ungeschuetzte_ZeitS
{
    putValue( KCAN_SOK_ungeschuetzte_Zeit, getValue( this ) );
}

on envVar KCAN_SOK_ungeschuetzte_Zeit
{
    _mSOK_NoAuthenticTime_01.SOK_ungeschuetzte_Zeit.phys = getValue( this );
    SOK_NoAuthenticTime_01Changed();
}

on Timer _tSWA_01
{
    if( getValue( eTSWA_01 ) <= 0)  putValue( eSendSWA_01, 0 );
    if( ( getValue( eSendEnabled ) && getValue( eSendSWA_01 )) || getValue( eDlcOnceSWA_01 ))  sendSWA_01();
}

on envVar eSendSWA_01
{
    if( getValue( eSendEnabled ) && getValue( eSendSWA_01 ))  sendSWA_01();
}

on envVar eTimeoutSWA_01
{
    cancelTimer( _tSWA_01 );
    cancelTimer( _totSWA_01 );
    if( getValue( this ))
        setTimer( _totSWA_01, ( getValue( eSendEnabled ) && getValue( eSendSWA_01 ) && ( getValue( eTOTSWA_01 ) > 0)) ? getValue( eTOTSWA_01 ) : 1 );
    else
        if( getValue( eSendEnabled ) && getValue( eSendSWA_01 ))  sendSWA_01();
}

on Timer _totSWA_01
{
    putValue( eTimeoutSWA_01, 0 );
}

on envVar eDlcOnceSWA_01
{
    if( getValue( eDlcOnceSWA_01 ) && !( getValue( eSendEnabled ) && getValue( eSendSWA_01 )))  setTimer( _tSWA_01, 1 );
}

void sendSWA_01()
{
    byte crc;
    dword bz;

    if( getValue( eChangeSWA_01 ))
    {
        if( getValue( eDlcOnceSWA_01 ) || getValue( eDlcWrongSWA_01 ))
        {
            putValue( eDlcOnceSWA_01, 0 );
            _mSWA_01.DLC = getValue( eDlcSWA_01 );
        }
        else
        {
            _mSWA_01.DLC = 8;
        }
    }
    else
    {
        _mSWA_01.DLC = 8;
    }

    output( _mSWA_01 );

    cancelTimer( _tSWA_01 );
    if( getValue( eTSWA_01 ) > 0)  setTimer( _tSWA_01, getValue( eTSWA_01 ) );  else  setTimer( _tSWA_01, 1 );
}

SWA_01Changed()
{
}

on envVar eASW_KombitexteS
{
    _mSWA_01.ASW_Kombitexte.phys = getValue( this );
    SWA_01Changed();
}

on envVar eHeckradar_KombitexteS
{
    _mSWA_01.Heckradar_Kombitexte.phys = getValue( this );
    SWA_01Changed();
}

on envVar eHRE_Anzeigetexte
{
    _mSWA_01.HRE_Anzeigetexte.phys = getValue( this );
    SWA_01Changed();
}

on envVar eRCTA_KombitexteS
{
    _mSWA_01.RCTA_Kombitexte.phys = getValue( this );
    SWA_01Changed();
}

on envVar eSWA_AnzeigenS
{
    _mSWA_01.SWA_Anzeigen.phys = getValue( this );
    SWA_01Changed();
}

on envVar eSWA_Blindheit_erkanntS
{
    _mSWA_01.SWA_Blindheit_erkannt.phys = getValue( this );
    SWA_01Changed();
}

on envVar eSWA_GischtzaehlerS
{
    _mSWA_01.SWA_Gischtzaehler.phys = getValue( this );
    SWA_01Changed();
}

on envVar eSWA_rel_FehlerS
{
    _mSWA_01.SWA_rel_Fehler.phys = getValue( this );
    SWA_01Changed();
}

on envVar eSWA_rel_NichtverfS
{
    _mSWA_01.SWA_rel_Nichtverf.phys = getValue( this );
    SWA_01Changed();
}

on envVar eSWA_Sta_aktivS
{
    _mSWA_01.SWA_Sta_aktiv.phys = getValue( this );
    SWA_01Changed();
}

on envVar eSWA_Sta_passivS
{
    _mSWA_01.SWA_Sta_passiv.phys = getValue( this );
    SWA_01Changed();
}

on envVar eSWA_Standziele_liS
{
    _mSWA_01.SWA_Standziele_li.phys = getValue( this );
    SWA_01Changed();
}

on envVar eSWA_Standziele_reS
{
    _mSWA_01.SWA_Standziele_re.phys = getValue( this );
    SWA_01Changed();
}

/*on Timer _tISO_Funktionaler_Req_All
{
    if( getValue( eTISO_Funktionaler_Req_All ) <= 0)  putValue( eSendISO_Funktionaler_Req_All, 0 );
    if( ( getValue( eSendEnabled ) && getValue( eSendISO_Funktionaler_Req_All )) || getValue( eDlcOnceISO_Funktionaler_Req_All ))  sendISO_Funktionaler_Req_All();
}*/

on envVar eSendISO_Funktionaler_Req_All
{
    if( getValue( eSendEnabled ) && getValue( eSendISO_Funktionaler_Req_All ))  sendISO_Funktionaler_Req_All();
}

/*on envVar eTimeoutISO_Funktionaler_Req_All
{*/
 //   cancelTimer( _tISO_Funktionaler_Req_All );
/*    cancelTimer( _totISO_Funktionaler_Req_All );
    if( getValue( this ))
        setTimer( _totISO_Funktionaler_Req_All, ( getValue( eSendEnabled ) && getValue( eSendISO_Funktionaler_Req_All ) && ( getValue( eTOTISO_Funktionaler_Req_All ) > 0)) ? getValue( eTOTISO_Funktionaler_Req_All ) : 1 );
    else
        if( getValue( eSendEnabled ) && getValue( eSendISO_Funktionaler_Req_All ))  sendISO_Funktionaler_Req_All();
}*/

/*on Timer _totISO_Funktionaler_Req_All
{
    putValue( eTimeoutISO_Funktionaler_Req_All, 0 );
}*/

on envVar eDlcOnceISO_Funktionaler_Req_All
{
 //   if( getValue( eDlcOnceISO_Funktionaler_Req_All ) && !( getValue( eSendEnabled ) && getValue( eSendISO_Funktionaler_Req_All )))  setTimer( _tISO_Funktionaler_Req_All, 1 );
}

/*on Timer _tISO_Kombi_Req
{
  if( getValue( eTISO_Kombi_Req ) <= 0)  putValue( eSendISO_Kombi_Req, 0 );
  if( ( getValue( eSendEnabled ) && getValue( eSendISO_Kombi_Req )) || getValue( eDlcOnceISO_Kombi_Req ))  sendISO_Kombi_Req();
}*/

on envVar eSendISO_Kombi_Req
{
  if( getValue( eSendEnabled ) && getValue( eSendISO_Kombi_Req ))  sendISO_Kombi_Req();
}

/*on envVar eTimeoutISO_Kombi_Req
{
  cancelTimer( _tISO_Kombi_Req );
  cancelTimer( _totISO_Kombi_Req );
  if( getValue( this ))
    setTimer( _totISO_Kombi_Req, ( getValue( eSendEnabled ) && getValue( eSendISO_Kombi_Req ) && ( getValue( eTOTISO_Kombi_Req ) > 0)) ? getValue( eTOTISO_Kombi_Req ) : 1 );
  else
    if( getValue( eSendEnabled ) && getValue( eSendISO_Kombi_Req ))  sendISO_Kombi_Req();
}*/

/*on Timer _totISO_Kombi_Req
{
  putValue( eTimeoutISO_Kombi_Req, 0 );
}*/

on envVar eDlcOnceISO_Kombi_Req
{
 // if( getValue( eDlcOnceISO_Kombi_Req ) && !( getValue( eSendEnabled ) && getValue( eSendISO_Kombi_Req )))  setTimer( _tISO_Kombi_Req, 1 );
}

on Timer _tLWR_AFS_01
{
    if( getValue( eTLWR_AFS_01 ) <= 0)  putValue( eSendLWR_AFS_01, 0 );
    if( ( getValue( eSendEnabled ) && getValue( eSendLWR_AFS_01 )) || getValue( eDlcOnceLWR_AFS_01 ))  sendLWR_AFS_01();
}

on envVar eSendLWR_AFS_01
{
    if( getValue( eSendEnabled ) && getValue( eSendLWR_AFS_01 ))  sendLWR_AFS_01();
}

on envVar eTimeoutLWR_AFS_01
{
    cancelTimer( _tLWR_AFS_01 );
    cancelTimer( _totLWR_AFS_01 );
    if( getValue( this ))
        setTimer( _totLWR_AFS_01, ( getValue( eSendEnabled ) && getValue( eSendLWR_AFS_01 ) && ( getValue( eTOTLWR_AFS_01 ) > 0)) ? getValue( eTOTLWR_AFS_01 ) : 1 );
    else
        if( getValue( eSendEnabled ) && getValue( eSendLWR_AFS_01 ))  sendLWR_AFS_01();
}

on Timer _totLWR_AFS_01
{
    putValue( eTimeoutLWR_AFS_01, 0 );
}

on envVar eDlcOnceLWR_AFS_01
{
    if( getValue( eDlcOnceLWR_AFS_01 ) && !( getValue( eSendEnabled ) && getValue( eSendLWR_AFS_01 )))  setTimer( _tLWR_AFS_01, 1 );
}

on Timer _tNMH_Gateway
{
    if( getValue( eTNMH_Gateway ) <= 0)  putValue( eSendNMH_Gateway, 0 );
    if( ( getValue( eSendEnabled ) && getValue( eSendNMH_Gateway )) || getValue( eDlcOnceNMH_Gateway ))  sendNMH_Gateway();
}

on envVar eSendNMH_Gateway
{
    if( getValue( eSendEnabled ) && getValue( eSendNMH_Gateway ))  sendNMH_Gateway();
}

on envVar eTimeoutNMH_Gateway
{
  cancelTimer( _tNMH_Gateway );
  cancelTimer( _totNMH_Gateway );
  if( getValue( this ))
    setTimer( _totNMH_Gateway, ( getValue( eSendEnabled ) && getValue( eSendNMH_Gateway ) && ( getValue( eTOTNMH_Gateway ) > 0)) ? getValue( eTOTNMH_Gateway ) : 1 );
  else
    if( getValue( eSendEnabled ) && getValue( eSendNMH_Gateway ))  sendNMH_Gateway();
}

on Timer _totNMH_Gateway
{
  putValue( eTimeoutNMH_Gateway, 0 );
}

on envVar eDlcOnceNMH_Gateway
{
  if( getValue( eDlcOnceNMH_Gateway ) && !( getValue( eSendEnabled ) && getValue( eSendNMH_Gateway )))  setTimer( _tNMH_Gateway, 1 );
}

on Timer _tRDK_02
{
  if( getValue( eTRDK_02 ) <= 0)  putValue( eSendRDK_02, 0 );
  if( ( getValue( eSendEnabled ) && getValue( eSendRDK_02 )) || getValue( eDlcOnceRDK_02 ))  sendRDK_02();
}

on envVar eSendRDK_02
{
  if( getValue( eSendEnabled ) && getValue( eSendRDK_02 ))  sendRDK_02();
}

on envVar eTimeoutRDK_02
{
  cancelTimer( _tRDK_02 );
  cancelTimer( _totRDK_02 );
  if( getValue( this ))
    setTimer( _totRDK_02, ( getValue( eSendEnabled ) && getValue( eSendRDK_02 ) && ( getValue( eTOTRDK_02 ) > 0)) ? getValue( eTOTRDK_02 ) : 1 );
  else
    if( getValue( eSendEnabled ) && getValue( eSendRDK_02 ))  sendRDK_02();
}

on Timer _totRDK_02
{
  putValue( eTimeoutRDK_02, 0 );
}

on envVar eDlcOnceRDK_02
{
  if( getValue( eDlcOnceRDK_02 ) && !( getValue( eSendEnabled ) && getValue( eSendRDK_02 )))  setTimer( _tRDK_02, 1 );
}

void sendRDK_02()
{
  if( getValue(eChangeRDK_02))
  {
    if( getValue( eDlcOnceRDK_02 ) || getValue( eDlcWrongRDK_02 ))
    {
        putValue( eDlcOnceRDK_02, 0 );
        _mRDK_02.DLC = getValue( eDlcRDK_02 );
    }
    else
    {
        _mRDK_02.DLC = 8;
    }
  }
  else
  {
    _mRDK_02.DLC = 8;
  }
  output( _mRDK_02 );
  cancelTimer( _tRDK_02 );
  if( getValue( eTRDK_02 ) > 0)  setTimer( _tRDK_02, getValue( eTRDK_02 ) );  else  setTimer( _tRDK_02, 1 );
}

on envVar eRDK_Warnungen_02s
{
    putValue( KCAN_RDK_Warnungen_02, getValue( this ) );
}

on envVar KCAN_RDK_Warnungen_02
{
    _mRDK_02.RDK_Warnungen_02.phys = getValue( this );

}


on envVar eRDK_FMVSS138_LampeS
{
    putValue( KCAN_RDK_FMVSS138_Lampe, getValue( this ) );
}

on envVar KCAN_RDK_FMVSS138_Lampe
{
    _mRDK_02.RDK_FMVSS138_Lampe.phys = getValue( this );

}

on envVar eRDK_FMVSS138_MILS
{
    putValue( KCAN_RDK_FMVSS138_MIL, getValue( this ) );
}

on envVar KCAN_RDK_FMVSS138_MIL
{
    _mRDK_02.RDK_FMVSS138_MIL.phys = getValue( this );

}

on envVar eRDK_KalibrierungS
{
    putValue( KCAN_RDK_Kalibrierung, getValue( this ) );
}

on envVar KCAN_RDK_Kalibrierung
{
    _mRDK_02.RDK_Kalibrierung.phys = getValue( this );
}

on envVar eISO_Kombi_Req_DataS
{
 //   _mISO_Kombi_Req.ISO_Kombi_Req_Data = getValue( eISO_Kombi_Req_DataS );
    ISO_Kombi_ReqChanged();
}

on envVar eAFS_Abbiegelicht_li_AnfS
{
  _mLWR_AFS_01.AFS_Abbiegelicht_li_Anf = getValue( eAFS_Abbiegelicht_li_AnfS );
}

on envVar eAFS_Abbiegelicht_re_AnfS
{
  _mLWR_AFS_01.AFS_Abbiegelicht_re_Anf = getValue( eAFS_Abbiegelicht_re_AnfS );
}

on envVar eAFS_Abbiegelicht_Dimm_AnfS
{
  _mLWR_AFS_01.AFS_Abbiegelicht_Dimm_Anf = getValue( eAFS_Abbiegelicht_Dimm_AnfS );
}

on envVar eAFS_Verfuegbarkeit_GLWS
{
  _mLWR_AFS_01.AFS_Verfuegbarkeit_GLW = getValue( eAFS_Verfuegbarkeit_GLWS );
}

on envVar eAFS_Status_adaptive_LVS
{
  _mLWR_AFS_01.AFS_Status_adaptive_LV = getValue( eAFS_Status_adaptive_LVS );
}

on envVar eAFS_Fernlicht_li_defektS
{
  _mLWR_AFS_01.AFS_Fernlicht_li_defekt = getValue( eAFS_Fernlicht_li_defektS );
}

on envVar eAFS_Fernlicht_re_defektS
{
  _mLWR_AFS_01.AFS_Fernlicht_re_defekt = getValue( eAFS_Fernlicht_re_defektS );
}

on envVar eAFS_Fernlicht_StatusS
{
  _mLWR_AFS_01.AFS_Fernlicht_Status = getValue( eAFS_Fernlicht_StatusS );
}

on envVar eLWR_AFS_01_BZS
{
  _mLWR_AFS_01.LWR_AFS_01_BZ = getValue( eLWR_AFS_01_BZS );
}

on envVar eAFS_LampeS
{
  _mLWR_AFS_01.AFS_Lampe = getValue( eAFS_LampeS );
}

on envVar eLWR_LampeS
{
  _mLWR_AFS_01.LWR_Lampe = getValue( eLWR_LampeS );
}

on envVar eAFS_FehlertextS
{
  _mLWR_AFS_01.AFS_Fehlertext = getValue( eAFS_FehlertextS );
}

on envVar eAFS_LED_BlinkmodeS
{
  _mLWR_AFS_01.AFS_LED_Blinkmode = getValue( eAFS_LED_BlinkmodeS );
}

on envVar eLWR_Touristenmodus_aktivS
{
  _mLWR_AFS_01.LWR_Touristenmodus_aktiv = getValue( eLWR_Touristenmodus_aktivS );
}

on envVar eAFS_Charisma_FahrPrS
{
  _mLWR_AFS_01.AFS_Charisma_FahrPr = getValue( eAFS_Charisma_FahrPrS );
}

on envVar eAFS_Charisma_StatusS
{
  _mLWR_AFS_01.AFS_Charisma_Status = getValue( eAFS_Charisma_StatusS );
}

on envVar eAFS_Charisma_UmschaltungS
{
  //_mLWR_AFS_01.AFS_Charisma_Umschaltung = getValue( eAFS_Charisma_UmschaltungS );
}

on envVar eAFS_AllwetterlichtS
{
  _mLWR_AFS_01.AFS_Allwetterlicht = getValue( eAFS_AllwetterlichtS );
}

on envVar eLWR_Touristenmodus_verbautS
{
  _mLWR_AFS_01.LWR_Touristenmodus_verbaut = getValue( eLWR_Touristenmodus_verbautS );
}

on envVar eAFS_adaptive_LV_verbautS
{
  _mLWR_AFS_01.AFS_adaptive_LV_verbaut = getValue( eAFS_adaptive_LV_verbautS );
}

on envVar eLWR_Reisemodus_TexteS
{
  _mLWR_AFS_01.LWR_Reisemodus_Texte = getValue( eLWR_Reisemodus_TexteS );
}

on envVar eLWR_Pos_SchrittmotorS
{
  _mLWR_AFS_01.LWR_Pos_Schrittmotor.phys = getValue( eLWR_Pos_SchrittmotorS );
}

on envVar eLWR_Hoehenwert_VLS
{
  _mLWR_AFS_01.LWR_Hoehenwert_VL.phys = getValue( eLWR_Hoehenwert_VLS );
}

on envVar eLWR_Hoehenwert_HLS
{
  _mLWR_AFS_01.LWR_Hoehenwert_HL.phys = getValue( eLWR_Hoehenwert_HLS );
}

on envVar eAFS_Ersatzlicht_LinksS
{
  _mLWR_AFS_01.AFS_Ersatzlicht_Links = getValue( eAFS_Ersatzlicht_LinksS );
}

on envVar eAFS_Ersatzlicht_RechtsS
{
  _mLWR_AFS_01.AFS_Ersatzlicht_Rechts = getValue( eAFS_Ersatzlicht_RechtsS );
}

on envVar eLWR_AFS_GrundeinstellungS
{
  _mLWR_AFS_01.LWR_AFS_Grundeinstellung = getValue( eLWR_AFS_GrundeinstellungS );
}

on envVar eLWR_AFS_ParametrisierungS
{
  _mLWR_AFS_01.LWR_AFS_Parametrisierung = getValue( eLWR_AFS_ParametrisierungS );
}

on envVar eLWR_InitialisierungslaufS
{
  _mLWR_AFS_01.LWR_Initialisierungslauf = getValue( eLWR_InitialisierungslaufS );
}

on envVar eLWR_SicherheitspositionS
{
  _mLWR_AFS_01.LWR_Sicherheitsposition = getValue( eLWR_SicherheitspositionS );
}

on envVar eLWR_ModusS
{
  _mLWR_AFS_01.LWR_Modus = getValue( eLWR_ModusS );
}

on envVar eLWR_KD_FehlerS
{
//  _mLWR_AFS_01.LWR_KD_Fehler = getValue( eLWR_KD_FehlerS );
}

on envVar eNM_Gateway_NM_StateS
{
  _mNMH_Gateway.NM_Gateway_NM_State = getValue( eNM_Gateway_NM_StateS );
}

on envVar eNM_Gateway_Car_WakeupS
{
  _mNMH_Gateway.NM_Gateway_Car_Wakeup = getValue( eNM_Gateway_Car_WakeupS );
}

on envVar eNM_Gateway_NM_aktiv_KL15S
{
  _mNMH_Gateway.NM_Gateway_NM_aktiv_KL15 = getValue( eNM_Gateway_NM_aktiv_KL15S );
}

on envVar eNM_Gateway_NM_aktiv_DiagnoseS
{
  _mNMH_Gateway.NM_Gateway_NM_aktiv_Diagnose = getValue( eNM_Gateway_NM_aktiv_DiagnoseS );
}

on envVar eNM_Gateway_NM_aktiv_TminS
{
  _mNMH_Gateway.NM_Gateway_NM_aktiv_Tmin = getValue( eNM_Gateway_NM_aktiv_TminS );
}

on envVar eNM_Gateway_UDS_CCS
{
  _mNMH_Gateway.NM_Gateway_UDS_CC = getValue( eNM_Gateway_UDS_CCS );
}

byte getCRC8( message* m, byte s_pdu_code[] )
{
  byte crc;
  byte byte_index;
  crc = 0xFF;
  for (byte_index = 1;  byte_index < m.DLC;  ++byte_index)
  {
    crc = _CRC8[ m.byte( byte_index ) ^ crc ];
  }
  crc = _CRC8[ s_pdu_code[ m.byte( 1 ) & 0x0F ] ^ crc ];
  return ~crc;
}

void sendISO_Funktionaler_Req_All()
{
    if( getValue( eChangeISO_Funktionaler_Req_All))
    {
//        if( getValue( eDlcOnceISO_Funktionaler_Req_All ) || getValue( eDlcWrongISO_Funktionaler_Req_All ))
 /*       {
            putValue( eDlcOnceISO_Funktionaler_Req_All, 0 );
            _mISO_Funktionaler_Req_All.DLC = getValue( eDlcISO_Funktionaler_Req_All );
        }
        else
        {
            _mISO_Funktionaler_Req_All.DLC = 8;
        }*/
    }
    else
    {
//        _mISO_Funktionaler_Req_All.DLC = 8;
    }
//    output( _mISO_Funktionaler_Req_All );
//    cancelTimer( _tISO_Funktionaler_Req_All );
///    if( getValue( eTISO_Funktionaler_Req_All ) > 0)  setTimer( _tISO_Funktionaler_Req_All, getValue( eTISO_Funktionaler_Req_All ) );  else  setTimer( _tISO_Funktionaler_Req_All, 1 );
}

ISO_Funktionaler_Req_AllChanged()
{
  if( getValue( eSendEnabled ) && getValue( eSendISO_Funktionaler_Req_All ))  sendISO_Funktionaler_Req_All();
}

on envVar eISO_ALL_01_Req_DataS
{
//    _mISO_Funktionaler_Req_All.ISO_ALL_01_Req_Data = getValue( this );
    ISO_Funktionaler_Req_AllChanged();
}

on envVar eISO_ALL_01_Req_Data_2S
{
//  _mISO_Funktionaler_Req_All.ISO_ALL_01_Req_Data_2 = getValue( eISO_ALL_01_Req_Data_2S );
  ISO_Funktionaler_Req_AllChanged();
}

void sendISO_Kombi_Req()
{
    if( getValue( eChangeISO_Kombi_Req))
    {
        if( getValue( eDlcOnceISO_Kombi_Req ) || getValue( eDlcWrongISO_Kombi_Req ))
        {
            putValue( eDlcOnceISO_Kombi_Req, 0 );
//            _mISO_Kombi_Req.DLC = getValue( eDlcISO_Kombi_Req );
        }
        else
        {
  //          _mISO_Kombi_Req.DLC = 8;
        }
    }
    else
    {
  //      _mISO_Kombi_Req.DLC = 8;
    }
  //  output( _mISO_Kombi_Req );
 //   cancelTimer( _tISO_Kombi_Req );
 //   if( getValue( eTISO_Kombi_Req ) > 0)  setTimer( _tISO_Kombi_Req, getValue( eTISO_Kombi_Req ) );  else  setTimer( _tISO_Kombi_Req, 1 );
}

ISO_Kombi_ReqChanged()
{
  if( getValue( eSendEnabled ) && getValue( eSendISO_Kombi_Req ))  sendISO_Kombi_Req();
}

void sendLWR_AFS_01()
{
  dword bz;

  if( getValue( eChangeLWR_AFS_01))
  {
    if( getValue( eDlcOnceLWR_AFS_01 ) || getValue( eDlcWrongLWR_AFS_01 ))
    {
        putValue( eDlcOnceLWR_AFS_01, 0 );
        _mLWR_AFS_01.DLC = getValue( eDlcLWR_AFS_01 );
    }
    else
    {
        _mLWR_AFS_01.DLC = 8;
    }

    if( getValue( eBZLWR_AFS_01 ))
    {
      bz = getValue( eLWR_AFS_01_BZS );
      bz = bz + getValue( eBZStepLWR_AFS_01 );
      putValue( eLWR_AFS_01_BZS, bz % 16 );
    }
  }
  else
  {
       _mLWR_AFS_01.DLC = 8;

      bz = getValue( eLWR_AFS_01_BZS ) + 1;
      putValue( eLWR_AFS_01_BZS, bz % 16 );
  }

  output( _mLWR_AFS_01 );

  cancelTimer( _tLWR_AFS_01 );
  if( getValue( eTLWR_AFS_01 ) > 0)  setTimer( _tLWR_AFS_01, getValue( eTLWR_AFS_01 ) );  else  setTimer( _tLWR_AFS_01, 1 );
}

void sendNMH_Gateway()
{
  if( getValue( eChangeNMH_Gateway))
  {
    if( getValue( eDlcOnceNMH_Gateway ) || getValue( eDlcWrongNMH_Gateway ))
    {
        putValue( eDlcOnceNMH_Gateway, 0 );
        _mNMH_Gateway.DLC = getValue( eDlcNMH_Gateway );
    }
    else
    {
        _mNMH_Gateway.DLC = 8;
    }
  }
  else
  {
    _mNMH_Gateway.DLC = 8;
  }
  output( _mNMH_Gateway );
  cancelTimer( _tNMH_Gateway );
  if( getValue( eTNMH_Gateway ) > 0)  setTimer( _tNMH_Gateway, getValue( eTNMH_Gateway ) );  else  setTimer( _tNMH_Gateway, 1 );
}

// ===== END OF GENERATED CODE =====

double getSpeedPulses( double speed )
{
  return (speed / 3.6)/*mm/ms*/ * getValue( eTESP_24 )/*ms*/ * getValue( ePulsesPerHalfWheelRotation ) * 2 / getValue( eWheelCircumferenceMax )/*mm*/;
}

void calculateSpeed()
{
  double speed_pulses;
  double total;
  double max;

  dword pulses;

  word oldAccu;
  word newAccu;
  dword temp;

  speed_pulses = getSpeedPulses( getValue( eSpeed ) );
//    write("speed_pulses: %f",speed_pulses);
  total = getValue( eSpeedPulses );
  if( !getValue( eSpeedSingleSteps ))
  {
    total += speed_pulses;
  }

  if( total <= 0)
  {
    pulses = 0;
  }
  else
  {
    pulses = (dword)(total + 0.5);
    if( getValue( eSpeedSingleSteps ))
    {
      max = getSpeedPulses( 320.0 );
      if( pulses > max)
      {
        pulses = (dword)max;
      }
    }
  }
  putValue( eSpeedPulses, total - pulses );

  if( getValue( eSpeedSingleSteps ) && getValue( eSpeedPulseCorrelation ))
  {
    speed_pulses = pulses;
  }

  /* Glider of eSpeed controls Glider of ESP_m_RaddrehzS based on value of eSpeedRPMCorrelation */
  if( getValue( eSpeedRPMCorrelation))
  {
 //   write( "speed_pulses: %f; V: %d; ePulsesPerHalfWheelRotation:%d ", speed_pulses, getValue( eTESP_24 ), (2 * getValue( ePulsesPerHalfWheelRotation )) );
    putValue( KCAN_ESP_m_Raddrehz,
              (speed_pulses * 1000.0 / getValue( eTESP_24 )/*ms*/)/*pulses/s*/
            / ((2 * getValue( ePulsesPerHalfWheelRotation ))/*pulses/rotation*/)
          );
  }
//  write("KCAN_ESP_m_Raddrehz:%f", getValue(KCAN_ESP_m_Raddrehz) );
  if( getValue( eSpeedPulseCorrelation ) || getValue( eSpeedSingleSteps ))
  {
   oldAccu = getValue( KCAN_ESP_Wegimp_VA );

    if( getValue( eCase) == 2)
    {
        /* Data from panel variable used to modify value of KCAN_ESP_Wegimp_VA */
        temp = (dword)(pulses * getValue( eESP_imp_var));
        newAccu = (oldAccu + temp) & 0x7FF;
    }
    else
    {
        putValue( eESP_imp_var, 1.0);
        newAccu = (oldAccu + pulses) & 0x7FF;
    }
//  write("KCAN_ESP_Wegimp_VA:%d", newAccu );

    putValue( KCAN_ESP_Wegimp_VA, newAccu );

    if( newAccu < oldAccu)  putValue( KCAN_ESP_Wegimp_Ueberlauf, 1 );
    putValue( KCAN_ESP_QBit_Wegimp_VA, 0 );
    putValue( eDistancePulseAccu, getValue( eDistancePulseAccu ) + pulses );
  }
}

on envVar eSpeedSendOnceButton
{
    if( getValue( this ) && !getValue( eSendESP_24 ))
    {
        sendESP_24();
    }
}

on envVar eConsumptionSendOnceButton
{
    if( getValue( this ) && !getValue( eSendMotor_04 ))
    {
        sendMotor_04();
    }
}

on envVar eSendAtOnceNMH_Gateway
{
    if( getValue( this ))
    {
        sendNMH_Gateway();
        putValue( this, 0 );
    }
}

on envVar eSI_Bus_01_Active
{
    if( getValue(this))
    {
        putValue( eSI_BUS_01S, 0);
    }
    else
    {
        putValue( eSI_BUS_01S, 1);
    }
}

on envVar eSI_Bus_04_Active
{
   if( getValue(this))
   {
      putValue( eSI_BUS_04S, 0);
   }
   else
   {
      putValue( eSI_BUS_04S, 1);
   }
}

on envVar eSI_Bus_06_Active
{
    if( getValue(this))
    {
        putValue( eSI_BUS_06S, 0);
    }
    else
    {
        putValue( eSI_BUS_06S, 1);
    }
}

on busOff
{
    putValue( eSendEnabled, 0x0);
}

on errorActive
{
 if(( this.can==1)&&(@PlayReplayblock==0)) //only for KI-Can not for ICOM @RV
    putValue( eSendEnabled, 0x1);
}

on errorPassive
{
 if(( this.can==1)&&(@PlayReplayblock==0)) //only for KI-Can not for ICOM  @RV
    putValue( eSendEnabled, 0x1);
}

//IssueList #73
void calculateConsumption_EM()
{
  dword consumption;//µl/ms
  dword oldAccu;
  dword newAccu;
  //consumption = (dword)( getValue( eConsumption_EM ) / 3.6  * getValue( eTMotor_EV_03 ) + 0.5);
  //Sabin's email 25.06.2012
  //consumption = (dword)( getValue( eConsumption_EM ) / 10  * ( getValue( eTMotor_EV_03 ) + 0.5));
  consumption = (dword)( getValue( eConsumption_EM ) * ( getValue( eTMotor_EV_03 ) + 0.5));

  oldAccu = getValue( eMO_Verbrauch_EM_GesS );
  //IssueList #124
  //newAccu = (oldAccu + consumption) & 0x7FFF;
 newAccu = (oldAccu + consumption);
 if( newAccu > 0x04FFF6)
  {
    putValue( eMO_Verbrauch_EM_Ges_UeberlaufS, 1 );
    newAccu = 0;
  }

  putValue( eMO_Verbrauch_EM_GesS, newAccu );
  //if(newAccu < oldAccu)  putValue( eMO_Verbrauch_EM_Ges_UeberlaufS, 1 );
}

//IssueList #73
void calculateConsumption_EM_Recuperation()
{
  dword consumption;//µl/ms
  dword oldAccu;
  dword newAccu;
  //consumption = (dword)( getValue( eConsumption_EM_Rekuperation ) / 3.6  * getValue( eTMotor_EV_03 ) + 0.5);

  //Sabin's email 25.06.2012
  //consumption = (dword)( getValue( eConsumption_EM_Rekuperation ) / 10  * ( getValue( eTMotor_EV_03 ) + 0.5));
  consumption = (dword)( getValue( eConsumption_EM_Rekuperation ) * ( getValue( eTMotor_EV_03 ) + 0.5));

  oldAccu = getValue( eMO_Rekuperation_Ges_EMS );
  //IssueList #124
  //newAccu = (oldAccu + consumption) & 0x7FFF;
    newAccu = (oldAccu + consumption);
  if( newAccu > 0x04FFF6)
  {
    putValue( eMO_Rekuperation_EM_Ges_UeberlaufS, 1 );
    newAccu = 0;
  }

  putValue( eMO_Rekuperation_Ges_EMS, newAccu );
}

//IssueList #169
void calculateConsumption_DC()
{
  dword consumption;//µl/ms
  dword oldAccu;
  dword newAccu;

  //consumption = (dword)( getValue( eConsumption_DC ) * ( getValue( eTDCDC_02 ) + 0.5)); // not sure for this formula
  consumption = (dword)( getValue( eConsumption_DC ) * ( getValue( eTDCDC_02 )));

  oldAccu = getValue( eDC_VerbrauchS );
  newAccu = (oldAccu + consumption);

 if( newAccu > 0x03FF) //max value of DC_Verbrauch
  {
    putValue( eDC_Verbrauch_UeberlaufS, 1 );
    newAccu = newAccu - 0x03FF ;
  }

  putValue( eDC_VerbrauchS, newAccu );

}

on message Kombi_HUD_01
{char temp[100];
 long anzeigeID = 0;
 if(getvalue(ev_WRN_Time_OnOff)==0||gValuesSet==1) return;

 anzeigeID = (((this.KBI_HUD_Data_03 & 0xFF) << 8) | (this.KBI_HUD_Data_02 & 0xFF));
 if(anzeigeID!=0){//test running
    if(gTiming==0&&gAnzID==0){//it starts
        gAnzID=anzeigeID;
        gTiming=timeNow();
    }
    else if(gAnzID!=anzeigeID){
        gTiming = timeNow() - gTiming;
        gTiming = gTiming/100;
        snprintf(temp, 100, "0x%X", gAnzID); gValuesSet=1;
        putvalue(ev_WRN_Time_AnzeigeID, temp);
        putvalue(ev_WRN_Time_DisplayTime, gTiming);

    }
 }
 else{//warning not present
    if(gTiming!=0&&gAnzID!=0&&getvalue(ev_WRN_Time_DisplayTime)==0){//test just stopped
        gTiming = timeNow() - gTiming;
        gTiming = gTiming/100;
        snprintf(temp, 100, "0x%X", gAnzID);
        putvalue(ev_WRN_Time_AnzeigeID, temp);
        putvalue(ev_WRN_Time_DisplayTime, gTiming); gValuesSet=1;
    }
    else{//test not started yet or finished and results already displayed
    }
 }

}

on envVar ev_WRN_Time_OnOff
{
    if( getvalue(ev_WRN_Time_OnOff)){
        putvalue(ev_WRN_Time_AnzeigeID, "");
        putvalue(ev_WRN_Time_DisplayTime, 0);
        gAnzID=0; gValuesSet=0;
        gTiming=0;
    }
}

on envVar eKL15TimeoutTest
{
    cancelTimer(_tKl15Test);
    cancelTimer(_tKL15TestAGA_01);
    cancelTimer(_tKL15TestAirbag_01);
    cancelTimer(_tKL15TestBEM_06);
    cancelTimer(_tKL15TestBMS_07);
    cancelTimer(_tKL15TestEPB_03);
    cancelTimer(_tKL15TestESP_21);
    cancelTimer(_tKL15TestESP_24);
    cancelTimer(_tKL15TestESP_30);
    cancelTimer(_tKL15TestLH_EPS_01);
    cancelTimer(_tKL15TestSMLS_01);
    cancelTimer(_tKL15TestTSG_FT_02);
    cancelTimer(_tKL15TestTSK_07);
    cancelTimer(_tKL15TestMVK_01 );
    cancelTimer(_tKL15TestWBA_03);

    putValue( eZAS_Kl_15S, 0);

    if( getValue( eKL15TimeoutAGA_01 ))        putValue( eSendAGA_01, 0 );
    if( getValue( eKL15TimeoutAirbag_01 ))     putValue( eSendAirbag_01, 0 );
    if( getValue( eKL15TimeoutBMS_07 ))        putValue( eSendBMS_07, 0 );
    if( getValue( eKL15TimeoutBEM_06 ))        putValue( eSendBEM_06, 0 );
    if( getValue( eKL15TimeoutEPB_03 ))        putValue( eSendEPB_03, 0 );
    if( getValue( eKL15TimeoutESP_21 ))        putValue( eSendESP_21, 0 );
    if( getValue( eKL15TimeoutESP_24 ))        putValue( eSendESP_24, 0 );
    if( getValue( eKL15TimeoutESP_30 ))        putValue( eSendESP_30, 0 );
    if( getValue( eKL15TimeoutLH_EPS_01 ))     putValue( eSendLH_EPS_01, 0 );
    if( getValue( eKL15TimeoutSMLS_01 ))       putValue( eSendSMLS_01, 0 );
    if( getValue( eKL15TimeoutTSG_FT_02 ))     putValue( eSendTSG_FT_02, 0 );
    if( getValue( eKL15TimeoutTSK_07 ))        putValue( eSendTSK_07, 0 );
    if( getValue( eKL15TimeoutMVK_01 ))        putValue( eSendMVK_01, 0 );
    if( getValue( eKL15TimeoutWBA_03 ))        putValue( eSendWBA_03, 0 );

    setTimer(_tKl15Test, getValue( eKL15TimeoutTestOffTime ));
}

on timer _tKl15Test
{
    putValue( eZAS_Kl_15S, 1);

    if( getValue( eKL15TimeoutAGA_01 ))        setTimer( _tKL15TestAGA_01, getValue( eKL15TOTAGA_01 ));
    if( getValue( eKL15TimeoutAirbag_01 ))     setTimer( _tKL15TestAirbag_01, getValue( eKL15TOTAirbag_01 ));
    if( getValue( eKL15TimeoutBEM_06 ))        setTimer( _tKL15TestBEM_06, getValue( eKL15TOTBEM_06 ));
    if( getValue( eKL15TimeoutBMS_07 ))        setTimer( _tKL15TestBMS_07, getValue( eKL15TOTBMS_07 ));
    if( getValue( eKL15TimeoutEPB_03 ))        setTimer( _tKL15TestEPB_03, getValue( eKL15TOTEPB_03 ));
    if( getValue( eKL15TimeoutESP_21 ))        setTimer( _tKL15TestESP_21, getValue( eKL15TOTESP_21 ));
    if( getValue( eKL15TimeoutESP_24 ))        setTimer( _tKL15TestESP_24, getValue( eKL15TOTESP_24 ));
    if( getValue( eKL15TimeoutESP_30 ))        setTimer( _tKL15TestESP_30, getValue( eKL15TOTESP_30 ));
    if( getValue( eKL15TimeoutLH_EPS_01 ))     setTimer( _tKL15TestLH_EPS_01, getValue( eKL15TOTLH_EPS_01 ));
    if( getValue( eKL15TimeoutSMLS_01 ))       setTimer( _tKL15TestSMLS_01, getValue( eKL15TOTSMLS_01 ));
    if( getValue( eKL15TimeoutTSG_FT_02 ))     setTimer( _tKL15TestTSG_FT_02, getValue( eKL15TOTTSG_FT_02 ));
    if( getValue( eKL15TimeoutTSK_07 ))        setTimer( _tKL15TestTSK_07, getValue( eKL15TOTTSK_07 ));
    if( getValue( eKL15TimeoutMVK_01 ))        setTimer( _tKL15TestMVK_01, getValue( eKL15TOTMVK_01 ));
    if( getValue( eKL15TimeoutWBA_03 ))        setTimer( _tKL15TestAirbag_01, getValue( eKL15TOTWBA_03 ));
}

on timer _tKL15TestAirbag_01
{
    if( getValue( eKL15TimeoutAirbag_01))
    {
        putValue( eSendAirbag_01, 1);
    }
}

on timer _tKL15TestBEM_06
{
    if( getValue( eKL15TimeoutBEM_06))
    {
        putValue( eSendBEM_06, 1);
    }
}

on timer _tKL15TestESP_24
{
    if( getValue( eKL15TimeoutESP_24))
    {
        putValue( eSendESP_24, 1);
    }
}

on timer _tKL15TestLH_EPS_01
{
    if( getValue( eKL15TimeoutLH_EPS_01))
    {
        putValue( eSendLH_EPS_01, 1);
    }
}

on timer _tKL15TestTSK_07
{
    if( getValue( eKL15TimeoutTSK_07))
    {
        putValue( eSendTSK_07, 1);
    }
}

on timer _tKL15TestBMS_07
{
    if( getValue( eKL15TimeoutBMS_07))
    {
        putValue( eSendBMS_07, 1);
    }
}

on timer _tKL15TestTSG_FT_02
{
    if( getValue( eKL15TimeoutTSG_FT_02))
    {
        putValue( eSendTSG_FT_02, 1);
    }
}

on timer _tKL15TestSMLS_01
{
    if( getValue( eKL15TimeoutSMLS_01))
    {
        putValue( eSendSMLS_01, 1);
    }
}

on timer _tKL15TestESP_21
{
  if( getValue( eKL15TimeoutESP_21))
    {
        putValue( eSendESP_21, 1 );
    }
}

on timer _tKL15TestESP_30
{
    if( getValue(eKL15TimeoutESP_30))
    {
        putValue( eSendESP_30, 1 );
    }
}

on timer _tKL15TestEPB_03
{
    if( getValue(eKL15TimeoutEPB_03))
    {
        putValue( eSendEPB_03, 1 );
    }
}

on timer _tKL15TestMVK_01
{
    if( getValue( eKL15TimeoutMVK_01 ))
    {
        putValue( eSendMVK_01, 1 );
    }
}

on timer _tKL15TestWBA_03
{
    if( getValue(eKL15TimeoutWBA_03))
    {
        putValue( eSendWBA_03, 1 );
    }
}

//NMH_STSG_HBFS
/*on Timer tNMH_STSG_HBFS
{
  if( getValue( eTNMH_STSG_HBFS ) <= 0)  putValue( eSendNMH_STSG_HBFS, 0 );
  if( ( getValue( eSendEnabled ) && getValue( eSendNMH_STSG_HBFS )) || getValue( eDlcOnceNMH_STSG_HBFS ))  sendNMH_STSG_HBFS();
}*/

//NMH_STSG_HBFS
/*on Timer _totNMH_STSG_HBFS
{
  putValue( eTimeoutNMH_STSG_HBFS, 0 );
}*/

//NMH_STSG_HBFS
void sendNMH_STSG_HBFS()
{
  if( getValue( eChangeNMH_STSG_HBFS))
  {
    if( getValue( eDlcOnceNMH_STSG_HBFS ) || getValue( eDlcWrongNMH_STSG_HBFS ))
    {
        putValue( eDlcOnceNMH_STSG_HBFS, 0 );
   //     _mNMH_STSG_HBFS.DLC = getValue( eDlcNMH_STSG_HBFS );
    }
    else
    {
  //      _mNMH_STSG_HBFS.DLC = 8;
    }
  }
  else
  {
//    _mNMH_STSG_HBFS.DLC = 8;
  }
 // output( _mNMH_STSG_HBFS );
 // cancelTimer( _tNMH_STSG_HBFS );
 // if( getValue( eTNMH_STSG_HBFS ) > 0)  setTimer( _tNMH_STSG_HBFS, getValue( eTNMH_STSG_HBFS ) );  else  setTimer( _tNMH_STSG_HBFS, 1 );
}

//NMH_STSG_HBFS
on envVar eSendNMH_STSG_HBFS
{
  if( getValue( eSendEnabled ) && getValue( eSendNMH_STSG_HBFS ))  sendNMH_STSG_HBFS();
}

//NMH_STSG_HBFS
on envVar eTimeoutNMH_STSG_HBFS
{
 // cancelTimer( _tNMH_STSG_HBFS );
 // cancelTimer( _totNMH_STSG_HBFS );
 // if( getValue( this ))
//    setTimer( _totNMH_STSG_HBFS, ( getValue( eSendEnabled ) && getValue( eSendNMH_STSG_HBFS ) && ( getValue( eTOTNMH_STSG_HBFS ) > 0)) ? getValue( eTOTNMH_STSG_HBFS ) : 1 );
//  else
//    if( getValue( eSendEnabled ) && getValue( eSendNMH_STSG_HBFS ))  sendNMH_STSG_HBFS();
}

//NMH_STSG_HBFS
on envVar eDlcOnceNMH_STSG_HBFS
{
 // if( getValue( eDlcOnceNMH_STSG_HBFS ) && !( getValue( eSendEnabled ) && getValue( eSendNMH_STSG_HBFS )))  setTimer( _tNMH_STSG_HBFS, 1 );
}

//NMH_STSG_HFS
/*on Timer _tNMH_STSG_HFS
{
  if( getValue( eTNMH_STSG_HFS ) <= 0)  putValue( eSendNMH_STSG_HFS, 0 );
  if( ( getValue( eSendEnabled ) && getValue( eSendNMH_STSG_HFS )) || getValue( eDlcOnceNMH_STSG_HFS ))  sendNMH_STSG_HFS();
}*/

//NMH_STSG_HFS
/*on Timer _totNMH_STSG_HFS
{
  putValue( eTimeoutNMH_STSG_HFS, 0 );
}*/

//NMH_STSG_HFS
void sendNMH_STSG_HFS()
{
  if( getValue( eChangeNMH_STSG_HFS))
  {
    if( getValue( eDlcOnceNMH_STSG_HFS ) || getValue( eDlcWrongNMH_STSG_HFS ))
    {
        putValue( eDlcOnceNMH_STSG_HFS, 0 );
    //    _mNMH_STSG_HFS.DLC = getValue( eDlcNMH_STSG_HFS );
    }
    else
    {
  //      _mNMH_STSG_HFS.DLC = 8;
    }
  }
  else
  {
//    _mNMH_STSG_HFS.DLC = 8;
  }
 // output( _mNMH_STSG_HFS );
//  cancelTimer( _tNMH_STSG_HFS );
 // if( getValue( eTNMH_STSG_HFS ) > 0)  setTimer( _tNMH_STSG_HFS, getValue( eTNMH_STSG_HFS ) );  else  setTimer( _tNMH_STSG_HFS, 1 );
}

//NMH_STSG_HFS
on envVar eSendNMH_STSG_HFS
{
  if( getValue( eSendEnabled ) && getValue( eSendNMH_STSG_HFS ))  sendNMH_STSG_HFS();
}

//NMH_STSG_HFS
on envVar eTimeoutNMH_STSG_HFS
{
//  cancelTimer( _tNMH_STSG_HFS );
//  cancelTimer( _totNMH_STSG_HFS );
//  if( getValue( this ))
//    setTimer( _totNMH_STSG_HFS, ( getValue( eSendEnabled ) && getValue( eSendNMH_STSG_HFS ) && ( getValue( eTOTNMH_STSG_HFS ) > 0)) ? getValue( eTOTNMH_STSG_HFS ) : 1 );
//  else
//    if( getValue( eSendEnabled ) && getValue( eSendNMH_STSG_HFS ))  sendNMH_STSG_HFS();
}

//NMH_STSG_HFS
on envVar eDlcOnceNMH_STSG_HFS
{
 // if( getValue( eDlcOnceNMH_STSG_HFS ) && !( getValue( eSendEnabled ) && getValue( eSendNMH_STSG_HFS )))  setTimer( _tNMH_STSG_HFS, 1 );
}

//WFS_Transponder_Req_02
/*on Timer _tWFS_Transponder_Req_02
{
  if( getValue( eTWFS_Transponder_Req_02 ) <= 0)  putValue( eSendWFS_Transponder_Req_02, 0 );
  if( ( getValue( eSendEnabled ) && getValue( eSendWFS_Transponder_Req_02 )) || getValue( eDlcOnceWFS_Transponder_Req_02 ))  sendWFS_Transponder_Req_02();
}*/

//WFS_Transponder_Req_02
/*on Timer _totWFS_Transponder_Req_02
{
  putValue( eTimeoutWFS_Transponder_Req_02, 0 );
}*/

//WFS_Transponder_Req_02
void sendWFS_Transponder_Req_02()
{
  if( getValue( eChangeWFS_Transponder_Req_02))
  {
    if( getValue( eDlcOnceWFS_Transponder_Req_02 ) || getValue( eDlcWrongWFS_Transponder_Req_02 ))
    {
        putValue( eDlcOnceWFS_Transponder_Req_02, 0 );
   //     _mWFS_Transponder_Req_02.DLC = getValue( eDlcWFS_Transponder_Req_02 );
    }
    else
    {
  //      _mWFS_Transponder_Req_02.DLC = 8;
    }
  }
  else
  {
 //   _mWFS_Transponder_Req_02.DLC = 8;
  }
//  output( _mWFS_Transponder_Req_02 );
//  cancelTimer( _tWFS_Transponder_Req_02 );
 // if( getValue( eTWFS_Transponder_Req_02 ) > 0)  setTimer( _tWFS_Transponder_Req_02, getValue( eTWFS_Transponder_Req_02 ) );  else  setTimer( _tWFS_Transponder_Req_02, 1 );
}

//WFS_Transponder_Req_02
/*on envVar eSendWFS_Transponder_Req_02
{
  if( getValue( eSendEnabled ) && getValue( eSendWFS_Transponder_Req_02 ))  sendWFS_Transponder_Req_02();
}*/

//WFS_Transponder_Req_02
/*on envVar eTimeoutWFS_Transponder_Req_02
{
  cancelTimer( _tWFS_Transponder_Req_02 );
  cancelTimer( _totWFS_Transponder_Req_02 );
  if( getValue( this ))
    setTimer( _totWFS_Transponder_Req_02, ( getValue( eSendEnabled ) && getValue( eSendWFS_Transponder_Req_02 ) && ( getValue( eTOTWFS_Transponder_Req_02 ) > 0)) ? getValue( eTOTWFS_Transponder_Req_02 ) : 1 );
  else
    if( getValue( eSendEnabled ) && getValue( eSendWFS_Transponder_Req_02 ))  sendWFS_Transponder_Req_02();
}*/

//WFS_Transponder_Req_02
on envVar eDlcOnceWFS_Transponder_Req_02
{
//  if( getValue( eDlcOnceWFS_Transponder_Req_02 ) && !( getValue( eSendEnabled ) && getValue( eSendWFS_Transponder_Req_02 )))  setTimer( _tWFS_Transponder_Req_02, 1 );
}

//End of EPB_03_Out

//NMH_STSG_HBFS_Out
//NM_STSG_HBFS_CBV_AWB
on envVar eNM_STSG_HBFS_CBV_AWBS
{
//_mNMH_STSG_HBFS.NM_STSG_HBFS_CBV_AWB.phys = getValue( eNM_STSG_HBFS_CBV_AWBS);

}

//NM_STSG_HBFS_CBV_CRI
on envVar eNM_STSG_HBFS_CBV_CRIS
{
//_mNMH_STSG_HBFS.NM_STSG_HBFS_CBV_CRI.phys = getValue( eNM_STSG_HBFS_CBV_CRIS);

}

//NM_STSG_HBFS_NM_State
on envVar eNM_STSG_HBFS_NM_StateS
{
//_mNMH_STSG_HBFS.NM_STSG_HBFS_NM_State.phys = getValue( eNM_STSG_HBFS_NM_StateS);

}

//NM_STSG_HBFS_Car_Wakeup
on envVar eNM_STSG_HBFS_Car_WakeupS
{
//_mNMH_STSG_HBFS.NM_STSG_HBFS_Car_Wakeup.phys = getValue( eNM_STSG_HBFS_Car_WakeupS);

}

//NM_STSG_HBFS_UDS_CC
on envVar eNM_STSG_HBFS_UDS_CCS
{
//_mNMH_STSG_HBFS.NM_STSG_HBFS_UDS_CC.phys = getValue( eNM_STSG_HBFS_UDS_CCS);

}

//NM_STSG_HBFS_NM_aktiv_KL15
on envVar eNM_STSG_HBFS_NM_aktiv_KL15S
{
//_mNMH_STSG_HBFS.NM_STSG_HBFS_NM_aktiv_KL15.phys = getValue( eNM_STSG_HBFS_NM_aktiv_KL15S);

}

//NM_STSG_HBFS_NM_aktiv_Diagnose
on envVar eNM_STSG_HBFS_NM_aktiv_DiagnoseS
{
//_mNMH_STSG_HBFS.NM_STSG_HBFS_NM_aktiv_Diagnose.phys = getValue( eNM_STSG_HBFS_NM_aktiv_DiagnoseS);

}

//NM_STSG_HBFS_NM_aktiv_Tmin
on envVar eNM_STSG_HBFS_NM_aktiv_TminS
{
//_mNMH_STSG_HBFS.NM_STSG_HBFS_NM_aktiv_Tmin.phys = getValue( eNM_STSG_HBFS_NM_aktiv_TminS);

}

//NM_STSG_HBFS_CAB_V09
on envVar eNM_STSG_HBFS_CAB_V09S
{
///_mNMH_STSG_HBFS.NM_STSG_HBFS_CAB_V09.phys = getValue( eNM_STSG_HBFS_CAB_V09S);

}

//End of NMH_STSG_HBFS_Out

//NMH_STSG_HFS_Out
//NM_STSG_HFS_CBV_AWB
on envVar eNM_STSG_HFS_CBV_AWBS
{
//_mNMH_STSG_HFS.NM_STSG_HFS_CBV_AWB.phys = getValue( eNM_STSG_HFS_CBV_AWBS);

}

//NM_STSG_HFS_CBV_CRI
on envVar eNM_STSG_HFS_CBV_CRIS
{
//_mNMH_STSG_HFS.NM_STSG_HFS_CBV_CRI.phys = getValue( eNM_STSG_HFS_CBV_CRIS);

}

//NM_STSG_HFS_NM_State
on envVar eNM_STSG_HFS_NM_StateS
{
//_mNMH_STSG_HFS.NM_STSG_HFS_NM_State.phys = getValue( eNM_STSG_HFS_NM_StateS);

}

//NM_STSG_HFS_Car_Wakeup
on envVar eNM_STSG_HFS_Car_WakeupS
{
//_mNMH_STSG_HFS.NM_STSG_HFS_Car_Wakeup.phys = getValue( eNM_STSG_HFS_Car_WakeupS);

}

//NM_STSG_HFS_UDS_CC
on envVar eNM_STSG_HFS_UDS_CCS
{
//_mNMH_STSG_HFS.NM_STSG_HFS_UDS_CC.phys = getValue( eNM_STSG_HFS_UDS_CCS);

}

//NM_STSG_HFS_NM_aktiv_KL15
on envVar eNM_STSG_HFS_NM_aktiv_KL15S
{
//_mNMH_STSG_HFS.NM_STSG_HFS_NM_aktiv_KL15.phys = getValue( eNM_STSG_HFS_NM_aktiv_KL15S);

}

//NM_STSG_HFS_NM_aktiv_Diagnose
on envVar eNM_STSG_HFS_NM_aktiv_DiagnoseS
{
//_mNMH_STSG_HFS.NM_STSG_HFS_NM_aktiv_Diagnose.phys = getValue( eNM_STSG_HFS_NM_aktiv_DiagnoseS);

}

//NM_STSG_HFS_NM_aktiv_Tmin
on envVar eNM_STSG_HFS_NM_aktiv_TminS
{
//_mNMH_STSG_HFS.NM_STSG_HFS_NM_aktiv_Tmin.phys = getValue( eNM_STSG_HFS_NM_aktiv_TminS);

}

//NM_STSG_HFS_CAB_V09
on envVar eNM_STSG_HFS_CAB_V09S
{
//_mNMH_STSG_HFS.NM_STSG_HFS_CAB_V09.phys = getValue( eNM_STSG_HFS_CAB_V09S);

}

//End of OBDC_Funktionaler_Req_All_Out

//WFS_Transponder_Req_02_Out
//WFS_Transponder_Req_02_Data
on envVar eWFS_Transponder_Req_02_DataS
{
//_mWFS_Transponder_Req_02.WFS_Transponder_Req_02_Data.phys = getValue( eWFS_Transponder_Req_02_DataS);

}

on Timer _tSysteminfo_01
{
    if( getValue( eTSysteminfo_01 ) <= 0)  putValue( eSendSysteminfo_01, 0 );
    if( ( getValue( eSendEnabled ) && getValue( eSendSysteminfo_01 )) || getValue( eDlcOnceSysteminfo_01 ))  sendSysteminfo_01();
}

on envVar eSendSysteminfo_01
{
    if( getValue( eSendEnabled ) && getValue( eSendSysteminfo_01 ))  sendSysteminfo_01();
}

on envVar eTimeoutSysteminfo_01
{
    cancelTimer( _tSysteminfo_01 );
    cancelTimer( _totSysteminfo_01 );
    if( getValue( this ))
        setTimer( _totSysteminfo_01, ( getValue( eSendEnabled ) && getValue( eSendSysteminfo_01 ) && ( getValue( eTOTSysteminfo_01 ) > 0)) ? getValue( eTOTSysteminfo_01 ) : 1 );
    else
        if( getValue( eSendEnabled ) && getValue( eSendSysteminfo_01 ))  sendSysteminfo_01();
}

on Timer _totSysteminfo_01
{
    putValue( eTimeoutSysteminfo_01, 0 );
}

on envVar eDlcOnceSysteminfo_01
{
    if( getValue( eDlcOnceSysteminfo_01 ) && !( getValue( eSendEnabled ) && getValue( eSendSysteminfo_01 )))  setTimer( _tSysteminfo_01, 1 );
}

on Timer _tinhSysteminfo_01
{
    _bsiSysteminfo_01 = 0;
    if( _bsaiSysteminfo_01 && getValue( eSendEnabled ))  sendSysteminfo_01();
}

void sendSysteminfo_01()
{
    if( getValue( eChangeSysteminfo_01))
    {
        if( getValue( eDlcOnceSysteminfo_01 ) || getValue( eDlcWrongSysteminfo_01 ))
        {
            putValue( eDlcOnceSysteminfo_01, 0 );
            _mSysteminfo_01.DLC = getValue( eDlcSysteminfo_01 );
        }
        else
        {
            _mSysteminfo_01.DLC = 8;
        }
    }
    else
    {
        _mSysteminfo_01.DLC = 8;
    }

    output( _mSysteminfo_01 );
    cancelTimer( _tSysteminfo_01 );
    if( getValue( eTSysteminfo_01 ) > 0)  setTimer( _tSysteminfo_01, getValue( eTSysteminfo_01 ) );  else  setTimer( _tSysteminfo_01, 1 );
    _bsaiSysteminfo_01 = 0;
    _bsiSysteminfo_01 = 1;
    cancelTimer( _tinhSysteminfo_01 );  setTimer( _tinhSysteminfo_01, 10 );
}

Systeminfo_01Changed()
{
    if( getValue( eSendEnabled ) && getValue( eSendSysteminfo_01 ))
        if( _bsiSysteminfo_01)
            _bsaiSysteminfo_01 = 1;
        else
            sendSysteminfo_01();
}

on envVar eGW_KD_FehlerS
{
    _mSysteminfo_01.GW_KD_Fehler.phys = getValue( this );
    Systeminfo_01Changed();
}

on envVar eSysteminfo_01_BusActive
{
    if( getValue(this))
    {
       putValue( eSI_Bus_01_Active, 1);
       putValue( eSI_Bus_04_Active, 1);
       putValue( eSI_Bus_06_Active, 1);
    }
    else
    {
       putValue( eSI_Bus_01_Active, 0);
       putValue( eSI_Bus_04_Active, 0);
       putValue( eSI_Bus_06_Active, 0);
    }
}

on envVar eSI_BUS_01S
{
  if( getValue(this))
  {
    if( getValue (eSI_Bus_01_Active) != 0)
    {
        putValue( eSI_Bus_01_Active, 0);
    }
  }
  else
  {
    if( getValue (eSI_Bus_01_Active) != 1)
    {
        putValue( eSI_Bus_01_Active, 1);
    }
  }

    _mSysteminfo_01.SI_BUS_01.phys = getValue( this );
    Systeminfo_01Changed();
}

on envVar eSI_BUS_02S
{
    _mSysteminfo_01.SI_BUS_02.phys = getValue( this );
    Systeminfo_01Changed();
}

on envVar eSI_BUS_03S
{
    _mSysteminfo_01.SI_BUS_03.phys = getValue( this );
    Systeminfo_01Changed();
}

on envVar eSI_BUS_04S
{
    if( getValue(this))
    {
        if( getValue (eSI_Bus_04_Active) != 0)
        {
            putValue( eSI_Bus_04_Active, 0);
        }
    }
    else
    {
        if( getValue (eSI_Bus_04_Active) != 1)
        {
            putValue( eSI_Bus_04_Active, 1);
        }
    }

    _mSysteminfo_01.SI_BUS_04.phys = getValue( this );
    Systeminfo_01Changed();
}

on envVar eSI_BUS_05S
{
    _mSysteminfo_01.SI_BUS_05.phys = getValue( this );
    Systeminfo_01Changed();
}

on envVar eSI_BUS_06S
{
    if( getValue(this))
    {
        if( getValue (eSI_Bus_06_Active) != 0)
        {
            putValue( eSI_Bus_06_Active, 0);
        }
    }
    else
    {
        if( getValue (eSI_Bus_06_Active) != 1)
        {
            putValue( eSI_Bus_06_Active, 1);
        }
    }

    _mSysteminfo_01.SI_BUS_06.phys = getValue( this );
    Systeminfo_01Changed();
}

on envVar eSI_BUS_07S
{
    _mSysteminfo_01.SI_BUS_07.phys = getValue( this );
    Systeminfo_01Changed();
}

on envVar eSI_BUS_08S
{
    _mSysteminfo_01.SI_BUS_08.phys = getValue( this );
    Systeminfo_01Changed();
}

on envVar eSI_BUS_09S
{
    _mSysteminfo_01.SI_BUS_09.phys = getValue( this );
    Systeminfo_01Changed();
}

on envVar eSI_BUS_10S
{
    _mSysteminfo_01.SI_BUS_10.phys = getValue( this );
    Systeminfo_01Changed();
}

on envVar eSI_BUS_11S
{
    _mSysteminfo_01.SI_BUS_11.phys = getValue( this );
    Systeminfo_01Changed();
}

on envVar eSI_BUS_12S
{
    _mSysteminfo_01.SI_BUS_12.phys = getValue( this );
    Systeminfo_01Changed();
}

on envVar eSI_BUS_13S
{
    _mSysteminfo_01.SI_BUS_13.phys = getValue( this );
    Systeminfo_01Changed();
}

on envVar eSI_BUS_14S
{
    _mSysteminfo_01.SI_BUS_14.phys = getValue( this );
    Systeminfo_01Changed();
}

on envVar eSI_BUS_15S
{
    _mSysteminfo_01.SI_BUS_15.phys = getValue( this );
    Systeminfo_01Changed();
}

on envVar eSI_CAB_01S
{
  if( getValue(this))
  {
    if( getValue (eSI_CAB_01_Active) != 0)
    {
        putValue(eSI_CAB_01_Active, 0);
    }
  }
  else
  {
    if( getValue (eSI_CAB_01_Active) != 1)
    {
        putValue(eSI_CAB_01_Active, 1);
    }
  }

  if( getValue( eSI_CAB_01S ) == 1)
  {
  	_mSysteminfo_01.SI_CAB_V09 |= (1);
  }
  else if( getValue( eSI_CAB_01S ) == 0)
  {
  	_mSysteminfo_01.SI_CAB_V09 &= ~(1);
  }
  Systeminfo_01Changed();
}

on envVar eSI_CAB_02S
{
  if( getValue(this))
  {
    if( getValue (eSI_CAB_02_Active) != 0)
    {
        putValue(eSI_CAB_02_Active, 0);
    }
  }
  else
  {
    if( getValue (eSI_CAB_02_Active) != 1)
    {
        putValue(eSI_CAB_02_Active, 1);
    }
  }

  if( getValue( eSI_CAB_02S ) == 1)
  {
  	_mSysteminfo_01.SI_CAB_V09 |= (2);
  }
  else if( getValue( eSI_CAB_02S ) == 0)
  {
  	_mSysteminfo_01.SI_CAB_V09 &= ~(2);
  }
  Systeminfo_01Changed();
}

on envVar eSI_CAB_03S
{
  if( getValue(this))
  {
    if( getValue (eSI_CAB_03_Active) != 0)
    {
        putValue(eSI_CAB_03_Active, 0);
    }
  }
  else
  {
    if( getValue (eSI_CAB_03_Active) != 1)
    {
        putValue(eSI_CAB_03_Active, 1);
    }
  }

  if( getValue( eSI_CAB_03S ) == 1)
  {
  	_mSysteminfo_01.SI_CAB_V09 |= (4);
  }
  else if( getValue( eSI_CAB_03S ) == 0)
  {
  	_mSysteminfo_01.SI_CAB_V09 &= ~(4);
  }
  Systeminfo_01Changed();
}

on envVar eSI_CAB_04S
{
  if( getValue(this))
  {
    if( getValue (eSI_CAB_04_Active) != 0)
    {
        putValue(eSI_CAB_04_Active, 0);
    }
  }
  else
  {
    if( getValue (eSI_CAB_04_Active) != 1)
    {
        putValue(eSI_CAB_04_Active, 1);
    }
  }

    if( getValue( eSI_CAB_04S ) == 1)
    {
        _mSysteminfo_01.SI_CAB_V09 |= (8);
    }
    else if( getValue( eSI_CAB_04S ) == 0)
    {
        _mSysteminfo_01.SI_CAB_V09 &= ~(8);
    }
    Systeminfo_01Changed();
}

on envVar eSI_CAB_05S
{
    if( getValue(this))
    {
        if( getValue (eSI_CAB_05_Active) != 0)
        {
            putValue(eSI_CAB_05_Active, 0);
        }
    }
    else
    {
        if( getValue (eSI_CAB_05_Active) != 1)
        {
            putValue(eSI_CAB_05_Active, 1);
        }
    }

    if( getValue( eSI_CAB_05S ) == 1)
    {
        _mSysteminfo_01.SI_CAB_V09 |= (16);
    }
    else if( getValue( eSI_CAB_05S ) == 0)
    {
        _mSysteminfo_01.SI_CAB_V09 &= ~(16);
    }
    Systeminfo_01Changed();
}

on envVar eSI_CAB_06S
{
  if( getValue(this))
  {
    if( getValue (eSI_CAB_06_Active) != 0)
    {
        putValue(eSI_CAB_06_Active, 0);
    }
  }
  else
  {
    if( getValue (eSI_CAB_06_Active) != 1)
    {
        putValue(eSI_CAB_06_Active, 1);
    }
  }

  if( getValue( eSI_CAB_06S ) == 1)
  {
    _mSysteminfo_01.SI_CAB_V09 |= (32);
  }
  else if( getValue( eSI_CAB_06S ) == 0)
  {
    _mSysteminfo_01.SI_CAB_V09 &= ~(32);
  }
  Systeminfo_01Changed();
}

on envVar eSI_CAB_07S
{
  if( getValue(this))
  {
    if( getValue (eSI_CAB_07_Active) != 0)
    {
        putValue(eSI_CAB_07_Active, 0);
    }
  }
  else
  {
    if( getValue (eSI_CAB_07_Active) != 1)
    {
        putValue(eSI_CAB_07_Active, 1);
    }
  }

  if( getValue( eSI_CAB_07S ) == 1)
  {
  	_mSysteminfo_01.SI_CAB_V09 |= (64);
  }
  else if( getValue( eSI_CAB_07S ) == 0)
  {
  	_mSysteminfo_01.SI_CAB_V09 &= ~(64);
  }
  Systeminfo_01Changed();
}

on envVar eSI_CAB_08S
{
  if( getValue(this))
  {
    if( getValue (eSI_CAB_08_Active) != 0)
    {
        putValue(eSI_CAB_08_Active, 0);
    }
  }
  else
  {
    if( getValue (eSI_CAB_08_Active) != 1)
    {
        putValue(eSI_CAB_08_Active, 1);
    }
  }

  if( getValue( eSI_CAB_08S ) == 1)
  {
  	_mSysteminfo_01.SI_CAB_V09 |= (128);
  }
  else if( getValue( eSI_CAB_08S ) == 0)
  {
  	_mSysteminfo_01.SI_CAB_V09 &= ~(128);
  }
  Systeminfo_01Changed();
}

on envVar eSI_CAB_09S
{
  if( getValue(this))
  {
    if( getValue (eSI_CAB_09_Active) != 0)
    {
        putValue(eSI_CAB_09_Active, 0);
    }
  }
  else
  {
    if( getValue (eSI_CAB_09_Active) != 1)
    {
        putValue(eSI_CAB_09_Active, 1);
    }
  }

  if( getValue( eSI_CAB_09S ) == 1)
  {
  	_mSysteminfo_01.SI_CAB_V09 |= (256);
  }
  else if( getValue( eSI_CAB_09S ) == 0)
  {
  	_mSysteminfo_01.SI_CAB_V09 &= ~(256);
  }
  Systeminfo_01Changed();
}

on envVar eSI_CAB_10S
{
  if( getValue(this))
  {
    if( getValue (eSI_CAB_10_Active) != 0)
    {
        putValue(eSI_CAB_10_Active, 0);
    }
  }
  else
  {
    if( getValue (eSI_CAB_10_Active) != 1)
    {
        putValue(eSI_CAB_10_Active, 1);
    }
  }

  if( getValue( eSI_CAB_10S ) == 1)
  {
  	_mSysteminfo_01.SI_CAB_V09 |= (512);
  }
  else if( getValue( eSI_CAB_10S ) == 0)
  {
  	_mSysteminfo_01.SI_CAB_V09 &= ~(512);
  }
  Systeminfo_01Changed();
}

on envVar eSI_CAB_11S
{
  if( getValue(this))
  {
    if( getValue (eSI_CAB_11_Active) != 0)
    {
        putValue(eSI_CAB_11_Active, 0);
    }
  }
  else
  {
    if( getValue (eSI_CAB_11_Active) != 1)
    {
        putValue(eSI_CAB_11_Active, 1);
    }
  }

  if( getValue( eSI_CAB_11S ) == 1)
  {
  	_mSysteminfo_01.SI_CAB_V09 |= (1024);
  }
  else if( getValue( eSI_CAB_11S ) == 0)
  {
  	_mSysteminfo_01.SI_CAB_V09 &= ~(1024);
  }
  Systeminfo_01Changed();
}

on envVar eSI_CAB_12S
{
  if( getValue(this))
  {
    if( getValue (eSI_CAB_12_Active) != 0)
    {
        putValue(eSI_CAB_12_Active, 0);
    }
  }
  else
  {
    if( getValue (eSI_CAB_12_Active) != 1)
    {
        putValue(eSI_CAB_12_Active, 1);
    }
  }

  if( getValue( eSI_CAB_12S ) == 1)
  {
  	_mSysteminfo_01.SI_CAB_V09 |= (2048);
  }
  else if( getValue( eSI_CAB_12S ) == 0)
  {
  	_mSysteminfo_01.SI_CAB_V09 &= ~(2048);
  }
  Systeminfo_01Changed();
}

on envVar eSI_CAB_13S
{
  if( getValue(this))
  {
    if( getValue (eSI_CAB_13_Active) != 0)
    {
        putValue(eSI_CAB_13_Active, 0);
    }
  }
  else
  {
    if( getValue (eSI_CAB_13_Active) != 1)
    {
        putValue(eSI_CAB_13_Active, 1);
    }
  }

  if( getValue( eSI_CAB_13S ) == 1)
  {
  	_mSysteminfo_01.SI_CAB_V09 |= (4096);
  }
  else if( getValue( eSI_CAB_13S ) == 0)
  {
  	_mSysteminfo_01.SI_CAB_V09 &= ~(4096);
  }
  Systeminfo_01Changed();
}

on envVar eSI_CAB_14S
{
    if( getValue(this))
    {
        if( getValue (eSI_CAB_14_Active) != 0)
        {
            putValue(eSI_CAB_14_Active, 0);
        }
    }
    else
    {
        if( getValue (eSI_CAB_14_Active) != 1)
        {
            putValue(eSI_CAB_14_Active, 1);
        }
    }

    if( getValue( eSI_CAB_14S ) == 1)
    {
        _mSysteminfo_01.SI_CAB_V09 |= (8192);
    }
    else if( getValue( eSI_CAB_14S ) == 0)
    {
        _mSysteminfo_01.SI_CAB_V09 &= ~(8192);
    }
    Systeminfo_01Changed();
}

on envVar KCAN_SI_Bus_Identifikation
{
    _mSysteminfo_01.SI_Bus_Identifikation.phys = getValue( this );
    Systeminfo_01Changed();
}

on envVar eSI_CAB_V09S
{
    putValue( KCAN_SI_CAB_V09, getValue( this ) );
}

on envVar KCAN_SI_CAB_V09
{
    _mSysteminfo_01.SI_CAB_V09.phys = getValue( this );
    Systeminfo_01Changed();
}

on envVar KCAN_SI_Diagnose_Aktiv
{
    _mSysteminfo_01.SI_Diagnose_Aktiv.phys = getValue( this );
    Systeminfo_01Changed();
}

on envVar eSI_NWDFS
{
    _mSysteminfo_01.SI_NWDF.phys = getValue( this );
    Systeminfo_01Changed();
}

on envVar eSI_NWDF_gueltigS
{
    _mSysteminfo_01.SI_NWDF_gueltig.phys = getValue( this );
    Systeminfo_01Changed();
}

on envVar eSI_P_ModeS
{
    _mSysteminfo_01.SI_P_Mode.phys = getValue( this );
    Systeminfo_01Changed();
}

on envVar eSI_P_Mode_gueltigS
{
    _mSysteminfo_01.SI_P_Mode_gueltig.phys = getValue( this );
    Systeminfo_01Changed();
}

on envVar eSI_QRS_ModeS
{
    _mSysteminfo_01.SI_QRS_Mode.phys = getValue( this );
    Systeminfo_01Changed();
}

on envVar eSI_Sammel_SG_FehlerS
{
    _mSysteminfo_01.SI_Sammel_SG_Fehler.phys = getValue( this );
    Systeminfo_01Changed();
}

on envVar eSI_T_Schutz
{
    _mSysteminfo_01.SI_T_Schutz.phys = getValue( this );
    Systeminfo_01Changed();
}

on Timer _tTA_01
{
    if( getValue( eTTA_01 ) <= 0)  putValue( eSendTA_01, 0 );
    if( ( getValue( eSendEnabled ) && getValue( eSendTA_01 )) || getValue( eDlcOnceTA_01 ))  sendTA_01();
}

on envVar eSendTA_01
{
    if( getValue( eSendEnabled ) && getValue( eSendTA_01 ))  sendTA_01();
}

on envVar eTimeoutTA_01
{
    cancelTimer( _tTA_01 );
    cancelTimer( _totTA_01 );
    if( getValue( this ))
        setTimer( _totTA_01, ( getValue( eSendEnabled ) && getValue( eSendTA_01 ) && ( getValue( eTOTTA_01 ) > 0)) ? getValue( eTOTTA_01 ) : 1 );
    else
        if( getValue( eSendEnabled ) && getValue( eSendTA_01 ))  sendTA_01();
}

on Timer _totTA_01
{
    putValue( eTimeoutTA_01, 0 );
}

on envVar eDlcOnceTA_01
{
    if( getValue( eDlcOnceTA_01 ) && !( getValue( eSendEnabled ) && getValue( eSendTA_01 )))  setTimer( _tTA_01, 1 );
}

void sendTA_01()
{
    if( getValue( eChangeTA_01))
    {
        if( getValue( eDlcOnceTA_01 ) || getValue( eDlcWrongTA_01 ))
        {
            putValue( eDlcOnceTA_01, 0 );
            _mTA_01.DLC = getValue( eDlcTA_01 );
        }
        else
        {
            _mTA_01.DLC = 8;
        }
    }
    else
    {
        _mTA_01.DLC = 8;
    }

    output( _mTA_01 );
    cancelTimer( _tTA_01 );
    if( getValue( eTTA_01 ) > 0)  setTimer( _tTA_01, getValue( eTTA_01 ) );  else  setTimer( _tTA_01, 1 );
}

TA_01Changed()
{
}

on envVar eTA_SpurwechselS
{
    _mTA_01.TA_Spurwechsel.phys = getValue( this );
    TA_01Changed();
}

on envVar eTA_StatusS
{
    _mTA_01.TA_Status.phys = getValue( this );
    TA_01Changed();
}

on envVar eTA_TexteS
{
    _mTA_01.TA_Texte.phys = getValue( this );
    TA_01Changed();
}

on Timer _tTSK_07
{
    if( getValue( eTTSK_07 ) <= 0)  putValue( eSendTSK_07, 0 );
    if( ( getValue( eSendEnabled ) && getValue( eSendTSK_07 )) || getValue( eDlcOnceTSK_07 ))  sendTSK_07();
}

on envVar eSendTSK_07
{
    if( getValue( eSendEnabled ) && getValue( eSendTSK_07 ))  sendTSK_07();
}

on envVar eTimeoutTSK_07
{
    cancelTimer( _tTSK_07 );
    cancelTimer( _totTSK_07 );
    if( getValue( this ))
        setTimer( _totTSK_07, ( getValue( eSendEnabled ) && getValue( eSendTSK_07 ) && ( getValue( eTOTTSK_07 ) > 0)) ? getValue( eTOTTSK_07 ) : 1 );
    else
        if( getValue( eSendEnabled ) && getValue( eSendTSK_07 ))  sendTSK_07();
}

on Timer _totTSK_07
{
    putValue( eTimeoutTSK_07, 0 );
}

on envVar eDlcOnceTSK_07
{
    if( getValue( eDlcOnceTSK_07 ) && !( getValue( eSendEnabled ) && getValue( eSendTSK_07 )))  setTimer( _tTSK_07, 1 );
}

void sendTSK_07()
{
    byte crc;
    dword bz;
    int hw;
    byte dlc;

    if( getValue( eChangeTSK_07 ))
    {
        if( getValue( eDlcOnceTSK_07 ) || getValue( eDlcWrongTSK_07 ))
        {
            putValue( eDlcOnceTSK_07, 0 );
            _mTSK_07.DLC = getValue( eDlcTSK_07 );
        }
        else
        {
            if( getValue( eTSK_07_ChngDLCEnabled ))
            {
                dlc = getValue( eTSK_07_ChngDLCData );
                if(dlc>0)
                {
                    dlc--;
                    putValue( eTSK_07_ChngDLCData, dlc );
                    _mTSK_07.DLC = getValue( eDlcTSK_07 );
                }
                else
                {
                    putValue( eTSK_07_ChngDLCData, 0 );
                    _mTSK_07.DLC = 8;
                }
            }
            else
            {
                _mTSK_07.DLC = 8;
            }
        }
    }
    else
    {
        _mTSK_07.DLC = 8;
    }
    output( _mTSK_07 );
    cancelTimer( _tTSK_07 );
    if( getValue( eTTSK_07 ) > 0)  setTimer( _tTSK_07, getValue( eTTSK_07 ) );  else  setTimer( _tTSK_07, 1 );
}

on envVar eMO_MotorlaufwarnungS
{
    _mTSK_07.MO_Motorlaufwarnung.phys = getValue( this );
}

on envVar eTSK_Fahrzeugstatus_GRAS
{
    _mTSK_07.TSK_Fahrzeugstatus_GRA.phys = getValue( this );
}

on envVar eTSK_Fahrzeugstatus_LimiterS
{
    _mTSK_07.TSK_Fahrzeugstatus_Limiter.phys = getValue( this );
}

on envVar eTSK_Limiter_AnzeigeS
{
    _mTSK_07.TSK_Limiter_Anzeige.phys = getValue( this );
}

on envVar eTSK_Limiter_FahrerinfoS
{
    _mTSK_07.TSK_Limiter_Fahrerinfo.phys = getValue( this );
}

on envVar eTSK_Status_AnzeigeS
{
    _mTSK_07.TSK_Status_Anzeige.phys = getValue( this );
}

on envVar eTSK_TexteS
{
    _mTSK_07.TSK_Texte.phys = getValue( this );
}

on envVar eTSK_Texte_PrimaeranzS
{
    _mTSK_07.TSK_Texte_Primaeranz.phys = getValue( this );
}

on envVar eTSK_WunschgeschwS
{
    float TempVal;

    TempVal = getValue( eTSK_WunschgeschwS );
    _mTSK_07.TSK_Wunschgeschw = TempVal / 0.3199;
}

// VZE_05 begin
// moved to message_VZE_05.cin
// VZE_05 end

on Timer _tWaehlhebel_05
{
    if( getValue( eTWaehlhebel_05 ) <= 0)  putValue( eSendWaehlhebel_05, 0 );
    if( ( getValue( eSendEnabled ) && getValue( eSendWaehlhebel_05 )) || getValue( eDlcOnceWaehlhebel_05 ))  sendWaehlhebel_05();
}

on envVar eSendWaehlhebel_05
{
    if( getValue( eSendEnabled ) && getValue( eSendWaehlhebel_05 ))  sendWaehlhebel_05();
}

on envVar eTimeoutWaehlhebel_05
{
    cancelTimer( _tWaehlhebel_05 );
    cancelTimer( _totWaehlhebel_05 );
    if( getValue( this ))
        setTimer( _totWaehlhebel_05, ( getValue( eSendEnabled ) && getValue( eSendWaehlhebel_05 ) && ( getValue( eTOTWaehlhebel_05 ) > 0)) ? getValue( eTOTWaehlhebel_05 ) : 1 );
    else
        if( getValue( eSendEnabled ) && getValue( eSendWaehlhebel_05 ))  sendWaehlhebel_05();
}

on Timer _totWaehlhebel_05
{
    putValue( eTimeoutWaehlhebel_05, 0 );
}

on envVar eDlcOnceWaehlhebel_05
{
    if( getValue( eDlcOnceWaehlhebel_05 ) && !( getValue( eSendEnabled ) && getValue( eSendWaehlhebel_05 )))  setTimer( _tWaehlhebel_05, 1 );
}

void sendWaehlhebel_05()
{
    if( getValue( eChangeWaehlhebel_05))
    {
        if( getValue( eDlcOnceWaehlhebel_05 ) || getValue( eDlcWrongWaehlhebel_05 ))
        {
            putValue( eDlcOnceWaehlhebel_05, 0 );
            _mWaehlhebel_05.DLC = getValue( eDlcWaehlhebel_05 );
        }
        else
        {
            _mWaehlhebel_05.DLC = 8;
        }
    }
    else
    {
        _mWaehlhebel_05.DLC = 8;
    }

    output( _mWaehlhebel_05 );
    cancelTimer( _tWaehlhebel_05 );
    if( getValue( eTWaehlhebel_05 ) > 0)  setTimer( _tWaehlhebel_05, getValue( eTWaehlhebel_05 ) );  else  setTimer( _tWaehlhebel_05, 1 );
}

on envVar eWH_Warnung_02S
{
    _mWaehlhebel_05.WH_Warnung_02.phys = getValue( this );
}

on Timer _tWIV_01
{
    if( getValue( eTWIV_01 ) <= 0)  putValue( eSendWIV_01, 0 );
    if( ( getValue( eSendEnabled ) && getValue( eSendWIV_01 )) || getValue( eDlcOnceWIV_01 ))  sendWIV_01();
}

on envVar eSendWIV_01
{
    if( getValue( eSendEnabled ) && getValue( eSendWIV_01 ))  sendWIV_01();
}

on envVar eTimeoutWIV_01
{
    cancelTimer( _tWIV_01 );
    cancelTimer( _totWIV_01 );
    if( getValue( this ))
        setTimer( _totWIV_01, ( getValue( eSendEnabled ) && getValue( eSendWIV_01 ) && ( getValue( eTOTWIV_01 ) > 0)) ? getValue( eTOTWIV_01 ) : 1 );
    else
        if( getValue( eSendEnabled ) && getValue( eSendWIV_01 ))  sendWIV_01();
}

on Timer _totWIV_01
{
    putValue( eTimeoutWIV_01, 0 );
}

on envVar eDlcOnceWIV_01
{
    if( getValue( eDlcOnceWIV_01 ) && !( getValue( eSendEnabled ) && getValue( eSendWIV_01 )))  setTimer( _tWIV_01, 1 );
}

void sendWIV_01()
{
    if( getValue( eChangeWIV_01 ))
    {
        if( getValue( eDlcOnceWIV_01 ) || getValue( eDlcWrongWIV_01 ))
        {
            putValue( eDlcOnceWIV_01, 0 );
            _mWIV_01.DLC = getValue( eDlcWIV_01 );
        }
        else
        {
            _mWIV_01.DLC = 8;
        }
    }
    else
    {
        _mWIV_01.DLC = 8;
    }

    output( _mWIV_01 );
    cancelTimer( _tWIV_01 );
    if( getValue( eTWIV_01 ) > 0)  setTimer( _tWIV_01, getValue( eTWIV_01 ) );  else  setTimer( _tWIV_01, 1 );
    _bsaiWIV_01 = 0;
    _bsiWIV_01 = 1;
    cancelTimer( _tinhWIV_01 );  setTimer( _tinhWIV_01, 200 );
}

on Timer _tinhWIV_01
{
  _bsiWIV_01 = 0;
  if( _bsaiWIV_01 && getValue( eSendEnabled ))  sendWIV_01();
}

WIV_01Changed()
{
    if( getValue( eSendEnabled ) && getValue( eSendWIV_01 ))
        if( _bsiWIV_01)
            _bsaiWIV_01 = 1;
        else
            sendWIV_01();
}

on envVar eWIV_RussindexS
{
    _mWIV_01.WIV_Russindex.phys = getValue( this );
    WIV_01Changed();
}

on envVar eWIV_t_maxS
{
    _mWIV_01.WIV_t_max.phys = getValue( this );
    WIV_01Changed();
}

on envVar eWIV_t_minS
{
    _mWIV_01.WIV_t_min.phys = getValue( this );
    WIV_01Changed();
}

on envVar eWIV_VerschleissindexS
{
    _mWIV_01.WIV_Verschleissindex.phys = getValue( this );
    WIV_01Changed();
}

on envVar eWIV_W_maxS
{
    _mWIV_01.WIV_W_max.phys = getValue( this );
    WIV_01Changed();
}

on envVar eWIV_W_minS
{
    _mWIV_01.WIV_W_min.phys = getValue( this );
    WIV_01Changed();
}

on Timer _tZentralrechner_03
{
    if( getValue( eTZentralrechner_03 ) <= 0)  putValue( eSendZentralrechner_03, 0 );
    if( ( getValue( eSendEnabled ) && getValue( eSendZentralrechner_03 )) || getValue( eDlcOnceZentralrechner_03 ))  sendZentralrechner_03();
}

on envVar eSendZentralrechner_03
{
    if( getValue( eSendEnabled ) && getValue( eSendZentralrechner_03 ))  sendZentralrechner_03();
}

on envVar eTimeoutZentralrechner_03
{
    cancelTimer( _tZentralrechner_03 );
    cancelTimer( _totZentralrechner_03 );
    if( getValue( this ))
        setTimer( _totZentralrechner_03, ( getValue( eSendEnabled ) && getValue( eSendZentralrechner_03 ) && ( getValue( eTOTZentralrechner_03 ) > 0)) ? getValue( eTOTZentralrechner_03 ) : 1 );
    else
        if( getValue( eSendEnabled ) && getValue( eSendZentralrechner_03 ))  sendZentralrechner_03();
}

on Timer _totZentralrechner_03
{
    putValue( eTimeoutZentralrechner_03, 0 );
}

on envVar eDlcOnceZentralrechner_03
{
    if( getValue( eDlcOnceZentralrechner_03 ) && !( getValue( eSendEnabled ) && getValue( eSendZentralrechner_03 )))  setTimer( _tZentralrechner_03, 1 );
}

void sendZentralrechner_03()
{
    if( getValue( eChangeZentralrechner_03))
    {
        if( getValue( eDlcOnceZentralrechner_03 ) || getValue( eDlcWrongZentralrechner_03 ))
        {
            putValue( eDlcOnceZentralrechner_03, 0 );
            _mZentralrechner_03.DLC = getValue( eDlcZentralrechner_03 );
        }
        else
        {
            _mZentralrechner_03.DLC = 8;
        }
    }
    else
    {
        _mZentralrechner_03.DLC = 8;
    }

    output( _mZentralrechner_03 );
    cancelTimer( _tZentralrechner_03 );
    if( getValue( eTZentralrechner_03 ) > 0)  setTimer( _tZentralrechner_03, getValue( eTZentralrechner_03 ) );  else  setTimer( _tZentralrechner_03, 1 );
}

Zentralrechner_03Changed()
{
}

on envVar eMMI_StartupAnimationS
{
    _mZentralrechner_03.MMI_StartupAnimation.phys = getValue( this );
}

/**
on Timer _tDEV_Kombi_SUP1
{
  if( getValue( eTDEV_Kombi_SUP1 ) <= 0)  putValue( eSendDEV_Kombi_SUP1, 0 );
  if( ( getValue( eSendEnabled ) && getValue( eSendDEV_Kombi_SUP1 )) || getValue( eDlcOnceDEV_Kombi_SUP1 ))  sendDEV_Kombi_SUP1();
}

on envVar eSendDEV_Kombi_SUP1
{
  if( getValue( eSendEnabled ) && getValue( eSendDEV_Kombi_SUP1 ))  sendDEV_Kombi_SUP1();
}

on envVar eTimeoutDEV_Kombi_SUP1
{
  cancelTimer( _tDEV_Kombi_SUP1 );
  cancelTimer( _totDEV_Kombi_SUP1 );
  if( getValue( this ))
    setTimer( _totDEV_Kombi_SUP1, ( getValue( eSendEnabled ) && getValue( eSendDEV_Kombi_SUP1 ) && ( getValue( eTOTDEV_Kombi_SUP1 ) > 0)) ? getValue( eTOTDEV_Kombi_SUP1 ) : 1 );
  else
    if( getValue( eSendEnabled ) && getValue( eSendDEV_Kombi_SUP1 ))  sendDEV_Kombi_SUP1();
}

on Timer _totDEV_Kombi_SUP1
{
  putValue( eTimeoutDEV_Kombi_SUP1, 0 );
}

on envVar eDlcOnceDEV_Kombi_SUP1
{
  if( getValue( eDlcOnceDEV_Kombi_SUP1 ) && !( getValue( eSendEnabled ) && getValue( eSendDEV_Kombi_SUP1 )))  setTimer( _tDEV_Kombi_SUP1, 1 );
}

on Timer _tDEV_Kombi_SUP2
{
  if( getValue( eTDEV_Kombi_SUP2 ) <= 0)  putValue( eSendDEV_Kombi_SUP2, 0 );
  if( ( getValue( eSendEnabled ) && getValue( eSendDEV_Kombi_SUP2 )) || getValue( eDlcOnceDEV_Kombi_SUP2 ))  sendDEV_Kombi_SUP2();
}

on envVar eSendDEV_Kombi_SUP2
{
  if( getValue( eSendEnabled ) && getValue( eSendDEV_Kombi_SUP2 ))  sendDEV_Kombi_SUP2();
}

on envVar eTimeoutDEV_Kombi_SUP2
{
  cancelTimer( _tDEV_Kombi_SUP2 );
  cancelTimer( _totDEV_Kombi_SUP2 );
  if( getValue( this ))
    setTimer( _totDEV_Kombi_SUP2, ( getValue( eSendEnabled ) && getValue( eSendDEV_Kombi_SUP2 ) && ( getValue( eTOTDEV_Kombi_SUP2 ) > 0)) ? getValue( eTOTDEV_Kombi_SUP2 ) : 1 );
  else
    if( getValue( eSendEnabled ) && getValue( eSendDEV_Kombi_SUP2 ))  sendDEV_Kombi_SUP2();
}

on Timer _totDEV_Kombi_SUP2
{
  putValue( eTimeoutDEV_Kombi_SUP2, 0 );
}

on envVar eDlcOnceDEV_Kombi_SUP2
{
  if( getValue( eDlcOnceDEV_Kombi_SUP2 ) && !( getValue( eSendEnabled ) && getValue( eSendDEV_Kombi_SUP2 )))  setTimer( _tDEV_Kombi_SUP2, 1 );
}
**/

on Timer _tOBDC_Funktionaler_Req_All
{
    if( getValue( eTOBDC_Funktionaler_Req_All ) <= 0)  putValue( eSendOBDC_Funktionaler_Req_All, 0 );
    if( ( getValue( eSendEnabled ) && getValue( eSendOBDC_Funktionaler_Req_All )) || getValue( eDlcOnceOBDC_Funktionaler_Req_All ))  sendOBDC_Funktionaler_Req_All();
}

on envVar eSendOBDC_Funktionaler_Req_All
{
  if( getValue( eSendEnabled ) && getValue( eSendOBDC_Funktionaler_Req_All ))  sendOBDC_Funktionaler_Req_All();
}

on envVar eTimeoutOBDC_Funktionaler_Req_All
{
    cancelTimer( _tOBDC_Funktionaler_Req_All );
    cancelTimer( _totOBDC_Funktionaler_Req_All );
    if( getValue( this ))
        setTimer( _totOBDC_Funktionaler_Req_All, ( getValue( eSendEnabled ) && getValue( eSendOBDC_Funktionaler_Req_All ) && ( getValue( eTOTOBDC_Funktionaler_Req_All ) > 0)) ? getValue( eTOTOBDC_Funktionaler_Req_All ) : 1 );
    else
        if( getValue( eSendEnabled ) && getValue( eSendOBDC_Funktionaler_Req_All ))  sendOBDC_Funktionaler_Req_All();
}

on Timer _totOBDC_Funktionaler_Req_All
{
    putValue( eTimeoutOBDC_Funktionaler_Req_All, 0 );
}

on envVar eDlcOnceOBDC_Funktionaler_Req_All
{
    if( getValue( eDlcOnceOBDC_Funktionaler_Req_All ) && !( getValue( eSendEnabled ) && getValue( eSendOBDC_Funktionaler_Req_All )))  setTimer( _tOBDC_Funktionaler_Req_All, 1 );
}

void sendOBDC_Funktionaler_Req_All()
{
    if( getValue( eChangeOBDC_Funktionaler_Req_All))
    {
        if( getValue( eDlcOnceOBDC_Funktionaler_Req_All ) || getValue( eDlcWrongOBDC_Funktionaler_Req_All ))
        {
            putValue( eDlcOnceOBDC_Funktionaler_Req_All, 0 );
            _mOBDC_Funktionaler_Req_All.DLC = getValue( eDlcOBDC_Funktionaler_Req_All );
        }
        else
        {
            _mOBDC_Funktionaler_Req_All.DLC = 8;
        }
    }
    else
    {
        _mOBDC_Funktionaler_Req_All.DLC = 8;
    }
    output( _mOBDC_Funktionaler_Req_All );
    cancelTimer( _tOBDC_Funktionaler_Req_All );
    if( getValue( eTOBDC_Funktionaler_Req_All ) > 0)  setTimer( _tOBDC_Funktionaler_Req_All, getValue( eTOBDC_Funktionaler_Req_All ) );  else  setTimer( _tOBDC_Funktionaler_Req_All, 1 );
}

on envVar eOBDC_Funktionaler_Req_All_DataS
{
    _mOBDC_Funktionaler_Req_All.OBDC_Funktionaler_Req_All_Data.phys = getValue( this );
}

void calculateConsumption_BMS()
{
  dword consumption;//µl/ms
  dword oldAccu;
  dword newAccu;
  //consumption = (dword)( getValue( eConsumption_BMS ) / 3.6  * getValue( eTBMS_05 ) + 0.5);
  //consumption = (dword)( getValue( eConsumption_BMS ) / 10  * ( getValue( eTBMS_05 ) + 0.5));
  consumption = (dword)( getValue( eConsumption_BMS ) * ( getValue( eTBMS_05 ) + 0.5));

  oldAccu = getValue( eBMS_VerbrauchS );
  //IssueList #124
  //newAccu = (oldAccu + consumption) & 0x7FFF;
    newAccu = (oldAccu + consumption);
  if( newAccu > 0x04FFF6)
  {
    putValue( eBMS_Verbrauch_UeberlaufS, 1 );
    newAccu = 0;
  }

  putValue( eBMS_VerbrauchS, newAccu );
}

void calculateConsumption_BMS_Recuperation()
{
  dword consumption;//µl/ms
  dword oldAccu;
  dword newAccu;
  //consumption = (dword)( getValue( eConsumption_BMS_Rekuperation ) / 3.6  * getValue( eTBMS_05 ) + 0.5);
  //consumption = (dword)( getValue( eConsumption_BMS_Rekuperation ) / 10  * ( getValue( eTBMS_05 ) + 0.5));
  consumption = (dword)( getValue( eConsumption_BMS_Rekuperation ) * ( getValue( eTBMS_05 ) + 0.5));

  oldAccu = getValue( eBMS_RekuperationS );
  //IssueList #124
  //newAccu = (oldAccu + consumption) & 0x7FFF;
    newAccu = (oldAccu + consumption);
  if( newAccu > 0x04FFF6)
  {
    putValue( eBMS_Rekuperation_UeberlaufS, 1 );
    newAccu = 0;
  }

  putValue( eBMS_RekuperationS, newAccu );
}