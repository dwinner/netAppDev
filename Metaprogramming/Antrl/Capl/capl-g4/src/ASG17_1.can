/*@!Encoding:1252*/
includes
{
    #include "..\..\..\_DLL\latest_BAP_DLL.cin"
}

variables
{
	char  dbc_path[255] = "BAP\\_DBC\\BAP_V9.04F.dbc";
	char  xml_path[255] = "BAP\\Clock_P30DF41_V2.10_ASG17_1\\asg17_1\\bapxml\\BAP_SW15_Clock_ASG1_MQB_SIM_v1.0.xml";

	//@BAPSIMGEN_VAR_SECTION_BEGIN

	/********************************************************************************/
	/*                  BapSimGen interne Teile, werden immer benoetigt                   */
	/********************************************************************************/

	/************** Ausgabe Konsolen (Traces) ***********/
	dword gBAP_Trace;
	dword gError_Trace;

	/************** Node Verwaltung ***************/
	//Power on/off
	byte gSG_PowerOnOff=0x01;     // wird mit Power_off/on gesetzt
	byte gBAP_Init=0;             // schon mal initialisiert?

	const Power_off = 0x00;
	const Power_on	= 0x01;

	mstimer TaskTimer;				//real communication timer

	/************************************************** Request Stuff **************************************/
	const Requestbuffer_lines=100;
	const BAP_buffer_size=4096;

	/************ Speichern von Requests im "Ringbuffer" ***********/
	int   gBAP_Requestbuffer_status     [Requestbuffer_lines];		            // 0: kein Eintrag, 1:pending
	dword gBAP_Request_header			[Requestbuffer_lines] [6];				// beinhaltet auch skalare Daten
	dword gBAP_Request_data             [Requestbuffer_lines] [BAP_buffer_size];// ringbuffer Eintrag fuer BAP-Request

	/**************************************************  Indication Stuff **************************************/
	// enthaelt die derzeitige Indication
	dword gBAP_Indication_header[6];	
	byte  gBAP_Indication_data[BAP_buffer_size];		

	/************** Konstanten ****************/

	//BAP Data Type 
	const Bap_void				=0;
	const Bap_uint8				=1;
	const Bap_uint16			=2;
	const Bap_uint32			=3;
	const Bap_byteSequence		=4;
	const Bap_error				=5;
	const Bap_acknowledge		=6;

	char Datatype_Text[7][20] =
	{
		"void", "uint8", "uint16", "uint32", "byteSequence", "error", "acknowledge"
	};

	//BAP request types
	const DataSetGet_REQ		 =0x00;
	const DataSet_REQ			   =0x01;
	const DataGet_REQ			   =0x02;
	const Data_REQ				   =0x03;
	const Changed_REQ			   =0x04;
	const Start_REQ				   =0x05;
	const StartResult_REQ		 =0x06;
	const AbortResult_REQ		 =0x07;
	const Processing_REQ		 =0x08;
	const Result_REQ			   =0x09;
	const DataAck_REQ        =0x0A;
	const Ack_REQ            =0x0B;
	const Invalid_REQ    		 =0x1F;      // Interne Kennzeichnung fuer einen ungueltigen Request

	//eigene Error-Definition
	const Error_REQ=0x20;

	char Requesttype_Text[33][30] =
	{
		"DataSetGet_REQ", "DataSet_REQ", "DataGet_REQ", "Data_REQ",			/* 00 .. 03 */
		"Changed_REQ", "Start_REQ", "StartResult_REQ", "AbortResult_REQ",   /* 04 .. 07 */
		"Processing_REQ", "Result_REQ", "DataAck_REQ", "Ack_REQ", 		/* 08 .. 0b */
		"Invalid_REQ", "Invalid_REQ", "Invalid_REQ", "Invalid_REQ",  		/* 0c .. 0f */
		"Invalid_REQ", "Invalid_REQ", "Invalid_REQ", "Invalid_REQ",  		/* 10 .. 13 */
		"Invalid_REQ", "Invalid_REQ", "Invalid_REQ", "Invalid_REQ",  		/* 14 .. 17 */
		"Invalid_REQ", "Invalid_REQ", "Invalid_REQ", "Invalid_REQ", 		/* 18 .. 1b */
		"Invalid_REQ", "Invalid_REQ", "Invalid_REQ", "Invalid_REQ",  		/* 1c .. 1f */
		"Error_REQ"	  														/* 20 */
	};

	//BAP indication types
	const Data_IND              = 0x00;
	const Reset_IND             = 0x01;
	const DataAck_IND           = 0x02;
	const Result_IND            = 0x03;
	const Processing_IND        = 0x04;
    const Changed_IND           = 0x05;
    const DataSetGet_IND        = 0x06;
	const DataSet_IND           = 0x07;
	const DataGet_IND           = 0x08;
	const Ack_IND               = 0x09;
	const Processing_CNF_IND 	= 0x0A;
	const Start_IND             = 0x0B;
	const StartResult_IND       = 0x0C;
	const AbortResult_IND       = 0x0D;
	const Invalid_IND           = 0x1F;      // Interne Kennzeichnung fuer eine ungueltige Indication

	//eigene Error-Definition
	const Error_IND=0x20;
	
	char Indicationtype_Text[33][30] =
	{
		"Data_IND", "Reset_IND", "DataAck_IND", "Result_IND",			 /* 00 .. 03 */
		"Processing_IND", "Changed_IND", "DataSetGet_IND", "DataSet_IND", /* 04 .. 07 */
		"DataGet_IND", "Ack_IND", "Processing_CNF_IND", "Start_REQ",	 /* 08 .. 0b */
		"StartResult_REQ", "AbortResult_REQ", "Invalid_REQ", "Invalid_REQ",  		 /* 0c .. 0f */
		"Invalid_REQ", "Invalid_REQ", "Invalid_REQ", "Invalid_REQ",  		 /* 10 .. 13 */
		"Invalid_REQ", "Invalid_REQ", "Invalid_REQ", "Invalid_REQ",  		 /* 14 .. 17 */
		"Invalid_REQ", "Invalid_REQ", "Invalid_REQ", "Invalid_REQ", 		 /* 18 .. 1b */
		"Invalid_REQ", "Invalid_REQ", "Invalid_REQ", "Invalid_REQ",  		 /* 1c .. 1f */
		"Error_REQ"	  														 /* 20 */
	};	
	
	char Acknowledgetype_Text[24][30] =
	{
		"Property_SetGet_ACK", "Array_SetGet_ACK",       "Property_Set_ACK",       "Array_Set_ACK",  		/* 00 .. 03 */
		"Method_Start_ACK",    "Method_StartResult_ACK", "Method_AbortResult_ACK", "Property_Get_ACK",	  	/* 04 .. 07 */
		"Array_Get_ACK",       "Cache_GetAll_ACK",       "Property_Ack_ACK",    "Property_Status_ACK",	   		/* 08 .. 0b */
		"Property_StatusAck_ACK",    "Property_Error_ACK",      "Array_Status_ACK",            "Array_Changed_ACK",	/* 0c .. 0f */
		"Array_Error_ACK",   "Method_Processing_ACK",            "Method_Result_ACK",            "Method_Error_ACK",  			/* 10 .. 13 */
		"Unknown_ACK",         "Unknown_ACK",            "Unknown_ACK",            "Unknown_ACK"  		  	/* 14 .. 17 */
	};

	/**************************** Global Function-ID's ******************************/
	/** TODO: already_pressed kann zwischen den Funktionen geshared werden          */

	byte already_pressed = 0;

	const FctID_GetAll									= 0x01;

	const FctID_BAP_Config								= 0x02;

	const FctID_FunctionList							= 0x03;


	const FctID_HeartBeat								= 0x04;
    
    char SGtype[4]="ASG";

	dword NODE_INDEX                =  0;
	char  NODE_NAME[100]            = "Clock";
	const LSGID                     = 17;
	char  panel_name[100]           = "ASG17_1";
	char  bapconfig_panel_name[100]    = "panel1";
	char  common_panel_name[100]    = "panel2";
	const TaskTime                  = 10;
	const heartBeatFactor                               = 5;
	 const C_ASG_17_1_0_1_ID = 1;
	 byte C_ASG_17_1_0_1GetAll_BTN_already_pressed = 0;
	 char gCheckbox1[100] = "checkbox_C_ASG_17_1_0_1";
	 char gErrField1[100] = "errfield_C_ASG_17_1_0_1";
	 byte gC_ASG_17_1_0_1_ErrCode = 1;
	 const P_ASG_17_1_0_2_ID = 2;
	 byte P_ASG_17_1_0_2Get_BTN_already_pressed = 0;
	 char gCheckbox2[100] = "checkbox_P_ASG_17_1_0_2";
	 char gErrField2[100] = "errfield_P_ASG_17_1_0_2";
	 byte gP_ASG_17_1_0_2_ErrCode = 1;
	 const P_ASG_17_1_0_3_ID = 3;
	 byte P_ASG_17_1_0_3Get_BTN_already_pressed = 0;
	 char gCheckbox3[100] = "checkbox_P_ASG_17_1_0_3";
	 char gErrField3[100] = "errfield_P_ASG_17_1_0_3";
	 byte gP_ASG_17_1_0_3_ErrCode = 1;
	 const P_ASG_17_1_0_4_ID = 4;
	 byte P_ASG_17_1_0_4Get_BTN_already_pressed = 0;
	 char gCheckbox4[100] = "checkbox_P_ASG_17_1_0_4";
	 char gErrField4[100] = "errfield_P_ASG_17_1_0_4";
	 byte gP_ASG_17_1_0_4_ErrCode = 1;
	 const P_ASG_17_1_0_13_ID = 13;
	 byte P_ASG_17_1_0_13Get_BTN_already_pressed = 0;
	 byte P_ASG_17_1_0_13SetGet_BTN_already_pressed = 0;
	 char gCheckbox13[100] = "checkbox_P_ASG_17_1_0_13";
	 char gErrField13[100] = "errfield_P_ASG_17_1_0_13";
	 byte gP_ASG_17_1_0_13_ErrCode = 1;
	 char gPanel13[100] = "panel_P_ASG_17_1_0_13";
	 const P_ASG_17_1_0_14_ID = 14;
	 byte P_ASG_17_1_0_14Get_BTN_already_pressed = 0;
	 char gCheckbox14[100] = "checkbox_P_ASG_17_1_0_14";
	 char gErrField14[100] = "errfield_P_ASG_17_1_0_14";
	 byte gP_ASG_17_1_0_14_ErrCode = 1;
	 char gPanel14[100] = "panel_P_ASG_17_1_0_14";
	 const P_ASG_17_1_0_15_ID = 15;
	 byte P_ASG_17_1_0_15Get_BTN_already_pressed = 0;
	 char gCheckbox15[100] = "checkbox_P_ASG_17_1_0_15";
	 char gErrField15[100] = "errfield_P_ASG_17_1_0_15";
	 byte gP_ASG_17_1_0_15_ErrCode = 1;
	 char gPanel15[100] = "panel_P_ASG_17_1_0_15";
	 const P_ASG_17_1_0_16_ID = 16;
	 byte P_ASG_17_1_0_16Get_BTN_already_pressed = 0;
	 byte P_ASG_17_1_0_16SetGet_BTN_already_pressed = 0;
	 char gCheckbox16[100] = "checkbox_P_ASG_17_1_0_16";
	 char gErrField16[100] = "errfield_P_ASG_17_1_0_16";
	 byte gP_ASG_17_1_0_16_ErrCode = 1;
	 char gPanel16[100] = "panel_P_ASG_17_1_0_16";
	 const P_ASG_17_1_0_17_ID = 17;
	 byte P_ASG_17_1_0_17Get_BTN_already_pressed = 0;
	 byte P_ASG_17_1_0_17SetGet_BTN_already_pressed = 0;
	 char gCheckbox17[100] = "checkbox_P_ASG_17_1_0_17";
	 char gErrField17[100] = "errfield_P_ASG_17_1_0_17";
	 byte gP_ASG_17_1_0_17_ErrCode = 1;
	 char gPanel17[100] = "panel_P_ASG_17_1_0_17";
	 const P_ASG_17_1_0_18_ID = 18;
	 byte P_ASG_17_1_0_18Get_BTN_already_pressed = 0;
	 byte P_ASG_17_1_0_18SetGet_BTN_already_pressed = 0;
	 char gCheckbox18[100] = "checkbox_P_ASG_17_1_0_18";
	 char gErrField18[100] = "errfield_P_ASG_17_1_0_18";
	 byte gP_ASG_17_1_0_18_ErrCode = 1;
	 char gPanel18[100] = "panel_P_ASG_17_1_0_18";
	 const P_ASG_17_1_0_19_ID = 19;
	 byte P_ASG_17_1_0_19Get_BTN_already_pressed = 0;
	 byte P_ASG_17_1_0_19SetGet_BTN_already_pressed = 0;
	 char gCheckbox19[100] = "checkbox_P_ASG_17_1_0_19";
	 char gErrField19[100] = "errfield_P_ASG_17_1_0_19";
	 byte gP_ASG_17_1_0_19_ErrCode = 1;
	 char gPanel19[100] = "panel_P_ASG_17_1_0_19";
	 const P_ASG_17_1_0_20_ID = 20;
	 byte P_ASG_17_1_0_20Get_BTN_already_pressed = 0;
	 byte P_ASG_17_1_0_20SetGet_BTN_already_pressed = 0;
	 char gCheckbox20[100] = "checkbox_P_ASG_17_1_0_20";
	 char gErrField20[100] = "errfield_P_ASG_17_1_0_20";
	 byte gP_ASG_17_1_0_20_ErrCode = 1;
	 char gPanel20[100] = "panel_P_ASG_17_1_0_20";
	 const P_ASG_17_1_0_21_ID = 21;
	 byte P_ASG_17_1_0_21Get_BTN_already_pressed = 0;
	 byte P_ASG_17_1_0_21SetGet_BTN_already_pressed = 0;
	 char gCheckbox21[100] = "checkbox_P_ASG_17_1_0_21";
	 char gErrField21[100] = "errfield_P_ASG_17_1_0_21";
	 byte gP_ASG_17_1_0_21_ErrCode = 1;
	 char gPanel21[100] = "panel_P_ASG_17_1_0_21";
	 const P_ASG_17_1_0_22_ID = 22;
	 byte P_ASG_17_1_0_22Get_BTN_already_pressed = 0;
	 byte P_ASG_17_1_0_22SetGet_BTN_already_pressed = 0;
	 char gCheckbox22[100] = "checkbox_P_ASG_17_1_0_22";
	 char gErrField22[100] = "errfield_P_ASG_17_1_0_22";
	 byte gP_ASG_17_1_0_22_ErrCode = 1;
	 char gPanel22[100] = "panel_P_ASG_17_1_0_22";
	 const P_ASG_17_1_0_23_ID = 23;
	 byte P_ASG_17_1_0_23Get_BTN_already_pressed = 0;
	 byte P_ASG_17_1_0_23SetGet_BTN_already_pressed = 0;
	 char gCheckbox23[100] = "checkbox_P_ASG_17_1_0_23";
	 char gErrField23[100] = "errfield_P_ASG_17_1_0_23";
	 byte gP_ASG_17_1_0_23_ErrCode = 1;
	 char gPanel23[100] = "panel_P_ASG_17_1_0_23";
	 const P_ASG_17_1_0_24_ID = 24;
	 byte P_ASG_17_1_0_24Get_BTN_already_pressed = 0;
	 byte P_ASG_17_1_0_24SetGet_BTN_already_pressed = 0;
	 char gCheckbox24[100] = "checkbox_P_ASG_17_1_0_24";
	 char gErrField24[100] = "errfield_P_ASG_17_1_0_24";
	 byte gP_ASG_17_1_0_24_ErrCode = 1;
	 char gPanel24[100] = "panel_P_ASG_17_1_0_24";
	 const P_ASG_17_1_0_25_ID = 25;
	 byte P_ASG_17_1_0_25Get_BTN_already_pressed = 0;
	 byte P_ASG_17_1_0_25SetGet_BTN_already_pressed = 0;
	 char gCheckbox25[100] = "checkbox_P_ASG_17_1_0_25";
	 char gErrField25[100] = "errfield_P_ASG_17_1_0_25";
	 byte gP_ASG_17_1_0_25_ErrCode = 1;
	 char gPanel25[100] = "panel_P_ASG_17_1_0_25";
	 const P_ASG_17_1_0_26_ID = 26;
	 byte P_ASG_17_1_0_26Get_BTN_already_pressed = 0;
	 byte P_ASG_17_1_0_26SetGet_BTN_already_pressed = 0;
	 char gCheckbox26[100] = "checkbox_P_ASG_17_1_0_26";
	 char gErrField26[100] = "errfield_P_ASG_17_1_0_26";
	 byte gP_ASG_17_1_0_26_ErrCode = 1;
	 char gPanel26[100] = "panel_P_ASG_17_1_0_26";
	 const P_ASG_17_1_0_27_ID = 27;
	 byte P_ASG_17_1_0_27Get_BTN_already_pressed = 0;
	 byte P_ASG_17_1_0_27SetGet_BTN_already_pressed = 0;
	 char gCheckbox27[100] = "checkbox_P_ASG_17_1_0_27";
	 char gErrField27[100] = "errfield_P_ASG_17_1_0_27";
	 byte gP_ASG_17_1_0_27_ErrCode = 1;
	 char gPanel27[100] = "panel_P_ASG_17_1_0_27";
	 const P_ASG_17_1_0_28_ID = 28;
	 byte P_ASG_17_1_0_28Get_BTN_already_pressed = 0;
	 byte P_ASG_17_1_0_28SetGet_BTN_already_pressed = 0;
	 char gCheckbox28[100] = "checkbox_P_ASG_17_1_0_28";
	 char gErrField28[100] = "errfield_P_ASG_17_1_0_28";
	 byte gP_ASG_17_1_0_28_ErrCode = 1;
	 char gPanel28[100] = "panel_P_ASG_17_1_0_28";
	 const P_ASG_17_1_0_29_ID = 29;
	 byte P_ASG_17_1_0_29Get_BTN_already_pressed = 0;
	 byte P_ASG_17_1_0_29SetGet_BTN_already_pressed = 0;
	 char gCheckbox29[100] = "checkbox_P_ASG_17_1_0_29";
	 char gErrField29[100] = "errfield_P_ASG_17_1_0_29";
	 byte gP_ASG_17_1_0_29_ErrCode = 1;
	 char gPanel29[100] = "panel_P_ASG_17_1_0_29";
	 const P_ASG_17_1_0_30_ID = 30;
	 byte P_ASG_17_1_0_30Get_BTN_already_pressed = 0;
	 byte P_ASG_17_1_0_30SetGet_BTN_already_pressed = 0;
	 char gCheckbox30[100] = "checkbox_P_ASG_17_1_0_30";
	 char gErrField30[100] = "errfield_P_ASG_17_1_0_30";
	 byte gP_ASG_17_1_0_30_ErrCode = 1;
	 char gPanel30[100] = "panel_P_ASG_17_1_0_30";

}

on preStart
{
	char Version[200];
	char Path[255];

	/***** Erzeugen der Ausgabeconsolen *****/	
	gBAP_Trace=writecreate("ASG17_1__Clock");		//write-window for BAP-cummunication
	writeclear(gBAP_Trace);						//clear BAP-window in write-window
	
	gError_Trace=writecreate("Error");			//error-window for BAP-cummunication
	writeclear(gError_Trace);					//clear error-window in write-window
	
	writeclear(1);								//clear CAPL-window in write-window
	
	/**** Versionsstring von DLL holen und auf Bildschirm ausgeben ***/	
	BAP160_GetVersions(Version, 200);
	writelineEx(gBAP_Trace, 0, "Versionx:%s", Version);
											
//   create Node
    NODE_INDEX = BAP160_CreateNode();
    writelineEx(gBAP_Trace, 0, "ASG %d Nodeindex:%d", LSGID, Version);
    
	/**** Laden der CANoe Datenbank *****/
	getAbsFilePath(dbc_path, Path, 255);
	writelineEx(gBAP_Trace, 0, "Load BAP_DBC-File: %s", Path);
	if(BAP150_LoadDBC(NODE_INDEX, 1, Path)  != 0)	{					//Load BAP-DBC-File		writelineEx(gError_Trace, 0, "Fehler beim Laden: %s !", Path);
	}

	/**** Laden des BAP XML Files ****/
	getAbsFilePath(xml_path, Path, 255);
	writelineEx(gBAP_Trace, 0, "Load BAP-XML-File: %s", Path);
	if (BAP160_LoadConfig(NODE_INDEX, Path) != 0) {		//load XML-File
	    writelineEx(gError_Trace, 0, "Fehler beim Laden: %s !", Path);
	}

	if (BAP160_AddCanMap(NODE_INDEX, 1, 1) != 0) {		// Mapping
		writelineEx(gError_Trace, 0, "Fehler beim Mappen!");
	}	
}

DisableFctCtrl ()
{
  	EnableControl(panel_name, common_panel_name, 0);
	EnableControl(panel_name,gErrField1,0);
	EnableControl(panel_name,gErrField2,0);
	EnableControl(panel_name,gErrField3,0);
	EnableControl(panel_name,gErrField4,0);
	EnableControl(panel_name,gErrField13,0);
	EnableControl(panel_name,gPanel13,0);
	EnableControl(panel_name,"panel_P_ASG_17_1_0_13",0);
	EnableControl(panel_name,gErrField14,0);
	EnableControl(panel_name,gPanel14,0);
	EnableControl(panel_name,"panel_P_ASG_17_1_0_14",0);
	EnableControl(panel_name,gErrField15,0);
	EnableControl(panel_name,gPanel15,0);
	EnableControl(panel_name,"panel_P_ASG_17_1_0_15",0);
	EnableControl(panel_name,gErrField16,0);
	EnableControl(panel_name,gPanel16,0);
	EnableControl(panel_name,"panel_P_ASG_17_1_0_16",0);
	EnableControl(panel_name,gErrField17,0);
	EnableControl(panel_name,gPanel17,0);
	EnableControl(panel_name,"panel_P_ASG_17_1_0_17",0);
	EnableControl(panel_name,gErrField18,0);
	EnableControl(panel_name,gPanel18,0);
	EnableControl(panel_name,"panel_P_ASG_17_1_0_18",0);
	EnableControl(panel_name,gErrField19,0);
	EnableControl(panel_name,gPanel19,0);
	EnableControl(panel_name,"panel_P_ASG_17_1_0_19",0);
	EnableControl(panel_name,gErrField20,0);
	EnableControl(panel_name,gPanel20,0);
	EnableControl(panel_name,"panel_P_ASG_17_1_0_20",0);
	EnableControl(panel_name,gErrField21,0);
	EnableControl(panel_name,gPanel21,0);
	EnableControl(panel_name,"panel_P_ASG_17_1_0_21",0);
	EnableControl(panel_name,gErrField22,0);
	EnableControl(panel_name,gPanel22,0);
	EnableControl(panel_name,"panel_P_ASG_17_1_0_22",0);
	EnableControl(panel_name,gErrField23,0);
	EnableControl(panel_name,gPanel23,0);
	EnableControl(panel_name,"panel_P_ASG_17_1_0_23",0);
	EnableControl(panel_name,gErrField24,0);
	EnableControl(panel_name,gPanel24,0);
	EnableControl(panel_name,"panel_P_ASG_17_1_0_24",0);
	EnableControl(panel_name,gErrField25,0);
	EnableControl(panel_name,gPanel25,0);
	EnableControl(panel_name,"panel_P_ASG_17_1_0_25",0);
	EnableControl(panel_name,gErrField26,0);
	EnableControl(panel_name,gPanel26,0);
	EnableControl(panel_name,"panel_P_ASG_17_1_0_26",0);
	EnableControl(panel_name,gErrField27,0);
	EnableControl(panel_name,gPanel27,0);
	EnableControl(panel_name,"panel_P_ASG_17_1_0_27",0);
	EnableControl(panel_name,gErrField28,0);
	EnableControl(panel_name,gPanel28,0);
	EnableControl(panel_name,"panel_P_ASG_17_1_0_28",0);
	EnableControl(panel_name,gErrField29,0);
	EnableControl(panel_name,gPanel29,0);
	EnableControl(panel_name,"panel_P_ASG_17_1_0_29",0);
	EnableControl(panel_name,gErrField30,0);
	EnableControl(panel_name,gPanel30,0);
	EnableControl(panel_name,"panel_P_ASG_17_1_0_30",0);

}

EnableFctCtrl ()
{
  	EnableControl(panel_name, common_panel_name, 1);
		 EnableControl(panel_name,gPanel13,1);
		 EnableControl(panel_name,gErrField13,1);
		 EnableControl(panel_name,gPanel14,1);
		 EnableControl(panel_name,gErrField14,1);
		 EnableControl(panel_name,gPanel15,1);
		 EnableControl(panel_name,gErrField15,1);
		 EnableControl(panel_name,gPanel16,1);
		 EnableControl(panel_name,gErrField16,1);
		 EnableControl(panel_name,gPanel17,1);
		 EnableControl(panel_name,gErrField17,1);
		 EnableControl(panel_name,gPanel18,1);
		 EnableControl(panel_name,gErrField18,1);
		 EnableControl(panel_name,gPanel19,1);
		 EnableControl(panel_name,gErrField19,1);
		 EnableControl(panel_name,gPanel20,1);
		 EnableControl(panel_name,gErrField20,1);
		 EnableControl(panel_name,gPanel21,1);
		 EnableControl(panel_name,gErrField21,1);
		 EnableControl(panel_name,gPanel22,1);
		 EnableControl(panel_name,gErrField22,1);
		 EnableControl(panel_name,gPanel23,1);
		 EnableControl(panel_name,gErrField23,1);
		 EnableControl(panel_name,gPanel24,1);
		 EnableControl(panel_name,gErrField24,1);
		 EnableControl(panel_name,gPanel25,1);
		 EnableControl(panel_name,gErrField25,1);
		 EnableControl(panel_name,gPanel26,1);
		 EnableControl(panel_name,gErrField26,1);
		 EnableControl(panel_name,gPanel27,1);
		 EnableControl(panel_name,gErrField27,1);
		 EnableControl(panel_name,gPanel28,1);
		 EnableControl(panel_name,gErrField28,1);
		 EnableControl(panel_name,gPanel29,1);
		 EnableControl(panel_name,gErrField29,1);
		 EnableControl(panel_name,gPanel30,1);
		 EnableControl(panel_name,gErrField30,1);

}

EnableConfigCtrl ()
{
  	if(getValue(C_ASG_17_1_0_1_FctLstItemEn))
	{
		setControlForeColor(panel_name, gCheckbox1, MakeRGB(0,240,0));
	}
	else
	{
		setControlForeColor(panel_name, gCheckbox1, MakeRGB(250,0,0));
	}
	if(getValue(P_ASG_17_1_0_2_FctLstItemEn))
	{
		setControlForeColor(panel_name, gCheckbox2, MakeRGB(0,240,0));
	}
	else
	{
		setControlForeColor(panel_name, gCheckbox2, MakeRGB(250,0,0));
	}
	if(getValue(P_ASG_17_1_0_3_FctLstItemEn))
	{
		setControlForeColor(panel_name, gCheckbox3, MakeRGB(0,240,0));
	}
	else
	{
		setControlForeColor(panel_name, gCheckbox3, MakeRGB(250,0,0));
	}
	EnableControl(panel_name, "panel_P_ASG_17_1_0_4", 1);
	if(getValue(P_ASG_17_1_0_4_FctLstItemEn))
	{
		setControlForeColor(panel_name, gCheckbox4, MakeRGB(0,240,0));
	}
	else
	{
		setControlForeColor(panel_name, gCheckbox4, MakeRGB(250,0,0));
	}
	if(getValue(P_ASG_17_1_0_13_FctLstItemEn))
	{
		EnableControl(panel_name, "panel_P_ASG_17_1_0_13",1);
		EnableControl(panel_name,"errfield_P_ASG_17_1_0_13",1);
		setControlForeColor(panel_name, gCheckbox13, MakeRGB(0,240,0));
	}
	else
	{
		EnableControl(panel_name, "panel_P_ASG_17_1_0_13",0);
		EnableControl(panel_name,"errfield_P_ASG_17_1_0_13",0);
		setControlForeColor(panel_name, gCheckbox13, MakeRGB(250,0,0));
	}
	if(getValue(P_ASG_17_1_0_14_FctLstItemEn))
	{
		EnableControl(panel_name, "panel_P_ASG_17_1_0_14",1);
		EnableControl(panel_name,"errfield_P_ASG_17_1_0_14",1);
		setControlForeColor(panel_name, gCheckbox14, MakeRGB(0,240,0));
	}
	else
	{
		EnableControl(panel_name, "panel_P_ASG_17_1_0_14",0);
		EnableControl(panel_name,"errfield_P_ASG_17_1_0_14",0);
		setControlForeColor(panel_name, gCheckbox14, MakeRGB(250,0,0));
	}
	if(getValue(P_ASG_17_1_0_15_FctLstItemEn))
	{
		EnableControl(panel_name, "panel_P_ASG_17_1_0_15",1);
		EnableControl(panel_name,"errfield_P_ASG_17_1_0_15",1);
		setControlForeColor(panel_name, gCheckbox15, MakeRGB(0,240,0));
	}
	else
	{
		EnableControl(panel_name, "panel_P_ASG_17_1_0_15",0);
		EnableControl(panel_name,"errfield_P_ASG_17_1_0_15",0);
		setControlForeColor(panel_name, gCheckbox15, MakeRGB(250,0,0));
	}
	if(getValue(P_ASG_17_1_0_16_FctLstItemEn))
	{
		EnableControl(panel_name, "panel_P_ASG_17_1_0_16",1);
		EnableControl(panel_name,"errfield_P_ASG_17_1_0_16",1);
		setControlForeColor(panel_name, gCheckbox16, MakeRGB(0,240,0));
	}
	else
	{
		EnableControl(panel_name, "panel_P_ASG_17_1_0_16",0);
		EnableControl(panel_name,"errfield_P_ASG_17_1_0_16",0);
		setControlForeColor(panel_name, gCheckbox16, MakeRGB(250,0,0));
	}
	if(getValue(P_ASG_17_1_0_17_FctLstItemEn))
	{
		EnableControl(panel_name, "panel_P_ASG_17_1_0_17",1);
		EnableControl(panel_name,"errfield_P_ASG_17_1_0_17",1);
		setControlForeColor(panel_name, gCheckbox17, MakeRGB(0,240,0));
	}
	else
	{
		EnableControl(panel_name, "panel_P_ASG_17_1_0_17",0);
		EnableControl(panel_name,"errfield_P_ASG_17_1_0_17",0);
		setControlForeColor(panel_name, gCheckbox17, MakeRGB(250,0,0));
	}
	if(getValue(P_ASG_17_1_0_18_FctLstItemEn))
	{
		EnableControl(panel_name, "panel_P_ASG_17_1_0_18",1);
		EnableControl(panel_name,"errfield_P_ASG_17_1_0_18",1);
		setControlForeColor(panel_name, gCheckbox18, MakeRGB(0,240,0));
	}
	else
	{
		EnableControl(panel_name, "panel_P_ASG_17_1_0_18",0);
		EnableControl(panel_name,"errfield_P_ASG_17_1_0_18",0);
		setControlForeColor(panel_name, gCheckbox18, MakeRGB(250,0,0));
	}
	if(getValue(P_ASG_17_1_0_19_FctLstItemEn))
	{
		EnableControl(panel_name, "panel_P_ASG_17_1_0_19",1);
		EnableControl(panel_name,"errfield_P_ASG_17_1_0_19",1);
		setControlForeColor(panel_name, gCheckbox19, MakeRGB(0,240,0));
	}
	else
	{
		EnableControl(panel_name, "panel_P_ASG_17_1_0_19",0);
		EnableControl(panel_name,"errfield_P_ASG_17_1_0_19",0);
		setControlForeColor(panel_name, gCheckbox19, MakeRGB(250,0,0));
	}
	if(getValue(P_ASG_17_1_0_20_FctLstItemEn))
	{
		EnableControl(panel_name, "panel_P_ASG_17_1_0_20",1);
		EnableControl(panel_name,"errfield_P_ASG_17_1_0_20",1);
		setControlForeColor(panel_name, gCheckbox20, MakeRGB(0,240,0));
	}
	else
	{
		EnableControl(panel_name, "panel_P_ASG_17_1_0_20",0);
		EnableControl(panel_name,"errfield_P_ASG_17_1_0_20",0);
		setControlForeColor(panel_name, gCheckbox20, MakeRGB(250,0,0));
	}
	if(getValue(P_ASG_17_1_0_21_FctLstItemEn))
	{
		EnableControl(panel_name, "panel_P_ASG_17_1_0_21",1);
		EnableControl(panel_name,"errfield_P_ASG_17_1_0_21",1);
		setControlForeColor(panel_name, gCheckbox21, MakeRGB(0,240,0));
	}
	else
	{
		EnableControl(panel_name, "panel_P_ASG_17_1_0_21",0);
		EnableControl(panel_name,"errfield_P_ASG_17_1_0_21",0);
		setControlForeColor(panel_name, gCheckbox21, MakeRGB(250,0,0));
	}
	if(getValue(P_ASG_17_1_0_22_FctLstItemEn))
	{
		EnableControl(panel_name, "panel_P_ASG_17_1_0_22",1);
		EnableControl(panel_name,"errfield_P_ASG_17_1_0_22",1);
		setControlForeColor(panel_name, gCheckbox22, MakeRGB(0,240,0));
	}
	else
	{
		EnableControl(panel_name, "panel_P_ASG_17_1_0_22",0);
		EnableControl(panel_name,"errfield_P_ASG_17_1_0_22",0);
		setControlForeColor(panel_name, gCheckbox22, MakeRGB(250,0,0));
	}
	if(getValue(P_ASG_17_1_0_23_FctLstItemEn))
	{
		EnableControl(panel_name, "panel_P_ASG_17_1_0_23",1);
		EnableControl(panel_name,"errfield_P_ASG_17_1_0_23",1);
		setControlForeColor(panel_name, gCheckbox23, MakeRGB(0,240,0));
	}
	else
	{
		EnableControl(panel_name, "panel_P_ASG_17_1_0_23",0);
		EnableControl(panel_name,"errfield_P_ASG_17_1_0_23",0);
		setControlForeColor(panel_name, gCheckbox23, MakeRGB(250,0,0));
	}
	if(getValue(P_ASG_17_1_0_24_FctLstItemEn))
	{
		EnableControl(panel_name, "panel_P_ASG_17_1_0_24",1);
		EnableControl(panel_name,"errfield_P_ASG_17_1_0_24",1);
		setControlForeColor(panel_name, gCheckbox24, MakeRGB(0,240,0));
	}
	else
	{
		EnableControl(panel_name, "panel_P_ASG_17_1_0_24",0);
		EnableControl(panel_name,"errfield_P_ASG_17_1_0_24",0);
		setControlForeColor(panel_name, gCheckbox24, MakeRGB(250,0,0));
	}
	if(getValue(P_ASG_17_1_0_25_FctLstItemEn))
	{
		EnableControl(panel_name, "panel_P_ASG_17_1_0_25",1);
		EnableControl(panel_name,"errfield_P_ASG_17_1_0_25",1);
		setControlForeColor(panel_name, gCheckbox25, MakeRGB(0,240,0));
	}
	else
	{
		EnableControl(panel_name, "panel_P_ASG_17_1_0_25",0);
		EnableControl(panel_name,"errfield_P_ASG_17_1_0_25",0);
		setControlForeColor(panel_name, gCheckbox25, MakeRGB(250,0,0));
	}
	if(getValue(P_ASG_17_1_0_26_FctLstItemEn))
	{
		EnableControl(panel_name, "panel_P_ASG_17_1_0_26",1);
		EnableControl(panel_name,"errfield_P_ASG_17_1_0_26",1);
		setControlForeColor(panel_name, gCheckbox26, MakeRGB(0,240,0));
	}
	else
	{
		EnableControl(panel_name, "panel_P_ASG_17_1_0_26",0);
		EnableControl(panel_name,"errfield_P_ASG_17_1_0_26",0);
		setControlForeColor(panel_name, gCheckbox26, MakeRGB(250,0,0));
	}
	if(getValue(P_ASG_17_1_0_27_FctLstItemEn))
	{
		EnableControl(panel_name, "panel_P_ASG_17_1_0_27",1);
		EnableControl(panel_name,"errfield_P_ASG_17_1_0_27",1);
		setControlForeColor(panel_name, gCheckbox27, MakeRGB(0,240,0));
	}
	else
	{
		EnableControl(panel_name, "panel_P_ASG_17_1_0_27",0);
		EnableControl(panel_name,"errfield_P_ASG_17_1_0_27",0);
		setControlForeColor(panel_name, gCheckbox27, MakeRGB(250,0,0));
	}
	if(getValue(P_ASG_17_1_0_28_FctLstItemEn))
	{
		EnableControl(panel_name, "panel_P_ASG_17_1_0_28",1);
		EnableControl(panel_name,"errfield_P_ASG_17_1_0_28",1);
		setControlForeColor(panel_name, gCheckbox28, MakeRGB(0,240,0));
	}
	else
	{
		EnableControl(panel_name, "panel_P_ASG_17_1_0_28",0);
		EnableControl(panel_name,"errfield_P_ASG_17_1_0_28",0);
		setControlForeColor(panel_name, gCheckbox28, MakeRGB(250,0,0));
	}
	if(getValue(P_ASG_17_1_0_29_FctLstItemEn))
	{
		EnableControl(panel_name, "panel_P_ASG_17_1_0_29",1);
		EnableControl(panel_name,"errfield_P_ASG_17_1_0_29",1);
		setControlForeColor(panel_name, gCheckbox29, MakeRGB(0,240,0));
	}
	else
	{
		EnableControl(panel_name, "panel_P_ASG_17_1_0_29",0);
		EnableControl(panel_name,"errfield_P_ASG_17_1_0_29",0);
		setControlForeColor(panel_name, gCheckbox29, MakeRGB(250,0,0));
	}
	if(getValue(P_ASG_17_1_0_30_FctLstItemEn))
	{
		EnableControl(panel_name, "panel_P_ASG_17_1_0_30",1);
		EnableControl(panel_name,"errfield_P_ASG_17_1_0_30",1);
		setControlForeColor(panel_name, gCheckbox30, MakeRGB(0,240,0));
	}
	else
	{
		EnableControl(panel_name, "panel_P_ASG_17_1_0_30",0);
		EnableControl(panel_name,"errfield_P_ASG_17_1_0_30",0);
		setControlForeColor(panel_name, gCheckbox30, MakeRGB(250,0,0));
	}

}

DisableReservedFld ()
{
  	EnableControl(panel_name,"P_ASG_17_1_0_20_2_reserved",0);
	EnableControl(panel_name,"P_ASG_17_1_0_21_7_reserved",0);
	EnableControl(panel_name,"P_ASG_17_1_0_22_7_reserved",0);
	EnableControl(panel_name,"P_ASG_17_1_0_23_7_reserved",0);
	EnableControl(panel_name,"P_ASG_17_1_0_27_7_reserved",0);
	EnableControl(panel_name,"P_ASG_17_1_0_27_8_reserved",0);
	EnableControl(panel_name,"P_ASG_17_1_0_28_7_reserved",0);
	EnableControl(panel_name,"P_ASG_17_1_0_28_8_reserved",0);
	EnableControl(panel_name,"P_ASG_17_1_0_29_7_reserved",0);
	EnableControl(panel_name,"P_ASG_17_1_0_29_8_reserved",0);
	EnableControl(panel_name,"P_ASG_17_1_0_30_7_reserved",0);
	EnableControl(panel_name,"P_ASG_17_1_0_30_8_reserved",0);

}

resetErrfieldColor()
{
  	setControlBackColor(panel_name, "errfield_C_ASG_17_1_0_1", MakeRGB(255,255,255));
	setControlBackColor(panel_name, "errfield_P_ASG_17_1_0_2", MakeRGB(255,255,255));
	setControlBackColor(panel_name, "errfield_P_ASG_17_1_0_3", MakeRGB(255,255,255));
	setControlBackColor(panel_name, "errfield_P_ASG_17_1_0_4", MakeRGB(255,255,255));
	setControlBackColor(panel_name, "errfield_P_ASG_17_1_0_13", MakeRGB(255,255,255));
	setControlBackColor(panel_name, "errfield_P_ASG_17_1_0_14", MakeRGB(255,255,255));
	setControlBackColor(panel_name, "errfield_P_ASG_17_1_0_15", MakeRGB(255,255,255));
	setControlBackColor(panel_name, "errfield_P_ASG_17_1_0_16", MakeRGB(255,255,255));
	setControlBackColor(panel_name, "errfield_P_ASG_17_1_0_17", MakeRGB(255,255,255));
	setControlBackColor(panel_name, "errfield_P_ASG_17_1_0_18", MakeRGB(255,255,255));
	setControlBackColor(panel_name, "errfield_P_ASG_17_1_0_19", MakeRGB(255,255,255));
	setControlBackColor(panel_name, "errfield_P_ASG_17_1_0_20", MakeRGB(255,255,255));
	setControlBackColor(panel_name, "errfield_P_ASG_17_1_0_21", MakeRGB(255,255,255));
	setControlBackColor(panel_name, "errfield_P_ASG_17_1_0_22", MakeRGB(255,255,255));
	setControlBackColor(panel_name, "errfield_P_ASG_17_1_0_23", MakeRGB(255,255,255));
	setControlBackColor(panel_name, "errfield_P_ASG_17_1_0_24", MakeRGB(255,255,255));
	setControlBackColor(panel_name, "errfield_P_ASG_17_1_0_25", MakeRGB(255,255,255));
	setControlBackColor(panel_name, "errfield_P_ASG_17_1_0_26", MakeRGB(255,255,255));
	setControlBackColor(panel_name, "errfield_P_ASG_17_1_0_27", MakeRGB(255,255,255));
	setControlBackColor(panel_name, "errfield_P_ASG_17_1_0_28", MakeRGB(255,255,255));
	setControlBackColor(panel_name, "errfield_P_ASG_17_1_0_29", MakeRGB(255,255,255));
	setControlBackColor(panel_name, "errfield_P_ASG_17_1_0_30", MakeRGB(255,255,255));

}

CANoe_Shutdown ()
{
	// Timer 
	canceltimer(TaskTimer);		//cancel real CAN-communication timer

	// Ruecksetzen der Hintergrundfarbe der Error-Felder
	resetErrfieldColor();
	// Deaktivierung aller Panel Elemente 
	DisableFctCtrl();
	EnableControl(panel_name, bapconfig_panel_name, 0); 
	EnableConfigCtrl();

}

on timer TaskTimer
{

	/*** Aufruf des BAP Task in DLL fuer NODE_INDEX ***/
	BAP160_Task(NODE_INDEX);	

	/*** Pollen ueber die anstehenden Indications (Lesen aus DLL, Auslesen eines Puffers der DLL) ***/
	BAP_DLL_Indication();	
	
	/*** Pollen ueber die anstehenden Requests (Schreiben in DLL, dort werden evt. Sendeauftraege gesetzt) ***/
	BAP_DLL_Request();
	
	/*** Abarbeiten der ausstehenden Sendeauftraege innerhalb der BAP DLL und Versenden ueber CANoe ***/
    if (getValue(eSendEnabled))
    {
	BAP_CAN_TX_Request();
    }

	/*** Der Empfang von CAN Daten geschieht ueber on message CAN message Mechanismen ***/
	// keine Funktion hier

	/*** Retriggern des Timers mit 10 ms ***/
	setTimer(TaskTimer, TaskTime); // @TODO bei anderer Taskzeit muss hier modifiziert werden
}

BAP_DLL_Indication()	//function to get received BAP-data from DLL (at BAL-interface)
{
	int i, length, datalength, temp;
	byte Indication_data[BAP_buffer_size];		// indication data from DLL
	dword Indication_header[6];					// indication header from DLL
	byte BAP_data_type;

	//init local variables
	length=0;
	datalength=0;
	temp=0;
	BAP_data_type=0;

	for(i=0;i<6;i++)
		Indication_header[i]=0;

	for(i=0;i<BAP_buffer_size;i++)
		Indication_data[i]=0;

	// BAP-Stack needs this information for successful BAP160_GetIndication 
	Indication_header[4]=BAP_buffer_size;

	while (BAP160_GetInd(NODE_INDEX, Indication_header, Indication_data) == 0)
	{		
		//read header and write in global variable
		for (i = 0; i < 6; i++) {
			gBAP_Indication_header[i]=Indication_header[i];	
		}

		// nur Bytesequneces haben Datenanteil
		if (gBAP_Indication_header[3] == Bap_byteSequence)
		{
			for (i = 0; i < BAP_buffer_size; i++) {
				gBAP_Indication_data[i]=Indication_data[i];	
			}
		}	
		// Verarbeiten der Indication
		Process_Current_Indication();

		// Vorbereiten fuer naechsten Durchlauf 
		Indication_header[4]=BAP_buffer_size;
	} 
}

ChangeConfig(long paramIndex,long config[])
{

        byte temp ;
        temp = BAP160_ChangeConfig(NODE_INDEX, paramIndex, config);
        if(temp == 0)
            writelineEx(gBAP_Trace, 0, "BAP160_ChangeConfig for %s succesful (LSG %d, NODE_INDEX %d)", NODE_NAME, LSGID, NODE_INDEX);
        else
            writelineEx(gError_Trace, 0, "BAP160_ChangeConfig error 0x%X for %s (LSG %d, NODE_INDEX %d)", temp, NODE_NAME, LSGID, NODE_INDEX);        
}

PrintIndicationError(char reason[])
{
	writelineEx(gError_Trace, 0, "%s - %s lsgId:%d fctid:%d indType:%s dataType:%s",
		reason, SGtype, gBAP_Indication_header[0], gBAP_Indication_header[1], Indicationtype_Text[gBAP_Indication_header[2]], Datatype_Text[gBAP_Indication_header[3]]);
}

BapOnOff(byte _on)
{
    int length, temp;

    /***** Einschalten ******/
    if(_on==1){
        // soll der BAP Stack wieder initlialisiert werden?                                 
        if(gBAP_Init==0){
            gBAP_Init=1;
            temp=BAP160_Init(NODE_INDEX, LSGID);
            if(temp==0)
                writelineEx(gBAP_Trace, 0, "BAP_Init for %s succesful (LSG %d, NODE_INDEX %d)", NODE_NAME, LSGID, NODE_INDEX);
            else
                writelineEx(gError_Trace, 0, "BAP_Init error 0x%X for %s (LSG %d, NODE_INDEX %d)", temp, NODE_NAME, LSGID, NODE_INDEX);         
        }

        // Initialisierung aller Variablen
        Initialize_Variables();                     

        // Aktivierung aller Panelelemente
		//EnableFctCtrl();
		initInvalidFields();
		EnableControl(panel_name, common_panel_name, 1);
		EnableControl(panel_name, bapconfig_panel_name, 1); 
		DisableReservedFld();

        //BAP-Shutdown
        temp = BAP160_Shutdown(NODE_INDEX, LSGID);
        if(temp==0)
            writelineEx(gBAP_Trace, 0, "BAP_Shutdown for %s succesful (LSG %d, NODE_INDEX %d)", NODE_NAME, LSGID, NODE_INDEX);
        else
            writelineEx(gError_Trace, 0, "BAP_Shutdown error 0x%X for %s (LSG %d, NODE_INDEX %d)", temp, NODE_NAME, LSGID, NODE_INDEX); 

        //BAP-Start
        temp = BAP160_Start(NODE_INDEX, LSGID);             
        if(temp == 0)
            writelineEx(gBAP_Trace, 0, "BAP_Start for %s succesful (LSG %d, NODE_INDEX %d)", NODE_NAME, LSGID, NODE_INDEX);
        else
            writelineEx(gError_Trace, 0, "BAP_Start error 0x%X for %s (LSG %d, NODE_INDEX %d)", temp, NODE_NAME, LSGID, NODE_INDEX);        
    
        // setze den Timer fuer den zyklischen Aufruf des CANoe-"Tasks"
        setTimer(TaskTimer, 10);                
    
        //  BAPFsg_ProcessDebug(NODE_INDEX,DEBUG_CAN_CHANNEL, DEBUG_ID, LSGID, DEBUG_SWITCH_ON);    
    }
    else{ /***** Ausschalten ****/
        
        BAP160_Shutdown(NODE_INDEX,LSGID);
        
        CANoe_Shutdown();
    }

}

Initialize_Variables()	//initialize/reset all global variables
{
	int i;
	byte  Init_data[BAP_buffer_size];	// InitSend data for DLL

	/**** Request Buffer Geschichten initialisieren ****/
	for (i = 0; i < Requestbuffer_lines; i++)
	{
		gBAP_Requestbuffer_status[i] = 0;
	}
	for (i = 0; i < BAP_buffer_size; i++)
	{
		Init_data[i] = 0;
	}
	
	/* Wert im Eingabefeld initialisieren*/
	putValue(P_ASG_17_1_0_13, 0);
	getValue(P_ASG_17_1_0_16,Init_data);
	putValue(P_ASG_17_1_0_16,Init_data, 3);
	getValue(P_ASG_17_1_0_17,Init_data);
	putValue(P_ASG_17_1_0_17,Init_data, 3);
	putValue(P_ASG_17_1_0_18, 0);
	putValue(P_ASG_17_1_0_19, 0);
	getValue(P_ASG_17_1_0_20,Init_data);
	putValue(P_ASG_17_1_0_20,Init_data, 2);
	getValue(P_ASG_17_1_0_21,Init_data);
	putValue(P_ASG_17_1_0_21,Init_data, 6);
	getValue(P_ASG_17_1_0_22,Init_data);
	putValue(P_ASG_17_1_0_22,Init_data, 6);
	getValue(P_ASG_17_1_0_23,Init_data);
	putValue(P_ASG_17_1_0_23,Init_data, 6);
	getValue(P_ASG_17_1_0_24,Init_data);
	putValue(P_ASG_17_1_0_24,Init_data, 6);
	getValue(P_ASG_17_1_0_25,Init_data);
	putValue(P_ASG_17_1_0_25,Init_data, 6);
	getValue(P_ASG_17_1_0_26,Init_data);
	putValue(P_ASG_17_1_0_26,Init_data, 6);
	getValue(P_ASG_17_1_0_27,Init_data);
	putValue(P_ASG_17_1_0_27,Init_data, 7);
	getValue(P_ASG_17_1_0_28,Init_data);
	putValue(P_ASG_17_1_0_28,Init_data, 7);
	getValue(P_ASG_17_1_0_29,Init_data);
	putValue(P_ASG_17_1_0_29,Init_data, 7);
	getValue(P_ASG_17_1_0_30,Init_data);
	putValue(P_ASG_17_1_0_30,Init_data, 7);
	/* Farbe setzen*/
	putValue(C_ASG_17_1_0_1_State,"");
	setControlBackColor(panel_name, "errfield_C_ASG_17_1_0_1_State", MakeRGB(255,255,255));

}

initInvalidFields()	//initialize/reset all global variables
{
	    setControlBackColor(panel_name, "panel1_edit", MakeRGB(220,220,220));
    setControlBackColor(panel_name, "panel_P_ASG_17_1_0_4", MakeRGB(220,220,220));
    setControlBackColor(panel_name, "panel_P_ASG_17_1_0_13", MakeRGB(220,220,220));
    setControlBackColor(panel_name, "panel_P_ASG_17_1_0_14", MakeRGB(220,220,220));
    setControlBackColor(panel_name, "panel_P_ASG_17_1_0_15", MakeRGB(220,220,220));
    setControlBackColor(panel_name, "panel_P_ASG_17_1_0_16", MakeRGB(220,220,220));
    setControlBackColor(panel_name, "panel_P_ASG_17_1_0_17", MakeRGB(220,220,220));
    setControlBackColor(panel_name, "panel_P_ASG_17_1_0_18", MakeRGB(220,220,220));
    setControlBackColor(panel_name, "panel_P_ASG_17_1_0_19", MakeRGB(220,220,220));
    setControlBackColor(panel_name, "panel_P_ASG_17_1_0_20", MakeRGB(220,220,220));
    setControlBackColor(panel_name, "panel_P_ASG_17_1_0_21", MakeRGB(220,220,220));
    setControlBackColor(panel_name, "panel_P_ASG_17_1_0_22", MakeRGB(220,220,220));
    setControlBackColor(panel_name, "panel_P_ASG_17_1_0_23", MakeRGB(220,220,220));
    setControlBackColor(panel_name, "panel_P_ASG_17_1_0_24", MakeRGB(220,220,220));
    setControlBackColor(panel_name, "panel_P_ASG_17_1_0_25", MakeRGB(220,220,220));
    setControlBackColor(panel_name, "panel_P_ASG_17_1_0_26", MakeRGB(220,220,220));
    setControlBackColor(panel_name, "panel_P_ASG_17_1_0_27", MakeRGB(220,220,220));
    setControlBackColor(panel_name, "panel_P_ASG_17_1_0_28", MakeRGB(220,220,220));
    setControlBackColor(panel_name, "panel_P_ASG_17_1_0_29", MakeRGB(220,220,220));
    setControlBackColor(panel_name, "panel_P_ASG_17_1_0_30", MakeRGB(220,220,220));

}

on start
{
	// noch nicht eingeschaltet
	gSG_PowerOnOff=0;
	// noch nicht initialisiert
	gBAP_Init=0;
	// open the panel, nur fuer CANoe-Version >= 5.1 erlaubt
	//openPanel(panel_name);
	// deaktiviere alle aktiven Panel Elemente, ausser AN/AUSS
    CANoe_Shutdown();
    // ungueltige Felder initialisieren
    initInvalidFields();
}

BAP_CAN_TX_Request()	//Function to send BAP-data over CAN
{
   int i;
   byte TX_Data[8];				// CAN-data
   dword TX_Header[3];			// CAN-header
   message 0x100 TX_Message;	// dummy-message, Adresse wird noch modifiziert
   
   TX_Header[2] = 8; // max-Length of TX_Data

	// Pollen ueber die Queue, die von der DLL zur Verfuegung gestellt wird
	// Diese Daten muessen ueber den CAN Bus gesendet werden
   while (BAP160_CAN_GetTxDat(NODE_INDEX,TX_Header,TX_Data) == 0) {	
      TX_Message.CAN = TX_Header[0]; 		//CAN channel
      TX_Message.ID =TX_Header[1]; 			//Can ID
      TX_Message.DLC = TX_Header[2]; 		// received length
      for (i=0; i<TX_Message.DLC; i++) {	//CAN data-bytes
	    TX_Message.byte(i) = TX_Data[i];
      }
      output(TX_Message);					//send CAN message
      //Versions Output
      if(TX_Data[0] == 0x40 && TX_Data[1] == 0x00 && TX_Header[2] == 4)
      {
        writelineEx(gBAP_Trace, 0,"Major Version: %i, Minor Version: %i", TX_Data[2], TX_Data[3]);
      }       
      TX_Header[2] = 8; // max-Length of TX_Data
   } 
}

ringbuffer_write (byte lsgID, byte fctID, byte request, byte dataType, word length, dword singleData, byte data[])
{
	int bufferline, i;

	bufferline = getNextWriteIndex();	//get next free position in ring-buffer

	if (bufferline == -1) 
	{
		writelineEx(gError_Trace, 0, "Crititcal Error: No free buffer found!");
		return;
	}
		
	gBAP_Request_header[bufferline][0] = lsgID;	// LSG
	gBAP_Request_header[bufferline][1] = fctID;	// FCT
	gBAP_Request_header[bufferline][3] = dataType; // dataType

    //writelineEx(gBAP_Trace, 0, "Write request in buffer ASG NODEINDEX:%d lsgid:%d fctid:%d requesttype:%d datatype:%d length:%d", 
    //        NODE_INDEX,lsgID,fctID,request,dataType,length);
	switch (dataType)
	{
		case Bap_void:
			gBAP_Request_header[bufferline][2] = request;	// request
			gBAP_Request_header[bufferline][4] = 0;	// length
				// Void
			// @TODO?		
			break;
		case Bap_uint8:
			gBAP_Request_header[bufferline][2] = request;		// request
			gBAP_Request_header[bufferline][5] = singleData;	// Daten		
			break;
		case Bap_uint16:
			gBAP_Request_header[bufferline][2] = request;		// request
			gBAP_Request_header[bufferline][5] = singleData;	// Daten
			break;			
		case Bap_uint32:
			gBAP_Request_header[bufferline][2] = request;		// request
			gBAP_Request_header[bufferline][5] = singleData;	// Daten		
			break;	
		case Bap_byteSequence:
			gBAP_Request_header[bufferline][2] = request;	// request
			gBAP_Request_header[bufferline][4] = length;	// length
			// Daten der ByteSequence kopieren
			for(i = 0; i < BAP_buffer_size; i++)									
				gBAP_Request_data[bufferline][i] = data[i];
		case Bap_error:
			gBAP_Request_header[bufferline][5] = singleData;	// Errorcode						
			break;
		default:
			break;
	}

			

}

double round (double value, float step)
{
	long factor;
	double val1, val2;
	factor= value/step;
	val1=step*factor;
	val2=value-val1;
	if(abs(val2)>=(step/2))
		factor+= (val2>0?1:-1);
	return (factor * step);
}

Request_Void (byte lsgID, byte fctID, byte request)
{
	int i;
	byte dataArray [BAP_buffer_size];

	// Initialisieren eines Arrays
	for(i=0;i<BAP_buffer_size;i++) dataArray [i]=0;

	ringbuffer_write (lsgID, fctID, request, Bap_void, 0, 0, dataArray);	
}

Request_Int8 (byte lsgID, byte fctID, byte request, dword data)
{
	int i;
	byte dataArray [BAP_buffer_size];

	// Initialisieren eines Arrays
	for(i=0;i<BAP_buffer_size;i++) dataArray [i]=0;

	ringbuffer_write (lsgID, fctID, request, Bap_uint8, 0, data, dataArray);

}

Request_Int16 (byte lsgID, byte fctID, byte request, dword data)
{
	int i;
	byte dataArray [BAP_buffer_size];

	// Initialisieren eines Arrays
	for(i=0;i<BAP_buffer_size;i++) dataArray [i]=0;

	ringbuffer_write (lsgID, fctID, request, Bap_uint16, 0, data, dataArray);

}

Request_Int32 (byte lsgID, byte fctID, byte request, dword data)
{
	int i;
	byte dataArray [BAP_buffer_size];

	// Initialisieren eines Arrays
	for(i=0;i<BAP_buffer_size;i++) dataArray [i]=0;

	ringbuffer_write (lsgID, fctID, request, Bap_uint32, 0, data, dataArray);
}

Request_ByteSequence (byte lsgID, byte fctID, byte request, byte data[], word length)
{
	int i;
	byte dataArray [BAP_buffer_size];

	// Initialisieren eines Arrays
	for(i=0;i<BAP_buffer_size;i++) dataArray [i]=0;

	// Fuellen des Arrays
	for(i=0;i<length;i++) dataArray [i]=data[i];

	ringbuffer_write (lsgID, fctID, request, Bap_byteSequence, length, 0, dataArray);
}

Request_Error (byte lsgID, byte fctID, byte errorCode)
{
	int i;
	byte dataArray [BAP_buffer_size];

	// Initialisieren eines Arrays
	for(i=0;i<BAP_buffer_size;i++) dataArray [i]=0;

	ringbuffer_write (lsgID, fctID, 0, Bap_error, 0, errorCode, dataArray);
}

DisplayRequestErrorCode(dword fctID, dword errCode)
{
       switch(fctID)
   {
       case C_ASG_17_1_0_1_ID:
           gC_ASG_17_1_0_1_ErrCode = 0;
           putValue(C_ASG_17_1_0_1_ErrCode,  errCode);
           setControlBackColor(panel_name,"errfield_C_ASG_17_1_0_1", MakeRGB(255,79,79));
       break;
       case P_ASG_17_1_0_2_ID:
           gP_ASG_17_1_0_2_ErrCode = 0;
           putValue(P_ASG_17_1_0_2_ErrCode,  errCode);
           setControlBackColor(panel_name,"errfield_P_ASG_17_1_0_2", MakeRGB(255,79,79));
       break;
       case P_ASG_17_1_0_3_ID:
           gP_ASG_17_1_0_3_ErrCode = 0;
           putValue(P_ASG_17_1_0_3_ErrCode,  errCode);
           setControlBackColor(panel_name,"errfield_P_ASG_17_1_0_3", MakeRGB(255,79,79));
       break;
       case P_ASG_17_1_0_4_ID:
           gP_ASG_17_1_0_4_ErrCode = 0;
           putValue(P_ASG_17_1_0_4_ErrCode,  errCode);
           setControlBackColor(panel_name,"errfield_P_ASG_17_1_0_4", MakeRGB(255,79,79));
       break;
       case P_ASG_17_1_0_13_ID:
           gP_ASG_17_1_0_13_ErrCode = 0;
           putValue(P_ASG_17_1_0_13_ErrCode,  errCode);
           setControlBackColor(panel_name,"errfield_P_ASG_17_1_0_13", MakeRGB(255,79,79));
       break;
       case P_ASG_17_1_0_14_ID:
           gP_ASG_17_1_0_14_ErrCode = 0;
           putValue(P_ASG_17_1_0_14_ErrCode,  errCode);
           setControlBackColor(panel_name,"errfield_P_ASG_17_1_0_14", MakeRGB(255,79,79));
       break;
       case P_ASG_17_1_0_15_ID:
           gP_ASG_17_1_0_15_ErrCode = 0;
           putValue(P_ASG_17_1_0_15_ErrCode,  errCode);
           setControlBackColor(panel_name,"errfield_P_ASG_17_1_0_15", MakeRGB(255,79,79));
       break;
       case P_ASG_17_1_0_16_ID:
           gP_ASG_17_1_0_16_ErrCode = 0;
           putValue(P_ASG_17_1_0_16_ErrCode,  errCode);
           setControlBackColor(panel_name,"errfield_P_ASG_17_1_0_16", MakeRGB(255,79,79));
       break;
       case P_ASG_17_1_0_17_ID:
           gP_ASG_17_1_0_17_ErrCode = 0;
           putValue(P_ASG_17_1_0_17_ErrCode,  errCode);
           setControlBackColor(panel_name,"errfield_P_ASG_17_1_0_17", MakeRGB(255,79,79));
       break;
       case P_ASG_17_1_0_18_ID:
           gP_ASG_17_1_0_18_ErrCode = 0;
           putValue(P_ASG_17_1_0_18_ErrCode,  errCode);
           setControlBackColor(panel_name,"errfield_P_ASG_17_1_0_18", MakeRGB(255,79,79));
       break;
       case P_ASG_17_1_0_19_ID:
           gP_ASG_17_1_0_19_ErrCode = 0;
           putValue(P_ASG_17_1_0_19_ErrCode,  errCode);
           setControlBackColor(panel_name,"errfield_P_ASG_17_1_0_19", MakeRGB(255,79,79));
       break;
       case P_ASG_17_1_0_20_ID:
           gP_ASG_17_1_0_20_ErrCode = 0;
           putValue(P_ASG_17_1_0_20_ErrCode,  errCode);
           setControlBackColor(panel_name,"errfield_P_ASG_17_1_0_20", MakeRGB(255,79,79));
       break;
       case P_ASG_17_1_0_21_ID:
           gP_ASG_17_1_0_21_ErrCode = 0;
           putValue(P_ASG_17_1_0_21_ErrCode,  errCode);
           setControlBackColor(panel_name,"errfield_P_ASG_17_1_0_21", MakeRGB(255,79,79));
       break;
       case P_ASG_17_1_0_22_ID:
           gP_ASG_17_1_0_22_ErrCode = 0;
           putValue(P_ASG_17_1_0_22_ErrCode,  errCode);
           setControlBackColor(panel_name,"errfield_P_ASG_17_1_0_22", MakeRGB(255,79,79));
       break;
       case P_ASG_17_1_0_23_ID:
           gP_ASG_17_1_0_23_ErrCode = 0;
           putValue(P_ASG_17_1_0_23_ErrCode,  errCode);
           setControlBackColor(panel_name,"errfield_P_ASG_17_1_0_23", MakeRGB(255,79,79));
       break;
       case P_ASG_17_1_0_24_ID:
           gP_ASG_17_1_0_24_ErrCode = 0;
           putValue(P_ASG_17_1_0_24_ErrCode,  errCode);
           setControlBackColor(panel_name,"errfield_P_ASG_17_1_0_24", MakeRGB(255,79,79));
       break;
       case P_ASG_17_1_0_25_ID:
           gP_ASG_17_1_0_25_ErrCode = 0;
           putValue(P_ASG_17_1_0_25_ErrCode,  errCode);
           setControlBackColor(panel_name,"errfield_P_ASG_17_1_0_25", MakeRGB(255,79,79));
       break;
       case P_ASG_17_1_0_26_ID:
           gP_ASG_17_1_0_26_ErrCode = 0;
           putValue(P_ASG_17_1_0_26_ErrCode,  errCode);
           setControlBackColor(panel_name,"errfield_P_ASG_17_1_0_26", MakeRGB(255,79,79));
       break;
       case P_ASG_17_1_0_27_ID:
           gP_ASG_17_1_0_27_ErrCode = 0;
           putValue(P_ASG_17_1_0_27_ErrCode,  errCode);
           setControlBackColor(panel_name,"errfield_P_ASG_17_1_0_27", MakeRGB(255,79,79));
       break;
       case P_ASG_17_1_0_28_ID:
           gP_ASG_17_1_0_28_ErrCode = 0;
           putValue(P_ASG_17_1_0_28_ErrCode,  errCode);
           setControlBackColor(panel_name,"errfield_P_ASG_17_1_0_28", MakeRGB(255,79,79));
       break;
       case P_ASG_17_1_0_29_ID:
           gP_ASG_17_1_0_29_ErrCode = 0;
           putValue(P_ASG_17_1_0_29_ErrCode,  errCode);
           setControlBackColor(panel_name,"errfield_P_ASG_17_1_0_29", MakeRGB(255,79,79));
       break;
       case P_ASG_17_1_0_30_ID:
           gP_ASG_17_1_0_30_ErrCode = 0;
           putValue(P_ASG_17_1_0_30_ErrCode,  errCode);
           setControlBackColor(panel_name,"errfield_P_ASG_17_1_0_30", MakeRGB(255,79,79));
       break;
       default:
           writelineEx(gError_Trace, 0, "%s%d/%d Unknown Functionid in  displayErrorCode", SGtype, LSGID,fctID);
   }

}

BAP_DLL_Request ()
{
	int i;
    int l=0;
	byte temp;
	byte Request_data[4096];	//Request data for DLL
	dword Request_header[6];	//Request header for DLL
	byte dataValid;
	int nextElementToRead;
	
	// defaultmaessig ist senden OK
	dataValid = 1;

	// loeschen der Daten "Container"
	for(i=0;i<6;i++)
		Request_header[i]=0;
	for(i=0;i<BAP_buffer_size;i++)
		Request_data[i]=0;

    
	// Verarbeiten aller noch offenen Requests	
	while ((nextElementToRead = getNextReadIndex()) != -1) 
	{
		// Fuer alle Datentypen gleich
		Request_header[0]=gBAP_Request_header [nextElementToRead][0];		//LSG-ID
		Request_header[1]=gBAP_Request_header [nextElementToRead][1];		//Function-ID
		Request_header[2]=gBAP_Request_header [nextElementToRead][2];		//request type
		Request_header[3]=gBAP_Request_header [nextElementToRead][3];		//BAP data type

		switch(gBAP_Request_header[nextElementToRead][3]){
			case Bap_uint32:
                l=2;
            case Bap_uint16:
                l++;
            case Bap_uint8:
			case Bap_error: // Request (2) wird dabei ignoriert
                l++;
			case Bap_void:  // Datenfeld (5) wird dabei ignoriert
				Request_header[4]=l;												//	not used
				Request_header[5]=gBAP_Request_header [nextElementToRead][5];		// Daten
			break;
			case Bap_byteSequence:									
				Request_header[4]=gBAP_Request_header [nextElementToRead][4];		// length
				Request_header[5]=0;												// not used

				// data-array for BAP-DLL funcion 'BAP_Request'
				for(i=0;i<BAP_buffer_size;i++)
					Request_data[i]=gBAP_Request_data [nextElementToRead][i];
				break;			
			default:
				writelineEx(gError_Trace, 0, "BAP_DLL_Request: invalid BAP-Data-Type: %d", gBAP_Request_header[nextElementToRead][3]);
				dataValid = 0;
			break;			
		}
		
		if(dataValid){
            // wie heisst der Request?
            writelineEx(gBAP_Trace, 0, "%s%d/%d BAP_Request %s datatype:%s length:%d", SGtype, Request_header[0],Request_header[1],Requesttype_Text[Request_header[2]],Datatype_Text[Request_header[3]],Request_header[4]);
			temp = BAP160_Request(NODE_INDEX, Request_header, Request_data);	//send data to BAP-DLL	
			// BAP-Request failed
            if(temp != 0){
                // Fehlercode: Request failed
                writelineEx(gError_Trace, 0, "%s%d/%d Error during BAP_Request errorcode: 0x%X", SGtype, Request_header[0],Request_header[1],temp);
                DisplayRequestErrorCode(Request_header[1],temp);
            } 
		}

	}
} 

int getNextReadIndex ()
{
	int i, ret;
	// der Puffer wird nach dem naechsten zu lesenden Eintrag durchsucht
	// Existiert keiner wird -1 zurueckgegeben
	ret = -1;

	for (i = 0; i < Requestbuffer_lines; i++)
	{
		if (gBAP_Requestbuffer_status[i] == 1)
		{
			// zum verschicken
			ret = i;
			// und wieder freigeben
			gBAP_Requestbuffer_status[i] = 0;
			break;
		}
	}

	return (ret);
}

int getNextWriteIndex ()
{
	int i, ret;
	// der Puffer wird nach dem naechsten freien Eintrag durchsucht
	// Existiert keiner wird -1 zurueckgegeben
	ret = -1;

	for (i = 0; i < Requestbuffer_lines; i++)
	{
		if (gBAP_Requestbuffer_status[i] == 0)
		{
			// zum schreiben
			ret = i;
			// belegen
			gBAP_Requestbuffer_status[i] = 1;
			break;
		}
	}

	return (ret);
}

byte  isBitForFctSetted(word fctid, byte fctList[])
{
    byte byteNo ;
    byte bitno ;
    byte fctValue ;

    byteNo = fctid / 8;
    bitno = fctid % 8;

    fctValue = 0x80 >> bitno;

    return (fctList[byteNo] & fctValue)?1:0;
}

UpdateAllProperties()
{
	Request_Void(LSGID,P_ASG_17_1_0_2_ID,DataGet_REQ);
	Request_Void(LSGID,P_ASG_17_1_0_3_ID,DataGet_REQ);
	Request_Void(LSGID,P_ASG_17_1_0_4_ID,DataGet_REQ);
	Request_Void(LSGID,P_ASG_17_1_0_13_ID,DataGet_REQ);
	Request_Void(LSGID,P_ASG_17_1_0_14_ID,DataGet_REQ);
	Request_Void(LSGID,P_ASG_17_1_0_15_ID,DataGet_REQ);
	Request_Void(LSGID,P_ASG_17_1_0_16_ID,DataGet_REQ);
	Request_Void(LSGID,P_ASG_17_1_0_17_ID,DataGet_REQ);
	Request_Void(LSGID,P_ASG_17_1_0_18_ID,DataGet_REQ);
	Request_Void(LSGID,P_ASG_17_1_0_19_ID,DataGet_REQ);
	Request_Void(LSGID,P_ASG_17_1_0_20_ID,DataGet_REQ);
	Request_Void(LSGID,P_ASG_17_1_0_21_ID,DataGet_REQ);
	Request_Void(LSGID,P_ASG_17_1_0_22_ID,DataGet_REQ);
	Request_Void(LSGID,P_ASG_17_1_0_23_ID,DataGet_REQ);
	Request_Void(LSGID,P_ASG_17_1_0_24_ID,DataGet_REQ);
	Request_Void(LSGID,P_ASG_17_1_0_25_ID,DataGet_REQ);
	Request_Void(LSGID,P_ASG_17_1_0_26_ID,DataGet_REQ);
	Request_Void(LSGID,P_ASG_17_1_0_27_ID,DataGet_REQ);
	Request_Void(LSGID,P_ASG_17_1_0_28_ID,DataGet_REQ);
	Request_Void(LSGID,P_ASG_17_1_0_29_ID,DataGet_REQ);
	Request_Void(LSGID,P_ASG_17_1_0_30_ID,DataGet_REQ);

}

Process_Current_Indication ()
{
   int rxsize;
   int txsize;
   byte temp[BAP_buffer_size];
   char buffer[BAP_buffer_size];
 //  if(strncmp(Datatype_Text[gBAP_Indication_header[3]], "acknowledge", 4)!=0) 
 //      writelineEx(gBAP_Trace, 0, "NodeIndex: %d: CurrentIndication %s lsgid:%d fctid:%d indType:%s dataType=%s length=%d",
  //             NODE_INDEX, SGtype, gBAP_Indication_header[0], gBAP_Indication_header[1], Indicationtype_Text[gBAP_Indication_header[2]], Datatype_Text[gBAP_Indication_header[3]], gBAP_Indication_header[4]);
  // else 
  //     writelineEx(gBAP_Trace, 0, "Internal acknowledge %s-%d fctid:%d indType:%s dataType=%s length=%d",
  //             SGtype, gBAP_Indication_header[0], gBAP_Indication_header[1], Acknowledgetype_Text[gBAP_Indication_header[5]], Datatype_Text[gBAP_Indication_header[3]], gBAP_Indication_header[4]);
   switch(gBAP_Indication_header[0])  // LSGID
   {
   case LSGID:
       switch(gBAP_Indication_header[1]) // FCTID
       {
    case C_ASG_17_1_0_1_ID: 
        switch(gBAP_Indication_header[3]) // Datentyp 
        {
        case Bap_void:
            switch (gBAP_Indication_header[2]) // IndType
            {
                case Data_IND: // Indicationtyp pruefen
                    //Now every Property with Cache is updated
                    UpdateAllProperties();
                    putValue(C_ASG_17_1_0_1_State, "StatusAll");
                    setControlBackColor(panel_name, "errfield_C_ASG_17_1_0_1_State", MakeRGB(255,255,255));
                    break;
                default:
                    PrintIndicationError("Illegal IndType");
                    break;
            }
            break;
            case Bap_error:
               snprintf(buffer,BAP_buffer_size-1,"Error %02x", gBAP_Indication_header[5]);
               putValue(C_ASG_17_1_0_1_State, buffer);
               setControlBackColor(panel_name, "errfield_C_ASG_17_1_0_1_State", MakeRGB(255,79,79));
               break;
            case Bap_acknowledge:
                break;
            default:
                PrintIndicationError("Illegal DataType");
                break;
        }
    break;
    case P_ASG_17_1_0_2_ID: 
        switch(gBAP_Indication_header[3]) // Datentyp 
        {
        case Bap_byteSequence:
            switch (gBAP_Indication_header[2]) // IndType
            {
                case Reset_IND: // Nur fuer FctId 2 (BAPConfig) relevant
                   putValue(C_ASG_17_1_0_1_State, "");
                   setControlBackColor(panel_name, "errfield_C_ASG_17_1_0_1_State", MakeRGB(255,255,255));
                   initInvalidFields();
                   // Fall through
                case Data_IND: // Indicationtyp pruefen
                    // Daten setzen
                    putValue(BAPCFG_ASG_17_1_0_ProtocolMajor, gBAP_Indication_data[0]);
                    putValue(BAPCFG_ASG_17_1_0_ProtocolMinor, gBAP_Indication_data[1]);
                    putValue(BAPCFG_ASG_17_1_0_LsgClassMajor, gBAP_Indication_data[2]);
                    putValue(BAPCFG_ASG_17_1_0_LsgClassMinor, gBAP_Indication_data[3]);
                    putValue(BAPCFG_ASG_17_1_0_DFMajor, gBAP_Indication_data[4]);
                    putValue(BAPCFG_ASG_17_1_0_DFMinor, gBAP_Indication_data[5]);
                    setControlBackColor(panel_name, "errfield_P_ASG_17_1_0_2", MakeRGB(255,255,255));  
                    setControlBackColor(panel_name, "panel1_edit", MakeRGB(255,255,255));  
                    break;
                default:
                    PrintIndicationError("Illegal IndType");
                    break;
            }
            break;
            case Bap_error:
                putValue(P_ASG_17_1_0_2_ErrCode,  gBAP_Indication_header[5]);
                setControlBackColor(panel_name, "errfield_P_ASG_17_1_0_2", MakeRGB(255,79,79));  
                setControlBackColor(panel_name, "panel1_edit", MakeRGB(220,220,220));  
                break;
            case Bap_acknowledge:
                break;
            default:
                PrintIndicationError("Illegal DataType");
                break;
        }
    break;
    case P_ASG_17_1_0_3_ID: 
       switch(gBAP_Indication_header[3]) // Datentyp
       {
            case Bap_byteSequence:
                switch (gBAP_Indication_header[2]) // IndType
                {
                    case Data_IND: // Indicationtyp pruefen
                    case Reset_IND: // Nur fuer FctId 2 (BAPConfig) relevant
                    {
                        setControlBackColor(panel_name, "errfield_P_ASG_17_1_0_3", MakeRGB(255,255,255));
                        if(isBitForFctSetted(P_ASG_17_1_0_30_ID,gBAP_Indication_data))
                        {
                            putValue(P_ASG_17_1_0_30_FctLstItemEn, 1);
                            setControlForeColor(panel_name, gCheckbox30,MakeRGB(0,240,0));
                            EnableControl(panel_name, gPanel30, 1);
                            EnableControl(panel_name, "panel_P_ASG_17_1_0_30",1);
                        }
                        else
                        {
                            putValue(P_ASG_17_1_0_30_FctLstItemEn, 0);
                            setControlForeColor(panel_name, gCheckbox30,MakeRGB(250,0,0));
                            EnableControl(panel_name, gPanel30, 0);
                            EnableControl(panel_name, "panel_P_ASG_17_1_0_30",0);
                        }

                        if(isBitForFctSetted(P_ASG_17_1_0_19_ID,gBAP_Indication_data))
                        {
                            putValue(P_ASG_17_1_0_19_FctLstItemEn, 1);
                            setControlForeColor(panel_name, gCheckbox19,MakeRGB(0,240,0));
                            EnableControl(panel_name, gPanel19, 1);
                            EnableControl(panel_name, "panel_P_ASG_17_1_0_19",1);
                        }
                        else
                        {
                            putValue(P_ASG_17_1_0_19_FctLstItemEn, 0);
                            setControlForeColor(panel_name, gCheckbox19,MakeRGB(250,0,0));
                            EnableControl(panel_name, gPanel19, 0);
                            EnableControl(panel_name, "panel_P_ASG_17_1_0_19",0);
                        }

                        if(isBitForFctSetted(P_ASG_17_1_0_18_ID,gBAP_Indication_data))
                        {
                            putValue(P_ASG_17_1_0_18_FctLstItemEn, 1);
                            setControlForeColor(panel_name, gCheckbox18,MakeRGB(0,240,0));
                            EnableControl(panel_name, gPanel18, 1);
                            EnableControl(panel_name, "panel_P_ASG_17_1_0_18",1);
                        }
                        else
                        {
                            putValue(P_ASG_17_1_0_18_FctLstItemEn, 0);
                            setControlForeColor(panel_name, gCheckbox18,MakeRGB(250,0,0));
                            EnableControl(panel_name, gPanel18, 0);
                            EnableControl(panel_name, "panel_P_ASG_17_1_0_18",0);
                        }

                        if(isBitForFctSetted(P_ASG_17_1_0_17_ID,gBAP_Indication_data))
                        {
                            putValue(P_ASG_17_1_0_17_FctLstItemEn, 1);
                            setControlForeColor(panel_name, gCheckbox17,MakeRGB(0,240,0));
                            EnableControl(panel_name, gPanel17, 1);
                            EnableControl(panel_name, "panel_P_ASG_17_1_0_17",1);
                        }
                        else
                        {
                            putValue(P_ASG_17_1_0_17_FctLstItemEn, 0);
                            setControlForeColor(panel_name, gCheckbox17,MakeRGB(250,0,0));
                            EnableControl(panel_name, gPanel17, 0);
                            EnableControl(panel_name, "panel_P_ASG_17_1_0_17",0);
                        }

                        if(isBitForFctSetted(P_ASG_17_1_0_16_ID,gBAP_Indication_data))
                        {
                            putValue(P_ASG_17_1_0_16_FctLstItemEn, 1);
                            setControlForeColor(panel_name, gCheckbox16,MakeRGB(0,240,0));
                            EnableControl(panel_name, gPanel16, 1);
                            EnableControl(panel_name, "panel_P_ASG_17_1_0_16",1);
                        }
                        else
                        {
                            putValue(P_ASG_17_1_0_16_FctLstItemEn, 0);
                            setControlForeColor(panel_name, gCheckbox16,MakeRGB(250,0,0));
                            EnableControl(panel_name, gPanel16, 0);
                            EnableControl(panel_name, "panel_P_ASG_17_1_0_16",0);
                        }

                        if(isBitForFctSetted(P_ASG_17_1_0_15_ID,gBAP_Indication_data))
                        {
                            putValue(P_ASG_17_1_0_15_FctLstItemEn, 1);
                            setControlForeColor(panel_name, gCheckbox15,MakeRGB(0,240,0));
                            EnableControl(panel_name, gPanel15, 1);
                            EnableControl(panel_name, "panel_P_ASG_17_1_0_15",1);
                        }
                        else
                        {
                            putValue(P_ASG_17_1_0_15_FctLstItemEn, 0);
                            setControlForeColor(panel_name, gCheckbox15,MakeRGB(250,0,0));
                            EnableControl(panel_name, gPanel15, 0);
                            EnableControl(panel_name, "panel_P_ASG_17_1_0_15",0);
                        }

                        if(isBitForFctSetted(P_ASG_17_1_0_14_ID,gBAP_Indication_data))
                        {
                            putValue(P_ASG_17_1_0_14_FctLstItemEn, 1);
                            setControlForeColor(panel_name, gCheckbox14,MakeRGB(0,240,0));
                            EnableControl(panel_name, gPanel14, 1);
                            EnableControl(panel_name, "panel_P_ASG_17_1_0_14",1);
                        }
                        else
                        {
                            putValue(P_ASG_17_1_0_14_FctLstItemEn, 0);
                            setControlForeColor(panel_name, gCheckbox14,MakeRGB(250,0,0));
                            EnableControl(panel_name, gPanel14, 0);
                            EnableControl(panel_name, "panel_P_ASG_17_1_0_14",0);
                        }

                        if(isBitForFctSetted(P_ASG_17_1_0_13_ID,gBAP_Indication_data))
                        {
                            putValue(P_ASG_17_1_0_13_FctLstItemEn, 1);
                            setControlForeColor(panel_name, gCheckbox13,MakeRGB(0,240,0));
                            EnableControl(panel_name, gPanel13, 1);
                            EnableControl(panel_name, "panel_P_ASG_17_1_0_13",1);
                        }
                        else
                        {
                            putValue(P_ASG_17_1_0_13_FctLstItemEn, 0);
                            setControlForeColor(panel_name, gCheckbox13,MakeRGB(250,0,0));
                            EnableControl(panel_name, gPanel13, 0);
                            EnableControl(panel_name, "panel_P_ASG_17_1_0_13",0);
                        }

                        if(isBitForFctSetted(P_ASG_17_1_0_29_ID,gBAP_Indication_data))
                        {
                            putValue(P_ASG_17_1_0_29_FctLstItemEn, 1);
                            setControlForeColor(panel_name, gCheckbox29,MakeRGB(0,240,0));
                            EnableControl(panel_name, gPanel29, 1);
                            EnableControl(panel_name, "panel_P_ASG_17_1_0_29",1);
                        }
                        else
                        {
                            putValue(P_ASG_17_1_0_29_FctLstItemEn, 0);
                            setControlForeColor(panel_name, gCheckbox29,MakeRGB(250,0,0));
                            EnableControl(panel_name, gPanel29, 0);
                            EnableControl(panel_name, "panel_P_ASG_17_1_0_29",0);
                        }

                        if(isBitForFctSetted(P_ASG_17_1_0_28_ID,gBAP_Indication_data))
                        {
                            putValue(P_ASG_17_1_0_28_FctLstItemEn, 1);
                            setControlForeColor(panel_name, gCheckbox28,MakeRGB(0,240,0));
                            EnableControl(panel_name, gPanel28, 1);
                            EnableControl(panel_name, "panel_P_ASG_17_1_0_28",1);
                        }
                        else
                        {
                            putValue(P_ASG_17_1_0_28_FctLstItemEn, 0);
                            setControlForeColor(panel_name, gCheckbox28,MakeRGB(250,0,0));
                            EnableControl(panel_name, gPanel28, 0);
                            EnableControl(panel_name, "panel_P_ASG_17_1_0_28",0);
                        }

                        if(isBitForFctSetted(P_ASG_17_1_0_27_ID,gBAP_Indication_data))
                        {
                            putValue(P_ASG_17_1_0_27_FctLstItemEn, 1);
                            setControlForeColor(panel_name, gCheckbox27,MakeRGB(0,240,0));
                            EnableControl(panel_name, gPanel27, 1);
                            EnableControl(panel_name, "panel_P_ASG_17_1_0_27",1);
                        }
                        else
                        {
                            putValue(P_ASG_17_1_0_27_FctLstItemEn, 0);
                            setControlForeColor(panel_name, gCheckbox27,MakeRGB(250,0,0));
                            EnableControl(panel_name, gPanel27, 0);
                            EnableControl(panel_name, "panel_P_ASG_17_1_0_27",0);
                        }

                        if(isBitForFctSetted(P_ASG_17_1_0_26_ID,gBAP_Indication_data))
                        {
                            putValue(P_ASG_17_1_0_26_FctLstItemEn, 1);
                            setControlForeColor(panel_name, gCheckbox26,MakeRGB(0,240,0));
                            EnableControl(panel_name, gPanel26, 1);
                            EnableControl(panel_name, "panel_P_ASG_17_1_0_26",1);
                        }
                        else
                        {
                            putValue(P_ASG_17_1_0_26_FctLstItemEn, 0);
                            setControlForeColor(panel_name, gCheckbox26,MakeRGB(250,0,0));
                            EnableControl(panel_name, gPanel26, 0);
                            EnableControl(panel_name, "panel_P_ASG_17_1_0_26",0);
                        }

                        if(isBitForFctSetted(P_ASG_17_1_0_4_ID,gBAP_Indication_data))
                        {
                            putValue(P_ASG_17_1_0_4_FctLstItemEn, 1);
                            setControlForeColor(panel_name, gCheckbox4,MakeRGB(0,240,0));
                        }
                        else
                        {
                            putValue(P_ASG_17_1_0_4_FctLstItemEn, 0);
                            setControlForeColor(panel_name, gCheckbox4,MakeRGB(250,0,0));
                        }

                        if(isBitForFctSetted(P_ASG_17_1_0_25_ID,gBAP_Indication_data))
                        {
                            putValue(P_ASG_17_1_0_25_FctLstItemEn, 1);
                            setControlForeColor(panel_name, gCheckbox25,MakeRGB(0,240,0));
                            EnableControl(panel_name, gPanel25, 1);
                            EnableControl(panel_name, "panel_P_ASG_17_1_0_25",1);
                        }
                        else
                        {
                            putValue(P_ASG_17_1_0_25_FctLstItemEn, 0);
                            setControlForeColor(panel_name, gCheckbox25,MakeRGB(250,0,0));
                            EnableControl(panel_name, gPanel25, 0);
                            EnableControl(panel_name, "panel_P_ASG_17_1_0_25",0);
                        }

                        if(isBitForFctSetted(P_ASG_17_1_0_3_ID,gBAP_Indication_data))
                        {
                            putValue(P_ASG_17_1_0_3_FctLstItemEn, 1);
                            setControlForeColor(panel_name, gCheckbox3,MakeRGB(0,240,0));
                        }
                        else
                        {
                            putValue(P_ASG_17_1_0_3_FctLstItemEn, 0);
                            setControlForeColor(panel_name, gCheckbox3,MakeRGB(250,0,0));
                        }

                        if(isBitForFctSetted(P_ASG_17_1_0_24_ID,gBAP_Indication_data))
                        {
                            putValue(P_ASG_17_1_0_24_FctLstItemEn, 1);
                            setControlForeColor(panel_name, gCheckbox24,MakeRGB(0,240,0));
                            EnableControl(panel_name, gPanel24, 1);
                            EnableControl(panel_name, "panel_P_ASG_17_1_0_24",1);
                        }
                        else
                        {
                            putValue(P_ASG_17_1_0_24_FctLstItemEn, 0);
                            setControlForeColor(panel_name, gCheckbox24,MakeRGB(250,0,0));
                            EnableControl(panel_name, gPanel24, 0);
                            EnableControl(panel_name, "panel_P_ASG_17_1_0_24",0);
                        }

                        if(isBitForFctSetted(P_ASG_17_1_0_2_ID,gBAP_Indication_data))
                        {
                            putValue(P_ASG_17_1_0_2_FctLstItemEn, 1);
                            setControlForeColor(panel_name, gCheckbox2,MakeRGB(0,240,0));
                        }
                        else
                        {
                            putValue(P_ASG_17_1_0_2_FctLstItemEn, 0);
                            setControlForeColor(panel_name, gCheckbox2,MakeRGB(250,0,0));
                        }

                        if(isBitForFctSetted(P_ASG_17_1_0_23_ID,gBAP_Indication_data))
                        {
                            putValue(P_ASG_17_1_0_23_FctLstItemEn, 1);
                            setControlForeColor(panel_name, gCheckbox23,MakeRGB(0,240,0));
                            EnableControl(panel_name, gPanel23, 1);
                            EnableControl(panel_name, "panel_P_ASG_17_1_0_23",1);
                        }
                        else
                        {
                            putValue(P_ASG_17_1_0_23_FctLstItemEn, 0);
                            setControlForeColor(panel_name, gCheckbox23,MakeRGB(250,0,0));
                            EnableControl(panel_name, gPanel23, 0);
                            EnableControl(panel_name, "panel_P_ASG_17_1_0_23",0);
                        }

                        if(isBitForFctSetted(C_ASG_17_1_0_1_ID,gBAP_Indication_data))
                        {
                            putValue(C_ASG_17_1_0_1_FctLstItemEn, 1);
                            setControlForeColor(panel_name, gCheckbox1,MakeRGB(0,240,0));
                        }
                        else
                        {
                            putValue(C_ASG_17_1_0_1_FctLstItemEn, 0);
                            setControlForeColor(panel_name, gCheckbox1,MakeRGB(250,0,0));
                        }

                        if(isBitForFctSetted(P_ASG_17_1_0_22_ID,gBAP_Indication_data))
                        {
                            putValue(P_ASG_17_1_0_22_FctLstItemEn, 1);
                            setControlForeColor(panel_name, gCheckbox22,MakeRGB(0,240,0));
                            EnableControl(panel_name, gPanel22, 1);
                            EnableControl(panel_name, "panel_P_ASG_17_1_0_22",1);
                        }
                        else
                        {
                            putValue(P_ASG_17_1_0_22_FctLstItemEn, 0);
                            setControlForeColor(panel_name, gCheckbox22,MakeRGB(250,0,0));
                            EnableControl(panel_name, gPanel22, 0);
                            EnableControl(panel_name, "panel_P_ASG_17_1_0_22",0);
                        }

                        if(isBitForFctSetted(P_ASG_17_1_0_21_ID,gBAP_Indication_data))
                        {
                            putValue(P_ASG_17_1_0_21_FctLstItemEn, 1);
                            setControlForeColor(panel_name, gCheckbox21,MakeRGB(0,240,0));
                            EnableControl(panel_name, gPanel21, 1);
                            EnableControl(panel_name, "panel_P_ASG_17_1_0_21",1);
                        }
                        else
                        {
                            putValue(P_ASG_17_1_0_21_FctLstItemEn, 0);
                            setControlForeColor(panel_name, gCheckbox21,MakeRGB(250,0,0));
                            EnableControl(panel_name, gPanel21, 0);
                            EnableControl(panel_name, "panel_P_ASG_17_1_0_21",0);
                        }

                        if(isBitForFctSetted(P_ASG_17_1_0_20_ID,gBAP_Indication_data))
                        {
                            putValue(P_ASG_17_1_0_20_FctLstItemEn, 1);
                            setControlForeColor(panel_name, gCheckbox20,MakeRGB(0,240,0));
                            EnableControl(panel_name, gPanel20, 1);
                            EnableControl(panel_name, "panel_P_ASG_17_1_0_20",1);
                        }
                        else
                        {
                            putValue(P_ASG_17_1_0_20_FctLstItemEn, 0);
                            setControlForeColor(panel_name, gCheckbox20,MakeRGB(250,0,0));
                            EnableControl(panel_name, gPanel20, 0);
                            EnableControl(panel_name, "panel_P_ASG_17_1_0_20",0);
                        }

                     }
                        break;
                    default:
                      writelineEx(gError_Trace, 0, "NodeIndex: %d: Illegal IndType : lsgid:%d fctid:%d indType:%d",
                           NODE_INDEX, gBAP_Indication_header[0], gBAP_Indication_header[1], gBAP_Indication_header[2]);
                       break;
                  }
                  break;
            case Bap_error:
                putValue(P_ASG_17_1_0_3_ErrCode,  gBAP_Indication_header[5]);
                setControlBackColor(panel_name, "errfield_P_ASG_17_1_0_3", MakeRGB(255,79,79));
                break;
            case Bap_acknowledge:
            	 break;
            default:
                PrintIndicationError("Illegal DataType");
                break;
       }
       break;
    case P_ASG_17_1_0_4_ID: 
        switch(gBAP_Indication_header[3]) // Datentyp 
        {
           case Bap_uint8:
                   switch(gBAP_Indication_header[2]) // IndType
                   {
                       case Data_IND: // Indicationtyp pruefen
                           // Daten setzen
                           putValue(P_ASG_17_1_0_4, gBAP_Indication_header[5]);
                           setControlBackColor(panel_name, "errfield_P_ASG_17_1_0_4", MakeRGB(255,255,255));  
                           setControlBackColor(panel_name, "panel_P_ASG_17_1_0_4", MakeRGB(255,255,255));  
                           break;                              
                       default:
                           PrintIndicationError("Illegal IndType");
                           break;
                   }
                   break;
            case Bap_error:
                putValue(P_ASG_17_1_0_4_ErrCode,  gBAP_Indication_header[5]);
                setControlBackColor(panel_name, "errfield_P_ASG_17_1_0_4", MakeRGB(255,79,79));  
                setControlBackColor(panel_name, "panel_P_ASG_17_1_0_4", MakeRGB(220,220,220));  
                if(gBAP_Indication_header[5]==0x21)
                {
                   putValue(C_ASG_17_1_0_1_State, "");
                   setControlBackColor(panel_name, "errfield_C_ASG_17_1_0_1_State", MakeRGB(255,255,255));
                }
                break;
            case Bap_acknowledge:
                break;
            default:
                PrintIndicationError("Illegal DataType");
                break;
        }
    break;
    case P_ASG_17_1_0_13_ID: 
        switch(gBAP_Indication_header[3]) // Datentyp 
        {
            case Bap_uint8:
                    switch(gBAP_Indication_header[2]) // IndType
                    {
                        case Data_IND: // Indicationtyp pruefen
                            // Daten setzen
                            putValue(P_ASG_17_1_0_13, gBAP_Indication_header[5]);
                            setControlBackColor(panel_name, "errfield_P_ASG_17_1_0_13", MakeRGB(255,255,255));  
                            setControlBackColor(panel_name, "panel_P_ASG_17_1_0_13", MakeRGB(255,255,255));  
                            break;                              
                        default:
                            PrintIndicationError("Illegal IndType");
                            break;
                    }
                    break;
            case Bap_error:
                gP_ASG_17_1_0_13_ErrCode = 0;
                putValue(P_ASG_17_1_0_13_ErrCode,  gBAP_Indication_header[5]);
                setControlBackColor(panel_name, "errfield_P_ASG_17_1_0_13", MakeRGB(255,79,79));  
                setControlBackColor(panel_name, "panel_P_ASG_17_1_0_13", MakeRGB(220,220,220));  
                break;
            case Bap_acknowledge:
                break;
            default:
                    PrintIndicationError("Illegal DataType");
                    break;
        }
    break;
    case P_ASG_17_1_0_14_ID: 
        switch(gBAP_Indication_header[3]) // Datentyp 
        {
            case Bap_uint8:
                    switch(gBAP_Indication_header[2]) // IndType
                    {
                        case Data_IND: // Indicationtyp pruefen
                            // Daten setzen
                            putValue(P_ASG_17_1_0_14, gBAP_Indication_header[5]);
                            setControlBackColor(panel_name, "errfield_P_ASG_17_1_0_14", MakeRGB(255,255,255));  
                            setControlBackColor(panel_name, "panel_P_ASG_17_1_0_14", MakeRGB(255,255,255));  
                            break;                              
                        default:
                            PrintIndicationError("Illegal IndType");
                            break;
                    }
                    break;
            case Bap_error:
                gP_ASG_17_1_0_14_ErrCode = 0;
                putValue(P_ASG_17_1_0_14_ErrCode,  gBAP_Indication_header[5]);
                setControlBackColor(panel_name, "errfield_P_ASG_17_1_0_14", MakeRGB(255,79,79));  
                setControlBackColor(panel_name, "panel_P_ASG_17_1_0_14", MakeRGB(220,220,220));  
                break;
            case Bap_acknowledge:
                break;
            default:
                    PrintIndicationError("Illegal DataType");
                    break;
        }
    break;
    case P_ASG_17_1_0_15_ID: 
        switch(gBAP_Indication_header[3]) // Datentyp 
        {
            case Bap_uint8:
                    switch(gBAP_Indication_header[2]) // IndType
                    {
                        case Data_IND: // Indicationtyp pruefen
                            // Daten setzen
                            putValue(P_ASG_17_1_0_15, gBAP_Indication_header[5]);
                            setControlBackColor(panel_name, "errfield_P_ASG_17_1_0_15", MakeRGB(255,255,255));  
                            setControlBackColor(panel_name, "panel_P_ASG_17_1_0_15", MakeRGB(255,255,255));  
                            break;                              
                        default:
                            PrintIndicationError("Illegal IndType");
                            break;
                    }
                    break;
            case Bap_error:
                gP_ASG_17_1_0_15_ErrCode = 0;
                putValue(P_ASG_17_1_0_15_ErrCode,  gBAP_Indication_header[5]);
                setControlBackColor(panel_name, "errfield_P_ASG_17_1_0_15", MakeRGB(255,79,79));  
                setControlBackColor(panel_name, "panel_P_ASG_17_1_0_15", MakeRGB(220,220,220));  
                break;
            case Bap_acknowledge:
                break;
            default:
                    PrintIndicationError("Illegal DataType");
                    break;
        }
    break;
    case P_ASG_17_1_0_16_ID: 
        switch(gBAP_Indication_header[3]) // Datentyp 
        {
            case Bap_byteSequence:
                switch (gBAP_Indication_header[2]) // IndType
                {
                    case Data_IND: // Indicationtyp pruefen
                        // Daten setzen
                        putValue(P_ASG_17_1_0_16, gBAP_Indication_data, gBAP_Indication_header[4]);
                        setControlBackColor(panel_name, "errfield_P_ASG_17_1_0_16", MakeRGB(255,255,255));  
                        setControlBackColor(panel_name, "panel_P_ASG_17_1_0_16", MakeRGB(255,255,255));  
                        break;
                    default:
                        PrintIndicationError("Illegal IndType");
                        break;
                }
                break;
            case Bap_error:
                gP_ASG_17_1_0_16_ErrCode = 0;
                putValue(P_ASG_17_1_0_16_ErrCode,  gBAP_Indication_header[5]);
                setControlBackColor(panel_name, "errfield_P_ASG_17_1_0_16", MakeRGB(255,79,79));  
                setControlBackColor(panel_name, "panel_P_ASG_17_1_0_16", MakeRGB(220,220,220));  
                break;
            case Bap_acknowledge:
                break;
            default:
                PrintIndicationError("Illegal DataType");
                break;
        }
    break;
    case P_ASG_17_1_0_17_ID: 
        switch(gBAP_Indication_header[3]) // Datentyp 
        {
            case Bap_byteSequence:
                switch (gBAP_Indication_header[2]) // IndType
                {
                    case Data_IND: // Indicationtyp pruefen
                        // Daten setzen
                        putValue(P_ASG_17_1_0_17, gBAP_Indication_data, gBAP_Indication_header[4]);
                        setControlBackColor(panel_name, "errfield_P_ASG_17_1_0_17", MakeRGB(255,255,255));  
                        setControlBackColor(panel_name, "panel_P_ASG_17_1_0_17", MakeRGB(255,255,255));  
                        break;
                    default:
                        PrintIndicationError("Illegal IndType");
                        break;
                }
                break;
            case Bap_error:
                gP_ASG_17_1_0_17_ErrCode = 0;
                putValue(P_ASG_17_1_0_17_ErrCode,  gBAP_Indication_header[5]);
                setControlBackColor(panel_name, "errfield_P_ASG_17_1_0_17", MakeRGB(255,79,79));  
                setControlBackColor(panel_name, "panel_P_ASG_17_1_0_17", MakeRGB(220,220,220));  
                break;
            case Bap_acknowledge:
                break;
            default:
                PrintIndicationError("Illegal DataType");
                break;
        }
    break;
    case P_ASG_17_1_0_18_ID: 
        switch(gBAP_Indication_header[3]) // Datentyp 
        {
            case Bap_uint8:
                    switch(gBAP_Indication_header[2]) // IndType
                    {
                        case Data_IND: // Indicationtyp pruefen
                            // Daten setzen
                            putValue(P_ASG_17_1_0_18, gBAP_Indication_header[5]);
                            setControlBackColor(panel_name, "errfield_P_ASG_17_1_0_18", MakeRGB(255,255,255));  
                            setControlBackColor(panel_name, "panel_P_ASG_17_1_0_18", MakeRGB(255,255,255));  
                            break;                              
                        default:
                            PrintIndicationError("Illegal IndType");
                            break;
                    }
                    break;
            case Bap_error:
                gP_ASG_17_1_0_18_ErrCode = 0;
                putValue(P_ASG_17_1_0_18_ErrCode,  gBAP_Indication_header[5]);
                setControlBackColor(panel_name, "errfield_P_ASG_17_1_0_18", MakeRGB(255,79,79));  
                setControlBackColor(panel_name, "panel_P_ASG_17_1_0_18", MakeRGB(220,220,220));  
                break;
            case Bap_acknowledge:
                break;
            default:
                    PrintIndicationError("Illegal DataType");
                    break;
        }
    break;
    case P_ASG_17_1_0_19_ID: 
        switch(gBAP_Indication_header[3]) // Datentyp 
        {
            case Bap_uint8:
                    switch(gBAP_Indication_header[2]) // IndType
                    {
                        case Data_IND: // Indicationtyp pruefen
                            // Daten setzen
                            putValue(P_ASG_17_1_0_19, gBAP_Indication_header[5]);
                            setControlBackColor(panel_name, "errfield_P_ASG_17_1_0_19", MakeRGB(255,255,255));  
                            setControlBackColor(panel_name, "panel_P_ASG_17_1_0_19", MakeRGB(255,255,255));  
                            break;                              
                        default:
                            PrintIndicationError("Illegal IndType");
                            break;
                    }
                    break;
            case Bap_error:
                gP_ASG_17_1_0_19_ErrCode = 0;
                putValue(P_ASG_17_1_0_19_ErrCode,  gBAP_Indication_header[5]);
                setControlBackColor(panel_name, "errfield_P_ASG_17_1_0_19", MakeRGB(255,79,79));  
                setControlBackColor(panel_name, "panel_P_ASG_17_1_0_19", MakeRGB(220,220,220));  
                break;
            case Bap_acknowledge:
                break;
            default:
                    PrintIndicationError("Illegal DataType");
                    break;
        }
    break;
    case P_ASG_17_1_0_20_ID: 
        switch(gBAP_Indication_header[3]) // Datentyp 
        {
            case Bap_byteSequence:
                switch (gBAP_Indication_header[2]) // IndType
                {
                    case Data_IND: // Indicationtyp pruefen
                        // Daten setzen
                        putValue(P_ASG_17_1_0_20, gBAP_Indication_data, gBAP_Indication_header[4]);
                        setControlBackColor(panel_name, "errfield_P_ASG_17_1_0_20", MakeRGB(255,255,255));  
                        setControlBackColor(panel_name, "panel_P_ASG_17_1_0_20", MakeRGB(255,255,255));  
                        break;
                    default:
                        PrintIndicationError("Illegal IndType");
                        break;
                }
                break;
            case Bap_error:
                gP_ASG_17_1_0_20_ErrCode = 0;
                putValue(P_ASG_17_1_0_20_ErrCode,  gBAP_Indication_header[5]);
                setControlBackColor(panel_name, "errfield_P_ASG_17_1_0_20", MakeRGB(255,79,79));  
                setControlBackColor(panel_name, "panel_P_ASG_17_1_0_20", MakeRGB(220,220,220));  
                break;
            case Bap_acknowledge:
                break;
            default:
                PrintIndicationError("Illegal DataType");
                break;
        }
    break;
    case P_ASG_17_1_0_21_ID: 
        switch(gBAP_Indication_header[3]) // Datentyp 
        {
            case Bap_byteSequence:
                switch (gBAP_Indication_header[2]) // IndType
                {
                    case Data_IND: // Indicationtyp pruefen
                        // Daten setzen
                        putValue(P_ASG_17_1_0_21, gBAP_Indication_data, gBAP_Indication_header[4]);
                        setControlBackColor(panel_name, "errfield_P_ASG_17_1_0_21", MakeRGB(255,255,255));  
                        setControlBackColor(panel_name, "panel_P_ASG_17_1_0_21", MakeRGB(255,255,255));  
                        break;
                    default:
                        PrintIndicationError("Illegal IndType");
                        break;
                }
                break;
            case Bap_error:
                gP_ASG_17_1_0_21_ErrCode = 0;
                putValue(P_ASG_17_1_0_21_ErrCode,  gBAP_Indication_header[5]);
                setControlBackColor(panel_name, "errfield_P_ASG_17_1_0_21", MakeRGB(255,79,79));  
                setControlBackColor(panel_name, "panel_P_ASG_17_1_0_21", MakeRGB(220,220,220));  
                break;
            case Bap_acknowledge:
                break;
            default:
                PrintIndicationError("Illegal DataType");
                break;
        }
    break;
    case P_ASG_17_1_0_22_ID: 
        switch(gBAP_Indication_header[3]) // Datentyp 
        {
            case Bap_byteSequence:
                switch (gBAP_Indication_header[2]) // IndType
                {
                    case Data_IND: // Indicationtyp pruefen
                        // Daten setzen
                        putValue(P_ASG_17_1_0_22, gBAP_Indication_data, gBAP_Indication_header[4]);
                        setControlBackColor(panel_name, "errfield_P_ASG_17_1_0_22", MakeRGB(255,255,255));  
                        setControlBackColor(panel_name, "panel_P_ASG_17_1_0_22", MakeRGB(255,255,255));  
                        break;
                    default:
                        PrintIndicationError("Illegal IndType");
                        break;
                }
                break;
            case Bap_error:
                gP_ASG_17_1_0_22_ErrCode = 0;
                putValue(P_ASG_17_1_0_22_ErrCode,  gBAP_Indication_header[5]);
                setControlBackColor(panel_name, "errfield_P_ASG_17_1_0_22", MakeRGB(255,79,79));  
                setControlBackColor(panel_name, "panel_P_ASG_17_1_0_22", MakeRGB(220,220,220));  
                break;
            case Bap_acknowledge:
                break;
            default:
                PrintIndicationError("Illegal DataType");
                break;
        }
    break;
    case P_ASG_17_1_0_23_ID: 
        switch(gBAP_Indication_header[3]) // Datentyp 
        {
            case Bap_byteSequence:
                switch (gBAP_Indication_header[2]) // IndType
                {
                    case Data_IND: // Indicationtyp pruefen
                        // Daten setzen
                        putValue(P_ASG_17_1_0_23, gBAP_Indication_data, gBAP_Indication_header[4]);
                        setControlBackColor(panel_name, "errfield_P_ASG_17_1_0_23", MakeRGB(255,255,255));  
                        setControlBackColor(panel_name, "panel_P_ASG_17_1_0_23", MakeRGB(255,255,255));  
                        break;
                    default:
                        PrintIndicationError("Illegal IndType");
                        break;
                }
                break;
            case Bap_error:
                gP_ASG_17_1_0_23_ErrCode = 0;
                putValue(P_ASG_17_1_0_23_ErrCode,  gBAP_Indication_header[5]);
                setControlBackColor(panel_name, "errfield_P_ASG_17_1_0_23", MakeRGB(255,79,79));  
                setControlBackColor(panel_name, "panel_P_ASG_17_1_0_23", MakeRGB(220,220,220));  
                break;
            case Bap_acknowledge:
                break;
            default:
                PrintIndicationError("Illegal DataType");
                break;
        }
    break;
    case P_ASG_17_1_0_24_ID: 
        switch(gBAP_Indication_header[3]) // Datentyp 
        {
            case Bap_byteSequence:
                switch (gBAP_Indication_header[2]) // IndType
                {
                    case Data_IND: // Indicationtyp pruefen
                        // Daten setzen
                        putValue(P_ASG_17_1_0_24, gBAP_Indication_data, gBAP_Indication_header[4]);
                        setControlBackColor(panel_name, "errfield_P_ASG_17_1_0_24", MakeRGB(255,255,255));  
                        setControlBackColor(panel_name, "panel_P_ASG_17_1_0_24", MakeRGB(255,255,255));  
                        break;
                    default:
                        PrintIndicationError("Illegal IndType");
                        break;
                }
                break;
            case Bap_error:
                gP_ASG_17_1_0_24_ErrCode = 0;
                putValue(P_ASG_17_1_0_24_ErrCode,  gBAP_Indication_header[5]);
                setControlBackColor(panel_name, "errfield_P_ASG_17_1_0_24", MakeRGB(255,79,79));  
                setControlBackColor(panel_name, "panel_P_ASG_17_1_0_24", MakeRGB(220,220,220));  
                break;
            case Bap_acknowledge:
                break;
            default:
                PrintIndicationError("Illegal DataType");
                break;
        }
    break;
    case P_ASG_17_1_0_25_ID: 
        switch(gBAP_Indication_header[3]) // Datentyp 
        {
            case Bap_byteSequence:
                switch (gBAP_Indication_header[2]) // IndType
                {
                    case Data_IND: // Indicationtyp pruefen
                        // Daten setzen
                        putValue(P_ASG_17_1_0_25, gBAP_Indication_data, gBAP_Indication_header[4]);
                        setControlBackColor(panel_name, "errfield_P_ASG_17_1_0_25", MakeRGB(255,255,255));  
                        setControlBackColor(panel_name, "panel_P_ASG_17_1_0_25", MakeRGB(255,255,255));  
                        break;
                    default:
                        PrintIndicationError("Illegal IndType");
                        break;
                }
                break;
            case Bap_error:
                gP_ASG_17_1_0_25_ErrCode = 0;
                putValue(P_ASG_17_1_0_25_ErrCode,  gBAP_Indication_header[5]);
                setControlBackColor(panel_name, "errfield_P_ASG_17_1_0_25", MakeRGB(255,79,79));  
                setControlBackColor(panel_name, "panel_P_ASG_17_1_0_25", MakeRGB(220,220,220));  
                break;
            case Bap_acknowledge:
                break;
            default:
                PrintIndicationError("Illegal DataType");
                break;
        }
    break;
    case P_ASG_17_1_0_26_ID: 
        switch(gBAP_Indication_header[3]) // Datentyp 
        {
            case Bap_byteSequence:
                switch (gBAP_Indication_header[2]) // IndType
                {
                    case Data_IND: // Indicationtyp pruefen
                        // Daten setzen
                        putValue(P_ASG_17_1_0_26, gBAP_Indication_data, gBAP_Indication_header[4]);
                        setControlBackColor(panel_name, "errfield_P_ASG_17_1_0_26", MakeRGB(255,255,255));  
                        setControlBackColor(panel_name, "panel_P_ASG_17_1_0_26", MakeRGB(255,255,255));  
                        break;
                    default:
                        PrintIndicationError("Illegal IndType");
                        break;
                }
                break;
            case Bap_error:
                gP_ASG_17_1_0_26_ErrCode = 0;
                putValue(P_ASG_17_1_0_26_ErrCode,  gBAP_Indication_header[5]);
                setControlBackColor(panel_name, "errfield_P_ASG_17_1_0_26", MakeRGB(255,79,79));  
                setControlBackColor(panel_name, "panel_P_ASG_17_1_0_26", MakeRGB(220,220,220));  
                break;
            case Bap_acknowledge:
                break;
            default:
                PrintIndicationError("Illegal DataType");
                break;
        }
    break;
    case P_ASG_17_1_0_27_ID: 
        switch(gBAP_Indication_header[3]) // Datentyp 
        {
            case Bap_byteSequence:
                switch (gBAP_Indication_header[2]) // IndType
                {
                    case Data_IND: // Indicationtyp pruefen
                        // Daten setzen
                        putValue(P_ASG_17_1_0_27, gBAP_Indication_data, gBAP_Indication_header[4]);
                        setControlBackColor(panel_name, "errfield_P_ASG_17_1_0_27", MakeRGB(255,255,255));  
                        setControlBackColor(panel_name, "panel_P_ASG_17_1_0_27", MakeRGB(255,255,255));  
                        break;
                    default:
                        PrintIndicationError("Illegal IndType");
                        break;
                }
                break;
            case Bap_error:
                gP_ASG_17_1_0_27_ErrCode = 0;
                putValue(P_ASG_17_1_0_27_ErrCode,  gBAP_Indication_header[5]);
                setControlBackColor(panel_name, "errfield_P_ASG_17_1_0_27", MakeRGB(255,79,79));  
                setControlBackColor(panel_name, "panel_P_ASG_17_1_0_27", MakeRGB(220,220,220));  
                break;
            case Bap_acknowledge:
                break;
            default:
                PrintIndicationError("Illegal DataType");
                break;
        }
    break;
    case P_ASG_17_1_0_28_ID: 
        switch(gBAP_Indication_header[3]) // Datentyp 
        {
            case Bap_byteSequence:
                switch (gBAP_Indication_header[2]) // IndType
                {
                    case Data_IND: // Indicationtyp pruefen
                        // Daten setzen
                        putValue(P_ASG_17_1_0_28, gBAP_Indication_data, gBAP_Indication_header[4]);
                        setControlBackColor(panel_name, "errfield_P_ASG_17_1_0_28", MakeRGB(255,255,255));  
                        setControlBackColor(panel_name, "panel_P_ASG_17_1_0_28", MakeRGB(255,255,255));  
                        break;
                    default:
                        PrintIndicationError("Illegal IndType");
                        break;
                }
                break;
            case Bap_error:
                gP_ASG_17_1_0_28_ErrCode = 0;
                putValue(P_ASG_17_1_0_28_ErrCode,  gBAP_Indication_header[5]);
                setControlBackColor(panel_name, "errfield_P_ASG_17_1_0_28", MakeRGB(255,79,79));  
                setControlBackColor(panel_name, "panel_P_ASG_17_1_0_28", MakeRGB(220,220,220));  
                break;
            case Bap_acknowledge:
                break;
            default:
                PrintIndicationError("Illegal DataType");
                break;
        }
    break;
    case P_ASG_17_1_0_29_ID: 
        switch(gBAP_Indication_header[3]) // Datentyp 
        {
            case Bap_byteSequence:
                switch (gBAP_Indication_header[2]) // IndType
                {
                    case Data_IND: // Indicationtyp pruefen
                        // Daten setzen
                        putValue(P_ASG_17_1_0_29, gBAP_Indication_data, gBAP_Indication_header[4]);
                        setControlBackColor(panel_name, "errfield_P_ASG_17_1_0_29", MakeRGB(255,255,255));  
                        setControlBackColor(panel_name, "panel_P_ASG_17_1_0_29", MakeRGB(255,255,255));  
                        break;
                    default:
                        PrintIndicationError("Illegal IndType");
                        break;
                }
                break;
            case Bap_error:
                gP_ASG_17_1_0_29_ErrCode = 0;
                putValue(P_ASG_17_1_0_29_ErrCode,  gBAP_Indication_header[5]);
                setControlBackColor(panel_name, "errfield_P_ASG_17_1_0_29", MakeRGB(255,79,79));  
                setControlBackColor(panel_name, "panel_P_ASG_17_1_0_29", MakeRGB(220,220,220));  
                break;
            case Bap_acknowledge:
                break;
            default:
                PrintIndicationError("Illegal DataType");
                break;
        }
    break;
    case P_ASG_17_1_0_30_ID: 
        switch(gBAP_Indication_header[3]) // Datentyp 
        {
            case Bap_byteSequence:
                switch (gBAP_Indication_header[2]) // IndType
                {
                    case Data_IND: // Indicationtyp pruefen
                        // Daten setzen
                        putValue(P_ASG_17_1_0_30, gBAP_Indication_data, gBAP_Indication_header[4]);
                        setControlBackColor(panel_name, "errfield_P_ASG_17_1_0_30", MakeRGB(255,255,255));  
                        setControlBackColor(panel_name, "panel_P_ASG_17_1_0_30", MakeRGB(255,255,255));  
                        break;
                    default:
                        PrintIndicationError("Illegal IndType");
                        break;
                }
                break;
            case Bap_error:
                gP_ASG_17_1_0_30_ErrCode = 0;
                putValue(P_ASG_17_1_0_30_ErrCode,  gBAP_Indication_header[5]);
                setControlBackColor(panel_name, "errfield_P_ASG_17_1_0_30", MakeRGB(255,79,79));  
                setControlBackColor(panel_name, "panel_P_ASG_17_1_0_30", MakeRGB(220,220,220));  
                break;
            case Bap_acknowledge:
                break;
            default:
                PrintIndicationError("Illegal DataType");
                break;
        }
    break;
       default:
           writelineEx(gError_Trace, 0, "NodeIndex: %d: Illegal Fct: lsgid:%d fctid:%d indType:%d",
           NODE_INDEX, gBAP_Indication_header[0], gBAP_Indication_header[1], gBAP_Indication_header[2]);
           break;
       }
       break;
   default:
       writelineEx(gError_Trace, 0, "NodeIndex: %d: Illegal LSGID: lsgid:%d fctid:%d indType:%s", NODE_INDEX, gBAP_Indication_header[0], gBAP_Indication_header[1], Indicationtype_Text[gBAP_Indication_header[2]]);
       break;
   }
}

on message BAP_Uhrzeit_FSG_01
{
   int i, temp;
   byte RX_Data[8];            // received CAN-DATA
   dword RX_Header[3];         // received CAN-Header
   if(gSG_PowerOnOff==Power_on){
       RX_Header[0]=this.CAN;
       RX_Header[1]=this.ID;
       RX_Header[2]=this.DLC; // received length
       for (i=0; i<this.DLC; i++) {
           RX_Data[i]=this.byte(i);
       }
       temp=BAP150_CAN_SetRxDat(NODE_INDEX, RX_Header, RX_Data);
   }
}

intertelegram_err(long fctId)
{
    long data[4];
    data[0]=LSGID;
    data[1]=fctId;
    data[2]=1;
    data[3]=940;
    ChangeConfig(0x0020,data);
}

sequence_err(long fctId, long size)
{
    long data[5];
    long lastSeg;

    lastSeg = size-5;

    data[0]=LSGID;
    data[1]=fctId;
    data[2]=lastSeg/7+1;
    data[3]=1;
    data[4]=(lastSeg/7+4) & 15;
    ChangeConfig(0x0021,data);
}

intertelegram_err_off(long fctId)
{
    long data[4];
    data[0]=LSGID;
    data[1]=fctId;
    data[2]=5000;
    data[3]=0;
    ChangeConfig(0x0020,data);
}

sequence_err_off(long fctId)
{
    long data[5];

    data[0]=LSGID;
    data[1]=fctId;
    data[2]=5000;
    data[3]=0;
    data[4]=0;
    ChangeConfig(0x0021,data);
}

on envVar ON_OFF_ASG17_1
{
   BapOnOff(getvalue(this));
   gSG_PowerOnOff=getvalue(ON_OFF_ASG17_1);
}

on envVar C_ASG_17_1_0_1GetAll_BTN
{
 if (C_ASG_17_1_0_1GetAll_BTN_already_pressed == 0)
  {
     C_ASG_17_1_0_1GetAll_BTN_already_pressed = 1;
     Request_Void(LSGID, C_ASG_17_1_0_1_ID, DataGet_REQ); 
     putValue(C_ASG_17_1_0_1_State, "GetAll");
     setControlBackColor(panel_name, "errfield_C_ASG_17_1_0_1_State", MakeRGB(255,255,255));
 }
 else
 {
     C_ASG_17_1_0_1GetAll_BTN_already_pressed = 0;
 }
}

on envVar P_ASG_17_1_0_2Get_BTN
{
 if (P_ASG_17_1_0_2Get_BTN_already_pressed == 0)
  {
       putValue(P_ASG_17_1_0_2_ErrCode,0);
       SetControlBackColor(panel_name,"errField_P_ASG_17_1_0_2",MakeRGB(255,255,255));
       P_ASG_17_1_0_2Get_BTN_already_pressed = 1;
 }
 else
 {
       Request_Void(LSGID, P_ASG_17_1_0_2_ID, DataGet_REQ); 
       P_ASG_17_1_0_2Get_BTN_already_pressed = 0;
 }
}

on envVar P_ASG_17_1_0_3Get_BTN
{
 if (P_ASG_17_1_0_3Get_BTN_already_pressed == 0)
  {
       putValue(P_ASG_17_1_0_3_ErrCode,0);
       SetControlBackColor(panel_name,"errField_P_ASG_17_1_0_3",MakeRGB(255,255,255));
       P_ASG_17_1_0_3Get_BTN_already_pressed = 1;
 }
 else
 {
       Request_Void(LSGID, P_ASG_17_1_0_3_ID, DataGet_REQ); 
       P_ASG_17_1_0_3Get_BTN_already_pressed = 0;
 }
}

on envVar P_ASG_17_1_0_4Get_BTN
{
 if (P_ASG_17_1_0_4Get_BTN_already_pressed == 0)
  {
       putValue(P_ASG_17_1_0_4_ErrCode,0);
       SetControlBackColor(panel_name,"errField_P_ASG_17_1_0_4",MakeRGB(255,255,255));
       P_ASG_17_1_0_4Get_BTN_already_pressed = 1;
 }
 else
 {
       Request_Void(LSGID, P_ASG_17_1_0_4_ID, DataGet_REQ); 
       P_ASG_17_1_0_4Get_BTN_already_pressed = 0;
 }
}

on envVar P_ASG_17_1_0_13Get_BTN
{
 if (P_ASG_17_1_0_13Get_BTN_already_pressed == 0)
  {
       putValue(P_ASG_17_1_0_13_ErrCode,0);
       SetControlBackColor(panel_name,"errField_P_ASG_17_1_0_13",MakeRGB(255,255,255));
       P_ASG_17_1_0_13Get_BTN_already_pressed = 1;
 }
 else
 {
       Request_Void(LSGID, P_ASG_17_1_0_13_ID, DataGet_REQ); 
       P_ASG_17_1_0_13Get_BTN_already_pressed = 0;
 }
}

on envVar P_ASG_17_1_0_13SetGet_BTN
{
    if (P_ASG_17_1_0_13SetGet_BTN_already_pressed == 0)
    {
       putValue(P_ASG_17_1_0_13_ErrCode,0);
       SetControlBackColor(panel_name,"errField_P_ASG_17_1_0_13",MakeRGB(255,255,255));
       P_ASG_17_1_0_13SetGet_BTN_already_pressed = 1;
    }
    else
    {
       Request_Int8(LSGID, P_ASG_17_1_0_13_ID, DataSetGet_REQ, getValue(P_ASG_17_1_0_13));
       P_ASG_17_1_0_13SetGet_BTN_already_pressed = 0;
    }
}

on envVar P_ASG_17_1_0_13
{
	int i;
	byte superval;
	byte param1;
	superval = getValue(P_ASG_17_1_0_13);
	param1 = superval;
	putValue(P_ASG_17_1_0_13_1, param1);
}

on envVar P_ASG_17_1_0_13_1_0
{
	byte bitval;
	//thisval steht hier fuer den bitfield-wert, 
	//aus Generierungsgruenden hier keine einheitliche Bezeichnung moeglich.
	byte thisval;
	bitval= getValue(this);
	thisval= getValue(P_ASG_17_1_0_13_1);
	putValue(P_ASG_17_1_0_13_1, thisval&~(1<<0)|(bitval<<0));
}

on envVar P_ASG_17_1_0_13_1_4
{
	byte bitval;
	//thisval steht hier fuer den bitfield-wert, 
	//aus Generierungsgruenden hier keine einheitliche Bezeichnung moeglich.
	byte thisval;
	bitval= getValue(this);
	thisval= getValue(P_ASG_17_1_0_13_1);
	putValue(P_ASG_17_1_0_13_1, thisval&~(1<<4)|(bitval<<4));
}

on envVar P_ASG_17_1_0_13_1
{
	byte mask=0x1;
	byte thisval;
	byte superval;
	thisval=getValue(this);
	if(thisval&(mask<<0))
		putValue(P_ASG_17_1_0_13_1_0, 1);
	else
		putValue(P_ASG_17_1_0_13_1_0, 0);
	if(thisval&(mask<<4))
		putValue(P_ASG_17_1_0_13_1_4, 1);
	else
		putValue(P_ASG_17_1_0_13_1_4, 0);
	superval = getValue(P_ASG_17_1_0_13);
	superval=thisval;
	putValue(P_ASG_17_1_0_13,superval);
}

on envVar P_ASG_17_1_0_14Get_BTN
{
 if (P_ASG_17_1_0_14Get_BTN_already_pressed == 0)
  {
       putValue(P_ASG_17_1_0_14_ErrCode,0);
       SetControlBackColor(panel_name,"errField_P_ASG_17_1_0_14",MakeRGB(255,255,255));
       P_ASG_17_1_0_14Get_BTN_already_pressed = 1;
 }
 else
 {
       Request_Void(LSGID, P_ASG_17_1_0_14_ID, DataGet_REQ); 
       P_ASG_17_1_0_14Get_BTN_already_pressed = 0;
 }
}

on envVar P_ASG_17_1_0_14
{
	int i;
	byte superval;
	byte param1;
	superval = getValue(P_ASG_17_1_0_14);
	param1 = superval;
	putValue(P_ASG_17_1_0_14_1, param1);
}

on envVar P_ASG_17_1_0_14_1_0
{
	byte bitval;
	//thisval steht hier fuer den bitfield-wert, 
	//aus Generierungsgruenden hier keine einheitliche Bezeichnung moeglich.
	byte thisval;
	bitval= getValue(this);
	thisval= getValue(P_ASG_17_1_0_14_1);
	putValue(P_ASG_17_1_0_14_1, thisval&~(1<<0)|(bitval<<0));
}

on envVar P_ASG_17_1_0_14_1_1
{
	byte bitval;
	//thisval steht hier fuer den bitfield-wert, 
	//aus Generierungsgruenden hier keine einheitliche Bezeichnung moeglich.
	byte thisval;
	bitval= getValue(this);
	thisval= getValue(P_ASG_17_1_0_14_1);
	putValue(P_ASG_17_1_0_14_1, thisval&~(1<<1)|(bitval<<1));
}

on envVar P_ASG_17_1_0_14_1_2
{
	byte bitval;
	//thisval steht hier fuer den bitfield-wert, 
	//aus Generierungsgruenden hier keine einheitliche Bezeichnung moeglich.
	byte thisval;
	bitval= getValue(this);
	thisval= getValue(P_ASG_17_1_0_14_1);
	putValue(P_ASG_17_1_0_14_1, thisval&~(1<<2)|(bitval<<2));
}

on envVar P_ASG_17_1_0_14_1_3
{
	byte bitval;
	//thisval steht hier fuer den bitfield-wert, 
	//aus Generierungsgruenden hier keine einheitliche Bezeichnung moeglich.
	byte thisval;
	bitval= getValue(this);
	thisval= getValue(P_ASG_17_1_0_14_1);
	putValue(P_ASG_17_1_0_14_1, thisval&~(1<<3)|(bitval<<3));
}

on envVar P_ASG_17_1_0_14_1
{
	byte mask=0x1;
	byte thisval;
	byte superval;
	thisval=getValue(this);
	if(thisval&(mask<<0))
		putValue(P_ASG_17_1_0_14_1_0, 1);
	else
		putValue(P_ASG_17_1_0_14_1_0, 0);
	if(thisval&(mask<<1))
		putValue(P_ASG_17_1_0_14_1_1, 1);
	else
		putValue(P_ASG_17_1_0_14_1_1, 0);
	if(thisval&(mask<<2))
		putValue(P_ASG_17_1_0_14_1_2, 1);
	else
		putValue(P_ASG_17_1_0_14_1_2, 0);
	if(thisval&(mask<<3))
		putValue(P_ASG_17_1_0_14_1_3, 1);
	else
		putValue(P_ASG_17_1_0_14_1_3, 0);
	superval = getValue(P_ASG_17_1_0_14);
	superval=thisval;
	putValue(P_ASG_17_1_0_14,superval);
}

on envVar P_ASG_17_1_0_15Get_BTN
{
 if (P_ASG_17_1_0_15Get_BTN_already_pressed == 0)
  {
       putValue(P_ASG_17_1_0_15_ErrCode,0);
       SetControlBackColor(panel_name,"errField_P_ASG_17_1_0_15",MakeRGB(255,255,255));
       P_ASG_17_1_0_15Get_BTN_already_pressed = 1;
 }
 else
 {
       Request_Void(LSGID, P_ASG_17_1_0_15_ID, DataGet_REQ); 
       P_ASG_17_1_0_15Get_BTN_already_pressed = 0;
 }
}

on envVar P_ASG_17_1_0_15
{
	int i;
	byte superval;
	byte param1;
	superval = getValue(P_ASG_17_1_0_15);
	param1 = superval;
	putValue(P_ASG_17_1_0_15_1, param1);
}

on envVar P_ASG_17_1_0_15_1
{
	byte thisval;
	byte superval;
	thisval=getValue(this);
	superval = getValue(P_ASG_17_1_0_15);
	superval=thisval;
	putValue(P_ASG_17_1_0_15,superval);
}

on envVar P_ASG_17_1_0_16Get_BTN
{
 if (P_ASG_17_1_0_16Get_BTN_already_pressed == 0)
  {
       putValue(P_ASG_17_1_0_16_ErrCode,0);
       SetControlBackColor(panel_name,"errField_P_ASG_17_1_0_16",MakeRGB(255,255,255));
       P_ASG_17_1_0_16Get_BTN_already_pressed = 1;
 }
 else
 {
       Request_Void(LSGID, P_ASG_17_1_0_16_ID, DataGet_REQ); 
       P_ASG_17_1_0_16Get_BTN_already_pressed = 0;
 }
}

on envVar P_ASG_17_1_0_16SetGet_BTN
{
	byte BAPTemp[3];
    if (P_ASG_17_1_0_16SetGet_BTN_already_pressed == 0)
    {
       putValue(P_ASG_17_1_0_16_ErrCode,0);
       SetControlBackColor(panel_name,"errField_P_ASG_17_1_0_16",MakeRGB(255,255,255));
       P_ASG_17_1_0_16SetGet_BTN_already_pressed = 1;
    }
    else
    {
       getValue(P_ASG_17_1_0_16, BAPTemp);
       Request_ByteSequence(LSGID, P_ASG_17_1_0_16_ID, DataSetGet_REQ, BAPTemp, getValueSize(P_ASG_17_1_0_16));
       P_ASG_17_1_0_16SetGet_BTN_already_pressed = 0;
    }
}

on envVar P_ASG_17_1_0_16
{
	int i;
	byte superval[3];
	byte param1;
	byte param2;
	byte param3;
	getValue(P_ASG_17_1_0_16, superval);
	param1 = superval[0];
	putValue(P_ASG_17_1_0_16_1, param1);
	getValue(P_ASG_17_1_0_16, superval);
	param2 = superval[1];
	putValue(P_ASG_17_1_0_16_2, param2);
	getValue(P_ASG_17_1_0_16, superval);
	param3 = superval[2];
	putValue(P_ASG_17_1_0_16_3, param3);
}

// Ueberwachung der Darstellungsvariable der Range
on envVar P_ASG_17_1_0_16_1_range
{
	double thisval, helpval;
	thisval=getValue(this);
	helpval=(thisval-(2000.0))*(1.0);
	if(thisval<0)
		helpval=round(helpval-((word)(helpval+2)),1)+((word)(helpval+2));
	else
		helpval=round(helpval, 1);
	putValue(P_ASG_17_1_0_16_1, helpval);
}

// Ueberwachung der Range-Variable im uebertragungsformat (nicht sichtbar)
on envVar P_ASG_17_1_0_16_1
{
	byte thisval;
	byte superval[3];
	thisval=getValue(this);
	putValue(P_ASG_17_1_0_16_1_range, round((thisval*(1.0) + (2000.0)),(1)));
	getValue(P_ASG_17_1_0_16, superval);
	superval[0]=thisval;
	putValue(P_ASG_17_1_0_16,superval);
}

// Ueberwachung der Darstellungsvariable der Range
on envVar P_ASG_17_1_0_16_2_range
{
	double thisval, helpval;
	thisval=getValue(this);
	helpval=(thisval-(0.0))*(1.0);
	if(thisval<0)
		helpval=round(helpval-((word)(helpval+2)),1)+((word)(helpval+2));
	else
		helpval=round(helpval, 1);
	putValue(P_ASG_17_1_0_16_2, helpval);
}

// Ueberwachung der Range-Variable im uebertragungsformat (nicht sichtbar)
on envVar P_ASG_17_1_0_16_2
{
	byte thisval;
	byte superval[3];
	thisval=getValue(this);
	putValue(P_ASG_17_1_0_16_2_range, round((thisval*(1.0) + (0.0)),(1)));
	getValue(P_ASG_17_1_0_16, superval);
	superval[1]=thisval;
	putValue(P_ASG_17_1_0_16,superval);
}

// Ueberwachung der Darstellungsvariable der Range
on envVar P_ASG_17_1_0_16_3_range
{
	double thisval, helpval;
	thisval=getValue(this);
	helpval=(thisval-(0.0))*(1.0);
	if(thisval<0)
		helpval=round(helpval-((word)(helpval+2)),1)+((word)(helpval+2));
	else
		helpval=round(helpval, 1);
	putValue(P_ASG_17_1_0_16_3, helpval);
}

// Ueberwachung der Range-Variable im uebertragungsformat (nicht sichtbar)
on envVar P_ASG_17_1_0_16_3
{
	byte thisval;
	byte superval[3];
	thisval=getValue(this);
	putValue(P_ASG_17_1_0_16_3_range, round((thisval*(1.0) + (0.0)),(1)));
	getValue(P_ASG_17_1_0_16, superval);
	superval[2]=thisval;
	putValue(P_ASG_17_1_0_16,superval);
}

on envVar P_ASG_17_1_0_17Get_BTN
{
 if (P_ASG_17_1_0_17Get_BTN_already_pressed == 0)
  {
       putValue(P_ASG_17_1_0_17_ErrCode,0);
       SetControlBackColor(panel_name,"errField_P_ASG_17_1_0_17",MakeRGB(255,255,255));
       P_ASG_17_1_0_17Get_BTN_already_pressed = 1;
 }
 else
 {
       Request_Void(LSGID, P_ASG_17_1_0_17_ID, DataGet_REQ); 
       P_ASG_17_1_0_17Get_BTN_already_pressed = 0;
 }
}

on envVar P_ASG_17_1_0_17SetGet_BTN
{
	byte BAPTemp[3];
    if (P_ASG_17_1_0_17SetGet_BTN_already_pressed == 0)
    {
       putValue(P_ASG_17_1_0_17_ErrCode,0);
       SetControlBackColor(panel_name,"errField_P_ASG_17_1_0_17",MakeRGB(255,255,255));
       P_ASG_17_1_0_17SetGet_BTN_already_pressed = 1;
    }
    else
    {
       getValue(P_ASG_17_1_0_17, BAPTemp);
       Request_ByteSequence(LSGID, P_ASG_17_1_0_17_ID, DataSetGet_REQ, BAPTemp, getValueSize(P_ASG_17_1_0_17));
       P_ASG_17_1_0_17SetGet_BTN_already_pressed = 0;
    }
}

on envVar P_ASG_17_1_0_17
{
	int i;
	byte superval[3];
	byte param1;
	byte param2;
	byte param3;
	getValue(P_ASG_17_1_0_17, superval);
	param1 = superval[0];
	putValue(P_ASG_17_1_0_17_1, param1);
	getValue(P_ASG_17_1_0_17, superval);
	param2 = superval[1];
	putValue(P_ASG_17_1_0_17_2, param2);
	getValue(P_ASG_17_1_0_17, superval);
	param3 = superval[2];
	putValue(P_ASG_17_1_0_17_3, param3);
}

// Ueberwachung der Darstellungsvariable der Range
on envVar P_ASG_17_1_0_17_1_range
{
	double thisval, helpval;
	thisval=getValue(this);
	helpval=(thisval-(0.0))*(1.0);
	if(thisval<0)
		helpval=round(helpval-((word)(helpval+2)),1)+((word)(helpval+2));
	else
		helpval=round(helpval, 1);
	putValue(P_ASG_17_1_0_17_1, helpval);
}

// Ueberwachung der Range-Variable im uebertragungsformat (nicht sichtbar)
on envVar P_ASG_17_1_0_17_1
{
	byte thisval;
	byte superval[3];
	thisval=getValue(this);
	putValue(P_ASG_17_1_0_17_1_range, round((thisval*(1.0) + (0.0)),(1)));
	getValue(P_ASG_17_1_0_17, superval);
	superval[0]=thisval;
	putValue(P_ASG_17_1_0_17,superval);
}

// Ueberwachung der Darstellungsvariable der Range
on envVar P_ASG_17_1_0_17_2_range
{
	double thisval, helpval;
	thisval=getValue(this);
	helpval=(thisval-(0.0))*(1.0);
	if(thisval<0)
		helpval=round(helpval-((word)(helpval+2)),1)+((word)(helpval+2));
	else
		helpval=round(helpval, 1);
	putValue(P_ASG_17_1_0_17_2, helpval);
}

// Ueberwachung der Range-Variable im uebertragungsformat (nicht sichtbar)
on envVar P_ASG_17_1_0_17_2
{
	byte thisval;
	byte superval[3];
	thisval=getValue(this);
	putValue(P_ASG_17_1_0_17_2_range, round((thisval*(1.0) + (0.0)),(1)));
	getValue(P_ASG_17_1_0_17, superval);
	superval[1]=thisval;
	putValue(P_ASG_17_1_0_17,superval);
}

// Ueberwachung der Darstellungsvariable der Range
on envVar P_ASG_17_1_0_17_3_range
{
	double thisval, helpval;
	thisval=getValue(this);
	helpval=(thisval-(0.0))*(1.0);
	if(thisval<0)
		helpval=round(helpval-((word)(helpval+2)),1)+((word)(helpval+2));
	else
		helpval=round(helpval, 1);
	putValue(P_ASG_17_1_0_17_3, helpval);
}

// Ueberwachung der Range-Variable im uebertragungsformat (nicht sichtbar)
on envVar P_ASG_17_1_0_17_3
{
	byte thisval;
	byte superval[3];
	thisval=getValue(this);
	putValue(P_ASG_17_1_0_17_3_range, round((thisval*(1.0) + (0.0)),(1)));
	getValue(P_ASG_17_1_0_17, superval);
	superval[2]=thisval;
	putValue(P_ASG_17_1_0_17,superval);
}

on envVar P_ASG_17_1_0_18Get_BTN
{
 if (P_ASG_17_1_0_18Get_BTN_already_pressed == 0)
  {
       putValue(P_ASG_17_1_0_18_ErrCode,0);
       SetControlBackColor(panel_name,"errField_P_ASG_17_1_0_18",MakeRGB(255,255,255));
       P_ASG_17_1_0_18Get_BTN_already_pressed = 1;
 }
 else
 {
       Request_Void(LSGID, P_ASG_17_1_0_18_ID, DataGet_REQ); 
       P_ASG_17_1_0_18Get_BTN_already_pressed = 0;
 }
}

on envVar P_ASG_17_1_0_18SetGet_BTN
{
    if (P_ASG_17_1_0_18SetGet_BTN_already_pressed == 0)
    {
       putValue(P_ASG_17_1_0_18_ErrCode,0);
       SetControlBackColor(panel_name,"errField_P_ASG_17_1_0_18",MakeRGB(255,255,255));
       P_ASG_17_1_0_18SetGet_BTN_already_pressed = 1;
    }
    else
    {
       Request_Int8(LSGID, P_ASG_17_1_0_18_ID, DataSetGet_REQ, getValue(P_ASG_17_1_0_18));
       P_ASG_17_1_0_18SetGet_BTN_already_pressed = 0;
    }
}

on envVar P_ASG_17_1_0_18
{
	int i;
	byte superval;
	byte param1;
	superval = getValue(P_ASG_17_1_0_18);
	param1 = superval;
	putValue(P_ASG_17_1_0_18_1, param1);
}

// Ueberwachung der Darstellungsvariable der Range
on envVar P_ASG_17_1_0_18_1_range
{
	double thisval, helpval;
	thisval=getValue(this);
	helpval=(thisval-(-12.0))*(2.0);
	if(thisval<0)
		helpval=round(helpval-((word)(helpval+2)),1)+((word)(helpval+2));
	else
		helpval=round(helpval, 1);
	putValue(P_ASG_17_1_0_18_1, helpval);
}

// Ueberwachung der Range-Variable im uebertragungsformat (nicht sichtbar)
on envVar P_ASG_17_1_0_18_1
{
	byte thisval;
	byte superval;
	thisval=getValue(this);
	putValue(P_ASG_17_1_0_18_1_range, round((thisval*(0.5) + (-12.0)),(0.5)));
	superval = getValue(P_ASG_17_1_0_18);
	superval=thisval;
	putValue(P_ASG_17_1_0_18,superval);
}

on envVar P_ASG_17_1_0_19Get_BTN
{
 if (P_ASG_17_1_0_19Get_BTN_already_pressed == 0)
  {
       putValue(P_ASG_17_1_0_19_ErrCode,0);
       SetControlBackColor(panel_name,"errField_P_ASG_17_1_0_19",MakeRGB(255,255,255));
       P_ASG_17_1_0_19Get_BTN_already_pressed = 1;
 }
 else
 {
       Request_Void(LSGID, P_ASG_17_1_0_19_ID, DataGet_REQ); 
       P_ASG_17_1_0_19Get_BTN_already_pressed = 0;
 }
}

on envVar P_ASG_17_1_0_19SetGet_BTN
{
    if (P_ASG_17_1_0_19SetGet_BTN_already_pressed == 0)
    {
       putValue(P_ASG_17_1_0_19_ErrCode,0);
       SetControlBackColor(panel_name,"errField_P_ASG_17_1_0_19",MakeRGB(255,255,255));
       P_ASG_17_1_0_19SetGet_BTN_already_pressed = 1;
    }
    else
    {
       Request_Int8(LSGID, P_ASG_17_1_0_19_ID, DataSetGet_REQ, getValue(P_ASG_17_1_0_19));
       P_ASG_17_1_0_19SetGet_BTN_already_pressed = 0;
    }
}

on envVar P_ASG_17_1_0_19
{
	int i;
	byte superval;
	byte param1;
	superval = getValue(P_ASG_17_1_0_19);
	param1 = superval;
	putValue(P_ASG_17_1_0_19_1, param1);
}

on envVar P_ASG_17_1_0_19_1_0
{
	byte bitval;
	//thisval steht hier fuer den bitfield-wert, 
	//aus Generierungsgruenden hier keine einheitliche Bezeichnung moeglich.
	byte thisval;
	bitval= getValue(this);
	thisval= getValue(P_ASG_17_1_0_19_1);
	putValue(P_ASG_17_1_0_19_1, thisval&~(1<<0)|(bitval<<0));
}

on envVar P_ASG_17_1_0_19_1
{
	byte mask=0x1;
	byte thisval;
	byte superval;
	thisval=getValue(this);
	if(thisval&(mask<<0))
		putValue(P_ASG_17_1_0_19_1_0, 1);
	else
		putValue(P_ASG_17_1_0_19_1_0, 0);
	superval = getValue(P_ASG_17_1_0_19);
	superval=thisval;
	putValue(P_ASG_17_1_0_19,superval);
}

on envVar P_ASG_17_1_0_20Get_BTN
{
 if (P_ASG_17_1_0_20Get_BTN_already_pressed == 0)
  {
       putValue(P_ASG_17_1_0_20_ErrCode,0);
       SetControlBackColor(panel_name,"errField_P_ASG_17_1_0_20",MakeRGB(255,255,255));
       P_ASG_17_1_0_20Get_BTN_already_pressed = 1;
 }
 else
 {
       Request_Void(LSGID, P_ASG_17_1_0_20_ID, DataGet_REQ); 
       P_ASG_17_1_0_20Get_BTN_already_pressed = 0;
 }
}

on envVar P_ASG_17_1_0_20SetGet_BTN
{
	byte BAPTemp[2];
    if (P_ASG_17_1_0_20SetGet_BTN_already_pressed == 0)
    {
       putValue(P_ASG_17_1_0_20_ErrCode,0);
       SetControlBackColor(panel_name,"errField_P_ASG_17_1_0_20",MakeRGB(255,255,255));
       P_ASG_17_1_0_20SetGet_BTN_already_pressed = 1;
    }
    else
    {
       getValue(P_ASG_17_1_0_20, BAPTemp);
       Request_ByteSequence(LSGID, P_ASG_17_1_0_20_ID, DataSetGet_REQ, BAPTemp, getValueSize(P_ASG_17_1_0_20));
       P_ASG_17_1_0_20SetGet_BTN_already_pressed = 0;
    }
}

on envVar P_ASG_17_1_0_20
{
	int i;
	byte superval[2];
	byte param1;
	byte param2;
	getValue(P_ASG_17_1_0_20, superval);
	param1 = superval[0];
	putValue(P_ASG_17_1_0_20_1, param1);
	getValue(P_ASG_17_1_0_20, superval);
	param2 = superval[1];
	putValue(P_ASG_17_1_0_20_2, param2);
}

on envVar P_ASG_17_1_0_20_1_0
{
	byte bitval;
	//thisval steht hier fuer den bitfield-wert, 
	//aus Generierungsgruenden hier keine einheitliche Bezeichnung moeglich.
	byte thisval;
	bitval= getValue(this);
	thisval= getValue(P_ASG_17_1_0_20_1);
	putValue(P_ASG_17_1_0_20_1, thisval&~(1<<0)|(bitval<<0));
}

on envVar P_ASG_17_1_0_20_1_1
{
	byte bitval;
	//thisval steht hier fuer den bitfield-wert, 
	//aus Generierungsgruenden hier keine einheitliche Bezeichnung moeglich.
	byte thisval;
	bitval= getValue(this);
	thisval= getValue(P_ASG_17_1_0_20_1);
	putValue(P_ASG_17_1_0_20_1, thisval&~(1<<1)|(bitval<<1));
}

on envVar P_ASG_17_1_0_20_1_2
{
	byte bitval;
	//thisval steht hier fuer den bitfield-wert, 
	//aus Generierungsgruenden hier keine einheitliche Bezeichnung moeglich.
	byte thisval;
	bitval= getValue(this);
	thisval= getValue(P_ASG_17_1_0_20_1);
	putValue(P_ASG_17_1_0_20_1, thisval&~(1<<2)|(bitval<<2));
}

on envVar P_ASG_17_1_0_20_1_3
{
	byte bitval;
	//thisval steht hier fuer den bitfield-wert, 
	//aus Generierungsgruenden hier keine einheitliche Bezeichnung moeglich.
	byte thisval;
	bitval= getValue(this);
	thisval= getValue(P_ASG_17_1_0_20_1);
	putValue(P_ASG_17_1_0_20_1, thisval&~(1<<3)|(bitval<<3));
}

on envVar P_ASG_17_1_0_20_1
{
	byte mask=0x1;
	byte thisval;
	byte superval[2];
	thisval=getValue(this);
	if(thisval&(mask<<0))
		putValue(P_ASG_17_1_0_20_1_0, 1);
	else
		putValue(P_ASG_17_1_0_20_1_0, 0);
	if(thisval&(mask<<1))
		putValue(P_ASG_17_1_0_20_1_1, 1);
	else
		putValue(P_ASG_17_1_0_20_1_1, 0);
	if(thisval&(mask<<2))
		putValue(P_ASG_17_1_0_20_1_2, 1);
	else
		putValue(P_ASG_17_1_0_20_1_2, 0);
	if(thisval&(mask<<3))
		putValue(P_ASG_17_1_0_20_1_3, 1);
	else
		putValue(P_ASG_17_1_0_20_1_3, 0);
	getValue(P_ASG_17_1_0_20, superval);
	superval[0]=thisval;
	putValue(P_ASG_17_1_0_20,superval);
}

on envVar P_ASG_17_1_0_20_2_0
{
	byte bitval;
	//thisval steht hier fuer den bitfield-wert, 
	//aus Generierungsgruenden hier keine einheitliche Bezeichnung moeglich.
	byte thisval;
	bitval= getValue(this);
	thisval= getValue(P_ASG_17_1_0_20_2);
	putValue(P_ASG_17_1_0_20_2, thisval&~(1<<0)|(bitval<<0));
}

on envVar P_ASG_17_1_0_20_2_1
{
	byte bitval;
	//thisval steht hier fuer den bitfield-wert, 
	//aus Generierungsgruenden hier keine einheitliche Bezeichnung moeglich.
	byte thisval;
	bitval= getValue(this);
	thisval= getValue(P_ASG_17_1_0_20_2);
	putValue(P_ASG_17_1_0_20_2, thisval&~(1<<1)|(bitval<<1));
}

on envVar P_ASG_17_1_0_20_2_2
{
	byte bitval;
	//thisval steht hier fuer den bitfield-wert, 
	//aus Generierungsgruenden hier keine einheitliche Bezeichnung moeglich.
	byte thisval;
	bitval= getValue(this);
	thisval= getValue(P_ASG_17_1_0_20_2);
	putValue(P_ASG_17_1_0_20_2, thisval&~(1<<2)|(bitval<<2));
}

on envVar P_ASG_17_1_0_20_2_3
{
	byte bitval;
	//thisval steht hier fuer den bitfield-wert, 
	//aus Generierungsgruenden hier keine einheitliche Bezeichnung moeglich.
	byte thisval;
	bitval= getValue(this);
	thisval= getValue(P_ASG_17_1_0_20_2);
	putValue(P_ASG_17_1_0_20_2, thisval&~(1<<3)|(bitval<<3));
}

on envVar P_ASG_17_1_0_20_2
{
	byte mask=0x1;
	byte thisval;
	byte superval[2];
	thisval=getValue(this);
	if(thisval&(mask<<0))
		putValue(P_ASG_17_1_0_20_2_0, 1);
	else
		putValue(P_ASG_17_1_0_20_2_0, 0);
	if(thisval&(mask<<1))
		putValue(P_ASG_17_1_0_20_2_1, 1);
	else
		putValue(P_ASG_17_1_0_20_2_1, 0);
	if(thisval&(mask<<2))
		putValue(P_ASG_17_1_0_20_2_2, 1);
	else
		putValue(P_ASG_17_1_0_20_2_2, 0);
	if(thisval&(mask<<3))
		putValue(P_ASG_17_1_0_20_2_3, 1);
	else
		putValue(P_ASG_17_1_0_20_2_3, 0);
	getValue(P_ASG_17_1_0_20, superval);
	superval[1]=thisval;
	putValue(P_ASG_17_1_0_20,superval);
}

on envVar P_ASG_17_1_0_21Get_BTN
{
 if (P_ASG_17_1_0_21Get_BTN_already_pressed == 0)
  {
       putValue(P_ASG_17_1_0_21_ErrCode,0);
       SetControlBackColor(panel_name,"errField_P_ASG_17_1_0_21",MakeRGB(255,255,255));
       P_ASG_17_1_0_21Get_BTN_already_pressed = 1;
 }
 else
 {
       Request_Void(LSGID, P_ASG_17_1_0_21_ID, DataGet_REQ); 
       P_ASG_17_1_0_21Get_BTN_already_pressed = 0;
 }
}

on envVar P_ASG_17_1_0_21SetGet_BTN
{
	byte BAPTemp[6];
    if (P_ASG_17_1_0_21SetGet_BTN_already_pressed == 0)
    {
       putValue(P_ASG_17_1_0_21_ErrCode,0);
       SetControlBackColor(panel_name,"errField_P_ASG_17_1_0_21",MakeRGB(255,255,255));
       P_ASG_17_1_0_21SetGet_BTN_already_pressed = 1;
    }
    else
    {
       getValue(P_ASG_17_1_0_21, BAPTemp);
       Request_ByteSequence(LSGID, P_ASG_17_1_0_21_ID, DataSetGet_REQ, BAPTemp, getValueSize(P_ASG_17_1_0_21));
       P_ASG_17_1_0_21SetGet_BTN_already_pressed = 0;
    }
}

on envVar P_ASG_17_1_0_21
{
	int i;
	byte superval[6];
	byte param1;
	byte param2;
	byte param3;
	byte param4;
	byte param5;
	byte param6;
	byte param7;
	getValue(P_ASG_17_1_0_21, superval);
	param1 = superval[0];
	putValue(P_ASG_17_1_0_21_1, param1);
	getValue(P_ASG_17_1_0_21, superval);
	param2 = superval[1];
	putValue(P_ASG_17_1_0_21_2, param2);
	getValue(P_ASG_17_1_0_21, superval);
	param3 = superval[2];
	putValue(P_ASG_17_1_0_21_3, param3);
	getValue(P_ASG_17_1_0_21, superval);
	param4 = superval[3];
	putValue(P_ASG_17_1_0_21_4, param4);
	getValue(P_ASG_17_1_0_21, superval);
	param5 = superval[4];
	putValue(P_ASG_17_1_0_21_5, param5);
	getValue(P_ASG_17_1_0_21, superval);
	param6 = (superval[5] & 0xf0)>>4;
	putValue(P_ASG_17_1_0_21_6, param6);
	getValue(P_ASG_17_1_0_21, superval);
	param7 = superval[5] & 0x0f;
	putValue(P_ASG_17_1_0_21_7, param7);
}

// Ueberwachung der Darstellungsvariable der Range
on envVar P_ASG_17_1_0_21_1_range
{
	double thisval, helpval;
	thisval=getValue(this);
	helpval=(thisval-(2000.0))*(1.0);
	if(thisval<0)
		helpval=round(helpval-((word)(helpval+2)),1)+((word)(helpval+2));
	else
		helpval=round(helpval, 1);
	putValue(P_ASG_17_1_0_21_1, helpval);
}

// Ueberwachung der Range-Variable im uebertragungsformat (nicht sichtbar)
on envVar P_ASG_17_1_0_21_1
{
	byte thisval;
	byte superval[6];
	thisval=getValue(this);
	putValue(P_ASG_17_1_0_21_1_range, round((thisval*(1.0) + (2000.0)),(1)));
	getValue(P_ASG_17_1_0_21, superval);
	superval[0]=thisval;
	putValue(P_ASG_17_1_0_21,superval);
}

// Ueberwachung der Darstellungsvariable der Range
on envVar P_ASG_17_1_0_21_2_range
{
	double thisval, helpval;
	thisval=getValue(this);
	helpval=(thisval-(0.0))*(1.0);
	if(thisval<0)
		helpval=round(helpval-((word)(helpval+2)),1)+((word)(helpval+2));
	else
		helpval=round(helpval, 1);
	putValue(P_ASG_17_1_0_21_2, helpval);
}

// Ueberwachung der Range-Variable im uebertragungsformat (nicht sichtbar)
on envVar P_ASG_17_1_0_21_2
{
	byte thisval;
	byte superval[6];
	thisval=getValue(this);
	putValue(P_ASG_17_1_0_21_2_range, round((thisval*(1.0) + (0.0)),(1)));
	getValue(P_ASG_17_1_0_21, superval);
	superval[1]=thisval;
	putValue(P_ASG_17_1_0_21,superval);
}

// Ueberwachung der Darstellungsvariable der Range
on envVar P_ASG_17_1_0_21_3_range
{
	double thisval, helpval;
	thisval=getValue(this);
	helpval=(thisval-(0.0))*(1.0);
	if(thisval<0)
		helpval=round(helpval-((word)(helpval+2)),1)+((word)(helpval+2));
	else
		helpval=round(helpval, 1);
	putValue(P_ASG_17_1_0_21_3, helpval);
}

// Ueberwachung der Range-Variable im uebertragungsformat (nicht sichtbar)
on envVar P_ASG_17_1_0_21_3
{
	byte thisval;
	byte superval[6];
	thisval=getValue(this);
	putValue(P_ASG_17_1_0_21_3_range, round((thisval*(1.0) + (0.0)),(1)));
	getValue(P_ASG_17_1_0_21, superval);
	superval[2]=thisval;
	putValue(P_ASG_17_1_0_21,superval);
}

// Ueberwachung der Darstellungsvariable der Range
on envVar P_ASG_17_1_0_21_4_range
{
	double thisval, helpval;
	thisval=getValue(this);
	helpval=(thisval-(0.0))*(1.0);
	if(thisval<0)
		helpval=round(helpval-((word)(helpval+2)),1)+((word)(helpval+2));
	else
		helpval=round(helpval, 1);
	putValue(P_ASG_17_1_0_21_4, helpval);
}

// Ueberwachung der Range-Variable im uebertragungsformat (nicht sichtbar)
on envVar P_ASG_17_1_0_21_4
{
	byte thisval;
	byte superval[6];
	thisval=getValue(this);
	putValue(P_ASG_17_1_0_21_4_range, round((thisval*(1.0) + (0.0)),(1)));
	getValue(P_ASG_17_1_0_21, superval);
	superval[3]=thisval;
	putValue(P_ASG_17_1_0_21,superval);
}

// Ueberwachung der Darstellungsvariable der Range
on envVar P_ASG_17_1_0_21_5_range
{
	double thisval, helpval;
	thisval=getValue(this);
	helpval=(thisval-(0.0))*(1.0);
	if(thisval<0)
		helpval=round(helpval-((word)(helpval+2)),1)+((word)(helpval+2));
	else
		helpval=round(helpval, 1);
	putValue(P_ASG_17_1_0_21_5, helpval);
}

// Ueberwachung der Range-Variable im uebertragungsformat (nicht sichtbar)
on envVar P_ASG_17_1_0_21_5
{
	byte thisval;
	byte superval[6];
	thisval=getValue(this);
	putValue(P_ASG_17_1_0_21_5_range, round((thisval*(1.0) + (0.0)),(1)));
	getValue(P_ASG_17_1_0_21, superval);
	superval[4]=thisval;
	putValue(P_ASG_17_1_0_21,superval);
}

on envVar P_ASG_17_1_0_21_6
{
	byte thisval;
	byte superval[6];
	thisval=getValue(this);
	thisval=thisval&0x000f;
	getValue(P_ASG_17_1_0_21, superval);
	superval[5]= superval[5]&0x0f;
	superval[5]= superval[5]|(thisval<<4);
	putValue(P_ASG_17_1_0_21,superval);
}

on envVar P_ASG_17_1_0_21_7
{
	byte thisval;
	byte superval[6];
	thisval=getValue(this);
	thisval=thisval&0x000f;
	getValue(P_ASG_17_1_0_21, superval);
	superval[5]= superval[5]&0xf0;
	superval[5]= superval[5]|thisval;
	putValue(P_ASG_17_1_0_21,superval);
}

on envVar P_ASG_17_1_0_22Get_BTN
{
 if (P_ASG_17_1_0_22Get_BTN_already_pressed == 0)
  {
       putValue(P_ASG_17_1_0_22_ErrCode,0);
       SetControlBackColor(panel_name,"errField_P_ASG_17_1_0_22",MakeRGB(255,255,255));
       P_ASG_17_1_0_22Get_BTN_already_pressed = 1;
 }
 else
 {
       Request_Void(LSGID, P_ASG_17_1_0_22_ID, DataGet_REQ); 
       P_ASG_17_1_0_22Get_BTN_already_pressed = 0;
 }
}

on envVar P_ASG_17_1_0_22SetGet_BTN
{
	byte BAPTemp[6];
    if (P_ASG_17_1_0_22SetGet_BTN_already_pressed == 0)
    {
       putValue(P_ASG_17_1_0_22_ErrCode,0);
       SetControlBackColor(panel_name,"errField_P_ASG_17_1_0_22",MakeRGB(255,255,255));
       P_ASG_17_1_0_22SetGet_BTN_already_pressed = 1;
    }
    else
    {
       getValue(P_ASG_17_1_0_22, BAPTemp);
       Request_ByteSequence(LSGID, P_ASG_17_1_0_22_ID, DataSetGet_REQ, BAPTemp, getValueSize(P_ASG_17_1_0_22));
       P_ASG_17_1_0_22SetGet_BTN_already_pressed = 0;
    }
}

on envVar P_ASG_17_1_0_22
{
	int i;
	byte superval[6];
	byte param1;
	byte param2;
	byte param3;
	byte param4;
	byte param5;
	byte param6;
	byte param7;
	getValue(P_ASG_17_1_0_22, superval);
	param1 = superval[0];
	putValue(P_ASG_17_1_0_22_1, param1);
	getValue(P_ASG_17_1_0_22, superval);
	param2 = superval[1];
	putValue(P_ASG_17_1_0_22_2, param2);
	getValue(P_ASG_17_1_0_22, superval);
	param3 = superval[2];
	putValue(P_ASG_17_1_0_22_3, param3);
	getValue(P_ASG_17_1_0_22, superval);
	param4 = superval[3];
	putValue(P_ASG_17_1_0_22_4, param4);
	getValue(P_ASG_17_1_0_22, superval);
	param5 = superval[4];
	putValue(P_ASG_17_1_0_22_5, param5);
	getValue(P_ASG_17_1_0_22, superval);
	param6 = (superval[5] & 0xf0)>>4;
	putValue(P_ASG_17_1_0_22_6, param6);
	getValue(P_ASG_17_1_0_22, superval);
	param7 = superval[5] & 0x0f;
	putValue(P_ASG_17_1_0_22_7, param7);
}

// Ueberwachung der Darstellungsvariable der Range
on envVar P_ASG_17_1_0_22_1_range
{
	double thisval, helpval;
	thisval=getValue(this);
	helpval=(thisval-(2000.0))*(1.0);
	if(thisval<0)
		helpval=round(helpval-((word)(helpval+2)),1)+((word)(helpval+2));
	else
		helpval=round(helpval, 1);
	putValue(P_ASG_17_1_0_22_1, helpval);
}

// Ueberwachung der Range-Variable im uebertragungsformat (nicht sichtbar)
on envVar P_ASG_17_1_0_22_1
{
	byte thisval;
	byte superval[6];
	thisval=getValue(this);
	putValue(P_ASG_17_1_0_22_1_range, round((thisval*(1.0) + (2000.0)),(1)));
	getValue(P_ASG_17_1_0_22, superval);
	superval[0]=thisval;
	putValue(P_ASG_17_1_0_22,superval);
}

// Ueberwachung der Darstellungsvariable der Range
on envVar P_ASG_17_1_0_22_2_range
{
	double thisval, helpval;
	thisval=getValue(this);
	helpval=(thisval-(0.0))*(1.0);
	if(thisval<0)
		helpval=round(helpval-((word)(helpval+2)),1)+((word)(helpval+2));
	else
		helpval=round(helpval, 1);
	putValue(P_ASG_17_1_0_22_2, helpval);
}

// Ueberwachung der Range-Variable im uebertragungsformat (nicht sichtbar)
on envVar P_ASG_17_1_0_22_2
{
	byte thisval;
	byte superval[6];
	thisval=getValue(this);
	putValue(P_ASG_17_1_0_22_2_range, round((thisval*(1.0) + (0.0)),(1)));
	getValue(P_ASG_17_1_0_22, superval);
	superval[1]=thisval;
	putValue(P_ASG_17_1_0_22,superval);
}

// Ueberwachung der Darstellungsvariable der Range
on envVar P_ASG_17_1_0_22_3_range
{
	double thisval, helpval;
	thisval=getValue(this);
	helpval=(thisval-(0.0))*(1.0);
	if(thisval<0)
		helpval=round(helpval-((word)(helpval+2)),1)+((word)(helpval+2));
	else
		helpval=round(helpval, 1);
	putValue(P_ASG_17_1_0_22_3, helpval);
}

// Ueberwachung der Range-Variable im uebertragungsformat (nicht sichtbar)
on envVar P_ASG_17_1_0_22_3
{
	byte thisval;
	byte superval[6];
	thisval=getValue(this);
	putValue(P_ASG_17_1_0_22_3_range, round((thisval*(1.0) + (0.0)),(1)));
	getValue(P_ASG_17_1_0_22, superval);
	superval[2]=thisval;
	putValue(P_ASG_17_1_0_22,superval);
}

// Ueberwachung der Darstellungsvariable der Range
on envVar P_ASG_17_1_0_22_4_range
{
	double thisval, helpval;
	thisval=getValue(this);
	helpval=(thisval-(0.0))*(1.0);
	if(thisval<0)
		helpval=round(helpval-((word)(helpval+2)),1)+((word)(helpval+2));
	else
		helpval=round(helpval, 1);
	putValue(P_ASG_17_1_0_22_4, helpval);
}

// Ueberwachung der Range-Variable im uebertragungsformat (nicht sichtbar)
on envVar P_ASG_17_1_0_22_4
{
	byte thisval;
	byte superval[6];
	thisval=getValue(this);
	putValue(P_ASG_17_1_0_22_4_range, round((thisval*(1.0) + (0.0)),(1)));
	getValue(P_ASG_17_1_0_22, superval);
	superval[3]=thisval;
	putValue(P_ASG_17_1_0_22,superval);
}

// Ueberwachung der Darstellungsvariable der Range
on envVar P_ASG_17_1_0_22_5_range
{
	double thisval, helpval;
	thisval=getValue(this);
	helpval=(thisval-(0.0))*(1.0);
	if(thisval<0)
		helpval=round(helpval-((word)(helpval+2)),1)+((word)(helpval+2));
	else
		helpval=round(helpval, 1);
	putValue(P_ASG_17_1_0_22_5, helpval);
}

// Ueberwachung der Range-Variable im uebertragungsformat (nicht sichtbar)
on envVar P_ASG_17_1_0_22_5
{
	byte thisval;
	byte superval[6];
	thisval=getValue(this);
	putValue(P_ASG_17_1_0_22_5_range, round((thisval*(1.0) + (0.0)),(1)));
	getValue(P_ASG_17_1_0_22, superval);
	superval[4]=thisval;
	putValue(P_ASG_17_1_0_22,superval);
}

on envVar P_ASG_17_1_0_22_6
{
	byte thisval;
	byte superval[6];
	thisval=getValue(this);
	thisval=thisval&0x000f;
	getValue(P_ASG_17_1_0_22, superval);
	superval[5]= superval[5]&0x0f;
	superval[5]= superval[5]|(thisval<<4);
	putValue(P_ASG_17_1_0_22,superval);
}

on envVar P_ASG_17_1_0_22_7
{
	byte thisval;
	byte superval[6];
	thisval=getValue(this);
	thisval=thisval&0x000f;
	getValue(P_ASG_17_1_0_22, superval);
	superval[5]= superval[5]&0xf0;
	superval[5]= superval[5]|thisval;
	putValue(P_ASG_17_1_0_22,superval);
}

on envVar P_ASG_17_1_0_23Get_BTN
{
 if (P_ASG_17_1_0_23Get_BTN_already_pressed == 0)
  {
       putValue(P_ASG_17_1_0_23_ErrCode,0);
       SetControlBackColor(panel_name,"errField_P_ASG_17_1_0_23",MakeRGB(255,255,255));
       P_ASG_17_1_0_23Get_BTN_already_pressed = 1;
 }
 else
 {
       Request_Void(LSGID, P_ASG_17_1_0_23_ID, DataGet_REQ); 
       P_ASG_17_1_0_23Get_BTN_already_pressed = 0;
 }
}

on envVar P_ASG_17_1_0_23SetGet_BTN
{
	byte BAPTemp[6];
    if (P_ASG_17_1_0_23SetGet_BTN_already_pressed == 0)
    {
       putValue(P_ASG_17_1_0_23_ErrCode,0);
       SetControlBackColor(panel_name,"errField_P_ASG_17_1_0_23",MakeRGB(255,255,255));
       P_ASG_17_1_0_23SetGet_BTN_already_pressed = 1;
    }
    else
    {
       getValue(P_ASG_17_1_0_23, BAPTemp);
       Request_ByteSequence(LSGID, P_ASG_17_1_0_23_ID, DataSetGet_REQ, BAPTemp, getValueSize(P_ASG_17_1_0_23));
       P_ASG_17_1_0_23SetGet_BTN_already_pressed = 0;
    }
}

on envVar P_ASG_17_1_0_23
{
	int i;
	byte superval[6];
	byte param1;
	byte param2;
	byte param3;
	byte param4;
	byte param5;
	byte param6;
	byte param7;
	getValue(P_ASG_17_1_0_23, superval);
	param1 = superval[0];
	putValue(P_ASG_17_1_0_23_1, param1);
	getValue(P_ASG_17_1_0_23, superval);
	param2 = superval[1];
	putValue(P_ASG_17_1_0_23_2, param2);
	getValue(P_ASG_17_1_0_23, superval);
	param3 = superval[2];
	putValue(P_ASG_17_1_0_23_3, param3);
	getValue(P_ASG_17_1_0_23, superval);
	param4 = superval[3];
	putValue(P_ASG_17_1_0_23_4, param4);
	getValue(P_ASG_17_1_0_23, superval);
	param5 = superval[4];
	putValue(P_ASG_17_1_0_23_5, param5);
	getValue(P_ASG_17_1_0_23, superval);
	param6 = (superval[5] & 0xf0)>>4;
	putValue(P_ASG_17_1_0_23_6, param6);
	getValue(P_ASG_17_1_0_23, superval);
	param7 = superval[5] & 0x0f;
	putValue(P_ASG_17_1_0_23_7, param7);
}

// Ueberwachung der Darstellungsvariable der Range
on envVar P_ASG_17_1_0_23_1_range
{
	double thisval, helpval;
	thisval=getValue(this);
	helpval=(thisval-(2000.0))*(1.0);
	if(thisval<0)
		helpval=round(helpval-((word)(helpval+2)),1)+((word)(helpval+2));
	else
		helpval=round(helpval, 1);
	putValue(P_ASG_17_1_0_23_1, helpval);
}

// Ueberwachung der Range-Variable im uebertragungsformat (nicht sichtbar)
on envVar P_ASG_17_1_0_23_1
{
	byte thisval;
	byte superval[6];
	thisval=getValue(this);
	putValue(P_ASG_17_1_0_23_1_range, round((thisval*(1.0) + (2000.0)),(1)));
	getValue(P_ASG_17_1_0_23, superval);
	superval[0]=thisval;
	putValue(P_ASG_17_1_0_23,superval);
}

// Ueberwachung der Darstellungsvariable der Range
on envVar P_ASG_17_1_0_23_2_range
{
	double thisval, helpval;
	thisval=getValue(this);
	helpval=(thisval-(0.0))*(1.0);
	if(thisval<0)
		helpval=round(helpval-((word)(helpval+2)),1)+((word)(helpval+2));
	else
		helpval=round(helpval, 1);
	putValue(P_ASG_17_1_0_23_2, helpval);
}

// Ueberwachung der Range-Variable im uebertragungsformat (nicht sichtbar)
on envVar P_ASG_17_1_0_23_2
{
	byte thisval;
	byte superval[6];
	thisval=getValue(this);
	putValue(P_ASG_17_1_0_23_2_range, round((thisval*(1.0) + (0.0)),(1)));
	getValue(P_ASG_17_1_0_23, superval);
	superval[1]=thisval;
	putValue(P_ASG_17_1_0_23,superval);
}

// Ueberwachung der Darstellungsvariable der Range
on envVar P_ASG_17_1_0_23_3_range
{
	double thisval, helpval;
	thisval=getValue(this);
	helpval=(thisval-(0.0))*(1.0);
	if(thisval<0)
		helpval=round(helpval-((word)(helpval+2)),1)+((word)(helpval+2));
	else
		helpval=round(helpval, 1);
	putValue(P_ASG_17_1_0_23_3, helpval);
}

// Ueberwachung der Range-Variable im uebertragungsformat (nicht sichtbar)
on envVar P_ASG_17_1_0_23_3
{
	byte thisval;
	byte superval[6];
	thisval=getValue(this);
	putValue(P_ASG_17_1_0_23_3_range, round((thisval*(1.0) + (0.0)),(1)));
	getValue(P_ASG_17_1_0_23, superval);
	superval[2]=thisval;
	putValue(P_ASG_17_1_0_23,superval);
}

// Ueberwachung der Darstellungsvariable der Range
on envVar P_ASG_17_1_0_23_4_range
{
	double thisval, helpval;
	thisval=getValue(this);
	helpval=(thisval-(0.0))*(1.0);
	if(thisval<0)
		helpval=round(helpval-((word)(helpval+2)),1)+((word)(helpval+2));
	else
		helpval=round(helpval, 1);
	putValue(P_ASG_17_1_0_23_4, helpval);
}

// Ueberwachung der Range-Variable im uebertragungsformat (nicht sichtbar)
on envVar P_ASG_17_1_0_23_4
{
	byte thisval;
	byte superval[6];
	thisval=getValue(this);
	putValue(P_ASG_17_1_0_23_4_range, round((thisval*(1.0) + (0.0)),(1)));
	getValue(P_ASG_17_1_0_23, superval);
	superval[3]=thisval;
	putValue(P_ASG_17_1_0_23,superval);
}

// Ueberwachung der Darstellungsvariable der Range
on envVar P_ASG_17_1_0_23_5_range
{
	double thisval, helpval;
	thisval=getValue(this);
	helpval=(thisval-(0.0))*(1.0);
	if(thisval<0)
		helpval=round(helpval-((word)(helpval+2)),1)+((word)(helpval+2));
	else
		helpval=round(helpval, 1);
	putValue(P_ASG_17_1_0_23_5, helpval);
}

// Ueberwachung der Range-Variable im uebertragungsformat (nicht sichtbar)
on envVar P_ASG_17_1_0_23_5
{
	byte thisval;
	byte superval[6];
	thisval=getValue(this);
	putValue(P_ASG_17_1_0_23_5_range, round((thisval*(1.0) + (0.0)),(1)));
	getValue(P_ASG_17_1_0_23, superval);
	superval[4]=thisval;
	putValue(P_ASG_17_1_0_23,superval);
}

on envVar P_ASG_17_1_0_23_6
{
	byte thisval;
	byte superval[6];
	thisval=getValue(this);
	thisval=thisval&0x000f;
	getValue(P_ASG_17_1_0_23, superval);
	superval[5]= superval[5]&0x0f;
	superval[5]= superval[5]|(thisval<<4);
	putValue(P_ASG_17_1_0_23,superval);
}

on envVar P_ASG_17_1_0_23_7
{
	byte thisval;
	byte superval[6];
	thisval=getValue(this);
	thisval=thisval&0x000f;
	getValue(P_ASG_17_1_0_23, superval);
	superval[5]= superval[5]&0xf0;
	superval[5]= superval[5]|thisval;
	putValue(P_ASG_17_1_0_23,superval);
}

on envVar P_ASG_17_1_0_24Get_BTN
{
 if (P_ASG_17_1_0_24Get_BTN_already_pressed == 0)
  {
       putValue(P_ASG_17_1_0_24_ErrCode,0);
       SetControlBackColor(panel_name,"errField_P_ASG_17_1_0_24",MakeRGB(255,255,255));
       P_ASG_17_1_0_24Get_BTN_already_pressed = 1;
 }
 else
 {
       Request_Void(LSGID, P_ASG_17_1_0_24_ID, DataGet_REQ); 
       P_ASG_17_1_0_24Get_BTN_already_pressed = 0;
 }
}

on envVar P_ASG_17_1_0_24SetGet_BTN
{
	byte BAPTemp[6];
    if (P_ASG_17_1_0_24SetGet_BTN_already_pressed == 0)
    {
       putValue(P_ASG_17_1_0_24_ErrCode,0);
       SetControlBackColor(panel_name,"errField_P_ASG_17_1_0_24",MakeRGB(255,255,255));
       P_ASG_17_1_0_24SetGet_BTN_already_pressed = 1;
    }
    else
    {
       getValue(P_ASG_17_1_0_24, BAPTemp);
       Request_ByteSequence(LSGID, P_ASG_17_1_0_24_ID, DataSetGet_REQ, BAPTemp, getValueSize(P_ASG_17_1_0_24));
       P_ASG_17_1_0_24SetGet_BTN_already_pressed = 0;
    }
}

on envVar P_ASG_17_1_0_24
{
	int i;
	byte superval[6];
	byte param1;
	byte param2;
	byte param3;
	byte param4;
	byte param5;
	byte param6;
	getValue(P_ASG_17_1_0_24, superval);
	param1 = superval[0];
	putValue(P_ASG_17_1_0_24_1, param1);
	getValue(P_ASG_17_1_0_24, superval);
	param2 = superval[1];
	putValue(P_ASG_17_1_0_24_2, param2);
	getValue(P_ASG_17_1_0_24, superval);
	param3 = superval[2];
	putValue(P_ASG_17_1_0_24_3, param3);
	getValue(P_ASG_17_1_0_24, superval);
	param4 = superval[3];
	putValue(P_ASG_17_1_0_24_4, param4);
	getValue(P_ASG_17_1_0_24, superval);
	param5 = superval[4];
	putValue(P_ASG_17_1_0_24_5, param5);
	getValue(P_ASG_17_1_0_24, superval);
	param6 = superval[5];
	putValue(P_ASG_17_1_0_24_6, param6);
}

// Ueberwachung der Darstellungsvariable der Range
on envVar P_ASG_17_1_0_24_1_range
{
	double thisval, helpval;
	thisval=getValue(this);
	helpval=(thisval-(2000.0))*(1.0);
	if(thisval<0)
		helpval=round(helpval-((word)(helpval+2)),1)+((word)(helpval+2));
	else
		helpval=round(helpval, 1);
	putValue(P_ASG_17_1_0_24_1, helpval);
}

// Ueberwachung der Range-Variable im uebertragungsformat (nicht sichtbar)
on envVar P_ASG_17_1_0_24_1
{
	byte thisval;
	byte superval[6];
	thisval=getValue(this);
	putValue(P_ASG_17_1_0_24_1_range, round((thisval*(1.0) + (2000.0)),(1)));
	getValue(P_ASG_17_1_0_24, superval);
	superval[0]=thisval;
	putValue(P_ASG_17_1_0_24,superval);
}

// Ueberwachung der Darstellungsvariable der Range
on envVar P_ASG_17_1_0_24_2_range
{
	double thisval, helpval;
	thisval=getValue(this);
//IssueList #4
	//helpval=(thisval-(1.0))*(1.0);
	helpval=(thisval-(0.0))*(1.0);
	if(thisval<0)
		helpval=round(helpval-((word)(helpval+2)),1)+((word)(helpval+2));
	else
		helpval=round(helpval, 1);
	putValue(P_ASG_17_1_0_24_2, helpval);
}

// Ueberwachung der Range-Variable im uebertragungsformat (nicht sichtbar)
on envVar P_ASG_17_1_0_24_2
{
	byte thisval;
	byte superval[6];
	thisval=getValue(this);
//IssueList #4
	//putValue(P_ASG_17_1_0_24_2_range, round((thisval*(1.0) + (1.0)),(1)));
	putValue(P_ASG_17_1_0_24_2_range, round((thisval*(1.0) + (0.0)),(1)));
	getValue(P_ASG_17_1_0_24, superval);
	superval[1]=thisval;
	putValue(P_ASG_17_1_0_24,superval);
}

// Ueberwachung der Darstellungsvariable der Range
on envVar P_ASG_17_1_0_24_3_range
{
	double thisval, helpval;
	thisval=getValue(this);
//IssueList #4
	//helpval=(thisval-(1.0))*(1.0);
	helpval=(thisval-(0.0))*(1.0);
	if(thisval<0)
		helpval=round(helpval-((word)(helpval+2)),1)+((word)(helpval+2));
	else
		helpval=round(helpval, 1);
	putValue(P_ASG_17_1_0_24_3, helpval);
}

// Ueberwachung der Range-Variable im uebertragungsformat (nicht sichtbar)
on envVar P_ASG_17_1_0_24_3
{
	byte thisval;
	byte superval[6];
	thisval=getValue(this);
//IssueList #4
	//putValue(P_ASG_17_1_0_24_3_range, round((thisval*(1.0) + (1.0)),(1)));
	putValue(P_ASG_17_1_0_24_3_range, round((thisval*(1.0) + (0.0)),(1)));
	getValue(P_ASG_17_1_0_24, superval);
	superval[2]=thisval;
	putValue(P_ASG_17_1_0_24,superval);
}

// Ueberwachung der Darstellungsvariable der Range
on envVar P_ASG_17_1_0_24_4_range
{
	double thisval, helpval;
	thisval=getValue(this);
	helpval=(thisval-(0.0))*(1.0);
	if(thisval<0)
		helpval=round(helpval-((word)(helpval+2)),1)+((word)(helpval+2));
	else
		helpval=round(helpval, 1);
	putValue(P_ASG_17_1_0_24_4, helpval);
}

// Ueberwachung der Range-Variable im uebertragungsformat (nicht sichtbar)
on envVar P_ASG_17_1_0_24_4
{
	byte thisval;
	byte superval[6];
	thisval=getValue(this);
	putValue(P_ASG_17_1_0_24_4_range, round((thisval*(1.0) + (0.0)),(1)));
	getValue(P_ASG_17_1_0_24, superval);
	superval[3]=thisval;
	putValue(P_ASG_17_1_0_24,superval);
}

// Ueberwachung der Darstellungsvariable der Range
on envVar P_ASG_17_1_0_24_5_range
{
	double thisval, helpval;
	thisval=getValue(this);
	helpval=(thisval-(0.0))*(1.0);
	if(thisval<0)
		helpval=round(helpval-((word)(helpval+2)),1)+((word)(helpval+2));
	else
		helpval=round(helpval, 1);
	putValue(P_ASG_17_1_0_24_5, helpval);
}

// Ueberwachung der Range-Variable im uebertragungsformat (nicht sichtbar)
on envVar P_ASG_17_1_0_24_5
{
	byte thisval;
	byte superval[6];
	thisval=getValue(this);
	putValue(P_ASG_17_1_0_24_5_range, round((thisval*(1.0) + (0.0)),(1)));
	getValue(P_ASG_17_1_0_24, superval);
	superval[4]=thisval;
	putValue(P_ASG_17_1_0_24,superval);
}

// Ueberwachung der Darstellungsvariable der Range
on envVar P_ASG_17_1_0_24_6_range
{
	double thisval, helpval;
	thisval=getValue(this);
	helpval=(thisval-(0.0))*(1.0);
	if(thisval<0)
		helpval=round(helpval-((word)(helpval+2)),1)+((word)(helpval+2));
	else
		helpval=round(helpval, 1);
	putValue(P_ASG_17_1_0_24_6, helpval);
}

// Ueberwachung der Range-Variable im uebertragungsformat (nicht sichtbar)
on envVar P_ASG_17_1_0_24_6
{
	byte thisval;
	byte superval[6];
	thisval=getValue(this);
	putValue(P_ASG_17_1_0_24_6_range, round((thisval*(1.0) + (0.0)),(1)));
	getValue(P_ASG_17_1_0_24, superval);
	superval[5]=thisval;
	putValue(P_ASG_17_1_0_24,superval);
}

on envVar P_ASG_17_1_0_25Get_BTN
{
 if (P_ASG_17_1_0_25Get_BTN_already_pressed == 0)
  {
       putValue(P_ASG_17_1_0_25_ErrCode,0);
       SetControlBackColor(panel_name,"errField_P_ASG_17_1_0_25",MakeRGB(255,255,255));
       P_ASG_17_1_0_25Get_BTN_already_pressed = 1;
 }
 else
 {
       Request_Void(LSGID, P_ASG_17_1_0_25_ID, DataGet_REQ); 
       P_ASG_17_1_0_25Get_BTN_already_pressed = 0;
 }
}

on envVar P_ASG_17_1_0_25SetGet_BTN
{
	byte BAPTemp[6];
    if (P_ASG_17_1_0_25SetGet_BTN_already_pressed == 0)
    {
       putValue(P_ASG_17_1_0_25_ErrCode,0);
       SetControlBackColor(panel_name,"errField_P_ASG_17_1_0_25",MakeRGB(255,255,255));
       P_ASG_17_1_0_25SetGet_BTN_already_pressed = 1;
    }
    else
    {
       getValue(P_ASG_17_1_0_25, BAPTemp);
       Request_ByteSequence(LSGID, P_ASG_17_1_0_25_ID, DataSetGet_REQ, BAPTemp, getValueSize(P_ASG_17_1_0_25));
       P_ASG_17_1_0_25SetGet_BTN_already_pressed = 0;
    }
}

on envVar P_ASG_17_1_0_25
{
	int i;
	byte superval[6];
	byte param1;
	byte param2;
	byte param3;
	byte param4;
	byte param5;
	byte param6;
	getValue(P_ASG_17_1_0_25, superval);
	param1 = superval[0];
	putValue(P_ASG_17_1_0_25_1, param1);
	getValue(P_ASG_17_1_0_25, superval);
	param2 = superval[1];
	putValue(P_ASG_17_1_0_25_2, param2);
	getValue(P_ASG_17_1_0_25, superval);
	param3 = superval[2];
	putValue(P_ASG_17_1_0_25_3, param3);
	getValue(P_ASG_17_1_0_25, superval);
	param4 = superval[3];
	putValue(P_ASG_17_1_0_25_4, param4);
	getValue(P_ASG_17_1_0_25, superval);
	param5 = superval[4];
	putValue(P_ASG_17_1_0_25_5, param5);
	getValue(P_ASG_17_1_0_25, superval);
	param6 = superval[5];
	putValue(P_ASG_17_1_0_25_6, param6);
}

// Ueberwachung der Darstellungsvariable der Range
on envVar P_ASG_17_1_0_25_1_range
{
	double thisval, helpval;
	thisval=getValue(this);
	helpval=(thisval-(2000.0))*(1.0);
	if(thisval<0)
		helpval=round(helpval-((word)(helpval+2)),1)+((word)(helpval+2));
	else
		helpval=round(helpval, 1);
	putValue(P_ASG_17_1_0_25_1, helpval);
}

// Ueberwachung der Range-Variable im uebertragungsformat (nicht sichtbar)
on envVar P_ASG_17_1_0_25_1
{
	byte thisval;
	byte superval[6];
	thisval=getValue(this);
	putValue(P_ASG_17_1_0_25_1_range, round((thisval*(1.0) + (2000.0)),(1)));
	getValue(P_ASG_17_1_0_25, superval);
	superval[0]=thisval;
	putValue(P_ASG_17_1_0_25,superval);
}

// Ueberwachung der Darstellungsvariable der Range
on envVar P_ASG_17_1_0_25_2_range
{
	double thisval, helpval;
	thisval=getValue(this);
//IssueList #4
        //helpval=(thisval-(1.0))*(1.0);
        helpval=(thisval-(0.0))*(1.0);
	if(thisval<0)
		helpval=round(helpval-((word)(helpval+2)),1)+((word)(helpval+2));
	else
		helpval=round(helpval, 1);
	putValue(P_ASG_17_1_0_25_2, helpval);
}

// Ueberwachung der Range-Variable im uebertragungsformat (nicht sichtbar)
on envVar P_ASG_17_1_0_25_2
{
	byte thisval;
	byte superval[6];
	thisval=getValue(this);
//IssueList #4	
	//putValue(P_ASG_17_1_0_25_2_range, round((thisval*(1.0) + (1.0)),(1)));
	putValue(P_ASG_17_1_0_25_2_range, round((thisval*(1.0) + (0.0)),(1)));
	getValue(P_ASG_17_1_0_25, superval);
	superval[1]=thisval;
	putValue(P_ASG_17_1_0_25,superval);
}

// Ueberwachung der Darstellungsvariable der Range
on envVar P_ASG_17_1_0_25_3_range
{
	double thisval, helpval;
	thisval=getValue(this);
//IssueList #4
        //helpval=(thisval-(1.0))*(1.0);
        helpval=(thisval-(0.0))*(1.0);
	if(thisval<0)
		helpval=round(helpval-((word)(helpval+2)),1)+((word)(helpval+2));
	else
		helpval=round(helpval, 1);
	putValue(P_ASG_17_1_0_25_3, helpval);
}

// Ueberwachung der Range-Variable im uebertragungsformat (nicht sichtbar)
on envVar P_ASG_17_1_0_25_3
{
	byte thisval;
	byte superval[6];
	thisval=getValue(this);
//IssueList #4
	//putValue(P_ASG_17_1_0_25_3_range, round((thisval*(1.0) + (1.0)),(1)));
	putValue(P_ASG_17_1_0_25_3_range, round((thisval*(1.0) + (0.0)),(1)));
	getValue(P_ASG_17_1_0_25, superval);
	superval[2]=thisval;
	putValue(P_ASG_17_1_0_25,superval);
}

// Ueberwachung der Darstellungsvariable der Range
on envVar P_ASG_17_1_0_25_4_range
{
	double thisval, helpval;
	thisval=getValue(this);
	helpval=(thisval-(0.0))*(1.0);
	if(thisval<0)
		helpval=round(helpval-((word)(helpval+2)),1)+((word)(helpval+2));
	else
		helpval=round(helpval, 1);
	putValue(P_ASG_17_1_0_25_4, helpval);
}

// Ueberwachung der Range-Variable im uebertragungsformat (nicht sichtbar)
on envVar P_ASG_17_1_0_25_4
{
	byte thisval;
	byte superval[6];
	thisval=getValue(this);
	putValue(P_ASG_17_1_0_25_4_range, round((thisval*(1.0) + (0.0)),(1)));
	getValue(P_ASG_17_1_0_25, superval);
	superval[3]=thisval;
	putValue(P_ASG_17_1_0_25,superval);
}

// Ueberwachung der Darstellungsvariable der Range
on envVar P_ASG_17_1_0_25_5_range
{
	double thisval, helpval;
	thisval=getValue(this);
	helpval=(thisval-(0.0))*(1.0);
	if(thisval<0)
		helpval=round(helpval-((word)(helpval+2)),1)+((word)(helpval+2));
	else
		helpval=round(helpval, 1);
	putValue(P_ASG_17_1_0_25_5, helpval);
}

// Ueberwachung der Range-Variable im uebertragungsformat (nicht sichtbar)
on envVar P_ASG_17_1_0_25_5
{
	byte thisval;
	byte superval[6];
	thisval=getValue(this);
	putValue(P_ASG_17_1_0_25_5_range, round((thisval*(1.0) + (0.0)),(1)));
	getValue(P_ASG_17_1_0_25, superval);
	superval[4]=thisval;
	putValue(P_ASG_17_1_0_25,superval);
}

// Ueberwachung der Darstellungsvariable der Range
on envVar P_ASG_17_1_0_25_6_range
{
	double thisval, helpval;
	thisval=getValue(this);
	helpval=(thisval-(0.0))*(1.0);
	if(thisval<0)
		helpval=round(helpval-((word)(helpval+2)),1)+((word)(helpval+2));
	else
		helpval=round(helpval, 1);
	putValue(P_ASG_17_1_0_25_6, helpval);
}

// Ueberwachung der Range-Variable im uebertragungsformat (nicht sichtbar)
on envVar P_ASG_17_1_0_25_6
{
	byte thisval;
	byte superval[6];
	thisval=getValue(this);
	putValue(P_ASG_17_1_0_25_6_range, round((thisval*(1.0) + (0.0)),(1)));
	getValue(P_ASG_17_1_0_25, superval);
	superval[5]=thisval;
	putValue(P_ASG_17_1_0_25,superval);
}

on envVar P_ASG_17_1_0_26Get_BTN
{
 if (P_ASG_17_1_0_26Get_BTN_already_pressed == 0)
  {
       putValue(P_ASG_17_1_0_26_ErrCode,0);
       SetControlBackColor(panel_name,"errField_P_ASG_17_1_0_26",MakeRGB(255,255,255));
       P_ASG_17_1_0_26Get_BTN_already_pressed = 1;
 }
 else
 {
       Request_Void(LSGID, P_ASG_17_1_0_26_ID, DataGet_REQ); 
       P_ASG_17_1_0_26Get_BTN_already_pressed = 0;
 }
}

on envVar P_ASG_17_1_0_26SetGet_BTN
{
	byte BAPTemp[6];
    if (P_ASG_17_1_0_26SetGet_BTN_already_pressed == 0)
    {
       putValue(P_ASG_17_1_0_26_ErrCode,0);
       SetControlBackColor(panel_name,"errField_P_ASG_17_1_0_26",MakeRGB(255,255,255));
       P_ASG_17_1_0_26SetGet_BTN_already_pressed = 1;
    }
    else
    {
       getValue(P_ASG_17_1_0_26, BAPTemp);
       Request_ByteSequence(LSGID, P_ASG_17_1_0_26_ID, DataSetGet_REQ, BAPTemp, getValueSize(P_ASG_17_1_0_26));
       P_ASG_17_1_0_26SetGet_BTN_already_pressed = 0;
    }
}

on envVar P_ASG_17_1_0_26
{
	int i;
	byte superval[6];
	byte param1;
	byte param2;
	byte param3;
	byte param4;
	byte param5;
	byte param6;
	getValue(P_ASG_17_1_0_26, superval);
	param1 = superval[0];
	putValue(P_ASG_17_1_0_26_1, param1);
	getValue(P_ASG_17_1_0_26, superval);
	param2 = superval[1];
	putValue(P_ASG_17_1_0_26_2, param2);
	getValue(P_ASG_17_1_0_26, superval);
	param3 = superval[2];
	putValue(P_ASG_17_1_0_26_3, param3);
	getValue(P_ASG_17_1_0_26, superval);
	param4 = superval[3];
	putValue(P_ASG_17_1_0_26_4, param4);
	getValue(P_ASG_17_1_0_26, superval);
	param5 = superval[4];
	putValue(P_ASG_17_1_0_26_5, param5);
	getValue(P_ASG_17_1_0_26, superval);
	param6 = superval[5];
	putValue(P_ASG_17_1_0_26_6, param6);
}

on envVar P_ASG_17_1_0_26_1
{
	byte thisval;
	byte superval[6];
	thisval=getValue(this);
	getValue(P_ASG_17_1_0_26, superval);
	superval[0]=thisval;
	putValue(P_ASG_17_1_0_26,superval);
}

// Ueberwachung der Darstellungsvariable der Range
on envVar P_ASG_17_1_0_26_2_range
{
	double thisval, helpval;
	thisval=getValue(this);
//IssueList #4
	//helpval=(thisval-(1.0))*(1.0);
	helpval=(thisval-(0.0))*(1.0);
	if(thisval<0)
		helpval=round(helpval-((word)(helpval+2)),1)+((word)(helpval+2));
	else
		helpval=round(helpval, 1);
	putValue(P_ASG_17_1_0_26_2, helpval);
}

// Ueberwachung der Range-Variable im uebertragungsformat (nicht sichtbar)
on envVar P_ASG_17_1_0_26_2
{
	byte thisval;
	byte superval[6];
	thisval=getValue(this);
//IssueList #4
	//putValue(P_ASG_17_1_0_26_2_range, round((thisval*(1.0) + (1.0)),(1)));
	putValue(P_ASG_17_1_0_26_2_range, round((thisval*(1.0) + (0.0)),(1)));
	getValue(P_ASG_17_1_0_26, superval);
	superval[1]=thisval;
	putValue(P_ASG_17_1_0_26,superval);
}

// Ueberwachung der Darstellungsvariable der Range
on envVar P_ASG_17_1_0_26_3_range
{
	double thisval, helpval;
	thisval=getValue(this);
//IssueList #4
	//helpval=(thisval-(1.0))*(1.0);
	helpval=(thisval-(0.0))*(1.0);
	if(thisval<0)
		helpval=round(helpval-((word)(helpval+2)),1)+((word)(helpval+2));
	else
		helpval=round(helpval, 1);
	putValue(P_ASG_17_1_0_26_3, helpval);
}

// Ueberwachung der Range-Variable im uebertragungsformat (nicht sichtbar)
on envVar P_ASG_17_1_0_26_3
{
	byte thisval;
	byte superval[6];
	thisval=getValue(this);
//IssueList #4
	//putValue(P_ASG_17_1_0_26_3_range, round((thisval*(1.0) + (1.0)),(1)));
	putValue(P_ASG_17_1_0_26_3_range, round((thisval*(1.0) + (0.0)),(1)));
	getValue(P_ASG_17_1_0_26, superval);
	superval[2]=thisval;
	putValue(P_ASG_17_1_0_26,superval);
}

// Ueberwachung der Darstellungsvariable der Range
on envVar P_ASG_17_1_0_26_4_range
{
	double thisval, helpval;
	thisval=getValue(this);
	helpval=(thisval-(0.0))*(1.0);
	if(thisval<0)
		helpval=round(helpval-((word)(helpval+2)),1)+((word)(helpval+2));
	else
		helpval=round(helpval, 1);
	putValue(P_ASG_17_1_0_26_4, helpval);
}

// Ueberwachung der Range-Variable im uebertragungsformat (nicht sichtbar)
on envVar P_ASG_17_1_0_26_4
{
	byte thisval;
	byte superval[6];
	thisval=getValue(this);
	putValue(P_ASG_17_1_0_26_4_range, round((thisval*(1.0) + (0.0)),(1)));
	getValue(P_ASG_17_1_0_26, superval);
	superval[3]=thisval;
	putValue(P_ASG_17_1_0_26,superval);
}

// Ueberwachung der Darstellungsvariable der Range
on envVar P_ASG_17_1_0_26_5_range
{
	double thisval, helpval;
	thisval=getValue(this);
	helpval=(thisval-(0.0))*(1.0);
	if(thisval<0)
		helpval=round(helpval-((word)(helpval+2)),1)+((word)(helpval+2));
	else
		helpval=round(helpval, 1);
	putValue(P_ASG_17_1_0_26_5, helpval);
}

// Ueberwachung der Range-Variable im uebertragungsformat (nicht sichtbar)
on envVar P_ASG_17_1_0_26_5
{
	byte thisval;
	byte superval[6];
	thisval=getValue(this);
	putValue(P_ASG_17_1_0_26_5_range, round((thisval*(1.0) + (0.0)),(1)));
	getValue(P_ASG_17_1_0_26, superval);
	superval[4]=thisval;
	putValue(P_ASG_17_1_0_26,superval);
}

// Ueberwachung der Darstellungsvariable der Range
on envVar P_ASG_17_1_0_26_6_range
{
	double thisval, helpval;
	thisval=getValue(this);
	helpval=(thisval-(0.0))*(1.0);
	if(thisval<0)
		helpval=round(helpval-((word)(helpval+2)),1)+((word)(helpval+2));
	else
		helpval=round(helpval, 1);
	putValue(P_ASG_17_1_0_26_6, helpval);
}

// Ueberwachung der Range-Variable im uebertragungsformat (nicht sichtbar)
on envVar P_ASG_17_1_0_26_6
{
	byte thisval;
	byte superval[6];
	thisval=getValue(this);
	putValue(P_ASG_17_1_0_26_6_range, round((thisval*(1.0) + (0.0)),(1)));
	getValue(P_ASG_17_1_0_26, superval);
	superval[5]=thisval;
	putValue(P_ASG_17_1_0_26,superval);
}

on envVar P_ASG_17_1_0_27Get_BTN
{
 if (P_ASG_17_1_0_27Get_BTN_already_pressed == 0)
  {
       putValue(P_ASG_17_1_0_27_ErrCode,0);
       SetControlBackColor(panel_name,"errField_P_ASG_17_1_0_27",MakeRGB(255,255,255));
       P_ASG_17_1_0_27Get_BTN_already_pressed = 1;
 }
 else
 {
       Request_Void(LSGID, P_ASG_17_1_0_27_ID, DataGet_REQ); 
       P_ASG_17_1_0_27Get_BTN_already_pressed = 0;
 }
}

on envVar P_ASG_17_1_0_27SetGet_BTN
{
	byte BAPTemp[7];
    if (P_ASG_17_1_0_27SetGet_BTN_already_pressed == 0)
    {
       putValue(P_ASG_17_1_0_27_ErrCode,0);
       SetControlBackColor(panel_name,"errField_P_ASG_17_1_0_27",MakeRGB(255,255,255));
       P_ASG_17_1_0_27SetGet_BTN_already_pressed = 1;
    }
    else
    {
	   P_ASG_17_1_0_27_BuildFct();
       getValue(P_ASG_17_1_0_27, BAPTemp);
       Request_ByteSequence(LSGID, P_ASG_17_1_0_27_ID, DataSetGet_REQ, BAPTemp, getValueSize(P_ASG_17_1_0_27));
       if(getValue(P_ASG_17_1_0_27_IntTlgEn)) //getValue(IT))
       {
         intertelegram_err(P_ASG_17_1_0_27_ID);
       }
       if(getValue(P_ASG_17_1_0_27_SegmEn))   //getvalue(SG)
       {
         sequence_err(P_ASG_17_1_0_27_ID,elCount(BAPTemp));
       }
       P_ASG_17_1_0_27SetGet_BTN_already_pressed = 0;
    }
}

// Man darf gleichzeitig nur Checkbox fuer SegmError oder IntertelegramError aktiviert werden
on envVar P_ASG_17_1_0_27_IntTlgEn
{
       if(getValue(this)) 
       {
           putValue(P_ASG_17_1_0_27_SegmEn,0);
           intertelegram_err(P_ASG_17_1_0_27_ID);
       }
       else
       {
           intertelegram_err_off(P_ASG_17_1_0_27_ID);
       }
}

// Man darf gleichzeitig nur Checkbox fuer SegmError oder IntertelegramError aktiviert werden
on envVar P_ASG_17_1_0_27_SegmEn
{
       if(getValue(this)) 
       {
           putValue(P_ASG_17_1_0_27_IntTlgEn,0);
           sequence_err(P_ASG_17_1_0_27_ID,getValueSize(P_ASG_17_1_0_27_SegmEn));
       }
       else
       {
              sequence_err_off(P_ASG_17_1_0_27_ID);
       }
}

on envVar P_ASG_17_1_0_27
{
	int i;
	byte superval[7];
	byte param1;
	byte param2;
	byte param3;
	byte param4;
	byte param5;
	byte param6;
	byte param7;
	byte param8;
	int currentPos;
	currentPos = 0;
	for( i = 0; i < 7; i++ )
	{
		superval[i] = 0;
	}
	getValue(P_ASG_17_1_0_27, superval);
	///////// Start Param 1 - UINT8 /////////
	param1 = superval[currentPos++];
	putValue(P_ASG_17_1_0_27_1, param1);
	///////// Start Param 2 - UINT8 /////////
	param2 = superval[currentPos++];
	putValue(P_ASG_17_1_0_27_2, param2);
	///////// Start Param 3 - UINT8 /////////
	param3 = superval[currentPos++];
	putValue(P_ASG_17_1_0_27_3, param3);
	///////// Start Param 4 - UINT8 /////////
	param4 = superval[currentPos++];
	putValue(P_ASG_17_1_0_27_4, param4);
	///////// Start Param 5 - UINT8 /////////
	param5 = superval[currentPos++];
	putValue(P_ASG_17_1_0_27_5, param5);
	///////// Start Param 6 - NIBBLE /////////
	param6 = (superval[currentPos] & 0xf0)>>4;
	putValue(P_ASG_17_1_0_27_6, param6);
	///////// Start Param 7 - NIBBLE /////////
	param7 = superval[currentPos++] & 0x0f;
	putValue(P_ASG_17_1_0_27_7, param7);
	///////// Start Param 8 - UINT8 /////////
	param8 = superval[currentPos++];
	putValue(P_ASG_17_1_0_27_8, param8);
}

//Build Function
P_ASG_17_1_0_27_BuildFct()
{
	int i;
	int currentPos;
	byte superval[7];
	byte param1;
	byte param2;
	byte param3;
	byte param4;
	byte param5;
	byte param6;
	byte param7;
	byte mask8;
	byte param8;

	currentPos = 0;
	for( i = 0; i < 7; i++ )
	{
		superval[i] = 0;
	}
	param1 =getValue(P_ASG_17_1_0_27_1);
	putValue(P_ASG_17_1_0_27_1_range, round((param1*(1.0) + (2000.0)),(1)));
	superval[currentPos++]=param1;
	param2 =getValue(P_ASG_17_1_0_27_2);
	putValue(P_ASG_17_1_0_27_2_range, round((param2*(1.0) + (0.0)),(1)));
	superval[currentPos++]=param2;
	param3 =getValue(P_ASG_17_1_0_27_3);
	putValue(P_ASG_17_1_0_27_3_range, round((param3*(1.0) + (0.0)),(1)));
	superval[currentPos++]=param3;
	param4 =getValue(P_ASG_17_1_0_27_4);
	putValue(P_ASG_17_1_0_27_4_range, round((param4*(1.0) + (0.0)),(1)));
	superval[currentPos++]=param4;
	param5 =getValue(P_ASG_17_1_0_27_5);
	putValue(P_ASG_17_1_0_27_5_range, round((param5*(1.0) + (0.0)),(1)));
	superval[currentPos++]=param5;
	param6 =getValue(P_ASG_17_1_0_27_6);
	param6=param6&0x000f;
	superval[currentPos]= superval[currentPos]&0x0f;
	superval[currentPos]= superval[currentPos]|(param6<<4);
	param7 =getValue(P_ASG_17_1_0_27_7);
	param7=param7&0x000f;
	superval[currentPos]= superval[currentPos]&0xf0;
	superval[currentPos]= superval[currentPos]|param7;
	currentPos++;
	mask8=0x1;
	param8 =getValue(P_ASG_17_1_0_27_8);
	if(param8&(mask8<<0))
		putValue(P_ASG_17_1_0_27_8_0, 1);
	else
		putValue(P_ASG_17_1_0_27_8_0, 0);
	if(param8&(mask8<<1))
		putValue(P_ASG_17_1_0_27_8_1, 1);
	else
		putValue(P_ASG_17_1_0_27_8_1, 0);
	if(param8&(mask8<<2))
		putValue(P_ASG_17_1_0_27_8_2, 1);
	else
		putValue(P_ASG_17_1_0_27_8_2, 0);
	if(param8&(mask8<<3))
		putValue(P_ASG_17_1_0_27_8_3, 1);
	else
		putValue(P_ASG_17_1_0_27_8_3, 0);
	superval[currentPos++]=param8;
	putValue(P_ASG_17_1_0_27, superval, currentPos);
}

// Ueberwachung der Darstellungsvariable der Range
on envVar P_ASG_17_1_0_27_1_range
{
	double thisval, helpval;
	thisval=getValue(this);
	helpval=(thisval-(2000.0))*(1.0);
	if(thisval<0)
		helpval=round(helpval-((word)(helpval+2)),1)+((word)(helpval+2));
	else
		helpval=round(helpval, 1);
	putValue(P_ASG_17_1_0_27_1, helpval);
}

on envVar P_ASG_17_1_0_27_1
{
	P_ASG_17_1_0_27_BuildFct();
}

// Ueberwachung der Darstellungsvariable der Range
on envVar P_ASG_17_1_0_27_2_range
{
	double thisval, helpval;
	thisval=getValue(this);
	helpval=(thisval-(0.0))*(1.0);
	if(thisval<0)
		helpval=round(helpval-((word)(helpval+2)),1)+((word)(helpval+2));
	else
		helpval=round(helpval, 1);
	putValue(P_ASG_17_1_0_27_2, helpval);
}

on envVar P_ASG_17_1_0_27_2
{
	P_ASG_17_1_0_27_BuildFct();
}

// Ueberwachung der Darstellungsvariable der Range
on envVar P_ASG_17_1_0_27_3_range
{
	double thisval, helpval;
	thisval=getValue(this);
	helpval=(thisval-(0.0))*(1.0);
	if(thisval<0)
		helpval=round(helpval-((word)(helpval+2)),1)+((word)(helpval+2));
	else
		helpval=round(helpval, 1);
	putValue(P_ASG_17_1_0_27_3, helpval);
}

on envVar P_ASG_17_1_0_27_3
{
	P_ASG_17_1_0_27_BuildFct();
}

// Ueberwachung der Darstellungsvariable der Range
on envVar P_ASG_17_1_0_27_4_range
{
	double thisval, helpval;
	thisval=getValue(this);
	helpval=(thisval-(0.0))*(1.0);
	if(thisval<0)
		helpval=round(helpval-((word)(helpval+2)),1)+((word)(helpval+2));
	else
		helpval=round(helpval, 1);
	putValue(P_ASG_17_1_0_27_4, helpval);
}

on envVar P_ASG_17_1_0_27_4
{
	P_ASG_17_1_0_27_BuildFct();
}

// Ueberwachung der Darstellungsvariable der Range
on envVar P_ASG_17_1_0_27_5_range
{
	double thisval, helpval;
	thisval=getValue(this);
	helpval=(thisval-(0.0))*(1.0);
	if(thisval<0)
		helpval=round(helpval-((word)(helpval+2)),1)+((word)(helpval+2));
	else
		helpval=round(helpval, 1);
	putValue(P_ASG_17_1_0_27_5, helpval);
}

on envVar P_ASG_17_1_0_27_5
{
	P_ASG_17_1_0_27_BuildFct();
}

on envVar P_ASG_17_1_0_27_6
{
	P_ASG_17_1_0_27_BuildFct();
}

on envVar P_ASG_17_1_0_27_7
{
	P_ASG_17_1_0_27_BuildFct();
}

on envVar P_ASG_17_1_0_27_8_0
{
	byte bitval;
	//thisval steht hier fuer den bitfield-wert, 
	//aus Generierungsgruenden hier keine einheitliche Bezeichnung moeglich.
	byte thisval;
	bitval= getValue(this);
	thisval= getValue(P_ASG_17_1_0_27_8);
	putValue(P_ASG_17_1_0_27_8, thisval&~(1<<0)|(bitval<<0));
}

on envVar P_ASG_17_1_0_27_8_1
{
	byte bitval;
	//thisval steht hier fuer den bitfield-wert, 
	//aus Generierungsgruenden hier keine einheitliche Bezeichnung moeglich.
	byte thisval;
	bitval= getValue(this);
	thisval= getValue(P_ASG_17_1_0_27_8);
	putValue(P_ASG_17_1_0_27_8, thisval&~(1<<1)|(bitval<<1));
}

on envVar P_ASG_17_1_0_27_8_2
{
	byte bitval;
	//thisval steht hier fuer den bitfield-wert, 
	//aus Generierungsgruenden hier keine einheitliche Bezeichnung moeglich.
	byte thisval;
	bitval= getValue(this);
	thisval= getValue(P_ASG_17_1_0_27_8);
	putValue(P_ASG_17_1_0_27_8, thisval&~(1<<2)|(bitval<<2));
}

on envVar P_ASG_17_1_0_27_8_3
{
	byte bitval;
	//thisval steht hier fuer den bitfield-wert, 
	//aus Generierungsgruenden hier keine einheitliche Bezeichnung moeglich.
	byte thisval;
	bitval= getValue(this);
	thisval= getValue(P_ASG_17_1_0_27_8);
	putValue(P_ASG_17_1_0_27_8, thisval&~(1<<3)|(bitval<<3));
}

on envVar P_ASG_17_1_0_27_8
{
	P_ASG_17_1_0_27_BuildFct();
}

on envVar P_ASG_17_1_0_28Get_BTN
{
 if (P_ASG_17_1_0_28Get_BTN_already_pressed == 0)
  {
       putValue(P_ASG_17_1_0_28_ErrCode,0);
       SetControlBackColor(panel_name,"errField_P_ASG_17_1_0_28",MakeRGB(255,255,255));
       P_ASG_17_1_0_28Get_BTN_already_pressed = 1;
 }
 else
 {
       Request_Void(LSGID, P_ASG_17_1_0_28_ID, DataGet_REQ); 
       P_ASG_17_1_0_28Get_BTN_already_pressed = 0;
 }
}

on envVar P_ASG_17_1_0_28SetGet_BTN
{
	byte BAPTemp[7];
    if (P_ASG_17_1_0_28SetGet_BTN_already_pressed == 0)
    {
       putValue(P_ASG_17_1_0_28_ErrCode,0);
       SetControlBackColor(panel_name,"errField_P_ASG_17_1_0_28",MakeRGB(255,255,255));
       P_ASG_17_1_0_28SetGet_BTN_already_pressed = 1;
    }
    else
    {
	   P_ASG_17_1_0_28_BuildFct();
       getValue(P_ASG_17_1_0_28, BAPTemp);
       Request_ByteSequence(LSGID, P_ASG_17_1_0_28_ID, DataSetGet_REQ, BAPTemp, getValueSize(P_ASG_17_1_0_28));
       if(getValue(P_ASG_17_1_0_28_IntTlgEn)) //getValue(IT))
       {
         intertelegram_err(P_ASG_17_1_0_28_ID);
       }
       if(getValue(P_ASG_17_1_0_28_SegmEn))   //getvalue(SG)
       {
         sequence_err(P_ASG_17_1_0_28_ID,elCount(BAPTemp));
       }
       P_ASG_17_1_0_28SetGet_BTN_already_pressed = 0;
    }
}

// Man darf gleichzeitig nur Checkbox fuer SegmError oder IntertelegramError aktiviert werden
on envVar P_ASG_17_1_0_28_IntTlgEn
{
       if(getValue(this)) 
       {
           putValue(P_ASG_17_1_0_28_SegmEn,0);
           intertelegram_err(P_ASG_17_1_0_28_ID);
       }
       else
       {
           intertelegram_err_off(P_ASG_17_1_0_28_ID);
       }
}

// Man darf gleichzeitig nur Checkbox fuer SegmError oder IntertelegramError aktiviert werden
on envVar P_ASG_17_1_0_28_SegmEn
{
       if(getValue(this)) 
       {
           putValue(P_ASG_17_1_0_28_IntTlgEn,0);
           sequence_err(P_ASG_17_1_0_28_ID,getValueSize(P_ASG_17_1_0_28_SegmEn));
       }
       else
       {
              sequence_err_off(P_ASG_17_1_0_28_ID);
       }
}

on envVar P_ASG_17_1_0_28
{
	int i;
	byte superval[7];
	byte param1;
	byte param2;
	byte param3;
	byte param4;
	byte param5;
	byte param6;
	byte param7;
	byte param8;
	int currentPos;
	currentPos = 0;
	for( i = 0; i < 7; i++ )
	{
		superval[i] = 0;
	}
	getValue(P_ASG_17_1_0_28, superval);
	///////// Start Param 1 - UINT8 /////////
	param1 = superval[currentPos++];
	putValue(P_ASG_17_1_0_28_1, param1);
	///////// Start Param 2 - UINT8 /////////
	param2 = superval[currentPos++];
	putValue(P_ASG_17_1_0_28_2, param2);
	///////// Start Param 3 - UINT8 /////////
	param3 = superval[currentPos++];
	putValue(P_ASG_17_1_0_28_3, param3);
	///////// Start Param 4 - UINT8 /////////
	param4 = superval[currentPos++];
	putValue(P_ASG_17_1_0_28_4, param4);
	///////// Start Param 5 - UINT8 /////////
	param5 = superval[currentPos++];
	putValue(P_ASG_17_1_0_28_5, param5);
	///////// Start Param 6 - NIBBLE /////////
	param6 = (superval[currentPos] & 0xf0)>>4;
	putValue(P_ASG_17_1_0_28_6, param6);
	///////// Start Param 7 - NIBBLE /////////
	param7 = superval[currentPos++] & 0x0f;
	putValue(P_ASG_17_1_0_28_7, param7);
	///////// Start Param 8 - UINT8 /////////
	param8 = superval[currentPos++];
	putValue(P_ASG_17_1_0_28_8, param8);
}

//Build Function
P_ASG_17_1_0_28_BuildFct()
{
	int i;
	int currentPos;
	byte superval[7];
	byte param1;
	byte param2;
	byte param3;
	byte param4;
	byte param5;
	byte param6;
	byte param7;
	byte mask8;
	byte param8;

	currentPos = 0;
	for( i = 0; i < 7; i++ )
	{
		superval[i] = 0;
	}
	param1 =getValue(P_ASG_17_1_0_28_1);
	putValue(P_ASG_17_1_0_28_1_range, round((param1*(1.0) + (2000.0)),(1)));
	superval[currentPos++]=param1;
	param2 =getValue(P_ASG_17_1_0_28_2);
	putValue(P_ASG_17_1_0_28_2_range, round((param2*(1.0) + (0.0)),(1)));
	superval[currentPos++]=param2;
	param3 =getValue(P_ASG_17_1_0_28_3);
	putValue(P_ASG_17_1_0_28_3_range, round((param3*(1.0) + (0.0)),(1)));
	superval[currentPos++]=param3;
	param4 =getValue(P_ASG_17_1_0_28_4);
	putValue(P_ASG_17_1_0_28_4_range, round((param4*(1.0) + (0.0)),(1)));
	superval[currentPos++]=param4;
	param5 =getValue(P_ASG_17_1_0_28_5);
	putValue(P_ASG_17_1_0_28_5_range, round((param5*(1.0) + (0.0)),(1)));
	superval[currentPos++]=param5;
	param6 =getValue(P_ASG_17_1_0_28_6);
	param6=param6&0x000f;
	superval[currentPos]= superval[currentPos]&0x0f;
	superval[currentPos]= superval[currentPos]|(param6<<4);
	param7 =getValue(P_ASG_17_1_0_28_7);
	param7=param7&0x000f;
	superval[currentPos]= superval[currentPos]&0xf0;
	superval[currentPos]= superval[currentPos]|param7;
	currentPos++;
	mask8=0x1;
	param8 =getValue(P_ASG_17_1_0_28_8);
	if(param8&(mask8<<0))
		putValue(P_ASG_17_1_0_28_8_0, 1);
	else
		putValue(P_ASG_17_1_0_28_8_0, 0);
	if(param8&(mask8<<1))
		putValue(P_ASG_17_1_0_28_8_1, 1);
	else
		putValue(P_ASG_17_1_0_28_8_1, 0);
	if(param8&(mask8<<2))
		putValue(P_ASG_17_1_0_28_8_2, 1);
	else
		putValue(P_ASG_17_1_0_28_8_2, 0);
	if(param8&(mask8<<3))
		putValue(P_ASG_17_1_0_28_8_3, 1);
	else
		putValue(P_ASG_17_1_0_28_8_3, 0);
	superval[currentPos++]=param8;
	putValue(P_ASG_17_1_0_28, superval, currentPos);
}

// Ueberwachung der Darstellungsvariable der Range
on envVar P_ASG_17_1_0_28_1_range
{
	double thisval, helpval;
	thisval=getValue(this);
	helpval=(thisval-(2000.0))*(1.0);
	if(thisval<0)
		helpval=round(helpval-((word)(helpval+2)),1)+((word)(helpval+2));
	else
		helpval=round(helpval, 1);
	putValue(P_ASG_17_1_0_28_1, helpval);
}

on envVar P_ASG_17_1_0_28_1
{
	P_ASG_17_1_0_28_BuildFct();
}

// Ueberwachung der Darstellungsvariable der Range
on envVar P_ASG_17_1_0_28_2_range
{
	double thisval, helpval;
	thisval=getValue(this);
	helpval=(thisval-(0.0))*(1.0);
	if(thisval<0)
		helpval=round(helpval-((word)(helpval+2)),1)+((word)(helpval+2));
	else
		helpval=round(helpval, 1);
	putValue(P_ASG_17_1_0_28_2, helpval);
}

on envVar P_ASG_17_1_0_28_2
{
	P_ASG_17_1_0_28_BuildFct();
}

// Ueberwachung der Darstellungsvariable der Range
on envVar P_ASG_17_1_0_28_3_range
{
	double thisval, helpval;
	thisval=getValue(this);
	helpval=(thisval-(0.0))*(1.0);
	if(thisval<0)
		helpval=round(helpval-((word)(helpval+2)),1)+((word)(helpval+2));
	else
		helpval=round(helpval, 1);
	putValue(P_ASG_17_1_0_28_3, helpval);
}

on envVar P_ASG_17_1_0_28_3
{
	P_ASG_17_1_0_28_BuildFct();
}

// Ueberwachung der Darstellungsvariable der Range
on envVar P_ASG_17_1_0_28_4_range
{
	double thisval, helpval;
	thisval=getValue(this);
	helpval=(thisval-(0.0))*(1.0);
	if(thisval<0)
		helpval=round(helpval-((word)(helpval+2)),1)+((word)(helpval+2));
	else
		helpval=round(helpval, 1);
	putValue(P_ASG_17_1_0_28_4, helpval);
}

on envVar P_ASG_17_1_0_28_4
{
	P_ASG_17_1_0_28_BuildFct();
}

// Ueberwachung der Darstellungsvariable der Range
on envVar P_ASG_17_1_0_28_5_range
{
	double thisval, helpval;
	thisval=getValue(this);
	helpval=(thisval-(0.0))*(1.0);
	if(thisval<0)
		helpval=round(helpval-((word)(helpval+2)),1)+((word)(helpval+2));
	else
		helpval=round(helpval, 1);
	putValue(P_ASG_17_1_0_28_5, helpval);
}

on envVar P_ASG_17_1_0_28_5
{
	P_ASG_17_1_0_28_BuildFct();
}

on envVar P_ASG_17_1_0_28_6
{
	P_ASG_17_1_0_28_BuildFct();
}

on envVar P_ASG_17_1_0_28_7
{
	P_ASG_17_1_0_28_BuildFct();
}

on envVar P_ASG_17_1_0_28_8_0
{
	byte bitval;
	//thisval steht hier fuer den bitfield-wert, 
	//aus Generierungsgruenden hier keine einheitliche Bezeichnung moeglich.
	byte thisval;
	bitval= getValue(this);
	thisval= getValue(P_ASG_17_1_0_28_8);
	putValue(P_ASG_17_1_0_28_8, thisval&~(1<<0)|(bitval<<0));
}

on envVar P_ASG_17_1_0_28_8_1
{
	byte bitval;
	//thisval steht hier fuer den bitfield-wert, 
	//aus Generierungsgruenden hier keine einheitliche Bezeichnung moeglich.
	byte thisval;
	bitval= getValue(this);
	thisval= getValue(P_ASG_17_1_0_28_8);
	putValue(P_ASG_17_1_0_28_8, thisval&~(1<<1)|(bitval<<1));
}

on envVar P_ASG_17_1_0_28_8_2
{
	byte bitval;
	//thisval steht hier fuer den bitfield-wert, 
	//aus Generierungsgruenden hier keine einheitliche Bezeichnung moeglich.
	byte thisval;
	bitval= getValue(this);
	thisval= getValue(P_ASG_17_1_0_28_8);
	putValue(P_ASG_17_1_0_28_8, thisval&~(1<<2)|(bitval<<2));
}

on envVar P_ASG_17_1_0_28_8_3
{
	byte bitval;
	//thisval steht hier fuer den bitfield-wert, 
	//aus Generierungsgruenden hier keine einheitliche Bezeichnung moeglich.
	byte thisval;
	bitval= getValue(this);
	thisval= getValue(P_ASG_17_1_0_28_8);
	putValue(P_ASG_17_1_0_28_8, thisval&~(1<<3)|(bitval<<3));
}

on envVar P_ASG_17_1_0_28_8
{
	P_ASG_17_1_0_28_BuildFct();
}

on envVar P_ASG_17_1_0_29Get_BTN
{
 if (P_ASG_17_1_0_29Get_BTN_already_pressed == 0)
  {
       putValue(P_ASG_17_1_0_29_ErrCode,0);
       SetControlBackColor(panel_name,"errField_P_ASG_17_1_0_29",MakeRGB(255,255,255));
       P_ASG_17_1_0_29Get_BTN_already_pressed = 1;
 }
 else
 {
       Request_Void(LSGID, P_ASG_17_1_0_29_ID, DataGet_REQ); 
       P_ASG_17_1_0_29Get_BTN_already_pressed = 0;
 }
}

on envVar P_ASG_17_1_0_29SetGet_BTN
{
	byte BAPTemp[7];
    if (P_ASG_17_1_0_29SetGet_BTN_already_pressed == 0)
    {
       putValue(P_ASG_17_1_0_29_ErrCode,0);
       SetControlBackColor(panel_name,"errField_P_ASG_17_1_0_29",MakeRGB(255,255,255));
       P_ASG_17_1_0_29SetGet_BTN_already_pressed = 1;
    }
    else
    {
	   P_ASG_17_1_0_29_BuildFct();
       getValue(P_ASG_17_1_0_29, BAPTemp);
       Request_ByteSequence(LSGID, P_ASG_17_1_0_29_ID, DataSetGet_REQ, BAPTemp, getValueSize(P_ASG_17_1_0_29));
       if(getValue(P_ASG_17_1_0_29_IntTlgEn)) //getValue(IT))
       {
         intertelegram_err(P_ASG_17_1_0_29_ID);
       }
       if(getValue(P_ASG_17_1_0_29_SegmEn))   //getvalue(SG)
       {
         sequence_err(P_ASG_17_1_0_29_ID,elCount(BAPTemp));
       }
       P_ASG_17_1_0_29SetGet_BTN_already_pressed = 0;
    }
}

// Man darf gleichzeitig nur Checkbox fuer SegmError oder IntertelegramError aktiviert werden
on envVar P_ASG_17_1_0_29_IntTlgEn
{
       if(getValue(this)) 
       {
           putValue(P_ASG_17_1_0_29_SegmEn,0);
           intertelegram_err(P_ASG_17_1_0_29_ID);
       }
       else
       {
           intertelegram_err_off(P_ASG_17_1_0_29_ID);
       }
}

// Man darf gleichzeitig nur Checkbox fuer SegmError oder IntertelegramError aktiviert werden
on envVar P_ASG_17_1_0_29_SegmEn
{
       if(getValue(this)) 
       {
           putValue(P_ASG_17_1_0_29_IntTlgEn,0);
           sequence_err(P_ASG_17_1_0_29_ID,getValueSize(P_ASG_17_1_0_29_SegmEn));
       }
       else
       {
              sequence_err_off(P_ASG_17_1_0_29_ID);
       }
}

on envVar P_ASG_17_1_0_29
{
	int i;
	byte superval[7];
	byte param1;
	byte param2;
	byte param3;
	byte param4;
	byte param5;
	byte param6;
	byte param7;
	byte param8;
	int currentPos;
	currentPos = 0;
	for( i = 0; i < 7; i++ )
	{
		superval[i] = 0;
	}
	getValue(P_ASG_17_1_0_29, superval);
	///////// Start Param 1 - UINT8 /////////
	param1 = superval[currentPos++];
	putValue(P_ASG_17_1_0_29_1, param1);
	///////// Start Param 2 - UINT8 /////////
	param2 = superval[currentPos++];
	putValue(P_ASG_17_1_0_29_2, param2);
	///////// Start Param 3 - UINT8 /////////
	param3 = superval[currentPos++];
	putValue(P_ASG_17_1_0_29_3, param3);
	///////// Start Param 4 - UINT8 /////////
	param4 = superval[currentPos++];
	putValue(P_ASG_17_1_0_29_4, param4);
	///////// Start Param 5 - UINT8 /////////
	param5 = superval[currentPos++];
	putValue(P_ASG_17_1_0_29_5, param5);
	///////// Start Param 6 - NIBBLE /////////
	param6 = (superval[currentPos] & 0xf0)>>4;
	putValue(P_ASG_17_1_0_29_6, param6);
	///////// Start Param 7 - NIBBLE /////////
	param7 = superval[currentPos++] & 0x0f;
	putValue(P_ASG_17_1_0_29_7, param7);
	///////// Start Param 8 - UINT8 /////////
	param8 = superval[currentPos++];
	putValue(P_ASG_17_1_0_29_8, param8);
}

//Build Function
P_ASG_17_1_0_29_BuildFct()
{
	int i;
	int currentPos;
	byte superval[7];
	byte param1;
	byte param2;
	byte param3;
	byte param4;
	byte param5;
	byte param6;
	byte param7;
	byte mask8;
	byte param8;

	currentPos = 0;
	for( i = 0; i < 7; i++ )
	{
		superval[i] = 0;
	}
	param1 =getValue(P_ASG_17_1_0_29_1);
	putValue(P_ASG_17_1_0_29_1_range, round((param1*(1.0) + (2000.0)),(1)));
	superval[currentPos++]=param1;
	param2 =getValue(P_ASG_17_1_0_29_2);
	putValue(P_ASG_17_1_0_29_2_range, round((param2*(1.0) + (0.0)),(1)));
	superval[currentPos++]=param2;
	param3 =getValue(P_ASG_17_1_0_29_3);
	putValue(P_ASG_17_1_0_29_3_range, round((param3*(1.0) + (0.0)),(1)));
	superval[currentPos++]=param3;
	param4 =getValue(P_ASG_17_1_0_29_4);
	putValue(P_ASG_17_1_0_29_4_range, round((param4*(1.0) + (0.0)),(1)));
	superval[currentPos++]=param4;
	param5 =getValue(P_ASG_17_1_0_29_5);
	putValue(P_ASG_17_1_0_29_5_range, round((param5*(1.0) + (0.0)),(1)));
	superval[currentPos++]=param5;
	param6 =getValue(P_ASG_17_1_0_29_6);
	param6=param6&0x000f;
	superval[currentPos]= superval[currentPos]&0x0f;
	superval[currentPos]= superval[currentPos]|(param6<<4);
	param7 =getValue(P_ASG_17_1_0_29_7);
	param7=param7&0x000f;
	superval[currentPos]= superval[currentPos]&0xf0;
	superval[currentPos]= superval[currentPos]|param7;
	currentPos++;
	mask8=0x1;
	param8 =getValue(P_ASG_17_1_0_29_8);
	if(param8&(mask8<<0))
		putValue(P_ASG_17_1_0_29_8_0, 1);
	else
		putValue(P_ASG_17_1_0_29_8_0, 0);
	if(param8&(mask8<<1))
		putValue(P_ASG_17_1_0_29_8_1, 1);
	else
		putValue(P_ASG_17_1_0_29_8_1, 0);
	if(param8&(mask8<<2))
		putValue(P_ASG_17_1_0_29_8_2, 1);
	else
		putValue(P_ASG_17_1_0_29_8_2, 0);
	if(param8&(mask8<<3))
		putValue(P_ASG_17_1_0_29_8_3, 1);
	else
		putValue(P_ASG_17_1_0_29_8_3, 0);
	superval[currentPos++]=param8;
	putValue(P_ASG_17_1_0_29, superval, currentPos);
}

// Ueberwachung der Darstellungsvariable der Range
on envVar P_ASG_17_1_0_29_1_range
{
	double thisval, helpval;
	thisval=getValue(this);
	helpval=(thisval-(2000.0))*(1.0);
	if(thisval<0)
		helpval=round(helpval-((word)(helpval+2)),1)+((word)(helpval+2));
	else
		helpval=round(helpval, 1);
	putValue(P_ASG_17_1_0_29_1, helpval);
}

on envVar P_ASG_17_1_0_29_1
{
	P_ASG_17_1_0_29_BuildFct();
}

// Ueberwachung der Darstellungsvariable der Range
on envVar P_ASG_17_1_0_29_2_range
{
	double thisval, helpval;
	thisval=getValue(this);
	helpval=(thisval-(0.0))*(1.0);
	if(thisval<0)
		helpval=round(helpval-((word)(helpval+2)),1)+((word)(helpval+2));
	else
		helpval=round(helpval, 1);
	putValue(P_ASG_17_1_0_29_2, helpval);
}

on envVar P_ASG_17_1_0_29_2
{
	P_ASG_17_1_0_29_BuildFct();
}

// Ueberwachung der Darstellungsvariable der Range
on envVar P_ASG_17_1_0_29_3_range
{
	double thisval, helpval;
	thisval=getValue(this);
	helpval=(thisval-(0.0))*(1.0);
	if(thisval<0)
		helpval=round(helpval-((word)(helpval+2)),1)+((word)(helpval+2));
	else
		helpval=round(helpval, 1);
	putValue(P_ASG_17_1_0_29_3, helpval);
}

on envVar P_ASG_17_1_0_29_3
{
	P_ASG_17_1_0_29_BuildFct();
}

// Ueberwachung der Darstellungsvariable der Range
on envVar P_ASG_17_1_0_29_4_range
{
	double thisval, helpval;
	thisval=getValue(this);
	helpval=(thisval-(0.0))*(1.0);
	if(thisval<0)
		helpval=round(helpval-((word)(helpval+2)),1)+((word)(helpval+2));
	else
		helpval=round(helpval, 1);
	putValue(P_ASG_17_1_0_29_4, helpval);
}

on envVar P_ASG_17_1_0_29_4
{
	P_ASG_17_1_0_29_BuildFct();
}

// Ueberwachung der Darstellungsvariable der Range
on envVar P_ASG_17_1_0_29_5_range
{
	double thisval, helpval;
	thisval=getValue(this);
	helpval=(thisval-(0.0))*(1.0);
	if(thisval<0)
		helpval=round(helpval-((word)(helpval+2)),1)+((word)(helpval+2));
	else
		helpval=round(helpval, 1);
	putValue(P_ASG_17_1_0_29_5, helpval);
}

on envVar P_ASG_17_1_0_29_5
{
	P_ASG_17_1_0_29_BuildFct();
}

on envVar P_ASG_17_1_0_29_6
{
	P_ASG_17_1_0_29_BuildFct();
}

on envVar P_ASG_17_1_0_29_7
{
	P_ASG_17_1_0_29_BuildFct();
}

on envVar P_ASG_17_1_0_29_8_0
{
	byte bitval;
	//thisval steht hier fuer den bitfield-wert, 
	//aus Generierungsgruenden hier keine einheitliche Bezeichnung moeglich.
	byte thisval;
	bitval= getValue(this);
	thisval= getValue(P_ASG_17_1_0_29_8);
	putValue(P_ASG_17_1_0_29_8, thisval&~(1<<0)|(bitval<<0));
}

on envVar P_ASG_17_1_0_29_8_1
{
	byte bitval;
	//thisval steht hier fuer den bitfield-wert, 
	//aus Generierungsgruenden hier keine einheitliche Bezeichnung moeglich.
	byte thisval;
	bitval= getValue(this);
	thisval= getValue(P_ASG_17_1_0_29_8);
	putValue(P_ASG_17_1_0_29_8, thisval&~(1<<1)|(bitval<<1));
}

on envVar P_ASG_17_1_0_29_8_2
{
	byte bitval;
	//thisval steht hier fuer den bitfield-wert, 
	//aus Generierungsgruenden hier keine einheitliche Bezeichnung moeglich.
	byte thisval;
	bitval= getValue(this);
	thisval= getValue(P_ASG_17_1_0_29_8);
	putValue(P_ASG_17_1_0_29_8, thisval&~(1<<2)|(bitval<<2));
}

on envVar P_ASG_17_1_0_29_8_3
{
	byte bitval;
	//thisval steht hier fuer den bitfield-wert, 
	//aus Generierungsgruenden hier keine einheitliche Bezeichnung moeglich.
	byte thisval;
	bitval= getValue(this);
	thisval= getValue(P_ASG_17_1_0_29_8);
	putValue(P_ASG_17_1_0_29_8, thisval&~(1<<3)|(bitval<<3));
}

on envVar P_ASG_17_1_0_29_8
{
	P_ASG_17_1_0_29_BuildFct();
}

on envVar P_ASG_17_1_0_30Get_BTN
{
 if (P_ASG_17_1_0_30Get_BTN_already_pressed == 0)
  {
       putValue(P_ASG_17_1_0_30_ErrCode,0);
       SetControlBackColor(panel_name,"errField_P_ASG_17_1_0_30",MakeRGB(255,255,255));
       P_ASG_17_1_0_30Get_BTN_already_pressed = 1;
 }
 else
 {
       Request_Void(LSGID, P_ASG_17_1_0_30_ID, DataGet_REQ); 
       P_ASG_17_1_0_30Get_BTN_already_pressed = 0;
 }
}

on envVar P_ASG_17_1_0_30SetGet_BTN
{
	byte BAPTemp[7];
    if (P_ASG_17_1_0_30SetGet_BTN_already_pressed == 0)
    {
       putValue(P_ASG_17_1_0_30_ErrCode,0);
       SetControlBackColor(panel_name,"errField_P_ASG_17_1_0_30",MakeRGB(255,255,255));
       P_ASG_17_1_0_30SetGet_BTN_already_pressed = 1;
    }
    else
    {
	   P_ASG_17_1_0_30_BuildFct();
       getValue(P_ASG_17_1_0_30, BAPTemp);
       Request_ByteSequence(LSGID, P_ASG_17_1_0_30_ID, DataSetGet_REQ, BAPTemp, getValueSize(P_ASG_17_1_0_30));
       if(getValue(P_ASG_17_1_0_30_IntTlgEn)) //getValue(IT))
       {
         intertelegram_err(P_ASG_17_1_0_30_ID);
       }
       if(getValue(P_ASG_17_1_0_30_SegmEn))   //getvalue(SG)
       {
         sequence_err(P_ASG_17_1_0_30_ID,elCount(BAPTemp));
       }
       P_ASG_17_1_0_30SetGet_BTN_already_pressed = 0;
    }
}

// Man darf gleichzeitig nur Checkbox fuer SegmError oder IntertelegramError aktiviert werden
on envVar P_ASG_17_1_0_30_IntTlgEn
{
       if(getValue(this)) 
       {
           putValue(P_ASG_17_1_0_30_SegmEn,0);
           intertelegram_err(P_ASG_17_1_0_30_ID);
       }
       else
       {
           intertelegram_err_off(P_ASG_17_1_0_30_ID);
       }
}

// Man darf gleichzeitig nur Checkbox fuer SegmError oder IntertelegramError aktiviert werden
on envVar P_ASG_17_1_0_30_SegmEn
{
       if(getValue(this)) 
       {
           putValue(P_ASG_17_1_0_30_IntTlgEn,0);
           sequence_err(P_ASG_17_1_0_30_ID,getValueSize(P_ASG_17_1_0_30_SegmEn));
       }
       else
       {
              sequence_err_off(P_ASG_17_1_0_30_ID);
       }
}

on envVar P_ASG_17_1_0_30
{
	int i;
	byte superval[7];
	byte param1;
	byte param2;
	byte param3;
	byte param4;
	byte param5;
	byte param6;
	byte param7;
	byte param8;
	int currentPos;
	currentPos = 0;
	for( i = 0; i < 7; i++ )
	{
		superval[i] = 0;
	}
	getValue(P_ASG_17_1_0_30, superval);
	///////// Start Param 1 - UINT8 /////////
	param1 = superval[currentPos++];
	putValue(P_ASG_17_1_0_30_1, param1);
	///////// Start Param 2 - UINT8 /////////
	param2 = superval[currentPos++];
	putValue(P_ASG_17_1_0_30_2, param2);
	///////// Start Param 3 - UINT8 /////////
	param3 = superval[currentPos++];
	putValue(P_ASG_17_1_0_30_3, param3);
	///////// Start Param 4 - UINT8 /////////
	param4 = superval[currentPos++];
	putValue(P_ASG_17_1_0_30_4, param4);
	///////// Start Param 5 - UINT8 /////////
	param5 = superval[currentPos++];
	putValue(P_ASG_17_1_0_30_5, param5);
	///////// Start Param 6 - NIBBLE /////////
	param6 = (superval[currentPos] & 0xf0)>>4;
	putValue(P_ASG_17_1_0_30_6, param6);
	///////// Start Param 7 - NIBBLE /////////
	param7 = superval[currentPos++] & 0x0f;
	putValue(P_ASG_17_1_0_30_7, param7);
	///////// Start Param 8 - UINT8 /////////
	param8 = superval[currentPos++];
	putValue(P_ASG_17_1_0_30_8, param8);
}

//Build Function
P_ASG_17_1_0_30_BuildFct()
{
	int i;
	int currentPos;
	byte superval[7];
	byte param1;
	byte param2;
	byte param3;
	byte param4;
	byte param5;
	byte param6;
	byte param7;
	byte mask8;
	byte param8;

	currentPos = 0;
	for( i = 0; i < 7; i++ )
	{
		superval[i] = 0;
	}
	param1 =getValue(P_ASG_17_1_0_30_1);
	putValue(P_ASG_17_1_0_30_1_range, round((param1*(1.0) + (2000.0)),(1)));
	superval[currentPos++]=param1;
	param2 =getValue(P_ASG_17_1_0_30_2);
	putValue(P_ASG_17_1_0_30_2_range, round((param2*(1.0) + (0.0)),(1)));
	superval[currentPos++]=param2;
	param3 =getValue(P_ASG_17_1_0_30_3);
	putValue(P_ASG_17_1_0_30_3_range, round((param3*(1.0) + (0.0)),(1)));
	superval[currentPos++]=param3;
	param4 =getValue(P_ASG_17_1_0_30_4);
	putValue(P_ASG_17_1_0_30_4_range, round((param4*(1.0) + (0.0)),(1)));
	superval[currentPos++]=param4;
	param5 =getValue(P_ASG_17_1_0_30_5);
	putValue(P_ASG_17_1_0_30_5_range, round((param5*(1.0) + (0.0)),(1)));
	superval[currentPos++]=param5;
	param6 =getValue(P_ASG_17_1_0_30_6);
	param6=param6&0x000f;
	superval[currentPos]= superval[currentPos]&0x0f;
	superval[currentPos]= superval[currentPos]|(param6<<4);
	param7 =getValue(P_ASG_17_1_0_30_7);
	param7=param7&0x000f;
	superval[currentPos]= superval[currentPos]&0xf0;
	superval[currentPos]= superval[currentPos]|param7;
	currentPos++;
	mask8=0x1;
	param8 =getValue(P_ASG_17_1_0_30_8);
	if(param8&(mask8<<0))
		putValue(P_ASG_17_1_0_30_8_0, 1);
	else
		putValue(P_ASG_17_1_0_30_8_0, 0);
	if(param8&(mask8<<1))
		putValue(P_ASG_17_1_0_30_8_1, 1);
	else
		putValue(P_ASG_17_1_0_30_8_1, 0);
	if(param8&(mask8<<2))
		putValue(P_ASG_17_1_0_30_8_2, 1);
	else
		putValue(P_ASG_17_1_0_30_8_2, 0);
	if(param8&(mask8<<3))
		putValue(P_ASG_17_1_0_30_8_3, 1);
	else
		putValue(P_ASG_17_1_0_30_8_3, 0);
	superval[currentPos++]=param8;
	putValue(P_ASG_17_1_0_30, superval, currentPos);
}

// Ueberwachung der Darstellungsvariable der Range
on envVar P_ASG_17_1_0_30_1_range
{
	double thisval, helpval;
	thisval=getValue(this);
	helpval=(thisval-(2000.0))*(1.0);
	if(thisval<0)
		helpval=round(helpval-((word)(helpval+2)),1)+((word)(helpval+2));
	else
		helpval=round(helpval, 1);
	putValue(P_ASG_17_1_0_30_1, helpval);
}

on envVar P_ASG_17_1_0_30_1
{
	P_ASG_17_1_0_30_BuildFct();
}

// Ueberwachung der Darstellungsvariable der Range
on envVar P_ASG_17_1_0_30_2_range
{
	double thisval, helpval;
	thisval=getValue(this);
	helpval=(thisval-(0.0))*(1.0);
	if(thisval<0)
		helpval=round(helpval-((word)(helpval+2)),1)+((word)(helpval+2));
	else
		helpval=round(helpval, 1);
	putValue(P_ASG_17_1_0_30_2, helpval);
}

on envVar P_ASG_17_1_0_30_2
{
	P_ASG_17_1_0_30_BuildFct();
}

// Ueberwachung der Darstellungsvariable der Range
on envVar P_ASG_17_1_0_30_3_range
{
	double thisval, helpval;
	thisval=getValue(this);
	helpval=(thisval-(0.0))*(1.0);
	if(thisval<0)
		helpval=round(helpval-((word)(helpval+2)),1)+((word)(helpval+2));
	else
		helpval=round(helpval, 1);
	putValue(P_ASG_17_1_0_30_3, helpval);
}

on envVar P_ASG_17_1_0_30_3
{
	P_ASG_17_1_0_30_BuildFct();
}

// Ueberwachung der Darstellungsvariable der Range
on envVar P_ASG_17_1_0_30_4_range
{
	double thisval, helpval;
	thisval=getValue(this);
	helpval=(thisval-(0.0))*(1.0);
	if(thisval<0)
		helpval=round(helpval-((word)(helpval+2)),1)+((word)(helpval+2));
	else
		helpval=round(helpval, 1);
	putValue(P_ASG_17_1_0_30_4, helpval);
}

on envVar P_ASG_17_1_0_30_4
{
	P_ASG_17_1_0_30_BuildFct();
}

// Ueberwachung der Darstellungsvariable der Range
on envVar P_ASG_17_1_0_30_5_range
{
	double thisval, helpval;
	thisval=getValue(this);
	helpval=(thisval-(0.0))*(1.0);
	if(thisval<0)
		helpval=round(helpval-((word)(helpval+2)),1)+((word)(helpval+2));
	else
		helpval=round(helpval, 1);
	putValue(P_ASG_17_1_0_30_5, helpval);
}

on envVar P_ASG_17_1_0_30_5
{
	P_ASG_17_1_0_30_BuildFct();
}

on envVar P_ASG_17_1_0_30_6
{
	P_ASG_17_1_0_30_BuildFct();
}

on envVar P_ASG_17_1_0_30_7
{
	P_ASG_17_1_0_30_BuildFct();
}

on envVar P_ASG_17_1_0_30_8_0
{
	byte bitval;
	//thisval steht hier fuer den bitfield-wert, 
	//aus Generierungsgruenden hier keine einheitliche Bezeichnung moeglich.
	byte thisval;
	bitval= getValue(this);
	thisval= getValue(P_ASG_17_1_0_30_8);
	putValue(P_ASG_17_1_0_30_8, thisval&~(1<<0)|(bitval<<0));
}

on envVar P_ASG_17_1_0_30_8_1
{
	byte bitval;
	//thisval steht hier fuer den bitfield-wert, 
	//aus Generierungsgruenden hier keine einheitliche Bezeichnung moeglich.
	byte thisval;
	bitval= getValue(this);
	thisval= getValue(P_ASG_17_1_0_30_8);
	putValue(P_ASG_17_1_0_30_8, thisval&~(1<<1)|(bitval<<1));
}

on envVar P_ASG_17_1_0_30_8_2
{
	byte bitval;
	//thisval steht hier fuer den bitfield-wert, 
	//aus Generierungsgruenden hier keine einheitliche Bezeichnung moeglich.
	byte thisval;
	bitval= getValue(this);
	thisval= getValue(P_ASG_17_1_0_30_8);
	putValue(P_ASG_17_1_0_30_8, thisval&~(1<<2)|(bitval<<2));
}

on envVar P_ASG_17_1_0_30_8_3
{
	byte bitval;
	//thisval steht hier fuer den bitfield-wert, 
	//aus Generierungsgruenden hier keine einheitliche Bezeichnung moeglich.
	byte thisval;
	bitval= getValue(this);
	thisval= getValue(P_ASG_17_1_0_30_8);
	putValue(P_ASG_17_1_0_30_8, thisval&~(1<<3)|(bitval<<3));
}

on envVar P_ASG_17_1_0_30_8
{
	P_ASG_17_1_0_30_BuildFct();
}

/**
*
* Template-Funktion zum automatischen befuellen der Array-Daten, die in einer Arrayfunktion genutzt werden.
* Die Funktion wird durch den von BAPSimGen generierten Code aufgerufen.
*
* Parameter:
* - structArray: Muss mindestens nMax * Arraygroesse Bytes Platz haben, wird vom BAPSimGen automatisch generiert
* - structElementsSizeArray: Enthaelt die Groesseangabe jedes Array-Elements. Die Arraygroesse entspricht der Elementanzahl im Array.
*       Byte & Nibble = 1; Word = 2; usw. Bei Strings wird die maximale Stringlaenge angegeben.
* - structElementsTypeArray: Gibt den Datentyp eines Array-Elements zurueck. Die Arraygroesse entspricht der Elmentanzahl im Array.
*                               0x0 = Zahlenwert, also ein Slider, Enum, Bitfield,...
*                               0xE = String (darauf folgt immer eine 2, mit der Angabe der benutzen Bytes im String)
*                               0xF = Laenge der Nutzdaten des Strings, nur return Wert
* - fctID: Kann zur Fallunterscheidung der Funktions-IDs verwendet werden.
* - nMax: Array-Index
*
* Die Funktion kann im Switch-Case beliebig erweitert werden. Der Switch-Case wertet den Parameter fctID aus.
*           
*                    
**/
initStruct(byte structArray[], dword structElementsSizeArray[], byte structElementsTypeArray[], dword structElementsMaxSizeArray[], word fctID, word nMax )
{
    byte rand8;
    word rand16;
    word randSize;
    word index;           //indexNr die an die String Parameter angehaengt wird.
    dword destArraySize;   //groesse von structArray
    dword destStructSize;  //groesse eines "Structs" also destArraySize / Anzahl Elemente (nMax))
    dword rand32;    
    dword i;
    dword pos;    //aktuelle Position im structArray
    dword elpos;  //aktuelle Position in den structElementsXXXArray's
    
    destArraySize = elCount(structArray);
    destStructSize = destArraySize / nMax;    

    Switch(fctID){

        //Idee ist, die Arrays je nach Funcion-ID speziell initalisieren zu koennen.
        //hierbei koennten die Daten z.B. aus einer Datei eingelesen werden,
        //oder auch ueber spezielle init Funktionen mit festen Werten initialisiert werden.
        //Der Default-Fall befuellt das Array mit Random-Werten und Strings mit einem vordefinierten Wort (hier test,)

        default :
        {
            pos = 0; 
            for(i = 1; i <= nMax; i++)
            {
                //walk through the array
                
                elpos = 0;
                while(pos < (destStructSize * i) )
                {   
                    //check Element type
                    if( structElementsTypeArray[elpos] == 0x0)          
                    { //Params like int, word, etc.
                        //check element length
                        Switch(structElementsSizeArray[elpos])
                        {
                            case(1) : //byte / nibble
                                rand8 = random(structElementsMaxSizeArray[elpos]);
                                structArray[pos] = rand8;
                                pos++;
                                break;

                            case(2) : //word / int
                                rand16 = random(structElementsMaxSizeArray[elpos]);
                                int2byte(structArray, pos, rand16);
                                pos += 2;
                                break;

                            case (4) : //dword / long
                                rand32 = random(structElementsMaxSizeArray[elpos]);
                                long2byte(structArray, pos, rand32);
                                pos += 4;
                                break;                        
                         }
                    }
                    else if(structElementsTypeArray[elpos] == 0xE)          
                    { //String Params like byte[]
                        randSize = random(structElementsSizeArray[elpos]);
                        if(randSize < 2) randSize = 2; 
                        index = i-1;
                        setRandomString(structArray ,pos ,structElementsSizeArray[elpos], randSize, index);
                        pos += structElementsSizeArray[elpos];
                    }
                    else if(structElementsTypeArray[elpos] == 0xF)          
                    {
                        int2byte(structArray, pos, randSize);
                        pos += 2;
                        //write("Pos: %d Strlth: %d Type: %d ",pos-1,randSize,structElementsTypeArray[elpos]);
                    
                    }
                    elpos++;
                }
            }   
        break;
        }            
    }
}

long2Byte(byte in[], dword pos, dword value)
{
    if( (elCount(in)-pos) < 4)
        write("Array out ouf bounds - too small!");
    in[pos] = value;
    in[++pos] = (value >> 8);
    in[++pos] = (value >> 16);
    in[++pos] = (value >> 24);
}

int2byte (byte in[],dword pos,word value)
{
    if( (elCount(in)-pos) < 2 )
        write("Array out of bounds - too small!");
    in[pos] = value;
    in[++pos] = (value >> 8);        
}

setRandomString (byte in[], dword pos, word strSize, word randSize, word count)
{
    word endPos, endString, j;
    byte testString[4]={'t','e','s','t'};
    
    endPos = pos + strSize;
    endString = pos + randSize;
    j=0;
    
    int2ascii(in, pos, count);
    pos += 2;
    
    for(pos; pos < endPos ;pos ++)
    {
        if(j > 3 )
            j = 0;
        if(pos < endString)
            in[pos] = testString[j++];
        else
            in[pos] = 0x0;
    }
}

int2ascii (byte in[], dword pos, word value)
{
    //Konvertiert nur die erste und zweite Dezimalstelle, also Zahlen zw. 0 und 99.
    
    //auf 2 Stellen kuerzen
    value = value%100;
    //10er schreiben
    in[pos] = (value/10) + 48;    //  0x30 hex = 48 dez = ascii null
    //1er schreiben
    in[pos+1] = (value%10) + 48;  //  0x30 hex = 48 dez = ascii null
}

