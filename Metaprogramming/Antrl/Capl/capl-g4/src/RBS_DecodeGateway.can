/*@!Encoding:1252*/
/* ------- generated code for Rest Bus Simulation ------- */

variables
{
  dword _MO_Kuehlerluefter_1;
  dword _MO_Kuehlerluefter_2;
  dword _ACC_Abstandsindex;
  double _BEM_STH_Zielzeit;
  double _BEM_Ladezustand;
  double _BEM_UBDM;
  dword _DGN_Verlernzaehler;
  dword _KBI_Kilometerstand_1;
  dword _UH_Monat_1;
  dword _UH_Tag_1;
  double _ESP_Querbeschleunigung;
  double _ESP_Laengsbeschl;
  double _ESP_Verteil_Wankmom;
  double _ESP_Gierrate;
  double _ESP_m_Raddrehz;
  double _ESP_HDC_Regelgeschw;
  double _MO_Drehzahl_01;
  double _LWR_Pos_Schrittmotor;
  dword _LWR_Hoehenwert_VL;
  dword _LWR_Hoehenwert_HL;
  double _MO_Oeldruck;
  double _MO_rel_Ladedruck;
  double _MO_Anzeigedrehz;
  double _MO_Ladedruck;
  double _MO_Ansaugluft_Temp;
  dword _MO_Oel_Temp;
  double _MO_Kuehlmittel_Temp;
  double _MO_Hoeheninfo;
  double _MO_Heizungspumpenansteuerung;
  double _MO_ITM_Kuehlmittel_Temp;
  double _MO_E85_Sensor;
  dword _SCR_Anz_Motorstarts;
  dword _MO_CO2_Faktor;
  dword _SI_Sammel_SG_Fehler;
  double _TSK_Wunschgeschw;
  double _WIV_Verschleissindex;
  double _WIV_Russindex;
}

on envVar eMO_Kuehlerluefter_MUXS
{
    switch (getValue( eMO_Kuehlerluefter_MUXS ))
    {
        case  0: putValue( eMO_Kuehlerluefter_MUXT, "Kuehlerluefter 1" ); break;
        case  1: putValue( eMO_Kuehlerluefter_MUXT, "Kuehlerluefter 2" ); break;
        default: putValue( eMO_Kuehlerluefter_MUXT, "!?!" );
    }
}

on envVar eMO_HYB_Status_HV_LadungS
{
    switch (getValue( eMO_HYB_Status_HV_LadungS ))
    {
        case  0: putValue( eMO_HYB_Status_HV_LadungT, "HV-Ladung nicht notwendig" ); break;
        case  1: putValue( eMO_HYB_Status_HV_LadungT, "HV-Ladung notwendig Freigaben erforderlich" ); break;
        case  2: putValue( eMO_HYB_Status_HV_LadungT, "HV-Ladung laeuf" ); break;
        case  3: putValue( eMO_HYB_Status_HV_LadungT, "HV-Ladung erfolgreich Motorstart moeglich" ); break;
        case  4: putValue( eMO_HYB_Status_HV_LadungT, "HV Ladung abgebrochen" ); break;
        default: putValue( eMO_HYB_Status_HV_LadungT, "!?!" );
    }
}

on envVar eWIV_Anzeige_aktivS
{
    switch (getValue( eWIV_Anzeige_aktivS ))
    {
        case  0: putValue( eWIV_Anzeige_aktivT, "Anzeige aus" ); break;
        case  1: putValue( eWIV_Anzeige_aktivT, "WIV Anzeige aktiv" ); break;
        default: putValue( eWIV_Anzeige_aktivT, "!?!" );
    }
}

on envVar eWIV_Oelmin_WarnS
{
    switch (getValue( eWIV_Oelmin_WarnS ))
    {
        case  0: putValue( eWIV_Oelmin_WarnT, "in Ordnung" ); break;
        case  1: putValue( eWIV_Oelmin_WarnT, "Warnung" ); break;
        default: putValue( eWIV_Oelmin_WarnT, "!?!" );
    }
}

on envVar eWIV_SensorfehlerS
{
    switch (getValue( eWIV_SensorfehlerS ))
    {
        case  0: putValue( eWIV_SensorfehlerT, "in Ordnung" ); break;
        case  1: putValue( eWIV_SensorfehlerT, "Sensor defekt" ); break;
        default: putValue( eWIV_SensorfehlerT, "!?!" );
    }
}

on envVar eWIV_SchieflageS
{
    switch (getValue( eWIV_SchieflageS ))
    {
        case  0: putValue( eWIV_SchieflageT, "Fahrzeug gerade" ); break;
        case  1: putValue( eWIV_SchieflageT, "Fahrzeug in Schieflage" ); break;
        default: putValue( eWIV_SchieflageT, "!?!" );
    }
}

on envVar eMO_Zustand_HWPS
{
    switch (getValue( eMO_Zustand_HWPS ))
    {
        case  0: putValue( eMO_Zustand_HWPT, "HWP nicht schaltbar" ); break;
        case  1: putValue( eMO_Zustand_HWPT, "HWP foerdert nicht" ); break;
        case  2: putValue( eMO_Zustand_HWPT, "HWP foerdert" ); break;
        case  3: putValue( eMO_Zustand_HWPT, "reserviert" ); break;
        default: putValue( eMO_Zustand_HWPT, "!?!" );
    }
}

on envVar eWIV_Oelsystem_aktivS
{
    switch (getValue( eWIV_Oelsystem_aktivS ))
    {
        case  0: putValue( eWIV_Oelsystem_aktivT, "Anzeige aus" ); break;
        case  1: putValue( eWIV_Oelsystem_aktivT, "Anzeige aktiv" ); break;
        default: putValue( eWIV_Oelsystem_aktivT, "!?!" );
    }
}

on envVar eWIV_nicht_betriebswarmS
{
    switch (getValue( eWIV_nicht_betriebswarmS ))
    {
        case  0: putValue( eWIV_nicht_betriebswarmT, "Motor warm" ); break;
        case  1: putValue( eWIV_nicht_betriebswarmT, "Motor nicht betriebswarm" ); break;
        default: putValue( eWIV_nicht_betriebswarmT, "!?!" );
    }
}

on envVar eWIV_Ueberfuell_WarnS
{
    switch (getValue( eWIV_Ueberfuell_WarnS ))
    {
        case  0: putValue( eWIV_Ueberfuell_WarnT, "in Ordnung" ); break;
        case  1: putValue( eWIV_Ueberfuell_WarnT, "Ueberfuellwarnung" ); break;
        default: putValue( eWIV_Ueberfuell_WarnT, "!?!" );
    }
}

on envVar eWIV_laufender_MotorS
{
    switch (getValue( eWIV_laufender_MotorS ))
    {
        case  0: putValue( eWIV_laufender_MotorT, "Messung moeglich" ); break;
        case  1: putValue( eWIV_laufender_MotorT, "Messung nicht moeglich" ); break;
        default: putValue( eWIV_laufender_MotorT, "!?!" );
    }
}

on envVar eMO_Text_MotorstartS
{
    switch (getValue( eMO_Text_MotorstartS ))
    {
        case  0: putValue( eMO_Text_MotorstartT, "keine Anzeige" ); break;
        case  1: putValue( eMO_Text_MotorstartT, "Motor im Stoppbetrieb" ); break;
        case  2: putValue( eMO_Text_MotorstartT, "StartStopp sicherheitsbedingt deaktiviert" ); break;
        case  3: putValue( eMO_Text_MotorstartT, "System fordert Wiederstart" ); break;
        case  5: putValue( eMO_Text_MotorstartT, "Motorlauf noetig" ); break;
        case  9: putValue( eMO_Text_MotorstartT, "Unerwuenschter Motorstillstand" ); break;
        case 12: putValue( eMO_Text_MotorstartT, "Motor startet" ); break;
        case 13: putValue( eMO_Text_MotorstartT, "Kupplung betaetigen" ); break;
        case 14: putValue( eMO_Text_MotorstartT, "Waehlhebel in PN Position" ); break;
        case 15: putValue( eMO_Text_MotorstartT, "Bremse treten" ); break;
        default: putValue( eMO_Text_MotorstartT, "!?!" );
    }
}

on envVar eMO_SystemlampeS
{
    switch (getValue( eMO_SystemlampeS ))
    {
        case  0: putValue( eMO_SystemlampeT, "Lampe aus" ); break;
        case  1: putValue( eMO_SystemlampeT, "Lampe ein" ); break;
        default: putValue( eMO_SystemlampeT, "!?!" );
    }
}

on envVar eMO_OBD2_LampeS
{
    switch (getValue( eMO_OBD2_LampeS ))
    {
        case  0: putValue( eMO_OBD2_LampeT, "Lampe aus" ); break;
        case  1: putValue( eMO_OBD2_LampeT, "Lampe ein" ); break;
        default: putValue( eMO_OBD2_LampeT, "!?!" );
    }
}

on envVar eMO_HeissleuchteS
{
    switch (getValue( eMO_HeissleuchteS ))
    {
        case  0: putValue( eMO_HeissleuchteT, "Lampe aus" ); break;
        case  1: putValue( eMO_HeissleuchteT, "Lampe ein" ); break;
        default: putValue( eMO_HeissleuchteT, "!?!" );
    }
}

on envVar eMO_Partikel_LampeS
{
    switch (getValue( eMO_Partikel_LampeS ))
    {
        case  0: putValue( eMO_Partikel_LampeT, "Lampe aus" ); break;
        case  1: putValue( eMO_Partikel_LampeT, "Lampe ein" ); break;
        default: putValue( eMO_Partikel_LampeT, "!?!" );
    }
}

on envVar eWIV_Oelstand_nicht_vorhandenS
{
    switch (getValue( eWIV_Oelstand_nicht_vorhandenS ))
    {
        case  0: putValue( eWIV_Oelstand_nicht_vorhandenT, "Ölstand vorhanden" ); break;
        case  1: putValue( eWIV_Oelstand_nicht_vorhandenT, "Ölstand nicht vorhanden" ); break;
        default: putValue( eWIV_Oelstand_nicht_vorhandenT, "!?!" );
    }
}

on envVar eWIV_nachfuellanzeige_einS
{
    switch (getValue( eWIV_nachfuellanzeige_einS ))
    {
        case  0: putValue( eWIV_nachfuellanzeige_einT, "keine Nachfuellanzeige" ); break;
        case  1: putValue( eWIV_nachfuellanzeige_einT, "Nachfuellanzeige" ); break;
        default: putValue( eWIV_nachfuellanzeige_einT, "!?!" );
    }
}

on envVar eWIV_Ueberfuell_deaktivS
{
    switch (getValue( eWIV_Ueberfuell_deaktivS ))
    {
        case  0: putValue( eWIV_Ueberfuell_deaktivT, "Ueberfuellwarnung am Kombi aktiv" ); break;
        case  1: putValue( eWIV_Ueberfuell_deaktivT, "Ueberfuellwarnung am Kombi deaktiv" ); break;
        default: putValue( eWIV_Ueberfuell_deaktivT, "!?!" );
    }
}

on envVar eWIV_Unterfuell_WarnS
{
    switch (getValue( eWIV_Unterfuell_WarnS ))
    {
        case  0: putValue( eWIV_Unterfuell_WarnT, "in Ordnung" ); break;
        case  1: putValue( eWIV_Unterfuell_WarnT, "Unterfuellwarnung" ); break;
        default: putValue( eWIV_Unterfuell_WarnT, "!?!" );
    }
}

on envVar eMO_Text_TankdeckelwarnS
{
    switch (getValue( eMO_Text_TankdeckelwarnS ))
    {
        case  0: putValue( eMO_Text_TankdeckelwarnT, "kein Text" ); break;
        case  1: putValue( eMO_Text_TankdeckelwarnT, "Anzeige Text Tankdeckelwarnung im Kombi" ); break;
        default: putValue( eMO_Text_TankdeckelwarnT, "!?!" );
    }
}

on envVar eWIV_Enable_Oeldr_MotorS
{
    switch (getValue( eWIV_Enable_Oeldr_MotorS ))
    {
        case  0: putValue( eWIV_Enable_Oeldr_MotorT, "Oeldruckauswertung im Kombi" ); break;
        case  1: putValue( eWIV_Enable_Oeldr_MotorT, "Oeldruckauswertung im MSG" ); break;
        default: putValue( eWIV_Enable_Oeldr_MotorT, "!?!" );
    }
}

on envVar eWIV_Oeldr_Warn_MotorS
{
    switch (getValue( eWIV_Oeldr_Warn_MotorS ))
    {
        case  0: putValue( eWIV_Oeldr_Warn_MotorT, "keine Warnung" ); break;
        case  1: putValue( eWIV_Oeldr_Warn_MotorT, "niedrige Oeldruckstufe nicht erreicht" ); break;
        default: putValue( eWIV_Oeldr_Warn_MotorT, "!?!" );
    }
}

on envVar eMO_Kuehlerluefter_1126
{
    if( getValue( this ))
    {
    _MO_Kuehlerluefter_1 = getValue( eMO_Kuehlerluefter_1S );
    putValue( eMO_Kuehlerluefter_1S, 126 );
    }
    else if( getValue( eMO_Kuehlerluefter_1S ) == 126)
    {
    if( _MO_Kuehlerluefter_1 != 126)
      putValue( eMO_Kuehlerluefter_1S, _MO_Kuehlerluefter_1 );
    else
      putValue( eMO_Kuehlerluefter_1S, 0 );
    }

}

on envVar eMO_Kuehlerluefter_1127
{
    if( getValue( this ))
    {
    _MO_Kuehlerluefter_1 = getValue( eMO_Kuehlerluefter_1S );
    putValue( eMO_Kuehlerluefter_1S, 127 );
    }
    else if( getValue( eMO_Kuehlerluefter_1S ) == 127)
    {
    if( _MO_Kuehlerluefter_1 != 127)
      putValue( eMO_Kuehlerluefter_1S, _MO_Kuehlerluefter_1 );
    else
      putValue( eMO_Kuehlerluefter_1S, 126 );
    }

}

on envVar eMO_Kuehlerluefter_1S
{
    putValue( eMO_Kuehlerluefter_1126, getValue( eMO_Kuehlerluefter_1S ) == 126 );
    putValue( eMO_Kuehlerluefter_1127, getValue( eMO_Kuehlerluefter_1S ) == 127 );
}

on envVar eMO_Kuehlerluefter_2126
{
    if( getValue( this ))
    {
    _MO_Kuehlerluefter_2 = getValue( eMO_Kuehlerluefter_2S );
    putValue( eMO_Kuehlerluefter_2S, 126 );
    }
    else if( getValue( eMO_Kuehlerluefter_2S ) == 126)
    {
    if( _MO_Kuehlerluefter_2 != 126)
      putValue( eMO_Kuehlerluefter_2S, _MO_Kuehlerluefter_2 );
    else
      putValue( eMO_Kuehlerluefter_2S, 0 );
    }

}

on envVar eMO_Kuehlerluefter_2127
{
    if( getValue( this ))
    {
    _MO_Kuehlerluefter_2 = getValue( eMO_Kuehlerluefter_2S );
    putValue( eMO_Kuehlerluefter_2S, 127 );
    }
    else if( getValue( eMO_Kuehlerluefter_2S ) == 127)
    {
    if( _MO_Kuehlerluefter_2 != 127)
      putValue( eMO_Kuehlerluefter_2S, _MO_Kuehlerluefter_2 );
    else
      putValue( eMO_Kuehlerluefter_2S, 126 );
    }

}

on envVar eMO_Kuehlerluefter_2S
{
    putValue( eMO_Kuehlerluefter_2126, getValue( eMO_Kuehlerluefter_2S ) == 126 );
    putValue( eMO_Kuehlerluefter_2127, getValue( eMO_Kuehlerluefter_2S ) == 127 );
}

on envVar eACC_Status_Prim_AnzS
{
    switch (getValue( eACC_Status_Prim_AnzS ))
    {
        case  0: putValue( eACC_Status_Prim_AnzT, "Symbol nicht beleuchtet" ); break;
        case  1: putValue( eACC_Status_Prim_AnzT, "Farbe 1 (typisch 'gruen')" ); break;
        case  2: putValue( eACC_Status_Prim_AnzT, "Farbe 2 (typisch 'rot')" ); break;
        case  3: putValue( eACC_Status_Prim_AnzT, "Farbe 3 (typisch 'gelb')" ); break;
        default: putValue( eACC_Status_Prim_AnzT, "!?!" );
    }
}

on envVar eACC_Akustik_02S
{
    switch (getValue( eACC_Akustik_02S ))
    {
        case  0: putValue( eACC_Akustik_02T, "keine Akustik" ); break;
        case  1: putValue( eACC_Akustik_02T, "hochpriore Akustik" ); break;
        case  2: putValue( eACC_Akustik_02T, "niederpriore Akustik" ); break;
        default: putValue( eACC_Akustik_02T, "!?!" );
    }
}

on envVar eACC_Typ_TachokranzS
{
    switch (getValue( eACC_Typ_TachokranzS ))
    {
        case  0: putValue( eACC_Typ_TachokranzT, "Tachokranz lang" ); break;
        case  1: putValue( eACC_Typ_TachokranzT, "Tachokranz kurz" ); break;
        default: putValue( eACC_Typ_TachokranzT, "!?!" );
    }
}

on envVar eACC_TachokranzS
{
    switch (getValue( eACC_TachokranzS ))
    {
        case  0: putValue( eACC_TachokranzT, "Tachokranz nicht beleuchtet" ); break;
        case  1: putValue( eACC_TachokranzT, "Tachokranz beleuchtet" ); break;
        default: putValue( eACC_TachokranzT, "!?!" );
    }
}

on envVar eACC_Relevantes_ObjektS
{
    switch (getValue( eACC_Relevantes_ObjektS ))
    {
        case  0: putValue( eACC_Relevantes_ObjektT, "Symbol nicht beleuchtet" ); break;
        case  1: putValue( eACC_Relevantes_ObjektT, "Farbe 1 typisch gruen" ); break;
        case  2: putValue( eACC_Relevantes_ObjektT, "Farbe 2 typisch rot" ); break;
        case  3: putValue( eACC_Relevantes_ObjektT, "Farbe 3 typisch gelb" ); break;
        default: putValue( eACC_Relevantes_ObjektT, "!?!" );
    }
}

on envVar eACC_Texte_PrimaeranzS
{
    switch (getValue( eACC_Texte_PrimaeranzS ))
    {
        case  0: putValue( eACC_Texte_PrimaeranzT, "keine Anzeige" ); break;
        case  1: putValue( eACC_Texte_PrimaeranzT, "ACC nicht verfuegbar !" ); break;
        case  2: putValue( eACC_Texte_PrimaeranzT, "Auto Auto     " ); break;
        case  3: putValue( eACC_Texte_PrimaeranzT, "Auto   Auto   " ); break;
        case  4: putValue( eACC_Texte_PrimaeranzT, "Auto     Auto " ); break;
        case  5: putValue( eACC_Texte_PrimaeranzT, "Auto       Auto" ); break;
        case  6: putValue( eACC_Texte_PrimaeranzT, "Auto Auto       Gong (durchgestrichen)" ); break;
        case  7: putValue( eACC_Texte_PrimaeranzT, "Auto   Auto     Gong (durchgestrichen)" ); break;
        case  8: putValue( eACC_Texte_PrimaeranzT, "Auto     Auto   Gong (durchgestrichen)" ); break;
        case  9: putValue( eACC_Texte_PrimaeranzT, "Auto       Auto Gong (durchgestrichen)" ); break;
        case 10: putValue( eACC_Texte_PrimaeranzT, "ACC bereit" ); break;
        case 11: putValue( eACC_Texte_PrimaeranzT, "keine Abstandsregelung" ); break;
        case 12: putValue( eACC_Texte_PrimaeranzT, "ACC Sensor Sicht !" ); break;
        case 13: putValue( eACC_Texte_PrimaeranzT, "ACC nicht verfuegbar" ); break;
        case 14: putValue( eACC_Texte_PrimaeranzT, "o  o  o" ); break;
        case 15: putValue( eACC_Texte_PrimaeranzT, "Hochschalten" ); break;
        case 16: putValue( eACC_Texte_PrimaeranzT, "ESP Eingriff" ); break;
        case 17: putValue( eACC_Texte_PrimaeranzT, "Herunterschalten" ); break;
        case 18: putValue( eACC_Texte_PrimaeranzT, "Parkbremse !" ); break;
        case 19: putValue( eACC_Texte_PrimaeranzT, "Geschwindigkeitsgrenze" ); break;
        case 20: putValue( eACC_Texte_PrimaeranzT, "Waehlhebelposition !" ); break;
        case 21: putValue( eACC_Texte_PrimaeranzT, "VDA ACC-Symbol YYY km/h / mph" ); break;
        case 22: putValue( eACC_Texte_PrimaeranzT, "Tempolimit XXX km/h / mph" ); break;
        case 23: putValue( eACC_Texte_PrimaeranzT, "Kurve XXX km/h / mph" ); break;
        case 24: putValue( eACC_Texte_PrimaeranzT, "ACC Abschaltung" ); break;
        case 25: putValue( eACC_Texte_PrimaeranzT, "Symbol 'Eieruhr'" ); break;
        case 26: putValue( eACC_Texte_PrimaeranzT, "!" ); break;
        case 27: putValue( eACC_Texte_PrimaeranzT, "--- km/h / mph" ); break;
        case 28: putValue( eACC_Texte_PrimaeranzT, "XXX km/h / mph (Schriftart 2)" ); break;
        case 29: putValue( eACC_Texte_PrimaeranzT, "Lenkradwinkel" ); break;
        case 30: putValue( eACC_Texte_PrimaeranzT, "Anfahren bestaetigen" ); break;
        case 31: putValue( eACC_Texte_PrimaeranzT, "Fahrzeug verloren" ); break;
        case 32: putValue( eACC_Texte_PrimaeranzT, "Im Stand nicht moeglich" ); break;
        case 33: putValue( eACC_Texte_PrimaeranzT, "Ungueltiger Anfahrbefehl" ); break;
        case 34: putValue( eACC_Texte_PrimaeranzT, "Tuer offen !" ); break;
        case 35: putValue( eACC_Texte_PrimaeranzT, "Fahrer Gurtschloss offen !" ); break;
        case 36: putValue( eACC_Texte_PrimaeranzT, "Schalthebelposition !" ); break;
        case 37: putValue( eACC_Texte_PrimaeranzT, "Drehzahl !" ); break;
        case 38: putValue( eACC_Texte_PrimaeranzT, "Kurvenassistent aus" ); break;
        case 39: putValue( eACC_Texte_PrimaeranzT, "Tempolimit aus" ); break;
        case 40: putValue( eACC_Texte_PrimaeranzT, "Abbiegeassistent" ); break;
        case 41: putValue( eACC_Texte_PrimaeranzT, "Ortsanfang XXX km/h / mph" ); break;
        case 42: putValue( eACC_Texte_PrimaeranzT, "Ortsende XXX km/h / mph" ); break;
        case 43: putValue( eACC_Texte_PrimaeranzT, "Tempolimit Ende XXX km/h / mph" ); break;
        case 44: putValue( eACC_Texte_PrimaeranzT, "HDC aktiv" ); break;
        case 45: putValue( eACC_Texte_PrimaeranzT, "braking guard Bremsruck" ); break;
        case 46: putValue( eACC_Texte_PrimaeranzT, "braking guard aus" ); break;
        case 47: putValue( eACC_Texte_PrimaeranzT, "braking guard aus" ); break;
        case 48: putValue( eACC_Texte_PrimaeranzT, "Uebernehmen !" ); break;
        case 49: putValue( eACC_Texte_PrimaeranzT, "Steigung zu gross" ); break;
        case 50: putValue( eACC_Texte_PrimaeranzT, "Stehendes Objekt voraus" ); break;
        case 51: putValue( eACC_Texte_PrimaeranzT, "SET / 'GRA Symbol'   xxx km/h / mph" ); break;
        case 52: putValue( eACC_Texte_PrimaeranzT, "SET / 'GRA Symbol' xxx km/h / mph" ); break;
        case 53: putValue( eACC_Texte_PrimaeranzT, "ACC aus" ); break;
        case 54: putValue( eACC_Texte_PrimaeranzT, "ACC startet" ); break;
        case 55: putValue( eACC_Texte_PrimaeranzT, "ACC reinigen" ); break;
        case 56: putValue( eACC_Texte_PrimaeranzT, "ACC Fehler" ); break;
        case 57: putValue( eACC_Texte_PrimaeranzT, "ACC haelt an !" ); break;
        case 58: putValue( eACC_Texte_PrimaeranzT, "Bremse betaetigen !" ); break;
        case 59: putValue( eACC_Texte_PrimaeranzT, "Kupplung betaetigt" ); break;
        case 60: putValue( eACC_Texte_PrimaeranzT, "LIM AUS" ); break;
        case 61: putValue( eACC_Texte_PrimaeranzT, "LIM AKTIV" ); break;
        case 62: putValue( eACC_Texte_PrimaeranzT, "LIM PASSIV" ); break;
        case 63: putValue( eACC_Texte_PrimaeranzT, "LIM FEHLER" ); break;
        case 64: putValue( eACC_Texte_PrimaeranzT, "Bremse ueberhitzt !" ); break;
        case 65: putValue( eACC_Texte_PrimaeranzT, "Bremse haelt !" ); break;
        case 66: putValue( eACC_Texte_PrimaeranzT, "ESP PASSIV !" ); break;
        case 67: putValue( eACC_Texte_PrimaeranzT, "ACC anfahrbereit" ); break;
        default: putValue( eACC_Texte_PrimaeranzT, "!?!" );
    }
}

on envVar eACC_Wunschgeschw_erreichtS
{
    switch (getValue( eACC_Wunschgeschw_erreichtS ))
    {
        case  0: putValue( eACC_Wunschgeschw_erreichtT, "Wunschgeschwindigkeit nicht erreicht" ); break;
        case  1: putValue( eACC_Wunschgeschw_erreichtT, "Wunschgeschwindigkeit erreicht" ); break;
        default: putValue( eACC_Wunschgeschw_erreichtT, "!?!" );
    }
}

on envVar eACC_Status_AnzeigeS
{
    switch (getValue( eACC_Status_AnzeigeS ))
    {
        case  0: putValue( eACC_Status_AnzeigeT, "ACC GRA Hauptschalter aus" ); break;
        case  1: putValue( eACC_Status_AnzeigeT, "ACC in Init nicht bei GRA" ); break;
        case  2: putValue( eACC_Status_AnzeigeT, "ACC GRA passiv" ); break;
        case  3: putValue( eACC_Status_AnzeigeT, "ACC GRA aktiv" ); break;
        case  4: putValue( eACC_Status_AnzeigeT, "ACC GRA im Hintergrund uebertreten" ); break;
        case  5: putValue( eACC_Status_AnzeigeT, "frei" ); break;
        case  6: putValue( eACC_Status_AnzeigeT, "ACC reversibel aus nicht bei GRA" ); break;
        case  7: putValue( eACC_Status_AnzeigeT, "ACC GRA irreversibel aus" ); break;
        default: putValue( eACC_Status_AnzeigeT, "!?!" );
    }
}

on envVar eACC_Texte_ZusatzanzS
{
    switch (getValue( eACC_Texte_ZusatzanzS ))
    {
        case  0: putValue( eACC_Texte_ZusatzanzT, "no display" ); break;
        case  1: putValue( eACC_Texte_ZusatzanzT, "ACC Off" ); break;
        case  2: putValue( eACC_Texte_ZusatzanzT, "ACC Ready" ); break;
        case  3: putValue( eACC_Texte_ZusatzanzT, "overridden" ); break;
        case  4: putValue( eACC_Texte_ZusatzanzT, "Distance!" ); break;
        case  5: putValue( eACC_Texte_ZusatzanzT, "Distance 1" ); break;
        case  6: putValue( eACC_Texte_ZusatzanzT, "Distance 2" ); break;
        case  7: putValue( eACC_Texte_ZusatzanzT, "Distance 3" ); break;
        case  8: putValue( eACC_Texte_ZusatzanzT, "Distance 4" ); break;
        case  9: putValue( eACC_Texte_ZusatzanzT, "Distance 1 - dyn." ); break;
        case 10: putValue( eACC_Texte_ZusatzanzT, "Distance 2 - dyn." ); break;
        case 11: putValue( eACC_Texte_ZusatzanzT, "Distance 3 - dyn." ); break;
        case 12: putValue( eACC_Texte_ZusatzanzT, "Distance 4 - dyn." ); break;
        case 13: putValue( eACC_Texte_ZusatzanzT, "Distance 1 - stand." ); break;
        case 14: putValue( eACC_Texte_ZusatzanzT, "Distance 2 - stand." ); break;
        case 15: putValue( eACC_Texte_ZusatzanzT, "Distance 3 - stand." ); break;
        case 16: putValue( eACC_Texte_ZusatzanzT, "Distance 4 - stand." ); break;
        case 17: putValue( eACC_Texte_ZusatzanzT, "Distance 1 - comf." ); break;
        case 18: putValue( eACC_Texte_ZusatzanzT, "Distance 2 - comf." ); break;
        case 19: putValue( eACC_Texte_ZusatzanzT, "Distance 3 - comf." ); break;
        case 20: putValue( eACC_Texte_ZusatzanzT, "Distance 4 - comf." ); break;
        default: putValue( eACC_Texte_ZusatzanzT, "!?!" );
    }
}

on envVar eACC_Status_ZusatzanzS
{
    switch (getValue( eACC_Status_ZusatzanzS ))
    {
        case  0: putValue( eACC_Status_ZusatzanzT, "keine Anzeige" ); break;
        case  1: putValue( eACC_Status_ZusatzanzT, "Bild 1 (Fzg. Silhouette, typ. farblos)" ); break;
        case  2: putValue( eACC_Status_ZusatzanzT, "Bild 2 (Fzg. Farbe 1, typ. grau)" ); break;
        case  3: putValue( eACC_Status_ZusatzanzT, "Bild 3 (Fzg. Farbe 2, typ. rot)" ); break;
        case  4: putValue( eACC_Status_ZusatzanzT, "Bild 4 (Symbol 1 ACCplus, typ. Doppelfzg. gelb)" ); break;
        case  5: putValue( eACC_Status_ZusatzanzT, "Bild 5 (Symbol 2 ACCplus, typ. Doppelfzg. grau)" ); break;
        case  6: putValue( eACC_Status_ZusatzanzT, "Bild 6 (Fzg. Farbe 2, typ. rot) mit Priorität im Kombi (Pop-up)" ); break;
        default: putValue( eACC_Status_ZusatzanzT, "!?!" );
    }
}

on envVar eACC_TexteS
{
    switch (getValue( eACC_TexteS ))
    {
        case  0: putValue( eACC_TexteT, "keine Anzeige" ); break;
        case  1: putValue( eACC_TexteT, "ACC nicht verfuegbar" ); break;
        case  2: putValue( eACC_TexteT, "ACC und AWV nicht verfuegbar" ); break;
        case  3: putValue( eACC_TexteT, "ACC keine Sensorsicht" ); break;
        case  4: putValue( eACC_TexteT, "ACC und AWV keine Sensorsicht" ); break;
        case  5: putValue( eACC_TexteT, "ACC Steigung zu gross" ); break;
        case  6: putValue( eACC_TexteT, "ACC nur in Fahrstufe verfuegbar" ); break;
        case  7: putValue( eACC_TexteT, "ACC Parkbremse betaetigt" ); break;
        case  8: putValue( eACC_TexteT, "ACC ESP Eingriff" ); break;
        case  9: putValue( eACC_TexteT, "ACC Bitte uebernehmen" ); break;
        case 10: putValue( eACC_TexteT, "ACC HDC betaetigt" ); break;
        default: putValue( eACC_TexteT, "!?!" );
    }
}

on envVar eACC_Texte_braking_guardS
{
    switch (getValue( eACC_Texte_braking_guardS ))
    {
        case  0: putValue( eACC_Texte_braking_guardT, "keine Anzeige" ); break;
        case  1: putValue( eACC_Texte_braking_guardT, "AWV aus" ); break;
        case  2: putValue( eACC_Texte_braking_guardT, "AWV Fahreruebernahmeaufforderung" ); break;
        case  3: putValue( eACC_Texte_braking_guardT, "AWV ein" ); break;
        case  4: putValue( eACC_Texte_braking_guardT, "AWV nicht verfuegbar" ); break;
        case  5: putValue( eACC_Texte_braking_guardT, "AWV Fehler" ); break;
        case  6: putValue( eACC_Texte_braking_guardT, "AWV Vorwarnung aus" ); break;
        default: putValue( eACC_Texte_braking_guardT, "!?!" );
    }
}

on envVar eACC_Charisma_FahrPrS
{
    switch (getValue( eACC_Charisma_FahrPrS ))
    {
        case  0: putValue( eACC_Charisma_FahrPrT, "nicht belegt" ); break;
        case  1: putValue( eACC_Charisma_FahrPrT, "Programm 1" ); break;
        case  2: putValue( eACC_Charisma_FahrPrT, "Programm 2" ); break;
        case  3: putValue( eACC_Charisma_FahrPrT, "Programm 3" ); break;
        case  4: putValue( eACC_Charisma_FahrPrT, "Programm 4" ); break;
        case  5: putValue( eACC_Charisma_FahrPrT, "Programm 5" ); break;
        case  6: putValue( eACC_Charisma_FahrPrT, "Programm 6" ); break;
        case  7: putValue( eACC_Charisma_FahrPrT, "Programm 7" ); break;
        case  8: putValue( eACC_Charisma_FahrPrT, "Programm 8" ); break;
        case  9: putValue( eACC_Charisma_FahrPrT, "Programm 9" ); break;
        case 10: putValue( eACC_Charisma_FahrPrT, "Programm 10" ); break;
        case 11: putValue( eACC_Charisma_FahrPrT, "Programm 11" ); break;
        case 12: putValue( eACC_Charisma_FahrPrT, "Programm 12" ); break;
        case 13: putValue( eACC_Charisma_FahrPrT, "Programm 13" ); break;
        case 14: putValue( eACC_Charisma_FahrPrT, "Programm 14" ); break;
        case 15: putValue( eACC_Charisma_FahrPrT, "Programm 15" ); break;
        default: putValue( eACC_Charisma_FahrPrT, "!?!" );
    }
}

on envVar eACC_Charisma_StatusS
{
    switch (getValue( eACC_Charisma_StatusS ))
    {
        case  0: putValue( eACC_Charisma_StatusT, "Init" ); break;
        case  1: putValue( eACC_Charisma_StatusT, "verfuegbar" ); break;
        case  2: putValue( eACC_Charisma_StatusT, "nicht verfuegbar" ); break;
        default: putValue( eACC_Charisma_StatusT, "!?!" );
    }
}

on envVar eAB_RGS_AnstS
{
    switch (getValue( eAB_RGS_AnstS ))
    {
        case  4: putValue( eAB_RGS_AnstT, "aktiv Niveau 1" ); break;
        case  5: putValue( eAB_RGS_AnstT, "aktiv Niveau 2" ); break;
        case  6: putValue( eAB_RGS_AnstT, "aktiv Niveau 3" ); break;
        case  7: putValue( eAB_RGS_AnstT, "aktiv Niveau 4" ); break;
        case  8: putValue( eAB_RGS_AnstT, "deaktiviert" ); break;
        default: putValue( eAB_RGS_AnstT, "!?!" );
    }
}

on envVar eAB_Front_CrashS
{
    switch (getValue( eAB_Front_CrashS ))
    {
        case  0: putValue( eAB_Front_CrashT, "kein Front Crash" ); break;
        case  1: putValue( eAB_Front_CrashT, "Front Crash" ); break;
        default: putValue( eAB_Front_CrashT, "!?!" );
    }
}

on envVar eAB_Heck_CrashS
{
    switch (getValue( eAB_Heck_CrashS ))
    {
        case  0: putValue( eAB_Heck_CrashT, "kein Heck Crash" ); break;
        case  1: putValue( eAB_Heck_CrashT, "Heck Crash" ); break;
        default: putValue( eAB_Heck_CrashT, "!?!" );
    }
}

on envVar eAB_SF_CrashS
{
    switch (getValue( eAB_SF_CrashS ))
    {
        case  0: putValue( eAB_SF_CrashT, "kein Seiten Crash Fahrer" ); break;
        case  1: putValue( eAB_SF_CrashT, "Seiten Crash Fahrer" ); break;
        default: putValue( eAB_SF_CrashT, "!?!" );
    }
}

on envVar eAB_SB_CrashS
{
    switch (getValue( eAB_SB_CrashS ))
    {
        case  0: putValue( eAB_SB_CrashT, "kein Seiten Crash Beifahrer" ); break;
        case  1: putValue( eAB_SB_CrashT, "Seiten Crash Beifahrer" ); break;
        default: putValue( eAB_SB_CrashT, "!?!" );
    }
}

on envVar eAB_Rollover_CrashS
{
    switch (getValue( eAB_Rollover_CrashS ))
    {
        case  0: putValue( eAB_Rollover_CrashT, "kein Rollover" ); break;
        case  1: putValue( eAB_Rollover_CrashT, "Rollover" ); break;
        default: putValue( eAB_Rollover_CrashT, "!?!" );
    }
}

on envVar eAB_Crash_IntS
{
    switch (getValue( eAB_Crash_IntS ))
    {
        case  0: putValue( eAB_Crash_IntT, "kein Crash" ); break;
        case  1: putValue( eAB_Crash_IntT, "Crash Intensitaet 1" ); break;
        case  2: putValue( eAB_Crash_IntT, "Crash Intensitaet 2 (nur Stellgliedtest B8)" ); break;
        case  3: putValue( eAB_Crash_IntT, "Crash Intensitaet 2 (nur D4 C7 Colorado NF PAG  Crash im B8)" ); break;
        case  4: putValue( eAB_Crash_IntT, "Crash Intensitaet 3 (alt VW/AUDI  Stellgiedtest B8)" ); break;
        case  5: putValue( eAB_Crash_IntT, "Crash Intensitaet 3 (alt PAG)" ); break;
        case  7: putValue( eAB_Crash_IntT, "Crash Intensitaet 3" ); break;
        default: putValue( eAB_Crash_IntT, "!?!" );
    }
}

on envVar eAB_LampeS
{
    switch (getValue( eAB_LampeS ))
    {
        case  0: putValue( eAB_LampeT, "Aus" ); break;
        case  1: putValue( eAB_LampeT, "Ein" ); break;
        default: putValue( eAB_LampeT, "!?!" );
    }
}

on envVar eAB_DeaktiviertS
{
    switch (getValue( eAB_DeaktiviertS ))
    {
        case  0: putValue( eAB_DeaktiviertT, "aktiv" ); break;
        case  1: putValue( eAB_DeaktiviertT, "deaktiviert" ); break;
        default: putValue( eAB_DeaktiviertT, "!?!" );
    }
}

on envVar eAB_VB_deaktiviertS
{
    switch (getValue( eAB_VB_deaktiviertS ))
    {
        case  0: putValue( eAB_VB_deaktiviertT, "Beifahrerairbag aktiv" ); break;
        case  1: putValue( eAB_VB_deaktiviertT, "Beifahrerairbag deaktiviert" ); break;
        default: putValue( eAB_VB_deaktiviertT, "!?!" );
    }
}

on envVar eAB_SystemfehlerS
{
    switch (getValue( eAB_SystemfehlerS ))
    {
        case  0: putValue( eAB_SystemfehlerT, "kein Fehler" ); break;
        case  1: putValue( eAB_SystemfehlerT, "Airbag Systemfehler" ); break;
        default: putValue( eAB_SystemfehlerT, "!?!" );
    }
}

on envVar eAB_DiagnoseS
{
    switch (getValue( eAB_DiagnoseS ))
    {
        case  0: putValue( eAB_DiagnoseT, "nicht in Diagnose" ); break;
        case  1: putValue( eAB_DiagnoseT, "in Diagnose" ); break;
        default: putValue( eAB_DiagnoseT, "!?!" );
    }
}

on envVar eAB_StellgliedtestS
{
    switch (getValue( eAB_StellgliedtestS ))
    {
        case  0: putValue( eAB_StellgliedtestT, "nicht im Stellgliedtest" ); break;
        case  1: putValue( eAB_StellgliedtestT, "Airbag im Stellgliedtest" ); break;
        default: putValue( eAB_StellgliedtestT, "!?!" );
    }
}

on envVar eAB_Erh_Auf_VBS
{
    switch (getValue( eAB_Erh_Auf_VBS ))
    {
        case  0: putValue( eAB_Erh_Auf_VBT, "keine Anzeige" ); break;
        case  1: putValue( eAB_Erh_Auf_VBT, "Beifahrerairbag deaktiviert" ); break;
        case  2: putValue( eAB_Erh_Auf_VBT, "Beifahrerairbag aktiviert" ); break;
        case  3: putValue( eAB_Erh_Auf_VBT, "nicht definiert" ); break;
        default: putValue( eAB_Erh_Auf_VBT, "!?!" );
    }
}

on envVar eAB_Gurtwarn_VFS
{
    switch (getValue( eAB_Gurtwarn_VFS ))
    {
        case  0: putValue( eAB_Gurtwarn_VFT, "keine Warnung" ); break;
        case  1: putValue( eAB_Gurtwarn_VFT, "Gurtwarnung ausloesen" ); break;
        default: putValue( eAB_Gurtwarn_VFT, "!?!" );
    }
}

on envVar eAB_Gurtwarn_VBS
{
    switch (getValue( eAB_Gurtwarn_VBS ))
    {
        case  0: putValue( eAB_Gurtwarn_VBT, "keine Warnung" ); break;
        case  1: putValue( eAB_Gurtwarn_VBT, "Gurtwarnung ausloesen" ); break;
        default: putValue( eAB_Gurtwarn_VBT, "!?!" );
    }
}

on envVar eAB_Anzeige_FussgS
{
    switch (getValue( eAB_Anzeige_FussgS ))
    {
        case  0: putValue( eAB_Anzeige_FussgT, "keine FSG Aktion ausgeloest" ); break;
        case  1: putValue( eAB_Anzeige_FussgT, "Motorhaube offen" ); break;
        case  2: putValue( eAB_Anzeige_FussgT, "Systemfehler" ); break;
        default: putValue( eAB_Anzeige_FussgT, "!?!" );
    }
}

on envVar eAB_Texte_AKSS
{
    switch (getValue( eAB_Texte_AKSS ))
    {
        case  0: putValue( eAB_Texte_AKST, "keine AKS Ausloesung" ); break;
        case  1: putValue( eAB_Texte_AKST, "AKS ausgeloest" ); break;
        case  2: putValue( eAB_Texte_AKST, "AKS Systemfehler" ); break;
        default: putValue( eAB_Texte_AKST, "!?!" );
    }
}

on envVar eAB_PAO_Leuchte_AnfS
{
    switch (getValue( eAB_PAO_Leuchte_AnfS ))
    {
        case  0: putValue( eAB_PAO_Leuchte_AnfT, "Leuchte ausschalten" ); break;
        case  1: putValue( eAB_PAO_Leuchte_AnfT, "Leuchte einschalten" ); break;
        default: putValue( eAB_PAO_Leuchte_AnfT, "!?!" );
    }
}

on envVar eAB_MKB_gueltigS
{
    switch (getValue( eAB_MKB_gueltigS ))
    {
        case  0: putValue( eAB_MKB_gueltigT, "Multikollisionsbremsung nicht freigeschaltet" ); break;
        case  1: putValue( eAB_MKB_gueltigT, "Multikollisionsbremsung freigeschaltet" ); break;
        default: putValue( eAB_MKB_gueltigT, "!?!" );
    }
}

on envVar eAB_MKB_AnforderungS
{
    switch (getValue( eAB_MKB_AnforderungS ))
    {
        case  0: putValue( eAB_MKB_AnforderungT, "Multikollisionsbremsung nicht angefordert" ); break;
        case  1: putValue( eAB_MKB_AnforderungT, "Multikollisionsbremsung angefordert" ); break;
        default: putValue( eAB_MKB_AnforderungT, "!?!" );
    }
}

on envVar eAB_VersorgungsspannungS
{
    switch (getValue( eAB_VersorgungsspannungS ))
    {
        case  0: putValue( eAB_VersorgungsspannungT, "plausibel" ); break;
        case  1: putValue( eAB_VersorgungsspannungT, "unplausibel" ); break;
        default: putValue( eAB_VersorgungsspannungT, "!?!" );
    }
}

on envVar eAB_Belegung_VBS
{
    switch (getValue( eAB_Belegung_VBS ))
    {
        case  0: putValue( eAB_Belegung_VBT, "nicht verfuegbar" ); break;
        case  1: putValue( eAB_Belegung_VBT, "Fehler" ); break;
        case  2: putValue( eAB_Belegung_VBT, "nicht belegt" ); break;
        case  3: putValue( eAB_Belegung_VBT, "belegt" ); break;
        default: putValue( eAB_Belegung_VBT, "!?!" );
    }
}

on envVar eAB_Gurtschloss_FAS
{
    switch (getValue( eAB_Gurtschloss_FAS ))
    {
        case  0: putValue( eAB_Gurtschloss_FAT, "nicht verbaut" ); break;
        case  1: putValue( eAB_Gurtschloss_FAT, "nicht verfügbar (Fehler oder Init)" ); break;
        case  2: putValue( eAB_Gurtschloss_FAT, "nicht gesteckt" ); break;
        case  3: putValue( eAB_Gurtschloss_FAT, "gesteckt" ); break;
        default: putValue( eAB_Gurtschloss_FAT, "!?!" );
    }
}

on envVar eAB_Gurtschloss_BFS
{
    switch (getValue( eAB_Gurtschloss_BFS ))
    {
        case  0: putValue( eAB_Gurtschloss_BFT, "nicht verbaut" ); break;
        case  1: putValue( eAB_Gurtschloss_BFT, "nicht verfügbar (Fehler oder Init)" ); break;
        case  2: putValue( eAB_Gurtschloss_BFT, "nicht gesteckt" ); break;
        case  3: putValue( eAB_Gurtschloss_BFT, "gesteckt" ); break;
        default: putValue( eAB_Gurtschloss_BFT, "!?!" );
    }
}

on envVar eAB_Gurtschloss_Reihe2_FAS
{
    switch (getValue( eAB_Gurtschloss_Reihe2_FAS ))
    {
        case  0: putValue( eAB_Gurtschloss_Reihe2_FAT, "nicht verbaut" ); break;
        case  1: putValue( eAB_Gurtschloss_Reihe2_FAT, "nicht verfügbar (Fehler oder Init)" ); break;
        case  2: putValue( eAB_Gurtschloss_Reihe2_FAT, "nicht gesteckt" ); break;
        case  3: putValue( eAB_Gurtschloss_Reihe2_FAT, "gesteckt" ); break;
        default: putValue( eAB_Gurtschloss_Reihe2_FAT, "!?!" );
    }
}

on envVar eAB_Gurtschloss_Reihe2_MIS
{
    switch (getValue( eAB_Gurtschloss_Reihe2_MIS ))
    {
        case  0: putValue( eAB_Gurtschloss_Reihe2_MIT, "nicht verbaut" ); break;
        case  1: putValue( eAB_Gurtschloss_Reihe2_MIT, "nicht verfügbar (Fehler oder Init)" ); break;
        case  2: putValue( eAB_Gurtschloss_Reihe2_MIT, "nicht gesteckt" ); break;
        case  3: putValue( eAB_Gurtschloss_Reihe2_MIT, "gesteckt" ); break;
        default: putValue( eAB_Gurtschloss_Reihe2_MIT, "!?!" );
    }
}

on envVar eAB_Gurtschloss_Reihe2_BFS
{
    switch (getValue( eAB_Gurtschloss_Reihe2_BFS ))
    {
        case  0: putValue( eAB_Gurtschloss_Reihe2_BFT, "nicht verbaut" ); break;
        case  1: putValue( eAB_Gurtschloss_Reihe2_BFT, "nicht verfügbar (Fehler oder Init)" ); break;
        case  2: putValue( eAB_Gurtschloss_Reihe2_BFT, "nicht gesteckt" ); break;
        case  3: putValue( eAB_Gurtschloss_Reihe2_BFT, "gesteckt" ); break;
        default: putValue( eAB_Gurtschloss_Reihe2_BFT, "!?!" );
    }
}

on envVar eAB_Gurtschloss_Reihe3_FAS
{
    switch (getValue( eAB_Gurtschloss_Reihe3_FAS ))
    {
        case  0: putValue( eAB_Gurtschloss_Reihe3_FAT, "nicht verbaut" ); break;
        case  1: putValue( eAB_Gurtschloss_Reihe3_FAT, "nicht verfügbar (Fehler oder Init)" ); break;
        case  2: putValue( eAB_Gurtschloss_Reihe3_FAT, "nicht gesteckt" ); break;
        case  3: putValue( eAB_Gurtschloss_Reihe3_FAT, "gesteckt" ); break;
        default: putValue( eAB_Gurtschloss_Reihe3_FAT, "!?!" );
    }
}

on envVar eAB_Gurtschloss_Reihe3_MIS
{
    switch (getValue( eAB_Gurtschloss_Reihe3_MIS ))
    {
        case  0: putValue( eAB_Gurtschloss_Reihe3_MIT, "nicht verbaut" ); break;
        case  1: putValue( eAB_Gurtschloss_Reihe3_MIT, "nicht verfügbar (Fehler oder Init)" ); break;
        case  2: putValue( eAB_Gurtschloss_Reihe3_MIT, "nicht gesteckt" ); break;
        case  3: putValue( eAB_Gurtschloss_Reihe3_MIT, "gesteckt" ); break;
        default: putValue( eAB_Gurtschloss_Reihe3_MIT, "!?!" );
    }
}

on envVar eAB_Gurtschloss_Reihe3_BFS
{
    switch (getValue( eAB_Gurtschloss_Reihe3_BFS ))
    {
        case  0: putValue( eAB_Gurtschloss_Reihe3_BFT, "nicht verbaut" ); break;
        case  1: putValue( eAB_Gurtschloss_Reihe3_BFT, "nicht verfügbar (Fehler oder Init)" ); break;
        case  2: putValue( eAB_Gurtschloss_Reihe3_BFT, "nicht gesteckt" ); break;
        case  3: putValue( eAB_Gurtschloss_Reihe3_BFT, "gesteckt" ); break;
        default: putValue( eAB_Gurtschloss_Reihe3_BFT, "!?!" );
    }
}

on envVar eAB_Sitzpos_Sens_FAS
{
    switch (getValue( eAB_Sitzpos_Sens_FAS ))
    {
        case  0: putValue( eAB_Sitzpos_Sens_FAT, "nicht verfügbar" ); break;
        case  1: putValue( eAB_Sitzpos_Sens_FAT, "Fehler" ); break;
        case  2: putValue( eAB_Sitzpos_Sens_FAT, "Sitz nicht vorne" ); break;
        case  3: putValue( eAB_Sitzpos_Sens_FAT, "Sitz vorne" ); break;
        default: putValue( eAB_Sitzpos_Sens_FAT, "!?!" );
    }
}

on envVar eAB_Sitzpos_Sens_BFS
{
    switch (getValue( eAB_Sitzpos_Sens_BFS ))
    {
        case  0: putValue( eAB_Sitzpos_Sens_BFT, "nicht verfügbar" ); break;
        case  1: putValue( eAB_Sitzpos_Sens_BFT, "Fehler" ); break;
        case  2: putValue( eAB_Sitzpos_Sens_BFT, "Sitz nicht vorne" ); break;
        case  3: putValue( eAB_Sitzpos_Sens_BFT, "Sitz vorne" ); break;
        default: putValue( eAB_Sitzpos_Sens_BFT, "!?!" );
    }
}

on envVar eBEM_02_AbschaltstufenS
{
    switch (getValue( eBEM_02_AbschaltstufenS ))
    {
        case  0: putValue( eBEM_02_AbschaltstufenT, "Stufe 0 (keine Einschraenkungen)" ); break;
        case  1: putValue( eBEM_02_AbschaltstufenT, "Stufe 1" ); break;
        case  2: putValue( eBEM_02_AbschaltstufenT, "Stufe 2" ); break;
        case  3: putValue( eBEM_02_AbschaltstufenT, "Stufe 3" ); break;
        case  4: putValue( eBEM_02_AbschaltstufenT, "Transportmodus" ); break;
        case  7: putValue( eBEM_02_AbschaltstufenT, "Ruhestrommessmodus" ); break;
        default: putValue( eBEM_02_AbschaltstufenT, "!?!" );
    }
}

on envVar eBEM_MMI_VorwarnungS
{
    switch (getValue( eBEM_MMI_VorwarnungS ))
    {
        case  0: putValue( eBEM_MMI_VorwarnungT, "keine Anzeige" ); break;
        case  1: putValue( eBEM_MMI_VorwarnungT, "Anzeige MMI-Vorwarnung" ); break;
        default: putValue( eBEM_MMI_VorwarnungT, "!?!" );
    }
}

on envVar eBEM_GeneratordiagnoseS
{
    switch (getValue( eBEM_GeneratordiagnoseS ))
    {
        case  0: putValue( eBEM_GeneratordiagnoseT, "keine Anzeige" ); break;
        case  1: putValue( eBEM_GeneratordiagnoseT, "Ladekontrollanzeige ein (Vorhalt)" ); break;
        case  2: putValue( eBEM_GeneratordiagnoseT, "rotes Batteriesymbol und Text (Generator defekt)" ); break;
        case  3: putValue( eBEM_GeneratordiagnoseT, "Hybrid DCDC Wandler defekt" ); break;
        default: putValue( eBEM_GeneratordiagnoseT, "!?!" );
    }
}

on envVar eBEM_Red_InnengeblaeseS
{
    switch (getValue( eBEM_Red_InnengeblaeseS ))
    {
        case  0: putValue( eBEM_Red_InnengeblaeseT, "keine Reduzierung" ); break;
        case  1: putValue( eBEM_Red_InnengeblaeseT, "Reduzierung Stufe 1" ); break;
        case  2: putValue( eBEM_Red_InnengeblaeseT, "Reduzierung Stufe 2" ); break;
        case  3: putValue( eBEM_Red_InnengeblaeseT, "Reduzierung Stufe 2 und Abschaltung Kompressor" ); break;
        default: putValue( eBEM_Red_InnengeblaeseT, "!?!" );
    }
}

on envVar eBEM_STH_EinschaltverbotS
{
    switch (getValue( eBEM_STH_EinschaltverbotS ))
    {
        case  0: putValue( eBEM_STH_EinschaltverbotT, "volle Verfuegbarkeit Standheizung/-lueftung" ); break;
        case  1: putValue( eBEM_STH_EinschaltverbotT, "Standheizung/-lueftung nicht aktivierbar" ); break;
        default: putValue( eBEM_STH_EinschaltverbotT, "!?!" );
    }
}

on envVar eBEM_HL_Regelung_StatusS
{
    switch (getValue( eBEM_HL_Regelung_StatusS ))
    {
        case  0: putValue( eBEM_HL_Regelung_StatusT, "HL Regelung inaktiv (vor und waehrend Motorstart)" ); break;
        case  1: putValue( eBEM_HL_Regelung_StatusT, "HL Regelung Stufe 1" ); break;
        case  2: putValue( eBEM_HL_Regelung_StatusT, "HL Regelung Stufe 2" ); break;
        case  3: putValue( eBEM_HL_Regelung_StatusT, "HL Regelung Stufe 3" ); break;
        case  4: putValue( eBEM_HL_Regelung_StatusT, "Verbrauchernotabschaltung (VNA)" ); break;
        case  7: putValue( eBEM_HL_Regelung_StatusT, "Default" ); break;
        default: putValue( eBEM_HL_Regelung_StatusT, "!?!" );
    }
}

on envVar eBEM_BatteriediagnoseS
{
    switch (getValue( eBEM_BatteriediagnoseS ))
    {
        case  0: putValue( eBEM_BatteriediagnoseT, "keine Anzeige" ); break;
        case  1: putValue( eBEM_BatteriediagnoseT, "Anzeige keine Freigabe fuer Start-Stopp (gealterte Batterie)" ); break;
        case  2: putValue( eBEM_BatteriediagnoseT, "Anzeige aberkannte Batterie (Vorhalt)" ); break;
        case  3: putValue( eBEM_BatteriediagnoseT, "gelbes Batteriesymbol und Text (Schwache Batterie)" ); break;
        default: putValue( eBEM_BatteriediagnoseT, "!?!" );
    }
}

on envVar eBEM_REK_aktivS
{
    switch (getValue( eBEM_REK_aktivS ))
    {
        case  0: putValue( eBEM_REK_aktivT, "keine Rekuperationsfreigabe" ); break;
        case  1: putValue( eBEM_REK_aktivT, "Rekuperationsfreigabe" ); break;
        default: putValue( eBEM_REK_aktivT, "!?!" );
    }
}

on envVar eBEM_EMLIN_ungueltigS
{
    switch (getValue( eBEM_EMLIN_ungueltigS ))
    {
        case  0: putValue( eBEM_EMLIN_ungueltigT, "Signale gueltig" ); break;
        case  1: putValue( eBEM_EMLIN_ungueltigT, "Signale ungueltig" ); break;
        default: putValue( eBEM_EMLIN_ungueltigT, "!?!" );
    }
}

on envVar eBEM_Batt_AbS
{
    switch (getValue( eBEM_Batt_AbS ))
    {
        case  0: putValue( eBEM_Batt_AbT, "verbunden" ); break;
        case  1: putValue( eBEM_Batt_AbT, "nicht verbunden" ); break;
        default: putValue( eBEM_Batt_AbT, "!?!" );
    }
}

on envVar eBEM_STH_Zielzeit15
{
    if( getValue( this ))
    {
    _BEM_STH_Zielzeit = getValue( eBEM_STH_ZielzeitS );
    putValue( eBEM_STH_ZielzeitS, 75 );
    }
    else if( getValue( eBEM_STH_ZielzeitS ) == 75)
    {
    if( _BEM_STH_Zielzeit != 75)
      putValue( eBEM_STH_ZielzeitS, _BEM_STH_Zielzeit );
    else
      putValue( eBEM_STH_ZielzeitS, 70 );
    }
}

on envVar eBEM_STH_ZielzeitS
{
    putValue( eBEM_STH_Zielzeit15, getValue( eBEM_STH_ZielzeitS ) == 75 );
}

on envVar eBEM_Ladezustand15
{
    if( getValue( this ))
    {
    _BEM_Ladezustand = getValue( eBEM_LadezustandS );
    putValue( eBEM_LadezustandS, 150 );
    }
    else if( getValue( eBEM_LadezustandS ) == 150)
    {
    if( _BEM_Ladezustand != 150)
      putValue( eBEM_LadezustandS, _BEM_Ladezustand );
    else
      putValue( eBEM_LadezustandS, 140 );
    }
}

on envVar eBEM_LadezustandS
{
    putValue( eBEM_Ladezustand15, getValue( eBEM_LadezustandS ) == 150 );
}

on envVar eBEM_UBDM255
{
    if( getValue( this ))
    {
        _BEM_UBDM = getValue( eBEM_UBDMS );
        putValue( eBEM_UBDMS, 17.75 );
    }
    else if( getValue( eBEM_UBDMS ) == 17.75)
    {
        if( _BEM_UBDM != 17.75)
            putValue( eBEM_UBDMS, _BEM_UBDM );
        else
            putValue( eBEM_UBDMS, 5 );
    }
}

on envVar eBEM_UBDMS
{
    putValue( eBEM_UBDM255, getValue( eBEM_UBDMS ) == 17.75 );
}

on envVar eCHA_Eco_Charisma_LEDS
{
    switch (getValue( eCHA_Eco_Charisma_LEDS ))
    {
        case  0: putValue( eCHA_Eco_Charisma_LEDT, "LED aus && Blinken aus" ); break;
        case  1: putValue( eCHA_Eco_Charisma_LEDT, "LED ein && Blinken aus" ); break;
        case  2: putValue( eCHA_Eco_Charisma_LEDT, "LED ein && Blinken ein 50%" ); break;
        case  3: putValue( eCHA_Eco_Charisma_LEDT, "reserviert" ); break;
        default: putValue( eCHA_Eco_Charisma_LEDT, "!?!" );
    }
}

on envVar eCHA_Ziel_FahrPr_AMBS
{
    switch (getValue( eCHA_Ziel_FahrPr_AMBS ))
    {
        case  0: putValue( eCHA_Ziel_FahrPr_AMBT, "nicht belegt" ); break;
        case  1: putValue( eCHA_Ziel_FahrPr_AMBT, "Programm 1" ); break;
        case  2: putValue( eCHA_Ziel_FahrPr_AMBT, "Programm 2" ); break;
        case  3: putValue( eCHA_Ziel_FahrPr_AMBT, "Programm 3" ); break;
        case  4: putValue( eCHA_Ziel_FahrPr_AMBT, "Programm 4" ); break;
        case  5: putValue( eCHA_Ziel_FahrPr_AMBT, "Programm 5" ); break;
        case  6: putValue( eCHA_Ziel_FahrPr_AMBT, "Programm 6" ); break;
        case  7: putValue( eCHA_Ziel_FahrPr_AMBT, "Programm 7" ); break;
        case  8: putValue( eCHA_Ziel_FahrPr_AMBT, "Programm 8" ); break;
        case  9: putValue( eCHA_Ziel_FahrPr_AMBT, "Programm 9" ); break;
        case 10: putValue( eCHA_Ziel_FahrPr_AMBT, "Programm 10" ); break;
        case 11: putValue( eCHA_Ziel_FahrPr_AMBT, "Programm 11" ); break;
        case 12: putValue( eCHA_Ziel_FahrPr_AMBT, "Programm 12" ); break;
        case 13: putValue( eCHA_Ziel_FahrPr_AMBT, "Programm 13" ); break;
        case 14: putValue( eCHA_Ziel_FahrPr_AMBT, "Programm 14" ); break;
        case 15: putValue( eCHA_Ziel_FahrPr_AMBT, "Programm 15" ); break;
        default: putValue( eCHA_Ziel_FahrPr_AMBT, "!?!" );
    }
}

on envVar eCHA_Ziel_FahrPr_IVBS
{
    switch (getValue( eCHA_Ziel_FahrPr_IVBS ))
    {
        case  0: putValue( eCHA_Ziel_FahrPr_IVBT, "nicht belegt" ); break;
        case  1: putValue( eCHA_Ziel_FahrPr_IVBT, "Programm 1" ); break;
        case  2: putValue( eCHA_Ziel_FahrPr_IVBT, "Programm 2" ); break;
        case  3: putValue( eCHA_Ziel_FahrPr_IVBT, "Programm 3" ); break;
        case  4: putValue( eCHA_Ziel_FahrPr_IVBT, "Programm 4" ); break;
        case  5: putValue( eCHA_Ziel_FahrPr_IVBT, "Programm 5" ); break;
        case  6: putValue( eCHA_Ziel_FahrPr_IVBT, "Programm 6" ); break;
        case  7: putValue( eCHA_Ziel_FahrPr_IVBT, "Programm 7" ); break;
        case  8: putValue( eCHA_Ziel_FahrPr_IVBT, "Programm 8" ); break;
        case  9: putValue( eCHA_Ziel_FahrPr_IVBT, "Programm 9" ); break;
        case 10: putValue( eCHA_Ziel_FahrPr_IVBT, "Programm 10" ); break;
        case 11: putValue( eCHA_Ziel_FahrPr_IVBT, "Programm 11" ); break;
        case 12: putValue( eCHA_Ziel_FahrPr_IVBT, "Programm 12" ); break;
        case 13: putValue( eCHA_Ziel_FahrPr_IVBT, "Programm 13" ); break;
        case 14: putValue( eCHA_Ziel_FahrPr_IVBT, "Programm 14" ); break;
        case 15: putValue( eCHA_Ziel_FahrPr_IVBT, "Programm 15" ); break;
        default: putValue( eCHA_Ziel_FahrPr_IVBT, "!?!" );
    }
}

on envVar eCHA_Kombi_TexteS
{
    switch (getValue( eCHA_Kombi_TexteS ))
    {
        case  0: putValue( eCHA_Kombi_TexteT, "keine Anzeige" ); break;
        case  1: putValue( eCHA_Kombi_TexteT, "Text 1" ); break;
        case  2: putValue( eCHA_Kombi_TexteT, "Text 2" ); break;
        case  3: putValue( eCHA_Kombi_TexteT, "Text 3" ); break;
        case  4: putValue( eCHA_Kombi_TexteT, "Text 4" ); break;
        case  5: putValue( eCHA_Kombi_TexteT, "Text 5" ); break;
        case  6: putValue( eCHA_Kombi_TexteT, "Text 6" ); break;
        case  7: putValue( eCHA_Kombi_TexteT, "Text 7" ); break;
        case  8: putValue( eCHA_Kombi_TexteT, "Text 8" ); break;
        case  9: putValue( eCHA_Kombi_TexteT, "Text 9" ); break;
        case 10: putValue( eCHA_Kombi_TexteT, "Text 10" ); break;
        case 11: putValue( eCHA_Kombi_TexteT, "Text 11" ); break;
        case 12: putValue( eCHA_Kombi_TexteT, "Text 12" ); break;
        case 13: putValue( eCHA_Kombi_TexteT, "Text 13" ); break;
        case 14: putValue( eCHA_Kombi_TexteT, "Text 14" ); break;
        case 15: putValue( eCHA_Kombi_TexteT, "Text 15" ); break;
        default: putValue( eCHA_Kombi_TexteT, "!?!" );
    }
}

on envVar eCHA_Ziel_FahrPr_KLS
{
    switch (getValue( eCHA_Ziel_FahrPr_KLS ))
    {
        case  0: putValue( eCHA_Ziel_FahrPr_KLT, "nicht belegt" ); break;
        case  1: putValue( eCHA_Ziel_FahrPr_KLT, "Programm 1" ); break;
        case  2: putValue( eCHA_Ziel_FahrPr_KLT, "Programm 2" ); break;
        case  3: putValue( eCHA_Ziel_FahrPr_KLT, "Programm 3" ); break;
        case  4: putValue( eCHA_Ziel_FahrPr_KLT, "Programm 4" ); break;
        case  5: putValue( eCHA_Ziel_FahrPr_KLT, "Programm 5" ); break;
        case  6: putValue( eCHA_Ziel_FahrPr_KLT, "Programm 6" ); break;
        case  7: putValue( eCHA_Ziel_FahrPr_KLT, "Programm 7" ); break;
        case  8: putValue( eCHA_Ziel_FahrPr_KLT, "Programm 8" ); break;
        case  9: putValue( eCHA_Ziel_FahrPr_KLT, "Programm 9" ); break;
        case 10: putValue( eCHA_Ziel_FahrPr_KLT, "Programm 10" ); break;
        case 11: putValue( eCHA_Ziel_FahrPr_KLT, "Programm 11" ); break;
        case 12: putValue( eCHA_Ziel_FahrPr_KLT, "Programm 12" ); break;
        case 13: putValue( eCHA_Ziel_FahrPr_KLT, "Programm 13" ); break;
        case 14: putValue( eCHA_Ziel_FahrPr_KLT, "Programm 14" ); break;
        case 15: putValue( eCHA_Ziel_FahrPr_KLT, "Programm 15" ); break;
        default: putValue( eCHA_Ziel_FahrPr_KLT, "!?!" );
    }
}

on envVar eCHA_Ziel_FahrPr_NAV_RouteS
{
    switch (getValue( eCHA_Ziel_FahrPr_NAV_RouteS ))
    {
        case  0: putValue( eCHA_Ziel_FahrPr_NAV_RouteT, "nicht belegt" ); break;
        case  1: putValue( eCHA_Ziel_FahrPr_NAV_RouteT, "Programm 1" ); break;
        case  2: putValue( eCHA_Ziel_FahrPr_NAV_RouteT, "Programm 2" ); break;
        case  3: putValue( eCHA_Ziel_FahrPr_NAV_RouteT, "Programm 3" ); break;
        case  4: putValue( eCHA_Ziel_FahrPr_NAV_RouteT, "Programm 4" ); break;
        case  5: putValue( eCHA_Ziel_FahrPr_NAV_RouteT, "Programm 5" ); break;
        case  6: putValue( eCHA_Ziel_FahrPr_NAV_RouteT, "Programm 6" ); break;
        case  7: putValue( eCHA_Ziel_FahrPr_NAV_RouteT, "Programm 7" ); break;
        case  8: putValue( eCHA_Ziel_FahrPr_NAV_RouteT, "Programm 8" ); break;
        case  9: putValue( eCHA_Ziel_FahrPr_NAV_RouteT, "Programm 9" ); break;
        case 10: putValue( eCHA_Ziel_FahrPr_NAV_RouteT, "Programm 10" ); break;
        case 11: putValue( eCHA_Ziel_FahrPr_NAV_RouteT, "Programm 11" ); break;
        case 12: putValue( eCHA_Ziel_FahrPr_NAV_RouteT, "Programm 12" ); break;
        case 13: putValue( eCHA_Ziel_FahrPr_NAV_RouteT, "Programm 13" ); break;
        case 14: putValue( eCHA_Ziel_FahrPr_NAV_RouteT, "Programm 14" ); break;
        case 15: putValue( eCHA_Ziel_FahrPr_NAV_RouteT, "Programm 15" ); break;
        default: putValue( eCHA_Ziel_FahrPr_NAV_RouteT, "!?!" );
    }
}

on envVar eCHA_Ziel_FahrPr_NAV_SegelS
{
    switch (getValue( eCHA_Ziel_FahrPr_NAV_SegelS ))
    {
        case  0: putValue( eCHA_Ziel_FahrPr_NAV_SegelT, "nicht belegt" ); break;
        case  1: putValue( eCHA_Ziel_FahrPr_NAV_SegelT, "Programm 1" ); break;
        case  2: putValue( eCHA_Ziel_FahrPr_NAV_SegelT, "Programm 2" ); break;
        case  3: putValue( eCHA_Ziel_FahrPr_NAV_SegelT, "Programm 3" ); break;
        case  4: putValue( eCHA_Ziel_FahrPr_NAV_SegelT, "Programm 4" ); break;
        case  5: putValue( eCHA_Ziel_FahrPr_NAV_SegelT, "Programm 5" ); break;
        case  6: putValue( eCHA_Ziel_FahrPr_NAV_SegelT, "Programm 6" ); break;
        case  7: putValue( eCHA_Ziel_FahrPr_NAV_SegelT, "Programm 7" ); break;
        case  8: putValue( eCHA_Ziel_FahrPr_NAV_SegelT, "Programm 8" ); break;
        case  9: putValue( eCHA_Ziel_FahrPr_NAV_SegelT, "Programm 9" ); break;
        case 10: putValue( eCHA_Ziel_FahrPr_NAV_SegelT, "Programm 10" ); break;
        case 11: putValue( eCHA_Ziel_FahrPr_NAV_SegelT, "Programm 11" ); break;
        case 12: putValue( eCHA_Ziel_FahrPr_NAV_SegelT, "Programm 12" ); break;
        case 13: putValue( eCHA_Ziel_FahrPr_NAV_SegelT, "Programm 13" ); break;
        case 14: putValue( eCHA_Ziel_FahrPr_NAV_SegelT, "Programm 14" ); break;
        case 15: putValue( eCHA_Ziel_FahrPr_NAV_SegelT, "Programm 15" ); break;
        default: putValue( eCHA_Ziel_FahrPr_NAV_SegelT, "!?!" );
    }
}

on envVar eCHA_Ziel_FahrPr_03_01S
{
    switch (getValue( eCHA_Ziel_FahrPr_03_01S ))
    {
        case  0: putValue( eCHA_Ziel_FahrPr_03_01T, "nicht belegt" ); break;
        case  1: putValue( eCHA_Ziel_FahrPr_03_01T, "Programm 1" ); break;
        case  2: putValue( eCHA_Ziel_FahrPr_03_01T, "Programm 2" ); break;
        case  3: putValue( eCHA_Ziel_FahrPr_03_01T, "Programm 3" ); break;
        case  4: putValue( eCHA_Ziel_FahrPr_03_01T, "Programm 4" ); break;
        case  5: putValue( eCHA_Ziel_FahrPr_03_01T, "Programm 5" ); break;
        case  6: putValue( eCHA_Ziel_FahrPr_03_01T, "Programm 6" ); break;
        case  7: putValue( eCHA_Ziel_FahrPr_03_01T, "Programm 7" ); break;
        case  8: putValue( eCHA_Ziel_FahrPr_03_01T, "Programm 8" ); break;
        case  9: putValue( eCHA_Ziel_FahrPr_03_01T, "Programm 9" ); break;
        case 10: putValue( eCHA_Ziel_FahrPr_03_01T, "Programm 10" ); break;
        case 11: putValue( eCHA_Ziel_FahrPr_03_01T, "Programm 11" ); break;
        case 12: putValue( eCHA_Ziel_FahrPr_03_01T, "Programm 12" ); break;
        case 13: putValue( eCHA_Ziel_FahrPr_03_01T, "Programm 13" ); break;
        case 14: putValue( eCHA_Ziel_FahrPr_03_01T, "Programm 14" ); break;
        case 15: putValue( eCHA_Ziel_FahrPr_03_01T, "Programm 15" ); break;
        default: putValue( eCHA_Ziel_FahrPr_03_01T, "!?!" );
    }
}

on envVar eCHA_Ziel_FahrPr_03_02S
{
    switch (getValue( eCHA_Ziel_FahrPr_03_02S ))
    {
        case  0: putValue( eCHA_Ziel_FahrPr_03_02T, "nicht belegt" ); break;
        case  1: putValue( eCHA_Ziel_FahrPr_03_02T, "Programm 1" ); break;
        case  2: putValue( eCHA_Ziel_FahrPr_03_02T, "Programm 2" ); break;
        case  3: putValue( eCHA_Ziel_FahrPr_03_02T, "Programm 3" ); break;
        case  4: putValue( eCHA_Ziel_FahrPr_03_02T, "Programm 4" ); break;
        case  5: putValue( eCHA_Ziel_FahrPr_03_02T, "Programm 5" ); break;
        case  6: putValue( eCHA_Ziel_FahrPr_03_02T, "Programm 6" ); break;
        case  7: putValue( eCHA_Ziel_FahrPr_03_02T, "Programm 7" ); break;
        case  8: putValue( eCHA_Ziel_FahrPr_03_02T, "Programm 8" ); break;
        case  9: putValue( eCHA_Ziel_FahrPr_03_02T, "Programm 9" ); break;
        case 10: putValue( eCHA_Ziel_FahrPr_03_02T, "Programm 10" ); break;
        case 11: putValue( eCHA_Ziel_FahrPr_03_02T, "Programm 11" ); break;
        case 12: putValue( eCHA_Ziel_FahrPr_03_02T, "Programm 12" ); break;
        case 13: putValue( eCHA_Ziel_FahrPr_03_02T, "Programm 13" ); break;
        case 14: putValue( eCHA_Ziel_FahrPr_03_02T, "Programm 14" ); break;
        case 15: putValue( eCHA_Ziel_FahrPr_03_02T, "Programm 15" ); break;
        default: putValue( eCHA_Ziel_FahrPr_03_02T, "!?!" );
    }
}

on envVar eDR_SystemstatusS
{
    switch (getValue( eDR_SystemstatusS ))
    {
        case  0: putValue( eDR_SystemstatusT, "Init oder kein Wert verfuegbar" ); break;
        case  1: putValue( eDR_SystemstatusT, "Komfortabel" ); break;
        case  2: putValue( eDR_SystemstatusT, "Normal" ); break;
        case  3: putValue( eDR_SystemstatusT, "Sport 1" ); break;
        case  4: putValue( eDR_SystemstatusT, "Sport 2" ); break;
        case  5: putValue( eDR_SystemstatusT, "nicht funktionsfähig" ); break;
        case  6: putValue( eDR_SystemstatusT, "nicht definiert" ); break;
        case  7: putValue( eDR_SystemstatusT, "Notfahrfunktion" ); break;
        default: putValue( eDR_SystemstatusT, "!?!" );
    }
}

on envVar eLF_TexteS
{
    switch (getValue( eLF_TexteS ))
    {
        case  0: putValue( eLF_TexteT, "keine Anzeige" ); break;
        case  1: putValue( eLF_TexteT, "Text Fahrzeug momentan zu tief Regelung laeuft" ); break;
        case  2: putValue( eLF_TexteT, "Text Fahrzeug momentan zu hoch Regelung laeuft" ); break;
        case  3: putValue( eLF_TexteT, "Text Niveauregelung abgeschaltet" ); break;
        default: putValue( eLF_TexteT, "!?!" );
    }
}

on envVar eDR_TasterS
{
    switch (getValue( eDR_TasterS ))
    {
        case  0: putValue( eDR_TasterT, "Taster nicht gedrückt" ); break;
        case  1: putValue( eDR_TasterT, "Taster gedrückt" ); break;
        default: putValue( eDR_TasterT, "!?!" );
    }
}

on envVar eDR_Gelbe_WarnlampeS
{
    switch (getValue( eDR_Gelbe_WarnlampeS ))
    {
        case  0: putValue( eDR_Gelbe_WarnlampeT, "Warnlampe aus" ); break;
        case  1: putValue( eDR_Gelbe_WarnlampeT, "Warnlampe ein (Aufprüfen)" ); break;
        case  2: putValue( eDR_Gelbe_WarnlampeT, "Warnlampe an (Warnung)" ); break;
        case  3: putValue( eDR_Gelbe_WarnlampeT, "reserviert" ); break;
        default: putValue( eDR_Gelbe_WarnlampeT, "!?!" );
    }
}

on envVar eDR_Daempferreg_TexteS
{
    switch (getValue( eDR_Daempferreg_TexteS ))
    {
        case  0: putValue( eDR_Daempferreg_TexteT, "kein Text" ); break;
        case  1: putValue( eDR_Daempferreg_TexteT, "Daempfer Sport" ); break;
        case  2: putValue( eDR_Daempferreg_TexteT, "Daempfer Basis" ); break;
        case  3: putValue( eDR_Daempferreg_TexteT, "Daempfer Comfort" ); break;
        case 15: putValue( eDR_Daempferreg_TexteT, "Verlademodus" ); break;
        default: putValue( eDR_Daempferreg_TexteT, "!?!" );
    }
}











on envVar eKombi_02_altS
{
    switch (getValue( eKombi_02_altS ))
    {
        case  0: putValue( eKombi_02_altT, "aktuell" ); break;
        case  1: putValue( eKombi_02_altT, "veraltet" ); break;
        default: putValue( eKombi_02_altT, "!?!" );
    }
}

on envVar eUhrzeit_01_altS
{
    switch (getValue( eUhrzeit_01_altS ))
    {
        case  0: putValue( eUhrzeit_01_altT, "aktuell" ); break;
        case  1: putValue( eUhrzeit_01_altT, "veraltet" ); break;
        default: putValue( eUhrzeit_01_altT, "!?!" );
    }
}

on envVar eDGN_Verlernzaehler255
{
    if( getValue( this ))
    {
    _DGN_Verlernzaehler = getValue( eDGN_VerlernzaehlerS );
    putValue( eDGN_VerlernzaehlerS, 255 );
    }
    else if( getValue( eDGN_VerlernzaehlerS ) == 255)
    {
    if( _DGN_Verlernzaehler != 255)
      putValue( eDGN_VerlernzaehlerS, _DGN_Verlernzaehler );
    else
      putValue( eDGN_VerlernzaehlerS, 0 );
    }

}

on envVar eDGN_VerlernzaehlerS
{
    putValue( eDGN_Verlernzaehler255, getValue( eDGN_VerlernzaehlerS ) == 255 );
}

on envVar eKBI_Kilometerstand_11048574
{
    if( getValue( this ))
    {
    _KBI_Kilometerstand_1 = getValue( eKBI_Kilometerstand_1S );
    putValue( eKBI_Kilometerstand_1S, 1048574 );
    }
    else if( getValue( eKBI_Kilometerstand_1S ) == 1048574)
    {
    if( _KBI_Kilometerstand_1 != 1048574)
      putValue( eKBI_Kilometerstand_1S, _KBI_Kilometerstand_1 );
    else
      putValue( eKBI_Kilometerstand_1S, 0 );
    }

}

on envVar eKBI_Kilometerstand_11048575
{
    if( getValue( this ))
    {
    _KBI_Kilometerstand_1 = getValue( eKBI_Kilometerstand_1S );
    putValue( eKBI_Kilometerstand_1S, 1048575 );
    }
    else if( getValue( eKBI_Kilometerstand_1S ) == 1048575)
    {
    if( _KBI_Kilometerstand_1 != 1048575)
      putValue( eKBI_Kilometerstand_1S, _KBI_Kilometerstand_1 );
    else
      putValue( eKBI_Kilometerstand_1S, 1048574 );
    }

}

on envVar eKBI_Kilometerstand_1S
{
    putValue( eKBI_Kilometerstand_11048574, getValue( eKBI_Kilometerstand_1S ) == 1048574 );
    putValue( eKBI_Kilometerstand_11048575, getValue( eKBI_Kilometerstand_1S ) == 1048575 );
}

on envVar eUH_Monat_114
{
    if( getValue( this ))
    {
    _UH_Monat_1 = getValue( eUH_Monat_1S );
    putValue( eUH_Monat_1S, 14 );
    }
    else if( getValue( eUH_Monat_1S ) == 14)
    {
    if( _UH_Monat_1 != 14)
      putValue( eUH_Monat_1S, _UH_Monat_1 );
    else
      putValue( eUH_Monat_1S, 1 );
    }

}

on envVar eUH_Monat_1S
{
    putValue( eUH_Monat_114, getValue( eUH_Monat_1S ) == 14 );
}

on envVar eUH_Tag_10
{
    if( getValue( this ))
    {
    _UH_Tag_1 = getValue( eUH_Tag_1S );
    putValue( eUH_Tag_1S, 0 );
    }
    else if( getValue( eUH_Tag_1S ) == 0)
    {
    if( _UH_Tag_1 != 0)
      putValue( eUH_Tag_1S, _UH_Tag_1 );
    else
      putValue( eUH_Tag_1S, 1 );
    }

}

on envVar eUH_Tag_1S
{
    putValue( eUH_Tag_10, getValue( eUH_Tag_1S ) == 0 );
}

on envVar eEPB_Fehlerlampe_GelbS
{
    switch (getValue( eEPB_Fehlerlampe_GelbS ))
    {
        case  0: putValue( eEPB_Fehlerlampe_GelbT, "Aus" ); break;
        case  1: putValue( eEPB_Fehlerlampe_GelbT, "Ein" ); break;
        default: putValue( eEPB_Fehlerlampe_GelbT, "!?!" );
    }
}

on envVar eEPB_Fehlerlampe_BKLS
{
    switch (getValue( eEPB_Fehlerlampe_BKLS ))
    {
        case  0: putValue( eEPB_Fehlerlampe_BKLT, "BKL aus" ); break;
        case  1: putValue( eEPB_Fehlerlampe_BKLT, "BKL an" ); break;
        default: putValue( eEPB_Fehlerlampe_BKLT, "!?!" );
    }
}

on envVar eEPB_FunktionslampeS
{
    switch (getValue( eEPB_FunktionslampeS ))
    {
        case  0: putValue( eEPB_FunktionslampeT, "Aus" ); break;
        case  1: putValue( eEPB_FunktionslampeT, "Ein" ); break;
        default: putValue( eEPB_FunktionslampeT, "!?!" );
    }
}

on envVar eEPB_TexteS
{
    switch (getValue( eEPB_TexteS ))
    {
        case  0: putValue( eEPB_TexteT, "keine Anzeige" ); break;
        case  1: putValue( eEPB_TexteT, "Neigungswinkel zu gross" ); break;
        case  2: putValue( eEPB_TexteT, "Parkbremse von Hand oeffnen" ); break;
        case  3: putValue( eEPB_TexteT, "EPB in Diagnose" ); break;
        case  4: putValue( eEPB_TexteT, "Bremspedal betaetigen" ); break;
        case  5: putValue( eEPB_TexteT, "tbd." ); break;
        case  6: putValue( eEPB_TexteT, "tbd." ); break;
        case  7: putValue( eEPB_TexteT, "Störung Anfahrassistent" ); break;
        case  8: putValue( eEPB_TexteT, "Abschleppschutz blockiert" ); break;
        default: putValue( eEPB_TexteT, "!?!" );
    }
}

on envVar eEPB_AkustikS
{
    switch (getValue( eEPB_AkustikS ))
    {
        case  0: putValue( eEPB_AkustikT, "Warnton aus" ); break;
        case  1: putValue( eEPB_AkustikT, "Warnton an" ); break;
        default: putValue( eEPB_AkustikT, "!?!" );
    }
}

on envVar eEPB_AutoholdlampeS
{
    switch (getValue( eEPB_AutoholdlampeS ))
    {
        case  0: putValue( eEPB_AutoholdlampeT, "Lampe aus (Autohold inaktiv)" ); break;
        case  1: putValue( eEPB_AutoholdlampeT, "Lampe ein (Autohold aktiv)" ); break;
        default: putValue( eEPB_AutoholdlampeT, "!?!" );
    }
}

on envVar eEPB_Bremsbelag_WarnS
{
    switch (getValue( eEPB_Bremsbelag_WarnS ))
    {
        case  0: putValue( eEPB_Bremsbelag_WarnT, "Bremsbelag ok" ); break;
        case  1: putValue( eEPB_Bremsbelag_WarnT, "Bremsbelag unter Minimum" ); break;
        default: putValue( eEPB_Bremsbelag_WarnT, "!?!" );
    }
}

on envVar eESP_QBit_GierrateS
{
    switch (getValue( eESP_QBit_GierrateS ))
    {
        case  0: putValue( eESP_QBit_GierrateT, "gueltiger Wert" ); break;
        case  1: putValue( eESP_QBit_GierrateT, "Ersatz Init oder Fehlerwert" ); break;
        default: putValue( eESP_QBit_GierrateT, "!?!" );
    }
}

on envVar eESP_QBit_LaengsbeschlS
{
    switch (getValue( eESP_QBit_LaengsbeschlS ))
    {
        case  0: putValue( eESP_QBit_LaengsbeschlT, "gueltiger Wert" ); break;
        case  1: putValue( eESP_QBit_LaengsbeschlT, "Ersatz Init oder Fehlerwert" ); break;
        default: putValue( eESP_QBit_LaengsbeschlT, "!?!" );
    }
}

on envVar eESP_QBit_QuerbS
{
    switch (getValue( eESP_QBit_QuerbS ))
    {
        case  0: putValue( eESP_QBit_QuerbT, "gueltiger Wert" ); break;
        case  1: putValue( eESP_QBit_QuerbT, "Ersatz Init oder Fehlerwert" ); break;
        default: putValue( eESP_QBit_QuerbT, "!?!" );
    }
}


on envVar eESP_VZ_GierrateS
{
    switch (getValue( eESP_VZ_GierrateS ))
    {
        case  0: putValue( eESP_VZ_GierrateT, "positiv" ); break;
        case  1: putValue( eESP_VZ_GierrateT, "negativ" ); break;
        default: putValue( eESP_VZ_GierrateT, "!?!" );
    }
}

on envVar eESP_NotbremsanzeigeS
{
    switch (getValue( eESP_NotbremsanzeigeS ))
    {
        case  0: putValue( eESP_NotbremsanzeigeT, "keine Notbremsung erkannt" ); break;
        case  1: putValue( eESP_NotbremsanzeigeT, "Notbremsung erkannt" ); break;
        default: putValue( eESP_NotbremsanzeigeT, "!?!" );
    }
}

on envVar eESP_SpannungsAnfS
{
    switch (getValue( eESP_SpannungsAnfS ))
    {
        case  0: putValue( eESP_SpannungsAnfT, "keine Anforderung" ); break;
        case  1: putValue( eESP_SpannungsAnfT, "Anforderung Spannungswert 1" ); break;
        default: putValue( eESP_SpannungsAnfT, "!?!" );
    }
}

on envVar eESP_PLA_AbbruchS
{
    switch (getValue( eESP_PLA_AbbruchS ))
    {
        case  0: putValue( eESP_PLA_AbbruchT, "Init" ); break;
        case  1: putValue( eESP_PLA_AbbruchT, "Geschwindigkeitsueberschreitung" ); break;
        case  2: putValue( eESP_PLA_AbbruchT, "Falscher PLA Status" ); break;
        case  3: putValue( eESP_PLA_AbbruchT, "Deaktivierung durch Abbruch Lenkung" ); break;
        case  4: putValue( eESP_PLA_AbbruchT, "PLA Bremsanforderung nach Stillstand" ); break;
        case  5: putValue( eESP_PLA_AbbruchT, "Abbruch durch Kl15 aus" ); break;
        case  6: putValue( eESP_PLA_AbbruchT, "Abbruch durch FT offen" ); break;
        default: putValue( eESP_PLA_AbbruchT, "!?!" );
    }
}

on envVar eESP_Status_ESP_PLAS
{
    switch (getValue( eESP_Status_ESP_PLAS ))
    {
        case  0: putValue( eESP_Status_ESP_PLAT, "ESP PLA deaktiv" ); break;
        case  1: putValue( eESP_Status_ESP_PLAT, "ESP PLA Init" ); break;
        case  2: putValue( eESP_Status_ESP_PLAT, "ESP PLA Fehler" ); break;
        case  4: putValue( eESP_Status_ESP_PLAT, "ESP PLA aktivierbar" ); break;
        case  6: putValue( eESP_Status_ESP_PLAT, "ESP PLA Bremse aktiv" ); break;
        case  8: putValue( eESP_Status_ESP_PLAT, "ESP PLA funktionsbereit" ); break;
        case  9: putValue( eESP_Status_ESP_PLAT, "ESP PLA Neustart" ); break;
        case 10: putValue( eESP_Status_ESP_PLAT, "ESP PLA Abbruch" ); break;
        default: putValue( eESP_Status_ESP_PLAT, "!?!" );
    }
}

on envVar eESP_Querbeschleunigung255
{
    if( getValue( this ))
    {
    _ESP_Querbeschleunigung = getValue( eESP_QuerbeschleunigungS );
    putValue( eESP_QuerbeschleunigungS, 1.28 );
    }
    else if( getValue( eESP_QuerbeschleunigungS ) == 1.28)
    {
    if( _ESP_Querbeschleunigung != 1.28)
      putValue( eESP_QuerbeschleunigungS, _ESP_Querbeschleunigung );
    else
      putValue( eESP_QuerbeschleunigungS, 0 );
    }

}

on envVar eESP_QuerbeschleunigungS
{
    putValue( eESP_Querbeschleunigung255, getValue( eESP_QuerbeschleunigungS ) == 1.28 );
}

on envVar eESP_Laengsbeschl1022
{
    if( getValue( this ))
    {
    _ESP_Laengsbeschl = getValue( eESP_LaengsbeschlS );
    putValue( eESP_LaengsbeschlS, 15.9375 );
    }
    else if( getValue( eESP_LaengsbeschlS ) == 15.9375)
    {
    if( _ESP_Laengsbeschl != 15.9375)
      putValue( eESP_LaengsbeschlS, _ESP_Laengsbeschl );
    else
      putValue( eESP_LaengsbeschlS, 0 );
    }

}

on envVar eESP_Laengsbeschl1023
{
    if( getValue( this ))
    {
    _ESP_Laengsbeschl = getValue( eESP_LaengsbeschlS );
    putValue( eESP_LaengsbeschlS, 15.96875 );
    }
    else if( getValue( eESP_LaengsbeschlS ) == 15.96875)
    {
    if( _ESP_Laengsbeschl != 15.96875)
      putValue( eESP_LaengsbeschlS, _ESP_Laengsbeschl );
    else
      putValue( eESP_LaengsbeschlS, 0 );
    }

}

on envVar eESP_LaengsbeschlS
{
    putValue( eESP_Laengsbeschl1022, getValue( eESP_LaengsbeschlS ) == 15.9375 );
    putValue( eESP_Laengsbeschl1023, getValue( eESP_LaengsbeschlS ) == 15.96875 );
}


on envVar eESP_Gierrate16383
{
    if( getValue( this ))
    {
    _ESP_Gierrate = getValue( eESP_GierrateS );
    putValue( eESP_GierrateS, 163.83 );
    }
    else if( getValue( eESP_GierrateS ) == 163.83)
    {
    if( _ESP_Gierrate != 163.83)
      putValue( eESP_GierrateS, _ESP_Gierrate );
    else
      putValue( eESP_GierrateS, 0 );
    }

}

on envVar eESP_GierrateS
{
    putValue( eESP_Gierrate16383, getValue( eESP_GierrateS ) == 163.83 );
}

on envVar eBR_SystemartS
{
    switch (getValue( eBR_SystemartS ))
    {
        case  0: putValue( eBR_SystemartT, "ABS" ); break;
        case  1: putValue( eBR_SystemartT, "ABS ASR" ); break;
        case  2: putValue( eBR_SystemartT, "ESP" ); break;
        case  3: putValue( eBR_SystemartT, "ESP mit integrierter EPB" ); break;
        default: putValue( eBR_SystemartT, "!?!" );
    }
}

on envVar eESP_LampeS
{
    switch (getValue( eESP_LampeS ))
    {
        case  0: putValue( eESP_LampeT, "Aus" ); break;
        case  1: putValue( eESP_LampeT, "Ein" ); break;
        default: putValue( eESP_LampeT, "!?!" );
    }
}

on envVar eABS_LampeS
{
    switch (getValue( eABS_LampeS ))
    {
        case  0: putValue( eABS_LampeT, "Aus" ); break;
        case  1: putValue( eABS_LampeT, "Ein" ); break;
        default: putValue( eABS_LampeT, "!?!" );
    }
}

on envVar eBK_Lampe_02S
{
    switch (getValue( eBK_Lampe_02S ))
    {
        case  0: putValue( eBK_Lampe_02T, "aus" ); break;
        case  1: putValue( eBK_Lampe_02T, "ein statisch" ); break;
        case  3: putValue( eBK_Lampe_02T, "Warnung" ); break;
        default: putValue( eBK_Lampe_02T, "!?!" );
    }
}

on envVar eESP_Textanzeigen_03S
{
    switch (getValue( eESP_Textanzeigen_03S ))
    {
        case  0: putValue( eESP_Textanzeigen_03T, "kein Text" ); break;
        case  1: putValue( eESP_Textanzeigen_03T, "ESP Stoerung" ); break;
        case  2: putValue( eESP_Textanzeigen_03T, "ABS Stoerung" ); break;
        case  3: putValue( eESP_Textanzeigen_03T, "ESP ABS Stoerung" ); break;
        case  4: putValue( eESP_Textanzeigen_03T, "Werkstatt Bremse" ); break;
        case  5: putValue( eESP_Textanzeigen_03T, "ASR Stoerung" ); break;
        case  6: putValue( eESP_Textanzeigen_03T, "ESP switched off" ); break;
        case  7: putValue( eESP_Textanzeigen_03T, "ASR off" ); break;
        case  8: putValue( eESP_Textanzeigen_03T, "ESP ASR on" ); break;
        case 10: putValue( eESP_Textanzeigen_03T, "keine Bremskraftverstaerkung" ); break;
        case 11: putValue( eESP_Textanzeigen_03T, "ASR aktiviert" ); break;
        case 12: putValue( eESP_Textanzeigen_03T, "ABS ASR Stoerung" ); break;
        case 15: putValue( eESP_Textanzeigen_03T, "ESP offroad" ); break;
        case 17: putValue( eESP_Textanzeigen_03T, "ESP sport" ); break;
        case 18: putValue( eESP_Textanzeigen_03T, "ESP Zwangsaktivierung" ); break;
        case 19: putValue( eESP_Textanzeigen_03T, "kein Text Prio2" ); break;
        default: putValue( eESP_Textanzeigen_03T, "!?!" );
    }
}

on envVar eESP_MeldungenS
{
    switch (getValue( eESP_MeldungenS ))
    {
        case  0: putValue( eESP_MeldungenT, "keine Anzeige" ); break;
        case  1: putValue( eESP_MeldungenT, "Autohold Hinweis 1" ); break;
        case  2: putValue( eESP_MeldungenT, "Stoerung Autohold" ); break;
        case  3: putValue( eESP_MeldungenT, "Stoerung Hillholder" ); break;
        case  4: putValue( eESP_MeldungenT, "Uebernehmen" ); break;
        default: putValue( eESP_MeldungenT, "!?!" );
    }
}

on envVar eESP_Fehlerstatus_WegimpS
{
    switch (getValue( eESP_Fehlerstatus_WegimpS ))
    {
        case  0: putValue( eESP_Fehlerstatus_WegimpT, "Wegimpulse iO" ); break;
        case  1: putValue( eESP_Fehlerstatus_WegimpT, "Fehler" ); break;
        default: putValue( eESP_Fehlerstatus_WegimpT, "!?!" );
    }
}

on envVar eESP_QBit_Wegimp_VAS
{
    switch (getValue( eESP_QBit_Wegimp_VAS ))
    {
        case  0: putValue( eESP_QBit_Wegimp_VAT, "gueltiger Wert" ); break;
        case  1: putValue( eESP_QBit_Wegimp_VAT, "Ersatz Init oder Fehlerwert" ); break;
        default: putValue( eESP_QBit_Wegimp_VAT, "!?!" );
    }
}

on envVar eESP_HDC_FktLampeS
{
    switch (getValue( eESP_HDC_FktLampeS ))
    {
        case  0: putValue( eESP_HDC_FktLampeT, "Aus" ); break;
        case  1: putValue( eESP_HDC_FktLampeT, "Ein" ); break;
        default: putValue( eESP_HDC_FktLampeT, "!?!" );
    }
}

on envVar eESP_Off_LampeS
{
    switch (getValue( eESP_Off_LampeS ))
    {
        case  0: putValue( eESP_Off_LampeT, "Lampe aus" ); break;
        case  1: putValue( eESP_Off_LampeT, "Lampe ein" ); break;
        default: putValue( eESP_Off_LampeT, "!?!" );
    }
}

on envVar eESP_BKV_WarnungS
{
    switch (getValue( eESP_BKV_WarnungS ))
    {
        case  0: putValue( eESP_BKV_WarnungT, "keine Anzeige" ); break;
        case  1: putValue( eESP_BKV_WarnungT, "keine Bremskraftverstaerkung" ); break;
        default: putValue( eESP_BKV_WarnungT, "!?!" );
    }
}

on envVar eESP_m_Raddrehz32765
{
    if( getValue( this ))
    {
    _ESP_m_Raddrehz = getValue( eESP_m_RaddrehzS );
    putValue( eESP_m_RaddrehzS, 65.53 );
    }
    else if( getValue( eESP_m_RaddrehzS ) == 65.53)
    {
    if( _ESP_m_Raddrehz != 65.53)
      putValue( eESP_m_RaddrehzS, _ESP_m_Raddrehz );
    else
      putValue( eESP_m_RaddrehzS, 65.532 );
    }
}

on envVar eESP_m_Raddrehz32766
{
    if( getValue( this ))
    {
    _ESP_m_Raddrehz = getValue( eESP_m_RaddrehzS );
    putValue( eESP_m_RaddrehzS, 65.532 );
    }
    else if( getValue( eESP_m_RaddrehzS ) == 65.532)
    {
    if( _ESP_m_Raddrehz != 65.532)
      putValue( eESP_m_RaddrehzS, _ESP_m_Raddrehz );
    else
      putValue( eESP_m_RaddrehzS, 0 );
    }

}

on envVar eESP_m_Raddrehz32767
{
    if( getValue( this ))
    {
    _ESP_m_Raddrehz = getValue( eESP_m_RaddrehzS );
    putValue( eESP_m_RaddrehzS, 65.534 );
    }
    else if( getValue( eESP_m_RaddrehzS ) == 65.534)
    {
    if( _ESP_m_Raddrehz != 65.534)
      putValue( eESP_m_RaddrehzS, _ESP_m_Raddrehz );
    else
      putValue( eESP_m_RaddrehzS, 65.532 );
    }
}

on envVar eESP_m_RaddrehzS
{
    putValue( eESP_m_Raddrehz32765, getValue( eESP_m_RaddrehzS ) == 65.53 );
    putValue( eESP_m_Raddrehz32766, getValue( eESP_m_RaddrehzS ) == 65.532 );
    putValue( eESP_m_Raddrehz32767, getValue( eESP_m_RaddrehzS ) == 65.534 );
}

on envVar eESP_HDC_Regelgeschw0
{
    if( getValue( this ))
    {
    _ESP_HDC_Regelgeschw = getValue( eESP_HDC_RegelgeschwS );
    putValue( eESP_HDC_RegelgeschwS, 0 );
    }
    else if( getValue( eESP_HDC_RegelgeschwS ) == 0)
    {
    if( _ESP_HDC_Regelgeschw != 0)
      putValue( eESP_HDC_RegelgeschwS, _ESP_HDC_Regelgeschw );
    else
      putValue( eESP_HDC_RegelgeschwS, 40.32 );
    }

}

on envVar eESP_HDC_Regelgeschw125
{
    if( getValue( this ))
    {
    _ESP_HDC_Regelgeschw = getValue( eESP_HDC_RegelgeschwS );
    putValue( eESP_HDC_RegelgeschwS, 40 );
    }
    else if( getValue( eESP_HDC_RegelgeschwS ) == 40)
    {
    if( _ESP_HDC_Regelgeschw != 40)
      putValue( eESP_HDC_RegelgeschwS, _ESP_HDC_Regelgeschw );
    else
      putValue( eESP_HDC_RegelgeschwS, 40.32 );
    }

}

on envVar eESP_HDC_Regelgeschw127
{
    if( getValue( this ))
    {
    _ESP_HDC_Regelgeschw = getValue( eESP_HDC_RegelgeschwS );
    putValue( eESP_HDC_RegelgeschwS, 40.64 );
    }
    else if( getValue( eESP_HDC_RegelgeschwS ) == 40.64)
    {
    if( _ESP_HDC_Regelgeschw != 40.64)
      putValue( eESP_HDC_RegelgeschwS, _ESP_HDC_Regelgeschw );
    else
      putValue( eESP_HDC_RegelgeschwS, 40.32 );
    }

}

on envVar eESP_HDC_RegelgeschwS
{
    putValue( eESP_HDC_Regelgeschw0, getValue( eESP_HDC_RegelgeschwS ) == 0 );
    putValue( eESP_HDC_Regelgeschw125, getValue( eESP_HDC_RegelgeschwS ) == 40 );
    putValue( eESP_HDC_Regelgeschw127, getValue( eESP_HDC_RegelgeschwS ) == 40.64 );
}

on envVar eMotor_12_altS
{
    switch (getValue( eMotor_12_altS ))
    {
        case  0: putValue( eMotor_12_altT, "aktuell" ); break;
        case  1: putValue( eMotor_12_altT, "veraltet" ); break;
        default: putValue( eMotor_12_altT, "!?!" );
    }
}

on envVar eGetriebe_11_altS
{
    switch (getValue( eGetriebe_11_altS ))
    {
        case  0: putValue( eGetriebe_11_altT, "aktuell" ); break;
        case  1: putValue( eGetriebe_11_altT, "veraltet" ); break;
        default: putValue( eGetriebe_11_altT, "!?!" );
    }
}

on envVar eGetriebe_13_altS
{
    switch (getValue( eGetriebe_13_altS ))
    {
        case  0: putValue( eGetriebe_13_altT, "aktuell" ); break;
        case  1: putValue( eGetriebe_13_altT, "veraltet" ); break;
        default: putValue( eGetriebe_13_altT, "!?!" );
    }
}

on envVar eMO_QBit_Drehzahl_01S
{
    switch (getValue( eMO_QBit_Drehzahl_01S ))
    {
        case  0: putValue( eMO_QBit_Drehzahl_01T, "gueltiger Wert" ); break;
        case  1: putValue( eMO_QBit_Drehzahl_01T, "Ersatz Init oder Fehlerwert" ); break;
        default: putValue( eMO_QBit_Drehzahl_01T, "!?!" );
    }
}

on envVar eMKE_TexteS
{
    switch (getValue( eMKE_TexteS ))
    {
        case  0: putValue( eMKE_TexteT, "keine Anzeige" ); break;
        case  1: putValue( eMKE_TexteT, "Warnstufe 1" ); break;
        case  2: putValue( eMKE_TexteT, "Warnstufe 2" ); break;
        default: putValue( eMKE_TexteT, "!?!" );
    }
}

on envVar eGE_FahrstufeS
{
    switch (getValue( eGE_FahrstufeS ))
    {
        case  0: putValue( eGE_FahrstufeT, "Zwischenstellung" ); break;
        case  1: putValue( eGE_FahrstufeT, "Init" ); break;
        case  5: putValue( eGE_FahrstufeT, "Position P" ); break;
        case  6: putValue( eGE_FahrstufeT, "Position R" ); break;
        case  7: putValue( eGE_FahrstufeT, "Position N" ); break;
        case  8: putValue( eGE_FahrstufeT, "Position D" ); break;
        case  9: putValue( eGE_FahrstufeT, "Position S" ); break;
        case 10: putValue( eGE_FahrstufeT, "Effizienz" ); break;
        case 13: putValue( eGE_FahrstufeT, "Tipp in S" ); break;
        case 14: putValue( eGE_FahrstufeT, "Tipp in D" ); break;
        case 15: putValue( eGE_FahrstufeT, "Fehler" ); break;
        default: putValue( eGE_FahrstufeT, "!?!" );
    }
}

on envVar eGE_NotlaufS
{
    switch (getValue( eGE_NotlaufS ))
    {
        case  0: putValue( eGE_NotlaufT, "kein Notlauf / Init" ); break;
        case  1: putValue( eGE_NotlaufT, "Getriebe im Notlauf" ); break;
        default: putValue( eGE_NotlaufT, "!?!" );
    }
}

on envVar eGE_ZielgangS
{
    switch (getValue( eGE_ZielgangS ))
    {
        case  0: putValue( eGE_ZielgangT, "Gang P/N (ausgekuppelt)" ); break;
        case  1: putValue( eGE_ZielgangT, "Gang 1" ); break;
        case  2: putValue( eGE_ZielgangT, "Gang 2" ); break;
        case  3: putValue( eGE_ZielgangT, "Gang 3" ); break;
        case  4: putValue( eGE_ZielgangT, "Gang 4" ); break;
        case  5: putValue( eGE_ZielgangT, "Gang 5" ); break;
        case  6: putValue( eGE_ZielgangT, "Gang 6" ); break;
        case  7: putValue( eGE_ZielgangT, "Gang 7" ); break;
        case  8: putValue( eGE_ZielgangT, "Gang R" ); break;
        case 11: putValue( eGE_ZielgangT, "Gang 8" ); break;
        case 12: putValue( eGE_ZielgangT, "Gang 9" ); break;
        case 14: putValue( eGE_ZielgangT, "Istgang nicht definiert" ); break;
        case 15: putValue( eGE_ZielgangT, "Fehler" ); break;
        default: putValue( eGE_ZielgangT, "!?!" );
    }
}

on envVar eMO_Drehzahl_0165535
{
    if( getValue( this ))
    {
    _MO_Drehzahl_01 = getValue( eMO_Drehzahl_01S );
    putValue( eMO_Drehzahl_01S, 16383.75 );
    }
    else if( getValue( eMO_Drehzahl_01S ) == 16383.75)
    {
    if( _MO_Drehzahl_01 != 16383.75)
      putValue( eMO_Drehzahl_01S, _MO_Drehzahl_01 );
    else
      putValue( eMO_Drehzahl_01S, 0 );
    }

}

on envVar eMO_Drehzahl_01S
{
    putValue( eMO_Drehzahl_0165535, getValue( eMO_Drehzahl_01S ) == 16383.75 );
}

on envVar eLDW_GongS
{
    switch (getValue( eLDW_GongS ))
    {
        case  0: putValue( eLDW_GongT, "kein akustisches Signal" ); break;
        case  1: putValue( eLDW_GongT, "Gong 1" ); break;
        case  2: putValue( eLDW_GongT, "Gong 2" ); break;
        case  3: putValue( eLDW_GongT, "nicht definiert" ); break;
        default: putValue( eLDW_GongT, "!?!" );
    }
}

on envVar eLDW_TexteS
{
    switch (getValue( eLDW_TexteS ))
    {
        case  0: putValue( eLDW_TexteT, "keine Anzeige" ); break;
        case  1: putValue( eLDW_TexteT, "Lane assist zur Zeit nicht verfügbar" ); break;
        case  2: putValue( eLDW_TexteT, "Lane assist Systemfehler" ); break;
        case  3: putValue( eLDW_TexteT, "Lane assist zur Zeit keine Sensorsicht" ); break;
        case  4: putValue( eLDW_TexteT, "Lane assist Fahreruebernahme" ); break;
        default: putValue( eLDW_TexteT, "!?!" );
    }
}

on envVar eLDW_Seite_DLCTLCS
{
    switch (getValue( eLDW_Seite_DLCTLCS ))
    {
        case  0: putValue( eLDW_Seite_DLCTLCT, "links" ); break;
        case  1: putValue( eLDW_Seite_DLCTLCT, "rechts" ); break;
        default: putValue( eLDW_Seite_DLCTLCT, "!?!" );
    }
}

/*on envVar eLDW_LernmodusS
{
    switch (getValue( eLDW_LernmodusS ))
    {
        case  0: putValue( eLDW_LernmodusT, "LDW aus" ); break;
        case  1: putValue( eLDW_LernmodusT, "LDW an/inaktiv" ); break;
        case  2: putValue( eLDW_LernmodusT, "LDW an/aktiv" ); break;
        case  3: putValue( eLDW_LernmodusT, "Warnung rechts" ); break;
        case  4: putValue( eLDW_LernmodusT, "Warnung links" ); break;
        case  5: putValue( eLDW_LernmodusT, "nicht definiert" ); break;
        case  6: putValue( eLDW_LernmodusT, "nicht definiert" ); break;
        case  7: putValue( eLDW_LernmodusT, "nicht definiert" ); break;
        default: putValue( eLDW_LernmodusT, "!?!" );
    }
}*/

on envVar eLDW_Lernmodus_seitenabhaengigS
{
    switch (getValue( eLDW_Lernmodus_seitenabhaengigS ))
    {
        case  0: putValue( eLDW_Lernmodus_seitenabhaengigT, "links aus  rechts aus" ); break;
        case  1: putValue( eLDW_Lernmodus_seitenabhaengigT, "nicht definiert" ); break;
        case  2: putValue( eLDW_Lernmodus_seitenabhaengigT, "nicht definiert" ); break;
        case  3: putValue( eLDW_Lernmodus_seitenabhaengigT, "nicht definiert" ); break;
        case  4: putValue( eLDW_Lernmodus_seitenabhaengigT, "nicht definiert" ); break;
        case  5: putValue( eLDW_Lernmodus_seitenabhaengigT, "links outlined  rechts outlined" ); break;
        case  6: putValue( eLDW_Lernmodus_seitenabhaengigT, "links outlined  rechts an" ); break;
        case  7: putValue( eLDW_Lernmodus_seitenabhaengigT, "links outlined  rechts Warnung" ); break;
        case  8: putValue( eLDW_Lernmodus_seitenabhaengigT, "nicht definiert" ); break;
        case  9: putValue( eLDW_Lernmodus_seitenabhaengigT, "links an  rechts outlined" ); break;
        case 10: putValue( eLDW_Lernmodus_seitenabhaengigT, "links an  rechts an" ); break;
        case 11: putValue( eLDW_Lernmodus_seitenabhaengigT, "links an  rechts Warnung" ); break;
        case 12: putValue( eLDW_Lernmodus_seitenabhaengigT, "nicht definiert" ); break;
        case 13: putValue( eLDW_Lernmodus_seitenabhaengigT, "links Warnung  rechts outlined" ); break;
        case 14: putValue( eLDW_Lernmodus_seitenabhaengigT, "links Warnung  rechts an" ); break;
        case 15: putValue( eLDW_Lernmodus_seitenabhaengigT, "Fehler" ); break;
        default: putValue( eLDW_Lernmodus_seitenabhaengigT, "!?!" );
    }
}

/*on envVar eLDW_Warnung_linksS
{
    switch (getValue( eLDW_Warnung_linksS ))
    {
        case  0: putValue( eLDW_Warnung_linksT, "Warnung links aus" ); break;
        case  1: putValue( eLDW_Warnung_linksT, "Warnung links ein" ); break;
        default: putValue( eLDW_Warnung_linksT, "!?!" );
    }
}*/

/*on envVar eLDW_Warnung_rechtsS
{
    switch (getValue( eLDW_Warnung_rechtsS ))
    {
        case  0: putValue( eLDW_Warnung_rechtsT, "Warnung rechts aus" ); break;
        case  1: putValue( eLDW_Warnung_rechtsT, "Warnung rechts ein" ); break;
        default: putValue( eLDW_Warnung_rechtsT, "!?!" );
    }
}*/

/*on envVar eLDW_Frontscheibenheizung_aktivS
{
    switch (getValue( eLDW_Frontscheibenheizung_aktivS ))
    {
        case  0: putValue( eLDW_Frontscheibenheizung_aktivT, "LDW-Frontscheibenheizung nicht aktiviert" ); break;
        case  1: putValue( eLDW_Frontscheibenheizung_aktivT, "LDW-Frontscheibenheizung aktiviert" ); break;
        default: putValue( eLDW_Frontscheibenheizung_aktivT, "!?!" );
    }
}*/

on envVar eLDW_Status_LED_gelbS
{
    switch (getValue( eLDW_Status_LED_gelbS ))
    {
        case  0: putValue( eLDW_Status_LED_gelbT, "LDW-Status gelb aus" ); break;
        case  1: putValue( eLDW_Status_LED_gelbT, "LDW-Status gelb aktiv" ); break;
        default: putValue( eLDW_Status_LED_gelbT, "!?!" );
    }
}

on envVar eLDW_Status_LED_gruenS
{
    switch (getValue( eLDW_Status_LED_gruenS ))
    {
        case  0: putValue( eLDW_Status_LED_gruenT, "LDW-Status gruen aus" ); break;
        case  1: putValue( eLDW_Status_LED_gruenT, "LDW-Status gruen aktiv" ); break;
        default: putValue( eLDW_Status_LED_gruenT, "!?!" );
    }
}

on envVar eEPS_AkustiksignalS
{
    switch (getValue( eEPS_AkustiksignalS ))
    {
        case  0: putValue( eEPS_AkustiksignalT, "Akustiksignal nicht aktiv" ); break;
        case  1: putValue( eEPS_AkustiksignalT, "Akustiksignal aktiv" ); break;
        default: putValue( eEPS_AkustiksignalT, "!?!" );
    }
}

on envVar eEPS_FehlerlampeS
{
    switch (getValue( eEPS_FehlerlampeS ))
    {
        case  0: putValue( eEPS_FehlerlampeT, "Lampe aus" ); break;
        case  1: putValue( eEPS_FehlerlampeT, "Lampe ein" ); break;
        default: putValue( eEPS_FehlerlampeT, "!?!" );
    }
}


on envVar eEPS_WarnungenS
{
    switch (getValue( eEPS_WarnungenS ))
    {
        case  0: putValue( eEPS_WarnungenT, "kein Text" ); break;
        case  1: putValue( eEPS_WarnungenT, "Text 1" ); break;
        case  2: putValue( eEPS_WarnungenT, "Text 2" ); break;
        case  3: putValue( eEPS_WarnungenT, "Text 3" ); break;
        case  4: putValue( eEPS_WarnungenT, "Text 4" ); break;
        default: putValue( eEPS_WarnungenT, "!?!" );
    }
}

on envVar eEPS_Charisma_FahrPrS
{
    switch (getValue( eEPS_Charisma_FahrPrS ))
    {
        case  0: putValue( eEPS_Charisma_FahrPrT, "nicht belegt" ); break;
        case  1: putValue( eEPS_Charisma_FahrPrT, "Programm 1" ); break;
        case  2: putValue( eEPS_Charisma_FahrPrT, "Programm 2" ); break;
        case  3: putValue( eEPS_Charisma_FahrPrT, "Programm 3" ); break;
        case  4: putValue( eEPS_Charisma_FahrPrT, "Programm 4" ); break;
        case  5: putValue( eEPS_Charisma_FahrPrT, "Programm 5" ); break;
        case  6: putValue( eEPS_Charisma_FahrPrT, "Programm 6" ); break;
        case  7: putValue( eEPS_Charisma_FahrPrT, "Programm 7" ); break;
        default: putValue( eEPS_Charisma_FahrPrT, "!?!" );
    }
}

on envVar eEPS_Charisma_StatusS
{
    switch (getValue( eEPS_Charisma_StatusS ))
    {
        case  0: putValue( eEPS_Charisma_StatusT, "Init" ); break;
        case  1: putValue( eEPS_Charisma_StatusT, "verfuegbar" ); break;
        case  2: putValue( eEPS_Charisma_StatusT, "nicht verfuegbar" ); break;
        default: putValue( eEPS_Charisma_StatusT, "!?!" );
    }
}


on envVar eEPS_LenkerpositionS
{
    switch (getValue( eEPS_LenkerpositionS ))
    {
        case  0: putValue( eEPS_LenkerpositionT, "unbekannt" ); break;
        case  1: putValue( eEPS_LenkerpositionT, "Linkslenker" ); break;
        case  2: putValue( eEPS_LenkerpositionT, "Rechtslenker" ); break;
        default: putValue( eEPS_LenkerpositionT, "!?!" );
    }
}

on envVar eEPS_Anf_KLS
{
    switch (getValue( eEPS_Anf_KLS ))
    {
        case  0: putValue( eEPS_Anf_KLT, "keine Anforderung" ); break;
        case  1: putValue( eEPS_Anf_KLT, "Anforderung Kuehlung" ); break;
        default: putValue( eEPS_Anf_KLT, "!?!" );
    }
}

on envVar eAFS_Abbiegelicht_li_AnfS
{
    switch (getValue( eAFS_Abbiegelicht_li_AnfS ))
    {
        case  0: putValue( eAFS_Abbiegelicht_li_AnfT, "Abbiegelicht aus" ); break;
        case  1: putValue( eAFS_Abbiegelicht_li_AnfT, "Abbiegelicht ein" ); break;
        default: putValue( eAFS_Abbiegelicht_li_AnfT, "!?!" );
    }
}

on envVar eAFS_Abbiegelicht_re_AnfS
{
    switch (getValue( eAFS_Abbiegelicht_re_AnfS ))
    {
        case  0: putValue( eAFS_Abbiegelicht_re_AnfT, "Abbiegelicht aus" ); break;
        case  1: putValue( eAFS_Abbiegelicht_re_AnfT, "Abbiegelicht ein" ); break;
        default: putValue( eAFS_Abbiegelicht_re_AnfT, "!?!" );
    }
}

on envVar eAFS_Abbiegelicht_Dimm_AnfS
{
    switch (getValue( eAFS_Abbiegelicht_Dimm_AnfS ))
    {
        case  0: putValue( eAFS_Abbiegelicht_Dimm_AnfT, "Dimmung angefordert" ); break;
        case  1: putValue( eAFS_Abbiegelicht_Dimm_AnfT, "keine Dimmung" ); break;
        default: putValue( eAFS_Abbiegelicht_Dimm_AnfT, "!?!" );
    }
}

on envVar eAFS_Verfuegbarkeit_GLWS
{
    switch (getValue( eAFS_Verfuegbarkeit_GLWS ))
    {
        case  0: putValue( eAFS_Verfuegbarkeit_GLWT, "GLW nicht verfuegbar" ); break;
        case  1: putValue( eAFS_Verfuegbarkeit_GLWT, "GLW verfuegbar" ); break;
        default: putValue( eAFS_Verfuegbarkeit_GLWT, "!?!" );
    }
}

on envVar eAFS_Status_adaptive_LVS
{
    switch (getValue( eAFS_Status_adaptive_LVS ))
    {
        case  0: putValue( eAFS_Status_adaptive_LVT, "adaptive Lichtverteilung aus" ); break;
        case  1: putValue( eAFS_Status_adaptive_LVT, "adaptive Lichtverteilung an" ); break;
        default: putValue( eAFS_Status_adaptive_LVT, "!?!" );
    }
}

on envVar eAFS_Fernlicht_li_defektS
{
    switch (getValue( eAFS_Fernlicht_li_defektS ))
    {
        case  0: putValue( eAFS_Fernlicht_li_defektT, "Fernlicht in Ordnung" ); break;
        case  1: putValue( eAFS_Fernlicht_li_defektT, "Fernlicht defekt" ); break;
        default: putValue( eAFS_Fernlicht_li_defektT, "!?!" );
    }
}

on envVar eAFS_Fernlicht_re_defektS
{
    switch (getValue( eAFS_Fernlicht_re_defektS ))
    {
        case  0: putValue( eAFS_Fernlicht_re_defektT, "Fernlicht in Ordnung" ); break;
        case  1: putValue( eAFS_Fernlicht_re_defektT, "Fernlicht defekt" ); break;
        default: putValue( eAFS_Fernlicht_re_defektT, "!?!" );
    }
}

on envVar eAFS_Fernlicht_StatusS
{
    switch (getValue( eAFS_Fernlicht_StatusS ))
    {
        case  0: putValue( eAFS_Fernlicht_StatusT, "Fernlicht aus" ); break;
        case  1: putValue( eAFS_Fernlicht_StatusT, "Fernlicht ein" ); break;
        default: putValue( eAFS_Fernlicht_StatusT, "!?!" );
    }
}

on envVar eAFS_LampeS
{
    switch (getValue( eAFS_LampeS ))
    {
        case  0: putValue( eAFS_LampeT, "Aus" ); break;
        case  1: putValue( eAFS_LampeT, "Ein" ); break;
        default: putValue( eAFS_LampeT, "!?!" );
    }
}

on envVar eLWR_LampeS
{
    switch (getValue( eLWR_LampeS ))
    {
        case  0: putValue( eLWR_LampeT, "LWR Fehlerlampe aus" ); break;
        case  1: putValue( eLWR_LampeT, "LWR Fehlerlampe ein" ); break;
        default: putValue( eLWR_LampeT, "!?!" );
    }
}

on envVar eAFS_FehlertextS
{
    switch (getValue( eAFS_FehlertextS ))
    {
        case  0: putValue( eAFS_FehlertextT, "kein Text" ); break;
        case  1: putValue( eAFS_FehlertextT, "AFS ohne Funktion" ); break;
        default: putValue( eAFS_FehlertextT, "!?!" );
    }
}

on envVar eAFS_LED_BlinkmodeS
{
    switch (getValue( eAFS_LED_BlinkmodeS ))
    {
        case  0: putValue( eAFS_LED_BlinkmodeT, "kein Blinkmode angefordert" ); break;
        case  1: putValue( eAFS_LED_BlinkmodeT, "Blinkmode angefordert" ); break;
        default: putValue( eAFS_LED_BlinkmodeT, "!?!" );
    }
}

on envVar eLWR_Touristenmodus_aktivS
{
    switch (getValue( eLWR_Touristenmodus_aktivS ))
    {
        case  0: putValue( eLWR_Touristenmodus_aktivT, "Touristenmodus inaktiv" ); break;
        case  1: putValue( eLWR_Touristenmodus_aktivT, "Touristenmodus aktiv" ); break;
        default: putValue( eLWR_Touristenmodus_aktivT, "!?!" );
    }
}

on envVar eAFS_Charisma_FahrPrS
{
    switch (getValue( eAFS_Charisma_FahrPrS ))
    {
        case  0: putValue( eAFS_Charisma_FahrPrT, "nicht belegt" ); break;
        case  1: putValue( eAFS_Charisma_FahrPrT, "Programm 1" ); break;
        case  2: putValue( eAFS_Charisma_FahrPrT, "Programm 2" ); break;
        case  3: putValue( eAFS_Charisma_FahrPrT, "Programm 3" ); break;
        case  4: putValue( eAFS_Charisma_FahrPrT, "Programm 4" ); break;
        case  5: putValue( eAFS_Charisma_FahrPrT, "Programm 5" ); break;
        case  6: putValue( eAFS_Charisma_FahrPrT, "Programm 6" ); break;
        case  7: putValue( eAFS_Charisma_FahrPrT, "Programm 7" ); break;
        default: putValue( eAFS_Charisma_FahrPrT, "!?!" );
    }
}

on envVar eAFS_Charisma_StatusS
{
    switch (getValue( eAFS_Charisma_StatusS ))
    {
        case  0: putValue( eAFS_Charisma_StatusT, "Init" ); break;
        case  1: putValue( eAFS_Charisma_StatusT, "verfuegbar" ); break;
        case  2: putValue( eAFS_Charisma_StatusT, "nicht verfuegbar" ); break;
        default: putValue( eAFS_Charisma_StatusT, "!?!" );
    }
}

on envVar eAFS_Charisma_UmschaltungS
{
    switch (getValue( eAFS_Charisma_UmschaltungS ))
    {
        case  0: putValue( eAFS_Charisma_UmschaltungT, "Idle" ); break;
        case  1: putValue( eAFS_Charisma_UmschaltungT, "Erkennung Umschaltaufforderung" ); break;
        case  2: putValue( eAFS_Charisma_UmschaltungT, "Steuerbotschaft nicht definiert" ); break;
        case  3: putValue( eAFS_Charisma_UmschaltungT, "Umschaltung verzoegert" ); break;
        default: putValue( eAFS_Charisma_UmschaltungT, "!?!" );
    }
}

on envVar eAFS_AllwetterlichtS
{
    switch (getValue( eAFS_AllwetterlichtS ))
    {
        case  0: putValue( eAFS_AllwetterlichtT, "Allwetterlicht nicht aktiv" ); break;
        case  1: putValue( eAFS_AllwetterlichtT, "Allwetterlicht aktiv" ); break;
        default: putValue( eAFS_AllwetterlichtT, "!?!" );
    }
}

on envVar eLWR_Touristenmodus_verbautS
{
    switch (getValue( eLWR_Touristenmodus_verbautS ))
    {
        case  0: putValue( eLWR_Touristenmodus_verbautT, "Touristenmodus nicht verbaut" ); break;
        case  1: putValue( eLWR_Touristenmodus_verbautT, "Touristenmodus verbaut" ); break;
        default: putValue( eLWR_Touristenmodus_verbautT, "!?!" );
    }
}

on envVar eAFS_adaptive_LV_verbautS
{
    switch (getValue( eAFS_adaptive_LV_verbautS ))
    {
        case  0: putValue( eAFS_adaptive_LV_verbautT, "adaptive Lichtverteilung nicht verbaut" ); break;
        case  1: putValue( eAFS_adaptive_LV_verbautT, "adaptive Lichtverteilung verbaut" ); break;
        default: putValue( eAFS_adaptive_LV_verbautT, "!?!" );
    }
}

on envVar eLWR_Reisemodus_TexteS
{
    switch (getValue( eLWR_Reisemodus_TexteS ))
    {
        case  0: putValue( eLWR_Reisemodus_TexteT, "keine Anzeige" ); break;
        case  1: putValue( eLWR_Reisemodus_TexteT, "Umschaltung auf linksverkehr" ); break;
        case  2: putValue( eLWR_Reisemodus_TexteT, "Umschaltung auf rechtsverkehr" ); break;
        default: putValue( eLWR_Reisemodus_TexteT, "!?!" );
    }
}

on envVar eAFS_Ersatzlicht_LinksS
{
    switch (getValue( eAFS_Ersatzlicht_LinksS ))
    {
        case  0: putValue( eAFS_Ersatzlicht_LinksT, "keine Ersatzlichtfunktion links" ); break;
        case  1: putValue( eAFS_Ersatzlicht_LinksT, "Ersatzlichtfunktion links" ); break;
        default: putValue( eAFS_Ersatzlicht_LinksT, "!?!" );
    }
}

on envVar eAFS_Ersatzlicht_RechtsS
{
    switch (getValue( eAFS_Ersatzlicht_RechtsS ))
    {
        case  0: putValue( eAFS_Ersatzlicht_RechtsT, "keine Ersatzlichtfunktion rechts" ); break;
        case  1: putValue( eAFS_Ersatzlicht_RechtsT, "Ersatzlichtfunktion rechts" ); break;
        default: putValue( eAFS_Ersatzlicht_RechtsT, "!?!" );
    }
}

on envVar eLWR_AFS_GrundeinstellungS
{
    switch (getValue( eLWR_AFS_GrundeinstellungS ))
    {
        case  0: putValue( eLWR_AFS_GrundeinstellungT, "Grundeinstellung nicht erfolgt" ); break;
        case  1: putValue( eLWR_AFS_GrundeinstellungT, "Grundeinstellung erfolgt" ); break;
        default: putValue( eLWR_AFS_GrundeinstellungT, "!?!" );
    }
}

on envVar eLWR_AFS_ParametrisierungS
{
    switch (getValue( eLWR_AFS_ParametrisierungS ))
    {
        case  0: putValue( eLWR_AFS_ParametrisierungT, "Parametrisierung nicht erfolgt" ); break;
        case  1: putValue( eLWR_AFS_ParametrisierungT, "Parametrisierung erfolgt" ); break;
        default: putValue( eLWR_AFS_ParametrisierungT, "!?!" );
    }
}

on envVar eLWR_InitialisierungslaufS
{
    switch (getValue( eLWR_InitialisierungslaufS ))
    {
        case  0: putValue( eLWR_InitialisierungslaufT, "Initialisierungslauf nicht erfolgt" ); break;
        case  1: putValue( eLWR_InitialisierungslaufT, "Initialisierungslauf erfolgt" ); break;
        default: putValue( eLWR_InitialisierungslaufT, "!?!" );
    }
}

on envVar eLWR_SicherheitspositionS
{
    switch (getValue( eLWR_SicherheitspositionS ))
    {
        case  0: putValue( eLWR_SicherheitspositionT, "Sicherheitsposition aus" ); break;
        case  1: putValue( eLWR_SicherheitspositionT, "Sicherheitsposition ein" ); break;
        default: putValue( eLWR_SicherheitspositionT, "!?!" );
    }
}

on envVar eLWR_ModusS
{
    switch (getValue( eLWR_ModusS ))
    {
        case  0: putValue( eLWR_ModusT, "LWR statisch" ); break;
        case  1: putValue( eLWR_ModusT, "LWR dynamisch" ); break;
        default: putValue( eLWR_ModusT, "!?!" );
    }
}

on envVar eLWR_KD_FehlerS
{
    switch (getValue( eLWR_KD_FehlerS ))
    {
        case  0: putValue( eLWR_KD_FehlerT, "kein KD Fehler" ); break;
        case  1: putValue( eLWR_KD_FehlerT, "KD Fehler" ); break;
        default: putValue( eLWR_KD_FehlerT, "!?!" );
    }
}

on envVar eLWR_Pos_Schrittmotor254
{
    if( getValue( this ))
    {
    _LWR_Pos_Schrittmotor = getValue( eLWR_Pos_SchrittmotorS );
    putValue( eLWR_Pos_SchrittmotorS, 101.6 );
    }
    else if( getValue( eLWR_Pos_SchrittmotorS ) == 101.6)
    {
    if( _LWR_Pos_Schrittmotor != 101.6)
      putValue( eLWR_Pos_SchrittmotorS, _LWR_Pos_Schrittmotor );
    else
      putValue( eLWR_Pos_SchrittmotorS, 0 );
    }

}

on envVar eLWR_Pos_Schrittmotor255
{
    if( getValue( this ))
    {
    _LWR_Pos_Schrittmotor = getValue( eLWR_Pos_SchrittmotorS );
    putValue( eLWR_Pos_SchrittmotorS, 102 );
    }
    else if( getValue( eLWR_Pos_SchrittmotorS ) == 102)
    {
    if( _LWR_Pos_Schrittmotor != 102)
      putValue( eLWR_Pos_SchrittmotorS, _LWR_Pos_Schrittmotor );
    else
      putValue( eLWR_Pos_SchrittmotorS, 101.6 );
    }

}

on envVar eLWR_Pos_SchrittmotorS
{
    putValue( eLWR_Pos_Schrittmotor254, getValue( eLWR_Pos_SchrittmotorS ) == 101.6 );
    putValue( eLWR_Pos_Schrittmotor255, getValue( eLWR_Pos_SchrittmotorS ) == 102 );
}

on envVar eLWR_Hoehenwert_VL254
{
    if( getValue( this ))
    {
    _LWR_Hoehenwert_VL = getValue( eLWR_Hoehenwert_VLS );
    putValue( eLWR_Hoehenwert_VLS, 127 );
    }
    else if( getValue( eLWR_Hoehenwert_VLS ) == 127)
    {
    if( _LWR_Hoehenwert_VL != 127)
      putValue( eLWR_Hoehenwert_VLS, _LWR_Hoehenwert_VL );
    else
      putValue( eLWR_Hoehenwert_VLS, 0 );
    }

}

on envVar eLWR_Hoehenwert_VL255
{
    if( getValue( this ))
    {
    _LWR_Hoehenwert_VL = getValue( eLWR_Hoehenwert_VLS );
    putValue( eLWR_Hoehenwert_VLS, 128 );
    }
    else if( getValue( eLWR_Hoehenwert_VLS ) == 128)
    {
    if( _LWR_Hoehenwert_VL != 128)
      putValue( eLWR_Hoehenwert_VLS, _LWR_Hoehenwert_VL );
    else
      putValue( eLWR_Hoehenwert_VLS, 127 );
    }

}

on envVar eLWR_Hoehenwert_VLS
{
    putValue( eLWR_Hoehenwert_VL254, getValue( eLWR_Hoehenwert_VLS ) == 127 );
    putValue( eLWR_Hoehenwert_VL255, getValue( eLWR_Hoehenwert_VLS ) == 128 );
}

on envVar eLWR_Hoehenwert_HL254
{
    if( getValue( this ))
    {
    _LWR_Hoehenwert_HL = getValue( eLWR_Hoehenwert_HLS );
    putValue( eLWR_Hoehenwert_HLS, 127 );
    }
    else if( getValue( eLWR_Hoehenwert_HLS ) == 127)
    {
    if( _LWR_Hoehenwert_HL != 127)
      putValue( eLWR_Hoehenwert_HLS, _LWR_Hoehenwert_HL );
    else
      putValue( eLWR_Hoehenwert_HLS, 0 );
    }

}

on envVar eLWR_Hoehenwert_HL255
{
    if( getValue( this ))
    {
    _LWR_Hoehenwert_HL = getValue( eLWR_Hoehenwert_HLS );
    putValue( eLWR_Hoehenwert_HLS, 128 );
    }
    else if( getValue( eLWR_Hoehenwert_HLS ) == 128)
    {
    if( _LWR_Hoehenwert_HL != 128)
      putValue( eLWR_Hoehenwert_HLS, _LWR_Hoehenwert_HL );
    else
      putValue( eLWR_Hoehenwert_HLS, 127 );
    }

}

on envVar eLWR_Hoehenwert_HLS
{
    putValue( eLWR_Hoehenwert_HL254, getValue( eLWR_Hoehenwert_HLS ) == 127 );
    putValue( eLWR_Hoehenwert_HL255, getValue( eLWR_Hoehenwert_HLS ) == 128 );
}

on envVar eMFL_Tastencode_1S
{
    switch (getValue( eMFL_Tastencode_1S ))
    {
        case  0: putValue( eMFL_Tastencode_1T, "Key Released  No Key" ); break;
        case  1: putValue( eMFL_Tastencode_1T, "Menu" ); break;
        case  2: putValue( eMFL_Tastencode_1T, "Menu Up  Next Screen" ); break;
        case  3: putValue( eMFL_Tastencode_1T, "Menu Down  Previous Screen" ); break;
        case  4: putValue( eMFL_Tastencode_1T, "Up" ); break;
        case  5: putValue( eMFL_Tastencode_1T, "Down" ); break;
        case  6: putValue( eMFL_Tastencode_1T, "Up  Down ThumbWheel" ); break;
        case  7: putValue( eMFL_Tastencode_1T, "OK  ThumbWheel Button" ); break;
        case  8: putValue( eMFL_Tastencode_1T, "Cancel  Escape" ); break;
        case 16: putValue( eMFL_Tastencode_1T, "Volume Up" ); break;
        case 17: putValue( eMFL_Tastencode_1T, "Volume Down" ); break;
        case 18: putValue( eMFL_Tastencode_1T, "Volume Up  Down ThumbWheel" ); break;
        case 19: putValue( eMFL_Tastencode_1T, "Volume ThumbWheel Button" ); break;
        case 20: putValue( eMFL_Tastencode_1T, "Audio Source" ); break;
        case 21: putValue( eMFL_Tastencode_1T, "Arrow A Up  Right" ); break;
        case 22: putValue( eMFL_Tastencode_1T, "Arrow A Down  Left" ); break;
        case 23: putValue( eMFL_Tastencode_1T, "Arrow B Up  Right" ); break;
        case 24: putValue( eMFL_Tastencode_1T, "Arrow B Down  Left" ); break;
        case 25: putValue( eMFL_Tastencode_1T, "PTT  PushToTalk" ); break;
        case 26: putValue( eMFL_Tastencode_1T, "PPT Cancel" ); break;
        case 27: putValue( eMFL_Tastencode_1T, "Route Info" ); break;
        case 28: putValue( eMFL_Tastencode_1T, "Hook" ); break;
        case 29: putValue( eMFL_Tastencode_1T, "Hang Up" ); break;
        case 30: putValue( eMFL_Tastencode_1T, "Off Hook" ); break;
        case 31: putValue( eMFL_Tastencode_1T, "Light On  Off" ); break;
        case 32: putValue( eMFL_Tastencode_1T, "Mute" ); break;
        case 33: putValue( eMFL_Tastencode_1T, "Joker1" ); break;
        case 34: putValue( eMFL_Tastencode_1T, "Joker2" ); break;
        case 240: putValue( eMFL_Tastencode_1T, "Startup Reset" ); break;
        default: putValue( eMFL_Tastencode_1T, "!?!" );
    }
}

on envVar eMFL_Tastencode_2S
{
    switch (getValue( eMFL_Tastencode_2S ))
    {
        case  0: putValue( eMFL_Tastencode_2T, "Key Released  No Key" ); break;
        case  1: putValue( eMFL_Tastencode_2T, "Menu" ); break;
        case  2: putValue( eMFL_Tastencode_2T, "Menu Up  Next Screen" ); break;
        case  3: putValue( eMFL_Tastencode_2T, "Menu Down  Previous Screen" ); break;
        case  4: putValue( eMFL_Tastencode_2T, "Up" ); break;
        case  5: putValue( eMFL_Tastencode_2T, "Down" ); break;
        case  6: putValue( eMFL_Tastencode_2T, "Up  Down ThumbWheel" ); break;
        case  7: putValue( eMFL_Tastencode_2T, "OK  ThumbWheel Button" ); break;
        case  8: putValue( eMFL_Tastencode_2T, "Cancel  Escape" ); break;
        case 16: putValue( eMFL_Tastencode_2T, "Volume Up" ); break;
        case 17: putValue( eMFL_Tastencode_2T, "Volume Down" ); break;
        case 18: putValue( eMFL_Tastencode_2T, "Volume Up  Down ThumbWheel" ); break;
        case 19: putValue( eMFL_Tastencode_2T, "Volume ThumbWheel Button" ); break;
        case 20: putValue( eMFL_Tastencode_2T, "Audio Source" ); break;
        case 21: putValue( eMFL_Tastencode_2T, "Arrow A Up  Right" ); break;
        case 22: putValue( eMFL_Tastencode_2T, "Arrow A Down  Left" ); break;
        case 23: putValue( eMFL_Tastencode_2T, "Arrow B Up  Right" ); break;
        case 24: putValue( eMFL_Tastencode_2T, "Arrow B Down  Left" ); break;
        case 25: putValue( eMFL_Tastencode_2T, "PPT  PushToTalk" ); break;
        case 26: putValue( eMFL_Tastencode_2T, "PPT Cancel" ); break;
        case 27: putValue( eMFL_Tastencode_2T, "Route Info" ); break;
        case 28: putValue( eMFL_Tastencode_2T, "Hook" ); break;
        case 29: putValue( eMFL_Tastencode_2T, "Hang Up" ); break;
        case 30: putValue( eMFL_Tastencode_2T, "Off Hook" ); break;
        case 31: putValue( eMFL_Tastencode_2T, "Light On  Off" ); break;
        case 32: putValue( eMFL_Tastencode_2T, "Mute" ); break;
        case 33: putValue( eMFL_Tastencode_2T, "Joker1" ); break;
        case 34: putValue( eMFL_Tastencode_2T, "Joker2" ); break;
        case 240: putValue( eMFL_Tastencode_2T, "Startup Reset" ); break;
        default: putValue( eMFL_Tastencode_2T, "!?!" );
    }
}

on envVar eMFL_Eventcode_1S
{
    switch (getValue( eMFL_Eventcode_1S ))
    {
        case  0: putValue( eMFL_Eventcode_1T, "Walze: no Event     | Taste: no Event" ); break;
        case  1: putValue( eMFL_Eventcode_1T, "Walze: 1 Tick  up   | Taste: pressed" ); break;
        case  2: putValue( eMFL_Eventcode_1T, "Walze: 2 Ticks up   |" ); break;
        case  3: putValue( eMFL_Eventcode_1T, "Walze: 3 Ticks up   | Taste: double-click" ); break;
        case  4: putValue( eMFL_Eventcode_1T, "Walze: 4 Ticks up   | Taste: long-press 1 [800ms]" ); break;
        case  5: putValue( eMFL_Eventcode_1T, "Walze: 5 Ticks up   | Taste: long-press 2 [2s]" ); break;
        case  6: putValue( eMFL_Eventcode_1T, "Walze: 6 Ticks up   | Taste: long-press 3 [3s]" ); break;
        case  7: putValue( eMFL_Eventcode_1T, "Walze: 7 Ticks up   |" ); break;
        case  9: putValue( eMFL_Eventcode_1T, "Walze: 7 Ticks down |" ); break;
        case 10: putValue( eMFL_Eventcode_1T, "Walze: 6 Ticks down |" ); break;
        case 11: putValue( eMFL_Eventcode_1T, "Walze: 5 Ticks down |" ); break;
        case 12: putValue( eMFL_Eventcode_1T, "Walze: 4 Ticks down |" ); break;
        case 13: putValue( eMFL_Eventcode_1T, "Walze: 3 Ticks down |" ); break;
        case 14: putValue( eMFL_Eventcode_1T, "Walze: 2 Ticks down |" ); break;
        case 15: putValue( eMFL_Eventcode_1T, "Walze: 1 Tick  down |" ); break;
        default: putValue( eMFL_Eventcode_1T, "!?!" );
    }
}

on envVar eMFL_Eventcode_2S
{
    switch (getValue( eMFL_Eventcode_2S ))
    {
        case  0: putValue( eMFL_Eventcode_2T, "Walze: no Event     | Taste: no Event" ); break;
        case  1: putValue( eMFL_Eventcode_2T, "Walze: 1 Tick  up   | Taste: pressed" ); break;
        case  2: putValue( eMFL_Eventcode_2T, "Walze: 2 Ticks up   |" ); break;
        case  3: putValue( eMFL_Eventcode_2T, "Walze: 3 Ticks up   | Taste: double-click" ); break;
        case  4: putValue( eMFL_Eventcode_2T, "Walze: 4 Ticks up   | Taste: long-press 1 [800ms]" ); break;
        case  5: putValue( eMFL_Eventcode_2T, "Walze: 5 Ticks up   | Taste: long-press 2 [2s]" ); break;
        case  6: putValue( eMFL_Eventcode_2T, "Walze: 6 Ticks up   | Taste: long-press 3 [3s]" ); break;
        case  7: putValue( eMFL_Eventcode_2T, "Walze: 7 Ticks up   |" ); break;
        case  9: putValue( eMFL_Eventcode_2T, "Walze: 7 Ticks down |" ); break;
        case 10: putValue( eMFL_Eventcode_2T, "Walze: 6 Ticks down |" ); break;
        case 11: putValue( eMFL_Eventcode_2T, "Walze: 5 Ticks down |" ); break;
        case 12: putValue( eMFL_Eventcode_2T, "Walze: 4 Ticks down |" ); break;
        case 13: putValue( eMFL_Eventcode_2T, "Walze: 3 Ticks down |" ); break;
        case 14: putValue( eMFL_Eventcode_2T, "Walze: 2 Ticks down |" ); break;
        case 15: putValue( eMFL_Eventcode_2T, "Walze: 1 Tick  down |" ); break;
        default: putValue( eMFL_Eventcode_2T, "!?!" );
    }
}

on envVar eMFL_MarkeS
{
    switch (getValue( eMFL_MarkeS ))
    {
        case  0: putValue( eMFL_MarkeT, "VW" ); break;
        case  1: putValue( eMFL_MarkeT, "Audi" ); break;
        case  2: putValue( eMFL_MarkeT, "Seat" ); break;
        case  3: putValue( eMFL_MarkeT, "Skoda" ); break;
        case  4: putValue( eMFL_MarkeT, "VW Nutzf" ); break;
        case  5: putValue( eMFL_MarkeT, "Bugatti" ); break;
        case  6: putValue( eMFL_MarkeT, "Lamborghini" ); break;
        case  7: putValue( eMFL_MarkeT, "Bentley" ); break;
        case  8: putValue( eMFL_MarkeT, "Rolls Royce" ); break;
        case  9: putValue( eMFL_MarkeT, "Quattro" ); break;
        case 10: putValue( eMFL_MarkeT, "kein Hersteller 1" ); break;
        case 11: putValue( eMFL_MarkeT, "kein Hersteller 2" ); break;
        case 12: putValue( eMFL_MarkeT, "kein Hersteller 3" ); break;
        case 13: putValue( eMFL_MarkeT, "kein Hersteller 4" ); break;
        case 14: putValue( eMFL_MarkeT, "Ford" ); break;
        case 15: putValue( eMFL_MarkeT, "Porsche" ); break;
        default: putValue( eMFL_MarkeT, "!?!" );
    }
}

on envVar eMO_IstgangS
{
    switch (getValue( eMO_IstgangS ))
    {
        case  0: putValue( eMO_IstgangT, "kein Gang eingelegt" ); break;
        case  1: putValue( eMO_IstgangT, "Gang 1" ); break;
        case  2: putValue( eMO_IstgangT, "Gang 2" ); break;
        case  3: putValue( eMO_IstgangT, "Gang 3" ); break;
        case  4: putValue( eMO_IstgangT, "Gang 4" ); break;
        case  5: putValue( eMO_IstgangT, "Gang 5" ); break;
        case  6: putValue( eMO_IstgangT, "Gang 6" ); break;
        default: putValue( eMO_IstgangT, "!?!" );
    }
}

on envVar eMO_SollgangS
{
    switch (getValue( eMO_SollgangS ))
    {
        case  0: putValue( eMO_SollgangT, "keine Empfehlung" ); break;
        case  1: putValue( eMO_SollgangT, "Gang 1" ); break;
        case  2: putValue( eMO_SollgangT, "Gang 2" ); break;
        case  3: putValue( eMO_SollgangT, "Gang 3" ); break;
        case  4: putValue( eMO_SollgangT, "Gang 4" ); break;
        case  5: putValue( eMO_SollgangT, "Gang 5" ); break;
        case  6: putValue( eMO_SollgangT, "Gang 6" ); break;
        default: putValue( eMO_SollgangT, "!?!" );
    }
}

on envVar eMO_Schaltempf_verfbarS
{
    switch (getValue( eMO_Schaltempf_verfbarS ))
    {
        case  0: putValue( eMO_Schaltempf_verfbarT, "nicht verfuegbar" ); break;
        case  1: putValue( eMO_Schaltempf_verfbarT, "verfuegbar" ); break;
        default: putValue( eMO_Schaltempf_verfbarT, "!?!" );
    }
}

on envVar eMO_KVS_UeberlaufS
{
    switch (getValue( eMO_KVS_UeberlaufS ))
    {
        case  0: putValue( eMO_KVS_UeberlaufT, "kein Ueberlauf" ); break;
        case  1: putValue( eMO_KVS_UeberlaufT, "Kraftstoffverbrauchsignale mindestens 1x übergelaufen" ); break;
        default: putValue( eMO_KVS_UeberlaufT, "!?!" );
    }
}

on envVar eMO_Oeldruck255
{
    if( getValue( this ))
    {
    _MO_Oeldruck = getValue( eMO_OeldruckS );
    putValue( eMO_OeldruckS, 10.2 );
    }
    else if( getValue( eMO_OeldruckS ) == 10.2)
    {
    if( _MO_Oeldruck != 10.2)
      putValue( eMO_OeldruckS, _MO_Oeldruck );
    else
      putValue( eMO_OeldruckS, 10.16 );
    }

}

on envVar eMO_OeldruckS
{
    putValue( eMO_Oeldruck255, getValue( eMO_OeldruckS ) == 10.2 );
}

on envVar eMO_Anzeigedrehz4095
{
    if( getValue( this ))
    {
    _MO_Anzeigedrehz = getValue( eMO_AnzeigedrehzS );
    putValue( eMO_AnzeigedrehzS, 12285 );
    }
    else if( getValue( eMO_AnzeigedrehzS ) == 12285)
    {
    if( _MO_Anzeigedrehz != 12285)
      putValue( eMO_AnzeigedrehzS, _MO_Anzeigedrehz );
    else
      putValue( eMO_AnzeigedrehzS, 0 );
    }

}

on envVar eMO_AnzeigedrehzS
{
    putValue( eMO_Anzeigedrehz4095, getValue( eMO_AnzeigedrehzS ) == 12285 );
}

on envVar eMO_Ladedruck511
{
    if( getValue( this ))
    {
    _MO_Ladedruck = getValue( eMO_LadedruckS );
    putValue( eMO_LadedruckS, 5.11 );
    }
    else if( getValue( eMO_LadedruckS ) == 5.11)
    {
    if( _MO_Ladedruck != 5.11)
      putValue( eMO_LadedruckS, _MO_Ladedruck );
    else
      putValue( eMO_LadedruckS, 0 );
    }

}

on envVar eMO_LadedruckS
{
    putValue( eMO_Ladedruck511, getValue( eMO_LadedruckS ) == 5.11 );
}

on envVar eMO_QBit_Ansaugluft_TempS
{
    switch (getValue( eMO_QBit_Ansaugluft_TempS ))
    {
        case  0: putValue( eMO_QBit_Ansaugluft_TempT, "gueltiger Wert" ); break;
        case  1: putValue( eMO_QBit_Ansaugluft_TempT, "Ersatz Init oder Fehlerwert" ); break;
        default: putValue( eMO_QBit_Ansaugluft_TempT, "!?!" );
    }
}

on envVar eMO_QBit_Oel_TempS
{
    switch (getValue( eMO_QBit_Oel_TempS ))
    {
        case  0: putValue( eMO_QBit_Oel_TempT, "gueltiger Wert" ); break;
        case  1: putValue( eMO_QBit_Oel_TempT, "Ersatz Init oder Fehlerwert" ); break;
        default: putValue( eMO_QBit_Oel_TempT, "!?!" );
    }
}

on envVar eMO_QBit_Kuehlmittel_TempS
{
    switch (getValue( eMO_QBit_Kuehlmittel_TempS ))
    {
        case  0: putValue( eMO_QBit_Kuehlmittel_TempT, "gueltiger Wert" ); break;
        case  1: putValue( eMO_QBit_Kuehlmittel_TempT, "Ersatz Init oder Fehlerwert" ); break;
        default: putValue( eMO_QBit_Kuehlmittel_TempT, "!?!" );
    }
}

on envVar eMO_Stellgliedtest_Soundaktuator
{
    switch (getValue( eMO_Stellgliedtest_Soundaktuator ))
    {
        case  0: putValue( e00MO_Stellgliedtest_Soundaktuat, "kein Stellgliedtest" ); break;
        case  1: putValue( e00MO_Stellgliedtest_Soundaktuat, "Anforderung des Stellgliedtest" ); break;
        default: putValue( e00MO_Stellgliedtest_Soundaktuat, "!?!" );
    }
}

on envVar eMO_HYB_Fehler_HV_NetzS
{
    switch (getValue( eMO_HYB_Fehler_HV_NetzS ))
    {
        case  0: putValue( eMO_HYB_Fehler_HV_NetzT, "i O" ); break;
        case  1: putValue( eMO_HYB_Fehler_HV_NetzT, "kein generatorischer Betrieb moeglich" ); break;
        default: putValue( eMO_HYB_Fehler_HV_NetzT, "!?!" );
    }
}

on envVar eMO_aktives_GetriebeheizenS
{
    switch (getValue( eMO_aktives_GetriebeheizenS ))
    {
        case  0: putValue( eMO_aktives_GetriebeheizenT, "kein Ventil ansteuern" ); break;
        case  1: putValue( eMO_aktives_GetriebeheizenT, "Ventil muss angesteuert werden" ); break;
        default: putValue( eMO_aktives_GetriebeheizenT, "!?!" );
    }
}

on envVar eMO_Absperrventil_oeffnenS
{
    switch (getValue( eMO_Absperrventil_oeffnenS ))
    {
        case  0: putValue( eMO_Absperrventil_oeffnenT, "nicht verfuegbar" ); break;
        case  1: putValue( eMO_Absperrventil_oeffnenT, "Ansteuerung Ventil zulaessig" ); break;
        case  2: putValue( eMO_Absperrventil_oeffnenT, "Ventil oeffnen oder geoeffnet" ); break;
        case  3: putValue( eMO_Absperrventil_oeffnenT, "Ventil schliessen oder geschlossen" ); break;
        default: putValue( eMO_Absperrventil_oeffnenT, "!?!" );
    }
}

on envVar eMO_KennfeldkS
{
    switch (getValue( eMO_KennfeldkS ))
    {
        case  0: putValue( eMO_KennfeldkT, "keine Kennfeldkühlung vorhanden" ); break;
        case  1: putValue( eMO_KennfeldkT, "Kennfeldkühlung vorhanden" ); break;
        default: putValue( eMO_KennfeldkT, "!?!" );
    }
}

on envVar eMO_VersionsinfoS
{
    switch (getValue( eMO_VersionsinfoS ))
    {
        case  0: putValue( eMO_VersionsinfoT, "zum Projektbeginn 'aufgeräumter CAN'" ); break;
        case  1: putValue( eMO_VersionsinfoT, "Motor 03 mit 10ms" ); break;
        case 16: putValue( eMO_VersionsinfoT, "MQB mit neuer Momentenschnittstelle" ); break;
        default: putValue( eMO_VersionsinfoT, "!?!" );
    }
}

on envVar eMO_Getriebe_kuehlenS
{
    switch (getValue( eMO_Getriebe_kuehlenS ))
    {
        case  0: putValue( eMO_Getriebe_kuehlenT, "nicht kuehlen" ); break;
        case  1: putValue( eMO_Getriebe_kuehlenT, "kuehlen" ); break;
        default: putValue( eMO_Getriebe_kuehlenT, "!?!" );
    }
}

on envVar eMO_SpannungsAnfS
{
    switch (getValue( eMO_SpannungsAnfS ))
    {
        case  0: putValue( eMO_SpannungsAnfT, "keine Anforderung" ); break;
        case  1: putValue( eMO_SpannungsAnfT, "Anforderung" ); break;
        default: putValue( eMO_SpannungsAnfT, "!?!" );
    }
}

on envVar eMO_Ansaugluft_Temp254
{
    if( getValue( this ))
    {
    _MO_Ansaugluft_Temp = getValue( eMO_Ansaugluft_TempS );
    putValue( eMO_Ansaugluft_TempS, 142.5 );
    }
    else if( getValue( eMO_Ansaugluft_TempS ) == 142.5)
    {
    if( _MO_Ansaugluft_Temp != 142.5)
      putValue( eMO_Ansaugluft_TempS, _MO_Ansaugluft_Temp );
    else
      putValue( eMO_Ansaugluft_TempS, 0 );
    }

}

on envVar eMO_Ansaugluft_Temp255
{
    if( getValue( this ))
    {
    _MO_Ansaugluft_Temp = getValue( eMO_Ansaugluft_TempS );
    putValue( eMO_Ansaugluft_TempS, 143.25 );
    }
    else if( getValue( eMO_Ansaugluft_TempS ) == 143.25)
    {
    if( _MO_Ansaugluft_Temp != 143.25)
      putValue( eMO_Ansaugluft_TempS, _MO_Ansaugluft_Temp );
    else
      putValue( eMO_Ansaugluft_TempS, 142.5 );
    }

}

on envVar eMO_Ansaugluft_TempS
{
    putValue( eMO_Ansaugluft_Temp254, getValue( eMO_Ansaugluft_TempS ) == 142.5 );
    putValue( eMO_Ansaugluft_Temp255, getValue( eMO_Ansaugluft_TempS ) == 143.25 );
}

on envVar eMO_Oel_Temp254
{
    if( getValue( this ))
    {
    _MO_Oel_Temp = getValue( eMO_Oel_TempS );
    putValue( eMO_Oel_TempS, 194 );
    }
    else if( getValue( eMO_Oel_TempS ) == 194)
    {
    if( _MO_Oel_Temp != 194)
      putValue( eMO_Oel_TempS, _MO_Oel_Temp );
    else
      putValue( eMO_Oel_TempS, 0 );
    }

}

on envVar eMO_Oel_Temp255
{
    if( getValue( this ))
    {
    _MO_Oel_Temp = getValue( eMO_Oel_TempS );
    putValue( eMO_Oel_TempS, 195 );
    }
    else if( getValue( eMO_Oel_TempS ) == 195)
    {
    if( _MO_Oel_Temp != 195)
      putValue( eMO_Oel_TempS, _MO_Oel_Temp );
    else
      putValue( eMO_Oel_TempS, 194 );
    }

}

on envVar eMO_Oel_TempS
{
    putValue( eMO_Oel_Temp254, getValue( eMO_Oel_TempS ) == 194 );
    putValue( eMO_Oel_Temp255, getValue( eMO_Oel_TempS ) == 195 );
}

on envVar eMO_Kuehlmittel_Temp254
{
    if( getValue( this ))
    {
    _MO_Kuehlmittel_Temp = getValue( eMO_Kuehlmittel_TempS );
    putValue( eMO_Kuehlmittel_TempS, 142.5 );
    }
    else if( getValue( eMO_Kuehlmittel_TempS ) == 142.5)
    {
    if( _MO_Kuehlmittel_Temp != 142.5)
      putValue( eMO_Kuehlmittel_TempS, _MO_Kuehlmittel_Temp );
    else
      putValue( eMO_Kuehlmittel_TempS, 0 );
    }

}

on envVar eMO_Kuehlmittel_Temp255
{
    if( getValue( this ))
    {
    _MO_Kuehlmittel_Temp = getValue( eMO_Kuehlmittel_TempS );
    putValue( eMO_Kuehlmittel_TempS, 143.25 );
    }
    else if( getValue( eMO_Kuehlmittel_TempS ) == 143.25)
    {
    if( _MO_Kuehlmittel_Temp != 143.25)
      putValue( eMO_Kuehlmittel_TempS, _MO_Kuehlmittel_Temp );
    else
      putValue( eMO_Kuehlmittel_TempS, 142.5 );
    }

}

on envVar eMO_Kuehlmittel_TempS
{
    putValue( eMO_Kuehlmittel_Temp254, getValue( eMO_Kuehlmittel_TempS ) == 142.5 );
    putValue( eMO_Kuehlmittel_Temp255, getValue( eMO_Kuehlmittel_TempS ) == 143.25 );
}

on envVar eMO_Hoeheninfo255
{
    if( getValue( this ))
    {
    _MO_Hoeheninfo = getValue( eMO_HoeheninfoS );
    putValue( eMO_HoeheninfoS, 1.99155 );
    }
    else if( getValue( eMO_HoeheninfoS ) == 1.99155)
    {
    if( _MO_Hoeheninfo != 1.99155)
      putValue( eMO_HoeheninfoS, _MO_Hoeheninfo );
    else
      putValue( eMO_HoeheninfoS, 0 );
    }

}

on envVar eMO_HoeheninfoS
{
    putValue( eMO_Hoeheninfo255, getValue( eMO_HoeheninfoS ) == 1.99155 );
}

on envVar eMO_Heizungspumpenansteuerung15
{
    if( getValue( this ))
    {
    _MO_Heizungspumpenansteuerung = getValue( eMO_HeizungspumpenansteuerungS );
    putValue( eMO_HeizungspumpenansteuerungS, 150 );
    }
    else if( getValue( eMO_HeizungspumpenansteuerungS ) == 150)
    {
    if( _MO_Heizungspumpenansteuerung != 150)
      putValue( eMO_HeizungspumpenansteuerungS, _MO_Heizungspumpenansteuerung );
    else
      putValue( eMO_HeizungspumpenansteuerungS, 140 );
    }

}

on envVar eMO_HeizungspumpenansteuerungS
{
    putValue( eMO_Heizungspumpenansteuerung15, getValue( eMO_HeizungspumpenansteuerungS ) == 150 );
}

on envVar eSCR_Warnstufe_1S
{
    switch (getValue( eSCR_Warnstufe_1S ))
    {
        case  0: putValue( eSCR_Warnstufe_1T, "nicht aktiv" ); break;
        case  1: putValue( eSCR_Warnstufe_1T, "Warnstufe 1 aktiv" ); break;
        default: putValue( eSCR_Warnstufe_1T, "!?!" );
    }
}

on envVar eSCR_Warnstufe_2S
{
    switch (getValue( eSCR_Warnstufe_2S ))
    {
        case  0: putValue( eSCR_Warnstufe_2T, "nicht aktiv" ); break;
        case  1: putValue( eSCR_Warnstufe_2T, "Warnstufe 2 aktiv" ); break;
        default: putValue( eSCR_Warnstufe_2T, "!?!" );
    }
}

on envVar eSCR_AkustikS
{
    switch (getValue( eSCR_AkustikS ))
    {
        case  0: putValue( eSCR_AkustikT, "keine Akustik" ); break;
        case  1: putValue( eSCR_AkustikT, "Akustik 1" ); break;
        case  2: putValue( eSCR_AkustikT, "Akustik 2" ); break;
        case  3: putValue( eSCR_AkustikT, "Akustik bei Hinweis (VW)" ); break;
        default: putValue( eSCR_AkustikT, "!?!" );
    }
}

on envVar eMO_Kraftstofffilter_WasserS
{
    switch (getValue( eMO_Kraftstofffilter_WasserS ))
    {
        case  0: putValue( eMO_Kraftstofffilter_WasserT, "keine Anzeige" ); break;
        case  1: putValue( eMO_Kraftstofffilter_WasserT, "Abscheidevolumen erschoepft" ); break;
        default: putValue( eMO_Kraftstofffilter_WasserT, "!?!" );
    }
}

on envVar eSCR_SystemfehlerS
{
    switch (getValue( eSCR_SystemfehlerS ))
    {
        case  0: putValue( eSCR_SystemfehlerT, "Warnung nicht aktiv" ); break;
        case  1: putValue( eSCR_SystemfehlerT, "Warnung aktiv" ); break;
        default: putValue( eSCR_SystemfehlerT, "!?!" );
    }
}

on envVar eSCR_Inducement_StrategieS
{
    switch (getValue( eSCR_Inducement_StrategieS ))
    {
        case  0: putValue( eSCR_Inducement_StrategieT, "Restart Strategie" ); break;
        case  1: putValue( eSCR_Inducement_StrategieT, "Reduced Drivability Strategie" ); break;
        default: putValue( eSCR_Inducement_StrategieT, "!?!" );
    }
}

on envVar eMO_MKB_MUXS
{
    switch (getValue( eMO_MKB_MUXS ))
    {
        case  0: putValue( eMO_MKB_MUXT, "MKB 01" ); break;
        case  1: putValue( eMO_MKB_MUXT, "MKB 02" ); break;
        case  2: putValue( eMO_MKB_MUXT, "MKB 03" ); break;
        case  3: putValue( eMO_MKB_MUXT, "MKB 04" ); break;
        default: putValue( eMO_MKB_MUXT, "!?!" );
    }
}

on envVar eMO_MKB_01S
{
    switch (getValue( eMO_MKB_01S ))
    {
        case  0: putValue( eMO_MKB_01T, "Minus" ); break;
        case  1: putValue( eMO_MKB_01T, "A" ); break;
        case  2: putValue( eMO_MKB_01T, "B" ); break;
        case  3: putValue( eMO_MKB_01T, "C" ); break;
        case  4: putValue( eMO_MKB_01T, "D" ); break;
        case  5: putValue( eMO_MKB_01T, "E" ); break;
        case  6: putValue( eMO_MKB_01T, "F" ); break;
        case  7: putValue( eMO_MKB_01T, "G" ); break;
        case  8: putValue( eMO_MKB_01T, "H" ); break;
        case  9: putValue( eMO_MKB_01T, "I" ); break;
        case 10: putValue( eMO_MKB_01T, "J" ); break;
        case 11: putValue( eMO_MKB_01T, "K" ); break;
        case 12: putValue( eMO_MKB_01T, "L" ); break;
        case 13: putValue( eMO_MKB_01T, "M" ); break;
        case 14: putValue( eMO_MKB_01T, "N" ); break;
        case 15: putValue( eMO_MKB_01T, "O" ); break;
        case 16: putValue( eMO_MKB_01T, "P" ); break;
        case 17: putValue( eMO_MKB_01T, "Q" ); break;
        case 18: putValue( eMO_MKB_01T, "R" ); break;
        case 19: putValue( eMO_MKB_01T, "S" ); break;
        case 20: putValue( eMO_MKB_01T, "T" ); break;
        case 21: putValue( eMO_MKB_01T, "U" ); break;
        case 22: putValue( eMO_MKB_01T, "V" ); break;
        case 23: putValue( eMO_MKB_01T, "W" ); break;
        case 24: putValue( eMO_MKB_01T, "X" ); break;
        case 25: putValue( eMO_MKB_01T, "Y" ); break;
        case 26: putValue( eMO_MKB_01T, "Z" ); break;
        case 27: putValue( eMO_MKB_01T, "Leerzeichen" ); break;
        case 28: putValue( eMO_MKB_01T, "Leerzeichen" ); break;
        case 29: putValue( eMO_MKB_01T, "Leerzeichen" ); break;
        case 30: putValue( eMO_MKB_01T, "Leerzeichen" ); break;
        case 31: putValue( eMO_MKB_01T, "Unterstrich" ); break;
        default: putValue( eMO_MKB_01T, "!?!" );
    }
}

on envVar eMO_MKB_02S
{
    switch (getValue( eMO_MKB_02S ))
    {
        case  0: putValue( eMO_MKB_02T, "Minus" ); break;
        case  1: putValue( eMO_MKB_02T, "A" ); break;
        case  2: putValue( eMO_MKB_02T, "B" ); break;
        case  3: putValue( eMO_MKB_02T, "C" ); break;
        case  4: putValue( eMO_MKB_02T, "D" ); break;
        case  5: putValue( eMO_MKB_02T, "E" ); break;
        case  6: putValue( eMO_MKB_02T, "F" ); break;
        case  7: putValue( eMO_MKB_02T, "G" ); break;
        case  8: putValue( eMO_MKB_02T, "H" ); break;
        case  9: putValue( eMO_MKB_02T, "I" ); break;
        case 10: putValue( eMO_MKB_02T, "J" ); break;
        case 11: putValue( eMO_MKB_02T, "K" ); break;
        case 12: putValue( eMO_MKB_02T, "L" ); break;
        case 13: putValue( eMO_MKB_02T, "M" ); break;
        case 14: putValue( eMO_MKB_02T, "N" ); break;
        case 15: putValue( eMO_MKB_02T, "O" ); break;
        case 16: putValue( eMO_MKB_02T, "P" ); break;
        case 17: putValue( eMO_MKB_02T, "Q" ); break;
        case 18: putValue( eMO_MKB_02T, "R" ); break;
        case 19: putValue( eMO_MKB_02T, "S" ); break;
        case 20: putValue( eMO_MKB_02T, "T" ); break;
        case 21: putValue( eMO_MKB_02T, "U" ); break;
        case 22: putValue( eMO_MKB_02T, "V" ); break;
        case 23: putValue( eMO_MKB_02T, "W" ); break;
        case 24: putValue( eMO_MKB_02T, "X" ); break;
        case 25: putValue( eMO_MKB_02T, "Y" ); break;
        case 26: putValue( eMO_MKB_02T, "Z" ); break;
        case 27: putValue( eMO_MKB_02T, "Leerzeichen" ); break;
        case 28: putValue( eMO_MKB_02T, "Leerzeichen" ); break;
        case 29: putValue( eMO_MKB_02T, "Leerzeichen" ); break;
        case 30: putValue( eMO_MKB_02T, "Leerzeichen" ); break;
        case 31: putValue( eMO_MKB_02T, "Unterstrich" ); break;
        default: putValue( eMO_MKB_02T, "!?!" );
    }
}

on envVar eMO_MKB_03S
{
    switch (getValue( eMO_MKB_03S ))
    {
        case  0: putValue( eMO_MKB_03T, "Minus" ); break;
        case  1: putValue( eMO_MKB_03T, "A" ); break;
        case  2: putValue( eMO_MKB_03T, "B" ); break;
        case  3: putValue( eMO_MKB_03T, "C" ); break;
        case  4: putValue( eMO_MKB_03T, "D" ); break;
        case  5: putValue( eMO_MKB_03T, "E" ); break;
        case  6: putValue( eMO_MKB_03T, "F" ); break;
        case  7: putValue( eMO_MKB_03T, "G" ); break;
        case  8: putValue( eMO_MKB_03T, "H" ); break;
        case  9: putValue( eMO_MKB_03T, "I" ); break;
        case 10: putValue( eMO_MKB_03T, "J" ); break;
        case 11: putValue( eMO_MKB_03T, "K" ); break;
        case 12: putValue( eMO_MKB_03T, "L" ); break;
        case 13: putValue( eMO_MKB_03T, "M" ); break;
        case 14: putValue( eMO_MKB_03T, "N" ); break;
        case 15: putValue( eMO_MKB_03T, "O" ); break;
        case 16: putValue( eMO_MKB_03T, "P" ); break;
        case 17: putValue( eMO_MKB_03T, "Q" ); break;
        case 18: putValue( eMO_MKB_03T, "R" ); break;
        case 19: putValue( eMO_MKB_03T, "S" ); break;
        case 20: putValue( eMO_MKB_03T, "T" ); break;
        case 21: putValue( eMO_MKB_03T, "U" ); break;
        case 22: putValue( eMO_MKB_03T, "V" ); break;
        case 23: putValue( eMO_MKB_03T, "W" ); break;
        case 24: putValue( eMO_MKB_03T, "X" ); break;
        case 25: putValue( eMO_MKB_03T, "Y" ); break;
        case 26: putValue( eMO_MKB_03T, "Z" ); break;
        case 27: putValue( eMO_MKB_03T, "Leerzeichen" ); break;
        case 28: putValue( eMO_MKB_03T, "Leerzeichen" ); break;
        case 29: putValue( eMO_MKB_03T, "Leerzeichen" ); break;
        case 30: putValue( eMO_MKB_03T, "Leerzeichen" ); break;
        case 31: putValue( eMO_MKB_03T, "Unterstrich" ); break;
        default: putValue( eMO_MKB_03T, "!?!" );
    }
}

on envVar eMO_MKB_04S
{
    switch (getValue( eMO_MKB_04S ))
    {
        case  0: putValue( eMO_MKB_04T, "Minus" ); break;
        case  1: putValue( eMO_MKB_04T, "A" ); break;
        case  2: putValue( eMO_MKB_04T, "B" ); break;
        case  3: putValue( eMO_MKB_04T, "C" ); break;
        case  4: putValue( eMO_MKB_04T, "D" ); break;
        case  5: putValue( eMO_MKB_04T, "E" ); break;
        case  6: putValue( eMO_MKB_04T, "F" ); break;
        case  7: putValue( eMO_MKB_04T, "G" ); break;
        case  8: putValue( eMO_MKB_04T, "H" ); break;
        case  9: putValue( eMO_MKB_04T, "I" ); break;
        case 10: putValue( eMO_MKB_04T, "J" ); break;
        case 11: putValue( eMO_MKB_04T, "K" ); break;
        case 12: putValue( eMO_MKB_04T, "L" ); break;
        case 13: putValue( eMO_MKB_04T, "M" ); break;
        case 14: putValue( eMO_MKB_04T, "N" ); break;
        case 15: putValue( eMO_MKB_04T, "O" ); break;
        case 16: putValue( eMO_MKB_04T, "P" ); break;
        case 17: putValue( eMO_MKB_04T, "Q" ); break;
        case 18: putValue( eMO_MKB_04T, "R" ); break;
        case 19: putValue( eMO_MKB_04T, "S" ); break;
        case 20: putValue( eMO_MKB_04T, "T" ); break;
        case 21: putValue( eMO_MKB_04T, "U" ); break;
        case 22: putValue( eMO_MKB_04T, "V" ); break;
        case 23: putValue( eMO_MKB_04T, "W" ); break;
        case 24: putValue( eMO_MKB_04T, "X" ); break;
        case 25: putValue( eMO_MKB_04T, "Y" ); break;
        case 26: putValue( eMO_MKB_04T, "Z" ); break;
        case 27: putValue( eMO_MKB_04T, "Leerzeichen" ); break;
        case 28: putValue( eMO_MKB_04T, "Leerzeichen" ); break;
        case 29: putValue( eMO_MKB_04T, "Leerzeichen" ); break;
        case 30: putValue( eMO_MKB_04T, "Leerzeichen" ); break;
        case 31: putValue( eMO_MKB_04T, "Unterstrich" ); break;
        default: putValue( eMO_MKB_04T, "!?!" );
    }
}

on envVar eMO_ITM_Kuehlmittel_Temp0
{
    if( getValue( this ))
    {
    _MO_ITM_Kuehlmittel_Temp = getValue( eMO_ITM_Kuehlmittel_TempS );
    putValue( eMO_ITM_Kuehlmittel_TempS, -48 );
    }
    else if( getValue( eMO_ITM_Kuehlmittel_TempS ) == -48)
    {
    if( _MO_ITM_Kuehlmittel_Temp != -48)
      putValue( eMO_ITM_Kuehlmittel_TempS, _MO_ITM_Kuehlmittel_Temp );
    else
      putValue( eMO_ITM_Kuehlmittel_TempS, -47.25 );
    }

}

on envVar eMO_ITM_Kuehlmittel_Temp2
{
    if( getValue( this ))
    {
    _MO_ITM_Kuehlmittel_Temp = getValue( eMO_ITM_Kuehlmittel_TempS );
    putValue( eMO_ITM_Kuehlmittel_TempS, -46.5 );
    }
    else if( getValue( eMO_ITM_Kuehlmittel_TempS ) == -46.5)
    {
    if( _MO_ITM_Kuehlmittel_Temp != -46.5)
      putValue( eMO_ITM_Kuehlmittel_TempS, _MO_ITM_Kuehlmittel_Temp );
    else
      putValue( eMO_ITM_Kuehlmittel_TempS, -47.25 );
    }

}

on envVar eMO_ITM_Kuehlmittel_TempS
{
    putValue( eMO_ITM_Kuehlmittel_Temp0, getValue( eMO_ITM_Kuehlmittel_TempS ) == -48 );
    putValue( eMO_ITM_Kuehlmittel_Temp2, getValue( eMO_ITM_Kuehlmittel_TempS ) == -46.5 );
}

on envVar eMO_E85_Sensor13
{
    if( getValue( this ))
    {
    _MO_E85_Sensor = getValue( eMO_E85_SensorS );
    putValue( eMO_E85_SensorS, 130 );
    }
    else if( getValue( eMO_E85_SensorS ) == 130)
    {
    if( _MO_E85_Sensor != 130)
      putValue( eMO_E85_SensorS, _MO_E85_Sensor );
    else
      putValue( eMO_E85_SensorS, 140 );
    }

}

on envVar eMO_E85_Sensor15
{
    if( getValue( this ))
    {
    _MO_E85_Sensor = getValue( eMO_E85_SensorS );
    putValue( eMO_E85_SensorS, 150 );
    }
    else if( getValue( eMO_E85_SensorS ) == 150)
    {
    if( _MO_E85_Sensor != 150)
      putValue( eMO_E85_SensorS, _MO_E85_Sensor );
    else
      putValue( eMO_E85_SensorS, 140 );
    }

}

on envVar eMO_E85_SensorS
{
    putValue( eMO_E85_Sensor13, getValue( eMO_E85_SensorS ) == 130 );
    putValue( eMO_E85_Sensor15, getValue( eMO_E85_SensorS ) == 150 );
}

on envVar eSCR_Anz_Motorstarts15
{
    if( getValue( this ))
    {
    _SCR_Anz_Motorstarts = getValue( eSCR_Anz_MotorstartsS );
    putValue( eSCR_Anz_MotorstartsS, 15 );
    }
    else if( getValue( eSCR_Anz_MotorstartsS ) == 15)
    {
    if( _SCR_Anz_Motorstarts != 15)
      putValue( eSCR_Anz_MotorstartsS, _SCR_Anz_Motorstarts );
    else
      putValue( eSCR_Anz_MotorstartsS, 0 );
    }

}

on envVar eSCR_Anz_MotorstartsS
{
    putValue( eSCR_Anz_Motorstarts15, getValue( eSCR_Anz_MotorstartsS ) == 15 );
}

on envVar eMO_CO2_Faktor0
{
    if( getValue( this ))
    {
    _MO_CO2_Faktor = getValue( eMO_CO2_FaktorS );
    putValue( eMO_CO2_FaktorS, 0 );
    }
    else if( getValue( eMO_CO2_FaktorS ) == 0)
    {
    if( _MO_CO2_Faktor != 0)
      putValue( eMO_CO2_FaktorS, _MO_CO2_Faktor );
    else
      putValue( eMO_CO2_FaktorS, 1 );
    }

}

on envVar eMO_CO2_Faktor4095
{
    if( getValue( this ))
    {
    _MO_CO2_Faktor = getValue( eMO_CO2_FaktorS );
    putValue( eMO_CO2_FaktorS, 4095 );
    }
    else if( getValue( eMO_CO2_FaktorS ) == 4095)
    {
    if( _MO_CO2_Faktor != 4095)
      putValue( eMO_CO2_FaktorS, _MO_CO2_Faktor );
    else
      putValue( eMO_CO2_FaktorS, 0 );
    }

}

on envVar eMO_CO2_FaktorS
{
    putValue( eMO_CO2_Faktor0, getValue( eMO_CO2_FaktorS ) == 0 );
    putValue( eMO_CO2_Faktor4095, getValue( eMO_CO2_FaktorS ) == 4095 );
}

on envVar eMO_StartStopp_StatusS
{
    switch (getValue( eMO_StartStopp_StatusS ))
    {
        case  0: putValue( eMO_StartStopp_StatusT, "System in diesem KL15 Zyklus nicht verfuegbar" ); break;
        case  1: putValue( eMO_StartStopp_StatusT, "System aktiv keine Freigabe durch StartStop Koordinator" ); break;
        case  2: putValue( eMO_StartStopp_StatusT, "System aktiv alle Freigaben liegen vor" ); break;
        case  3: putValue( eMO_StartStopp_StatusT, "System aktiv mindestens eine Freigabe fehlt" ); break;
        default: putValue( eMO_StartStopp_StatusT, "!?!" );
    }
}

on envVar eMO_Freig_RekuS
{
    switch (getValue( eMO_Freig_RekuS ))
    {
        case  0: putValue( eMO_Freig_RekuT, "Rekuperations-Modus aus" ); break;
        case  1: putValue( eMO_Freig_RekuT, "Empfehlung Spannungsanhebung" ); break;
        case  2: putValue( eMO_Freig_RekuT, "Empfehlung Spannungsabsenkung" ); break;
        case  3: putValue( eMO_Freig_RekuT, "Rekuperationsmodus aktiv, Spannungsvariation nicht notwendig" ); break;
        default: putValue( eMO_Freig_RekuT, "!?!" );
    }
}

on envVar eMO_Kl_75S
{
    switch (getValue( eMO_Kl_75S ))
    {
        case  0: putValue( eMO_Kl_75T, "aus" ); break;
        case  1: putValue( eMO_Kl_75T, "ein" ); break;
        default: putValue( eMO_Kl_75T, "!?!" );
    }
}

on envVar eMO_Kl_50S
{
    switch (getValue( eMO_Kl_50S ))
    {
        case  0: putValue( eMO_Kl_50T, "aus" ); break;
        case  1: putValue( eMO_Kl_50T, "KL50 ein Startausfuehrung Fahrer" ); break;
        default: putValue( eMO_Kl_50T, "!?!" );
    }
}

on envVar eMO_GangpositionS
{
    switch (getValue( eMO_GangpositionS ))
    {
        case  0: putValue( eMO_GangpositionT, "Gang N" ); break;
        case  1: putValue( eMO_GangpositionT, "Gang 1" ); break;
        case  2: putValue( eMO_GangpositionT, "Gang 2" ); break;
        case  3: putValue( eMO_GangpositionT, "Gang 3" ); break;
        case  4: putValue( eMO_GangpositionT, "Gang 4" ); break;
        case  5: putValue( eMO_GangpositionT, "Gang 5" ); break;
        case  6: putValue( eMO_GangpositionT, "Gang 6" ); break;
        case  7: putValue( eMO_GangpositionT, "Gang 7" ); break;
        case  8: putValue( eMO_GangpositionT, "Gang 8" ); break;
        case 12: putValue( eMO_GangpositionT, "Zwischengangstellung" ); break;
        case 13: putValue( eMO_GangpositionT, "Gang R" ); break;
        case 14: putValue( eMO_GangpositionT, "Istgang nicht definiert" ); break;
        case 15: putValue( eMO_GangpositionT, "Fehler" ); break;
        default: putValue( eMO_GangpositionT, "!?!" );
    }
}

on envVar eMO_StartStopp_FahrerwunschS
{
    switch (getValue( eMO_StartStopp_FahrerwunschS ))
    {
        case  0: putValue( eMO_StartStopp_FahrerwunschT, "Init" ); break;
        case  1: putValue( eMO_StartStopp_FahrerwunschT, "Stoppverbot durch Fahrer" ); break;
        case  2: putValue( eMO_StartStopp_FahrerwunschT, "Stoppfreigabe durch Fahrer" ); break;
        case  3: putValue( eMO_StartStopp_FahrerwunschT, "Stoppanforderung durch Fahrer" ); break;
        default: putValue( eMO_StartStopp_FahrerwunschT, "!?!" );
    }
}

on envVar eMO_HYB_FahrbereitschaftS
{
    switch (getValue( eMO_HYB_FahrbereitschaftS ))
    {
        case  0: putValue( eMO_HYB_FahrbereitschaftT, "keine Fahrbereitschaft" ); break;
        case  1: putValue( eMO_HYB_FahrbereitschaftT, "Fahrbereitschaft" ); break;
        default: putValue( eMO_HYB_FahrbereitschaftT, "!?!" );
    }
}

on envVar eMO_Ext_E_Fahrt_aktivS
{
    switch (getValue( eMO_Ext_E_Fahrt_aktivS ))
    {
        case  0: putValue( eMO_Ext_E_Fahrt_aktivT, "Rueckmeldung E Taster aus" ); break;
        case  1: putValue( eMO_Ext_E_Fahrt_aktivT, "Rueckmeldung E Taster ein" ); break;
        default: putValue( eMO_Ext_E_Fahrt_aktivT, "!?!" );
    }
}

on envVar eMO_Fahrer_bremstS
{
    switch (getValue( eMO_Fahrer_bremstS ))
    {
        case  0: putValue( eMO_Fahrer_bremstT, "kein Bremsen" ); break;
        case  1: putValue( eMO_Fahrer_bremstT, "Bremse betaetigt" ); break;
        default: putValue( eMO_Fahrer_bremstT, "!?!" );
    }
}

on envVar eMO_QBit_Fahrer_bremstS
{
    switch (getValue( eMO_QBit_Fahrer_bremstS ))
    {
        case  0: putValue( eMO_QBit_Fahrer_bremstT, "gueltiger Wert" ); break;
        case  1: putValue( eMO_QBit_Fahrer_bremstT, "Ersatz Init oder Fehlerwert" ); break;
        default: putValue( eMO_QBit_Fahrer_bremstT, "!?!" );
    }
}

on envVar eMO_BLSS
{
    switch (getValue( eMO_BLSS ))
    {
        case  0: putValue( eMO_BLST, "kein Bremsen" ); break;
        case  1: putValue( eMO_BLST, "Bremse betaetigt" ); break;
        default: putValue( eMO_BLST, "!?!" );
    }
}

on envVar eMO_Konsistenz_BremspedS
{
    switch (getValue( eMO_Konsistenz_BremspedS ))
    {
        case  0: putValue( eMO_Konsistenz_BremspedT, "Bremspedalinformation plausibel" ); break;
        case  1: putValue( eMO_Konsistenz_BremspedT, "Bremspedalinformation unplausibel" ); break;
        default: putValue( eMO_Konsistenz_BremspedT, "!?!" );
    }
}

on envVar eMO_Timeout_ESPS
{
    switch (getValue( eMO_Timeout_ESPS ))
    {
        case  0: putValue( eMO_Timeout_ESPT, "Empfang iO" ); break;
        case  1: putValue( eMO_Timeout_ESPT, "Timeout" ); break;
        default: putValue( eMO_Timeout_ESPT, "!?!" );
    }
}

on envVar eMO_Klima_EingrS
{
    switch (getValue( eMO_Klima_EingrS ))
    {
        case  0: putValue( eMO_Klima_EingrT, "kein Eingriff" ); break;
        case  1: putValue( eMO_Klima_EingrT, "Klimakompressor ausschalten" ); break;
        case  2: putValue( eMO_Klima_EingrT, "Klimakompressor Leistungsreduzierung" ); break;
        case  3: putValue( eMO_Klima_EingrT, "Klimakompressor aufgrund der Heissleuchtenvorwarnung ausschalten" ); break;
        default: putValue( eMO_Klima_EingrT, "!?!" );
    }
}

on envVar eMO_Aussp_AnlassS
{
    switch (getValue( eMO_Aussp_AnlassS ))
    {
        case  0: putValue( eMO_Aussp_AnlassT, "Motor laeuft nicht stabil" ); break;
        case  1: putValue( eMO_Aussp_AnlassT, "Anlasser ausspuren (Motor läuft stabil)" ); break;
        default: putValue( eMO_Aussp_AnlassT, "!?!" );
    }
}

on envVar eMO_Freig_AnlassS
{
    switch (getValue( eMO_Freig_AnlassS ))
    {
        case  0: putValue( eMO_Freig_AnlassT, "Start nicht zulaessig" ); break;
        case  1: putValue( eMO_Freig_AnlassT, "Startfreigabe" ); break;
        default: putValue( eMO_Freig_AnlassT, "!?!" );
    }
}

on envVar eMO_Kuppl_schalterS
{
    switch (getValue( eMO_Kuppl_schalterS ))
    {
        case  0: putValue( eMO_Kuppl_schalterT, "Schalter sagt ausgekuppelt" ); break;
        case  1: putValue( eMO_Kuppl_schalterT, "Schalter sagt eingekuppelt" ); break;
        default: putValue( eMO_Kuppl_schalterT, "!?!" );
    }
}

on envVar eMO_InterlockS
{
    switch (getValue( eMO_InterlockS ))
    {
        case  0: putValue( eMO_InterlockT, "Interlockschalter nicht betaetigt" ); break;
        case  1: putValue( eMO_InterlockT, "Interlockschalter betaetigt" ); break;
        default: putValue( eMO_InterlockT, "!?!" );
    }
}

on envVar eMO_Motor_laeuftS
{
    switch (getValue( eMO_Motor_laeuftS ))
    {
        case  0: putValue( eMO_Motor_laeuftT, "Motor laeuft nicht" ); break;
        case  1: putValue( eMO_Motor_laeuftT, "Motor laeuft autark und stabil und darf mechanisch belastet werden" ); break;
        default: putValue( eMO_Motor_laeuftT, "!?!" );
    }
}

on envVar eMO_KickdownS
{
    switch (getValue( eMO_KickdownS ))
    {
        case  0: putValue( eMO_KickdownT, "kein Kickdown" ); break;
        case  1: putValue( eMO_KickdownT, "Kickdown" ); break;
        default: putValue( eMO_KickdownT, "!?!" );
    }
}

on envVar eMO_Status_Zylabschalt_01S
{
    switch (getValue( eMO_Status_Zylabschalt_01S ))
    {
        case  0: putValue( eMO_Status_Zylabschalt_01T, "alle Zylinder brennen" ); break;
        case  1: putValue( eMO_Status_Zylabschalt_01T, "mindestens ein Zylinder wurde abgeschaltet" ); break;
        default: putValue( eMO_Status_Zylabschalt_01T, "!?!" );
    }
}

on envVar eMO_EKlKomLeiRedS
{
    switch (getValue( eMO_EKlKomLeiRedS ))
    {
        case  0: putValue( eMO_EKlKomLeiRedT, "keine Leistungsbegr" ); break;
        case  1: putValue( eMO_EKlKomLeiRedT, "Leistungsbegr 75" ); break;
        case  2: putValue( eMO_EKlKomLeiRedT, "Leistungsbegr 50" ); break;
        case  3: putValue( eMO_EKlKomLeiRedT, "Leistungsbegr 25" ); break;
        default: putValue( eMO_EKlKomLeiRedT, "!?!" );
    }
}

on envVar eMO_Handshake_STHS
{
    switch (getValue( eMO_Handshake_STHS ))
    {
        case  0: putValue( eMO_Handshake_STHT, "keine EKP-Ansteuerung durch STH-Anforderung" ); break;
        case  1: putValue( eMO_Handshake_STHT, "EKP-Ansteuerung durch STH-Anforderung" ); break;
        default: putValue( eMO_Handshake_STHT, "!?!" );
    }
}

on envVar eMO_BKV_UnterdruckwarnungS
{
    switch (getValue( eMO_BKV_UnterdruckwarnungS ))
    {
        case  0: putValue( eMO_BKV_UnterdruckwarnungT, "Unterdruckhaushalt iO" ); break;
        case  1: putValue( eMO_BKV_UnterdruckwarnungT, "Unterdruckhaushalt niO" ); break;
        default: putValue( eMO_BKV_UnterdruckwarnungT, "!?!" );
    }
}

on envVar eMO_Freigabe_SegelnS
{
    switch (getValue( eMO_Freigabe_SegelnS ))
    {
        case  0: putValue( eMO_Freigabe_SegelnT, "Segelbetrieb nicht freigegeben" ); break;
        case  1: putValue( eMO_Freigabe_SegelnT, "Segelbetrieb freigegeben" ); break;
        default: putValue( eMO_Freigabe_SegelnT, "!?!" );
    }
}

on envVar eMO_Drehzahl_WarnungS
{
    switch (getValue( eMO_Drehzahl_WarnungS ))
    {
        case  0: putValue( eMO_Drehzahl_WarnungT, "keinen Warnhinweis anzeigen" ); break;
        case  1: putValue( eMO_Drehzahl_WarnungT, "Warnhinweis anzeigen" ); break;
        default: putValue( eMO_Drehzahl_WarnungT, "!?!" );
    }
}

on envVar eMO_Faktor_Momente_02S
{
    switch (getValue( eMO_Faktor_Momente_02S ))
    {
        case  0: putValue( eMO_Faktor_Momente_02T, "nicht belegt" ); break;
        case  1: putValue( eMO_Faktor_Momente_02T, "Faktor 1" ); break;
        case  2: putValue( eMO_Faktor_Momente_02T, "Faktor 2" ); break;
        case  3: putValue( eMO_Faktor_Momente_02T, "Faktor 3" ); break;
        default: putValue( eMO_Faktor_Momente_02T, "!?!" );
    }
}

on envVar eMO_HybridfahrzeugS
{
    switch (getValue( eMO_HybridfahrzeugS ))
    {
        case  0: putValue( eMO_HybridfahrzeugT, "kein Hybridfahrzeug" ); break;
        case  1: putValue( eMO_HybridfahrzeugT, "Mild Hybrid" ); break;
        case  2: putValue( eMO_HybridfahrzeugT, "Full Hybrid" ); break;
        default: putValue( eMO_HybridfahrzeugT, "!?!" );
    }
}

on envVar eMO_Getriebe_CodeS
{
    switch (getValue( eMO_Getriebe_CodeS ))
    {
        case  2: putValue( eMO_Getriebe_CodeT, "DL501" ); break;
        case  4: putValue( eMO_Getriebe_CodeT, "VL381" ); break;
        case 10: putValue( eMO_Getriebe_CodeT, "AL651" ); break;
        case 11: putValue( eMO_Getriebe_CodeT, "AL551, AL951, AL1000-8A" ); break;
        case 12: putValue( eMO_Getriebe_CodeT, "PDK PAG" ); break;
        case 13: putValue( eMO_Getriebe_CodeT, "AL551 Hybrid" ); break;
        case 15: putValue( eMO_Getriebe_CodeT, "Handschalter (konventionell)" ); break;
        case 16: putValue( eMO_Getriebe_CodeT, "AQ250" ); break;
        case 17: putValue( eMO_Getriebe_CodeT, "AQ450" ); break;
        case 18: putValue( eMO_Getriebe_CodeT, "DQ200" ); break;
        case 19: putValue( eMO_Getriebe_CodeT, "DQ250" ); break;
        case 20: putValue( eMO_Getriebe_CodeT, "DQ500" ); break;
        case 21: putValue( eMO_Getriebe_CodeT, "SQ100" ); break;
        case 22: putValue( eMO_Getriebe_CodeT, "SQ200" ); break;
        default: putValue( eMO_Getriebe_CodeT, "!?!" );
    }
}

on envVar eMO_StartStopp_CodiertS
{
    switch (getValue( eMO_StartStopp_CodiertS ))
    {
        case  0: putValue( eMO_StartStopp_CodiertT, "Start Stopp nicht verbaut" ); break;
        case  1: putValue( eMO_StartStopp_CodiertT, "Start Stopp verbaut" ); break;
        default: putValue( eMO_StartStopp_CodiertT, "!?!" );
    }
}

on envVar eMO_KraftstoffartS
{
    switch (getValue( eMO_KraftstoffartS ))
    {
        case  0: putValue( eMO_KraftstoffartT, "Diesel" ); break;
        case  1: putValue( eMO_KraftstoffartT, "Benzin" ); break;
        case  2: putValue( eMO_KraftstoffartT, "CNG" ); break;
        case  3: putValue( eMO_KraftstoffartT, "Erdgas" ); break;
        case  4: putValue( eMO_KraftstoffartT, "Wasserstoff" ); break;
        default: putValue( eMO_KraftstoffartT, "!?!" );
    }
}

on envVar eMO_AnsaugsystemS
{
    switch (getValue( eMO_AnsaugsystemS ))
    {
        case  0: putValue( eMO_AnsaugsystemT, "Turbo" ); break;
        case  1: putValue( eMO_AnsaugsystemT, "Sauger" ); break;
        default: putValue( eMO_AnsaugsystemT, "!?!" );
    }
}

on envVar eMO_Abgastyp_EOBDS
{
    switch (getValue( eMO_Abgastyp_EOBDS ))
    {
        case  0: putValue( eMO_Abgastyp_EOBDT, "kein EOBD" ); break;
        case  1: putValue( eMO_Abgastyp_EOBDT, "EOBD" ); break;
        default: putValue( eMO_Abgastyp_EOBDT, "!?!" );
    }
}

on envVar eMO_Abgastyp_OBDS
{
    switch (getValue( eMO_Abgastyp_OBDS ))
    {
        case  0: putValue( eMO_Abgastyp_OBDT, "kein OBD" ); break;
        case  1: putValue( eMO_Abgastyp_OBDT, "OBD" ); break;
        default: putValue( eMO_Abgastyp_OBDT, "!?!" );
    }
}

on envVar eMO_DPF_verbautS
{
    switch (getValue( eMO_DPF_verbautS ))
    {
        case  0: putValue( eMO_DPF_verbautT, "kein DPF verbaut" ); break;
        case  1: putValue( eMO_DPF_verbautT, "DPF verbaut" ); break;
        default: putValue( eMO_DPF_verbautT, "!?!" );
    }
}

on envVar eTSK_CodierungS
{
    switch (getValue( eTSK_CodierungS ))
    {
        case  0: putValue( eTSK_CodierungT, "kein Fahrgeschwindigkeitsregler" ); break;
        case  1: putValue( eTSK_CodierungT, "GRA" ); break;
        case  2: putValue( eTSK_CodierungT, "GRA Plus" ); break;
        case  3: putValue( eTSK_CodierungT, "Basis ACC" ); break;
        case  4: putValue( eTSK_CodierungT, "ACC Follow to Stop" ); break;
        case  5: putValue( eTSK_CodierungT, "ACC Stop and Go" ); break;
        case  7: putValue( eTSK_CodierungT, "Codierung in Plausibilisierungsphase" ); break;
        default: putValue( eTSK_CodierungT, "!?!" );
    }
}

on envVar eMO_EinspritzartS
{
    switch (getValue( eMO_EinspritzartS ))
    {
        case  0: putValue( eMO_EinspritzartT, "MPI" ); break;
        case  1: putValue( eMO_EinspritzartT, "FSI / TDI" ); break;
        default: putValue( eMO_EinspritzartT, "!?!" );
    }
}

on envVar eNM_Gateway_NM_StateS
{
    switch (getValue( eNM_Gateway_NM_StateS ))
    {
        case  1: putValue( eNM_Gateway_NM_StateT, "NM RM aus BSM" ); break;
        case  2: putValue( eNM_Gateway_NM_StateT, "NM RM aus PBSM" ); break;
        case  4: putValue( eNM_Gateway_NM_StateT, "NM NO aus RM" ); break;
        case  8: putValue( eNM_Gateway_NM_StateT, "NM NO aus RS" ); break;
        default: putValue( eNM_Gateway_NM_StateT, "!?!" );
    }
}

on envVar eNM_Gateway_Car_WakeupS
{
    switch (getValue( eNM_Gateway_Car_WakeupS ))
    {
        case  1: putValue( eNM_Gateway_Car_WakeupT, "Car Wakeup" ); break;
        default: putValue( eNM_Gateway_Car_WakeupT, "!?!" );
    }
}

on envVar eNM_Gateway_WakeupS
{
    switch (getValue( eNM_Gateway_WakeupS ))
    {
        case  0: putValue( eNM_Gateway_WakeupT, "Peripherie Wakeup  Ursache nicht bekannt" ); break;
        case  1: putValue( eNM_Gateway_WakeupT, "Bus Wakeup" ); break;
        case  2: putValue( eNM_Gateway_WakeupT, "KL15 HW" ); break;
        default: putValue( eNM_Gateway_WakeupT, "!?!" );
    }
}

on envVar eNM_Gateway_NM_aktiv_KL15S
{
    switch (getValue( eNM_Gateway_NM_aktiv_KL15S ))
    {
        case  1: putValue( eNM_Gateway_NM_aktiv_KL15T, "KL15 EIN" ); break;
        default: putValue( eNM_Gateway_NM_aktiv_KL15T, "!?!" );
    }
}

on envVar eNM_Gateway_NM_aktiv_DiagnoseS
{
    switch (getValue( eNM_Gateway_NM_aktiv_DiagnoseS ))
    {
        case  1: putValue( eNM_Gateway_NM_aktiv_DiagnoseT, "Diagnose aktiv" ); break;
        default: putValue( eNM_Gateway_NM_aktiv_DiagnoseT, "!?!" );
    }
}

on envVar eNM_Gateway_NM_aktiv_TminS
{
    switch (getValue( eNM_Gateway_NM_aktiv_TminS ))
    {
        case  1: putValue( eNM_Gateway_NM_aktiv_TminT, "Mindestaktivzeit" ); break;
        default: putValue( eNM_Gateway_NM_aktiv_TminT, "!?!" );
    }
}

on envVar eNM_Gateway_UDS_CCS
{
    switch (getValue( eNM_Gateway_UDS_CCS ))
    {
        case  1: putValue( eNM_Gateway_UDS_CCT, "CC aktiv" ); break;
        default: putValue( eNM_Gateway_UDS_CCT, "!?!" );
    }
}

on envVar ePLS_Anf_AnzS
{
    switch (getValue( ePLS_Anf_AnzS ))
    {
        case  0: putValue( ePLS_Anf_AnzT, "keine Anforderung" ); break;
        case  1: putValue( ePLS_Anf_AnzT, "Anzeige Anforderung" ); break;
        default: putValue( ePLS_Anf_AnzT, "!?!" );
    }
}

on envVar ePLS_Kurze_LueckeS
{
    switch (getValue( ePLS_Kurze_LueckeS ))
    {
        case  0: putValue( ePLS_Kurze_LueckeT, "keine Kurze Luecke" ); break;
        case  1: putValue( ePLS_Kurze_LueckeT, "Kurze Luecke" ); break;
        default: putValue( ePLS_Kurze_LueckeT, "!?!" );
    }
}

on envVar ePLS_Laengs_QuerlueckeS
{
    switch (getValue( ePLS_Laengs_QuerlueckeS ))
    {
        case  0: putValue( ePLS_Laengs_QuerlueckeT, "Laengsluecke" ); break;
        case  1: putValue( ePLS_Laengs_QuerlueckeT, "Querluecke" ); break;
        default: putValue( ePLS_Laengs_QuerlueckeT, "!?!" );
    }
}

on envVar ePLS_Anf_Anz_SchwellpfeilS
{
    switch (getValue( ePLS_Anf_Anz_SchwellpfeilS ))
    {
        case  0: putValue( ePLS_Anf_Anz_SchwellpfeilT, "Anzeige Schwellpfeil aus" ); break;
        case  1: putValue( ePLS_Anf_Anz_SchwellpfeilT, "Anzeige Schwellpfeil ein" ); break;
        default: putValue( ePLS_Anf_Anz_SchwellpfeilT, "!?!" );
    }
}

on envVar ePLS_Fahrtrichtg_MehrzgS
{
    switch (getValue( ePLS_Fahrtrichtg_MehrzgS ))
    {
        case  0: putValue( ePLS_Fahrtrichtg_MehrzgT, "vorwaerts" ); break;
        case  1: putValue( ePLS_Fahrtrichtg_MehrzgT, "rueckwaerts" ); break;
        default: putValue( ePLS_Fahrtrichtg_MehrzgT, "!?!" );
    }
}

on envVar ePLS_BremssymbolS
{
    switch (getValue( ePLS_BremssymbolS ))
    {
        case  0: putValue( ePLS_BremssymbolT, "keine Anzeige" ); break;
        case  1: putValue( ePLS_BremssymbolT, "Anzeige Bremssymbol" ); break;
        default: putValue( ePLS_BremssymbolT, "!?!" );
    }
}

on envVar ePLS_PL_ExistS
{
    switch (getValue( ePLS_PL_ExistS ))
    {
        case  0: putValue( ePLS_PL_ExistT, "keine Parkluecke" ); break;
        case  1: putValue( ePLS_PL_ExistT, "Parkluecke" ); break;
        default: putValue( ePLS_PL_ExistT, "!?!" );
    }
}

on envVar ePLS_StandbyS
{
    switch (getValue( ePLS_StandbyS ))
    {
        case  0: putValue( ePLS_StandbyT, "keine Anzeige" ); break;
        case  1: putValue( ePLS_StandbyT, "Anzeige des Standby Symbols" ); break;
        default: putValue( ePLS_StandbyT, "!?!" );
    }
}

on envVar ePLS_Mehrzg_AktivS
{
    switch (getValue( ePLS_Mehrzg_AktivS ))
    {
        case  0: putValue( ePLS_Mehrzg_AktivT, "nicht aktiv" ); break;
        case  1: putValue( ePLS_Mehrzg_AktivT, "aktiv" ); break;
        default: putValue( ePLS_Mehrzg_AktivT, "!?!" );
    }
}

on envVar ePLS_Pos_OKS
{
    switch (getValue( ePLS_Pos_OKS ))
    {
        case  0: putValue( ePLS_Pos_OKT, "Pos NOK" ); break;
        case  1: putValue( ePLS_Pos_OKT, "Pos OK" ); break;
        default: putValue( ePLS_Pos_OKT, "!?!" );
    }
}

on envVar ePLS_PL_SeiteS
{
    switch (getValue( ePLS_PL_SeiteS ))
    {
        case  0: putValue( ePLS_PL_SeiteT, "rechts" ); break;
        case  1: putValue( ePLS_PL_SeiteT, "links" ); break;
        default: putValue( ePLS_PL_SeiteT, "!?!" );
    }
}

on envVar ePLS_Lenk_Aktiv_HinweisS
{
    switch (getValue( ePLS_Lenk_Aktiv_HinweisS ))
    {
        case  0: putValue( ePLS_Lenk_Aktiv_HinweisT, "keine Info" ); break;
        case  1: putValue( ePLS_Lenk_Aktiv_HinweisT, "Lenkeingriff aktiv" ); break;
        default: putValue( ePLS_Lenk_Aktiv_HinweisT, "!?!" );
    }
}

on envVar ePLS_TexteS
{
    switch (getValue( ePLS_TexteS ))
    {
        case  0: putValue( ePLS_TexteT, "keine Meldung" ); break;
        case  1: putValue( ePLS_TexteT, "ParkAssist deaktiviert  Funktion ohne vorherigem Lenkeingriff regulaer beendet" ); break;
        case  2: putValue( ePLS_TexteT, "ParkAssist deaktiviert  Geschwindigkeit zu hoch" ); break;
        case  3: putValue( ePLS_TexteT, "ParkAssist deaktiviert  Eingriff ASR ohne aktiviertem Lenkeingriff" ); break;
        case  4: putValue( ePLS_TexteT, "ParkAssist deaktiviert  ASR Ausgeschaltet" ); break;
        case  5: putValue( ePLS_TexteT, "ParkAssist deaktiviert  Anhaenger vorhanden ohne aktiviertem Lenkeingriff" ); break;
        case  6: putValue( ePLS_TexteT, "ParkAssist deaktiviert  Zeitlimit ueberschritten" ); break;
        case  7: putValue( ePLS_TexteT, "ParkAssist deaktiviert  Systemstoerung ohne aktiviertem Lenkeingriff" ); break;
        case  8: putValue( ePLS_TexteT, "ParkAssist deaktiviert  defekt ohne aktiviertem Lenkeingriff" ); break;
        case  9: putValue( ePLS_TexteT, "Stillstandszeit nicht ausreichend" ); break;
        case 10: putValue( ePLS_TexteT, "Geschwindigkeit zu niedrig" ); break;
        case 11: putValue( ePLS_TexteT, "Blinker setzen und Rueckwaertsgang einlegen  Ausparkfunktion" ); break;
        case 12: putValue( ePLS_TexteT, "Automatisches Ausparken nicht moeglich  Luecke zu klein" ); break;
        case 13: putValue( ePLS_TexteT, "Geschwindigkeit zu hoch  bei aktivem Lenkeingriff" ); break;
        case 14: putValue( ePLS_TexteT, "ParkAssist beendet  Geschwindigkeit zu hoch" ); break;
        case 15: putValue( ePLS_TexteT, "ParkAssist deaktiviert  Lenkung uebernehmen" ); break;
        case 16: putValue( ePLS_TexteT, "ParkAssist deaktiviert  Anhaenger  bei aktiviertem Lenkeingriff" ); break;
        case 17: putValue( ePLS_TexteT, "ParkAssist deaktiviert  ASR ausgeschaltet  Lenkung uebernehmen" ); break;
        case 18: putValue( ePLS_TexteT, "ParkAssist deaktiviert  Zeitlimit ueberschritten Lenkung uebernehmen" ); break;
        case 19: putValue( ePLS_TexteT, "Lenkeingriff deaktiviert  Lenkung uebernehmen" ); break;
        case 20: putValue( ePLS_TexteT, "ParkAssist deaktiviert  Lenkung uebernehmen Parkvorgang manuell beenden" ); break;
        case 21: putValue( ePLS_TexteT, "ParkAssist deaktiviert  Geschwindigkeit zu hoch  Lenkung uebernehmen" ); break;
        case 22: putValue( ePLS_TexteT, "ParkAssist deaktiviert  Eingriff ASR  Lenkung uebernehmen" ); break;
        case 23: putValue( ePLS_TexteT, "ParkAssist deaktiviert  Systemstoerung" ); break;
        case 24: putValue( ePLS_TexteT, "ParkAssist deaktiviert  defekt" ); break;
        case 25: putValue( ePLS_TexteT, "Bitte Lenkung uebernehmen und Fahrt fortsetzen" ); break;
        case 26: putValue( ePLS_TexteT, "Automatisches Ausparken nicht moeglich  Luecke zu klein" ); break;
        case 27: putValue( ePLS_TexteT, "ParkAssist  Bremseingriff  Geschwindigkeit zu hoch" ); break;
        case 28: putValue( ePLS_TexteT, "Hindernis erkannt  bitte Bremse betaetigen" ); break;
        case 29: putValue( ePLS_TexteT, "Achtung  Bremse öffnet" ); break;
        case 30: putValue( ePLS_TexteT, "Achtung  Seitliches Hindernis" ); break;
        case 31: putValue( ePLS_TexteT, "ParkAssist beendet  Lenkung uebernehmen" ); break;
        case 32: putValue( ePLS_TexteT, "Dauertonbereich veraendert  besondere Vorsicht geboten" ); break;
        default: putValue( ePLS_TexteT, "!?!" );
    }
}

on envVar ePLS_Schwellpfeil_relS
{
    switch (getValue( ePLS_Schwellpfeil_relS ))
    {
        case  0: putValue( ePLS_Schwellpfeil_relT, "kein Segment leer" ); break;
        case  1: putValue( ePLS_Schwellpfeil_relT, "1 Segment" ); break;
        case  2: putValue( ePLS_Schwellpfeil_relT, "2 Segmente" ); break;
        case  3: putValue( ePLS_Schwellpfeil_relT, "3 Segmente" ); break;
        case  4: putValue( ePLS_Schwellpfeil_relT, "4 Segmente" ); break;
        case  5: putValue( ePLS_Schwellpfeil_relT, "5 Segmente" ); break;
        case  6: putValue( ePLS_Schwellpfeil_relT, "6 Segmente" ); break;
        case  7: putValue( ePLS_Schwellpfeil_relT, "7 Segmente" ); break;
        case  8: putValue( ePLS_Schwellpfeil_relT, "8 Segmente" ); break;
        case  9: putValue( ePLS_Schwellpfeil_relT, "9 Segmente" ); break;
        case 10: putValue( ePLS_Schwellpfeil_relT, "10 Segmente" ); break;
        case 11: putValue( ePLS_Schwellpfeil_relT, "11 Segmente" ); break;
        case 12: putValue( ePLS_Schwellpfeil_relT, "12 Segmente" ); break;
        case 13: putValue( ePLS_Schwellpfeil_relT, "13 Segmente" ); break;
        case 14: putValue( ePLS_Schwellpfeil_relT, "14 Segmente" ); break;
        case 15: putValue( ePLS_Schwellpfeil_relT, "15 Segmente voll" ); break;
        default: putValue( ePLS_Schwellpfeil_relT, "!?!" );
    }
}

on envVar ePLS_Schwellpfeil_absS
{
    switch (getValue( ePLS_Schwellpfeil_absS ))
    {
        case  0: putValue( ePLS_Schwellpfeil_absT, "3 Segmente  voll" ); break;
        case  1: putValue( ePLS_Schwellpfeil_absT, "2 Segmente" ); break;
        case  2: putValue( ePLS_Schwellpfeil_absT, "1 Segment" ); break;
        case  3: putValue( ePLS_Schwellpfeil_absT, "kein Segment  togelt in Gegenrichtung" ); break;
        default: putValue( ePLS_Schwellpfeil_absT, "!?!" );
    }
}

on envVar ePLS_Ausparken_AktivS
{
    switch (getValue( ePLS_Ausparken_AktivS ))
    {
        case  0: putValue( ePLS_Ausparken_AktivT, "Ausparken nicht aktiv" ); break;
        case  1: putValue( ePLS_Ausparken_AktivT, "Ausparken aktiv" ); break;
        default: putValue( ePLS_Ausparken_AktivT, "!?!" );
    }
}

on envVar ePLS_BremsleuchteS
{
    switch (getValue( ePLS_BremsleuchteS ))
    {
        case  0: putValue( ePLS_BremsleuchteT, "Bremsleuchte aus" ); break;
        case  1: putValue( ePLS_BremsleuchteT, "Bremsleuchte an" ); break;
        default: putValue( ePLS_BremsleuchteT, "!?!" );
    }
}

on envVar eRDK_System_OffS
{
    switch (getValue( eRDK_System_OffS ))
    {
        case  0: putValue( eRDK_System_OffT, "System eingeschaltet" ); break;
        case  1: putValue( eRDK_System_OffT, "System ausgeschaltet" ); break;
        default: putValue( eRDK_System_OffT, "!?!" );
    }
}

on envVar eRDK_FMVSS138_LampeS
{
    switch (getValue( eRDK_FMVSS138_LampeS ))
    {
        case  0: putValue( eRDK_FMVSS138_LampeT, "keine Warnung" ); break;
        case  1: putValue( eRDK_FMVSS138_LampeT, "Warnlampe FMVSS 138, gelbe Lampe statisch an" ); break;
        default: putValue( eRDK_FMVSS138_LampeT, "!?!" );
    }
}

on envVar eRDK_Druckwarnung_RdWS
{
    switch (getValue( eRDK_Druckwarnung_RdWS ))
    {
        case  0: putValue( eRDK_Druckwarnung_RdWT, "rote Lampe aus" ); break;
        case  1: putValue( eRDK_Druckwarnung_RdWT, "rote Lampe ein" ); break;
        default: putValue( eRDK_Druckwarnung_RdWT, "!?!" );
    }
}

on envVar eRDK_LF_aktivS
{
    switch (getValue( eRDK_LF_aktivS ))
    {
        case  0: putValue( eRDK_LF_aktivT, "Inaktiv" ); break;
        case  1: putValue( eRDK_LF_aktivT, "Aktiv" ); break;
        default: putValue( eRDK_LF_aktivT, "!?!" );
    }
}

on envVar eRDK_KD_FehlerS
{
    switch (getValue( eRDK_KD_FehlerS ))
    {
        case  0: putValue( eRDK_KD_FehlerT, "kein KD Fehler" ); break;
        case  1: putValue( eRDK_KD_FehlerT, "KD Fehler" ); break;
        default: putValue( eRDK_KD_FehlerT, "!?!" );
    }
}

on envVar eRKA_WarnungenS
{
    switch (getValue( eRKA_WarnungenS ))
    {
        case  0: putValue( eRKA_WarnungenT, "keine Anzeige" ); break;
        case  1: putValue( eRKA_WarnungenT, "RD prüfen (P1-rot)" ); break;
        case  2: putValue( eRKA_WarnungenT, "RD VL (P1-rot)" ); break;
        case  3: putValue( eRKA_WarnungenT, "RD VR (P1-rot)" ); break;
        case  4: putValue( eRKA_WarnungenT, "RD HL (P1-rot)" ); break;
        case  5: putValue( eRKA_WarnungenT, "RD HR (P1-rot)" ); break;
        case  6: putValue( eRKA_WarnungenT, "RD RR (P2-gelb)" ); break;
        case  7: putValue( eRKA_WarnungenT, "RD prüfen (P2-gelb)" ); break;
        case  8: putValue( eRKA_WarnungenT, "reserviert" ); break;
        case  9: putValue( eRKA_WarnungenT, "RD Systemstörung (P2-gelb)" ); break;
        case 10: putValue( eRKA_WarnungenT, "RD VL (P2-gelb)" ); break;
        case 11: putValue( eRKA_WarnungenT, "RD VR (P2-gelb)" ); break;
        case 12: putValue( eRKA_WarnungenT, "RD HL (P2-gelb)" ); break;
        case 13: putValue( eRKA_WarnungenT, "RD HR (P2-gelb)" ); break;
        default: putValue( eRKA_WarnungenT, "!?!" );
    }
}

on envVar eRKA_FMVSS138_LampeS
{
    switch (getValue( eRKA_FMVSS138_LampeS ))
    {
        case  0: putValue( eRKA_FMVSS138_LampeT, "keine Warnung" ); break;
        case  1: putValue( eRKA_FMVSS138_LampeT, "Warnlampe FMVSS 138, gelbe Lampe statisch an" ); break;
        default: putValue( eRKA_FMVSS138_LampeT, "!?!" );
    }
}

on envVar eRKA_Druckwarnung_RdWS
{
    switch (getValue( eRKA_Druckwarnung_RdWS ))
    {
        case  0: putValue( eRKA_Druckwarnung_RdWT, "rote Lampe aus" ); break;
        case  1: putValue( eRKA_Druckwarnung_RdWT, "rote Lampe ein" ); break;
        default: putValue( eRKA_Druckwarnung_RdWT, "!?!" );
    }
}

on envVar eRKA_Warnungen_02S
{
    switch (getValue( eRKA_Warnungen_02S ))
    {
        case  0: putValue( eRKA_Warnungen_02T, "keine Anzeige" ); break;
        case  1: putValue( eRKA_Warnungen_02T, "Kontrollleuchte" ); break;
        case  2: putValue( eRKA_Warnungen_02T, "Systemfehler" ); break;
        case  3: putValue( eRKA_Warnungen_02T, "Reifen allgemein Warnstufe 1" ); break;
        case  4: putValue( eRKA_Warnungen_02T, "Reifen vorne links Warnstufe 1" ); break;
        case  5: putValue( eRKA_Warnungen_02T, "Reifen vorne rechts Warnstufe 1" ); break;
        case  6: putValue( eRKA_Warnungen_02T, "Reifen hinten links Warnstufe 1" ); break;
        case  7: putValue( eRKA_Warnungen_02T, "Reifen hinten rechts Warnstufe 1" ); break;
        case  8: putValue( eRKA_Warnungen_02T, "Reifen allgemein Warnstufe 2" ); break;
        case  9: putValue( eRKA_Warnungen_02T, "Reifen vorne links Warnstufe 2" ); break;
        case 10: putValue( eRKA_Warnungen_02T, "Reifen vorne rechts Warnstufe 2" ); break;
        case 11: putValue( eRKA_Warnungen_02T, "Reifen hinten links Warnstufe 2" ); break;
        case 12: putValue( eRKA_Warnungen_02T, "Reifen hinten rechts Warnstufe 2" ); break;
        case 13: putValue( eRKA_Warnungen_02T, "Reifen allgemein Warnstufe 3" ); break;
        case 14: putValue( eRKA_Warnungen_02T, "Reifen vorne links Warnstufe 3" ); break;
        case 15: putValue( eRKA_Warnungen_02T, "Reifen vorne rechts Warnstufe 3" ); break;
        case 16: putValue( eRKA_Warnungen_02T, "Reifen hinten links Warnstufe 3" ); break;
        case 17: putValue( eRKA_Warnungen_02T, "Reifen hinten rechts Warnstufe 3" ); break;
        case 18: putValue( eRKA_Warnungen_02T, "Reifendruecke kalibrieren" ); break;
        default: putValue( eRKA_Warnungen_02T, "!?!" );
    }
}

on envVar eRKA_KD_FehlerS
{
    switch (getValue( eRKA_KD_FehlerS ))
    {
        case  0: putValue( eRKA_KD_FehlerT, "kein KD Fehler" ); break;
        case  1: putValue( eRKA_KD_FehlerT, "KD Fehler" ); break;
        default: putValue( eRKA_KD_FehlerT, "!?!" );
    }
}

on envVar eSWA_AnzeigenS
{
    switch (getValue( eSWA_AnzeigenS ))
    {
        case  0: putValue( eSWA_AnzeigenT, "keine Anzeige" ); break;
        case  1: putValue( eSWA_AnzeigenT, "Text 1 'SWA zur Zeit nicht verfügbar' und Akustik" ); break;
        case  2: putValue( eSWA_AnzeigenT, "Text 2 'SWA Systemfehler' und Akustik" ); break;
        case  3: putValue( eSWA_AnzeigenT, "Text 3 'SWA Sensoren blockiert' und Akustik" ); break;
        case  4: putValue( eSWA_AnzeigenT, "Text 4 'SWA im Anhängerbetrieb nicht verfügbar' und Akustik" ); break;
        case  9: putValue( eSWA_AnzeigenT, "Text 1 ohne Akustik" ); break;
        case 10: putValue( eSWA_AnzeigenT, "Text 2 ohne Akustik" ); break;
        case 11: putValue( eSWA_AnzeigenT, "Text 3 ohne Akustik" ); break;
        case 12: putValue( eSWA_AnzeigenT, "Text 4 ohne Akustik" ); break;
        default: putValue( eSWA_AnzeigenT, "!?!" );
    }
}

on envVar eSWA_Blindheit_erkanntS
{
    switch (getValue( eSWA_Blindheit_erkanntS ))
    {
        case  0: putValue( eSWA_Blindheit_erkanntT, "nicht erkannt" ); break;
        case  1: putValue( eSWA_Blindheit_erkanntT, "erkannt" ); break;
        default: putValue( eSWA_Blindheit_erkanntT, "!?!" );
    }
}

on envVar eSWA_rel_NichtverfS
{
    switch (getValue( eSWA_rel_NichtverfS ))
    {
        case  0: putValue( eSWA_rel_NichtverfT, "verfuegbar" ); break;
        case  1: putValue( eSWA_rel_NichtverfT, "nicht verfuegbar" ); break;
        default: putValue( eSWA_rel_NichtverfT, "!?!" );
    }
}

on envVar eSWA_rel_FehlerS
{
    switch (getValue( eSWA_rel_FehlerS ))
    {
        case  0: putValue( eSWA_rel_FehlerT, "kein Fehler" ); break;
        case  1: putValue( eSWA_rel_FehlerT, "Fehler" ); break;
        default: putValue( eSWA_rel_FehlerT, "!?!" );
    }
}

on envVar eSWA_Sta_aktivS
{
    switch (getValue( eSWA_Sta_aktivS ))
    {
        case  0: putValue( eSWA_Sta_aktivT, "Aus" ); break;
        case  1: putValue( eSWA_Sta_aktivT, "Ein" ); break;
        default: putValue( eSWA_Sta_aktivT, "!?!" );
    }
}

on envVar eSWA_Sta_passivS
{
    switch (getValue( eSWA_Sta_passivS ))
    {
        case  0: putValue( eSWA_Sta_passivT, "Aus" ); break;
        case  1: putValue( eSWA_Sta_passivT, "Ein" ); break;
        default: putValue( eSWA_Sta_passivT, "!?!" );
    }
}

on envVar eSWA_Standziele_liS
{
    switch (getValue( eSWA_Standziele_liS ))
    {
        case  0: putValue( eSWA_Standziele_liT, "Abstand i.O." ); break;
        case  1: putValue( eSWA_Standziele_liT, "Abstand zu gering" ); break;
        default: putValue( eSWA_Standziele_liT, "!?!" );
    }
}

on envVar eSWA_Kolonne_liS
{
    switch (getValue( eSWA_Kolonne_liS ))
    {
        case  0: putValue( eSWA_Kolonne_liT, "zwei oder weniger Fahrzeuge auf der Spur" ); break;
        case  1: putValue( eSWA_Kolonne_liT, "mehr als zwei Fahrzeuge auf der Spur" ); break;
        default: putValue( eSWA_Kolonne_liT, "!?!" );
    }
}

on envVar eSWA_Infostufe_SWA_liS
{
    switch (getValue( eSWA_Infostufe_SWA_liS ))
    {
        case  0: putValue( eSWA_Infostufe_SWA_liT, "keine Aktion" ); break;
        case  1: putValue( eSWA_Infostufe_SWA_liT, "Aktion" ); break;
        default: putValue( eSWA_Infostufe_SWA_liT, "!?!" );
    }
}

on envVar eSWA_Warnung_SWA_liS
{
    switch (getValue( eSWA_Warnung_SWA_liS ))
    {
        case  0: putValue( eSWA_Warnung_SWA_liT, "keine Warnung" ); break;
        case  1: putValue( eSWA_Warnung_SWA_liT, "Warnung aktiv" ); break;
        default: putValue( eSWA_Warnung_SWA_liT, "!?!" );
    }
}

on envVar eSWA_Kolonne_miS
{
    switch (getValue( eSWA_Kolonne_miS ))
    {
        case  0: putValue( eSWA_Kolonne_miT, "zwei oder weniger Fahrzeuge auf der Spur" ); break;
        case  1: putValue( eSWA_Kolonne_miT, "mehr als zwei Fahrzeuge auf der Spur" ); break;
        default: putValue( eSWA_Kolonne_miT, "!?!" );
    }
}

on envVar eSWA_Standziele_reS
{
    switch (getValue( eSWA_Standziele_reS ))
    {
        case  0: putValue( eSWA_Standziele_reT, "Abstand i.O." ); break;
        case  1: putValue( eSWA_Standziele_reT, "Abstand zu gering" ); break;
        default: putValue( eSWA_Standziele_reT, "!?!" );
    }
}

on envVar eSWA_Kolonne_reS
{
    switch (getValue( eSWA_Kolonne_reS ))
    {
        case  0: putValue( eSWA_Kolonne_reT, "zwei oder weniger Fahrzeuge auf der Spur" ); break;
        case  1: putValue( eSWA_Kolonne_reT, "mehr als zwei Fahrzeuge auf der Spur" ); break;
        default: putValue( eSWA_Kolonne_reT, "!?!" );
    }
}

on envVar eSWA_Infostufe_SWA_reS
{
    switch (getValue( eSWA_Infostufe_SWA_reS ))
    {
        case  0: putValue( eSWA_Infostufe_SWA_reT, "keine Aktion" ); break;
        case  1: putValue( eSWA_Infostufe_SWA_reT, "Aktion" ); break;
        default: putValue( eSWA_Infostufe_SWA_reT, "!?!" );
    }
}

on envVar eSWA_Warnung_SWA_reS
{
    switch (getValue( eSWA_Warnung_SWA_reS ))
    {
        case  0: putValue( eSWA_Warnung_SWA_reT, "keine Warnung" ); break;
        case  1: putValue( eSWA_Warnung_SWA_reT, "Warnung aktiv" ); break;
        default: putValue( eSWA_Warnung_SWA_reT, "!?!" );
    }
}

on envVar eSI_QRS_ModeS
{
    switch (getValue( eSI_QRS_ModeS ))
    {
        case  0: putValue( eSI_QRS_ModeT, "QRS Messmodus nicht aktiv" ); break;
        case  1: putValue( eSI_QRS_ModeT, "QRS Messmodus aktiv" ); break;
        default: putValue( eSI_QRS_ModeT, "!?!" );
    }
}

on envVar eSI_NWDFS
{
    switch (getValue( eSI_NWDFS ))
    {
        case  0: putValue( eSI_NWDFT, "Ueberwachung nicht freigegeben" ); break;
        case  1: putValue( eSI_NWDFT, "Ueberwachung freigegeben" ); break;
        default: putValue( eSI_NWDFT, "!?!" );
    }
}

on envVar eSI_NWDF_gueltigS
{
    switch (getValue( eSI_NWDF_gueltigS ))
    {
        case  0: putValue( eSI_NWDF_gueltigT, "NWDF wird nicht unterstuetzt" ); break;
        case  1: putValue( eSI_NWDF_gueltigT, "NWDF wird unterstuetzt" ); break;
        default: putValue( eSI_NWDF_gueltigT, "!?!" );
    }
}

on envVar eGW_KD_FehlerS
{
    switch (getValue( eGW_KD_FehlerS ))
    {
        case  0: putValue( eGW_KD_FehlerT, "kein KD Fehler" ); break;
        case  1: putValue( eGW_KD_FehlerT, "KD Fehler" ); break;
        default: putValue( eGW_KD_FehlerT, "!?!" );
    }
}

on envVar eSI_BUS_01S
{
    switch (getValue( eSI_BUS_01S ))
    {
        case  0: putValue( eSI_BUS_01T, "keine Busruhe" ); break;
        case  1: putValue( eSI_BUS_01T, "Busruhe" ); break;
        default: putValue( eSI_BUS_01T, "!?!" );
    }
}

on envVar eSI_BUS_02S
{
    switch (getValue( eSI_BUS_02S ))
    {
        case  0: putValue( eSI_BUS_02T, "keine Busruhe" ); break;
        case  1: putValue( eSI_BUS_02T, "Busruhe" ); break;
        default: putValue( eSI_BUS_02T, "!?!" );
    }
}

on envVar eSI_BUS_03S
{
    switch (getValue( eSI_BUS_03S ))
    {
        case  0: putValue( eSI_BUS_03T, "keine Busruhe" ); break;
        case  1: putValue( eSI_BUS_03T, "Busruhe" ); break;
        default: putValue( eSI_BUS_03T, "!?!" );
    }
}

on envVar eSI_BUS_04S
{
    switch (getValue( eSI_BUS_04S ))
    {
        case  0: putValue( eSI_BUS_04T, "keine Busruhe" ); break;
        case  1: putValue( eSI_BUS_04T, "Busruhe" ); break;
        default: putValue( eSI_BUS_04T, "!?!" );
    }
}

on envVar eSI_BUS_05S
{
    switch (getValue( eSI_BUS_05S ))
    {
        case  0: putValue( eSI_BUS_05T, "keine Busruhe" ); break;
        case  1: putValue( eSI_BUS_05T, "Busruhe" ); break;
        default: putValue( eSI_BUS_05T, "!?!" );
    }
}

on envVar eSI_BUS_06S
{
    switch (getValue( eSI_BUS_06S ))
    {
        case  0: putValue( eSI_BUS_06T, "keine Busruhe" ); break;
        case  1: putValue( eSI_BUS_06T, "Busruhe" ); break;
        default: putValue( eSI_BUS_06T, "!?!" );
    }
}

on envVar eSI_BUS_07S
{
    switch (getValue( eSI_BUS_07S ))
    {
        case  0: putValue( eSI_BUS_07T, "keine Busruhe" ); break;
        case  1: putValue( eSI_BUS_07T, "Busruhe" ); break;
        default: putValue( eSI_BUS_07T, "!?!" );
    }
}

on envVar eSI_BUS_08S
{
    switch (getValue( eSI_BUS_08S ))
    {
        case  0: putValue( eSI_BUS_08T, "keine Busruhe" ); break;
        case  1: putValue( eSI_BUS_08T, "Busruhe" ); break;
        default: putValue( eSI_BUS_08T, "!?!" );
    }
}

on envVar eSI_BUS_09S
{
    switch (getValue( eSI_BUS_09S ))
    {
        case  0: putValue( eSI_BUS_09T, "keine Busruhe" ); break;
        case  1: putValue( eSI_BUS_09T, "Busruhe" ); break;
        default: putValue( eSI_BUS_09T, "!?!" );
    }
}

on envVar eSI_BUS_10S
{
    switch (getValue( eSI_BUS_10S ))
    {
        case  0: putValue( eSI_BUS_10T, "keine Busruhe" ); break;
        case  1: putValue( eSI_BUS_10T, "Busruhe" ); break;
        default: putValue( eSI_BUS_10T, "!?!" );
    }
}

on envVar eSI_BUS_11S
{
    switch (getValue( eSI_BUS_11S ))
    {
        case  0: putValue( eSI_BUS_11T, "keine Busruhe" ); break;
        case  1: putValue( eSI_BUS_11T, "Busruhe" ); break;
        default: putValue( eSI_BUS_11T, "!?!" );
    }
}

on envVar eSI_BUS_12S
{
    switch (getValue( eSI_BUS_12S ))
    {
        case  0: putValue( eSI_BUS_12T, "keine Busruhe" ); break;
        case  1: putValue( eSI_BUS_12T, "Busruhe" ); break;
        default: putValue( eSI_BUS_12T, "!?!" );
    }
}

on envVar eSI_BUS_13S
{
    switch (getValue( eSI_BUS_13S ))
    {
        case  0: putValue( eSI_BUS_13T, "keine Busruhe" ); break;
        case  1: putValue( eSI_BUS_13T, "Busruhe" ); break;
        default: putValue( eSI_BUS_13T, "!?!" );
    }
}

on envVar eSI_BUS_14S
{
    switch (getValue( eSI_BUS_14S ))
    {
        case  0: putValue( eSI_BUS_14T, "keine Busruhe" ); break;
        case  1: putValue( eSI_BUS_14T, "Busruhe" ); break;
        default: putValue( eSI_BUS_14T, "!?!" );
    }
}

on envVar eSI_BUS_15S
{
    switch (getValue( eSI_BUS_15S ))
    {
        case  0: putValue( eSI_BUS_15T, "keine Busruhe" ); break;
        case  1: putValue( eSI_BUS_15T, "Busruhe" ); break;
        default: putValue( eSI_BUS_15T, "!?!" );
    }
}

on envVar eSI_Sammel_SG_Fehler61
{
    if( getValue( this ))
    {
    _SI_Sammel_SG_Fehler = getValue( eSI_Sammel_SG_FehlerS );
    putValue( eSI_Sammel_SG_FehlerS, 61 );
    }
    else if( getValue( eSI_Sammel_SG_FehlerS ) == 61)
    {
    if( _SI_Sammel_SG_Fehler != 61)
      putValue( eSI_Sammel_SG_FehlerS, _SI_Sammel_SG_Fehler );
    else
      putValue( eSI_Sammel_SG_FehlerS, 63 );
    }

}

on envVar eSI_Sammel_SG_Fehler62
{
    if( getValue( this ))
    {
    _SI_Sammel_SG_Fehler = getValue( eSI_Sammel_SG_FehlerS );
    putValue( eSI_Sammel_SG_FehlerS, 62 );
    }
    else if( getValue( eSI_Sammel_SG_FehlerS ) == 62)
    {
    if( _SI_Sammel_SG_Fehler != 62)
      putValue( eSI_Sammel_SG_FehlerS, _SI_Sammel_SG_Fehler );
    else
      putValue( eSI_Sammel_SG_FehlerS, 63 );
    }

}

on envVar eSI_Sammel_SG_FehlerS
{
    putValue( eSI_Sammel_SG_Fehler61, getValue( eSI_Sammel_SG_FehlerS ) == 61 );
    putValue( eSI_Sammel_SG_Fehler62, getValue( eSI_Sammel_SG_FehlerS ) == 62 );
}

on envVar eTSK_Texte_PrimaeranzS
{
    switch (getValue( eTSK_Texte_PrimaeranzS ))
    {
        case  0: putValue( eTSK_Texte_PrimaeranzT, "keine Anzeige" ); break;
        case  1: putValue( eTSK_Texte_PrimaeranzT, "GRA Symbol passiv xxx kmh mph" ); break;
        case  2: putValue( eTSK_Texte_PrimaeranzT, "GRA Symbol aktiv xxx kmh mph" ); break;
        case  3: putValue( eTSK_Texte_PrimaeranzT, "Bremse ueberhitzt" ); break;
        case  4: putValue( eTSK_Texte_PrimaeranzT, "Limiter Modus aktiviert" ); break;
        case  5: putValue( eTSK_Texte_PrimaeranzT, "GRA Modus aktiviert" ); break;
        case  6: putValue( eTSK_Texte_PrimaeranzT, "ACC Modus aktiviert" ); break;
        case  7: putValue( eTSK_Texte_PrimaeranzT, "Opt Geschwindigkeitswarnung" ); break;
        case  8: putValue( eTSK_Texte_PrimaeranzT, "Opt und akustische GeschwWarnung" ); break;
        case  9: putValue( eTSK_Texte_PrimaeranzT, "Opt Geswarn dauer mit ein Akus" ); break;
        case 10: putValue( eTSK_Texte_PrimaeranzT, "Limiter passiv mit Akustik" ); break;
        case 11: putValue( eTSK_Texte_PrimaeranzT, "Description for the value '0xB'" ); break;
        default: putValue( eTSK_Texte_PrimaeranzT, "!?!" );
    }
}

on envVar eTSK_Limiter_AnzeigeS
{
    switch (getValue( eTSK_Limiter_AnzeigeS ))
    {
        case  0: putValue( eTSK_Limiter_AnzeigeT, "Display Anzeige GRA ACC" ); break;
        case  1: putValue( eTSK_Limiter_AnzeigeT, "Description for the value '0x1'" ); break;
        default: putValue( eTSK_Limiter_AnzeigeT, "!?!" );
    }
}

on envVar eTSK_Status_AnzeigeS
{
    switch (getValue( eTSK_Status_AnzeigeS ))
    {
        case  0: putValue( eTSK_Status_AnzeigeT, "Hauptschalter aus" ); break;
        case  1: putValue( eTSK_Status_AnzeigeT, "Init" ); break;
        case  2: putValue( eTSK_Status_AnzeigeT, "passiv" ); break;
        case  3: putValue( eTSK_Status_AnzeigeT, "aktiv" ); break;
        case  4: putValue( eTSK_Status_AnzeigeT, "Uebertreten" ); break;
        case  5: putValue( eTSK_Status_AnzeigeT, "reserviert" ); break;
        case  6: putValue( eTSK_Status_AnzeigeT, "reversibel aus" ); break;
        case  7: putValue( eTSK_Status_AnzeigeT, "Description for the value '0x7'" ); break;
        default: putValue( eTSK_Status_AnzeigeT, "!?!" );
    }
}

on envVar eTSK_Wunschgeschw1022
{
    if( getValue( this ))
    {
    _TSK_Wunschgeschw = getValue( eTSK_WunschgeschwS );
    putValue( eTSK_WunschgeschwS, 327.04 );
    }
    else if( getValue( eTSK_WunschgeschwS ) == 327.04)
    {
    if( _TSK_Wunschgeschw != 327.04)
      putValue( eTSK_WunschgeschwS, _TSK_Wunschgeschw );
    else
      putValue( eTSK_WunschgeschwS, 0 );
    }

}

on envVar eTSK_Wunschgeschw1023
{
    if( getValue( this ))
    {
    _TSK_Wunschgeschw = getValue( eTSK_WunschgeschwS );
    putValue( eTSK_WunschgeschwS, 327.36 );
    }
    else if( getValue( eTSK_WunschgeschwS ) == 327.36)
    {
    if( _TSK_Wunschgeschw != 327.36)
      putValue( eTSK_WunschgeschwS, _TSK_Wunschgeschw );
    else
      putValue( eTSK_WunschgeschwS, 0 );
    }

}

on envVar eTSK_WunschgeschwS
{
    putValue( eTSK_Wunschgeschw1022, getValue( eTSK_WunschgeschwS ) == 327.04 );
    putValue( eTSK_Wunschgeschw1023, getValue( eTSK_WunschgeschwS ) == 327.36 );
}

on envVar eWBA_Fahrstufe_02S
{
    switch (getValue( eWBA_Fahrstufe_02S ))
    {
        case  0: putValue( eWBA_Fahrstufe_02T, "Zwischenstellung keine Position" ); break;
        case  1: putValue( eWBA_Fahrstufe_02T, "Position P" ); break;
        case  2: putValue( eWBA_Fahrstufe_02T, "Position R" ); break;
        case  3: putValue( eWBA_Fahrstufe_02T, "Position N" ); break;
        case  4: putValue( eWBA_Fahrstufe_02T, "Position D" ); break;
        case  5: putValue( eWBA_Fahrstufe_02T, "Position S" ); break;
        case  6: putValue( eWBA_Fahrstufe_02T, "Position M Tippfunktion" ); break;
        case  7: putValue( eWBA_Fahrstufe_02T, "Kurzzeit M" ); break;
        case  8: putValue( eWBA_Fahrstufe_02T, "Position E" ); break;
        default: putValue( eWBA_Fahrstufe_02T, "!?!" );
    }
}

on envVar eWBA_ZielFahrstufeS
{
    switch (getValue( eWBA_ZielFahrstufeS ))
    {
        case  0: putValue( eWBA_ZielFahrstufeT, "keine Gangempfehlung kein Gang eingelegt" ); break;
        case  1: putValue( eWBA_ZielFahrstufeT, "Pfeil nach S" ); break;
        case  2: putValue( eWBA_ZielFahrstufeT, "Pfeil nach D" ); break;
        case  3: putValue( eWBA_ZielFahrstufeT, "Pfeil nach M" ); break;
        case  4: putValue( eWBA_ZielFahrstufeT, "Pfeil nach E" ); break;
        default: putValue( eWBA_ZielFahrstufeT, "!?!" );
    }
}

on envVar eWBA_GE_Warnung_02S
{
    switch (getValue( eWBA_GE_Warnung_02S ))
    {
        case  0: putValue( eWBA_GE_Warnung_02T, "keine Anzeige" ); break;
        case  1: putValue( eWBA_GE_Warnung_02T, "Fehlereskalationsstufe I" ); break;
        case  2: putValue( eWBA_GE_Warnung_02T, "Fehlereskalationsstufe II" ); break;
        case  3: putValue( eWBA_GE_Warnung_02T, "Weiterfahrt nur eingeschränkt möglich. Kein R-Gang" ); break;
        case  4: putValue( eWBA_GE_Warnung_02T, "Getriebefehler, Weiterfahrt nur in D moeglich, P bei Motor aus" ); break;
        case  5: putValue( eWBA_GE_Warnung_02T, "Wegrollgefahr! P nicht möglich" ); break;
        case  6: putValue( eWBA_GE_Warnung_02T, "Getriebeüberhitzung Warnstufe I" ); break;
        case  7: putValue( eWBA_GE_Warnung_02T, "Getriebeüberhitzung Warnstufe II" ); break;
        default: putValue( eWBA_GE_Warnung_02T, "!?!" );
    }
}

on envVar eWBA_eing_Gang_02S
{
    switch (getValue( eWBA_eing_Gang_02S ))
    {
        case  0: putValue( eWBA_eing_Gang_02T, "keine Ganganzeige" ); break;
        case  1: putValue( eWBA_eing_Gang_02T, "1.Gang" ); break;
        case  2: putValue( eWBA_eing_Gang_02T, "2.Gang" ); break;
        case  3: putValue( eWBA_eing_Gang_02T, "3.Gang" ); break;
        case  4: putValue( eWBA_eing_Gang_02T, "4.Gang" ); break;
        case  5: putValue( eWBA_eing_Gang_02T, "5.Gang" ); break;
        case  6: putValue( eWBA_eing_Gang_02T, "6.Gang" ); break;
        case  7: putValue( eWBA_eing_Gang_02T, "7.Gang" ); break;
        case  8: putValue( eWBA_eing_Gang_02T, "8.Gang" ); break;
        case  9: putValue( eWBA_eing_Gang_02T, "9.Gang" ); break;
        case 10: putValue( eWBA_eing_Gang_02T, "Funktion Ganganzeigeunterdrueckung" ); break;
        default: putValue( eWBA_eing_Gang_02T, "!?!" );
    }
}

on envVar eWBA_GE_TexteS
{
    switch (getValue( eWBA_GE_TexteS ))
    {
        case  0: putValue( eWBA_GE_TexteT, "keine Anzeige" ); break;
        case  1: putValue( eWBA_GE_TexteT, "zum Einlegen einer Fahrstufe Fussbremse betaetigen  ShiftLock Information" ); break;
        case  2: putValue( eWBA_GE_TexteT, "zum Einlegen von R,N,D Fussbremse betaetigen und Motor starten" ); break;
        case  3: putValue( eWBA_GE_TexteT, "Wegrollgefahr bitte P einlegen" ); break;
        case  4: putValue( eWBA_GE_TexteT, "Achtung Zeitueberschreitung P wird eingelegt" ); break;
        case  5: putValue( eWBA_GE_TexteT, "Bremse betaetigen" ); break;
        default: putValue( eWBA_GE_TexteT, "!?!" );
    }
}

on envVar eWBA_Segeln_aktivS
{
    switch (getValue( eWBA_Segeln_aktivS ))
    {
        case  0: putValue( eWBA_Segeln_aktivT, "inaktiv" ); break;
        case  1: putValue( eWBA_Segeln_aktivT, "aktiv" ); break;
        default: putValue( eWBA_Segeln_aktivT, "!?!" );
    }
}

on envVar eWBA_SchaltschemaS
{
    switch (getValue( eWBA_SchaltschemaS ))
    {
        case  0: putValue( eWBA_SchaltschemaT, "kein Schaltschema" ); break;
        case  1: putValue( eWBA_SchaltschemaT, "xxxD(S)" ); break;
        case  2: putValue( eWBA_SchaltschemaT, "xxxD S" ); break;
        case  3: putValue( eWBA_SchaltschemaT, "xxxS(D)" ); break;
        case  4: putValue( eWBA_SchaltschemaT, "xxxS D" ); break;
        case  5: putValue( eWBA_SchaltschemaT, "xxxM(D)" ); break;
        case  6: putValue( eWBA_SchaltschemaT, "xxxM D" ); break;
        case  7: putValue( eWBA_SchaltschemaT, "xxxM(S)" ); break;
        case  8: putValue( eWBA_SchaltschemaT, "xxxM S" ); break;
        case  9: putValue( eWBA_SchaltschemaT, "xxxE(D)" ); break;
        case 10: putValue( eWBA_SchaltschemaT, "xxxE D" ); break;
        case 11: putValue( eWBA_SchaltschemaT, "xxxE(S)" ); break;
        case 12: putValue( eWBA_SchaltschemaT, "xxxE S" ); break;
        case 13: putValue( eWBA_SchaltschemaT, "xxxE(M)" ); break;
        case 14: putValue( eWBA_SchaltschemaT, "xxxE M" ); break;
        default: putValue( eWBA_SchaltschemaT, "!?!" );
    }
}

on envVar eWIV_Verschleissindex65535
{
    if( getValue( this ))
    {
    _WIV_Verschleissindex = getValue( eWIV_VerschleissindexS );
    putValue( eWIV_VerschleissindexS, 0.0013107 );
    }
    else if( getValue( eWIV_VerschleissindexS ) == 0.0013107)
    {
    if( _WIV_Verschleissindex != 0.0013107)
      putValue( eWIV_VerschleissindexS, _WIV_Verschleissindex );
    else
      putValue( eWIV_VerschleissindexS, 0 );
    }

}

on envVar eWIV_VerschleissindexS
{
    putValue( eWIV_Verschleissindex65535, getValue( eWIV_VerschleissindexS ) == 0.0013107 );
}

on envVar eWIV_Russindex65535
{
    if( getValue( this ))
    {
    _WIV_Russindex = getValue( eWIV_RussindexS );
    putValue( eWIV_RussindexS, 0.0013107 );
    }
    else if( getValue( eWIV_RussindexS ) == 0.0013107)
    {
    if( _WIV_Russindex != 0.0013107)
      putValue( eWIV_RussindexS, _WIV_Russindex );
    else
      putValue( eWIV_RussindexS, 0 );
    }

}

on envVar eWIV_RussindexS
{
    putValue( eWIV_Russindex65535, getValue( eWIV_RussindexS ) == 0.0013107 );
}

// ===== END OF GENERATED CODE =====

on envVar eMO_rel_LadedruckS
{
    putValue( eMO_rel_Ladedruck255, getValue( eMO_rel_LadedruckS ) == 100.4 );
}

on envVar eMO_rel_Ladedruck255
{
    if( getValue( this ))
    {
    _MO_rel_Ladedruck = getValue( eMO_rel_LadedruckS );
    putValue( eMO_rel_LadedruckS, 100.4 );
    }
    else if( getValue( eMO_rel_LadedruckS ) == 100.4)
    {
    if( _MO_rel_Ladedruck != 10.4)
      putValue( eMO_rel_LadedruckS, _MO_rel_Ladedruck );
    else
      putValue( eMO_rel_LadedruckS, 100);
    }

}

on envVar eMO_E_WarnungenS
{
    switch (getValue( eMO_E_WarnungenS ))
    {
        case  0: putValue( eMO_E_WarnungenT, "keine_Anzeige" ); break;
        case  1: putValue( eMO_E_WarnungenT, "Fehler_Elektrosystem_Anhalten" ); break;
        case  2: putValue( eMO_E_WarnungenT, "Fehler_Elektrosystem_Werkstatt" ); break;
        case  3: putValue( eMO_E_WarnungenT, "Elektrosystem_ueberhitzt_Stopp" ); break;
        case  4: putValue( eMO_E_WarnungenT, "Fehler_Hybridsystem_Anhalten");  break;
        case  5: putValue( eMO_E_WarnungenT, "Fehler_Hybridsystem_Werkstatt" ); break;
        case  6: putValue( eMO_E_WarnungenT, "reserviert_keine_Anzeige");  break;
        case  7: putValue( eMO_E_WarnungenT, "reserviert_keine_Anzeige");  break;
        case  8: putValue( eMO_E_WarnungenT, "reserviert_keine_Anzeige");  break;
        case  9: putValue( eMO_E_WarnungenT, "reserviert_keine_Anzeige" ); break;
        case  10: putValue( eMO_E_WarnungenT, "reserviert_keine_Anzeige");  break;
        case  11: putValue( eMO_E_WarnungenT, "reserviert_keine_Anzeige");  break;
        case  12: putValue( eMO_E_WarnungenT, "reserviert_keine_Anzeige" ); break;
        case  13: putValue( eMO_E_WarnungenT, "reserviert_keine_Anzeige" ); break;
        case  14: putValue( eMO_E_WarnungenT, "reserviert_keine_Anzeige" ); break;
        case  15: putValue( eMO_E_WarnungenT, "reserviert_keine_Anzeige" ); break;
        default: putValue( eMO_E_WarnungenT, "!?!" );
    }
}

on envVar eMO_E_TexteS
{
    switch (getValue( eMO_E_TexteS ))
    {
        case  0: putValue( eMO_E_TexteT, "keine_Anzeige" ); break;
        case  1: putValue( eMO_E_TexteT, "Stopp_Batterie_leer" ); break;
        case  2: putValue( eMO_E_TexteT, "Batterie_wird_geladen" ); break;
        case  3: putValue( eMO_E_TexteT, "Hybridsystem_zurzeit_nicht_verfuegbar" ); break;
        case  4: putValue( eMO_E_TexteT, "Hybridbatterie_wird_geladen" ); break;
        case  5: putValue( eMO_E_TexteT, "Bitte_Bremse_treten" ); break;
        case  6: putValue( eMO_E_TexteT, "Motor_erneut_starten" ); break;
        case  7: putValue( eMO_E_TexteT, "reserviert_keine_Anzeige" ); break;
        case  8: putValue( eMO_E_TexteT, "reserviert_keine_Anzeige" ); break;
        case  9: putValue( eMO_E_TexteT, "reserviert_keine_Anzeige" ); break;
        case  10: putValue( eMO_E_TexteT, "reserviert_keine_Anzeige" ); break;
        case  11: putValue( eMO_E_TexteT, "reserviert_keine_Anzeige" ); break;
        case 12: putValue( eMO_E_TexteT, "reserviert_keine_Anzeige" ); break;
        case 13: putValue( eMO_E_TexteT, "reserviert_keine_Anzeige" ); break;
        case 14: putValue( eMO_E_TexteT, "reserviert_keine_Anzeige" ); break;
        case 15: putValue( eMO_E_TexteT, "reserviert_keine_Anzeige" ); break;
        default: putValue( eMO_E_TexteT, "!?!" );
    }
}

on envVar eMO_E_ModeS
{
    switch (getValue( eMO_E_ModeS ))
    {
        case  0: putValue( eMO_E_ModeT, "keine_Anzeige" ); break;
        case  1: putValue( eMO_E_ModeT, "E_Mode_passiv" ); break;
        case  2: putValue( eMO_E_ModeT, "E_Mode_aktiv" ); break;
        case  3: putValue( eMO_E_ModeT, "E_Mode_zurzeit_nicht_verfuegbar" ); break;
        case  4: putValue( eMO_E_ModeT, "reserviert_keine_Anzeige" ); break;
        case  5: putValue( eMO_E_ModeT, "reserviert_keine_Anzeige" ); break;
        case  6: putValue( eMO_E_ModeT, "reserviert_keine_Anzeige" ); break;
        case  7: putValue( eMO_E_ModeT, "reserviert_keine_Anzeige" ); break;
        default: putValue( eMO_E_ModeT, "!?!" );
    }
}

on envVar eHVEM_Anf_ReichweiteNVS
{
    switch (getValue( eHVEM_Anf_ReichweiteNVS ))
    {
        case  0: putValue( eHVEM_Anf_ReichweiteNVT, "keine_Massnahme_notwendig" ); break;
        case  1: putValue( eHVEM_Anf_ReichweiteNVT, "Reduktion_Stufe_1" ); break;
        case  2: putValue( eHVEM_Anf_ReichweiteNVT, "Reduktion_Stufe_2" ); break;
        case  3: putValue( eHVEM_Anf_ReichweiteNVT, "Fehler" ); break;
        default: putValue( eHVEM_Anf_ReichweiteNVT, "!?!" );
    }
}

on envVar eHVEM_HV_AnfS
{
    switch (getValue( eHVEM_HV_AnfS ))
    {
        case  0: putValue( eHVEM_HV_AnfT, "keine_Anforderung" ); break;
        case  1: putValue( eHVEM_HV_AnfT, "HV_angefordert" ); break;
        default: putValue( eHVEM_HV_AnfT, "!?!" );
    }
}

on envVar eHVEM_LeistungsAnfS
{
    switch (getValue( eHVEM_LeistungsAnfS ))
    {
        case  0: putValue( eHVEM_LeistungsAnfT, "nicht_angefordert" ); break;
        case  1: putValue( eHVEM_LeistungsAnfT, "angefordert" ); break;
        default: putValue( eHVEM_LeistungsAnfT, "!?!" );
    }
}

on envVar eHVEM_Nachladen_AnfS
{
    switch (getValue( eHVEM_Nachladen_AnfS ))
    {
        case  0: putValue( eHVEM_Nachladen_AnfT, "keine_Anforderung" ); break;
        case  1: putValue( eHVEM_Nachladen_AnfT, "Nachladen_angefordert" ); break;
        default: putValue( eHVEM_Nachladen_AnfT, "!?!" );
    }
}

on envVar eHVEM_Text_1S
{
    switch (getValue( eHVEM_Text_1S ))
    {
        case  0: putValue( eHVEM_Text_1T, "kein_Text" ); break;
        case  1: putValue( eHVEM_Text_1T, "Text" ); break;
        default: putValue( eHVEM_Text_1T, "!?!" );
    }
}

on envVar eHVLM_Lademodus_HV_BatS
{
    switch (getValue( eHVLM_Lademodus_HV_BatS ))
    {
        case  0: putValue( eHVLM_Lademodus_HV_BatT, "Sofortlademodus" ); break;
        case  1: putValue( eHVLM_Lademodus_HV_BatT, "zeitversetztes_Laden" ); break;
        default: putValue( eHVLM_Lademodus_HV_BatT, "!?!" );
    }
}

on envVar eHVLM_VK_AnfS
{
    switch (getValue( eHVLM_VK_AnfS ))
    {
        case  0: putValue( eHVLM_VK_AnfT, "nicht_angefordert" ); break;
        case  1: putValue( eHVLM_VK_AnfT, "angefordert" ); break;
        default: putValue( eHVLM_VK_AnfT, "!?!" );
    }
}

on envVar eHVEM_Nachlad_StatusS
{
    switch (getValue( eHVEM_Nachlad_StatusS ))
    {
        case  0: putValue( eHVEM_Nachlad_StatusT, "nicht_moeglich__Fehler" ); break;
        case  1: putValue( eHVEM_Nachlad_StatusT, "moeglich__begonnen" ); break;
        case  2: putValue( eHVEM_Nachlad_StatusT, "Beendet" ); break;
        case  3: putValue( eHVEM_Nachlad_StatusT, "Init" ); break;
        default: putValue( eHVEM_Nachlad_StatusT, "!?!" );
    }
}

on envVar eHVLM_LadeartS
{
    switch (getValue( eHVLM_LadeartS ))
    {
        case  0: putValue( eHVLM_LadeartT, "keine_Anf" ); break;
        case  1: putValue( eHVLM_LadeartT, "AC_Laden" ); break;
        case  2: putValue( eHVLM_LadeartT, "DC_Laden" ); break;
        case  3: putValue( eHVLM_LadeartT, "Konditionierung" ); break;
        default: putValue( eHVLM_LadeartT, "!?!" );
    }
}

on envVar eHVLM_LadesystemhinweiseS
{
    switch (getValue( eHVLM_LadesystemhinweiseS ))
    {
        case  0: putValue( eHVLM_LadesystemhinweiseT, "kein_Hinweis" ); break;
        case  1: putValue( eHVLM_LadesystemhinweiseT, "Ladesystem_defekt" ); break;
        case  2: putValue( eHVLM_LadesystemhinweiseT, "Ladesaeule_inkompatibel" ); break;
        case  3: putValue( eHVLM_LadesystemhinweiseT, "DC_Laden_nicht_moeglich" ); break;
        default: putValue( eHVLM_LadesystemhinweiseT, "!?!" );
    }
}

on envVar eHVLM_Langzeit_LadenS
{
    switch (getValue( eHVLM_Langzeit_LadenS ))
    {
        case  0: putValue( eHVLM_Langzeit_LadenT, "keine_Anforderung" ); break;
        case  1: putValue( eHVLM_Langzeit_LadenT, "Anforderung_Reduzierung_Batterie_SOC_auf_Stufe_1" ); break;
        case  2: putValue( eHVLM_Langzeit_LadenT, "Anforderung_Reduzierung_Batterie_SOC_auf_Stufe_2" ); break;
        case  3: putValue( eHVLM_Langzeit_LadenT, "Fehler" ); break;
        default: putValue( eHVLM_Langzeit_LadenT, "!?!" );
    }
}

on envVar eHVLM_Restladezeit_HV_BatS
{
    switch (getValue( eHVLM_Restladezeit_HV_BatS ))
    {
        case  0: putValue( eHVLM_Restladezeit_HV_BatT, "Init" ); break;
        case  1: putValue( eHVLM_Restladezeit_HV_BatT, "kein_Stecker_gesteckt" ); break;
        case  2: putValue( eHVLM_Restladezeit_HV_BatT, "Stecker_erkannt_nicht_verriegelt" ); break;
        case  3: putValue( eHVLM_Restladezeit_HV_BatT, "Stecker_erkannt_und_verriegelt" ); break;
        default: putValue( eHVLM_Restladezeit_HV_BatT, "!?!" );
    }
}

on envVar eHV_Bordnetz_aktivS	
{	
    switch (getValue( eHV_Bordnetz_aktivS ))	
    {	
        case  0: putValue( eHV_Bordnetz_aktivT, "inaktiv" ); break;	
        case  1: putValue( eHV_Bordnetz_aktivT, "aktiv" ); break;	
        default: putValue( eHV_Bordnetz_aktivT, "!?!" );	
    }	
}	

on envVar eMO_WaehlposS	
{	
    switch (getValue( eMO_WaehlposS ))	
    {	
        case  0: putValue( eMO_WaehlposT, "Init_nicht_unterstuetzt" ); break;	
        case  1: putValue( eMO_WaehlposT, "reserviert" ); break;	
        case  2: putValue( eMO_WaehlposT, "P" ); break;	
        case  3: putValue( eMO_WaehlposT, "R" ); break;	
        case  4: putValue( eMO_WaehlposT, "N" ); break;	
        case  5: putValue( eMO_WaehlposT, "D" ); break;	
        case  6: putValue( eMO_WaehlposT, "B" ); break;	
        case  7: putValue( eMO_WaehlposT, "Fehler" ); break;	
        default: putValue( eMO_WaehlposT, "!?!" );	
    }	
}	

on envVar eMO_HVEM_EskalationS	
{	
    switch (getValue( eMO_HVEM_EskalationS ))	
    {	
        case  0: putValue( eMO_HVEM_EskalationT, "keine_Eskalation_HVEM" ); break;	
        case  1: putValue( eMO_HVEM_EskalationT, "Eskalation_HVEM" ); break;	
        default: putValue( eMO_HVEM_EskalationT, "!?!" );	
    }	
}	

on envVar eMO_W_Reku_normiert_ueberlaufS	
{	
    switch (getValue( eMO_W_Reku_normiert_ueberlaufS ))	
    {	
        case  0: putValue( eMO_W_Reku_normiert_ueberlaufT, "kein_Ueberlauf" ); break;	
        case  1: putValue( eMO_W_Reku_normiert_ueberlaufT, "Rekuperationssignal_min_1_mal_uebergelaufen" ); break;	
        default: putValue( eMO_W_Reku_normiert_ueberlaufT, "!?!" );	
    }	
}	

on envVar eEnrgfluss_StateS	
{	
    switch (getValue( eEnrgfluss_StateS ))	
    {	
        case  0: putValue( eEnrgfluss_StateT, "Init" ); break;	
        case  1: putValue( eEnrgfluss_StateT, "no_torques" ); break;	
        case  2: putValue( eEnrgfluss_StateT, "pos_tor_EE" ); break;	
        case  3: putValue( eEnrgfluss_StateT, "pos_tor_ICE" ); break;	

        case  4: putValue( eEnrgfluss_StateT, "pos_tor_ICE_bat_charge" ); break;	
        case  5: putValue( eEnrgfluss_StateT, "pos_tor_EE_ICE" ); break;	
        case  6: putValue( eEnrgfluss_StateT, "neg_tor_EE_bar_charge" ); break;	
        case  7: putValue( eEnrgfluss_StateT, "neg_tor_EE_bat_discharge" ); break;

        case  8: putValue( eEnrgfluss_StateT, "neg_tor_EE" ); break;	
        case  9: putValue( eEnrgfluss_StateT, "ICE_charge_bat" ); break;	
        case  10: putValue( eEnrgfluss_StateT,"neg_tor_EE_and_ICE" ); break;	
        case  11: putValue( eEnrgfluss_StateT,"no_tor_sailing" ); break;

        case  12: putValue( eEnrgfluss_StateT, "no_tor_sailing_and_ICE" ); break;	
        case  255: putValue( eEnrgfluss_StateT,"Fehler" ); break;
        default: putValue( eEnrgfluss_StateT, "!?!" );	
    }	
}	

on	EnvVar	eAGA_Charisma_FahrPrS						
{								
	switch(getValue(eAGA_Charisma_FahrPrS	))			
	{							
	case	0	:	putValue(	eAGA_Charisma_FahrPrT,	"keine_Funktion");	break;
	case	1	:	putValue(	eAGA_Charisma_FahrPrT,	"Programm_1"	);	break;
	case	2	:	putValue(	eAGA_Charisma_FahrPrT,	"Programm_2"	);	break;
	case	3	:	putValue(	eAGA_Charisma_FahrPrT,	"Programm_3"	);	break;
	case	4	:	putValue(	eAGA_Charisma_FahrPrT,	"Programm_4"	);	break;
	case	5	:	putValue(	eAGA_Charisma_FahrPrT,	"Programm_5"	);	break;
	case	6	:	putValue(	eAGA_Charisma_FahrPrT,	"Programm_6"	);	break;
	case	7	:	putValue(	eAGA_Charisma_FahrPrT,	"Programm_7"	);	break;
	case	8	:	putValue(	eAGA_Charisma_FahrPrT,	"Programm_8"	);	break;
	case	9	:	putValue(	eAGA_Charisma_FahrPrT,	"Programm_9"	);	break;
	case	10	:	putValue(	eAGA_Charisma_FahrPrT,	"Programm_10"	);	break;
	case	11	:	putValue(	eAGA_Charisma_FahrPrT,	"Programm_11"	);	break;
	case	12	:	putValue(	eAGA_Charisma_FahrPrT,	"Programm_12"	);	break;
	case	13	:	putValue(	eAGA_Charisma_FahrPrT,	"Programm_13"	);	break;
	case	14	:	putValue(	eAGA_Charisma_FahrPrT,	"Programm_14"	);	break;
	case	15	:	putValue(	eAGA_Charisma_FahrPrT,	"Programm_15"	);	break;
	default:	putValue(		eAGA_Charisma_FahrPrT,	"!?!"	);		
	}							
}								

on	EnvVar	eAGA_Charisma_StatusS						
{								
	switch	(getValue(eAGA_Charisma_StatusS	))			
	{							
	case	0	:	putValue(	eAGA_Charisma_StatusT,	"Init"	);	break;
	case	1	:	putValue(	eAGA_Charisma_StatusT,	"verfuegbar"	);	break;
	case	2	:	putValue(	eAGA_Charisma_StatusT,	"nicht_verfuegbar"	);	break;
	case	3	:	putValue(	eAGA_Charisma_StatusT,	"asynchron_durch_Fahrerwunsch"	);	break;
	default:	putValue(		eAGA_Charisma_StatusT,	"!?!"	);
	}					
}						

on	EnvVar	eAGA_ohne_FunktionS						
{								
	switch	(getValue(eAGA_ohne_FunktionS	))			
	{							
	case	0:	putValue(eAGA_ohne_FunktionT,"kein_Fehler");break;
	case	1:	putValue(eAGA_ohne_FunktionT,"Fehler");	break;
	default:	putValue(eAGA_ohne_FunktionT,"!?!");
	}					
}						

on	EnvVar	eBMS_MaxEnergieinhaltS						
{								
	switch(getValue(eBMS_MaxEnergieinhaltS	))			
	{							
	case	102300:putValue(eBMS_MaxEnergieinhaltT,"Init"	);	break;
	case	102350:putValue(eBMS_MaxEnergieinhaltT,"Fehler");	break;
	default:  	 putValue(eBMS_MaxEnergieinhaltT,	"!?!");
	}				
}				 	

on	EnvVar	eBMS_Ausgleichsladung_AnfS						
{								
	switch	(getValue(eBMS_Ausgleichsladung_AnfS	))			
	{							
	case	1:	putValue(eBMS_Ausgleichsladung_AnfT,"Balancing_Request");	break;
	default:	putValue(eBMS_Ausgleichsladung_AnfT,"!?!");
	}					
}						

on	EnvVar	eBMS_Gesamtst_SpgfreiheitS						
{								
	switch	(getValue(eBMS_Gesamtst_SpgfreiheitS	))			
	{							
	case	0:	putValue(eBMS_Gesamtst_SpgfreiheitT,"Funktion_nicht_aktiviert");break;
	case	1:	putValue(eBMS_Gesamtst_SpgfreiheitT,"HV_System_spannungsfrei");	break;
        case	2:	putValue(eBMS_Gesamtst_SpgfreiheitT,"HV_System_nicht_spannungsfrei");	break;
        case	3:	putValue(eBMS_Gesamtst_SpgfreiheitT,"Fehler_nicht_spannungsfrei");	break;
	default:	putValue(eBMS_Gesamtst_SpgfreiheitT,"!?!");
	}					
}						

on envVar eEBKV_OBD_StatusS
{
    switch (getValue( eEBKV_OBD_StatusS ))
    {
        case  0: putValue( eEBKV_OBD_StatusT, "MIL_aus" ); break;
        case  1: putValue( eEBKV_OBD_StatusT, "MIL_ein" ); break;
        default: putValue( eEBKV_OBD_StatusT, "!?!" );
    }
}

on	EnvVar	eEBKV_HinweiseS						
{								
	switch	(getValue(eEBKV_HinweiseS))			
	{							
	case	0:	putValue(eEBKV_HinweiseT,"i_O_System");break;
	case	1:	putValue(eEBKV_HinweiseT,"Werkstattdiagnose");	break;
        case	2:	putValue(eEBKV_HinweiseT,"Rollenmodes");	break;
        case	3:	putValue(eEBKV_HinweiseT,"Uebernahme_Feststellbremse");	break;
	default:	putValue(eEBKV_HinweiseT,"!?!");
	}					
}						

on	EnvVar	eEBKV_WarnungenS						
{								
	switch	(getValue(eEBKV_WarnungenS))			
	{							
	case	0:	putValue(eEBKV_WarnungenT,"i_O_System");break;
	case	1:	putValue(eEBKV_WarnungenT,"Ausfall_2nd_Aktuator");	break;
        case	2:	putValue(eEBKV_WarnungenT,"Reduktion_Bremsverstaerkung");	break;
        case	3:	putValue(eEBKV_WarnungenT,"Ausfall_eBKV_ohne_HBV");	break;
        case	4:	putValue(eEBKV_WarnungenT,"Ausfall_Stillstandsmanagement");	break;
	default:	putValue(eEBKV_WarnungenT,"!?!");
	}					
}						

