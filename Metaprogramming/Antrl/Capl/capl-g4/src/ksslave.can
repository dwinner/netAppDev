/*@@var:*/
variables
{

byte rx_buffer[4096];

int bufferSize=4095;

byte bSlaveState=0;  //0: Init (Wait Challenge_M)
					 //1: Send Challenge_K
					 //2: Wait for Response_M
					 //3: Send Response_K valid
					 //4: Send Response_K invalid
					 //5: Send negative Response, if Challenge_M not correct request sequence error
					 //6: Send negative Response, if Response_M not correct	request sequence error
					 //7: Send negative Response, if Challenge_M too short or long, general reject
					 //8: Send negative Response, if Response_M too short or long, general reject
					 

byte bIdenticalCounter=0;

byte Challenge_K[12]={0xC0,0x01,0x01,0x02,0x03,0x04,0x05,0x06,0x07,0x08,0x00,0xaa};
byte Response_K[12] ={0xC0,0x02,0xaa,0xaa,0xaa,0xaa,0xaa,0xaa,0xaa,0xaa,0x00,0xaa};
byte Challenge_K_Neg[5]={0x7f,0x80,0x01,0x00,0x00};
byte Response_K_Neg[5]={0x7f,0x80,0x02,0x00,0x00};



byte txLength;					 

byte plain[16]=     {0x00,0x00,0x00,0x00,0x00,0x00,0x00,0x00,0x01,0x02,0x03,0x04,0x05,0x06,0x07,0x08};          // inputbuffer for encryption
byte dest[16];           // result buffer for encryption
byte schluessel_gueltig[16]={0x01,0x02,0x03,0x04,0x05,0x06,0x07,0x08,0x08,0x07,0x06,0x05,0x04,0x03,0x02,0x01};           // result buffer for encryption
byte schluessel_ungueltig[16]={0x07,0x02,0x03,0x04,0x05,0x06,0x07,0x08,0x08,0x07,0x06,0x05,0x04,0x03,0x02,0x01};           // result buffer for encryption

msTimer t_Tx;

byte IkaCounter;

int i;

char gECU[10] = "KS Slave";

byte Aktion=1;		// 1: valid IKA 
					// 2: invalid IKA
					// Authentifikation mit falschem Protokoll
					// 3: Challenge_K mit 80 01
					// 4: Challenge_K mit 80 02
					// 5: Challenge_K mit C0 02
					// 6: Response_K mit 80 01
					// 7: Response_K mit 80 02
					// 8: Response_K mit C0 01
					// 9: Challenge_K zu kurz
					//10: Challenge_K zu lang
					//11: Response_K zu kurz
					//12: Response_K zu lang
					//13: Falscher IKA Counter in Challenge_K
					//14: Falscher IKA Counter in Response_K	
					//15: UDS Frame auf Challenge_M
					//16: UDS Frame auf Response_M
	
					//Negative Antworten auf Challenge_M
					//17: 7f 80 01 35 xx 
					//18: 7f 80 01 22 xx 
					//19: 7f 80 01 21 xx 
					//20: 7f 80 01 10 xx 
					
					//27: 7f 80 02 35 xx 
					//28: 7f 80 02 22 xx 
					//29: 7f 80 02 21 xx 
					//30: 7f 80 02 10 xx 
					//31: 7f 80 02 88 xx
					
					//Negative Antworten auf Response_M
					
					//32: 7f 80 01 35 xx 
					//33: 7f 80 01 22 xx 
					//34: 7f 80 01 21 xx 
					//35: 7f 80 01 10 xx 
					//36: 7f 80 01 88 xx
					
					//21: 7f 80 02 35 xx 
					//22: 7f 80 02 22 xx 
					//23: 7f 80 02 21 xx 
					//24: 7f 80 02 10 xx 
					
					
					//Nicht spezifizierte Negative Antwort
					//25: 7f 80 01 88 xx 
					//26: 7f 80 02 88 xx 

byte bKnotenAdresse=0;

const byte MASTERECUNUMBER = 0x80;	//ECU Adress of KS-Master

const dword KS_EXT_ID_NORM_ADDR_REQ_BASE = 0x17FC0100;
const dword KS_EXT_ID_NORM_ADDR_RES_BASE = 0x17FE0100;
}
/*@@end*/

/*@@startStart:Start:*/
on start
{

    OSEKTL_SetBS(15);     //Blocksize set to 15
    OSEKTL_SetSTMIN(5);  //Separation Time
    OSEKTL_SetExtMode();	//For this node extended adressing is used
    OSEKTL_UseExtId(0);
    OSEKTL_SetTgtAdr(MASTERECUNUMBER);
    putValue(evTA,0x2c);
    OSEKTL_SetEcuNumber(getValue(evTA));	//Please set here the TP-Adressword of the simulated ECU

    putValue(evSLValidIka_Led,2);

}
/*@@end*/

/*@@caplFunc:OSEKTL_DataCon(long):*///callback
OSEKTL_DataCon (long txLength)
{

  if ( (bSlaveState==1) && (txLength==11) ) //Challenge_K successfully sent
  {
  write("Challenge_K sucessfully sent.");
  bSlaveState=2;	//wait for Response_M
  }	

  if  ((bSlaveState==3) || (bSlaveState==4) ) 
  {
  write("Response_K sucessfully sent.");
  bSlaveState=0;	//Wait for Challenge_M
  }	

  if ((bSlaveState==5) || (bSlaveState==7) )
  {
  write("Challenge_K_Neg sucessfully sent.");
  bSlaveState=0;	//Wait for Challenge_M
  }	
  
  if  ((bSlaveState==6) || (bSlaveState==8) )
  {
  write("Response_K_Neg sucessfully sent.");
  bSlaveState=0;	//Wait for Challenge_M
  }
}
/*@@end*/

/*@@caplFunc:OSEKTL_DataInd(long):*///callback
OSEKTL_DataInd (long rxCount)
{
	//write("DataInd, bSlaveState: %d",bSlaveState);

	OSEKTL_GetRxData(rx_buffer,bufferSize);	//Abholen der Daten aus der Transportschicht

	
	//Requirement: With the reception of ChM, the ks-state machine is reset
	if ((rxCount==11) && (rx_buffer[0]==0x80) && (rx_buffer[1]==0x01))
	  bSlaveState=0;
	
	if (bSlaveState==0)	
	{
		if (rxCount==11)
		{
		    IkaCounter=rx_buffer[10];

			if ((rx_buffer[0]==0x80) && (rx_buffer[1]==0x01))	//Challenge_M received
			{
			  for (i=2;i<10;i++)	//Fill plain with the correct data
			  {
			  plain[i-2]=rx_buffer[i];
			  }
				
			  if (Aktion==2) //invalid IKA
			    encrypt(plain, dest, schluessel_ungueltig);
			  else
				encrypt(plain, dest, schluessel_gueltig);	
		  
			  for (i=0;i<8;i++)	//Fill Response_K with encrypted data
			  {
			  Response_K[i+2]=dest[i+8];
			  }	
		
			  bSlaveState=1;	//Send Challenge_K
			  setTimer(t_Tx,20);
			}
			else
			{
			  bSlaveState=5;	//Send negative Response, if Challenge_M not correct
			  setTimer(t_Tx,20);
			}
	    }
		else //rxCount != 11
		{
			if (rxCount>11)
			  IkaCounter=rx_buffer[10];

			bSlaveState=7;	//if Challenge_M too short or long, general reject
			setTimer(t_Tx,20);
		}
	
	}
	
	
	if (bSlaveState==2)
	{
		
		if (rxCount==11)
		{
		
			if ((rx_buffer[0]==0x80) && (rx_buffer[1]==0x02))	
			{
				bIdenticalCounter=0;
			
				for(i=0;i<8;i++)
				{
				    //write("rx_buffer[%d]: %x dest[%d]: %x",i+2,rx_buffer[i+2],i,dest[i]);
					if(rx_buffer[i+2] == dest[i])
						bIdenticalCounter++;
				}
		
				//write("rx_buffer[10]: %x IkaCounter: %x bIdenticalCounter: %d",rx_buffer[10],IkaCounter,bIdenticalCounter);
				
				if (rx_buffer[10]==IkaCounter)
				{
					if (bIdenticalCounter==8)
						bSlaveState=3;
					else
					    bSlaveState=4;
		 		}
			    else
				{
					bSlaveState=6;	
				}
				
				setTimer(t_Tx,20);
			}	    	
	
			else
			{
			  bSlaveState=6;	//Send negative Response, if Response_M not correct
			  setTimer(t_Tx,20);
			}
	
		}
		else  //rxCount!= 11
		{
			bSlaveState=8;	//if Response_M too short or long, general reject
			setTimer(t_Tx,20);
		}
	
	
	}

}
/*@@end*/

/*@@timer:t_Tx:*/
on timer t_Tx
{
	
	//write("t_Tx, bSlaveState: %d",bSlaveState);
	
	if (bSlaveState==1)	//Send Challenge_K
	{  
	  switch (Aktion)
	  {
	  	case(3):	// 3: Challenge_K mit 80 01
		{
		  Challenge_K[0]=0x80;
		  Challenge_K[1]=0x01;
		  Challenge_K[2]=0x01;
		  Challenge_K[3]=0x02;
		  Challenge_K[4]=0x03;
		  Challenge_K[10]=IkaCounter;		  
	      OSEKTL_DataReq(Challenge_K,11);
		break;
		}
		
		case(4):	// 4: Challenge_K mit 80 02
		{
		  Challenge_K[0]=0x80;
		  Challenge_K[1]=0x02;
		  Challenge_K[2]=0x01;
		  Challenge_K[3]=0x02;
		  Challenge_K[4]=0x03;
		  Challenge_K[10]=IkaCounter;		  
	      OSEKTL_DataReq(Challenge_K,11);
		break;
		}	  

		case(5):	// 5: Challenge_K mit C0 02
		{
		  Challenge_K[0]=0xC0;
		  Challenge_K[1]=0x02;
		  Challenge_K[2]=0x01;
		  Challenge_K[3]=0x02;
		  Challenge_K[4]=0x03;
		  Challenge_K[10]=IkaCounter;		  
	      OSEKTL_DataReq(Challenge_K,11);
		break;
		}
		
		case(9):	// 9: Challenge_K zu kurz
		{
		  Challenge_K[0]=0xC0;
		  Challenge_K[1]=0x01;
		  Challenge_K[2]=0x01;
		  Challenge_K[3]=0x02;
		  Challenge_K[4]=0x03;
		  Challenge_K[10]=IkaCounter;		  
	      OSEKTL_DataReq(Challenge_K,10);
		break;
		}

		case(10):	//10: Challenge_K zu lang
		{
		  Challenge_K[0]=0xC0;
		  Challenge_K[1]=0x01;
		  Challenge_K[2]=0x01;
		  Challenge_K[3]=0x02;
		  Challenge_K[4]=0x03;
		  Challenge_K[10]=IkaCounter;		  
	      OSEKTL_DataReq(Challenge_K,12);
		break;
		}

		case(13):	//13: Falscher IKA Counter in Challenge_K
		{
		  Challenge_K[0]=0xC0;
		  Challenge_K[1]=0x01;
		  Challenge_K[2]=0x01;
		  Challenge_K[3]=0x02;
		  Challenge_K[4]=0x03;
		  Challenge_K[10]=IkaCounter-1;		  //um 1 geringerer IKA-Counter als der empfangene
	      OSEKTL_DataReq(Challenge_K,11);
		break;
		}

		case(15):	//15: UDS Frame auf Challenge_M
		{
		  Challenge_K[0]=0x6e;	//positive Antwort auf Schlüsseldownload
		  Challenge_K[1]=0x00;
		  Challenge_K[2]=0xbe;		  
	      OSEKTL_DataReq(Challenge_K,3);
		break;
		}	
		
		case(17):	//17: 7f 80 01 35 xx 
		{
		  Challenge_K[0]=0x7f;	
		  Challenge_K[1]=0x80;
		  Challenge_K[2]=0x01;		  
	      Challenge_K[3]=0x35;		  
	      Challenge_K[4]=IkaCounter;		  
	      OSEKTL_DataReq(Challenge_K,5);
		break;
		}

		case(18):	//17: 7f 80 01 22 xx 
		{
		  Challenge_K[0]=0x7f;	
		  Challenge_K[1]=0x80;
		  Challenge_K[2]=0x01;		  
	      Challenge_K[3]=0x22;		  
	      Challenge_K[4]=IkaCounter;		  
	      OSEKTL_DataReq(Challenge_K,5);
		break;
		}

		case(19):	//19: 7f 80 01 21 xx 
		{
		  Challenge_K[0]=0x7f;	
		  Challenge_K[1]=0x80;
		  Challenge_K[2]=0x01;		  
	      Challenge_K[3]=0x21;		  
	      Challenge_K[4]=IkaCounter;		  
	      OSEKTL_DataReq(Challenge_K,5);
		break;
		}

		case(20):	//20: 7f 80 01 10 xx 
		{
		  Challenge_K[0]=0x7f;	
		  Challenge_K[1]=0x80;
		  Challenge_K[2]=0x01;		  
	      Challenge_K[3]=0x10;		  
	      Challenge_K[4]=IkaCounter;		  
	      OSEKTL_DataReq(Challenge_K,5);
		break;
		}

		case(25):	//25: 7f 80 01 88 xx 
		{
		  Challenge_K[0]=0x7f;	
		  Challenge_K[1]=0x80;
		  Challenge_K[2]=0x01;		  
	      Challenge_K[3]=0x88;		  
	      Challenge_K[4]=IkaCounter;		  
	      OSEKTL_DataReq(Challenge_K,5);
		break;
		}

		case(27):	//25: 7f 80 02 35 xx 
		{
		  Challenge_K[0]=0x7f;	
		  Challenge_K[1]=0x80;
		  Challenge_K[2]=0x02;		  
	      Challenge_K[3]=0x35;		  
	      Challenge_K[4]=IkaCounter;		  
	      OSEKTL_DataReq(Challenge_K,5);
		break;
		}
	  	
		case(28):	//25: 7f 80 02 22 xx 
		{
		  Challenge_K[0]=0x7f;	
		  Challenge_K[1]=0x80;
		  Challenge_K[2]=0x02;		  
	      Challenge_K[3]=0x22;		  
	      Challenge_K[4]=IkaCounter;		  
	      OSEKTL_DataReq(Challenge_K,5);
		break;
		}
		
		case(29):	//25: 7f 80 02 21 xx 
		{
		  Challenge_K[0]=0x7f;	
		  Challenge_K[1]=0x80;
		  Challenge_K[2]=0x02;		  
	      Challenge_K[3]=0x21;		  
	      Challenge_K[4]=IkaCounter;		  
	      OSEKTL_DataReq(Challenge_K,5);
		break;
		}
		
		case(30):	//25: 7f 80 02 10 xx 
		{
		  Challenge_K[0]=0x7f;	
		  Challenge_K[1]=0x80;
		  Challenge_K[2]=0x02;		  
	      Challenge_K[3]=0x10;		  
	      Challenge_K[4]=IkaCounter;		  
	      OSEKTL_DataReq(Challenge_K,5);
		break;
		}

		case(31):	//25: 7f 80 02 88 xx 
		{
		  Challenge_K[0]=0x7f;	
		  Challenge_K[1]=0x80;
		  Challenge_K[2]=0x02;		  
	      Challenge_K[3]=0x88;		  
	      Challenge_K[4]=IkaCounter;		  
	      OSEKTL_DataReq(Challenge_K,5);
		break;
		}


		default:
		{
		  Challenge_K[0]=0xC0;
		  Challenge_K[1]=0x01;
		  Challenge_K[2]=0x01;
		  Challenge_K[3]=0x02;
		  Challenge_K[4]=0x03;
		  Challenge_K[10]=IkaCounter;		  
	      OSEKTL_DataReq(Challenge_K,11);
		break;
		}
	  
	  }//switch
	  
	  
	}  	      

	if (bSlaveState==3)	//Send Response_K valid
	{  
	  
	  switch (Aktion)
	  {
	  	case(6):	// 6: Response_K mit 80 01
		{
		  Response_K[0]=0x80;
		  Response_K[1]=0x01;
		  Response_K[10]=IkaCounter;		  
	      OSEKTL_DataReq(Response_K,11);
		break;
		}
		
		case(7):	// 7: Response_K mit 80 02
		{
		  Response_K[0]=0x80;
		  Response_K[1]=0x02;
		  Response_K[10]=IkaCounter;		  
	      OSEKTL_DataReq(Response_K,11);
		break;
		}	  

		case(8):	// 8: Response_K mit C0 01
		{
		  Response_K[0]=0xC0;
		  Response_K[1]=0x01;
		  Response_K[10]=IkaCounter;		  
	      OSEKTL_DataReq(Response_K,11);
		break;
		}
		
		case(11):	// 11: Response_K zu kurz
		{
		  Response_K[0]=0xC0;
		  Response_K[1]=0x02;
		  Response_K[10]=IkaCounter;		  
	      OSEKTL_DataReq(Response_K,10);
		break;
		}

		case(12):	//10: Response_K zu lang
		{
		  Response_K[0]=0xC0;
		  Response_K[1]=0x02;
		  Response_K[10]=IkaCounter;		  
	      OSEKTL_DataReq(Response_K,12);
		break;
		}

		case(14):	//14: Falscher IKA Counter in Response_K
		{
		  Response_K[0]=0xC0;
		  Response_K[1]=0x02;
		  Response_K[10]=IkaCounter-1;		  //um 1 geringerer IKA-Counter als der empfangene
	      OSEKTL_DataReq(Response_K,11);
		break;
		}

		case(16):	//16: UDS Frame auf Repsonse_M
		{
		  Response_K[0]=0x6e;	//positive Antwort auf Schlüsseldownload
		  Response_K[1]=0x00;
		  Response_K[2]=0xbe;		  
	      OSEKTL_DataReq(Response_K,3);
		break;
		}	
		
		case(21):	//21: 7f 80 02 35 xx  
		{
		  Response_K[0]=0x7f;	
		  Response_K[1]=0x80;
		  Response_K[2]=0x02;		  
	      Response_K[3]=0x35;		  
	      Response_K[4]=IkaCounter;		  
	      OSEKTL_DataReq(Response_K,5);
		break;
		}

		case(22):	//22: 7f 80 02 22 xx  
		{
		  Response_K[0]=0x7f;	
		  Response_K[1]=0x80;
		  Response_K[2]=0x02;		  
	      Response_K[3]=0x22;		  
	      Response_K[4]=IkaCounter;		  
	      OSEKTL_DataReq(Response_K,5);
		break;
		}

		case(23):	//23: 7f 80 02 21 xx  
		{
		  Response_K[0]=0x7f;	
		  Response_K[1]=0x80;
		  Response_K[2]=0x02;		  
	      Response_K[3]=0x21;		  
	      Response_K[4]=IkaCounter;		  
	      OSEKTL_DataReq(Response_K,5);
		break;
		}

		case(24):	//24: 7f 80 02 10 xx  
		{
		  Response_K[0]=0x7f;	
		  Response_K[1]=0x80;
		  Response_K[2]=0x02;		  
	      Response_K[3]=0x10;		  
	      Response_K[4]=IkaCounter;		  
	      OSEKTL_DataReq(Response_K,5);
		break;
		}

		case(26):	//26: 7f 80 02 88 xx  
		{
		  Response_K[0]=0x7f;	
		  Response_K[1]=0x80;
		  Response_K[2]=0x02;		  
	      Response_K[3]=0x88;		  
	      Response_K[4]=IkaCounter;		  
	      OSEKTL_DataReq(Response_K,5);
		break;
		}

		case(32):	//32: 7f 80 01 35 xx  
		{
		  Response_K[0]=0x7f;	
		  Response_K[1]=0x80;
		  Response_K[2]=0x01;		  
	      Response_K[3]=0x35;		  
	      Response_K[4]=IkaCounter;		  
	      OSEKTL_DataReq(Response_K,5);
		break;
		}

		case(33):	//33: 7f 80 01 22 xx  
		{
		  Response_K[0]=0x7f;	
		  Response_K[1]=0x80;
		  Response_K[2]=0x01;		  
	      Response_K[3]=0x22;		  
	      Response_K[4]=IkaCounter;		  
	      OSEKTL_DataReq(Response_K,5);
		break;
		}

		case(34):	//34: 7f 80 01 21 xx  
		{
		  Response_K[0]=0x7f;	
		  Response_K[1]=0x80;
		  Response_K[2]=0x01;		  
	      Response_K[3]=0x21;		  
	      Response_K[4]=IkaCounter;		  
	      OSEKTL_DataReq(Response_K,5);
		break;
		}
		
		case(35):	//35: 7f 80 01 10 xx  
		{
		  Response_K[0]=0x7f;	
		  Response_K[1]=0x80;
		  Response_K[2]=0x01;		  
	      Response_K[3]=0x10;		  
	      Response_K[4]=IkaCounter;		  
	      OSEKTL_DataReq(Response_K,5);
		break;
		}
		
		case(36):	//36: 7f 80 01 88 xx  
		{
		  Response_K[0]=0x7f;	
		  Response_K[1]=0x80;
		  Response_K[2]=0x01;		  
	      Response_K[3]=0x88;		  
	      Response_K[4]=IkaCounter;		  
	      OSEKTL_DataReq(Response_K,5);
		break;
		}


	  	default:
		{
		  Response_K[0]=0xc0;
	  	  Response_K[1]=0x02;
	      Response_K[10]=IkaCounter;		  
	      OSEKTL_DataReq(Response_K,11);
		break;
		}
	  
	  }//switch
	  
	}

	if (bSlaveState==4)	//Send Response_K invalid
	{  
	  Response_K[0]=0x7f;
	  Response_K[1]=0x80;
	  Response_K[2]=0x02;
	  Response_K[3]=0x35; //invalid Key	
	  Response_K[4]=IkaCounter;		  
	  OSEKTL_DataReq(Response_K,5);
	}

	if (bSlaveState==5)	//Send negative Response, if Challenge_M not correct
	{  
	  Challenge_K_Neg[3]=0x22; //KWP2000 Response Code "request sequence error"		  
	  Challenge_K_Neg[4]=IkaCounter;		  
	  OSEKTL_DataReq(Challenge_K_Neg,5);
	}  	      

	
	if (bSlaveState==6)	//Send negative Response, if Response_M not correct
	{  
	  Response_K_Neg[3]=0x22; //KWP2000 Response Code "request sequence error"		  
	  Response_K_Neg[4]=IkaCounter;		  
	  OSEKTL_DataReq(Response_K_Neg,5);
	}  	      


	if (bSlaveState==7)	//Send negative Response, if Challenge_M not correct
	{  
	  Challenge_K_Neg[3]=0x10; //KWP2000 Response Code "general reject"		  
	  Challenge_K_Neg[4]=0;//IkaCounter;		  
	  OSEKTL_DataReq(Challenge_K_Neg,5);
	}  	      

	
	if (bSlaveState==8)	//Send negative Response, if Response_M not correct
	{  
	  Response_K_Neg[3]=0x10; //KWP2000 Response Code "gerneral reject"		  
	  Response_K_Neg[4]=0;//IkaCounter;		  
	  OSEKTL_DataReq(Response_K_Neg,5);
	}

}
/*@@end*/

/*@@caplFunc:OSEKTL_ErrorInd(int):*///callback
OSEKTL_ErrorInd(int error)
{
  switch (error)
  {
    case 1:     write("CAPL: %s: Error (%d): Timeout while waiting for CF", gECU, error);     break;
    case 2:     write("CAPL: %s: Error (%d): Timeout while waiting for FC", gECU, error);     break;
    case 3:     write("CAPL: %s: Error (%d): Wrong Sequence Number", gECU, error);            break;
    case 4:     write("CAPL: %s: Error (%d): TP_DLL busy", gECU, error);                      break;
    case 5:     write("CAPL: %s: Error (%d): Unexpected PDU", gECU, error);                   break;
    case 6:     write("CAPL: %s: Error (%d): Timeout while waiting for Tx-Ack", gECU, error); break;
    case 7:     write("CAPL: %s: Error (%d): WFT Overrun", gECU, error);                      break;
    case 8:     write("CAPL: %s: Error (%d): Buffer overflow", gECU, error); break;
    case 9:     write("CAPL: %s: Error (%d): Wrong parameter", gECU, error);                      break;    
    default:    write("CAPL: %s: Error (%d): unknown error", gECU, error);                    break;
  }
}
/*@@end*/

/*@@envVar:evSLValidIka:*/
on envVar evSLValidIka
{

	if (getValue(this) == 1)
	{
	
	  LedReset();
	  putValue(evSLValidIka_Led,2);
	  Aktion=1; //Valid IKA
	}



}
/*@@end*/

/*@@caplFunc:LedReset():*///function
LedReset ()
{

	putValue(evSLValidIka_Led,0);
	putValue(evSLInvalidIka_Led,0);
	putValue(evSLChK8001_Led,0);
	putValue(evSLChK8002_Led,0);
	putValue(evSLChKC002_Led,0);
	putValue(evSLRsK8001_Led,0);
	putValue(evSLRsK8002_Led,0);
	putValue(evSLRsKC001_Led,0);
	putValue(evSLRsKlang_Led,0);
	putValue(evSLRsKkurz_Led,0);
	putValue(evSLChKlang_Led,0);
	putValue(evSLChKkurz_Led,0);
	putValue(evSLICChK_Led,0);
	putValue(evSLICRsK_Led,0);
	putValue(evSLUdsChM_Led,0);
	putValue(evSLUdsRsM_Led,0);
	putValue(evSLChMNeg35_Led,0);
	putValue(evSLChMNeg22_Led,0);
	putValue(evSLChMNeg21_Led,0);
	putValue(evSLChMNeg10_Led,0);
	putValue(evSLChMNeg88_Led,0);
	
	putValue(evSLChMNeg35_2_Led,0);
	putValue(evSLChMNeg22_2_Led,0);
	putValue(evSLChMNeg21_2_Led,0);
	putValue(evSLChMNeg10_2_Led,0);
	putValue(evSLChMNeg88_2_Led,0);
	
	putValue(evSLRsMNeg35_Led,0);
	putValue(evSLRsMNeg22_Led,0);
	putValue(evSLRsMNeg21_Led,0);
	putValue(evSLRsMNeg10_Led,0);
	putValue(evSLRsMNeg88_Led,0);
	
	putValue(evSLRsMNeg35_1_Led,0);
	putValue(evSLRsMNeg22_1_Led,0);
	putValue(evSLRsMNeg21_1_Led,0);
	putValue(evSLRsMNeg10_1_Led,0);
	putValue(evSLRsMNeg88_1_Led,0);
		



}
/*@@end*/

/*@@envVar:evSLInvalidIka:*/
on envVar evSLInvalidIka
{

	if (getValue(this) == 1)
	{
	
	  LedReset();
	  putValue(evSLInvalidIka_Led,2);
	  Aktion=2; //Invalid IKA
	}



}
/*@@end*/

/*@@envVar:evSLChK8001:*/
on envVar evSLChK8001
{

	if (getValue(this) == 1)
	{
	
	  LedReset();
	  putValue(evSLChK8001_Led,2);
	  Aktion=3; //Challenge_K mit 80 01
	}

}
/*@@end*/

/*@@envVar:evSLChK8002:*/
on envVar evSLChK8002
{

	if (getValue(this) == 1)
	{
	
	  LedReset();
	  putValue(evSLChK8002_Led,2);
	  Aktion=4; //Challenge_K mit 80 02
	}



}
/*@@end*/

/*@@envVar:evSLChKC002:*/
on envVar evSLChKC002
{

	if (getValue(this) == 1)
	{
	
	  LedReset();
	  putValue(evSLChKC002_Led,2);
	  Aktion=5; //Challenge_K mit C0 02
	}



}
/*@@end*/

/*@@envVar:evSLRsK8001:*/
on envVar evSLRsK8001
{

	if (getValue(this) == 1)
	{
	
	  LedReset();
	  putValue(evSLRsK8001_Led,2);
	  Aktion=6; //Response_K mit 80 01
	}



}
/*@@end*/

/*@@envVar:evSLRsK8002:*/
on envVar evSLRsK8002
{

	if (getValue(this) == 1)
	{
	
	  LedReset();
	  putValue(evSLRsK8002_Led,2);
	  Aktion=7; //Response_K mit 80 02
	}



}
/*@@end*/

/*@@envVar:evSLRsKC001:*/
on envVar evSLRsKC001
{

	if (getValue(this) == 1)
	{
	
	  LedReset();
	  putValue(evSLRsKC001_Led,2);
	  Aktion=8; //Response_K mit C0 01
	}



}
/*@@end*/

/*@@envVar:evSLChKkurz:*/
on envVar evSLChKkurz
{

	if (getValue(this) == 1)
	{
	
	  LedReset();
	  putValue(evSLChKkurz_Led,2);
	  Aktion=9; //Challenge_K zu kurz
	}



}
/*@@end*/

/*@@envVar:evSLChKlang:*/
on envVar evSLChKlang
{

	if (getValue(this) == 1)
	{
	
	  LedReset();
	  putValue(evSLChKlang_Led,2);
	  Aktion=10; //Challenge_K zu lang
	}



}
/*@@end*/

/*@@envVar:evSLRsKkurz:*/
on envVar evSLRsKkurz
{

	if (getValue(this) == 1)
	{
	
	  LedReset();
	  putValue(evSLRsKkurz_Led,2);
	  Aktion=11; //Response_K zu kurz
	}



}
/*@@end*/

/*@@envVar:evSLRsKlang:*/
on envVar evSLRsKlang
{

	if (getValue(this) == 1)
	{
	
	  LedReset();
	  putValue(evSLRsKlang_Led,2);
	  Aktion=12; //Response_K zu lang
	}



}
/*@@end*/

/*@@envVar:evSLICChK:*/
on envVar evSLICChK
{

	if (getValue(this) == 1)
	{
	
	  LedReset();
	  putValue(evSLICChK_Led,2);
	  Aktion=13; //13: Falscher IKA Counter in Challenge_K
	}

}
/*@@end*/

/*@@envVar:evSLICRsK:*/
on envVar evSLICRsK
{

	if (getValue(this) == 1)
	{
	
	  LedReset();
	  putValue(evSLICRsK_Led,2);
	  Aktion=14; //14: Falscher IKA Counter in Response_K
	}

}
/*@@end*/

/*@@envVar:evSLChMNeg35:*/
on envVar evSLChMNeg35
{

	if (getValue(this) == 1)
	{
	
	  LedReset();
	  putValue(evSLChMNeg35_Led,2);
	  Aktion=17; //7f 80 01 35 xx 
	}

}
/*@@end*/

/*@@envVar:evSLChMNeg22:*/
on envVar evSLChMNeg22
{

	if (getValue(this) == 1)
	{
	
	  LedReset();
	  putValue(evSLChMNeg22_Led,2);
	  Aktion=18; //7f 80 01 22 xx 
	}

}
/*@@end*/

/*@@envVar:evSLChMNeg21:*/
on envVar evSLChMNeg21
{

	if (getValue(this) == 1)
	{
	
	  LedReset();
	  putValue(evSLChMNeg21_Led,2);
	  Aktion=19; //7f 80 01 21 xx 
	}

}
/*@@end*/

/*@@envVar:evSLChMNeg10:*/
on envVar evSLChMNeg10
{

	if (getValue(this) == 1)
	{
	
	  LedReset();
	  putValue(evSLChMNeg10_Led,2);
	  Aktion=20; //7f 80 01 10 xx 
	}

}
/*@@end*/

/*@@envVar:evSLRsMNeg35:*/
on envVar evSLRsMNeg35
{

	if (getValue(this) == 1)
	{
	
	  LedReset();
	  putValue(evSLRsMNeg35_Led,2);
	  Aktion=21; //7f 80 02 35 xx 
	}

}
/*@@end*/

/*@@envVar:evSLRsMNeg22:*/
on envVar evSLRsMNeg22
{

	if (getValue(this) == 1)
	{
	
	  LedReset();
	  putValue(evSLRsMNeg22_Led,2);
	  Aktion=22; //7f 80 02 22 xx 
	}

}
/*@@end*/

/*@@envVar:evSLRsMNeg21:*/
on envVar evSLRsMNeg21
{

	if (getValue(this) == 1)
	{
	
	  LedReset();
	  putValue(evSLRsMNeg21_Led,2);
	  Aktion=23; //7f 80 02 21 xx 
	}

}
/*@@end*/

/*@@envVar:evSLRsMNeg10:*/
on envVar evSLRsMNeg10
{

	if (getValue(this) == 1)
	{
	
	  LedReset();
	  putValue(evSLRsMNeg10_Led,2);
	  Aktion=24; //7f 80 02 10 xx 
	}

}
/*@@end*/

/*@@envVar:evSLUdsChM:*/
on envVar evSLUdsChM
{

	if (getValue(this) == 1)
	{
	
	  LedReset();
	  putValue(evSLUdsChM_Led,2);
	  Aktion=15; //15: UDS Frame auf Challenge_M
	}

}
/*@@end*/

/*@@envVar:evSLUdsRsM:*/
on envVar evSLUdsRsM
{

	if (getValue(this) == 1)
	{
	
	  LedReset();
	  putValue(evSLUdsRsM_Led,2);
	  Aktion=16; //16: UDS Frame auf Response_M
	}

}
/*@@end*/

/*@@envVar:evSLRsMNeg88:*/
on envVar evSLRsMNeg88
{

	if (getValue(this) == 1)
	{
	
	  LedReset();
	  putValue(evSLRsMNeg88_Led,2);
	  Aktion=26; //7f 80 02 88 xx 
	}

}
/*@@end*/

/*@@envVar:evSLChMNeg88:*/
on envVar evSLChMNeg88
{

	if (getValue(this) == 1)
	{
	
	  LedReset();
	  putValue(evSLChMNeg88_Led,2);
	  Aktion=25; //7f 80 01 88 xx 
	}

}
/*@@end*/

/*@@envVar:evSLChMNeg35_2:*/
on envVar evSLChMNeg35_2
{

	if (getValue(this) == 1)
	{
	
	  LedReset();
	  putValue(evSLChMNeg35_2_Led,2);
	  Aktion=27; //7f 80 02 35 xx 
	}

}
/*@@end*/

/*@@envVar:evSLChMNeg22_2:*/
on envVar evSLChMNeg22_2
{

	if (getValue(this) == 1)
	{
	
	  LedReset();
	  putValue(evSLChMNeg22_2_Led,2);
	  Aktion=28; //7f 80 02 22 xx 
	}

}
/*@@end*/

/*@@envVar:evSLChMNeg21_2:*/
on envVar evSLChMNeg21_2
{

	if (getValue(this) == 1)
	{
	
	  LedReset();
	  putValue(evSLChMNeg21_2_Led,2);
	  Aktion=29; //7f 80 02 21 xx 
	}

}
/*@@end*/

/*@@envVar:evSLChMNeg10_2:*/
on envVar evSLChMNeg10_2
{

	if (getValue(this) == 1)
	{
	
	  LedReset();
	  putValue(evSLChMNeg10_2_Led,2);
	  Aktion=30; //7f 80 02 10 xx 
	}

}
/*@@end*/

/*@@envVar:evSLChMNeg88_2:*/
on envVar evSLChMNeg88_2
{

	if (getValue(this) == 1)
	{
	
	  LedReset();
	  putValue(evSLChMNeg88_2_Led,2);
	  Aktion=31; //7f 80 02 88 xx 
	}

}
/*@@end*/

/*@@envVar:evSLRsMNeg35_1:*/
on envVar evSLRsMNeg35_1
{

	if (getValue(this) == 1)
	{
	
	  LedReset();
	  putValue(evSLRsMNeg35_1_Led,2);
	  Aktion=32; //7f 80 01 35 xx 
	}

}
/*@@end*/

/*@@envVar:evSLRsMNeg22_1:*/
on envVar evSLRsMNeg22_1
{

	if (getValue(this) == 1)
	{
	
	  LedReset();
	  putValue(evSLRsMNeg22_1_Led,2);
	  Aktion=33; //7f 80 01 22 xx 
	}

}
/*@@end*/

/*@@envVar:evSLRsMNeg21_1:*/
on envVar evSLRsMNeg21_1
{

	if (getValue(this) == 1)
	{
	
	  LedReset();
	  putValue(evSLRsMNeg21_1_Led,2);
	  Aktion=34; //7f 80 01 21 xx 
	}

}
/*@@end*/

/*@@envVar:evSLRsMNeg10_1:*/
on envVar evSLRsMNeg10_1
{

	if (getValue(this) == 1)
	{
	
	  LedReset();
	  putValue(evSLRsMNeg10_1_Led,2);
	  Aktion=35; //7f 80 01 10 xx 
	}

}
/*@@end*/

/*@@envVar:evSLRsMNeg88_1:*/
on envVar evSLRsMNeg88_1
{

	if (getValue(this) == 1)
	{
	
	  LedReset();
	  putValue(evSLRsMNeg88_1_Led,2);
	  Aktion=36; //7f 80 01 88 xx 
	}

}
/*@@end*/

/*@@envVar:evTA:*/
on envVar evTA
{
    OSEKTL_SetEcuNumber(getvalue(this));
}
/*@@end*/

/*@@envVar:evUseExtIds:*/
on envVar evUseExtIds
{
	if (getValue(this)==1)  //29-Bit IDs with normal addressing
	{
        OSEKTL_SetNrmlMode();
        OSEKTL_UseExtId(1);
	}

	if (getValue(this)==0)  //29-Bit IDs with normal addressing
	{
        OSEKTL_SetExtMode();	//For this node extended adressing is used
        OSEKTL_UseExtId(0);
        OSEKTL_SetTgtAdr(MASTERECUNUMBER);
	}
}
/*@@end*/

/*@@envVar:evIsoReqId:*/
on envVar evIsoReqId
{
    bKnotenAdresse = (byte)getValue(this);
    OSEKTL_SetTxId(KS_EXT_ID_NORM_ADDR_RES_BASE + bKnotenAdresse);
    OSEKTL_SetRxId(KS_EXT_ID_NORM_ADDR_REQ_BASE + bKnotenAdresse);
}
/*@@end*/

/*@@msg:*:*/
on message *
{

    if(this.id == 0x17fc0146x)
        write("Slave received: %x",this.id);


    //if(this.id == 0x17fe0146x)
        //write("%x",this.id);
}
/*@@end*/

