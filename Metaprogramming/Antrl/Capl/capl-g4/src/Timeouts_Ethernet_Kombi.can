/*@!Encoding:1252*/
variables
{
  msTimer EthStatus;  
}

on preStart
{
  EthControlInit  ();
}

on start
{
  // SOME/IP & Navi PDUs deaktivieren
  @IL_ETH1::PDU_FIEnableTXofPDU::ETH_Cluster_MEB_Kombi_SimulatedPeerNodes_RTP_NavMainMap_Info_El_XIX_E3V_VLAN_Infotainment              = 0;
  @IL_ETH1::PDU_FIEnableTXofPDU::ETH_Cluster_MEB_Kombi_SimulatedPeerNodes_ServiceDiscoverySomeIP_ICAS1Gateway_XIX_E3V_VLAN_Infotainment = 0;
  
  Global_IL_Timeout(0);
  Global_IL_Timeout(1);
  
  settimercyclic (EthStatus, 100);
}

on timer EthStatus
{
  if ( EthGetAdapterStatus() == 2 )
    @Env_Ethernet_active = 1;
  else
    @Env_Ethernet_active = 0;
  
    
//  switch (EthGetAdapterStatus())
//  {
//    case 0: write("Adapter status unknown"); break;
//    case 1: write("Adapter is not connected"); break;
//    case 2: write("Adapter is connected"); break;
//  }
}


on envVar Env_GlobalAppl
{
  if ( (@Env_GlobalAppl == 1) || (@Env_GlobalNMH == 1) )
    Global_IL_Timeout(0);
  else
    Global_IL_Timeout(1);
}

on envVar Env_GlobalNMH
{
  if ( (@Env_GlobalAppl == 1) || (@Env_GlobalNMH == 1) )
    Global_IL_Timeout(0);
  else
    Global_IL_Timeout(1);
}

Global_IL_Timeout(byte timeout)
{
  byte info;

  @IL_ETH1::EnableNode::Kombi_SimulatedPeerNodes                                = !timeout;
  //@_NMControl::ETH_Cluster_MEB::Nodes::Kombi_SimulatedPeerNodes::RequestIL    = !timeout;
  @NM_ETH1::Kombi_SimulatedPeerNodes::DeactivateNM                              =  timeout;
  @EnvKlemme15                                                                  = !timeout;

  
  if (timeout == 0)
  {
    EthControlStart ();
  }

  if (timeout == 1)
  {
    EthControlStop ();
  }
}