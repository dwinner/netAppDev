/*@!Encoding:1252*/
variables
{
  double aadCharacteristicDelogPT[5][2]
   = { {   0,   0 }
     , {  50,  50 }
     , { 100, 100 }
     , { 200, 200 }
     , { 253, 500 }
     };

  double aadCharacteristicFMin[2][2]
   = { {   8,   8 }
     , { 220, 100 }
     };

  double aadCharacteristicFMax[2][2]
   = { {   8,  18 }
     , { 200, 100 }
     };

  double aadCharacteristicLogKl58d[6][2]
   = { {   0,   0 }
     , {   6,  10 }
     , {  16, 100 }
     , {  30, 150 }
     , {  60, 220 }
     , { 100, 253 }
     };

	   double aadRPMTest[10][4]
   = { {1200, 1203, 4, 50}
     , {5748, 5751, 4, 50}
     , {1500, 1503, 4, 50}
     , {999, 1002, 4, 50}     
     , {3249, 3252, 4, 50}
     , {6600, 6603, 4, 50}
     , {1398, 1401, 4, 50}     
     , {4998, 5001, 4, 50}
     , {999, 1002, 4, 50}     
     , {3249, 3252, 4, 50}
     };

	 double aadSpeedTest[10][4]
   = { {39.7, 40.3, 4, 50}
     , {210.0, 210.6, 4, 50}
     , {39.7, 40.3, 4, 50}
     , {210.0, 210.1, 1, 300}
     , {25.0, 25.1, 1, 300}     
     , {100.0, 100.1, 1, 300}
     , {210.0, 210.3, 1, 300}
     , {25.0, 25.3, 1, 300}     
     , {100.0, 100.3, 1, 300}
     , {25.0, 25.2, 1, 300}
     };

  msTimer tPRMSpeedTest;
  msTimer tRPMSweep;
  dword dwRPMStep;
  double dRPMStart;
  double dRPMEnd;

  msTimer tSpeedSweep;
  dword dwSpeedStep;
  double dSpeedStart;
  double dSpeedEnd;
  
  msTimer tPowermeterSweep;
  dword dwPowermeterStep;
  double dPowermeterStart;
  double dPowermeterEnd;

  double dYardsPerMile;
  double dKilometersPerMile;
  double dSpeedFactor;

  msTimer tMflCycleSend;
  msTimer tWheelLeftRelease;
  msTimer tWheelRightRelease;
  msTimer tDoubleClick;
  msTimer tLongPress;
  msTimer tDelayedKey;
  byte    bLastMflCode;
  byte    bCurrMflCode;
  byte    bDelayedMflCode = 0;
  byte    bLongPressState = 0;
  byte    bMflCycleCount = 0;
  const int iMflCycleTime = 1000;
  const byte bMflNullFrameCount = 5;
  const int iDoubleclickTime = 250;  // TODO: evtl. EnvVar?
  const int iWheelReleaseTime = 100; // 50;
  const int iLongPress1Time = 800;
  const int iLongPress2Time = 2000;
  const int iLongPress3Time = 3000;
  // key codes
  const byte enKeyReleased = 0;
  const byte enKeyMenu = 1;
  const byte enKeyMenuUp = 2;
  const byte enKeyMenuDown = 3;
  const byte enKeyUp = 4;
  const byte enKeyDown = 5;
  const byte enKeyUpDownWheelLeft = 6;
  const byte enKeyOKWheelLeft = 7;
  const byte enKeyCancel = 8;
  //MR 61808
  const byte enKeyFAS_Taster = 0x0C;

  const byte enKeyVolumeUp = 0x10;
  const byte enKeyVolumeDown = 0x11;
  const byte enKeyUpDownWheelRight = 0x12;
  const byte enKeyOKWheelRight = 0x13;
  const byte enKeyAudioSource = 0x14;
  const byte enKeyAUp = 0x15;
  const byte enKeyADown = 0x16;
  const byte enKeyBUp = 0x17;
  const byte enKeyBDown = 0x18;
  const byte enKeyPtt = 0x19;
  const byte enKeyPttCancel = 0x1a;
  const byte enKeyRouteInfo = 0x1B;
  const byte enKeyHook = 0x1C;
  const byte enKeyHangUp = 0x1D;
  const byte enKeyOffHook = 0x1E;
  const byte enKeyLightOnOff = 0x1F;
  const byte enKeyMute = 0x20;
  const byte enKeyJoker1= 0x21;
  const byte enKeyJoker2= 0x22;
    //MR 77727
  const byte enKeyView = 0x23;
  const byte enMfaReset = 0xf0;
  //VAGH-26971
  const byte enKeyMainMenu = 0x09;
  const byte enKeySideMenuleft = 0x0A;
  const byte enKeySideMenuright = 0x0B;
  const byte enKeyExhaustSound = 0x6F;
  const byte enKeyDriveSelectbutton = 0x70;
  const byte enKeySportbutton = 0x71;
  const byte enKeyESPDriftSelection = 0x72;
  // key events
  const byte enKeyPressed = 1;
  const byte enDoubleClick = 3;
  const byte enLongPress1 = 4;
  const byte enLongPress2 = 5;
  const byte enLongPress3 = 6;
  const byte enWheel1TickUp = 1;
  const byte enWheel2TickUp = 2;
  const byte enWheel3TickUp = 3;
  const byte enWheel4TickUp = 4;
  const byte enWheel5TickUp = 5;
  const byte enWheel6TickUp = 6;
  const byte enWheel7TickUp = 7;
  const byte enWheel7TickDown = 9;
  const byte enWheel6TickDown = 10;
  const byte enWheel5TickDown = 11;
  const byte enWheel4TickDown = 12;
  const byte enWheel3TickDown = 13;
  const byte enWheel2TickDown = 14;
  const byte enWheel1TickDown = 15;
  const byte enWheelLeft = 1;
  const byte enWheelRight = 2;

  byte enTestCount = 10;

  msTimer tIndicator;

  msTimer BusOffTimer;

  msTimer KeyReleaseTimer;

  word FirstKey = 0;
  word LastKey = 0; 

  msTimer mode_switch_timer;
  message Speed_RPM _mSpeed_RPM;

 }

on start
{
  char acReleaseNotesFile[64] = "release notes.txt";
  char acVersionInfo[64];

  char acHelp[32768] = "";
  char acHelpFile[64] = "Speed+RPM_Help.txt";
  dword dwHelpFile;
  char acHelpLine[256];

  getProFileString( "CurrentVersion", "CurrentVersiontxt", "undefined...", acVersionInfo, elcount( acVersionInfo ), acReleaseNotesFile );
  putValue( ENV_VersionInfo, acVersionInfo );
  
  

  dwHelpFile = openFileRead( acHelpFile, /*binary*/1 );
  if( dwHelpFile)
  {
    while (fileGetStringSZ( acHelpLine, elcount( acHelpLine ), dwHelpFile ))
    {
      if( acHelp[0])  strncat( acHelp, "\r\n", elcount( acHelp ) );
      strncat( acHelp, acHelpLine, elcount( acHelp ) );
    }
    fileClose( dwHelpFile );
  }
  else
  {
    strncat( acHelp, "help file ", elcount( acHelp ) );
    strncat( acHelp, acHelpFile, elcount( acHelp ) );
    strncat( acHelp, " missing", elcount( acHelp ) );
  }
  putValue( ENV_SpeedRpmHelp, acHelp );

  dYardsPerMile      = 1760.0;
  dKilometersPerMile = 1.609375; // = 412 / 256 im Gegensatz zur echten US-amerikanischen Statute Mile mit 1.609344 km
  dSpeedFactor       = 1.0;

  putValue( ENV_RPMSweep,  getProfileInt( "Sweeps", "ENV_RPMSweep",      0, "RBS.ini" ) );
  putValue( ENV_RPMRandom, getProfileInt( "Sweeps", "ENV_RPMRandom",     0, "RBS.ini" ) );
  putValue( ENV_RPMStart,  getProfileInt( "Sweeps", "ENV_RPMStart",      0, "RBS.ini" ) );
  putValue( ENV_RPMEnd,    getProfileInt( "Sweeps", "ENV_RPMEnd",    10000, "RBS.ini" ) );
  putValue( ENV_RPMSteps,  getProfileInt( "Sweeps", "ENV_RPMSteps",     10, "RBS.ini" ) );
  putValue( ENV_RPMTime,   getProfileInt( "Sweeps", "ENV_RPMTime",     250, "RBS.ini" ) );

  putValue( ENV_SpeedInputIsMetric, 1 );
  putValue( ENV_SpeedInputIsMetric, getProfileInt(   "Sweeps", "ENV_SpeedInputIsMetric",     0, "RBS.ini" ) );
  putValue( ENV_Speed,              getProfileFloat( "Sweeps", "ENV_Speed",                0, "RBS.ini" ) );

  putValue( ENV_SpeedPulseCorrelation, getProfileInt(   "Sweeps", "ENV_SpeedPulseCorrelation",  0, "RBS.ini" ) );
  putValue( ENV_SpeedSingleSteps,      getProfileInt(   "Sweeps", "ENV_SpeedSingleSteps",       0, "RBS.ini" ) );
  putValue( ENV_SpeedSweep,            getProfileInt(   "Sweeps", "ENV_SpeedSweep",             0, "RBS.ini" ) );
  putValue( ENV_SpeedRandom,           getProfileInt(   "Sweeps", "ENV_SpeedRandom",            0, "RBS.ini" ) );
  putValue( ENV_SpeedStart,            getProfileFloat( "Sweeps", "ENV_SpeedStart",             0, "RBS.ini" ) );
  putValue( ENV_SpeedEnd,              getProfileFloat( "Sweeps", "ENV_SpeedEnd",             320, "RBS.ini" ) );
  putValue( ENV_SpeedSteps,            getProfileInt(   "Sweeps", "ENV_SpeedSteps",            20, "RBS.ini" ) );
  putValue( ENV_SpeedTime,             getProfileInt(   "Sweeps", "ENV_SpeedTime",            250, "RBS.ini" ) );
  putValue( ENV_SpeedPulsesInput,      getProfileInt(   "Sweeps", "ENV_SpeedPulsesInput",      10, "RBS.ini" ) );
  putValue( ENV_SpeedDistanceInput,    getProfileFloat( "Sweeps", "ENV_SpeedDistanceInput",     0, "RBS.ini" ) );
  
  putValue( ENV_PowermeterSweep,            getProfileInt(   "Sweeps", "ENV_PowermeterSweep",             0, "RBS.ini" ) );
  putValue( ENV_PowermeterRandom,           getProfileInt(   "Sweeps", "ENV_PowermeterRandom",            0, "RBS.ini" ) );
  putValue( ENV_PowermeterStart,            getProfileFloat( "Sweeps", "ENV_PowermeterStart",             0, "RBS.ini" ) );
  putValue( ENV_PowermeterEnd,              getProfileFloat( "Sweeps", "ENV_PowermeterEnd",             4093, "RBS.ini" ) );
  putValue( ENV_PowermeterSteps,            getProfileInt(   "Sweeps", "ENV_PowermeterSteps",            20, "RBS.ini" ) );
  putValue( ENV_PowermeterTime,             getProfileInt(   "Sweeps", "ENV_PowermeterTime",            250, "RBS.ini" ) );

  putValue( ENV_WheelCircumferenceMax,      getProfileInt(   "Sweeps", "ENV_WheelCircumferenceMax",      2134, "RBS.ini" ) );
  putValue( ENV_WheelCircumferenceAvg,      getProfileInt(   "Sweeps", "ENV_WheelCircumferenceAvg",      2104, "RBS.ini" ) );
  putValue( KCAN_ESP_Zaehnezahl,            getProfileInt(   "Sweeps", "KCAN_ESP_Zaehnezahl",              20, "RBS.ini" ) );

  putValue( ENV_SpeedPulses,       0 );
  putValue( ENV_DistancePulseAccu, 0 );

  putValue( ENV_Consumption,                getProfileFloat( "Sweeps", "ENV_Consumption",                   0, "RBS.ini" ) );
  putValue( ENV_GasConsumption,             getProfileFloat( "Sweeps", "ENV_GasConsumption",                0, "RBS.ini" ) );

  putValue( ENV_NMHStateMachineEnabled, getProfileInt( "NMHigh", "ENV_NMHStateMachineEnabled", 1, "RBS.ini" ) );
  putValue( ENV_NMHControllerNodeAwake, getProfileInt( "NMHigh", "ENV_NMHControllerNodeAwake", 1, "RBS.ini" ) );

  putValue( ENV_CalculateKl58d,         getProfileInt( "Dimming", "ENV_CalculateKl58d",        1, "RBS.ini" ) );

  putValue( ENV_IndicatorOnTime,        getProfileInt( "Indicator", "ENV_IndicatorOnTime",   400, "RBS.ini" ) );
  putValue( ENV_IndicatorOffTime,       getProfileInt( "Indicator", "ENV_IndicatorOffTime",  300, "RBS.ini" ) );

  putValue( ENV_SendMfl,                getProfileInt( "MFL",       "ENV_SendMfl",             1, "RBS.ini" ) );

  putValue( KCAN_MFL_Tastencode_1, 0 );
  putValue( KCAN_MFL_Eventcode_1, 0 );
  putValue( KCAN_MFL_Tastencode_2, 0 );
  putValue( KCAN_MFL_Eventcode_2, 0 );
  putValue( KCAN_LSS_Tastencode, 0);
  bLastMflCode = 0;
  bCurrMflCode = 0;
  bDelayedMflCode = 0;
  bLongPressState = 0;  

  enableControl ("Speed+RPM", "EnvVar:ENV_RPMSpeedTestTimer", 1);
  /* Enabling and Disabling MFL/LSS Keys */
  if( getValue(ENV_MFL_LSS_switch) == 2)  //LSS Mode
  {
      enableControl ("MFL/LSS", "EnvVar:ENV_KeyJoker1State", 0);
      enableControl ("MFL/LSS", "EnvVar:ENV_KeyJoker2State", 0);
      enableControl ("MFL/LSS", "EnvVar:ENV_KeyVolUpState", 0);  
      enableControl ("MFL/LSS", "EnvVar:ENV_KeyVolDownState", 0);  
      enableControl ("MFL/LSS", "EnvVar:ENV_KeyWheelEventCodeRight_M1", 0);    
      enableControl ("MFL/LSS", "EnvVar:ENV_KeyWheelEventCodeRight_M2", 0);    
      enableControl ("MFL/LSS", "EnvVar:ENV_KeyWheelEventCodeRight_M3", 0);    
      enableControl ("MFL/LSS", "EnvVar:ENV_KeyWheelEventCodeRight_M4", 0);    
      enableControl ("MFL/LSS", "EnvVar:ENV_KeyWheelEventCodeRight_M5", 0);    
      enableControl ("MFL/LSS", "EnvVar:ENV_KeyWheelEventCodeRight_M6", 0);    
      enableControl ("MFL/LSS", "EnvVar:ENV_KeyWheelEventCodeRight_M7", 0);
      enableControl ("MFL/LSS", "EnvVar:ENV_KeyWheelEventCodeRight_P1", 0);
      enableControl ("MFL/LSS", "EnvVar:ENV_KeyWheelEventCodeRight_P2", 0);
      enableControl ("MFL/LSS", "EnvVar:ENV_KeyWheelEventCodeRight_P3", 0);
      enableControl ("MFL/LSS", "EnvVar:ENV_KeyWheelEventCodeRight_P4", 0);
      enableControl ("MFL/LSS", "EnvVar:ENV_KeyWheelEventCodeRight_P5", 0);
      enableControl ("MFL/LSS", "EnvVar:ENV_KeyWheelEventCodeRight_P6", 0);
      enableControl ("MFL/LSS", "EnvVar:ENV_KeyWheelEventCodeRight_P7", 0);  
      enableControl ("MFL/LSS", "EnvVar:ENV_SendMfl", 0);  
      enableControl ("MFL/LSS", "EnvVar:ENV_SendMFL_Tasten_Kon_01", 0);
      enableControl ("MFL/LSS", "EnvVar:ENV_MenuLevelsUpDown", 0);
      enableControl ("MFL/LSS", "EnvVar:ENV_MenuLevelsLeftRight", 0);
      enableControl ("MFL/LSS", "EnvVar:ENV_MenuLevelsCycleTime", 0);
      enableControl ("MFL/LSS", "EnvVar:ENV_MenuLevelsChange", 0);
      enableControl ("MFL/LSS", "EnvVar:ENV_KeyOkWheelRightState", 0);
      //enableControl ("MFL/LSS", "ElemPanelCtrlBN",0);
  }
  else if( getValue(ENV_MFL_LSS_switch) == 1) //MFL Mode
  {
      enableControl ("MFL/LSS", "EnvVar:ENV_KeyJoker1State", 1);
      enableControl ("MFL/LSS", "EnvVar:ENV_KeyJoker2State", 1);
      enableControl ("MFL/LSS", "EnvVar:ENV_KeyVolUpState", 1);  
      enableControl ("MFL/LSS", "EnvVar:ENV_KeyVolDownState", 1);  
      enableControl ("MFL/LSS", "EnvVar:ENV_KeyWheelEventCodeRight_M1", 1);    
      enableControl ("MFL/LSS", "EnvVar:ENV_KeyWheelEventCodeRight_M2", 1);    
      enableControl ("MFL/LSS", "EnvVar:ENV_KeyWheelEventCodeRight_M3", 1);    
      enableControl ("MFL/LSS", "EnvVar:ENV_KeyWheelEventCodeRight_M4", 1);    
      enableControl ("MFL/LSS", "EnvVar:ENV_KeyWheelEventCodeRight_M5", 1);    
      enableControl ("MFL/LSS", "EnvVar:ENV_KeyWheelEventCodeRight_M6", 1);    
      enableControl ("MFL/LSS", "EnvVar:ENV_KeyWheelEventCodeRight_M7", 1);
      enableControl ("MFL/LSS", "EnvVar:ENV_KeyWheelEventCodeRight_P1", 1);
      enableControl ("MFL/LSS", "EnvVar:ENV_KeyWheelEventCodeRight_P2", 1);
      enableControl ("MFL/LSS", "EnvVar:ENV_KeyWheelEventCodeRight_P3", 1);
      enableControl ("MFL/LSS", "EnvVar:ENV_KeyWheelEventCodeRight_P4", 1);
      enableControl ("MFL/LSS", "EnvVar:ENV_KeyWheelEventCodeRight_P5", 1);
      enableControl ("MFL/LSS", "EnvVar:ENV_KeyWheelEventCodeRight_P6", 1);
      enableControl ("MFL/LSS", "EnvVar:ENV_KeyWheelEventCodeRight_P7", 1);  
      enableControl ("MFL/LSS", "EnvVar:ENV_SendMfl", 1);  
      enableControl ("MFL/LSS", "EnvVar:ENV_SendMFL_Tasten_Kon_01", 1);
      enableControl ("MFL/LSS", "EnvVar:ENV_MenuLevelsUpDown", 1);
      enableControl ("MFL/LSS", "EnvVar:ENV_MenuLevelsLeftRight", 1);
      enableControl ("MFL/LSS", "EnvVar:ENV_MenuLevelsCycleTime", 1);
      enableControl ("MFL/LSS", "EnvVar:ENV_MenuLevelsChange", 1);
      enableControl ("MFL/LSS", "EnvVar:ENV_KeyOkWheelRightState", 1);
      //enableControl ("MFL/LSS", "ElemPanelCtrlBN",1);
  }
   enableControl ("RPM_SPEED_production", "EnvVar:ENV_Production_alarm", 0);
   enableControl ("RPM_SPEED_production", "EnvVar:ENV_Production_String", 0);
   putValue(ENV_Production_String, "STOP");
       putValue(ENV_Production_alarm, 1);
}

on stopMeasurement
{
  writeProfileInt(   "Sweeps", "ENV_RPMSweep",  getValue( ENV_RPMSweep ),  "RBS.ini" );
  writeProfileInt(   "Sweeps", "ENV_RPMRandom", getValue( ENV_RPMRandom ), "RBS.ini" );
  writeProfileInt(   "Sweeps", "ENV_RPMStart",  getValue( ENV_RPMStart ),  "RBS.ini" );
  writeProfileInt(   "Sweeps", "ENV_RPMEnd",    getValue( ENV_RPMEnd ),    "RBS.ini" );
  writeProfileInt(   "Sweeps", "ENV_RPMSteps",  getValue( ENV_RPMSteps ),  "RBS.ini" );
  writeProfileInt(   "Sweeps", "ENV_RPMTime",   getValue( ENV_RPMTime ),   "RBS.ini" );

  writeProfileInt(   "Sweeps", "ENV_SpeedInputIsMetric", getValue( ENV_SpeedInputIsMetric ),  "RBS.ini" );
  writeProfileFloat( "Sweeps", "ENV_Speed",              getValue( ENV_Speed ),               "RBS.ini" );

  writeProfileInt(   "Sweeps", "ENV_SpeedPulseCorrelation", getValue( ENV_SpeedPulseCorrelation ), "RBS.ini" );
  writeProfileInt(   "Sweeps", "ENV_SpeedSingleSteps",      getValue( ENV_SpeedSingleSteps ),      "RBS.ini" );
  writeProfileInt(   "Sweeps", "ENV_SpeedSweep",            getValue( ENV_SpeedSweep ),            "RBS.ini" );
  writeProfileInt(   "Sweeps", "ENV_SpeedRandom",           getValue( ENV_SpeedRandom ),           "RBS.ini" );
  writeProfileFloat( "Sweeps", "ENV_SpeedStart",            getValue( ENV_SpeedStart ),            "RBS.ini" );
  writeProfileFloat( "Sweeps", "ENV_SpeedEnd",              getValue( ENV_SpeedEnd ),              "RBS.ini" );
  writeProfileInt(   "Sweeps", "ENV_SpeedSteps",            getValue( ENV_SpeedSteps ),            "RBS.ini" );
  writeProfileInt(   "Sweeps", "ENV_SpeedTime",             getValue( ENV_SpeedTime ),             "RBS.ini" );
  writeProfileInt(   "Sweeps", "ENV_SpeedPulsesInput",      getValue( ENV_SpeedPulsesInput ),      "RBS.ini" );
  writeProfileFloat( "Sweeps", "ENV_SpeedDistanceInput",    getValue( ENV_SpeedDistanceInput ),    "RBS.ini" );
  
  writeProfileInt(   "Sweeps", "ENV_PowermeterSweep",       getValue( ENV_PowermeterSweep ),            "RBS.ini" );
  writeProfileInt(   "Sweeps", "ENV_PowermeterRandom",      getValue( ENV_PowermeterRandom ),           "RBS.ini" );
  writeProfileFloat( "Sweeps", "ENV_PowermeterStart",       getValue( ENV_PowermeterStart ),            "RBS.ini" );
  writeProfileFloat( "Sweeps", "ENV_PowermeterEnd",         getValue( ENV_PowermeterEnd ),              "RBS.ini" );
  writeProfileInt(   "Sweeps", "ENV_PowermeterSteps",       getValue( ENV_PowermeterSteps ),            "RBS.ini" );
  writeProfileInt(   "Sweeps", "ENV_PowermeterTime",        getValue( ENV_PowermeterTime ),             "RBS.ini" );

  writeProfileInt(   "Sweeps", "ENV_WheelCircumferenceMax",      getValue( ENV_WheelCircumferenceMax ),      "RBS.ini" );
  writeProfileInt(   "Sweeps", "ENV_WheelCircumferenceAvg",      getValue( ENV_WheelCircumferenceAvg ),      "RBS.ini" );
  writeProfileInt(   "Sweeps", "KCAN_ESP_Zaehnezahl",            getValue( KCAN_ESP_Zaehnezahl ),            "RBS.ini" );

  writeProfileFloat( "Sweeps", "ENV_Consumption",                getValue( ENV_Consumption ),                "RBS.ini" );
  writeProfileFloat( "Sweeps", "ENV_GasConsumption",             getValue( ENV_GasConsumption ),             "RBS.ini" );

  writeProfileInt(   "NMHigh", "ENV_NMHStateMachineEnabled", getValue( ENV_NMHStateMachineEnabled ), "RBS.ini" );
  writeProfileInt(   "NMHigh", "ENV_NMHControllerNodeAwake", getValue( ENV_NMHControllerNodeAwake ), "RBS.ini" );

  writeProfileInt(   "Dimming", "ENV_CalculateKl58d",        getValue( ENV_CalculateKl58d ),         "RBS.ini" );

  writeProfileInt(   "Indicator", "ENV_IndicatorOnTime",     getValue( ENV_IndicatorOnTime  ),       "RBS.ini" );
  writeProfileInt(   "Indicator", "ENV_IndicatorOffTime",    getValue( ENV_IndicatorOffTime ),       "RBS.ini" );

  writeProfileInt(   "MFL",       "ENV_SendMfl",             getValue( ENV_SendMfl ),                "RBS.ini" );

  writeProfileInt(   "Sweeps", "ENV_Case_SpeedRPM",            getValue( ENV_Case_SpeedRPM ),            "RBS.ini" );
  writeProfileInt(   "Sweeps", "ENV_RPMSpeedTestTimer",        getValue( ENV_RPMSpeedTestTimer ),        "RBS.ini" );

}

on envVar ENV_RPMSweep
{
  if( getValue(this))
  {
    putValue( ENV_RPMRandom, 0 );
  }
  startRPM();
}

on envVar ENV_RPMRandom
{
  if( getValue(this))
  {
    putValue( ENV_RPMSweep, 0 );
  }
  startRPM();
}

void startRPM()
{
  if( getValue( ENV_RPMSweep ))
  {
    dRPMStart = getValue( ENV_RPMStart );
    dRPMEnd   = getValue( ENV_RPMEnd );
  }
  else if( getValue( ENV_RPMRandom ))
  {
    dRPMStart = getValue( KCAN_MO_Anzeigedrehz );
    dRPMEnd   = randomRPM();
  }
  else
  {
    // stop further execution of sweep for on timer
    dwRPMStep = getValue( ENV_RPMSteps );
    return;
  }
  dwRPMStep = 0;
  stepRPM();
}

void stepRPM()
{
  dword dwSteps;
  double dSwap;

  dwSteps = getValue( ENV_RPMSteps );
  if( dwSteps > 0)
  {
    if( dwRPMStep >= dwSteps)
    {
      if( getValue( ENV_RPMSweep ))
      {
        dSwap = dRPMStart;
        dRPMStart = dRPMEnd;
        dRPMEnd = dSwap;
      }
      else if( getValue( ENV_RPMRandom ))
      {
        dRPMStart = dRPMEnd;
        dRPMEnd = randomRPM();
      }
      else
      {
        return;
      }
      dwRPMStep = 0;
    }
    putValue( KCAN_MO_Anzeigedrehz, dRPMStart + (dRPMEnd - dRPMStart) * dwRPMStep / dwSteps );
    dwRPMStep = dwRPMStep + 1;
    cancelTimer( tRPMSweep );
    setTimer( tRPMSweep, getValue( ENV_RPMTime ) );
  }
}

dword randomRPM()
{
  return getValue( ENV_RPMStart ) + random( getValue( ENV_RPMEnd ) - getValue( ENV_RPMStart ) + 1 );
}

on timer tRPMSweep
{
  stepRPM();
}

on envVar ENV_RPMStart
{
  startRPM();
}

on envVar ENV_RPMEnd
{
  startRPM();
}

on envVar KCAN_MO_Anzeigedrehz
{
  putValue( ENV_RPMRaw, (dword)(getValue( KCAN_MO_Anzeigedrehz ) / 3.0) );
  
  if( getValue(ENV_Case_SpeedRPM)==0x02 ||getValue(ENV_Case_SpeedRPM)==0x04)
  {
  _mSpeed_RPM.RPM.phys = getValue(KCAN_MO_Anzeigedrehz);
  output(_mSpeed_RPM);
  }
}

// ===== Powermeter Sweep =====
on envVar ENV_PowermeterSweep
{
  if( getValue(this))
  {
    putValue( ENV_PowermeterRandom, 0 );
  }
  startPowermeter();
}

on envVar ENV_PowermeterRandom
{
  if( getValue(this))
  {
    putValue( ENV_PowermeterSweep, 0 );
  }
  startPowermeter();
}

void startPowermeter()
{
  if( getValue( ENV_PowermeterSweep ))
  {
    dPowermeterStart = getValue( ENV_PowermeterStart );
    dPowermeterEnd   = getValue( ENV_PowermeterEnd );
  }
  else if( getValue( ENV_PowermeterRandom ))
  {
    dPowermeterStart = 0;
    dPowermeterEnd   = randomPowermeter();
  }
  else
  {
    // stop further execution of sweep for on timer
    dwPowermeterStep = getValue( ENV_PowermeterSteps );
    return;
  }
  dwPowermeterStep = 0;
  stepPowermeter();
}

void stepPowermeter()
{
  dword dwSteps;
  double dSwap;

  dwSteps = getValue( ENV_PowermeterSteps );
  if( dwSteps > 0)
  {
    if( dwPowermeterStep >= dwSteps)
    {
      if( getValue( ENV_PowermeterSweep ))
      {
        dSwap = dPowermeterStart;
        dPowermeterStart = dPowermeterEnd;
        dPowermeterEnd = dSwap;
      }
      else if( getValue( ENV_PowermeterRandom ))
      {
        dPowermeterStart = dPowermeterEnd;
        dPowermeterEnd = randomPowermeter();
      }
      else
      {
        return;
      }
      dwPowermeterStep = 0;
    }
    putValue( KCAN_MO_Powermeter, dPowermeterStart + (dPowermeterEnd - dPowermeterStart) * dwPowermeterStep / dwSteps );
    dwPowermeterStep = dwPowermeterStep + 1;
    cancelTimer( tPowermeterSweep );
    setTimer( tPowermeterSweep, getValue( ENV_PowermeterTime ) );
  }
}

dword randomPowermeter()
{
  return (dword)getValue( ENV_PowermeterStart ) + random( (dword)(getValue( ENV_PowermeterEnd ) - getValue( ENV_PowermeterStart ) + 1.5) );
}

on timer tPowermeterSweep
{
  stepPowermeter();
}

on envVar ENV_PowermeterStart
{
  startPowermeter();
}

on envVar ENV_PowermeterEnd
{
  startPowermeter();
}

// ===== Speed Sweep =====
on envVar ENV_SpeedSweep
{
  if( getValue(this))
  {
    putValue( ENV_SpeedRandom, 0 );
    putValue( ENV_SpeedSingleSteps, 0 );
  }
  startSpeed();
}

on envVar ENV_SpeedRandom
{
  if( getValue(this))
  {
    putValue( ENV_SpeedSweep, 0 );
    putValue( ENV_SpeedSingleSteps, 0 );
  }
  startSpeed();
}

void startSpeed()
{
  if( getValue( ENV_SpeedSweep ))
  {
    dSpeedStart = getValue( ENV_SpeedStart );
    dSpeedEnd   = getValue( ENV_SpeedEnd );
  }
  else if( getValue( ENV_SpeedRandom ))
  {
    dSpeedStart = getValue( KCAN_MO_Anzeigedrehz );
    dSpeedEnd   = randomSpeed();
  }
  else
  {
    // stop further execution of sweep for on timer
    dwSpeedStep = getValue( ENV_SpeedSteps );
    return;
  }
  dwSpeedStep = 0;
  stepSpeed();
}

void stepSpeed()
{
  dword dwSteps;
  double dSwap;

  dwSteps = getValue( ENV_SpeedSteps );
  if( dwSteps > 0)
  {
    if( dwSpeedStep >= dwSteps)
    {
      if( getValue( ENV_SpeedSweep ))
      {
        dSwap = dSpeedStart;
        dSpeedStart = dSpeedEnd;
        dSpeedEnd = dSwap;
      }
      else if( getValue( ENV_SpeedRandom ))
      {
        dSpeedStart = dSpeedEnd;
        dSpeedEnd = randomSpeed();
      }
      else
      {
        return;
      }
      dwSpeedStep = 0;
    }
    putValue( ENV_SpeedInput, dSpeedStart + (dSpeedEnd - dSpeedStart) * dwSpeedStep / dwSteps );
    dwSpeedStep = dwSpeedStep + 1;
    cancelTimer( tSpeedSweep );
    setTimer( tSpeedSweep, getValue( ENV_SpeedTime ) );
  }
}

dword randomSpeed()
{
  return (dword)getValue( ENV_SpeedStart ) + random( (dword)(getValue( ENV_SpeedEnd ) - getValue( ENV_SpeedStart ) + 1.5) );
}

on timer tSpeedSweep
{
  stepSpeed();
}

on envVar ENV_SpeedStart
{
  startSpeed();
}

on envVar ENV_SpeedEnd
{
  startSpeed();
}

// ===== Speed Specials =====
on envVar ENV_SpeedInputIsMetric
{
  dword accu;
  if( getValue( this ))
  {
    putValue( ENV_DistanceUnit, "km" );
    putValue( ENV_SpeedUnit, "km/h" );
    if( dSpeedFactor != 1.0)
    {
      dSpeedFactor = 1.0;
      putValue( ENV_SpeedStart,   getValue( ENV_SpeedStart   ) * dKilometersPerMile );
      putValue( ENV_SpeedEnd,     getValue( ENV_SpeedEnd     ) * dKilometersPerMile );
      putValue( ENV_DisplaySpeed, getValue( ENV_DisplaySpeed ) * dKilometersPerMile );
    }
  }
  else
  {
    putValue( ENV_DistanceUnit, "mls" );
    putValue( ENV_SpeedUnit, "mls/h" );
    if( dSpeedFactor != dKilometersPerMile)
    {
      dSpeedFactor = dKilometersPerMile;
      putValue( ENV_SpeedStart,   getValue( ENV_SpeedStart   ) / dKilometersPerMile );
      putValue( ENV_SpeedEnd,     getValue( ENV_SpeedEnd     ) / dKilometersPerMile );
      putValue( ENV_DisplaySpeed, getValue( ENV_DisplaySpeed ) / dKilometersPerMile );
    }
  }

  putValue( ENV_SpeedInput, getValue( ENV_Speed ) / dSpeedFactor );

  accu = getValue( ENV_DistancePulseAccu );
  putValue( ENV_DistancePulseAccu, 0 );
  putValue( ENV_DistancePulseAccu, accu );
}

on envVar ENV_SpeedInput
{
    double actualSpeed;

    actualSpeed = getValue( ENV_SpeedInput ) * dSpeedFactor * getValue( ENV_SpeedOverfeedFactor );
    putValue( ENV_Speed, actualSpeed );
}
 

on envVar ENV_Speed
{
    putValue( ENV_SpeedInput, ( getValue( ENV_Speed ) / dSpeedFactor ) / getValue( ENV_SpeedOverfeedFactor ) );
}

on envVar ENV_SpeedSingleSteps
{
  if( getValue( this ))
  {
    putValue( ENV_SpeedSweep,  0 );
    putValue( ENV_SpeedRandom, 0 );
  }
  putValue( ENV_SpeedPulses, 0 );
}

void setPulses()
{
  putValue( ENV_SpeedPulses, getValue( ENV_SpeedPulses ) + getValue( ENV_SpeedPulsesInput ) );
}

void setDistance()
{
  putValue( ENV_SpeedPulses,
              getValue( ENV_SpeedPulses )
            + 2.0 * getValue( KCAN_ESP_Zaehnezahl ) * (getValue( ENV_SpeedDistanceInput ) * 1000)/*mm*/
              / getValue( ENV_WheelCircumferenceAvg )/*mm*/
          );
}

on envVar ENV_SpeedPulsesInput
{
  //setPulses();
}

on envVar ENV_SpeedPulsesButton
{
  if( getValue( this ))
  {
    putValue( ENV_SpeedSingleSteps, 1 );
    setPulses();
  }
}

on envVar ENV_SpeedDistanceInput
{
  //setDistance();
}

on envVar ENV_SpeedDistanceButton
{
  if( getValue( this ))
  {
    putValue( ENV_SpeedSingleSteps, 1 );
    setDistance();
  }
}

on envVar ENV_DistanceAccuReset
{
  putValue( ENV_DistancePulseAccu, 0 );
  putValue( KCAN_ESP_Wegimp_VA, 0 );
  putValue( KCAN_ESP_Wegimp_Ueberlauf, 0 );
  putValue( KCAN_ESP_QBit_Wegimp_VA, 1 );
  putValue( ENV_SpeedPulses, 0 );
}

on envVar ENV_DistancePulseAccu
{
  double old;
  old = getValue( ENV_DistanceAccu );
  putValue( ENV_DistanceAccu, 0.5e-6 / dSpeedFactor * getValue( ENV_DistancePulseAccu ) * getValue( ENV_WheelCircumferenceAvg ) / getValue( KCAN_ESP_Zaehnezahl ) );
  //putValue( ENV_SpeedEnd, (getValue( ENV_DistanceAccu ) - old) / getValue( ENV_TESP_24 )/*ms*/ * 3.6e6/*ms/h*/ );
}

on envVar KCAN_ESP_m_Raddrehz
{
  putValue( ENV_DisplaySpeed, getValue( KCAN_ESP_m_Raddrehz )/*1/s*/ * getValue( ENV_WheelCircumferenceMax )/*mm*/ * 1e-6/*km/mm*/ * 3600/*s/h*/ / dSpeedFactor );


  if( getValue(ENV_Case_SpeedRPM)==0x03 ||getValue(ENV_Case_SpeedRPM)==0x04)
  {
  _mSpeed_RPM.Speed.phys = getValue(KCAN_ESP_m_Raddrehz);
  output(_mSpeed_RPM);
  }
}

on envVar ENV_KeyMenuState
{
  if( getValue( this ))
  {
    setKey( enKeyMenu, enKeyPressed );
  }
  else
  {
    releaseKey( enKeyMenu );
  }
  // special permanent handling
  if( (getValue( ENV_SendMflPermanent1 ) == 1) && (getValue( this ) == 0)) // if not consistent
  {
    putValue( ENV_SendMflPermanent1, 0); // change permanent ON -> OFF
  }
}

on envVar ENV_KeyMenuUpState
{
  if( getValue( this ))
  {
    setKey( enKeyMenuUp, enKeyPressed );
  }
  else
  {
    releaseKey( enKeyMenuUp );
  }
}

on envVar ENV_KeyMenuDownState
{
  if( getValue( this ))
  {
    setKey( enKeyMenuDown, enKeyPressed );
  }
  else
  {
    releaseKey( enKeyMenuDown );
  }
}

on envVar ENV_KeyUpState
{
  if( getValue( this ))
  {
    setKey( enKeyUp, enKeyPressed );
  }
  else
  {
    releaseKey( enKeyUp );
  }
}

on envVar ENV_KeyDownState
{
  if( getValue( this ))
  {
    setKey( enKeyDown, enKeyPressed );
  }
  else
  {
    releaseKey( enKeyDown );
  }
  // special permanent handling
  if( (getValue( ENV_SendMflPermanent2 ) == 1) && (getValue( this ) == 0)) // if not consistent
  {
    putValue( ENV_SendMflPermanent2, 0); // change permanent ON -> OFF
  }
}

on envVar ENV_KeyOkWheelLeftState
{
  if( getValue( this ))
  {
    setKey( enKeyOKWheelLeft, enKeyPressed );
  }
  else
  {
    releaseKey( enKeyOKWheelLeft );
  }
}

on envVar ENV_KeyPttCancelState
{
  if( getValue( this ))
  {
    setKey( enKeyPttCancel, enKeyPressed );
  }
  else
  {
    releaseKey( enKeyPttCancel );
  }
}

on envVar ENV_SendMflPermanent1
{
  if( getValue( this ))
  {
    if( getValue( ENV_SendMflPermanent2 ) == 1) // other permanent key active?
    {
      putValue( ENV_SendMflPermanent2,0 );
      bDelayedMflCode = enKeyMenu; // at first delete the other key!
      cancelTimer( tDelayedKey );
      setTimer( tDelayedKey, iWheelReleaseTime ); // TODO: separate constant?
    }
    else
    {
      putValue( ENV_KeyMenuState, enKeyPressed );    // MENU, enKeyPressed -> enLongPress3
    }
  }
  else
  {
      putValue( ENV_KeyMenuState, enKeyReleased );
  }
}

on envVar ENV_SendMflPermanent2
{
  if( getValue( this ))
  {
    if( getValue( ENV_SendMflPermanent1 ) == 1) // other permanent key active?
    {
      putValue( ENV_SendMflPermanent1,0 );
      bDelayedMflCode = enKeyDown; // at first delete the other key!
      cancelTimer( tDelayedKey );
      setTimer( tDelayedKey, iWheelReleaseTime ); // TODO: separate constant?
    }
    else
    {
      putValue( ENV_KeyDownState, enKeyPressed );    // DOWN, enKeyPressed -> enLongPress3
    }
  }
  else
  {
    putValue( ENV_KeyDownState, enKeyReleased );
  }
}

setKey ( byte KeyCode, byte _EventCode )
{
  byte EventCode;
  byte NewValues;

  NewValues = 0;
  EventCode = _EventCode;
  // check special event codes
  if( (bLastMflCode != 0) && (bLastMflCode == KeyCode)  // the same key as before ...
       && (KeyCode != enKeyUpDownWheelLeft) && (KeyCode != enKeyUpDownWheelRight)
       && (KeyCode != enMfaReset) // not for wheel and MFA reset
     )
  {
    if( EventCode == 1) EventCode = enDoubleClick; // double click
  }

  // look for buffer
  // - look for already registered key code
  if( getValue( KCAN_MFL_Tastencode_1 ) == KeyCode)
  {
    putValue( KCAN_MFL_Eventcode_1, EventCode ); // change only event code
    NewValues = 1;
  }
  else if( getValue( KCAN_MFL_Tastencode_2 ) == KeyCode)
  {
    putValue( KCAN_MFL_Eventcode_2, EventCode );
    NewValues = 1;
  }
  // - look for free buffer
  else if( getValue( KCAN_MFL_Tastencode_1 ) == 0)
  {
    if( getValue(ENV_MFL_LSS_switch) == 1)
    {
        putValue( KCAN_MFL_Tastencode_1, KeyCode );
        putValue( KCAN_MFL_Eventcode_1, EventCode );
    }
    else
    {
        putValue( KCAN_LSS_Tastencode, KeyCode );
    }
    NewValues = 1;
  }
  else if( getValue( KCAN_MFL_Tastencode_2 ) == 0)
  {
    if( getValue(ENV_MFL_LSS_switch) == 1)
    {
        putValue( KCAN_MFL_Tastencode_2, KeyCode );
        putValue( KCAN_MFL_Eventcode_2, EventCode );
    }
    else
    {
        putValue( KCAN_LSS_Tastencode, KeyCode );
    }

    NewValues = 1;
  }
  if( NewValues == 1)
  {
    canceltimer( tDoubleClick );
    if( bLastMflCode == 0)
    {
      cancelTimer( tDoubleClick );
      setTimer( tDoubleClick, iDoubleclickTime );
      bLastMflCode = KeyCode;
    }
    if( bCurrMflCode != KeyCode)
    {
      cancelTimer( tLongPress );
      setTimer( tLongPress, iLongPress1Time );
      bCurrMflCode = KeyCode;
      bLongPressState = 0;
    }
    // send
    if( getValue( ENV_SendAtOnceMFL_Tasten_Kon_01 ) == 1) // "SendAtOnce" already activated?
    {
      putValue( ENV_SendAtOnceMFL_Tasten_Kon_01, 0 );
      // retrigger frame - TODO: delay between frames? Queue?
    }
    putValue( ENV_SendAtOnceMFL_Tasten_Kon_01, 1 );
    cancelTimer( tMflCycleSend );
    bMflCycleCount = bMflNullFrameCount -1;  // to send 5 times
    setTimer( tMflCycleSend, iMflCycleTime );
  }
}

releaseKey ( byte _KeyCode )
{

  byte NewValues;

  // look for used buffer
  if( getValue( KCAN_MFL_Tastencode_1 ) == _KeyCode)
  {
    putValue( KCAN_MFL_Tastencode_1, enKeyReleased );
    putValue( KCAN_MFL_Eventcode_1, enKeyReleased );
    NewValues = 1;

    //MR 63136 - release the keys if both KCAN_MFL_Tastencode_1 and KCAN_MFL_Tastencode_2 >0
    //events like keyDown/keyRight & Enter key pressed at the same time
    if( getValue( KCAN_MFL_Tastencode_2 ) !=0)
    {
    putValue( KCAN_MFL_Tastencode_2, enKeyReleased );
    putValue( KCAN_MFL_Eventcode_2, enKeyReleased );
    }

  }
  else if( getValue( KCAN_MFL_Tastencode_2 ) == _KeyCode)
  {
    putValue( KCAN_MFL_Tastencode_2, enKeyReleased );
    putValue( KCAN_MFL_Eventcode_2, enKeyReleased );
    NewValues = 1;

    //MR 63136 - release the keys if both KCAN_MFL_Tastencode_1 and KCAN_MFL_Tastencode_2 >0
    //events like keyDown/keyRight & Enter key pressed at the same time
    if( getValue( KCAN_MFL_Tastencode_1 ) !=0)
    {
    putValue( KCAN_MFL_Tastencode_1, enKeyReleased );
    putValue( KCAN_MFL_Eventcode_1, enKeyReleased );
    }
  }
  /* Vijay added for LSS */
  else if( getValue(KCAN_LSS_Tastencode) == _KeyCode)
  {
    putValue( KCAN_LSS_Tastencode, enKeyReleased);
    NewValues = 1;
  }

  if( NewValues == 1)
  {
    canceltimer( tDoubleClick );
    setTimer( tDoubleClick, iDoubleclickTime );
    canceltimer( tLongPress );
    bCurrMflCode = enKeyReleased;
    // send
    if( getValue( ENV_SendAtOnceMFL_Tasten_Kon_01 ) == 1) // "SendAtOnce" already activated?
    {
      putValue( ENV_SendAtOnceMFL_Tasten_Kon_01, 0 );
      // retrigger frame - TODO: delay between frames? Queue?
    }
    putValue( ENV_SendAtOnceMFL_Tasten_Kon_01, 1 );
    cancelTimer( tMflCycleSend );
    bMflCycleCount = bMflNullFrameCount - 1; // to send 5 times
    setTimer( tMflCycleSend, iMflCycleTime );
  }
}

on envVar ENV_MfaResetState
{
  if( getValue( this ))
  {
    putValue( KCAN_MFL_Tastencode_1, 0 );
    putValue( KCAN_MFL_Eventcode_1, 0 );
    putValue( KCAN_MFL_Tastencode_2, 0 );
    putValue( KCAN_MFL_Eventcode_2, 0 );
    putValue( ENV_SendMflPermanent1, 0 );
    putValue( ENV_SendMflPermanent2, 0 );
    bLastMflCode = 0;
    bCurrMflCode = 0;
    bDelayedMflCode = 0;
    bLongPressState = 0;
    setKey( enMfaReset, enKeyPressed );
  }
  else
  {
    releaseKey( enMfaReset );
  }
}

on timer tWheelLeftRelease
{
  // delete wheel event frame after it is sent once
  //deleteWheelEventsLeft( enKeyReleased ); 
   setKeyWheelEvent(enWheelLeft, 0, 0);                   
}

on timer tWheelRightRelease
{
  // delete wheel event frame after it is sent once
  //deleteWheelEventsRight( enKeyReleased );  
  setKeyWheelEvent(enWheelRight, 0, 0);                   
}

on envVar ENV_KeyOkWheelRightState
{
  if( getValue( this ))
  {
    setKey( enKeyOKWheelRight, enKeyPressed );
  }
  else
  {
    releaseKey( enKeyOKWheelRight );
  }
}

on envVar ENV_KeyMuteState
{
  if( getValue( this ))
  {
    setKey( enKeyMute, enKeyPressed );
  }
  else
  {
    releaseKey( enKeyMute );
  }
}

on envVar ENV_KeyPttState
{
  if( getValue( this ))
  {
    setKey( enKeyPtt, enKeyPressed );
  }
  else
  {
    releaseKey( enKeyPtt );
  }
}

on envVar ENV_KeyVolDownState
{
  if( getValue( this ))
  {
    setKey( enKeyVolumeDown, enKeyPressed );
  }
  else
  {
    releaseKey( enKeyVolumeDown );
  }
}

on envVar ENV_KeyVolUpState
{
  if( getValue( this ))
  {
    setKey( enKeyVolumeUp, enKeyPressed );
  }
  else
  {
    releaseKey( enKeyVolumeUp );
  }
}

on timer tDoubleClick
{
  // "double click time" between two keys is reached
  bLastMflCode = enKeyReleased; // -> forget the previous key ...
}

on timer tLongPress
{
  // check how long the key is pressed ...
  if( (bCurrMflCode != enKeyReleased)
       && (bCurrMflCode != enKeyUpDownWheelLeft) && (bCurrMflCode != enKeyUpDownWheelRight)
       && (bCurrMflCode != enMfaReset)// not for wheel and MFA reset
     )
  {
    switch (bLongPressState)
    {
      case 0:  setTimer( tLongPress, iLongPress2Time - iLongPress1Time ); // after iLongPress1Time
               bLongPressState = 1;
               setKey ( bCurrMflCode, enLongPress1 );
               break;
      case 1:  setTimer( tLongPress, iLongPress3Time - iLongPress2Time ); // after iLongPress2Time
               bLongPressState = 2;
               setKey ( bCurrMflCode, enLongPress2 );
               break;
      case 2:  bLongPressState = 3;                                       // after iLongPress3Time
               setKey ( bCurrMflCode, enLongPress3 );
               break;
      default: break;
    }
  }
}

on timer tDelayedKey
{
  // switch between permanent MENU and DOWN
  // at first in the "main" the last permanent key is released
  // and now in the "timer call" the new permanent key is set
  if( bDelayedMflCode != enKeyReleased)
  {
    switch (bDelayedMflCode)
    {
      case enKeyReleased: break;
      case enKeyMenu:     putValue( ENV_KeyMenuState, enKeyPressed );
                          break;
      case enKeyDown:     putValue( ENV_KeyDownState, enKeyPressed );
                          break;
      default:            break;
    }
    bDelayedMflCode = enKeyReleased;
  }
}

on timer tMflCycleSend
{
  // send Mfl frame cyclic if there is no change and key is pressed or 5 times if no key is pressed
  if( bMflCycleCount > 0)
  {
    // send
    if( (bLongPressState < 1) || (bLongPressState >2)) // work around to prevent cyclic and timed frames at once
    {
      if( getValue( ENV_SendAtOnceMFL_Tasten_Kon_01 ) == 1) // "SendAtOnce" already activated?
      {
        putValue( ENV_SendAtOnceMFL_Tasten_Kon_01, 0 );
        // retrigger frame - TODO: delay between frames? Queue?
      }
      putValue( ENV_SendAtOnceMFL_Tasten_Kon_01, 1 );
    }
    if(    (getValue( KCAN_MFL_Tastencode_1 ) != 0) || (getValue( KCAN_MFL_Eventcode_1 ) != 0)
        || (getValue( KCAN_MFL_Tastencode_2 ) != 0) || (getValue( KCAN_MFL_Eventcode_2 ) != 0)
       )
    {
      bMflCycleCount = bMflNullFrameCount - 1;
    }
    else
    {
      --bMflCycleCount;
    }
  }
  if( bMflCycleCount > 0)
  {
    setTimer( tMflCycleSend, iMflCycleTime );
  }
}

setKeyWheelEvent( byte WheelSide, byte EventNo, byte State )
{
  switch (State)
  {
    case 0:  if( WheelSide == enWheelLeft)
             {
               cancelTimer( tWheelLeftRelease );
               releaseKey( enKeyUpDownWheelLeft );
             }
             else if( WheelSide == enWheelRight)
             {
               cancelTimer( tWheelRightRelease );
               releaseKey( enKeyUpDownWheelRight );
             }
             break;
    case 1:  if( WheelSide == enWheelLeft)
             {
               deleteWheelEventsLeft( EventNo );  // delete other events
               cancelTimer( tWheelLeftRelease );
               setKey( enKeyUpDownWheelLeft, EventNo );
               setTimer( tWheelLeftRelease, iWheelReleaseTime );   // to delete wheel event after it is sent
             }
             else if( WheelSide == enWheelRight)
             {
               deleteWheelEventsRight( EventNo );  // delete other events
               cancelTimer( tWheelRightRelease );
               setKey( enKeyUpDownWheelRight, EventNo );
               setTimer( tWheelRightRelease, iWheelReleaseTime );   // to delete wheel event after it is sent
             }
             break;
    default: break;
  }
}

on envVar ENV_KeyWheelEventCodeLeft_M1
{
  setKeyWheelEvent( enWheelLeft, enWheel1TickDown, getValue( this ) );
}

on envVar ENV_KeyWheelEventCodeLeft_M2
{
  setKeyWheelEvent( enWheelLeft, enWheel2TickDown, getValue( this ) );
}

on envVar ENV_KeyWheelEventCodeLeft_M3
{
  setKeyWheelEvent( enWheelLeft, enWheel3TickDown, getValue( this ) );
}

on envVar ENV_KeyWheelEventCodeLeft_M4
{
  setKeyWheelEvent( enWheelLeft, enWheel4TickDown, getValue( this ) );
}

on envVar ENV_KeyWheelEventCodeLeft_M5
{
  setKeyWheelEvent( enWheelLeft, enWheel5TickDown, getValue( this ) );
}

on envVar ENV_KeyWheelEventCodeLeft_M6
{
  setKeyWheelEvent( enWheelLeft, enWheel6TickDown, getValue( this ) );
}

on envVar ENV_KeyWheelEventCodeLeft_M7
{
  setKeyWheelEvent( enWheelLeft, enWheel7TickDown, getValue( this ) );
}

on envVar ENV_KeyWheelEventCodeLeft_P1
{
  setKeyWheelEvent( enWheelLeft, enWheel1TickUp, getValue( this ) );
}

on envVar ENV_KeyWheelEventCodeLeft_P2
{
  setKeyWheelEvent( enWheelLeft, enWheel2TickUp, getValue( this ) );
}

on envVar ENV_KeyWheelEventCodeLeft_P3
{
  setKeyWheelEvent( enWheelLeft, enWheel3TickUp, getValue( this ) );
}

on envVar ENV_KeyWheelEventCodeLeft_P4
{
  setKeyWheelEvent( enWheelLeft, enWheel4TickUp, getValue( this ) );
}

on envVar ENV_KeyWheelEventCodeLeft_P5
{
  setKeyWheelEvent( enWheelLeft, enWheel5TickUp, getValue( this ) );
}

on envVar ENV_KeyWheelEventCodeLeft_P6
{
  setKeyWheelEvent( enWheelLeft, enWheel6TickUp, getValue( this ) );
}

on envVar ENV_KeyWheelEventCodeLeft_P7
{
  setKeyWheelEvent( enWheelLeft, enWheel7TickUp, getValue( this ) );
}

on envVar ENV_KeyWheelEventCodeRight_M1
{
  setKeyWheelEvent( enWheelRight, enWheel1TickDown, getValue( this ) );
}

on envVar ENV_KeyWheelEventCodeRight_M2
{
  setKeyWheelEvent( enWheelRight, enWheel2TickDown, getValue( this ) );
}

on envVar ENV_KeyWheelEventCodeRight_M3
{
  setKeyWheelEvent( enWheelRight, enWheel3TickDown, getValue( this ) );
}

on envVar ENV_KeyWheelEventCodeRight_M4
{
  setKeyWheelEvent( enWheelRight, enWheel4TickDown, getValue( this ) );
}

on envVar ENV_KeyWheelEventCodeRight_M5
{
  setKeyWheelEvent( enWheelRight, enWheel5TickDown, getValue( this ) );
}

on envVar ENV_KeyWheelEventCodeRight_M6
{
  setKeyWheelEvent( enWheelRight, enWheel6TickDown, getValue( this ) );
}

on envVar ENV_KeyWheelEventCodeRight_M7
{
  setKeyWheelEvent( enWheelRight, enWheel7TickDown, getValue( this ) );
}

on envVar ENV_KeyWheelEventCodeRight_P1
{
  setKeyWheelEvent( enWheelRight, enWheel1TickUp, getValue( this ) );
}

on envVar ENV_KeyWheelEventCodeRight_P2
{
  setKeyWheelEvent( enWheelRight, enWheel2TickUp, getValue( this ) );
}

on envVar ENV_KeyWheelEventCodeRight_P3
{
  setKeyWheelEvent( enWheelRight, enWheel3TickUp, getValue( this ) );
}

on envVar ENV_KeyWheelEventCodeRight_P4
{
  setKeyWheelEvent( enWheelRight, enWheel4TickUp, getValue( this ) );
}

on envVar ENV_KeyWheelEventCodeRight_P5
{
  setKeyWheelEvent( enWheelRight, enWheel5TickUp, getValue( this ) );
}

on envVar ENV_KeyWheelEventCodeRight_P6
{
  setKeyWheelEvent( enWheelRight, enWheel6TickUp, getValue( this ) );
}

on envVar ENV_KeyWheelEventCodeRight_P7
{
  setKeyWheelEvent( enWheelRight, enWheel7TickUp, getValue( this ) );
}

deleteWheelEventsLeft ( byte EventNo )
{
  if( EventNo != enWheel1TickDown) putValue( ENV_KeyWheelEventCodeLeft_M1, enKeyReleased );
  if( EventNo != enWheel2TickDown) putValue( ENV_KeyWheelEventCodeLeft_M2, enKeyReleased );
  if( EventNo != enWheel3TickDown) putValue( ENV_KeyWheelEventCodeLeft_M3, enKeyReleased );
  if( EventNo != enWheel4TickDown) putValue( ENV_KeyWheelEventCodeLeft_M4, enKeyReleased );
  if( EventNo != enWheel5TickDown) putValue( ENV_KeyWheelEventCodeLeft_M5, enKeyReleased );
  if( EventNo != enWheel6TickDown) putValue( ENV_KeyWheelEventCodeLeft_M6, enKeyReleased );
  if( EventNo != enWheel7TickDown) putValue( ENV_KeyWheelEventCodeLeft_M7, enKeyReleased );
  if( EventNo != enWheel1TickUp) putValue( ENV_KeyWheelEventCodeLeft_P1, enKeyReleased );
  if( EventNo != enWheel2TickUp) putValue( ENV_KeyWheelEventCodeLeft_P2, enKeyReleased );
  if( EventNo != enWheel3TickUp) putValue( ENV_KeyWheelEventCodeLeft_P3, enKeyReleased );
  if( EventNo != enWheel4TickUp) putValue( ENV_KeyWheelEventCodeLeft_P4, enKeyReleased );
  if( EventNo != enWheel5TickUp) putValue( ENV_KeyWheelEventCodeLeft_P5, enKeyReleased );
  if( EventNo != enWheel6TickUp) putValue( ENV_KeyWheelEventCodeLeft_P6, enKeyReleased );
  if( EventNo != enWheel7TickUp) putValue( ENV_KeyWheelEventCodeLeft_P7, enKeyReleased );
}

deleteWheelEventsRight ( byte EventNo )
{
  if( EventNo != enWheel1TickDown) putValue( ENV_KeyWheelEventCodeRight_M1, enKeyReleased );
  if( EventNo != enWheel2TickDown) putValue( ENV_KeyWheelEventCodeRight_M2, enKeyReleased );
  if( EventNo != enWheel3TickDown) putValue( ENV_KeyWheelEventCodeRight_M3, enKeyReleased );
  if( EventNo != enWheel4TickDown) putValue( ENV_KeyWheelEventCodeRight_M4, enKeyReleased );
  if( EventNo != enWheel5TickDown) putValue( ENV_KeyWheelEventCodeRight_M5, enKeyReleased );
  if( EventNo != enWheel6TickDown) putValue( ENV_KeyWheelEventCodeRight_M6, enKeyReleased );
  if( EventNo != enWheel7TickDown) putValue( ENV_KeyWheelEventCodeRight_M7, enKeyReleased );
  if( EventNo != enWheel1TickUp) putValue( ENV_KeyWheelEventCodeRight_P1, enKeyReleased );
  if( EventNo != enWheel2TickUp) putValue( ENV_KeyWheelEventCodeRight_P2, enKeyReleased );
  if( EventNo != enWheel3TickUp) putValue( ENV_KeyWheelEventCodeRight_P3, enKeyReleased );
  if( EventNo != enWheel4TickUp) putValue( ENV_KeyWheelEventCodeRight_P4, enKeyReleased );
  if( EventNo != enWheel5TickUp) putValue( ENV_KeyWheelEventCodeRight_P5, enKeyReleased );
  if( EventNo != enWheel6TickUp) putValue( ENV_KeyWheelEventCodeRight_P6, enKeyReleased );
  if( EventNo != enWheel7TickUp) putValue( ENV_KeyWheelEventCodeRight_P7, enKeyReleased );
}

double interpolate( double dX, double aadCharacteristic[][] )
{
  long lIndex;
  long lLast;
  lLast = elcount( aadCharacteristic ) - 1;

  if( dX < aadCharacteristic[0][0])
  {
    return aadCharacteristic[0][1];
  }

  for (lIndex = 1;  lIndex <= lLast;  ++lIndex)
  {
    if( aadCharacteristic[lIndex][0] >= dX)
    {
      return    aadCharacteristic[lIndex][1]
             - (aadCharacteristic[lIndex][1] - aadCharacteristic[lIndex - 1][1])
             / (aadCharacteristic[lIndex][0] - aadCharacteristic[lIndex - 1][0])
             * (aadCharacteristic[lIndex][0] - dX);
    }
  }

  return aadCharacteristic[lLast][1];
}

calculateKl58d()
{
  byte log_d;

  byte s;
  byte logPT;
  double pt;
  double fmin;
  double fmax;
  double d;

  if( getValue( ENV_CalculateKl58d ))
  {
    s = getValue( KCAN_DI_KL_58xs );
    switch (s)
    {
      case 126:  log_d = 254;  break;  // Init
      case 127:  log_d = 255;  break;  // Fehler
      default:
      {
        logPT = getValue( ENV_KBI_PhototransistorD );
        //logPT = getValue( KCAN_DI_Fotosensor ); // for debugging
        if( (s > 100) || (logPT > 253))
        {
          log_d = 255;  // Fehler
        }
        else
        {
          pt = interpolate( logPT, aadCharacteristicDelogPT );
          fmin = interpolate( pt, aadCharacteristicFMin );
          fmax = interpolate( pt, aadCharacteristicFMax );
          d = fmin + 0.01 * s * (fmax - fmin);
          //putValue( KCAN_DI_KL_58xt, d ); // for debugging
          if( (d <= 0) || (d >= 100))
          {
            log_d = 253;
          }
          else
          {
            log_d = interpolate( d, aadCharacteristicLogKl58d );
          }
        }
      }
      break;
    }
    putValue( KCAN_DI_KL_58xd, log_d );
  }
}

on envVar ENV_CalculateKl58d
{
  calculateKl58d();
}

on envVar KCAN_DI_KL_58xs
{
  calculateKl58d();
}

on envVar KCAN_DI_Fotosensor // for debugging, doesn't do anything wrong anyway
{
  calculateKl58d();
}

on envVar KCAN_ZAS_Kl_15
{
  if( getValue( this ))
  {
    cancelTimer( tMflCycleSend );
    bMflCycleCount = bMflNullFrameCount; // to send 5 times
    setTimer( tMflCycleSend, 1 );
  }
}

indicate( byte restart )
{
  byte startTimer;
  byte left;
  byte right;
  startTimer = 1;
  left  = getValue( KCAN_Blinken_li_Fzg_Takt );
  right = getValue( KCAN_Blinken_re_Fzg_Takt );

  if( getValue( KCAN_BM_Warnblinken ))
  {
    left  = restart || !left;
    right = left;
  }
  else if( getValue( KCAN_BM_links  ))
  {
    left  = restart || !left;
    right = 0;
  }
  else if( getValue( KCAN_BM_rechts ))
  {
    left  = 0;
    right = restart || !right;
  }
  else
  {
    left  = 0;
    right = 0;
    startTimer = 0;
  }

  cancelTimer( tIndicator );
  if( startTimer)
  {
    setTimer( tIndicator, left || right ? getValue( ENV_IndicatorOnTime ) : getValue( ENV_IndicatorOffTime ) );
  }

  putValue( KCAN_Blinken_li_Fzg_Takt,   left  );
  putValue( KCAN_Blinken_re_Fzg_Takt,   right );
  putValue( KCAN_Blinken_li_Kombi_Takt, left  );
  putValue( KCAN_Blinken_re_Kombi_Takt, right );
}

on timer tIndicator
{
  indicate( /*start*/0 );
}

on envVar KCAN_BM_links
{
  if( getValue( KCAN_BM_links ))
  {
    putValue( KCAN_BM_rechts, 0 );
  }
  indicate( /*start*/1 );
}

on envVar KCAN_BM_rechts
{
  if( getValue( KCAN_BM_rechts ))
  {
    putValue( KCAN_BM_links, 0 );
  }
  indicate( /*start*/1 );
}

on envVar KCAN_BM_Warnblinken
{
  indicate( /*start*/1 );
}

void setAllWarnLightComf(int value)
{
  putValue( KCAN_LV_Standlicht_Anzeige, value );
  putValue( KCAN_LV_Abblendlicht_Anzeige, value );
  putValue( KCAN_LV_Fernlicht_Anzeige, value );
  putValue( KCAN_LV_Nebellicht_Anzeige, value );
  putValue( KCAN_LV_Nebelschlusslicht_Anzeige, value );
  putValue( KCAN_LV_Tagfahrlicht_Anzeige, value );
  putValue( KCAN_LV_AFL_aktiv_Anzeige, value );
  putValue( KCAN_LV_AFL_defekt, value );
  putValue( KCAN_AFS_Lampe, value );
  putValue( KCAN_LWR_Lampe, value );
 //  //   putValue( eAFS_FehlertextS, value );
 //  //   putValue( eAFS_LED_BlinkmodeS, value );
  putValue( KCAN_LV_Blinker_li_def, value );
  putValue( KCAN_LV_Standlicht_li_def, value );
  putValue( KCAN_LV_Abblendlicht_li_def, value );
  putValue( KCAN_LV_Fernlicht_li_def, value );
  putValue( KCAN_LV_Nebellicht_li_def, value );
  putValue( KCAN_LV_Blk_li_Seite_def, value );
  putValue( KCAN_LV_Tagfahrlicht_li_def, value );
  putValue( KCAN_LV_FLA_aktiv_Anzeige, value );
  putValue( KCAN_LV_FLA_defekt, value );
  putValue( KCAN_LV_FLA_Sensor_blockiert, value );
  putValue( KCAN_LV_Blinker_re_def, value );
  putValue( KCAN_LV_Standlicht_re_def, value );
  putValue( KCAN_LV_Abblendlicht_re_def, value );
  putValue( KCAN_LV_Fernlicht_re_def, value );
  putValue( KCAN_LV_Nebellicht_re_def, value );
  putValue( KCAN_LV_Blk_re_Seite_def, value );
  putValue( KCAN_LV_Tagfahrlicht_re_def, value );
  putValue( KCAN_LV_Abblendlicht_TFL_li_def, value );
  putValue( KCAN_LV_Nebellicht_TFL_li_def, value );
  putValue( KCAN_LV_Standlicht_TFL_li_def, value );
  putValue( KCAN_LV_Abblend_Fernlicht_li_def, value );
  putValue( KCAN_LV_Abblendlicht_TFL_re_def, value );
  putValue( KCAN_LV_Nebellicht_TFL_re_def, value );
  putValue( KCAN_LV_Standlicht_TFL_re_def, value );
  putValue( KCAN_LV_Abblend_Fernlicht_re_def, value );
  putValue( KCAN_LV_Aussenlicht_def, value );
  putValue( KCAN_LH_Aussenlicht_def, value );
  putValue( KCAN_LH_Blinker_li_def, value );
  putValue( KCAN_LH_Bremsl_li_def, value );
  putValue( KCAN_LH_Schlusslicht_li_def, value );
  putValue( KCAN_LH_Rueckf_li_def, value );
  putValue( KCAN_LH_Nebel_li_def, value );
  putValue( KCAN_LH_Schluss_Brems_Nebel_li_def, value );
  putValue( KCAN_LH_Schluss_Brems_Nebel_re_def, value );
  putValue( KCAN_LH_Schluss_Brems_li_def, value );
  putValue( KCAN_LH_Schluss_Nebel_li_def, value );
  putValue( KCAN_LH_SL_BRL_BLK_li_def, value );
  putValue( KCAN_LH_Brems_Blk_li_def, value );
  putValue( KCAN_LH_Blinker_re_def, value );
  putValue( KCAN_LH_Bremsl_re_def, value );
  putValue( KCAN_LH_Schlusslicht_re_def, value );
  putValue( KCAN_LH_Rueckf_re_def, value );
  putValue( KCAN_LH_Nebel_re_def, value );
  putValue( KCAN_LH_Schluss_Brems_re_def, value );
  putValue( KCAN_LH_Schluss_Nebel_re_def, value );
  putValue( KCAN_LH_SL_BRL_BLK_re_def, value );
  putValue( KCAN_LH_Brems_Blk_re_def, value );
  putValue( KCAN_LH_Kennzl_def, value );
  putValue( KCAN_LH_3_Bremsl_def, value );
  putValue( KCAN_LH_Nebel_mi_def, value );
  putValue( KCAN_LH_Rueckf_mi_def, value );
  putValue( KCAN_AAG_Blinker_HL_def, value );
  putValue( KCAN_AAG_Blinker_HR_def, value );
  putValue( KCAN_AAG_Bremslicht_H_def, value );
  putValue( KCAN_AAG_Schlusslicht_HL_def, value );
  putValue( KCAN_AAG_Schlusslicht_HR_def, value );
  putValue( KCAN_AAG_Blinker_H_aktiv, value );
 //  //   putValue( eBCM1_Licht_WarnS, value );
  putValue( KCAN_Blinken_li_Kombi_Takt, value );
  putValue( KCAN_Blinken_re_Kombi_Takt, value );
  putValue( KCAN_BCM_Waschwasser_Sensor, value );
 //  //   putValue( eRDK_FMVSS138_LampeS, value );
 //  //   putValue( eRDK_FMVSS138_MILS, value );
  putValue( KCAN_RKA_FMVSS138_Lampe, value );
  putValue( KCAN_RKA_FMVSS138_MIL, value );
}

on EnvVar ENV_NoWarnLightComf
{
  setAllWarnLightComf( 0 );
}

on EnvVar ENV_AllWarnLightComf
{
  setAllWarnLightComf( 1 );
}

void setAllWarn(int value)
{
  putValue( KCAN_AB_Gurtwarn_VF, value );
  putValue( KCAN_AB_Gurtwarn_VB, value );
  putValue( KCAN_AB_Gurtschloss_Reihe2_FA, 3 - value );
  putValue( KCAN_AB_Gurtschloss_Reihe2_MI, 3 - value );
  putValue( KCAN_AB_Gurtschloss_Reihe2_BF, 3 - value );
  putValue( KCAN_AB_Gurtschloss_Reihe3_FA, 3 - value );
  putValue( KCAN_AB_Gurtschloss_Reihe3_MI, 3 - value );
  putValue( KCAN_AB_Gurtschloss_Reihe3_BF, 3 - value );
  putValue( KCAN_ZV_FT_offen, value );
  putValue( KCAN_ZV_BT_offen, value );
  putValue( KCAN_ZV_HFS_offen, value );
  putValue( KCAN_ZV_HBFS_offen, value );
  putValue( KCAN_ZV_HD_offen, value );
  putValue( KCAN_ZV_HS_offen, value );
  putValue( KCAN_BCM1_MH_Schalter, value );
  putValue( KCAN_AB_Lampe, value );
  putValue( KCAN_AB_Deaktiviert, value );
  putValue( KCAN_AB_VB_deaktiviert, value );
  putValue( KCAN_AB_Systemfehler, value );
 //  //   putValue( eELV_Akustik_1S, value );
 //  //   putValue( eELV_Akustik_2S, value );
 //  //   putValue( eELV_Blink_LEDS, value );
  putValue( KCAN_ELV_LED_Rot, value );
 //  //   putValue( eELV_LED_BremseS, value );
 //  //   //putValue( eELV_Txt_Lkg_nicht_EntrS, value );
  putValue( KCAN_ELV_Txt_Lkg_Bewegen, value );
  putValue( KCAN_ELV_Txt_Werkstatt, value );
  putValue( KCAN_ELV_Txt_Defekt, value );
 //  //   putValue( eWIV_Enable_Oeldr_MotorS, value );
  putValue( KCAN_WIV_Oeldr_Warn_Motor, value );
  putValue( KCAN_WIV_Ueberfuell_Warn, value );
  putValue( KCAN_WIV_laufender_Motor, value );
 //  //   //putValue( eMO_HYB_Text_1S, value );
 //  //   //putValue( eMO_HYB_Text_2S, value );
 //  //   //putValue( eMO_HYB_Text_3S, value );
 //  //   //putValue( eMO_HYB_Text_5S, value );
 //  //   //putValue( eMO_HYB_Text_6S, value );
  putValue( KCAN_MO_Text_Motorstart, value * 9 );
 //  //   //putValue( eMO_HYB_Text_7S, value );
  putValue( KCAN_MO_Text_Partikelfil_Reg, value );
  putValue( KCAN_MO_Systemlampe, value );
  putValue( KCAN_MO_OBD2_Lampe, value );
  putValue( KCAN_MO_Heissleuchte, value );
  putValue( KCAN_MO_Partikel_Lampe, value );
  putValue( KCAN_WIV_Ueberfuell_deaktiv, value );
  putValue( KCAN_WIV_Unterfuell_Warn, value );
  putValue( KCAN_MO_Text_Tankdeckelwarn, value );
  putValue( KCAN_MO_HYB_Fahrbereitschaft, value );
 //  //   //putValue( eMO_Avus_MotorschutzS, value );
  putValue( KCAN_BEM_Batteriediagnose, value * 3 );
  putValue( KCAN_BEM_Generatordiagnose, value * 2 );
  putValue( KCAN_BCM_Bremsbelag_Sensor, value );
  putValue( KCAN_BCM_Bremsfluessigkeit_Sensor, value );
  //putValue( KCAN_BR_Systemart, value );
  putValue( KCAN_ESP_Lampe, value );
  putValue( KCAN_ABS_Lampe, value );
  putValue( KCAN_BK_Lampe_02, value * 3 );
  putValue( KCAN_ESP_HDC_FktLampe, value );
  putValue( KCAN_ESP_Off_Lampe, value );
  putValue( KCAN_ESP_Textanzeigen_03, value );
  putValue( KCAN_ESP_Meldungen, value );
 //  //   putValue( eEPB_Fehlerlampe_GelbS, value );
 //  //   putValue( eEPB_Fehlerlampe_BKLS, value );
  putValue( KCAN_EPB_Funktionslampe, value );
 //  //   putValue( eEPB_AkustikS, value );
  putValue( KCAN_EPB_Autoholdlampe, value );
 //  //   putValue( eEPB_Bremsbelag_WarnS, value );
  putValue( KCAN_EPB_Texte, value );
  putValue( KCAN_EPS_Warnungen, value );
  putValue( KCAN_WBA_GE_Texte, value );
  putValue( KCAN_WBA_GE_Warnung_02, value );
  putValue( KCAN_BCM_Kuehlmittel_Sensor, value );
}

on EnvVar ENV_NoWarn
{
  setAllWarn( 0 );
}

on EnvVar ENV_WarnAll
{
  setWarnNone();
  setWarnGreen ( 1 );
  setWarnYellow( 1 );
  setWarnRed   ( 1 );
  setWarnBlue  ( 1 );


  //setAllWarn( 1 );
}

void setWarnGreen(int value)
{
  putValue( KCAN_Blinken_li_Kombi_Takt, value );
  putValue( KCAN_Blinken_re_Kombi_Takt, value );
  putValue( KCAN_LV_Tagfahrlicht_Anzeige, value );
  putValue( KCAN_ESP_HDC_FktLampe, value );
  putValue( KCAN_TSK_Status_Anzeige, value ); // GRA/Cruise
 //  //   putValue( eMO_KraftstoffartS, value ? 3 : 1 ); // Erdgas : Benzin
  putValue( KCAN_WBA_GE_Texte, value ); // Shiftlock
  putValue( KCAN_LDW_Status_LED_gruen, value );
  putValue( KCAN_SWA_Sta_aktiv, value );
 //  //   if( value)  putValue( eACC_Texte_braking_guardS, 3 ); // TODO: Anhaltewegsverkürzung
  if( value)  putValue( KCAN_ACC_Relevantes_Objekt, 1 ); // ACC Folgefahrt
 //  //   if( value)  putValue( eACC_Status_Prim_AnzS, 1 ); // ACC freie Fahrt
  putValue( KCAN_LV_Abblendlicht_Anzeige, value );
  putValue( KCAN_EPB_Autoholdlampe, value );
  putValue( KCAN_AAG_Blinker_H_aktiv, value );
  putValue( KCAN_MO_HYB_Fahrbereitschaft, value );
  putValue( KCAN_LV_Nebellicht_Anzeige, value );
}

void setWarnYellow(int value)
{
  putValue( KCAN_LV_Abblendlicht_re_def, value ); // Sammelwarnung
  putValue( KCAN_AB_Lampe, value );
  putValue( KCAN_ESP_Off_Lampe, value );
 //  //   putValue( eRDK_FMVSS138_LampeS, value );
  putValue( KCAN_MO_Systemlampe, value );
  putValue( KCAN_MO_OBD2_Lampe, value );
  putValue( KCAN_ABS_Lampe, value );
  putValue( KCAN_EPS_Fehlerlampe, value );
  putValue( KCAN_ESP_Lampe, value );
  putValue( KCAN_BCM_Bremsbelag_Sensor, value );
  putValue( KCAN_WIV_Oelmin_Warn, value );
  // KBI_Tankwarnung calculated by Kombi internally
  putValue( KCAN_MO_Partikel_Lampe, value );
  putValue( KCAN_LV_Abblendlicht_li_def, value ); // Glühlampenausfall
  putValue( KCAN_BCM_Verdeck_Freigabe, value );
  // Differentialsperre hinten
 //  //   putValue( eEPB_Fehlerlampe_GelbS, value );
  putValue( KCAN_BCM_Waschwasser_Sensor, value );
  // Low 4x4 Reduzierstufe
  // Differentialsperre längs
  putValue( KCAN_LDW_Status_LED_gelb, value );
  putValue( KCAN_SWA_Sta_passiv, value ); // Spurwechsel (Lane Assist)
 //  //   if( value)  putValue( eACC_Texte_braking_guardS, 1 ); // TODO: Anhaltewegsverkürzung
  putValue( KCAN_LV_Nebelschlusslicht_Anzeige, value );
  // Harnstoffanzeige (SCR) (Diesel)
}

void setWarnRed(int value)
{
  putValue( KCAN_BCM_Kuehlmittel_Sensor, value ); // Sammelwarnung
  putValue( KCAN_AB_Gurtwarn_VF, value );
  putValue( KCAN_BK_Lampe_02, value ); // "Bremse allgemein"/"BRAKE"
  putValue( KCAN_EPS_Warnungen, value ? 3 : 0 );
  // Break Wear (red only in the USA, yellow elsewhere)
  putValue( KCAN_BCM_Kuehlmittel_Sensor, value );
  // Oeldruckwarnung
  putValue( KCAN_BEM_Batteriediagnose, value );
  putValue( KCAN_ZV_FT_offen, value );
  putValue( KCAN_ZV_HD_offen, value );
  putValue( KCAN_BCM1_MH_Schalter, value );
  putValue( KCAN_ACC_Optischer_Fahrerhinweis, value ); // ACC/ADR
  if( value)  putValue( KCAN_ACC_Relevantes_Objekt, 2 ); // ACC Folgefahrt
 //  //   if( value)  putValue( eACC_Status_Prim_AnzS, 2 ); // ACC freie Fahrt
 //  //   putValue( eEPB_Fehlerlampe_BKLS, value );
  putValue( KCAN_ACC_Tachokranz, value );
}

void setWarnBlue(int value)
{
  putValue( KCAN_LV_Fernlicht_Anzeige, value );
  // Kaltleuchte (Erdgasvariante)
}

void setWarnNone()
{
  setWarnGreen ( 0 );
  setWarnYellow( 0 );
  setWarnRed   ( 0 );
  setWarnBlue  ( 0 );

  // green and yellow or red
 //  //   putValue( eACC_Texte_braking_guardS, 0 ); // TODO: Anhaltewegsverkürzung
  putValue( KCAN_ACC_Relevantes_Objekt, 0 ); // ACC Folgefahrt
 //  //   putValue( eACC_Status_Prim_AnzS, 0 ); // ACC freie Fahrt
}

on EnvVar ENV_WarnNone
{
  setWarnNone();
}

on EnvVar ENV_WarnGreen
{
  setWarnNone();
  setWarnGreen( 1 );
}

on EnvVar ENV_WarnYellow
{
  setWarnNone();
  setWarnYellow( 1 );
}

on EnvVar ENV_WarnRed
{
  setWarnNone();
  setWarnRed( 1 );
}

on EnvVar ENV_WarnBlue
{
  setWarnNone();
  setWarnBlue( 1 );
}

on envVar ENV_SendMfl
{
  putValue( ENV_SendMFL_Tasten_Kon_01, 0 );
}

on busOff
{
  msgBeep( 5 );
  write( "BusOff detected - resetting CAN" );
  resetCanEx( 1 );
}

on key 'r'
{
  resetCanEx( 1 );
}

on errorFrame
{
  CancelTimer( BusOffTimer );
  setTimer( BusOffTimer, 50 );
}

on timer BusOffTimer
{
  resetCanEx( 1 );
}

on key * {

if( getValue(ENV_MFL_LSS_Shortcut))
{

    write("Key: %X \n",keypressed());
    
    //IssueList #171 - if condition
    if( FirstKey !=this)
    {
    switch(this) {

        case 0x4800 : if( FirstKey == 0){FirstKey=this;}else{LastKey = this;}
                      write("Taste up\n");                      
                      setKey( enKeyUp, enKeyPressed );
                      if(!isTimerActive(KeyReleaseTimer))
                      setTimer(KeyReleaseTimer,100);
                      break;
        case 0x5000 : if( FirstKey == 0){FirstKey=this;}else{LastKey = this;}
                      write("Taste down\n");
                      setKey( enKeyDown, enKeyPressed );
                      if(!isTimerActive(KeyReleaseTimer))
                      setTimer(KeyReleaseTimer,100);
                      break;
        case 0x4D00 : if( FirstKey == 0){FirstKey=this;}else{LastKey = this;}
                      write("Taste right\n");
                      setKey( enKeyMenuUp, enKeyPressed );
                      if(!isTimerActive(KeyReleaseTimer))
                      setTimer(KeyReleaseTimer,100);
                      break;
               
        case 0x4B00 : if( FirstKey == 0){FirstKey=this;}else{LastKey = this;}
                      write("Taste left\n");               
                      setKey( enKeyMenuDown, enKeyPressed );
                      if(!isTimerActive(KeyReleaseTimer))
                      setTimer(KeyReleaseTimer,100);
                      break;

        case 0xD :    if( FirstKey == 0){FirstKey=this;}else{LastKey = this;}
                      write("Taste Enter\n");
                      setKey( enKeyOKWheelLeft, enKeyPressed );
                      if(!isTimerActive(KeyReleaseTimer))
                      setTimer(KeyReleaseTimer,100);
                      break;

        // '+'
        case 0x2B :   if( FirstKey == 0){FirstKey=this;}else{LastKey = this;}
                      write("Taste Volume Up\n"); 
                      setKey( enKeyVolumeUp, enKeyPressed );
                      if(!isTimerActive(KeyReleaseTimer))
                      setTimer(KeyReleaseTimer,100);
                      break;

       // '-'
       case 0x2D :    if( FirstKey == 0){FirstKey=this;}else{LastKey = this;}
                      write("Taste Volume Down\n");
                      setKey( enKeyVolumeDown, enKeyPressed );
                      if(!isTimerActive(KeyReleaseTimer))
                      setTimer(KeyReleaseTimer,100);
                      break;

       //'M'
       case 0x4D:    if( FirstKey == 0){FirstKey=this;}else{LastKey = this;}
                     write("Taste Menu\n");
                     setKey( enKeyMenu, enKeyPressed );
                     if(!isTimerActive(KeyReleaseTimer))
                     setTimer(KeyReleaseTimer,100);
                     break;

       //'D'
       case 0x44:    if( FirstKey == 0){FirstKey=this;}else{LastKey = this;}
                     write("Taste menu Down\n");                     
                     setKey( enKeyMenuDown, enKeyPressed );
                     if(!isTimerActive(KeyReleaseTimer))
                     setTimer(KeyReleaseTimer,100);
                     break;
 
       //'U'
       case 0x55:    if( FirstKey == 0){FirstKey=this;}else{LastKey = this;}
                     write("Taste menu Up\n");                     
                     setKey( enKeyMenuUp, enKeyPressed );
                     if(!isTimerActive(KeyReleaseTimer))
                     setTimer(KeyReleaseTimer,100);
                     break;

      //'P'
      case 0x50:    if( FirstKey == 0){FirstKey=this;}else{LastKey = this;}
                    write("Ptt\n");
                    setKey( enKeyPtt, enKeyPressed );
                    if(!isTimerActive(KeyReleaseTimer))
                    setTimer(KeyReleaseTimer,100);
                    break;

      //'C'
      case 0x43:    if( FirstKey == 0){FirstKey=this;}else{LastKey = this;}
                    write("ptt Cancel\n");
                    setKey( enKeyPttCancel, enKeyPressed );
                    if(!isTimerActive(KeyReleaseTimer))
                    setTimer(KeyReleaseTimer,100);
                    break;
  
      //'T'
      case 0x54:    if( FirstKey == 0){FirstKey=this;}else{LastKey = this;}
                    write("muTe\n");
                    setKey( enKeyMute, enKeyPressed );
                    if(!isTimerActive(KeyReleaseTimer))
                    setTimer(KeyReleaseTimer,100);
                    break;
      //'F1'
      case 0x3B00:                      
                if( getValue(ENV_MFL_LSS_Shortcut))
                {                                        
                     setKeyWheelEvent(enWheelLeft, enWheel1TickUp, 1);                   
                }
      break;   

      //'F2'
      case 0x3C00:                      
                if( getValue(ENV_MFL_LSS_Shortcut))
                {                                        
                    setKeyWheelEvent(enWheelLeft, enWheel1TickDown, 1);
                }
      break; 

      //'F3'
      case 0x6000:                      
                if( getValue(ENV_MFL_LSS_Shortcut))
                {                                        
                    setKeyWheelEvent(enWheelRight, enWheel1TickUp, 1);
                    write ("\n Volume +");
                }
      break;  

       //'F4'
      case 0x6100:                      
                if( getValue(ENV_MFL_LSS_Shortcut))
                {                                                            
                    setKeyWheelEvent(enWheelRight, enWheel1TickDown, 1);
                    write ("\n Volume -");
                }
      break;
//changes from Jöran Karl (28.03.2012)
      //'PageUp'
      case 0x4900:                      
                if( getValue(ENV_MFL_LSS_Shortcut))
                {                                        
                     setKeyWheelEvent(enWheelLeft, enWheel1TickUp, 1);                   
                }
      break;

      //'PageDown'
      case 0x5100:                      
                if( getValue(ENV_MFL_LSS_Shortcut))
                {                                        
                    setKeyWheelEvent(enWheelLeft, enWheel1TickDown, 1);
                }
      break;
   }
//end of changes from Jöran Karl (28.03.2012)
 }//if   
} //if
}

on timer KeyReleaseTimer
{
 if(keypressed()==0)
   {     
     switch(FirstKey) {

       case 0x4800 : FirstKey=0;
                     //write("Release Taste up\n"); 
                     releaseKey( enKeyUp );                     
                     break;             
       case 0x5000 : FirstKey=0;
                     //write("Release Taste down\n"); 
                     releaseKey( enKeyDown );
                     break;
       case 0x4D00 : FirstKey=0;
                     //write("Release Taste right\n"); 
                     releaseKey( enKeyMenuUp );
                     break;             
       case 0x4B00 : FirstKey=0;
                     //write("Release Taste left\n"); 
                     releaseKey( enKeyMenuDown );
                     break;                         
       case 0xD :    FirstKey=0;
                     //write("Release Taste Enter\n"); 
                     releaseKey( enKeyOKWheelLeft );
                     break;        
       case 0x2B :    FirstKey=0;
                     //write("Release Taste volume Up\n"); 
                     releaseKey( enKeyVolumeUp );
                     break;    
       case 0x2D :    FirstKey=0;
                     //write("Release Taste volume Down\n"); 
                     releaseKey( enKeyVolumeDown );
                     break;              
       case 0x4D :    FirstKey=0;
                     //write("Release Taste Menu\n"); 
                     releaseKey( enKeyMenu );
                     break;
       case 0x44 :    FirstKey=0;
                     //write("Release Taste menu Down\n"); 
                     releaseKey( enKeyMenuDown );
                     break;        
       case 0x55 :    FirstKey=0;
                     //write("Release Taste menu Up\n"); 
                     releaseKey( enKeyMenuUp );
                     break;    
       case 0x50 :    FirstKey=0;
                     //write("Release Taste Ptt\n"); 
                     releaseKey( enKeyPtt );
                     break;    
       case 0x43 :    FirstKey=0;
                     //write("Release Taste ptt Cancel\n"); 
                     releaseKey( enKeyPttCancel );
                     break;    
       case 0x54 :    FirstKey=0;
                     //write("Release Taste muTe\n"); 
                     releaseKey( enKeyMute );
                     break;    
      }
          
     switch(LastKey) {

       case 0x4800 : LastKey=0;
                     //write("Release Taste up\n"); 
                     releaseKey( enKeyUp );                     
                     break;             
       case 0x5000 : LastKey=0;
                     //write("Release Taste down\n"); 
                     releaseKey( enKeyDown );
                     break;
       case 0x4D00 : LastKey=0;
                     //write("Release Taste right\n"); 
                     releaseKey( enKeyMenuUp );
                     break;             
       case 0x4B00 : LastKey=0;
                     //write("Release Taste left\n"); 
                     releaseKey( enKeyMenuDown );
                     break;                         
       case 0xD :    LastKey=0;
                     //write("Release Taste Enter\n"); 
                     releaseKey( enKeyOKWheelLeft );
                     break;        
       case 0x2B :    LastKey=0;
                     //write("Release Taste volume Up\n"); 
                     releaseKey( enKeyVolumeUp );
                     break;    
       case 0x2D :    LastKey=0;
                     //write("Release Taste volume Down\n"); 
                     releaseKey( enKeyVolumeDown );
                     break;              
       case 0x4D :    LastKey=0;
                     //write("Release Taste Menu\n"); 
                     releaseKey( enKeyMenu );
                     break;
       case 0x44 :    LastKey=0;
                     //write("Release Taste menu Down\n"); 
                     releaseKey( enKeyMenuDown );
                     break;        
       case 0x55 :    LastKey=0;
                     //write("Release Taste menu Up\n"); 
                     releaseKey( enKeyMenuUp );
                     break;    
       case 0x50 :    LastKey=0;
                     //write("Release Taste Ptt\n"); 
                     releaseKey( enKeyPtt );
                     break;    
       case 0x43 :    LastKey=0;
                     //write("Release Taste ptt Cancel\n"); 
                     releaseKey( enKeyPttCancel );
                     break;    
       case 0x54 :    LastKey=0;
                     //write("Release Taste muTe\n"); 
                     releaseKey( enKeyMute );
                     break;    
      }
      cancelTimer( KeyReleaseTimer );
   }
  else
    setTimer(KeyReleaseTimer,100);
}

on envVar ENV_KeyCancelState
{
  if( getValue( this ))
  {
    setKey( enKeyCancel, enKeyPressed );
  }
  else
  {
    releaseKey( enKeyCancel );
  }
}

on envVar ENV_KeyAudioSourceState
{
  if( getValue( this ))
  {
    setKey( enKeyAudioSource, enKeyPressed );
  }
  else
  {
    releaseKey( enKeyAudioSource );
  }
}

on envVar ENV_KeyRouteInfoState
{
  if( getValue( this ))
  {
    setKey( enKeyRouteInfo, enKeyPressed );
  }
  else
  {
    releaseKey( enKeyRouteInfo );
  }
}

on envVar ENV_KeyHookState
{
  if( getValue( this ))
  {
    setKey( enKeyHook, enKeyPressed );
  }
  else
  {
    releaseKey( enKeyHook );
  }
}

on envVar ENV_KeyHangUpState
{
  if( getValue( this ))
  {
    setKey( enKeyHangUp, enKeyPressed );
  }
  else
  {
    releaseKey( enKeyHangUp );
  }
}

on envVar ENV_KeyOffHookState
{
  if( getValue( this ))
  {
    setKey( enKeyOffHook, enKeyPressed );
  }
  else
  {
    releaseKey( enKeyOffHook );
  }
}

on envVar ENV_KeyLightOnOffState
{
  if( getValue( this ))
  {
    setKey( enKeyLightOnOff, enKeyPressed );
  }
  else
  {
    releaseKey( enKeyLightOnOff );
  }
}

on envVar ENV_KeyJoker1State
{
  if( getValue( this ))
  {
    setKey( enKeyJoker1, enKeyPressed );
  }
  else
  {
    releaseKey( enKeyJoker1 );
  }
}

on envVar ENV_KeyJoker2State
{
  if( getValue( this ))
  {
    setKey( enKeyJoker2, enKeyPressed );
  }
  else
  {
    releaseKey( enKeyJoker2 );
  }
}

on envVar ENV_KeyAUpState
{
  if( getValue( this ))
  {
    setKey(enKeyAUp , enKeyPressed );
  }
  else
  {
    releaseKey( enKeyAUp );
  }
}

on envVar ENV_KeyADownState
{
  if( getValue( this ))
  {
    setKey(enKeyADown , enKeyPressed );
  }
  else
  {
    releaseKey( enKeyADown );
  }
}

on envVar ENV_KeyBUpState
{
  if( getValue( this ))
  {
    setKey(enKeyBUp , enKeyPressed );
  }
  else
  {
    releaseKey( enKeyBUp );
  }
}

on envVar ENV_KeyBDownState
{
  if( getValue( this ))
  {
    setKey(enKeyBDown , enKeyPressed );
  }
  else
  {
    releaseKey( enKeyBDown );
  }
}

on envVar ENV_MFL_LSS_switch
{
  if( getValue(this) == 2) //LSS Mode
  {
      enableControl ("MFL/LSS", "EnvVar:ENV_KeyJoker1State", 0);
      enableControl ("MFL/LSS", "EnvVar:ENV_KeyJoker2State", 0);
      enableControl ("MFL/LSS", "EnvVar:ENV_KeyVolUpState", 0);  
      enableControl ("MFL/LSS", "EnvVar:ENV_KeyVolDownState", 0);  
      enableControl ("MFL/LSS", "EnvVar:ENV_KeyWheelEventCodeRight_M1", 0);    
      enableControl ("MFL/LSS", "EnvVar:ENV_KeyWheelEventCodeRight_M2", 0);    
      enableControl ("MFL/LSS", "EnvVar:ENV_KeyWheelEventCodeRight_M3", 0);    
      enableControl ("MFL/LSS", "EnvVar:ENV_KeyWheelEventCodeRight_M4", 0);    
      enableControl ("MFL/LSS", "EnvVar:ENV_KeyWheelEventCodeRight_M5", 0);    
      enableControl ("MFL/LSS", "EnvVar:ENV_KeyWheelEventCodeRight_M6", 0);    
      enableControl ("MFL/LSS", "EnvVar:ENV_KeyWheelEventCodeRight_M7", 0);
      enableControl ("MFL/LSS", "EnvVar:ENV_KeyWheelEventCodeRight_P1", 0);
      enableControl ("MFL/LSS", "EnvVar:ENV_KeyWheelEventCodeRight_P2", 0);
      enableControl ("MFL/LSS", "EnvVar:ENV_KeyWheelEventCodeRight_P3", 0);
      enableControl ("MFL/LSS", "EnvVar:ENV_KeyWheelEventCodeRight_P4", 0);
      enableControl ("MFL/LSS", "EnvVar:ENV_KeyWheelEventCodeRight_P5", 0);
      enableControl ("MFL/LSS", "EnvVar:ENV_KeyWheelEventCodeRight_P6", 0);
      enableControl ("MFL/LSS", "EnvVar:ENV_KeyWheelEventCodeRight_P7", 0);  
      enableControl ("MFL/LSS", "EnvVar:ENV_SendMfl", 0);  
      enableControl ("MFL/LSS", "EnvVar:ENV_SendMFL_Tasten_Kon_01", 0);
      enableControl ("MFL/LSS", "EnvVar:ENV_MenuLevelsUpDown", 0);
      enableControl ("MFL/LSS", "EnvVar:ENV_MenuLevelsLeftRight", 0);
      enableControl ("MFL/LSS", "EnvVar:ENV_MenuLevelsCycleTime", 0);
      enableControl ("MFL/LSS", "EnvVar:ENV_MenuLevelsChange", 0);
      enableControl ("MFL/LSS", "EnvVar:ENV_KeyOkWheelRightState", 0);   
      
      putValue (KCAN_ZAS_Kl_15, 0);
      putValue (ENV_ModeSwitchStatus, "Mode Switching in progress...");
      setTimer (mode_switch_timer, 2000);   
  }
  else if( getValue(this) == 1) //MFL Mode
  {
      enableControl ("MFL/LSS", "EnvVar:ENV_KeyJoker1State", 1);
      enableControl ("MFL/LSS", "EnvVar:ENV_KeyJoker2State", 1);
      enableControl ("MFL/LSS", "EnvVar:ENV_KeyVolUpState", 1);  
      enableControl ("MFL/LSS", "EnvVar:ENV_KeyVolDownState", 1);  
      enableControl ("MFL/LSS", "EnvVar:ENV_KeyWheelEventCodeRight_M1", 1);    
      enableControl ("MFL/LSS", "EnvVar:ENV_KeyWheelEventCodeRight_M2", 1);    
      enableControl ("MFL/LSS", "EnvVar:ENV_KeyWheelEventCodeRight_M3", 1);    
      enableControl ("MFL/LSS", "EnvVar:ENV_KeyWheelEventCodeRight_M4", 1);    
      enableControl ("MFL/LSS", "EnvVar:ENV_KeyWheelEventCodeRight_M5", 1);    
      enableControl ("MFL/LSS", "EnvVar:ENV_KeyWheelEventCodeRight_M6", 1);    
      enableControl ("MFL/LSS", "EnvVar:ENV_KeyWheelEventCodeRight_M7", 1);
      enableControl ("MFL/LSS", "EnvVar:ENV_KeyWheelEventCodeRight_P1", 1);
      enableControl ("MFL/LSS", "EnvVar:ENV_KeyWheelEventCodeRight_P2", 1);
      enableControl ("MFL/LSS", "EnvVar:ENV_KeyWheelEventCodeRight_P3", 1);
      enableControl ("MFL/LSS", "EnvVar:ENV_KeyWheelEventCodeRight_P4", 1);
      enableControl ("MFL/LSS", "EnvVar:ENV_KeyWheelEventCodeRight_P5", 1);
      enableControl ("MFL/LSS", "EnvVar:ENV_KeyWheelEventCodeRight_P6", 1);
      enableControl ("MFL/LSS", "EnvVar:ENV_KeyWheelEventCodeRight_P7", 1);  
      enableControl ("MFL/LSS", "EnvVar:ENV_SendMfl", 1);  
      enableControl ("MFL/LSS", "EnvVar:ENV_SendMFL_Tasten_Kon_01", 1);
      enableControl ("MFL/LSS", "EnvVar:ENV_MenuLevelsUpDown", 1);
      enableControl ("MFL/LSS", "EnvVar:ENV_MenuLevelsLeftRight", 1);
      enableControl ("MFL/LSS", "EnvVar:ENV_MenuLevelsCycleTime", 1);
      enableControl ("MFL/LSS", "EnvVar:ENV_MenuLevelsChange", 1);
      enableControl ("MFL/LSS", "EnvVar:ENV_KeyOkWheelRightState", 1); 
      
      putValue (KCAN_ZAS_Kl_15, 0);
      putValue (ENV_ModeSwitchStatus, "Mode Switching in progress...");
      setTimer (mode_switch_timer, 2000);     
  }
}

on envVar ENV_AllWarn
{
    setAllWarn(1);
}

on timer mode_switch_timer
{
    putValue (KCAN_ZAS_Kl_15, 1);

    if( getValue(ENV_MFL_LSS_switch) == 1)
    {
        putValue(ENV_SendAtOnceMFL_Tasten_Kon_01, 1);
        putValue (ENV_ModeSwitchStatus, "Current Mode is MFL");
    }
    else
    {
        putValue (ENV_ModeSwitchStatus, "Current Mode is LSS");
    }
}

on envVar ENV_Case_SpeedRPM
{
  if( getValue( this ) == 1) /* do nothing */
  {
       resetSpeedRPMTest();
  }
  else if( getValue( this ) == 2) 
  {
       setRPMTest(); 
  }
  else if( getValue( this ) == 3) 
  {
       setSpeedTest();
  }
  else if( getValue( this ) == 4) 
  {
       setSpeedRpmTest();
  }
}

on timer tPRMSpeedTest
{
   if(enTestCount !=0 )
   switch (getValue(ENV_Case_SpeedRPM))
   {
   case 2:
      setRPMTest();
      break;
   case 3:
      setSpeedTest();
      break;
   case 4:
      if( getValue(ENV_ProductionMode) == 0x01)
      {
        if( enTestCount >7)
      setSpeedRPMTest();
      else
      {
      putValue(ENV_Case_SpeedRPM, 1);
      resetSpeedRPMTest();
      }

      }
      else
       setSpeedRPMTest();
      break;
   default: 
      break;
   }
   else
   {
     putValue(ENV_Case_SpeedRPM, 1);
   }
}

setRPMTest ()
{
    putValue(ENV_RPMStart, aadRPMTest[10-enTestCount][0]);
    putValue(ENV_RPMEnd, aadRPMTest[10-enTestCount][1]);
    putValue(ENV_RPMSteps, aadRPMTest[10-enTestCount][2]);
    putValue(ENV_RPMTime, aadRPMTest[10-enTestCount][3]);

    putValue(ENV_RPMSweep, 1);

    cancelTimer(tPRMSpeedTest);
    setTimer(tPRMSpeedTest, getValue(ENV_RPMSpeedTestTimer) * 1000);
    enTestCount--;
}

setSpeedTest ()
{
    putValue(ENV_SpeedStart, aadSpeedTest[10-enTestCount][0]);
    putValue(ENV_SpeedEnd, aadSpeedTest[10-enTestCount][1]);
    putValue(ENV_SpeedSteps, aadSpeedTest[10-enTestCount][2]);
    putValue(ENV_SpeedTime, aadSpeedTest[10-enTestCount][3]);

    putValue(ENV_SpeedSweep, 1);

    cancelTimer(tPRMSpeedTest);
    setTimer(tPRMSpeedTest, getValue(ENV_RPMSpeedTestTimer) * 1000);
    enTestCount--;
}

setSpeedRPMTest ()
{
    putValue(ENV_SpeedStart, aadSpeedTest[10-enTestCount][0]);
    putValue(ENV_SpeedEnd, aadSpeedTest[10-enTestCount][1]);
    putValue(ENV_SpeedSteps, aadSpeedTest[10-enTestCount][2]);
    putValue(ENV_SpeedTime, aadSpeedTest[10-enTestCount][3]);


    putValue(ENV_RPMStart, aadRPMTest[10-enTestCount][0]);
    putValue(ENV_RPMEnd, aadRPMTest[10-enTestCount][1]);
    putValue(ENV_RPMSteps, aadRPMTest[10-enTestCount][2]);
    putValue(ENV_RPMTime, aadRPMTest[10-enTestCount][3]);

    putValue(ENV_SpeedSweep, 1);
    putValue(ENV_RPMSweep, 1);

    cancelTimer(tPRMSpeedTest);
    setTimer(tPRMSpeedTest, getValue(ENV_RPMSpeedTestTimer) * 1000);
    enTestCount--;


      if( getValue(ENV_ProductionMode) == 0x01)
    {
    putValue(ENV_Production_String, "TEST RUNNING");
    putValue(ENV_Production_alarm,0);
    }
    else
    putValue(ENV_Production_String, "NORMAL MODE");

}

resetSpeedRPMTest ()
{
    enTestCount = 10;

    putValue(ENV_SpeedStart, 0);
    putValue(ENV_SpeedEnd, 0);
    putValue(ENV_SpeedSteps, 0);
    putValue(ENV_SpeedTime, 0);

    putValue(ENV_RPMStart, 0);
    putValue(ENV_RPMEnd, 0);
    putValue(ENV_RPMSteps, 0);
    putValue(ENV_RPMTime, 0);

    putValue(ENV_SpeedSweep, 0);
    putValue(ENV_RPMSweep, 0);
    putValue(ENV_SpeedInput, 0);
    putValue(KCAN_MO_Anzeigedrehz, 0);
 //  //     putValue(eMO_ITM_Kuehlmittel_TempS, 0);
    
    if( getValue(ENV_ProductionMode) == 0x01)
    {
    putValue(ENV_Production_String, "STOP");
    putValue(ENV_Production_alarm, 1);
    }
}

on envVar ENV_ProductionMode
{
   if( getValue(this))
   {
   enableControl ("RPM_SPEED_production", "EnvVar:ENV_Production_alarm", 1);
   enableControl ("RPM_SPEED_production", "EnvVar:ENV_Production_String", 1);
   }

   else
   {
   enableControl ("RPM_SPEED_production", "EnvVar:ENV_Production_alarm", 0);
   enableControl ("RPM_SPEED_production", "EnvVar:ENV_Production_String", 0);
   }
      putValue(ENV_Production_String, "STOP");
}


on envVar ENV_SpeedOverfeedFactor
{
 //IssueList #74: addition of SpeedOverFeedFactor
 double actualSpeed_;

  actualSpeed_ = 0;
  
  actualSpeed_= getValue( ENV_SpeedInput ) * dSpeedFactor * getValue(ENV_SpeedOverfeedFactor);
  putValue( ENV_Speed, actualSpeed_);
}

//IssueList #175
//calculate the dimming values on every change of KBI_photransistor
on signal Sensorik_Dimmung_01::KBI_Phototransistor
{
if( getValue(ENV_CalculateKl58d)==0x01)
calculateKl58d();

}

//MR 61808
on envVar ENV_KeyFAS_Taster
{
  if( getValue( this ))
  {
    setKey( enKeyFAS_Taster, enKeyPressed );
  }
  else
  {
    releaseKey( enKeyFAS_Taster );
  }
}

//copy of MR 61187  for 15S1
/*on signal s_klemme_15
{
    if( this == 0x00)
    {
        cancelTimer( tMflCycleSend );
        bMflCycleCount = bMflNullFrameCount; // to send 5 times
        setTimer( tMflCycleSend, 1 );
    }
}*/

//MR 77727
on envVar ENV_KeyView
{
  if( getValue( this ))
  {
    setKey( enKeyView, enKeyPressed );
  }
  else
  {
    releaseKey( enKeyView );
  }
}
//VAGH-26971
on envVar ENV_KeyMainMenuState
{
  if( getValue( this ))
  {
    setKey( enKeyMainMenu, enKeyPressed );
  }
  else
  {
    releaseKey( enKeyMainMenu );
  }
}
//VAGH-26971
on envVar ENV_KeySideMenuleftState
{
  if( getValue( this ))
  {
    setKey( enKeySideMenuleft, enKeyPressed );
  }
  else
  {
    releaseKey( enKeySideMenuleft );
  }
}
//VAGH-26971
on envVar ENV_KeySideMenurightState
{
  if( getValue( this ))
  {
    setKey( enKeySideMenuright, enKeyPressed );
  }
  else
  {
    releaseKey( enKeySideMenuright );
  }
}
//VAGH-26971
on envVar ENV_KeyExhaustSoundState
{
  if( getValue( this ))
  {
    setKey( enKeyExhaustSound, enKeyPressed );
  }
  else
  {
    releaseKey( enKeyExhaustSound );
  }
}
//VAGH-26971
on envVar ENV_KeyDriveSelectbuttonState
{
  if( getValue( this ))
  {
    setKey( enKeyDriveSelectbutton, enKeyPressed );
  }
  else
  {
    releaseKey( enKeyDriveSelectbutton );
  }
}
//VAGH-26971
on envVar ENV_KeySportbuttonState
{
  if( getValue( this ))
  {
    setKey( enKeySportbutton, enKeyPressed );
  }
  else
  {
    releaseKey( enKeySportbutton );
  }
}
//VAGH-26971
on envVar ENV_KeyESPDriftSelectionState
{
  if( getValue( this ))
  {
    setKey( enKeyESPDriftSelection, enKeyPressed );
  }
  else
  {
    releaseKey( enKeyESPDriftSelection );
  }
}
