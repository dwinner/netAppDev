/*@@var:*/
variables
{
    char path[250];
    char Simu_Name[80] = "BR213_V4.00   E009.2 pre20 and newer\\\\";
    char Tool_Name[40] = "Test_GC\\\\EL\\\\Test_020.bat";
    char sActiveReplay[32];
    dword activeReplayHandle;
}
/*@@end*/

/*@@startStart:Start:*/
on start
{
    putValue( Env_TEST_Replay_Trigger_EL, 0);
    putValue( Env_TEST_Loop_Countdown_EL, 0);
}
/*@@end*/

/*@@caplFunc:Test_Start_Download():*///function
Test_Start_Download()
{
char Toollink[270];

    {
        ReadSimuPath( "..\\..\\205TP_HWR_Path.ini" );
        strncpy( Toollink, path, 248 );
        strncat( Toollink, Simu_Name, 248 );  
        strncat( Toollink, Tool_Name, 248 );  
        write( "Try to open character recognition tool under the following path:" );
        write( "   %s", Toollink );
        dllRunEXE( Toollink );
    }
}
/*@@end*/

/*@@caplFunc:ReadSimuPath(char[]):*///function
ReadSimuPath( char iniFilename[] )
{
      // Lese zwei INT-Parameter aus der INI Datei "Test.Ini" :
      //  "ReadPara1",
      //  "ReadPara2".     (Sektion "Input")
      // 
//      readPara1 = getProfileInt("Input","ReadPara1",defVal,iniFilename);
//      readPara2 = getProfileInt("Input","ReadPara2",defVal,iniFilename);
      //
      // Wird der Pfad fuer die Schreiboperation nicht explizit 
      // gesetzt, so wird der Pfad der Konfigurationsdatei heran-
      // gezogen.
      // 


	getProFileString( "Path_HWR_Tool", "Simulation_Root_Path", "D:\\CANsimulations\\W213", path, elcount( path ), iniFilename );

}
/*@@end*/

/*@@envVar:Env_TEST_Trace_Rec_Stop_EL:*/
on envVar Env_TEST_Trace_Rec_Stop_EL
{
    char Toollink[270];

    if( getValue( this ) )
    {
        ReadSimuPath( "..\\..\\205TP_HWR_Path.ini" );
        strncpy( Toollink, path, 248 );
        strncat( Toollink, Simu_Name, 248 );
        snprintf(Tool_Name, elcount(Tool_Name ), "Test_GC\\\\EL\\\\Trace_Rec_Stop_%03u.bat", getValue(Env_TEST_Actual_Replay_EL ));
        strncat( Toollink, Tool_Name, 248 );
        write("Executing external tool:\n   %s", Toollink );
        dllRunEXE( Toollink );
    }
    putValue( this, 0 );
}
/*@@end*/

/*@@envVar:Env_TEST_Trace_Rec_Start_EL:*/
on envVar Env_TEST_Trace_Rec_Start_EL
{
    char Toollink[270];

    if( getValue( this ) )
    {
        ReadSimuPath( "..\\..\\205TP_HWR_Path.ini" );
        strncpy( Toollink, path, 248 );
        strncat( Toollink, Simu_Name, 248 );
        strncpy(Tool_Name, "Test_GC\\\\EL\\\\Trace_Rec_Start.bat", elcount( Tool_Name ) );
        strncat( Toollink, Tool_Name, 248 );
        write("Executing external tool:\n   %s", Toollink);
        dllRunEXE( Toollink );
    }
    putValue( this, 0 );
}
/*@@end*/

/*@@envVar:Env_TEST_Start_Post_Processing_EL:*/
on envVar Env_TEST_Start_Post_Processing_EL
{
    char Toollink[270];

    if( getValue( this ) )
    {
        ReadSimuPath( "..\\..\\205TP_HWR_Path.ini" );
        strncpy( Toollink, path, 248 );
        strncat( Toollink, Simu_Name, 248 );
        strncpy(Tool_Name, "Test_GC\\\\EL\\\\post_Process_EL.bat", elcount( Tool_Name ) );
        strncat( Toollink, Tool_Name, 248 );
        write("Executing external tool:\n   %s", Toollink);
        dllRunEXE( Toollink );
    }
    putValue( this, 0 );
}
/*@@end*/

/*@@envVar:Env_TEST_Replay_Trigger_EL:*/
on envVar Env_TEST_Replay_Trigger_EL 
{
    if( getValue(this)) 
    {
        if( getValue(Env_TEST_Loop_Countdown_EL ) > 0 ) 
        {
            if (( getValue(Env_TEST_Loop_Mode_EL ) == 0) || ((getValue( Env_TEST_Loop_Mode_EL ) == 1 ) && ( getValue( Env_TEST_Actual_Replay_EL ) == 0 )))
            {
                putValue(Env_TEST_Loop_Countdown_EL, getValue(Env_TEST_Loop_Countdown_EL ) - 1 );
            }
        }
        snprintf( sActiveReplay, elcount( sActiveReplay ), "Traces\\EL_GC\\Test_Trace_%03u.asc", getValue( Env_TEST_Actual_Replay_EL ));
        putValue( Env_TEST_Replay_Running_EL, 1 );
        activeReplayHandle = StartReplayFile( sActiveReplay );
    } 
    else 
    {
        StopReplayFile(activeReplayHandle);
    }
}
/*@@end*/

/*@@envVar:Env_TEST_Replay_Running_EL:*/
on envVar Env_TEST_Replay_Running_EL
{
    if( !getValue(this)) 
    {
        putValue( Env_TEST_Replay_Trigger_EL, 0);
        switch( getValue( Env_TEST_Loop_Mode_EL )) 
        {
            case 0:
                if (getValue(Env_TEST_Loop_Countdown_EL ) > 0) 
                {
                    putValue(Env_TEST_Replay_Trigger_EL, 1);
                }
                break;
            case 1:
                switch (getValue(Env_TEST_Actual_Replay_EL)) 
                {
                    case 6:
                        putValue(Env_TEST_Actual_Replay_EL, 8);
                        break;
                    case 26:
                        putValue(Env_TEST_Actual_Replay_EL, 28);
                        break;
                    case 29:
                        putValue(Env_TEST_Actual_Replay_EL, 31);
                        break;
                    case 48:
                        putValue(Env_TEST_Actual_Replay_EL, 50);
                        break;
                    case 52:
                        putValue(Env_TEST_Actual_Replay_EL, 0);
                        break;
                    default:
                        putValue(Env_TEST_Actual_Replay_EL, getValue(Env_TEST_Actual_Replay_EL ) + 1);
                        break;
                }
                if ((getValue(Env_TEST_Loop_Countdown_EL ) > 0) || (getValue(Env_TEST_Actual_Replay_EL ) != 0)) 
                {
                    putValue(Env_TEST_Replay_Trigger_EL, 0);
                    putValue(Env_TEST_Replay_Trigger_EL, 1);
                }
                break;
        }
    }

}
/*@@end*/

