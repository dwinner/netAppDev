/*@@var:*/
/*
Copyright ( C ) Continental AG 2012

Created by generator, do not modify

Based on Version  1.0, 12.05.10   from M.Dangelmeyr      IBD im Auftrag von EP/ESE   Daimler AG

Date of creation :  14.04.2011

Created by :                 Hans Jürgen Hipp
changed by :                 SAL  KMatrix 2014_05a deactivation signal ECU_APPL_DISP_RL1
*/


variables
{
    const TRUE  = 0xAA;
    const FALSE = 0x00;

    msTimer t_DBKomTimer;      // Timer zum zyklischen Aufruf der DBKom-Task
    int c_tDBKomTimer = 20;    // msec


    // BA_DEF_ BO_  "GenMsgSendType" ENUM
    //  0 : cyclicX
    //  1 : spontanX
    //  2 : cyclicIfActiveX
    //  3 : spontanWithDelay
    //  4 : cyclicAndSpontanX
    //  5 : cyclicAndSpontanWithDelay
    //  6 : spontanWithRepitition
    //  7 : cyclicIfActiveAndSpontanWD
    //  8 : cyclicIfActiveFast
    //  9 : cyclicWithRepeatOnDemand
    //  10 : none

   // Botschaft DISP_RL_Stat_AR ---- Sendeart 5 cyclicAndSpontanWithDelay
   message DISP_RL_Stat_AR _mDISP_RL_Stat_AR;
   int _DISP_RL_Stat_AR_CycleCount = 5;
   int _DISP_RL_Stat_AR_Cnt;
   int _DISP_RL_Stat_AR_SpontanFlag = 0;
   int _DISP_RL_Stat_AR_MinDelay = 0;
   int _DISP_RL_Stat_AR_DelayCnt;
   msTimer _tDISP_RL_Stat_AR;

   
   // Update Kmatrix2014_05a
   // Botschaft ECU_APPL_DISP_RL1 ---- Sendeart 1 spontanX
   /*message ECU_APPL_DISP_RL1 _mECU_APPL_DISP_RL1;
   int _ECU_APPL_DISP_RL1_SpontanFlag = 0;
   msTimer _tECU_APPL_DISP_RL1;*/

   // Botschaft ROE_DISP_RL ---- Sendeart 1 spontanX
   message ROE_DISP_RL _mROE_DISP_RL;
   int _ROE_DISP_RL_SpontanFlag = 0;  
   msTimer _tROE_DISP_RL;



    Timer _tDoorNMCancelTimer;
    Timer _tKeyInLockNMCancelTimer;

    char buffer[1024], stringbuffer[512];
    int bActiveHelper;    // Hilfsvariable für "Aktive Signale"

//--------------------------------------- AUTOSAR NM ------------------------------------------------

    const byte cAUTO =   0;
    const byte cMANUAL = 1;

    msTimer t_NM_Transmit;
    long  NM_Transmit_Cycle;
    msTimer t_NM_Wait_Bus_Sleep_Time;
    const c_NM_Wait_Bus_Sleep_Time = 1500;
//    msTimer t_NM_Remote_Sleep_Ind_Time;
    const c_NM_Remote_Sleep_Ind_Time = 5000;
    msTimer t_NM_Repeat_Message_Time;
    const c_NM_Repeat_Message_Time = 6000;
    msTimer t_NM_Timeout_Time;
    const c_NM_Timeout_Time = 5000;

    byte NM_Mode = 0;
    const byte cNM_Mode_Init = 0;
    const byte cNM_Mode_Sleep = 1;
    const byte cNM_Mode_Prepare_Bus_Sleep = 2;
    const byte cNM_Mode_Ready_Sleep = 3;
    const byte cNM_Mode_Normal_Operation_State = 4;
    const byte cNM_Mode_RepeatMsg = 5;

    byte boCanNM_Rx_Indication = 0; 
    byte boCanNM_Tx_Confirmation = 0; 
    byte boCanNM_WaitBusSleep_Timer_Expired = 0; 
    byte boCanNM_RepeatMessage_Timer_Expired = 0; 
    byte boCanNM_NM_Timeout_Timer_Expired = 0; 
    byte boCanNM_RepeatMessage_Requested = 0; 

    const cFLDoorNMRequest =     1;
    const cFRDoorNMRequest =     2;
    const cRLDoorNMRequest =     4;
    const cRRDoorNMRequest =     8;
    const cIgnitionNMRequest =  16;
    const cManualNMRequest =   128;

    const CanNmNodeId_Base =       1280; //  = 400h
    const CanNmNodeId_TPAD =         55;
    const CanNmNodeId_TGW =          56; //  =  38h
    const CanNmNodeId_DISP_RL =      57;
    const CanNmNodeId_CTRL_C =       58;
    const CanNmNodeId_DISP_C =       59;
    const CanNmNodeId_FU =           60;
    const CanNmNodeId_DISP_RR =      61;

    const CanNmNodeDetectionEnabled          = 0; //false
    const CanNmNodeIdEnabled                 = 1; //true
    const CanNmUserDataEnabled               = 1; //true;
    const CanNmUserDataLentgh                = 7;
    const CanNmRepeatMsgIndEnabled           = 1; //true;
    const CanNmDevErrorDetect                = 0; //false
//    const CanNmUserDataEnabled             = 1; //true
    const CanNmRemoteSleepIndEnabled         = 0; //false
    const CanNmMsgReducedtime                = 80; //ms
    const CanNmPduRxIndicationEnabled        = 0; //false
    const CanNmStateChangeIndEnabled         = 0; //false
    const CanNmImmediateTxconfEnabled        = 0;// false
    const CanNmMsgTimeoutTime                = 5000; //ms
    const CanNmPduNidPosition                = 0; //CANNM_PDU_BYTE_0;
    const CanNmPduCbvPosition                = 0xFF; //ANNM_PDU_OFF;
    const CanNmPduLength                     = 8;
    const cCanNmPassiveModeEnabled           = 0; //false
    const CanNmBusSynchronizationEnabled     = 0; //false
    const CanNmBusLoadReductionEnabled       = 1; //true
//    const CanNmRemoteSleepIndEnabled       = 0; //false
//    const CanNmNodeDetectionEnabled        = 0; //false
    const CanNmComControlEnabled             = 1; //true    

    const NmAsrCanMsgStandardCycle =          2000;
    const NmAsrCanMsgCycleOffset_TPAD =         70;
    const NmAsrCanMsgReducedTime_TPAD =       1550;
    const NmAsrCanMsgCycleOffset_TGW =           0;
    const NmAsrCanMsgReducedTime_TGW =        1560;
    const NmAsrCanMsgCycleOffset_DISP_RL =      10;
    const NmAsrCanMsgReducedTime_DISP_RL =    1570;
    const NmAsrCanMsgCycleOffset_CTRL_C =       20;
    const NmAsrCanMsgReducedTime_CTRL_C =     1580;
    const NmAsrCanMsgCycleOffset_DISP_C =       30;
    const NmAsrCanMsgReducedTime_DISP_C =     1590;
    const NmAsrCanMsgCycleOffset_FU =           40;
    const NmAsrCanMsgReducedTime_FU =         1600;
    const NmAsrCanMsgCycleOffset_DISP_RR =      50;
    const NmAsrCanMsgReducedTime_DISP_RR =    1610;

    char gECU[12] = "HU_DISP_RL";

    byte CanNmNodeId            = CanNmNodeId_DISP_RL;
    word NmNodeIdentifier       = CanNmNodeId_Base + CanNmNodeId_DISP_RL;
    word NmAsrCanMsgCycleOffset = NmAsrCanMsgCycleOffset_DISP_RL;
    word NmAsrCanMsgReducedTime = NmAsrCanMsgReducedTime_DISP_RL;
    word NmAsrCanMsgCycleTime   = 2000;
    byte NM_Repeat_Message_State_Active = 0;
    byte NM_AutomaticModeActive = 0;

    // Botschaft NM_xxx_AR ---- Sendeart cyclicX
      message CAN1.HU_NM::NM_DISP_RL_AR _mNM_xxx_AR;

//--------------------------------------- AUTOSAR NM ------------------------------------------------

   byte  crctable[256] = {
      0x00, 0x1D, 0x3A, 0x27, 0x74, 0x69, 0x4E, 0x53,
      0xE8, 0xF5, 0xD2, 0xCF, 0x9C, 0x81, 0xA6, 0xBB,
      0xCD, 0xD0, 0xF7, 0xEA, 0xB9, 0xA4, 0x83, 0x9E,
      0x25, 0x38, 0x1F, 0x02, 0x51, 0x4C, 0x6B, 0x76,
      0x87, 0x9A, 0xBD, 0xA0, 0xF3, 0xEE, 0xC9, 0xD4,
      0x6F, 0x72, 0x55, 0x48, 0x1B, 0x06, 0x21, 0x3C,
      0x4A, 0x57, 0x70, 0x6D, 0x3E, 0x23, 0x04, 0x19,
      0xA2, 0xBF, 0x98, 0x85, 0xD6, 0xCB, 0xEC, 0xF1,
      0x13, 0x0E, 0x29, 0x34, 0x67, 0x7A, 0x5D, 0x40,
      0xFB, 0xE6, 0xC1, 0xDC, 0x8F, 0x92, 0xB5, 0xA8,
      0xDE, 0xC3, 0xE4, 0xF9, 0xAA, 0xB7, 0x90, 0x8D,
      0x36, 0x2B, 0x0C, 0x11, 0x42, 0x5F, 0x78, 0x65,
      0x94, 0x89, 0xAE, 0xB3, 0xE0, 0xFD, 0xDA, 0xC7,
      0x7C, 0x61, 0x46, 0x5B, 0x08, 0x15, 0x32, 0x2F,
      0x59, 0x44, 0x63, 0x7E, 0x2D, 0x30, 0x17, 0x0A,
      0xB1, 0xAC, 0x8B, 0x96, 0xC5, 0xD8, 0xFF, 0xE2,
      0x26, 0x3B, 0x1C, 0x01, 0x52, 0x4F, 0x68, 0x75,
      0xCE, 0xD3, 0xF4, 0xE9, 0xBA, 0xA7, 0x80, 0x9D,
      0xEB, 0xF6, 0xD1, 0xCC, 0x9F, 0x82, 0xA5, 0xB8,
      0x03, 0x1E, 0x39, 0x24, 0x77, 0x6A, 0x4D, 0x50,
      0xA1, 0xBC, 0x9B, 0x86, 0xD5, 0xC8, 0xEF, 0xF2,
      0x49, 0x54, 0x73, 0x6E, 0x3D, 0x20, 0x07, 0x1A,
      0x6C, 0x71, 0x56, 0x4B, 0x18, 0x05, 0x22, 0x3F,
      0x84, 0x99, 0xBE, 0xA3, 0xF0, 0xED, 0xCA, 0xD7,
      0x35, 0x28, 0x0F, 0x12, 0x41, 0x5C, 0x7B, 0x66,
      0xDD, 0xC0, 0xE7, 0xFA, 0xA9, 0xB4, 0x93, 0x8E,
      0xF8, 0xE5, 0xC2, 0xDF, 0x8C, 0x91, 0xB6, 0xAB,
      0x10, 0x0D, 0x2A, 0x37, 0x64, 0x79, 0x5E, 0x43,
      0xB2, 0xAF, 0x88, 0x95, 0xC6, 0xDB, 0xFC, 0xE1,
      0x5A, 0x47, 0x60, 0x7D, 0x2E, 0x33, 0x14, 0x09,
      0x7F, 0x62, 0x45, 0x58, 0x0B, 0x16, 0x31, 0x2C,
      0x97, 0x8A, 0xAD, 0xB0, 0xE3, 0xFE, 0xD9, 0xC4
   };

}
/*@@end*/

/*@@startStart:Start:*/
on start
{
    putValue( HU__NM_DISP_RL_NM_Request, 0 );  // reset all requests
    _NM_Switch_NM_Mode();
    DISP_RL_Stat_AR_init();                  // Botschaft DISP_RL_Stat_AR            --- Sendeart 5 cyclicAndSpontanWithDelay --- 
    //ECU_APPL_DISP_RL1_init();                // Botschaft ECU_APPL_DISP_RL1          --- Sendeart 1 spontanX --- 
    ROE_DISP_RL_init();                      // Botschaft ROE_DISP_RL                --- Sendeart 9 cyclicWithRepeatOnDemand --- 

    putValue( HU__NM_DISP_RL_AutomaticModeActive, 0 );
    putValue( HU__NM_DISP_RL_AutomaticModeActive, 1 );
}
/*@@end*/

/*@@timer:t_DBKomTimer:*/
on Timer t_DBKomTimer
{
// *** DBKom-Sendefunktion ***
    // timer aufziehen für nächsten Zyklus
    if( getValue( HU__NM_DISP_RL_CommActive        ) |
        getValue( HU__NM_DISP_RL_RequestBusCom )   )
    {
        setTimer( t_DBKomTimer, 20 );
    }
    DISP_RL_Stat_AR_check_output();                 // Botschaft DISP_RL_Stat_AR                 --- Sendeart 5 cyclicAndSpontanWithDelay --- 
    //ECU_APPL_DISP_RL1_check_output();                 // Botschaft ECU_APPL_DISP_RL1                 --- Sendeart 1 spontanX --- 
    ROE_DISP_RL_check_output();                 // Botschaft ROE_DISP_RL                 --- Sendeart 9 cyclicWithRepeatOnDemand --- 

}
/*@@end*/

/*@@busOff:BusOff:*/
on busOff
{
    resetCan();
    write("CAN has been resetted due to BUSOFF    ( coded version )");
}
/*@@end*/

/*@@msg:0x500-0x57F:*/
on message 0x500-0x57F
{
    byte Identifier;

    Identifier = this.byte(1 );

    if( this.byte(1) == CanNmNodeId )    // check, wether the received NM-Frame is an own one
    {
        boCanNM_Tx_Confirmation = TRUE;    // so it is a TX-confirmation
    }
    else
    {
        boCanNM_Rx_Indication = TRUE;     // else it is a NM-Frame from another ECU
    }
    _NM_Switch_NM_Mode();     // inform the state-mashine
}
/*@@end*/

/*@@timer:_tDoorNMCancelTimer:*/
on timer _tDoorNMCancelTimer
{
    if( getValue( HU__NM_DISP_RL_AutomaticModeActive ) == 1 )
    {
//      write("HJH:_tDoorNMCancelTimer : expired");
//        Trace( "_tDoorNMCancelTimer expired", "", "_ReleaseCommRequest( 15 )");
        _ReleaseCommRequest( 15 );  // all doors reset their requests
    }
//    Trace( "_tDoorNMCancelTimer", "Timer expired");
}
/*@@end*/

/*@@timer:_tKeyInLockNMCancelTimer:*/
on timer _tKeyInLockNMCancelTimer
{
    if( getValue( HU__NM_DISP_RL_AutomaticModeActive ) == 1)
    {
//    write("HJH:_tKeyInLockNMCancelTimer : expired");
//    writeLineEx(dwWriteSinkSimu, dwWriteSeverityInfo, "_tKeyInLockNMCancelTimer expired");
//        Trace( "_tKeyInLockNMCancelTimer expired", "", "_ReleaseCommRequest( cIgnitionNMRequest )");
        _ReleaseCommRequest( cIgnitionNMRequest );
    }
}
/*@@end*/

/*@@timer:t_NM_Repeat_Message_Time:*/
on timer t_NM_Repeat_Message_Time
{
    boCanNM_RepeatMessage_Timer_Expired = TRUE;
    _NM_Switch_NM_Mode();     // inform the state-mashine
}
/*@@end*/

/*@@timer:t_NM_Timeout_Time:*/
on timer t_NM_Timeout_Time
{
    boCanNM_NM_Timeout_Timer_Expired = TRUE;
    _NM_Switch_NM_Mode();     // inform the state-mashine
}
/*@@end*/

/*@@timer:t_NM_Transmit:*/
on timer t_NM_Transmit
{
    setTimer( t_NM_Transmit, NM_Transmit_Cycle );
    _mNM_xxx_AR.byte(1) = CanNmNodeId;
    output( _mNM_xxx_AR );
}
/*@@end*/

/*@@timer:t_NM_Wait_Bus_Sleep_Time:*/
on timer t_NM_Wait_Bus_Sleep_Time
{
    boCanNM_WaitBusSleep_Timer_Expired = TRUE;
    _NM_Switch_NM_Mode();     // inform the state-mashine
}
/*@@end*/

/*@@envVar:HU__NM_DISP_RL_AutomaticModeActive:*/
on envVar HU__NM_DISP_RL_AutomaticModeActive
{
    byte temp; // actual NM request status

    if( getValue( this ) )
    {
        EnableControl( "Hauptpanel", "EnvVar:HMI__NM_DISP_RL_Manually_Request_NM", 0 );

        temp = getValue( HU_ISw_Stat );
        write( "HU_ISw_Stat is %d", temp );
        if( temp > 1 ) // IGN not Lock
        {
            putValue( HU__NM_DISP_RL_Manually_Request_NM, 1 );
            putValue( HU__NM_DISP_RL_NM_Request, cIgnitionNMRequest );
            _NM_Switch_NM_Mode();
        }
        else
        {
            putValue( HU__NM_DISP_RL_Manually_Request_NM, 0 );
            _ReleaseCommRequest( 0xFF );  // release all requests
            _NM_Switch_NM_Mode();
        }
    }
    else
    {
        _ReleaseCommRequest( 0xFF );  // release all requests
    }
    NM_AutomaticModeActive = getValue( this );
}
/*@@end*/

/*@@envVar:HU__NM_DISP_RL_COM_Request:*/
on envVar HU__NM_DISP_RL_COM_Request
{
    byte temp;   //actual ISw_stat
    temp = getValue( this );
    if( temp == 0)
    {
        if( getValue( HU__NM_DISP_RL_AutomaticModeActive ) == 1)
        {
        cancelTimer( _tKeyInLockNMCancelTimer );
        _ReleaseCommRequest( cIgnitionNMRequest );
        setTimer( _tKeyInLockNMCancelTimer, 1 );
        }
    }
    if( temp == 1)
    {
        if( getValue( HU__NM_DISP_RL_AutomaticModeActive ) == 1)
        {
        cancelTimer( _tKeyInLockNMCancelTimer );
        _SetCommRequest( cIgnitionNMRequest );
        }
    }
}
/*@@end*/

/*@@envVar:HU__NM_DISP_RL_Manually_Request_NM:*/
on envVar HU__NM_DISP_RL_Manually_Request_NM
{
    if( getValue( HU__NM_DISP_RL_AutomaticModeActive ) == 0 )
    {
        if( getValue( this ) )
        {
            _SetCommRequest( cManualNMRequest );
        }
        else
        {
            _ReleaseCommRequest( 0xFF );// all
        }
    }
}
/*@@end*/

/*@@caplFunc:_NM_Switch_NM_Mode():*///function
_NM_Switch_NM_Mode()
{
    byte bOld_NM_Mode;
    byte NM_Request_State;

    bOld_NM_Mode = NM_Mode;
    NM_Request_State = getValue( HU__NM_DISP_RL_NM_Request );
    switch( NM_Mode )
    {
        case cNM_Mode_Init:                   _NM_Init();
                                              NM_Mode = cNM_Mode_Sleep;
                                              break;
        case cNM_Mode_Sleep:                  if( boCanNM_Rx_Indication == TRUE )
                                              {
                                                  // _NM_NetworkStartIndication();   nothing to do
                                                  // _NM_PassiveStartUp();    is content of _NM_NetworkMode();
                                                  setTimer( t_NM_Transmit, NmAsrCanMsgCycleOffset );    // send NM-Frame delayed
                                                  boCanNM_Rx_Indication = FALSE;
                                                  cancelTimer( t_NM_Timeout_Time );
                                                  setTimer( t_NM_Timeout_Time, c_NM_Timeout_Time );
                                                  setTimer( t_NM_Repeat_Message_Time, c_NM_Repeat_Message_Time );
                                                  NM_Transmit_Cycle = NmAsrCanMsgStandardCycle;
                                                  _NM_NetworkMode();
                                                  NM_Mode = cNM_Mode_RepeatMsg;
                                              }
                                              if( NM_Request_State )
                                              {
                                                  setTimer( t_NM_Transmit, 1 );    //send NM-Franme immediately
                                                  NM_Transmit_Cycle = NmAsrCanMsgStandardCycle;
                                                  cancelTimer( t_NM_Timeout_Time );
                                                  setTimer( t_NM_Timeout_Time, c_NM_Timeout_Time );
                                                  setTimer( t_NM_Repeat_Message_Time, c_NM_Repeat_Message_Time );
                                                  NM_Transmit_Cycle = NmAsrCanMsgStandardCycle;
                                                  _NM_NetworkMode();
                                                  NM_Mode = cNM_Mode_RepeatMsg;
                                              }
                                              break;
        case cNM_Mode_Prepare_Bus_Sleep:      if( boCanNM_WaitBusSleep_Timer_Expired == TRUE )
                                              {
                                                  // _NM_BusSleepModeInd();   // no action to be taken
                                                  NM_Mode = cNM_Mode_Sleep;
                                                  boCanNM_WaitBusSleep_Timer_Expired = FALSE;
                                              }
                                              if( boCanNM_NM_Timeout_Timer_Expired == TRUE )
                                                  boCanNM_NM_Timeout_Timer_Expired = FALSE;
                                              if( ( boCanNM_Rx_Indication == TRUE ) ||  NM_Request_State )
                                              {
                                                  boCanNM_Rx_Indication = FALSE;
                                                  if( NM_Request_State )
                                                  {
                                                      setTimer( t_NM_Transmit, 1 );    //send NM-Franme immediately
                                                  }
                                                  cancelTimer( t_NM_Timeout_Time );
                                                  setTimer( t_NM_Timeout_Time, c_NM_Timeout_Time );
                                                  setTimer( t_NM_Repeat_Message_Time, c_NM_Repeat_Message_Time );
                                                  _NM_NetworkMode();
                                                  NM_Transmit_Cycle = NmAsrCanMsgStandardCycle;
                                                  NM_Mode = cNM_Mode_RepeatMsg;
                                              }
                                              break;
        case cNM_Mode_Ready_Sleep:            if( boCanNM_Rx_Indication == TRUE )
                                              {
                                                  cancelTimer( t_NM_Timeout_Time );
                                                  setTimer( t_NM_Timeout_Time, c_NM_Timeout_Time );
                                                  boCanNM_Rx_Indication = FALSE;
                                              }
                                              if( boCanNM_Tx_Confirmation == TRUE )
                                              {
                                                  cancelTimer( t_NM_Timeout_Time );
                                                  setTimer( t_NM_Timeout_Time, c_NM_Timeout_Time );
                                                  boCanNM_Tx_Confirmation = FALSE;
                                              }
                                              if( NM_Request_State )
                                              {
                                                  setTimer( t_NM_Transmit, 1 );    //send NM-Franme immediately
                                                  cancelTimer( t_NM_Timeout_Time );
                                                  setTimer( t_NM_Timeout_Time, c_NM_Timeout_Time );
                                                  NM_Transmit_Cycle = NmAsrCanMsgReducedTime;
                                                  NM_Mode = cNM_Mode_Normal_Operation_State;
                                              }
                                              if( boCanNM_RepeatMessage_Requested == TRUE )
                                              {
                                                  setTimer( t_NM_Transmit, NmAsrCanMsgCycleOffset );    // send NM-Frame delayed
                                                  cancelTimer( t_NM_Timeout_Time );
                                                  setTimer( t_NM_Timeout_Time, c_NM_Timeout_Time );
                                                  setTimer( t_NM_Repeat_Message_Time, c_NM_Repeat_Message_Time );
                                                  NM_Transmit_Cycle = NmAsrCanMsgStandardCycle;
                                                  boCanNM_RepeatMessage_Requested = FALSE;
                                                  NM_Mode = cNM_Mode_RepeatMsg;
                                              }
                                              if( boCanNM_NM_Timeout_Timer_Expired == TRUE )
                                              {
                                                  setTimer( t_NM_Wait_Bus_Sleep_Time, c_NM_Wait_Bus_Sleep_Time );
                                                  _NM_PrepareBusSleepModeInd();    // here t_DBKonTimer is stopped
                                                  NM_Mode = cNM_Mode_Prepare_Bus_Sleep;
                                                  boCanNM_NM_Timeout_Timer_Expired = FALSE;
                                              }
                                              break;
        case cNM_Mode_Normal_Operation_State: if( boCanNM_NM_Timeout_Timer_Expired == TRUE )
                                              {
                                                  setTimer( t_NM_Timeout_Time, c_NM_Timeout_Time );
                                                  // _NM_TimeoutExeption();    // no action to be done
                                                  boCanNM_NM_Timeout_Timer_Expired = FALSE;
                                              }
                                              if( boCanNM_Rx_Indication == TRUE )
                                              {
                                                  cancelTimer( t_NM_Timeout_Time );
                                                  setTimer( t_NM_Timeout_Time, c_NM_Timeout_Time );
                                                  cancelTimer( t_NM_Transmit );
                                                  setTimer( t_NM_Transmit, NmAsrCanMsgReducedTime );
                                                  boCanNM_Rx_Indication = FALSE;
                                              }
                                              if( boCanNM_Tx_Confirmation == TRUE )
                                              {
                                                  cancelTimer( t_NM_Timeout_Time );
                                                  setTimer( t_NM_Timeout_Time, c_NM_Timeout_Time );
                                                  cancelTimer( t_NM_Transmit );
                                                  setTimer( t_NM_Transmit, NmAsrCanMsgStandardCycle );
                                                  boCanNM_Tx_Confirmation = FALSE;
                                              }
                                              if( NM_Request_State == 0 )    //no network requested
                                              {
                                                  cancelTimer( t_NM_Transmit );    // stop NM-Franme immediately
                                                  NM_Mode = cNM_Mode_Ready_Sleep;
                                              }
                                              if( boCanNM_RepeatMessage_Requested == TRUE )
                                              {
                                                  setTimer( t_NM_Transmit, NmAsrCanMsgCycleOffset );    // send NM-Frame delayed
                                                  cancelTimer( t_NM_Timeout_Time );
                                                  setTimer( t_NM_Timeout_Time, c_NM_Timeout_Time );
                                                  setTimer( t_NM_Repeat_Message_Time, c_NM_Repeat_Message_Time );
                                                  boCanNM_RepeatMessage_Requested = FALSE;
                                                  NM_Transmit_Cycle = NmAsrCanMsgStandardCycle;
                                                  NM_Mode = cNM_Mode_RepeatMsg;
                                              }
                                              break;
        case cNM_Mode_RepeatMsg:              if( boCanNM_NM_Timeout_Timer_Expired == TRUE )
                                              {
                                                  setTimer( t_NM_Timeout_Time, c_NM_Timeout_Time );
                                                  boCanNM_NM_Timeout_Timer_Expired = FALSE;
                                              }
                                              if( boCanNM_Rx_Indication == TRUE )
                                              {
                                                  cancelTimer( t_NM_Timeout_Time );
                                                  setTimer( t_NM_Timeout_Time, c_NM_Timeout_Time );
                                                  boCanNM_Rx_Indication = FALSE;
                                              }
                                              if( boCanNM_Tx_Confirmation == TRUE )
                                              {
                                                  cancelTimer( t_NM_Timeout_Time );
                                                  setTimer( t_NM_Timeout_Time, c_NM_Timeout_Time );
                                                  boCanNM_Tx_Confirmation = FALSE;
                                              }
                                              if( boCanNM_RepeatMessage_Timer_Expired == TRUE )
                                              {
                                                  boCanNM_RepeatMessage_Timer_Expired = FALSE;
                                                  if( NM_Request_State )
                                                  {
                                                      NM_Mode = cNM_Mode_Normal_Operation_State;
                                                      NM_Transmit_Cycle = NmAsrCanMsgReducedTime;
                                                  }
                                                  else
                                                  {
                                                      cancelTimer( t_NM_Transmit );    // stop NM-Franme immediately
                                                      NM_Mode = cNM_Mode_Ready_Sleep;
                                                  }
                                              }
                                              break;
    }
    if( bOld_NM_Mode != NM_Mode )
    {
        _Nm_StateChangeNotification( bOld_NM_Mode, NM_Mode );    // does the Trace
        putValue( HU__NM_DISP_RL_ActualState, NM_Mode );
    }
}
/*@@end*/

/*@@caplFunc:_NM_Init():*///function
_NM_Init()
{
    NM_Transmit_Cycle = NmAsrCanMsgStandardCycle;
}
/*@@end*/

/*@@caplFunc:_NM_NetworkMode():*///function
_NM_NetworkMode()
{
    setTimer( t_DBKomTimer, 1 ); //  ms     start CAN-communication immediately
    putValue( HU__NM_DISP_RL_CommActive, 1 );
}
/*@@end*/

/*@@caplFunc:_Nm_BusSleepModeInd():*///function
_Nm_BusSleepModeInd()
{
//    _Trace( "_Nm_BusSleepModeInd", "Sleep Mode active");
}
/*@@end*/

/*@@caplFunc:_Nm_PrepareBusSleepModeInd():*///function
void _Nm_PrepareBusSleepModeInd()
{
//    _Trace( "Nm_PrepareBusSleepModeInd", "Prepare Sleep Mode active");
    putValue( HU__NM_DISP_RL_CommActive, 0 );
    cancelTimer( t_DBKomTimer );
}
/*@@end*/

/*@@caplFunc:_Nm_StateChangeNotification(byte,byte):*///function
_Nm_StateChangeNotification( byte previousState, byte currentState )
{
/*
    char line[50];

    snprintf( line, elcount(line ), "Transition from %d to %d", previousState, currentState );
    _Trace( "Nm_StateChangeNotification", "", line );
*/
}
/*@@end*/

/*@@caplFunc:_ReleaseCommRequest(byte):*///function
_ReleaseCommRequest( byte RequestID )
{
    byte temp; // actual NM request status

    temp = getValue( HU__NM_DISP_RL_NM_Request );
    temp &= ~RequestID; // reset NM request 
    putValue( HU__NM_DISP_RL_NM_Request, temp );
    _NM_Switch_NM_Mode();
}
/*@@end*/

/*@@caplFunc:_SetCommRequest(byte):*///function
_SetCommRequest( byte RequestID )
{
    byte temp; // actual NM request status

    temp = getValue( HU__NM_DISP_RL_NM_Request );
    temp |= RequestID; // set NM request 
        putValue( HU__NM_DISP_RL_NM_Request, temp );
    _NM_Switch_NM_Mode();
}
/*@@end*/

/*@@caplFunc:_TraceCall(char[],long):*///function
void _TraceCall( char functionName[], long callResult)
{
    char line[100];

    if( callResult == 1 )
        snprintf( line, elcount(line ), "calling %s", functionName );
    else
        snprintf( line, elcount(line ), "call to %s failed - wrong state?", functionName );
    _Trace( "", "", line );
}
/*@@end*/

/*@@caplFunc:_Trace(char[],char[]):*///function
void _Trace( char functionName[], char info[])
{
    _Trace( functionName, info, "");
}
/*@@end*/

/*@@caplFunc:_Trace(char[],char[],char[],long):*///function
void _Trace( char functionName[], char info[], char verbose[], long argument)
{
    char line[100];

    snprintf( line, elcount(line ), verbose, argument);
    _Trace( functionName, info, line );
}
/*@@end*/

/*@@caplFunc:_Trace(char[],char[],char[]):*///function
void _Trace( char functionName[], char info[], char verbose[])
{
  char sep[2] = "/";
  sep[0] = functionName[0] ? '/' : 0;
  if( verbose[0])
  {
    write( "[%.3f]%s%s%s: %s", timeNow()/100000.0, gECU
           , sep
           , functionName
           , verbose
           );
  } else
  {
    write( "[%.3f]%s%s%s: %s", timeNow()/100000.0, gECU
           , sep
           , functionName
           , info
           );
  }
}
/*@@end*/

/*@@caplFunc:DISP_RL_Stat_AR_check_output():*///function
DISP_RL_Stat_AR_check_output()
{
      if( !getValue(HU__STMSG_DISP_RL_Stat_AR ))
    {
        // Botschaft DISP_RL_Stat_AR --- Sendeart 5 cyclicAndSpontanWithDelay --- Beginn DBKOM-Bewertung
        if( _DISP_RL_Stat_AR_DelayCnt > 0) _DISP_RL_Stat_AR_DelayCnt--; // Mindestsendeabstand
        _DISP_RL_Stat_AR_Cnt--;
        if( _DISP_RL_Stat_AR_Cnt < 1)
        {
            if( _DISP_RL_Stat_AR_DelayCnt < 1)
            {
                // Nachricht wg. abgelaufenem Zyklus ausgeben (Mindestsendeabstand eingehalten)
                output( _mDISP_RL_Stat_AR );
                 _DISP_RL_Stat_AR_SpontanFlag = 0; // Spontan-Flag zurücksetzen
                _DISP_RL_Stat_AR_DelayCnt = _DISP_RL_Stat_AR_MinDelay;
            }
            else
            {
                // Spontanflag setzen damit nach Ablauf Mindestsendeabstand gesendet wird
                 _DISP_RL_Stat_AR_SpontanFlag = 1;
            }
            _DISP_RL_Stat_AR_Cnt = _DISP_RL_Stat_AR_CycleCount; // Zyklus-Zähler zurücksetzen
        }
        else if( _DISP_RL_Stat_AR_SpontanFlag )
        {
            if( _DISP_RL_Stat_AR_DelayCnt < 1)
            {
                // Nachricht wg. spontaner Änderung ausgeben (Mindestsendeabstand eingehalten)
                output( _mDISP_RL_Stat_AR );
                _DISP_RL_Stat_AR_SpontanFlag = 0; // Spontan-Flag zurücksetzen
                _DISP_RL_Stat_AR_DelayCnt = _DISP_RL_Stat_AR_MinDelay;
            }
        }
    }
}
/*@@end*/

/*@@caplFunc:DISP_RL_Stat_AR_init():*///function
DISP_RL_Stat_AR_init()
{    // Botschaft DISP_RL_Stat_AR ---- Sendeart 5 cyclicAndSpontanWithDelay ---- Beginn Initialisierung
    _DISP_RL_Stat_AR_Cnt = 50;
    _DISP_RL_Stat_AR_SpontanFlag = 0;
    _DISP_RL_Stat_AR_DelayCnt = 1;
    _mDISP_RL_Stat_AR.DISP_RL_BackLgt_Stat.phys         = getValue( HU_DISP_RL_BackLgt_Stat );
    _mDISP_RL_Stat_AR.DISP_RL_On_Stat.phys              = getValue( HU_DISP_RL_On_Stat );
    _mDISP_RL_Stat_AR.DISP_RL_OnKey_Psd.phys            = getValue( HU_DISP_RL_OnKey_Psd );
    _mDISP_RL_Stat_AR.HeadPhone_Stat_DISP_RL_V2.phys    = getValue( HU_HeadPhone_Stat_DISP_RL_V2 );
}
/*@@end*/

/*@@timer:_tDISP_RL_Stat_AR:*/
on timer _tDISP_RL_Stat_AR
{
    putValue( HU__STMSG_DISP_RL_Stat_AR, 0 );
}
/*@@end*/

/*@@envVar:HU__STMSG_DISP_RL_Stat_AR:*/
on EnvVar HU__STMSG_DISP_RL_Stat_AR
{
    long tDelay;
    if( getValue( this ) == 2 )
    {
        tDelay = getValue( HU__STMSGT_DISP_RL_Stat_AR );
        if( tDelay > 0)    
            setTimer( _tDISP_RL_Stat_AR, tDelay );
        else
            putValue( HU__STMSG_DISP_RL_Stat_AR, 0 );
    }
}
/*@@end*/

/*@@envVar:HU_DISP_RL_BackLgt_Stat:*/
on EnvVar HU_DISP_RL_BackLgt_Stat
{
   _mDISP_RL_Stat_AR.DISP_RL_BackLgt_Stat.phys = getValue(this);
    _DISP_RL_Stat_AR_SpontanFlag = 1;
}
/*@@end*/

/*@@envVar:HU_DISP_RL_On_Stat:*/
on EnvVar HU_DISP_RL_On_Stat
{
   _mDISP_RL_Stat_AR.DISP_RL_On_Stat.phys = getValue(this);
    _DISP_RL_Stat_AR_SpontanFlag = 1;
}
/*@@end*/

/*@@envVar:HU_DISP_RL_OnKey_Psd:*/
on EnvVar HU_DISP_RL_OnKey_Psd
{
   _mDISP_RL_Stat_AR.DISP_RL_OnKey_Psd.phys = getValue(this);
    _DISP_RL_Stat_AR_SpontanFlag = 1;
}
/*@@end*/

/*@@envVar:HU_HeadPhone_Stat_DISP_RL_V2:*/
on EnvVar HU_HeadPhone_Stat_DISP_RL_V2
{
   _mDISP_RL_Stat_AR.HeadPhone_Stat_DISP_RL_V2.phys = getValue(this);
    _DISP_RL_Stat_AR_SpontanFlag = 1;
}
/*@@end*/

/*@@caplFunc:ECU_APPL_DISP_RL1_check_output():*///function
/* Kmatrix 2014_05a
ECU_APPL_DISP_RL1_check_output()
{
      if( !getValue( HU__STMSG_ECU_APPL_DISP_RL1 ))
    {
        // Botschaft ECU_APPL_DISP_RL1 --- Sendeart 1 spontanX --- Beginn DBKOM-Bewertung
        if(  _ECU_APPL_DISP_RL1_SpontanFlag )
        {
            // Nachricht wg. spontaner Änderung ausgeben
            output( _mECU_APPL_DISP_RL1 );
            // Spontan-Flag zurücksetzen
             _ECU_APPL_DISP_RL1_SpontanFlag = 0;
        }
    }
}*/
/*@@end*/

/*@@caplFunc:ECU_APPL_DISP_RL1_init():*///function
/*ECU_APPL_DISP_RL1_init()
{    // Botschaft ECU_APPL_DISP_RL1 ---- Sendeart 1 spontanX ---- Beginn Initialisierung
    _ECU_APPL_DISP_RL1_SpontanFlag = 0;*/
    /* spontan */ //_mECU_APPL_DISP_RL1.ECU_APPL_DISP_RL1A.phys = getValue( HU_ECU_APPL_DISP_RL1A );
    /* spontan */ // _mECU_APPL_DISP_RL1.ECU_APPL_DISP_RL1B.phys = getValue( HU_ECU_APPL_DISP_RL1B );
    /* spontan */ // _mECU_APPL_DISP_RL1.ECU_APPL_DISP_RL1C.phys = getValue( HU_ECU_APPL_DISP_RL1C );
    /* spontan */ // _mECU_APPL_DISP_RL1.ECU_APPL_DISP_RL1D.phys = getValue( HU_ECU_APPL_DISP_RL1D );
    /* spontan */ //_mECU_APPL_DISP_RL1.ECU_APPL_DISP_RL1E.phys = getValue( HU_ECU_APPL_DISP_RL1E );
    /* spontan */ // _mECU_APPL_DISP_RL1.ECU_APPL_DISP_RL1F.phys = getValue( HU_ECU_APPL_DISP_RL1F );
    /* spontan */ //_mECU_APPL_DISP_RL1.ECU_APPL_DISP_RL1G.phys = getValue( HU_ECU_APPL_DISP_RL1G );
    /* spontan */ //_mECU_APPL_DISP_RL1.ECU_APPL_DISP_RL1H.phys = getValue( HU_ECU_APPL_DISP_RL1H );
//}
/*@@end*/

/*@@timer:_tECU_APPL_DISP_RL1:*/
/*on timer _tECU_APPL_DISP_RL1
{
    putValue( HU__STMSG_ECU_APPL_DISP_RL1, 0 );
}*/
/*@@end*/

/*@@envVar:HU__STMSG_ECU_APPL_DISP_RL1:*/
/*on EnvVar HU__STMSG_ECU_APPL_DISP_RL1
{
    long tDelay;
    if( getValue( this ) == 2 )
    {
        tDelay = getValue( HU__STMSGT_ECU_APPL_DISP_RL1 );
        if( tDelay > 0)    
            setTimer( _tECU_APPL_DISP_RL1, tDelay );
        else
            putValue( HU__STMSG_ECU_APPL_DISP_RL1, 0 );
    }
}*/
/*@@end*/

/*@@envVar:HU_ECU_APPL_DISP_RL1A:*/
/*
on EnvVar HU_ECU_APPL_DISP_RL1A
{
   _mECU_APPL_DISP_RL1.ECU_APPL_DISP_RL1A.phys = getValue(this);
    _ECU_APPL_DISP_RL1_SpontanFlag = 1;
}*/ 
/*@@end*/

/*@@envVar:HU_ECU_APPL_DISP_RL1B:*/
/*on EnvVar HU_ECU_APPL_DISP_RL1B
{
   _mECU_APPL_DISP_RL1.ECU_APPL_DISP_RL1B.phys = getValue(this);
    _ECU_APPL_DISP_RL1_SpontanFlag = 1;
}*/
/*@@end*/

/*@@envVar:HU_ECU_APPL_DISP_RL1C:*/
/*on EnvVar HU_ECU_APPL_DISP_RL1C
{
   _mECU_APPL_DISP_RL1.ECU_APPL_DISP_RL1C.phys = getValue(this);
    _ECU_APPL_DISP_RL1_SpontanFlag = 1;
}*/
/*@@end*/

/*@@envVar:HU_ECU_APPL_DISP_RL1D:*/
/*on EnvVar HU_ECU_APPL_DISP_RL1D
{
   _mECU_APPL_DISP_RL1.ECU_APPL_DISP_RL1D.phys = getValue(this);
    _ECU_APPL_DISP_RL1_SpontanFlag = 1;
}*/
/*@@end*/

/*@@envVar:HU_ECU_APPL_DISP_RL1E:*/
/*on EnvVar HU_ECU_APPL_DISP_RL1E
{
   _mECU_APPL_DISP_RL1.ECU_APPL_DISP_RL1E.phys = getValue(this);
    _ECU_APPL_DISP_RL1_SpontanFlag = 1;
}*/
/*@@end*/

/*@@envVar:HU_ECU_APPL_DISP_RL1F:*/
/*
on EnvVar HU_ECU_APPL_DISP_RL1F
{
   _mECU_APPL_DISP_RL1.ECU_APPL_DISP_RL1F.phys = getValue(this);
    _ECU_APPL_DISP_RL1_SpontanFlag = 1;
}*/
/*@@end*/

/*@@envVar:HU_ECU_APPL_DISP_RL1G:*/
/*on EnvVar HU_ECU_APPL_DISP_RL1G
{
   _mECU_APPL_DISP_RL1.ECU_APPL_DISP_RL1G.phys = getValue(this);
    _ECU_APPL_DISP_RL1_SpontanFlag = 1;
}*/
/*@@end*/

/*@@envVar:HU_ECU_APPL_DISP_RL1H:*/
/*on EnvVar HU_ECU_APPL_DISP_RL1H
{
   _mECU_APPL_DISP_RL1.ECU_APPL_DISP_RL1H.phys = getValue(this);
    _ECU_APPL_DISP_RL1_SpontanFlag = 1;
}*/
/*@@end*/

/*@@caplFunc:ROE_DISP_RL_check_output():*///function
ROE_DISP_RL_check_output()
{
      if( !getValue(HU__STMSG_ROE_DISP_RL ))
    {
        // Botschaft ROE_DISP_RL --- Sendeart 1 spontanX --- Beginn DBKOM-Bewertung
        if(  _ROE_DISP_RL_SpontanFlag )
        {
            // Nachricht wg. spontaner Änderung ausgeben
            output(_mROE_DISP_RL );
            // Spontan-Flag zurücksetzen
             _ROE_DISP_RL_SpontanFlag = 0;
        }
    }
}
/*@@end*/

/*@@caplFunc:ROE_DISP_RL_init():*///function
ROE_DISP_RL_init()
{
    // Botschaft ROE_DISP_RL ---- Sendeart 1 spontanX ---- Beginn Initialisierung
    _ROE_DISP_RL_SpontanFlag = 0;
    /* geändert */ _mROE_DISP_RL.ROE_DTC_DISP_RL.phys = getValue( HU_ROE_DTC_DISP_RL );
    /* geändert */ _mROE_DISP_RL.ROE_DTC_Stat_DISP_RL.phys = getValue( HU_ROE_DTC_Stat_DISP_RL );
    /* geändert */ _mROE_DISP_RL.ROE_Header_DISP_RL.phys = getValue( HU_ROE_Header_DISP_RL );

}
/*@@end*/

/*@@timer:_tROE_DISP_RL:*/
on timer _tROE_DISP_RL
{
    putValue( HU__STMSG_ROE_DISP_RL, 0 );
}
/*@@end*/

/*@@envVar:HU__STMSG_ROE_DISP_RL:*/
on EnvVar HU__STMSG_ROE_DISP_RL
{
    long tDelay;
    if( getValue( this ) == 2 )
    {
        tDelay = getValue( HU__STMSGT_ROE_DISP_RL );
        if( tDelay > 0)    
            setTimer( _tROE_DISP_RL, tDelay );
        else
            putValue( HU__STMSG_ROE_DISP_RL, 0 );
    }
}
/*@@end*/

/*@@envVar:HU_ROE_DTC_DISP_RL:*/
on EnvVar HU_ROE_DTC_DISP_RL
{
    _mROE_DISP_RL.ROE_DTC_DISP_RL.phys = getValue(this);
    _ROE_DISP_RL_SpontanFlag = 1;
}
/*@@end*/

/*@@envVar:HU_ROE_DTC_Stat_DISP_RL:*/
on EnvVar HU_ROE_DTC_Stat_DISP_RL
{
    _mROE_DISP_RL.ROE_DTC_Stat_DISP_RL.phys = getValue(this);
    _ROE_DISP_RL_SpontanFlag = 1;
}
/*@@end*/

/*@@envVar:HU_ROE_Header_DISP_RL:*/
on EnvVar HU_ROE_Header_DISP_RL
{
    _mROE_DISP_RL.ROE_Header_DISP_RL.phys = getValue(this);
    _ROE_DISP_RL_SpontanFlag = 1;
}
/*@@end*/

