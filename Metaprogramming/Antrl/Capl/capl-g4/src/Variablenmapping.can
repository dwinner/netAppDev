/*@!Encoding:1252*/
on start
{
  @EnvUH_Stunde	=	$	UH_Stunde	.phys;
  @EnvUH_Minute	=	$	UH_Minute	.phys;
  @EnvUH_Sekunde	=	$	UH_Sekunde	.phys;
}

on envVar	EnvUH_Stunde	{	$	UH_Stunde	.phys	=	@this;	}
on envVar	EnvUH_Minute	{	$	UH_Minute	.phys	=	@this;	}
on envVar	EnvUH_Sekunde	{	$	UH_Sekunde	.phys	=	@this;	}
