/*@!Encoding:1252*/
includes
{
    #include "..\..\_DLL\latest_BAP_DLL.cin"
}

/********************************************************************************/ 
/*  Author:      Roy Buehring                                                   */ 
/*  Department:  IAV, VC-F-23                                                   */ 
/*  Email (IAV): roy.buehring@IAV.de                                            */
/*  Email (VW):  extern.roy.buehring@volkswagen.de                              */
/*  Mobil:       +49 152 21881956                                               */ 
/*                                                                              */ 
/*  Substitute:  Christian Franz                                                */ 
/*  Department:  VW, EECF/1                                                     */ 
/*  Phone:       +49-5361-9-42880                                               */ 
/*                                                                              */ 
/*  Purpose:     CANoe simulation for stand alone Display Config                */ 
/********************************************************************************/ 

/* Global variables for the DisplayConfig CANoe BAP simulation */
variables 
{
    // CAPL constants
    dword gBAP_Trace, gError_Trace;
    const CAPL_WRITE_LINE_SUCCESS                   = 0;
    const CAPL_WRITE_LINE_INFORMATION               = 1;
    const CAPL_WRITE_LINE_WARNING                   = 2;
    const CAPL_WRITE_LINE_ERROR                     = 3;

    char dbc_path[255]  ="BAP\\_DBC\\BAP_V9.04F.dbc";	            // relative path for dbc-file											
    char xml_path[255]  ="BAP\\DisplayConfig_v1.00_DF33_man\\XML\\BAP_SW17_MIB2_Std_MQB_V2_00_mod.xml";        // relative path for xml-file
    dword NODE_INDEX;
    
    // Timers
    mstimer TaskTimer;													    // timer for BAP-Task	
    mstimer startupTimer;                                                   // timer for startup (init-time)
    mstimer initTimer;                                                      // avoids start of Bap stack before complete initialisation													
	
    // general values for readable code
    const FALSE                                     	= 0;
	const TRUE                                      	= 1;

    // BAP constants
    const BAP_HEADER_SIZE                           	= 6;
    const BAP_BUFFER_SIZE                           	= 4000;

    //BAP Data Type 
    const Bap_Void			                        	= 0;
    const Bap_UInt8			                        	= 1;
    const Bap_UInt16		                        	= 2;
    const Bap_UInt32		                        	= 3;
    const Bap_ByteSequence	                        	= 4;
    const Bap_Error			                        	= 5;
    const Bap_Acknowledge                           	= 6;

    //BAP request types (ASG)
    const DataSetGet_REQ	                        	= 0x00;
    const DataSet_REQ		                        	= 0x01;
    const DataGet_REQ		                        	= 0x02;
    const Start_REQ			                        	= 0x05;
    const StartResult_REQ	                        	= 0x06;
    const AbortResult_REQ	                        	= 0x07;
    const Ack_REQ                                   	= 0x0B; 
    const DataGet_REQ_CAN		                    	= 0x10;   

    //BAP indication types (ASG)
    const Data_IND			                        	= 0x00;
    const Reset_IND                                 	= 0x01;
    const DataAck_IND                               	= 0x02;
    const Result_IND		                        	= 0x03;
    const Processing_IND                            	= 0x04;  
    const Changed_IND		                        	= 0x05;

    // BAP and BAL error codes
	const BAP_NO_ERROR                              	= 0x00;
	const BAP_BAL_OUT_OF_RANGE                      	= 0x41;
	const BAP_BAL_TEMP_NOT_AVAILABLE                	= 0x42;
	const BAP_BAL_MAX_DL_EXCEEDED                   	= 0x43;
	const BAP_BAL_UNIT_MISMATCH                     	= 0x44;
    const Error_IND                                 	= 0x55;                 // eigene Error-Definition

    /*** FSG specific global consts. ***/
    const LSG_DisplayConfig	                        	= 0x45;
    message BAP_DisplayConfig_ASG_01 DispalyConfig_FSG_CAN_Message;			// Needed because of no dll functionality
	message BAP_DisplayConfig_ASG_01 DispalyConfig_ASG_CAN_Message;                                
    const ASG_GET_MESSAGE_BYTE0                     	= 0x10;
    const ASG_GET_MESSAGE_DLC                       	= 2;
	const INIT_DISPLAY_CONFIG_STD						= 0x01;
	
    /*** GetAll ***/
    const GET_ALL_FCT_ID                            	= 0x01;
    const GET_ALL_BAP_DATA_TYPE                     	= Bap_Void;
    const GET_ALL_BAP_DATA_LENGTH                   	= 0;
	
    /*** BAP_Config ***/
    const BAP_CONFIG_FCT_ID                         	= 0x02;
    const BAP_CONFIG_BAP_DATA_TYPE                  	= Bap_Void;
	const BAP_CONFIG_BAP_DATA_LENGTH                	= 0;
	byte  BAP_CONFIG_INIT_STD[6]						= {0x03, 0x00, 0x45, 0x00, 0x03, 0x03};

    /*** FunctionList ***/
    const FUNCTION_LIST_FCT_ID                      	= 0x03;
    const FUNCTION_LIST_BAP_DATA_TYPE               	= Bap_Void;
	const FUNCTION_LIST_BAP_DATA_LENGTH             	= 0;
	byte  FUNCTION_LIST_INIT_STD[8]						= {0x00, 0x00, 0x00, 0x00, 0x00, 0x00, 0x00, 0x00};

    /*** Heartbeat ***/
    const HEART_BEAT_FCT_ID                         	= 0x04;
    const HEART_BEAT_BAP_DATA_TYPE                  	= Bap_Void;
	const HEART_BEAT_BAP_DATA_LENGTH                	= 0;
	byte  HEART_BEAT_INIT_STD							= 0x0A;

	/*** FSG_Control ***/
    const FSG_CONTROL_FCT_ID                        	= 0x0D;
    const FSG_CONTROL_BAP_DATA_TYPE                 	= Bap_UInt8;
	const FSG_CONTROL_BAP_DATA_LENGTH               	= 0;
	byte  FSG_CONTROL_INIT_STD							= 0x00;
	
    /*** FSG_Setup ***/
    const FSG_SETUP_FCT_ID                          	= 0x0E;
    const FSG_SETUP_BAP_DATA_TYPE                   	= Bap_Void;
	const FSG_SETUP_BAP_DATA_LENGTH                 	= 0;
	byte  FSG_SETUP_INIT_STD[6]							= {0xFF, 0x00, 0x00, 0x00, 0x00, 0x00};

    /*** FSG_OperationState ***/
    const FSG_OPERATION_STATE_FCT_ID                	= 0x0F;
    const FSG_OPERATION_STATE_BAP_DATA_TYPE         	= Bap_Void;
	const FSG_OPERATION_STATE_BAP_DATA_LENGTH       	= 0;
	const FSG_OPERATION_STATE_NORMAL                	= 0;
    const FSG_OPERATION_STATE_OFF                   	= 1;
    const FSG_OPERATION_STATE_INIT                  	= 3;
	byte  FSG_OPERATION_STATE_INIT_STD					= FSG_OPERATION_STATE_INIT;

	/*** Brightness ***/
    const BRIGHTNESS_FCT_ID                         	= 0x10;
    const BRIGHTNESS_BAP_DATA_TYPE                  	= Bap_ByteSequence;
    const BRIGHTNESS_BAP_DATA_LENGTH                	= 2;
	byte  BRIGHTNESS_INIT_STD[BRIGHTNESS_BAP_DATA_LENGTH] = {0x64, 0x00};
	
	/*** Volume ***/
    const VOLUME_FCT_ID                         		= 0x11;
    const VOLUME_BAP_DATA_TYPE                  		= Bap_ByteSequence;
    const VOLUME_BAP_DATA_LENGTH                		= 2;
	byte  VOLUME_INIT_STD[VOLUME_BAP_DATA_LENGTH]		= {0x02, 0x00};
		
	/*** ElementContentSelection ***/
    const ELEMENT_CONTENT_SELECTION_FCT_ID 	            = 0x12;
    const ELEMENT_CONTENT_SELECTION_BAP_DATA_TYPE       = Bap_ByteSequence;
    const ELEMENT_CONTENT_SELECTION_BAP_DATA_LENGTH     = 64;
    const ELEMENT_CONTENT_SELECTION_ENTRIES             = 256;                  // for 16 bit addressing, 256 needed for setGet
    const ELEMENT_CONTENT_SELECTION_EXTENSION_LENGTH    = 2;
    const ELEMENT_CONTENT_SELECTION_RECADDR_RESERVED   	= 0x00;
	const ELEMENT_CONTENT_SELECTION_RECADDR_ALL     	= 0x01;
    const ELEMENT_CONTENT_SELECTION_RECADDR_EL_CONTENT  = 0x02;
	const ELEMENT_CONTENT_SELECTION_RECADDR_POS  		= 0x0F;
	const ELEMENT_CONTENT_SELECTION_ASGID               = 0x07;
	// global variables to store all possible elements (consecutive IDs)
    word ElementContentSelection_Data_Pos_get				[ELEMENT_CONTENT_SELECTION_ENTRIES];
    byte ElementContentSelection_Data_Display_get			[ELEMENT_CONTENT_SELECTION_ENTRIES];
	byte ElementContentSelection_Data_AdditionalInfo_get	[ELEMENT_CONTENT_SELECTION_ENTRIES];
	byte ElementContentSelection_Data_Element_get			[ELEMENT_CONTENT_SELECTION_ENTRIES];
	byte ElementContentSelection_Data_ElementContent_get	[ELEMENT_CONTENT_SELECTION_ENTRIES];
	byte ElementContentSelection_Data_Validity_get			[ELEMENT_CONTENT_SELECTION_ENTRIES];
    int  ElementContentSelection_Data_startPos_get 		= 0;
    word ElementContentSelection_Data_Pos_setGet			[ELEMENT_CONTENT_SELECTION_ENTRIES];
    byte ElementContentSelection_Data_Display_setGet		[ELEMENT_CONTENT_SELECTION_ENTRIES];
	byte ElementContentSelection_Data_AdditionalInfo_setGet	[ELEMENT_CONTENT_SELECTION_ENTRIES];
	byte ElementContentSelection_Data_Element_setGet		[ELEMENT_CONTENT_SELECTION_ENTRIES];
	byte ElementContentSelection_Data_ElementContent_setGet	[ELEMENT_CONTENT_SELECTION_ENTRIES];
	byte ElementContentSelection_Data_Validity_setGet		[ELEMENT_CONTENT_SELECTION_ENTRIES];
	int  ElementContentSelection_Data_startPos_setGet 	= 0;
	byte ElementContentSelection_Data_lastRequestedTAID = 0;
	
	/*** Display1Setup ***/
    const DISPLAY_1_SETUP_FCT_ID             			= 0x13;
    const DISPLAY_1_SETUP_BAP_DATA_TYPE             	= Bap_Void;
	const DISPLAY_1_SETUP_BAP_DATA_LENGTH           	= 0;
	byte  DISPLAY_1_SETUP_INIT_STD[21] 					= {0x00, 0x00, 0x00, 0x00, 0x00, 0x00, 0x00, 0x00, 0x00, 0x00, 0x00, 0x00, 0x00, 0x00, 0x00, 0x00, 0x00, 0x00, 0x00, 0x00, 0x00};
	
	/*** Display1MainSelection ***/
    const DISPLAY_1_MAIN_SELECTION_FCT_ID   			= 0x14;
    const DISPLAY_1_MAIN_SELECTION_BAP_DATA_TYPE    	= Bap_ByteSequence;
    const DISPLAY_1_MAIN_SELECTION_BAP_DATA_LENGTH  	= 5;
	byte  DISPLAY_1_MAIN_SELECTION_INIT_STD[DISPLAY_1_MAIN_SELECTION_BAP_DATA_LENGTH] = {0x00, 0x00, 0x00, 0x00, 0x00};
	
	/*** Display2Setup ***/
    const DISPLAY_2_SETUP_FCT_ID             			= 0x15;
    const DISPLAY_2_SETUP_BAP_DATA_TYPE             	= Bap_Void;
	const DISPLAY_2_SETUP_BAP_DATA_LENGTH           	= 0;
	byte  DISPLAY_2_SETUP_INIT_STD[21] 					= {0x00, 0x00, 0x00, 0x00, 0x00, 0x00, 0x00, 0x00, 0x00, 0x00, 0x00, 0x00, 0x00, 0x00, 0x00, 0x00, 0x00, 0x00, 0x00, 0x00, 0x00};
	
	/*** Display2MainSelection ***/
    const DISPLAY_2_MAIN_SELECTION_FCT_ID   			= 0x16;
    const DISPLAY_2_MAIN_SELECTION_BAP_DATA_TYPE    	= Bap_ByteSequence;
    const DISPLAY_2_MAIN_SELECTION_BAP_DATA_LENGTH  	= 5;
	byte  DISPLAY_2_MAIN_SELECTION_INIT_STD[DISPLAY_2_MAIN_SELECTION_BAP_DATA_LENGTH] = {0x00, 0x00, 0x00, 0x00, 0x00};
	
	/*** Display3Setup ***/
    const DISPLAY_3_SETUP_FCT_ID             			= 0x17;
    const DISPLAY_3_SETUP_BAP_DATA_TYPE             	= Bap_Void;
	const DISPLAY_3_SETUP_BAP_DATA_LENGTH           	= 0;
	byte  DISPLAY_3_SETUP_INIT_STD[21] 					= {0x00, 0x00, 0x00, 0x00, 0x00, 0x00, 0x00, 0x00, 0x00, 0x00, 0x00, 0x00, 0x00, 0x00, 0x00, 0x00, 0x00, 0x00, 0x00, 0x00, 0x00};
	
	/*** Display3MainSelection ***/
    const DISPLAY_3_MAIN_SELECTION_FCT_ID   			= 0x18;
    const DISPLAY_3_MAIN_SELECTION_BAP_DATA_TYPE    	= Bap_ByteSequence;
    const DISPLAY_3_MAIN_SELECTION_BAP_DATA_LENGTH  	= 5;
	byte  DISPLAY_3_MAIN_SELECTION_INIT_STD[DISPLAY_3_MAIN_SELECTION_BAP_DATA_LENGTH] = {0x00, 0x00, 0x00, 0x00, 0x00};
	
	/*** AdditionalInstrument ***/
    const ADDITIONAL_INSTRUMENT_FCT_ID   				= 0x19;
    const ADDITIONAL_INSTRUMENT_BAP_DATA_TYPE    		= Bap_ByteSequence;
    const ADDITIONAL_INSTRUMENT_BAP_DATA_LENGTH  		= 3;
	byte  ADDITIONAL_INSTRUMENT_INIT_STD[ADDITIONAL_INSTRUMENT_BAP_DATA_LENGTH] = {0x00, 0x64, 0x00};
	
	/*** AdditionalInstrument2 ***/
    const ADDITIONAL_INSTRUMENT2_FCT_ID   				= 0x1A;
    const ADDITIONAL_INSTRUMENT2_BAP_DATA_TYPE   		= Bap_UInt8;
	const ADDITIONAL_INSTRUMENT2_BAP_DATA_LENGTH  		= 0;
	byte  ADDITIONAL_INSTRUMENT2_INIT_STD				= 0x00;
	
    /*** DisplayPresets ***/
    const DISPLAY_PRESETS_FCT_ID 	                	= 0x1B;
    const DISPLAY_PRESETS_BAP_DATA_TYPE             	= Bap_ByteSequence;
    const DISPLAY_PRESETS_BAP_DATA_LENGTH           	= 664;
    const DISPLAY_PRESETS_ENTRIES                   	= 256;                  // for 16 bit addressing, 256 needed for setGet
    const DISPLAY_PRESETS_EXTENSION_LENGTH          	= 2;
    const DISPLAY_PRESETS_RECADDR_DISPLAY123           	= 0x01;
    const DISPLAY_PRESETS_RECADDR_DISPLAY12            	= 0x02;
    const DISPLAY_PRESETS_RECADDR_POS              		= 0x0F;
	const DISPLAY_PRESETS_ASGID               			= 0x07;
    // global variables to store all possible elements (arbitrary IDs)
    word  DisplayPresets_Data_Pos_get							[DISPLAY_PRESETS_ENTRIES];
    byte  DisplayPresets_Data_State_get							[DISPLAY_PRESETS_ENTRIES];
	byte  DisplayPresets_Data_DisplayPresetType_get				[DISPLAY_PRESETS_ENTRIES];
	byte  DisplayPresets_Data_DisplayPresetInstance_get			[DISPLAY_PRESETS_ENTRIES];
	dword DisplayPresets_Data_Display1MainSelection_get			[DISPLAY_PRESETS_ENTRIES];
	dword DisplayPresets_Data_Display1AdditionalInfo1_1_get		[DISPLAY_PRESETS_ENTRIES];
	dword DisplayPresets_Data_Display1AdditionalInfo1_2_get		[DISPLAY_PRESETS_ENTRIES];
	dword DisplayPresets_Data_Display1AdditionalInfo2_1_get		[DISPLAY_PRESETS_ENTRIES];
	dword DisplayPresets_Data_Display1AdditionalInfo2_2_get		[DISPLAY_PRESETS_ENTRIES];
	dword DisplayPresets_Data_Display2MainSelection_get			[DISPLAY_PRESETS_ENTRIES];
	dword DisplayPresets_Data_Display2AdditionalInfo1_1_get		[DISPLAY_PRESETS_ENTRIES];
	dword DisplayPresets_Data_Display2AdditionalInfo1_2_get		[DISPLAY_PRESETS_ENTRIES];
	dword DisplayPresets_Data_Display2AdditionalInfo2_1_get		[DISPLAY_PRESETS_ENTRIES];
	dword DisplayPresets_Data_Display2AdditionalInfo2_2_get		[DISPLAY_PRESETS_ENTRIES];
	dword DisplayPresets_Data_Display3MainSelection_get			[DISPLAY_PRESETS_ENTRIES];
	dword DisplayPresets_Data_Display3AdditionalInfo1_1_get		[DISPLAY_PRESETS_ENTRIES];
	dword DisplayPresets_Data_Display3AdditionalInfo1_2_get		[DISPLAY_PRESETS_ENTRIES];
	dword DisplayPresets_Data_Display3AdditionalInfo2_1_get		[DISPLAY_PRESETS_ENTRIES];
	dword DisplayPresets_Data_Display3AdditionalInfo2_2_get		[DISPLAY_PRESETS_ENTRIES];
	byte  DisplayPresets_Data_Validity_get						[DISPLAY_PRESETS_ENTRIES];
    int   DisplayPresets_Data_startPos_get 						= 0;
	word  DisplayPresets_Data_Pos_setGet						[DISPLAY_PRESETS_ENTRIES];
    byte  DisplayPresets_Data_State_setGet						[DISPLAY_PRESETS_ENTRIES];
	byte  DisplayPresets_Data_DisplayPresetType_setGet			[DISPLAY_PRESETS_ENTRIES];
	byte  DisplayPresets_Data_DisplayPresetInstance_setGet		[DISPLAY_PRESETS_ENTRIES];
	dword DisplayPresets_Data_Display1MainSelection_setGet		[DISPLAY_PRESETS_ENTRIES];
	dword DisplayPresets_Data_Display1AdditionalInfo1_1_setGet	[DISPLAY_PRESETS_ENTRIES];
	dword DisplayPresets_Data_Display1AdditionalInfo1_2_setGet	[DISPLAY_PRESETS_ENTRIES];
	dword DisplayPresets_Data_Display1AdditionalInfo2_1_setGet	[DISPLAY_PRESETS_ENTRIES];
	dword DisplayPresets_Data_Display1AdditionalInfo2_2_setGet	[DISPLAY_PRESETS_ENTRIES];
	dword DisplayPresets_Data_Display2MainSelection_setGet		[DISPLAY_PRESETS_ENTRIES];
	dword DisplayPresets_Data_Display2AdditionalInfo1_1_setGet	[DISPLAY_PRESETS_ENTRIES];
	dword DisplayPresets_Data_Display2AdditionalInfo1_2_setGet	[DISPLAY_PRESETS_ENTRIES];
	dword DisplayPresets_Data_Display2AdditionalInfo2_1_setGet	[DISPLAY_PRESETS_ENTRIES];
	dword DisplayPresets_Data_Display2AdditionalInfo2_2_setGet	[DISPLAY_PRESETS_ENTRIES];
	dword DisplayPresets_Data_Display3MainSelection_setGet		[DISPLAY_PRESETS_ENTRIES];
	dword DisplayPresets_Data_Display3AdditionalInfo1_1_setGet	[DISPLAY_PRESETS_ENTRIES];
	dword DisplayPresets_Data_Display3AdditionalInfo1_2_setGet	[DISPLAY_PRESETS_ENTRIES];
	dword DisplayPresets_Data_Display3AdditionalInfo2_1_setGet	[DISPLAY_PRESETS_ENTRIES];
	dword DisplayPresets_Data_Display3AdditionalInfo2_2_setGet	[DISPLAY_PRESETS_ENTRIES];
	byte  DisplayPresets_Data_Validity_setGet					[DISPLAY_PRESETS_ENTRIES];
    int   DisplayPresets_Data_startPos_setGet 					= 0;
	byte DisplayPresets_Data_lastRequestedTAID = 0;
	
	/*** DisplayDependency ***/
    const DISPLAY_DEPENDENCY_FCT_ID   					= 0x1C;
    const DISPLAY_DEPENDENCY_BAP_DATA_TYPE   			= Bap_ByteSequence;
    const DISPLAY_DEPENDENCY_BAP_DATA_LENGTH  			= 4;
	byte  DISPLAY_DEPENDENCY_INIT_STD[DISPLAY_DEPENDENCY_BAP_DATA_LENGTH] = {0x00, 0x00, 0x00, 0x00};
	
	/*** ActiveDisplayPreset ***/
    const ACTIVE_DISPLAY_PRESET_FCT_ID   				= 0x1D;
    const ACTIVE_DISPLAY_PRESET_BAP_DATA_TYPE   		= Bap_ByteSequence;
    const ACTIVE_DISPLAY_PRESET_BAP_DATA_LENGTH  		= 2;
	byte  ACTIVE_DISPLAY_PRESET_INIT_STD[ACTIVE_DISPLAY_PRESET_BAP_DATA_LENGTH] = {0x00, 0x00};
	
	/*** DisplayViewConfiguration ***/
    const DISPLAY_VIEW_CONFIGURATION_FCT_ID   			= 0x1E;
    const DISPLAY_VIEW_CONFIGURATION_BAP_DATA_TYPE   	= Bap_ByteSequence;
    const DISPLAY_VIEW_CONFIGURATION_BAP_DATA_LENGTH  	= 4;
	byte  DISPLAY_VIEW_CONFIGURATION_INIT_STD[DISPLAY_VIEW_CONFIGURATION_BAP_DATA_LENGTH] = {0x00, 0x00, 0x00, 0x00};
	
	/*** LED_Configuration ***/
    const LED_CONFIGURATION_FCT_ID   					= 0x1F;
    const LED_CONFIGURATION_BAP_DATA_TYPE   			= Bap_ByteSequence;
    const LED_CONFIGURATION_BAP_DATA_LENGTH  			= 6;
	byte  LED_CONFIGURATION_INIT_STD[LED_CONFIGURATION_BAP_DATA_LENGTH] = {0x00, 0x00, 0x00, 0x00, 0x00, 0x00};
}

on preStart
{
    int error;
    char Path[255];
    char BAPVersion [200];

	// create write window for BAP communication
    gBAP_Trace  = writecreate("DisplayConfig_ASG BAP-Trace");								
    writeclear(gBAP_Trace);													
	gError_Trace = writecreate("DisplayConfig_ASG Error");									
	writeclear(gError_Trace);												

    //clear CAPL-window in write-window
    writeclear(1);	

    @sysvar::DisplayConfig_General::Smart = 0;
    //get version from Stack
	Bap180_GetVersions(BAPVersion, 200);
	writelineEx(gBAP_Trace, CAPL_WRITE_LINE_SUCCESS, "*********************************************************************************");
	writelineEx(gBAP_Trace, CAPL_WRITE_LINE_SUCCESS, BAPVersion);
	writelineEx(gBAP_Trace, CAPL_WRITE_LINE_SUCCESS, "*********************************************************************************");

    // Create Node
	NODE_INDEX = Bap180_CreateNode();

    // Load DBC and XML files. 
    // load dbc-file
    getAbsFilePath(dbc_path, Path, 255);
	writelineEx(gBAP_Trace, CAPL_WRITE_LINE_SUCCESS, "ASG-DisplayConfig: Loading BAP_DBC-File: '%s'", Path);
   
	if(Bap180_LoadDBC(NODE_INDEX, 1, Path) != BAP_NO_ERROR)						
		writelineEx(gError_Trace, CAPL_WRITE_LINE_ERROR, "ASG-DisplayConfig Fehler beim Laden: '%s', Path");

	//load xml-file 
	getAbsFilePath(xml_path, Path, 255);
    writelineEx(gBAP_Trace, CAPL_WRITE_LINE_SUCCESS, "ASG-DisplayConfig: Load BAP-XML-File: '%s'", Path);
	
  
    if (Bap180_LoadConfig(NODE_INDEX,Path,"") != BAP_NO_ERROR) 
	    writelineEx(gError_Trace, CAPL_WRITE_LINE_ERROR, "ASG-DisplayConfig: Fehler beim Laden: '%s' !", Path);	   
    writelineEx(gBAP_Trace, CAPL_WRITE_LINE_SUCCESS, "*********************************************************************************");

    // BAP DLL: Add CAN channel: BAP channel 1 is mapped to CAN card channel 1.
	Bap180_AddCanMap(NODE_INDEX, 1, 1);	
    
    // BAP INIT
	error = Bap180_Init(NODE_INDEX,LSG_DisplayConfig);
    // Check for initialisation error.
    if(error == BAP_NO_ERROR)
	    writelineEx(gBAP_Trace, CAPL_WRITE_LINE_SUCCESS, "ASG-DisplayConfig BAP_Init successful");	
    else
	    writelineEx(gError_Trace, CAPL_WRITE_LINE_ERROR,"ASG-DisplayConfig error in BAP_DLL_StackStart () - BAP INIT: 0x%x", error);	
}

on start
{
    init_variables_controls();

    controls_enable_all();    
    init_variables();
    setTimer(initTimer, 3000);
}

on timer TaskTimer
{
	Bap180_Task(NODE_INDEX);	// DLL-Task
	
    BAP_DLL_Indication();
	
	if (getValue(eSendEnabled))
        {
          BAP_CAN_TX_Request();
        }

	setTimer(TaskTimer, 10);	// restart BAP-DLL-Timer
}

on timer startupTimer
{
	if(@sysvar::DisplayConfig_ASG::x03_FctList_0x04_HeartBeat)
		Request_0x04_HeartBeat(DataGet_REQ);
	if(@sysvar::DisplayConfig_ASG::x03_FctList_0x0D_FSG_Control)
		Request_0x0D_FSG_Control(DataGet_REQ);
	if(@sysvar::DisplayConfig_ASG::x03_FctList_0x0E_FSG_Setup)
		Request_0x0E_FSG_Setup(DataGet_REQ);
	if(@sysvar::DisplayConfig_ASG::x03_FctList_0x0F_FSG_OperationState)
		Request_0x0F_FSG_OperationState(DataGet_REQ);
	if(@sysvar::DisplayConfig_ASG::x03_FctList_0x10_Brightness)
		Request_0x10_Brightness(DataGet_REQ);
	if(@sysvar::DisplayConfig_ASG::x03_FctList_0x11_Volume)
		Request_0x11_Volume(DataGet_REQ);
	if(@sysvar::DisplayConfig_ASG::x03_FctList_0x13_Display1Setup)
		Request_0x13_Display1Setup(DataGet_REQ);
	if(@sysvar::DisplayConfig_ASG::x03_FctList_0x14_Display1MainSelection)
		Request_0x14_Display1MainSelection(DataGet_REQ);
	if(@sysvar::DisplayConfig_ASG::x03_FctList_0x15_Display2Setup)
		Request_0x15_Display2Setup(DataGet_REQ);
	if(@sysvar::DisplayConfig_ASG::x03_FctList_0x16_Display2MainSelection)
		Request_0x16_Display2MainSelection(DataGet_REQ);
	if(@sysvar::DisplayConfig_ASG::x03_FctList_0x17_Display3Setup)
		Request_0x17_Display3Setup(DataGet_REQ);
	if(@sysvar::DisplayConfig_ASG::x03_FctList_0x18_Display3MainSelection)
		Request_0x18_Display3MainSelection(DataGet_REQ);
	if(@sysvar::DisplayConfig_ASG::x03_FctList_0x19_AdditionalInstrument)
		Request_0x19_AdditionalInstrument(DataGet_REQ);
	if(@sysvar::DisplayConfig_ASG::x03_FctList_0x1A_AdditionalInstrument2)
		Request_0x1A_AdditionalInstrument2(DataGet_REQ);
	if(@sysvar::DisplayConfig_ASG::x03_FctList_0x1C_DisplayDependency)
		Request_0x1C_DisplayDependency(DataGet_REQ);
	if(@sysvar::DisplayConfig_ASG::x03_FctList_0x1D_ActiveDisplayPreset)
		Request_0x1D_ActiveDisplayPreset(DataGet_REQ);
	if(@sysvar::DisplayConfig_ASG::x03_FctList_0x1E_DisplayViewConfiguration)
		Request_0x1E_DisplayViewConfiguration(DataGet_REQ);
	if(@sysvar::DisplayConfig_ASG::x03_FctList_0x1F_LED_Configuration)
		Request_0x1F_LED_Configuration(DataGet_REQ);
}

on stopMeasurement
{
    BAP180_ReleaseNode(NODE_INDEX);
}

void BAP_CAN_TX_Request()
{
	int i;
	byte TX_Data[8];			// CAN data 
	dword TX_Header[3];			// CAN header 
	message 0x100 TX_Message;	// dummy message 

	TX_Header[2] = 8; // max-Length of TX_Data

	// Get BAP data in CAN format from DLL.
	while (Bap180_CAN_GetTxDat(NODE_INDEX,TX_Header,TX_Data) == 0) // as long as data are to be sent...
	{
		TX_Message.CAN = TX_Header[0]; // CAN channel
		TX_Message.ID  = TX_Header[1]; // CAN ID
		TX_Message.DLC = TX_Header[2]; // received length from BAP-DLL. 

		// CAN data bytes
		for (i=0; i < TX_Message.DLC; i++) 
			TX_Message.byte(i) = TX_Data[i];
		

		output(TX_Message); // send CAN message

		// Correct bug on CAPL CAN interface.
		// Rewrite length information (max length). 
		TX_Header[2] = 8; // max. length of TX data.

	} /* end of: while (Bap150_CAN_GetTxDat(NODE_INDEX,TX_Header,TX_Data) == 0) */
} /* end of function */

void BAP_DLL_Indication()
{
    int i, bapErrorCode;
    int fct_ID, lsg_ID, bapIndication_t, BAP_data_type; 
    int datalength;
    dword indicationHeader[BAP_HEADER_SIZE];
    byte indicationData[BAP_BUFFER_SIZE];
    byte requestarray[BAP_HEADER_SIZE];

    // Hinweis: Die Länge (indication[4]) muss vor Aufruf der Funktion auf die Länge von „data“ gesetzt werden!
    // Ist das Datenfeld zu kurz, wird der Fehler „BapErr_InvalidArg“ zurückgegeben!
    indicationHeader[4] = elCount(indicationData);

    bapErrorCode = Bap180_GetInd(NODE_INDEX, indicationHeader, indicationData);

    if(bapErrorCode == 0)
	{
		lsg_ID = indicationHeader[0];									            // LSG-ID
		fct_ID = indicationHeader[1];									            // Function-ID
		bapIndication_t = indicationHeader[2];									    // indication
		BAP_data_type = indicationHeader[3];									    // BAP data type
		datalength = indicationHeader[4];

		if(indicationHeader[1] == 0)												// BAP Stack start
			return;
		
        if(indicationHeader[0] != LSG_DisplayConfig)                                // catch invalid LSG-ID
        {
	        writelineEx(gError_Trace, CAPL_WRITE_LINE_ERROR, "ASG: Error BAP_Indication: invalid/unhandled LSG-ID %x", indicationHeader[0]);
            return;
        }

        switch (fct_ID)
	    {
            case GET_ALL_FCT_ID:
                Indication_0x01_GetAll(indicationHeader, indicationData, datalength);
		        break;

            case BAP_CONFIG_FCT_ID:
                Indication_0x02_BAP_Config(indicationHeader, indicationData, datalength);
		        break;

            case FUNCTION_LIST_FCT_ID:
                Indication_0x03_FunctionList(indicationHeader, indicationData, datalength);
		        break;

            case HEART_BEAT_FCT_ID:
                Indication_0x04_HeartBeat(indicationHeader, indicationData, datalength);
		        break;
		
			case FSG_CONTROL_FCT_ID:
				Indication_0x0D_FSG_Control(indicationHeader, indicationData, datalength);
				break;
				
            case FSG_SETUP_FCT_ID:
                Indication_0x0E_FSG_Setup(indicationHeader, indicationData, datalength);
		        break;

            case FSG_OPERATION_STATE_FCT_ID:
			    Indication_0x0F_FSG_OperationState(indicationHeader, indicationData, datalength);
		        break;

			case BRIGHTNESS_FCT_ID:
				Indication_0x10_Brightness(indicationHeader, indicationData, datalength);
				break;
		
			case VOLUME_FCT_ID:
				Indication_0x11_Volume(indicationHeader, indicationData, datalength);
				break;
		
			case ELEMENT_CONTENT_SELECTION_FCT_ID:
				Indication_0x12_ElementContentSelection(indicationHeader, indicationData, datalength);
				break;
		
			case DISPLAY_1_SETUP_FCT_ID:
				Indication_0x13_Display1Setup(indicationHeader, indicationData, datalength);
				break;
		
			case DISPLAY_1_MAIN_SELECTION_FCT_ID:
				Indication_0x14_Display1MainSelection(indicationHeader, indicationData, datalength);
				break;
		
			case DISPLAY_2_SETUP_FCT_ID:
				Indication_0x15_Display2Setup(indicationHeader, indicationData, datalength);
				break;
		
			case DISPLAY_2_MAIN_SELECTION_FCT_ID:
				Indication_0x16_Display2MainSelection(indicationHeader, indicationData, datalength);
				break;
		
			case DISPLAY_3_SETUP_FCT_ID:
				Indication_0x17_Display3Setup(indicationHeader, indicationData, datalength);
				break;
		
			case DISPLAY_3_MAIN_SELECTION_FCT_ID:
				Indication_0x18_Display3MainSelection(indicationHeader, indicationData, datalength);
				break;
		
			case ADDITIONAL_INSTRUMENT_FCT_ID:
				Indication_0x19_AdditionalInstrument(indicationHeader, indicationData, datalength);
				break;
		
			case ADDITIONAL_INSTRUMENT2_FCT_ID:
				Indication_0x1A_AdditionalInstrument2(indicationHeader, indicationData, datalength);
				break;
		
			case DISPLAY_PRESETS_FCT_ID:
				Indication_0x1B_DisplayPresets(indicationHeader, indicationData, datalength);
				break;
		
			case DISPLAY_DEPENDENCY_FCT_ID:
				Indication_0x1C_DisplayDependency(indicationHeader, indicationData, datalength);
				break;
		
			case ACTIVE_DISPLAY_PRESET_FCT_ID:
				Indication_0x1D_ActiveDisplayPreset(indicationHeader, indicationData, datalength);
				break;
		
			case DISPLAY_VIEW_CONFIGURATION_FCT_ID:
				Indication_0x1E_DisplayViewConfiguration(indicationHeader, indicationData, datalength);
				break;
		
			case LED_CONFIGURATION_FCT_ID:
				Indication_0x1F_LED_Configuration(indicationHeader, indicationData, datalength);
				break;
                        
		    default:
			    writelineEx(gError_Trace, CAPL_WRITE_LINE_ERROR, "ASG: BAP_DLL_Indication: invalid funcion-ID %x", indicationHeader[1]);
	    }	
	}
}

void Request_0x0D_FSG_Control(byte request)
{
    dword header [BAP_HEADER_SIZE];
    byte data[1];
	
    switch(request)
    {
        case DataGet_REQ_CAN:
            /*** NO FUNCTION WITH BAP DLL (CacheAvailability=true) -> Call via CAN ***/
            CAN_sendGetMessage(FSG_CONTROL_FCT_ID);
            break;

        case DataGet_REQ:
            /*** Cache data request ***/
            BAP_createHeader(FSG_CONTROL_FCT_ID, header, FSG_CONTROL_BAP_DATA_LENGTH, request);
            BAP_DLL_Request(DataGet_REQ, header, data);
            break;

        case DataSetGet_REQ:
			BAP_createHeader(FSG_CONTROL_FCT_ID, header, FSG_CONTROL_BAP_DATA_LENGTH, request);
			header[5]  = createData_0x0D_FSG_Control();
    		BAP_DLL_Request(DataSetGet_REQ, header, data);
            break;

        default:
            break;
    }
}

void Request_0x0E_FSG_Setup(byte request)
{
    dword header [BAP_HEADER_SIZE];
    byte data[1];
	
    switch(request)
    {
        case DataGet_REQ_CAN:
            /*** NO FUNCTION WITH BAP DLL (CacheAvailability=true) -> Call via CAN ***/
            CAN_sendGetMessage(FSG_SETUP_FCT_ID);
            break;

        case DataGet_REQ:
            /*** Cache data request ***/
            BAP_createHeader(FSG_SETUP_FCT_ID, header, FSG_SETUP_BAP_DATA_LENGTH, request);
            BAP_DLL_Request(DataGet_REQ, header, data);
            break;

        default:
            break;
    }
}

void Request_0x0F_FSG_OperationState(byte request)
{
    dword header [BAP_HEADER_SIZE];
    byte data[1];
	
    switch(request)
    {
        case DataGet_REQ_CAN:
            /*** NO FUNCTION WITH BAP DLL (CacheAvailability=true) -> Call via CAN ***/
            CAN_sendGetMessage(FSG_OPERATION_STATE_FCT_ID);
            break;

        case DataGet_REQ:
            /*** Cache data request ***/
            BAP_createHeader(FSG_OPERATION_STATE_FCT_ID, header, FSG_OPERATION_STATE_BAP_DATA_LENGTH, request);
            BAP_DLL_Request(DataGet_REQ, header, data);
            break;

        default:
            break;
    }
}

void Request_0x10_Brightness(byte request)
{
    dword header [BAP_HEADER_SIZE];
    byte data[BRIGHTNESS_BAP_DATA_LENGTH];
	
    switch(request)
    {
        case DataGet_REQ_CAN:
            /*** NO FUNCTION WITH BAP DLL (CacheAvailability=true) -> Call via CAN ***/
            CAN_sendGetMessage(BRIGHTNESS_FCT_ID);
            break;

        case DataGet_REQ:
            /*** Cache data request ***/
            BAP_createHeader(BRIGHTNESS_FCT_ID, header, BRIGHTNESS_BAP_DATA_LENGTH, request);
            BAP_DLL_Request(DataGet_REQ, header, data);
            break;

        case DataSetGet_REQ:
			BAP_createHeader(BRIGHTNESS_FCT_ID, header, BRIGHTNESS_BAP_DATA_LENGTH, request);
			createData_0x10_Brightness(data);
    		BAP_DLL_Request(DataSetGet_REQ, header, data);
            break;

        default:
            break;
    }
}

void Request_0x11_Volume(byte request)
{
    dword header [BAP_HEADER_SIZE];
    byte data[VOLUME_BAP_DATA_LENGTH];
	
    switch(request)
    {
        case DataGet_REQ_CAN:
            /*** NO FUNCTION WITH BAP DLL (CacheAvailability=true) -> Call via CAN ***/
            CAN_sendGetMessage(VOLUME_FCT_ID);
            break;

        case DataGet_REQ:
            /*** Cache data request ***/
            BAP_createHeader(VOLUME_FCT_ID, header, VOLUME_BAP_DATA_LENGTH, request);
            BAP_DLL_Request(DataGet_REQ, header, data);
            break;

        case DataSetGet_REQ:
			BAP_createHeader(VOLUME_FCT_ID, header, VOLUME_BAP_DATA_LENGTH, request);
			createData_0x11_Volume(data);
    		BAP_DLL_Request(DataSetGet_REQ, header, data);
            break;

        default:
            break;
    }
}

void Request_0x12_ElementContentSelection_get ()
{
    // BAP stack buffer
    dword header [BAP_HEADER_SIZE];
    byte data[BAP_BUFFER_SIZE];
    byte modeByte;
    int i;

    byte recordAddress, shift, direction, transmitPos, idxSize, ASG_ID, TAID;
    word start_pos, elements;

    // clear variables
    for(i=0; i<elCount(header); i++)
        header[i] = 0;
    for(i=0; i<elCount(data); i++)
        data[i] = 0;

    // get data
    shift           = @sysvar::DisplayConfig_ASG_ElementContentSelection::x12_ElementContentSelection_AH_shift;
    direction       = @sysvar::DisplayConfig_ASG_ElementContentSelection::x12_ElementContentSelection_AH_direction;
    transmitPos     = @sysvar::DisplayConfig_ASG_ElementContentSelection::x12_ElementContentSelection_AH_transmitPos;
    idxSize         = @sysvar::DisplayConfig_ASG_ElementContentSelection::x12_ElementContentSelection_AH_indexSize;
    recordAddress   = @sysvar::DisplayConfig_ASG_ElementContentSelection::x12_ElementContentSelection_AH_recordAddress;

    ASG_ID          = @sysvar::DisplayConfig_ASG_ElementContentSelection::x12_ElementContentSelection_ASGID;
    TAID            = @sysvar::DisplayConfig_ASG_ElementContentSelection::x12_ElementContentSelection_TAID_hex;

    start_pos       = @sysvar::DisplayConfig_ASG_ElementContentSelection::x12_ElementContentSelection_AH_start_hex;
    elements        = @sysvar::DisplayConfig_ASG_ElementContentSelection::x12_ElementContentSelection_AH_elements_hex;

    modeByte        = Array_createModeByte (shift, direction, transmitPos, idxSize, recordAddress);
    i = Array_createHeader_get (data, start_pos, elements, ASG_ID, TAID, modeByte, idxSize);

    BAP_createHeader(ELEMENT_CONTENT_SELECTION_FCT_ID, header, i, DataGet_REQ);
    BAP_DLL_Request(DataGet_REQ, header, data);
}

Request_0x12_ElementContentSelection_setGet ()
{
	// BAP stack buffer
    dword header [BAP_HEADER_SIZE];
    byte data[BAP_BUFFER_SIZE];
    word indices[ELEMENT_CONTENT_SELECTION_ENTRIES];
    int dataIterator; // data[]-iterator
    
    byte byteBuffer;
    byte modeByte;
    int i;

    // header variables
    byte recordAddress, shift, direction, transmitPos, idxSize, ASG_ID, TAID;
    word start_pos, elements, tnle;
    
    //temporary array-element variables
    int elementsCount;

    // clear variables
    for(i=0; i<elCount(header); i++)
        header[i] = 0;
    for(i=0; i<elCount(data); i++)
        data[i] = 0;
    for(i=0; i<elCount(indices); i++)
        indices[i] = 0;

    // get data
    tnle = Array_getTNLE(ElementContentSelection_Data_Validity_setGet);
    recordAddress = @sysvar::DisplayConfig_ASG_ElementContentSelection::x12_ElementContentSelection_AH_recordAddress;
    shift = @sysvar::DisplayConfig_ASG_ElementContentSelection::x12_ElementContentSelection_AH_shift;
    direction = @sysvar::DisplayConfig_ASG_ElementContentSelection::x12_ElementContentSelection_AH_direction;
    transmitPos = @sysvar::DisplayConfig_ASG_ElementContentSelection::x12_ElementContentSelection_AH_transmitPos;
    idxSize = @sysvar::DisplayConfig_ASG_ElementContentSelection::x12_ElementContentSelection_AH_indexSize;
    ASG_ID = @sysvar::DisplayConfig_ASG_ElementContentSelection::x12_ElementContentSelection_ASGID;
    TAID = @sysvar::DisplayConfig_ASG_ElementContentSelection::x12_ElementContentSelection_TAID_hex;
    start_pos = @sysvar::DisplayConfig_ASG_ElementContentSelection::x12_ElementContentSelection_AH_start_hex;
    elements = Array_getTNLE(ElementContentSelection_Data_Validity_setGet);
	
    elementsCount = Array_getRequestedIndices (indices, start_pos, direction, shift, tnle, elements, ElementContentSelection_Data_Validity_setGet);

    // if start in header != position of array element, change TransmitPos to true
    if(elementsCount != 0)
    {
        if(@sysvar::DisplayConfig_General::Smart && start_pos != ElementContentSelection_Data_Pos_setGet[indices[0]])
        {
            @sysvar::DisplayConfig_ASG_ElementContentSelection::x12_ElementContentSelection_AH_transmitPos = 1;
            transmitPos = @sysvar::DisplayConfig_ASG_ElementContentSelection::x12_ElementContentSelection_AH_transmitPos;
        }
    }

    // if smart, change TransmitPos to true, if requested Positions are not continuous
    if(@sysvar::DisplayConfig_General::Smart && transmitPos == 0)
    {
        for(i=0; i<(elementsCount-1); i++)
        {
            if(ElementContentSelection_Data_Pos_setGet[indices[i]] != (ElementContentSelection_Data_Pos_setGet[indices[i+1]]-1))
            {
                @sysvar::DisplayConfig_ASG_ElementContentSelection::x12_ElementContentSelection_AH_transmitPos = 1;
                transmitPos = @sysvar::DisplayConfig_ASG_ElementContentSelection::x12_ElementContentSelection_AH_transmitPos;
                break;
            }
        }
    }

    // create mode byte
    modeByte = Array_createModeByte (shift, direction, transmitPos, idxSize, recordAddress);

	// Special for SetGet Array: Transmit empty element with elements=panel variable
	if(elements == 0)	// Element deletion
	{
		dataIterator = Array_createHeader_setGet (data, tnle, start_pos, 1, ASG_ID, TAID, modeByte, idxSize);
		data[dataIterator] = 0x00;
		dataIterator++;
	}
	else if(elementsCount == 0 && start_pos == 0xFF)	// Element creation
	{
		dataIterator = Array_createHeader_setGet (data, tnle, start_pos, 1, ASG_ID, TAID, modeByte, idxSize);
		dataIterator = ElementContentSelection_addArrayElementData (data, dataIterator, Array_getFirstElementPos(ElementContentSelection_Data_Validity_setGet, 0), transmitPos, recordAddress, idxSize);
	}
	else	// 'Normal' setGet
	{
    	dataIterator = Array_createHeader_setGet (data, tnle, start_pos, elementsCount, ASG_ID, TAID, modeByte, idxSize);
		for(i=0; i<elementsCount; i++)
    	{
        	dataIterator = ElementContentSelection_addArrayElementData (data, dataIterator, indices[i], transmitPos, recordAddress, idxSize);
    	}
	}

    // Send BAP request
    BAP_createHeader(ELEMENT_CONTENT_SELECTION_FCT_ID, header, dataIterator, DataSetGet_REQ);
    BAP_DLL_Request(DataSetGet_REQ, header, data);
}

void Request_0x13_Display1Setup(byte request)
{
    dword header [BAP_HEADER_SIZE];
    byte data[1];
	
    switch(request)
    {
        case DataGet_REQ_CAN:
            /*** NO FUNCTION WITH BAP DLL (CacheAvailability=true) -> Call via CAN ***/
            CAN_sendGetMessage(DISPLAY_1_SETUP_FCT_ID);
            break;

        case DataGet_REQ:
            /*** Cache data request ***/
            BAP_createHeader(DISPLAY_1_SETUP_FCT_ID, header, DISPLAY_1_SETUP_BAP_DATA_LENGTH, request);
            BAP_DLL_Request(DataGet_REQ, header, data);
            break;

        default:
            break;
    }
}

void Request_0x14_Display1MainSelection(byte request)
{
    dword header [BAP_HEADER_SIZE];
    byte data[DISPLAY_1_MAIN_SELECTION_BAP_DATA_LENGTH];
	
    switch(request)
    {
        case DataGet_REQ_CAN:
            /*** NO FUNCTION WITH BAP DLL (CacheAvailability=true) -> Call via CAN ***/
            CAN_sendGetMessage(DISPLAY_1_MAIN_SELECTION_FCT_ID);
            break;

        case DataGet_REQ:
            /*** Cache data request ***/
            BAP_createHeader(DISPLAY_1_MAIN_SELECTION_FCT_ID, header, DISPLAY_1_MAIN_SELECTION_BAP_DATA_LENGTH, request);
            BAP_DLL_Request(DataGet_REQ, header, data);
            break;

        case DataSetGet_REQ:
			BAP_createHeader(DISPLAY_1_MAIN_SELECTION_FCT_ID, header, DISPLAY_1_MAIN_SELECTION_BAP_DATA_LENGTH, request);
			createData_0x14_Display1MainSelection(data);
    		BAP_DLL_Request(DataSetGet_REQ, header, data);
            break;

        default:
            break;
    }
}

void Request_0x15_Display2Setup(byte request)
{
    dword header [BAP_HEADER_SIZE];
    byte data[1];
	
    switch(request)
    {
        case DataGet_REQ_CAN:
            /*** NO FUNCTION WITH BAP DLL (CacheAvailability=true) -> Call via CAN ***/
            CAN_sendGetMessage(DISPLAY_2_SETUP_FCT_ID);
            break;

        case DataGet_REQ:
            /*** Cache data request ***/
            BAP_createHeader(DISPLAY_2_SETUP_FCT_ID, header, DISPLAY_2_SETUP_BAP_DATA_LENGTH, request);
            BAP_DLL_Request(DataGet_REQ, header, data);
            break;

        default:
            break;
    }
}

void Request_0x16_Display2MainSelection(byte request)
{
    dword header [BAP_HEADER_SIZE];
    byte data[DISPLAY_1_MAIN_SELECTION_BAP_DATA_LENGTH];
	
    switch(request)
    {
        case DataGet_REQ_CAN:
            /*** NO FUNCTION WITH BAP DLL (CacheAvailability=true) -> Call via CAN ***/
            CAN_sendGetMessage(DISPLAY_2_MAIN_SELECTION_FCT_ID);
            break;

        case DataGet_REQ:
            /*** Cache data request ***/
            BAP_createHeader(DISPLAY_2_MAIN_SELECTION_FCT_ID, header, DISPLAY_2_MAIN_SELECTION_BAP_DATA_LENGTH, request);
            BAP_DLL_Request(DataGet_REQ, header, data);
            break;

        case DataSetGet_REQ:
			BAP_createHeader(DISPLAY_2_MAIN_SELECTION_FCT_ID, header, DISPLAY_2_MAIN_SELECTION_BAP_DATA_LENGTH, request);
			createData_0x16_Display2MainSelection(data);
    		BAP_DLL_Request(DataSetGet_REQ, header, data);
            break;

        default:
            break;
    }
}

void Request_0x17_Display3Setup(byte request)
{
    dword header [BAP_HEADER_SIZE];
    byte data[1];
	
    switch(request)
    {
        case DataGet_REQ_CAN:
            /*** NO FUNCTION WITH BAP DLL (CacheAvailability=true) -> Call via CAN ***/
            CAN_sendGetMessage(DISPLAY_3_SETUP_FCT_ID);
            break;

        case DataGet_REQ:
            /*** Cache data request ***/
            BAP_createHeader(DISPLAY_3_SETUP_FCT_ID, header, DISPLAY_3_SETUP_BAP_DATA_LENGTH, request);
            BAP_DLL_Request(DataGet_REQ, header, data);
            break;

        default:
            break;
    }
}

void Request_0x18_Display3MainSelection(byte request)
{
    dword header [BAP_HEADER_SIZE];
    byte data[DISPLAY_3_MAIN_SELECTION_BAP_DATA_LENGTH];
	
    switch(request)
    {
        case DataGet_REQ_CAN:
            /*** NO FUNCTION WITH BAP DLL (CacheAvailability=true) -> Call via CAN ***/
            CAN_sendGetMessage(DISPLAY_3_MAIN_SELECTION_FCT_ID);
            break;

        case DataGet_REQ:
            /*** Cache data request ***/
            BAP_createHeader(DISPLAY_3_MAIN_SELECTION_FCT_ID, header, DISPLAY_3_MAIN_SELECTION_BAP_DATA_LENGTH, request);
            BAP_DLL_Request(DataGet_REQ, header, data);
            break;

        case DataSetGet_REQ:
			BAP_createHeader(DISPLAY_3_MAIN_SELECTION_FCT_ID, header, DISPLAY_3_MAIN_SELECTION_BAP_DATA_LENGTH, request);
			createData_0x18_Display3MainSelection(data);
    		BAP_DLL_Request(DataSetGet_REQ, header, data);
            break;

        default:
            break;
    }
}

void Request_0x19_AdditionalInstrument(byte request)
{
    dword header [BAP_HEADER_SIZE];
    byte data[ADDITIONAL_INSTRUMENT_BAP_DATA_LENGTH];
	
    switch(request)
    {
        case DataGet_REQ_CAN:
            /*** NO FUNCTION WITH BAP DLL (CacheAvailability=true) -> Call via CAN ***/
            CAN_sendGetMessage(ADDITIONAL_INSTRUMENT_FCT_ID);
            break;

        case DataGet_REQ:
            /*** Cache data request ***/
            BAP_createHeader(ADDITIONAL_INSTRUMENT_FCT_ID, header, ADDITIONAL_INSTRUMENT_BAP_DATA_LENGTH, request);
            BAP_DLL_Request(DataGet_REQ, header, data);
            break;

        case DataSetGet_REQ:
			BAP_createHeader(ADDITIONAL_INSTRUMENT_FCT_ID, header, ADDITIONAL_INSTRUMENT_BAP_DATA_LENGTH, request);
			createData_0x19_AdditionalInstrument(data);
    		BAP_DLL_Request(DataSetGet_REQ, header, data);
            break;

        default:
            break;
    }
}

void Request_0x1A_AdditionalInstrument2(byte request)
{
    dword header [BAP_HEADER_SIZE];
    byte data[1];
	
    switch(request)
    {
        case DataGet_REQ_CAN:
            /*** NO FUNCTION WITH BAP DLL (CacheAvailability=true) -> Call via CAN ***/
            CAN_sendGetMessage(ADDITIONAL_INSTRUMENT2_FCT_ID);
            break;

        case DataGet_REQ:
            /*** Cache data request ***/
            BAP_createHeader(ADDITIONAL_INSTRUMENT2_FCT_ID, header, ADDITIONAL_INSTRUMENT2_BAP_DATA_LENGTH, request);
            BAP_DLL_Request(DataGet_REQ, header, data);
            break;

        case DataSetGet_REQ:
			BAP_createHeader(ADDITIONAL_INSTRUMENT2_FCT_ID, header, ADDITIONAL_INSTRUMENT2_BAP_DATA_LENGTH, request);
			header[5] = createData_0x1A_AdditionalInstrument2();
    		BAP_DLL_Request(DataSetGet_REQ, header, data);
            break;

        default:
            break;
    }
}

void Request_0x1B_DisplayPresets_get ()
{
    // BAP stack buffer
    dword header [BAP_HEADER_SIZE];
    byte data[BAP_BUFFER_SIZE];
    byte modeByte;
    int i;

    byte recordAddress, shift, direction, transmitPos, idxSize, ASG_ID, TAID;
    word start_pos, elements;

    // clear variables
    for(i=0; i<elCount(header); i++)
        header[i] = 0;
    for(i=0; i<elCount(data); i++)
        data[i] = 0;

    // get data
    shift           = @sysvar::DisplayConfig_ASG_DisplayPresets::x1B_DisplayPresets_AH_shift;
    direction       = @sysvar::DisplayConfig_ASG_DisplayPresets::x1B_DisplayPresets_AH_direction;
    transmitPos     = @sysvar::DisplayConfig_ASG_DisplayPresets::x1B_DisplayPresets_AH_transmitPos;
    idxSize         = @sysvar::DisplayConfig_ASG_DisplayPresets::x1B_DisplayPresets_AH_indexSize;
    recordAddress   = @sysvar::DisplayConfig_ASG_DisplayPresets::x1B_DisplayPresets_AH_recordAddress;

    ASG_ID          = @sysvar::DisplayConfig_ASG_DisplayPresets::x1B_DisplayPresets_ASGID;
    TAID            = @sysvar::DisplayConfig_ASG_DisplayPresets::x1B_DisplayPresets_TAID_hex;

    start_pos       = @sysvar::DisplayConfig_ASG_DisplayPresets::x1B_DisplayPresets_AH_start_hex;
    elements        = @sysvar::DisplayConfig_ASG_DisplayPresets::x1B_DisplayPresets_AH_elements_hex;

    modeByte        = Array_createModeByte (shift, direction, transmitPos, idxSize, recordAddress);
    i = Array_createHeader_get (data, start_pos, elements, ASG_ID, TAID, modeByte, idxSize);

    BAP_createHeader(DISPLAY_PRESETS_FCT_ID, header, i, DataGet_REQ);
    BAP_DLL_Request(DataGet_REQ, header, data);
}

Request_0x1B_DisplayPresets_setGet ()
{
	// BAP stack buffer
    dword header [BAP_HEADER_SIZE];
    byte data[BAP_BUFFER_SIZE];
    word indices[ELEMENT_CONTENT_SELECTION_ENTRIES];
    int dataIterator; // data[]-iterator
    
    byte byteBuffer;
    byte modeByte;
    int i;

    // header variables
    byte recordAddress, shift, direction, transmitPos, idxSize, ASG_ID, TAID;
    word start_pos, elements, tnle;
    
    //temporary array-element variables
    int elementsCount;

    // clear variables
    for(i=0; i<elCount(header); i++)
        header[i] = 0;
    for(i=0; i<elCount(data); i++)
        data[i] = 0;
    for(i=0; i<elCount(indices); i++)
        indices[i] = 0;

    // get data
    tnle = Array_getTNLE(DisplayPresets_Data_Validity_setGet);
    recordAddress = @sysvar::DisplayConfig_ASG_DisplayPresets::x1B_DisplayPresets_AH_recordAddress;
    shift = @sysvar::DisplayConfig_ASG_DisplayPresets::x1B_DisplayPresets_AH_shift;
    direction = @sysvar::DisplayConfig_ASG_DisplayPresets::x1B_DisplayPresets_AH_direction;
    transmitPos = @sysvar::DisplayConfig_ASG_DisplayPresets::x1B_DisplayPresets_AH_transmitPos;
    idxSize = @sysvar::DisplayConfig_ASG_DisplayPresets::x1B_DisplayPresets_AH_indexSize;
    ASG_ID = @sysvar::DisplayConfig_ASG_DisplayPresets::x1B_DisplayPresets_ASGID;
    TAID = @sysvar::DisplayConfig_ASG_DisplayPresets::x1B_DisplayPresets_TAID_hex;
    start_pos = @sysvar::DisplayConfig_ASG_DisplayPresets::x1B_DisplayPresets_AH_start_hex;
    elements = Array_getTNLE(DisplayPresets_Data_Validity_setGet);
	
    elementsCount = Array_getRequestedIndices (indices, start_pos, direction, shift, tnle, elements, DisplayPresets_Data_Validity_setGet);
	
    // if start in header != position of array element, change TransmitPos to true
    if(elementsCount != 0)
    {
        if(@sysvar::DisplayConfig_General::Smart && start_pos != DisplayPresets_Data_Pos_setGet[indices[0]])
        {
            @sysvar::DisplayConfig_ASG_DisplayPresets::x1B_DisplayPresets_AH_transmitPos = 1;
            transmitPos = @sysvar::DisplayConfig_ASG_DisplayPresets::x1B_DisplayPresets_AH_transmitPos;
        }
    }

    // if smart, change TransmitPos to true, if requested Positions are not continuous
    if(@sysvar::DisplayConfig_General::Smart && transmitPos == 0)
    {
        for(i=0; i<(elementsCount-1); i++)
        {
            if(DisplayPresets_Data_Pos_setGet[indices[i]] != (DisplayPresets_Data_Pos_setGet[indices[i+1]]-1))
            {
                @sysvar::DisplayConfig_ASG_DisplayPresets::x1B_DisplayPresets_AH_transmitPos = 1;
                transmitPos = @sysvar::DisplayConfig_ASG_DisplayPresets::x1B_DisplayPresets_AH_transmitPos;
                break;
            }
        }
    }

    // create mode byte
    modeByte = Array_createModeByte (shift, direction, transmitPos, idxSize, recordAddress);

	// Special for SetGet Array: Transmit empty element with elements=panel variable
	if(elements == 0)	// Element deletion
	{
		dataIterator = Array_createHeader_setGet (data, tnle, start_pos, 1, ASG_ID, TAID, modeByte, idxSize);
		data[dataIterator] = 0x00;
		dataIterator++;
	}
	else if(elementsCount == 0 && start_pos == 0xFF)	// Element creation
	{
		dataIterator = Array_createHeader_setGet (data, tnle, start_pos, 1, ASG_ID, TAID, modeByte, idxSize);
		dataIterator = DisplayPresets_addArrayElementData (data, dataIterator, Array_getFirstElementPos(DisplayPresets_Data_Validity_setGet, 0), transmitPos, recordAddress, idxSize);
	}
	else	// 'Normal' setGet
	{
    	dataIterator = Array_createHeader_setGet (data, tnle, start_pos, elementsCount, ASG_ID, TAID, modeByte, idxSize);
		for(i=0; i<elementsCount; i++)
    	{
        	dataIterator = DisplayPresets_addArrayElementData (data, dataIterator, indices[i], transmitPos, recordAddress, idxSize);
    	}
	}

    // Send BAP request
    BAP_createHeader(DISPLAY_PRESETS_FCT_ID, header, dataIterator, DataSetGet_REQ);
    BAP_DLL_Request(DataSetGet_REQ, header, data);
}

void Request_0x1C_DisplayDependency(byte request)
{
    dword header [BAP_HEADER_SIZE];
    byte data[DISPLAY_DEPENDENCY_BAP_DATA_LENGTH];
	
    switch(request)
    {
        case DataGet_REQ_CAN:
            /*** NO FUNCTION WITH BAP DLL (CacheAvailability=true) -> Call via CAN ***/
            CAN_sendGetMessage(DISPLAY_DEPENDENCY_FCT_ID);
            break;

        case DataGet_REQ:
            /*** Cache data request ***/
            BAP_createHeader(DISPLAY_DEPENDENCY_FCT_ID, header, DISPLAY_DEPENDENCY_BAP_DATA_LENGTH, request);
            BAP_DLL_Request(DataGet_REQ, header, data);
            break;

        case DataSetGet_REQ:
			BAP_createHeader(DISPLAY_DEPENDENCY_FCT_ID, header, DISPLAY_DEPENDENCY_BAP_DATA_LENGTH, request);
			createData_0x1C_DisplayDependency(data);
    		BAP_DLL_Request(DataSetGet_REQ, header, data);
            break;

        default:
            break;
    }
}

void Request_0x1D_ActiveDisplayPreset(byte request)
{
    dword header [BAP_HEADER_SIZE];
    byte data[ACTIVE_DISPLAY_PRESET_BAP_DATA_LENGTH];
	
    switch(request)
    {
        case DataGet_REQ_CAN:
            /*** NO FUNCTION WITH BAP DLL (CacheAvailability=true) -> Call via CAN ***/
            CAN_sendGetMessage(ACTIVE_DISPLAY_PRESET_FCT_ID);
            break;

        case DataGet_REQ:
            /*** Cache data request ***/
            BAP_createHeader(ACTIVE_DISPLAY_PRESET_FCT_ID, header, ACTIVE_DISPLAY_PRESET_BAP_DATA_LENGTH, request);
            BAP_DLL_Request(DataGet_REQ, header, data);
            break;

        case DataSetGet_REQ:
			BAP_createHeader(ACTIVE_DISPLAY_PRESET_FCT_ID, header, ACTIVE_DISPLAY_PRESET_BAP_DATA_LENGTH, request);
			createData_0x1D_ActiveDisplayPreset(data);
    		BAP_DLL_Request(DataSetGet_REQ, header, data);
            break;

        default:
            break;
    }
}

void Request_0x1E_DisplayViewConfiguration(byte request)
{
    dword header [BAP_HEADER_SIZE];
    byte data[DISPLAY_VIEW_CONFIGURATION_BAP_DATA_LENGTH];
	
    switch(request)
    {
        case DataGet_REQ_CAN:
            /*** NO FUNCTION WITH BAP DLL (CacheAvailability=true) -> Call via CAN ***/
            CAN_sendGetMessage(DISPLAY_VIEW_CONFIGURATION_FCT_ID);
            break;

        case DataGet_REQ:
            /*** Cache data request ***/
            BAP_createHeader(DISPLAY_VIEW_CONFIGURATION_FCT_ID, header, DISPLAY_VIEW_CONFIGURATION_BAP_DATA_LENGTH, request);
            BAP_DLL_Request(DataGet_REQ, header, data);
            break;

        case DataSetGet_REQ:
			BAP_createHeader(DISPLAY_VIEW_CONFIGURATION_FCT_ID, header, DISPLAY_VIEW_CONFIGURATION_BAP_DATA_LENGTH, request);
			createData_0x1E_DisplayViewConfiguration(data);
    		BAP_DLL_Request(DataSetGet_REQ, header, data);
            break;

        default:
            break;
    }
}

void Request_0x1F_LED_Configuration(byte request)
{
    dword header [BAP_HEADER_SIZE];
    byte data[LED_CONFIGURATION_BAP_DATA_LENGTH];
	
    switch(request)
    {
        case DataGet_REQ_CAN:
            /*** NO FUNCTION WITH BAP DLL (CacheAvailability=true) -> Call via CAN ***/
            CAN_sendGetMessage(LED_CONFIGURATION_FCT_ID);
            break;

        case DataGet_REQ:
            /*** Cache data request ***/
            BAP_createHeader(LED_CONFIGURATION_FCT_ID, header, LED_CONFIGURATION_BAP_DATA_LENGTH, request);
            BAP_DLL_Request(DataGet_REQ, header, data);
            break;

        case DataSetGet_REQ:
			BAP_createHeader(LED_CONFIGURATION_FCT_ID, header, LED_CONFIGURATION_BAP_DATA_LENGTH, request);
			createData_0x1F_LED_Configuration(data);
    		BAP_DLL_Request(DataSetGet_REQ, header, data);
            break;

        default:
            break;
    }
}



void Indication_0x04_HeartBeat(dword indication_header [], byte indication_data[], int datalength)
{
    switch (indication_header[2]) // indication
	{
		case Data_IND: 
            extractData_0x04_HeartBeat(indication_header[5]);              
		    break;

		case Error_IND:
            writelineEx(gError_Trace, CAPL_WRITE_LINE_ERROR, "DisplayConfig_ASG: Error-Indication in Indication_0x04_HeartBeat: Error 0x%x", indication_header[5]);
		    break;
		
        default:
			writelineEx(gBAP_Trace, CAPL_WRITE_LINE_INFORMATION, "DisplayConfig_ASG: Unhandled indication 0x%x in Indication_0x04_HeartBeat.", indication_header[2]);
		    break;
	}  
}

void Indication_0x0D_FSG_Control(dword indication_header [], byte indication_data[], int datalength)
{
    switch (indication_header[2]) // indication
	{
		case Data_IND: 
            extractData_0x0D_FSG_Control(indication_header[5]);              
		    break;

		case Error_IND:
            writelineEx(gError_Trace, CAPL_WRITE_LINE_ERROR, "DisplayConfig_ASG: Error-Indication in Indication_0x0D_FSG_Control: Error 0x%x", indication_header[5]);
		    break;
		
        default:
			writelineEx(gBAP_Trace, CAPL_WRITE_LINE_INFORMATION, "DisplayConfig_ASG: Unhandled indication 0x%x in Indication_0x0D_FSG_Control.", indication_header[2]);
		    break;
	}  
}

void Indication_0x0E_FSG_Setup(dword indication_header [], byte indication_data[], int datalength)
{
    switch (indication_header[2]) // indication
	{
		case Data_IND: 
            extractData_0x0E_FSG_Setup(indication_data);              
		    break;

		case Error_IND:
            writelineEx(gError_Trace, CAPL_WRITE_LINE_ERROR, "DisplayConfig_ASG: Error-Indication in Indication_0x0E_FSG_Setup: Error 0x%x", indication_header[5]);
		    break;
		
        default:
			writelineEx(gBAP_Trace, CAPL_WRITE_LINE_INFORMATION, "DisplayConfig_ASG: Unhandled indication 0x%x in Indication_0x0E_FSG_Setup.", indication_header[2]);
		    break;
	}  
}

void Indication_0x0F_FSG_OperationState(dword indication_header [], byte indication_data[], int datalength)
{
    switch (indication_header[2]) // indication
	{
		case Data_IND: 
            extractData_0x0F_FSG_OperationState(indication_header[5]);              
		    break;

		case Error_IND:
            writelineEx(gError_Trace, CAPL_WRITE_LINE_ERROR, "DisplayConfig_ASG: Error-Indication in Indication_0x0F_FSG_OperationState: Error 0x%x", indication_header[5]);
		    break;
		
        default:
			writelineEx(gBAP_Trace, CAPL_WRITE_LINE_INFORMATION, "DisplayConfig_ASG: Unhandled indication 0x%x in Indication_0x0F_FSG_OperationState.", indication_header[2]);
		    break;
	}  
}

void Indication_0x10_Brightness(dword indication_header [], byte indication_data[], int datalength)
{
    switch (indication_header[2]) // indication
	{
		case Data_IND: 
            extractData_0x10_Brightness(indication_data);              
		    break;

		case Error_IND:
            writelineEx(gError_Trace, CAPL_WRITE_LINE_ERROR, "DisplayConfig_ASG: Error-Indication in Indication_0x10_Brightness: Error 0x%x", indication_header[5]);
		    break;
		
        default:
			writelineEx(gBAP_Trace, CAPL_WRITE_LINE_INFORMATION, "DisplayConfig_ASG: Unhandled indication 0x%x in Indication_0x10_Brightness.", indication_header[2]);
		    break;
	}  
}

void Indication_0x11_Volume(dword indication_header [], byte indication_data[], int datalength)
{
    switch (indication_header[2]) // indication
	{
		case Data_IND: 
            extractData_0x11_Volume(indication_data);              
		    break;

		case Error_IND:
            writelineEx(gError_Trace, CAPL_WRITE_LINE_ERROR, "DisplayConfig_ASG: Error-Indication in Indication_0x11_Volume: Error 0x%x", indication_header[5]);
		    break;
		
        default:
			writelineEx(gBAP_Trace, CAPL_WRITE_LINE_INFORMATION, "DisplayConfig_ASG: Unhandled indication 0x%x in Indication_0x11_Volume.", indication_header[2]);
		    break;
	}  
}

void Indication_0x12_ElementContentSelection(dword indication_header [], byte indication_data[], int datalength)
{
    int tnle;
    int i;

    tnle = @sysvar::DisplayConfig_ASG_ElementContentSelection::x12_ElementContentSelection_TNLE;

    if(!@sysvar::DisplayConfig_ASG_ElementContentSelection::x12_ElementContentSelection_control_onOff)
        return;

    switch (indication_header[2]) // indication
	{
		case Changed_IND:
            // Clear old Array data
            ElementContentSelection_clearData_get();

            // Get First Element
            ElementContentSelection_getElement(0);
		    break;

        case Data_IND:
			// if Status Array with MSB of ASG_ID == 1 -> broadcast -> handle as changedArray
			if(Array_DecodeFirstByte_getASGID(indication_data[0]) & 0x8 && indication_header[3] == Bap_ByteSequence)	// Don't listen to Acknowledge
			{
				// Clear old Array data
				ElementContentSelection_clearData_get();
				// Get First Element
				ElementContentSelection_getElement(0);
				return;
			}
				
            // Check right Addressing 
            if(Array_DecodeFirstByte_getASGID(indication_data[0]) != ELEMENT_CONTENT_SELECTION_ASGID                      	// Only evaluate messages with valid ASGID
            || Array_DecodeFirstByte_getTAID(indication_data[0]) != ElementContentSelection_Data_lastRequestedTAID)     	// Only evaluate correct answered GetArrays
                return;
			
            // tnle == 0
            if(tnle >= indication_data[1] )                                             
                return;
			
            // Check if Get-Parameters are OK
            if(Array_DecodeModeByte_getShift(indication_data[2])            != 0                            				// No Shift
            || Array_DecodeModeByte_getDirection(indication_data[2])        != 0                            				// Forwards
            || Array_DecodeModeByte_getIdxSize(indication_data[2])          != 0                            				// 8 Bit
            || Array_DecodeModeByte_getRecordAddress(indication_data[2])    != ELEMENT_CONTENT_SELECTION_RECADDR_ALL  		// Full data
            || indication_data[4]                                           != 1)                           				// Elements
                return;
			
			// Everything OK, take Data
			extractData_0x12_ElementContentSelection(indication_data);

            // Get next element, if tnle>this
			tnle = indication_data[1];    
            if(@sysvar::DisplayConfig_ASG_ElementContentSelection::x12_ElementContentSelection_TNLE < tnle)
                ElementContentSelection_getElement(indication_data[5] + 1);

		    break;

		case Error_IND:
            writelineEx(gError_Trace, CAPL_WRITE_LINE_ERROR, "DisplayConfig_ASG: Error-Indication in Indication_0x12_ElementContentSelection: Error 0x%x", indication_header[5]);
		    break;
		
        default:
			writelineEx(gBAP_Trace, CAPL_WRITE_LINE_INFORMATION, "DisplayConfig_ASG: Unhandled indication 0x%x in Indication_0x12_ElementContentSelection.", indication_header[2]);
		    break;
	} 
}

void Indication_0x13_Display1Setup(dword indication_header [], byte indication_data[], int datalength)
{
    switch (indication_header[2]) // indication
	{
		case Data_IND: 
            extractData_0x13_Display1Setup(indication_data);              
		    break;

		case Error_IND:
            writelineEx(gError_Trace, CAPL_WRITE_LINE_ERROR, "DisplayConfig_ASG: Error-Indication in Indication_0x13_Display1Setup: Error 0x%x", indication_header[5]);
		    break;
		
        default:
			writelineEx(gBAP_Trace, CAPL_WRITE_LINE_INFORMATION, "DisplayConfig_ASG: Unhandled indication 0x%x in Indication_0x13_Display1Setup.", indication_header[2]);
		    break;
	}  
}

void Indication_0x14_Display1MainSelection(dword indication_header [], byte indication_data[], int datalength)
{
    switch (indication_header[2]) // indication
	{
		case Data_IND: 
            extractData_0x14_Display1MainSelection(indication_data);              
		    break;

		case Error_IND:
            writelineEx(gError_Trace, CAPL_WRITE_LINE_ERROR, "DisplayConfig_ASG: Error-Indication in Indication_0x14_Display1MainSelection: Error 0x%x", indication_header[5]);
		    break;
		
        default:
			writelineEx(gBAP_Trace, CAPL_WRITE_LINE_INFORMATION, "DisplayConfig_ASG: Unhandled indication 0x%x in Indication_0x14_Display1MainSelection.", indication_header[2]);
		    break;
	}  
}

void Indication_0x15_Display2Setup(dword indication_header [], byte indication_data[], int datalength)
{
    switch (indication_header[2]) // indication
	{
		case Data_IND: 
            extractData_0x15_Display2Setup(indication_data);              
		    break;

		case Error_IND:
            writelineEx(gError_Trace, CAPL_WRITE_LINE_ERROR, "DisplayConfig_ASG: Error-Indication in Indication_0x15_Display2Setup: Error 0x%x", indication_header[5]);
		    break;
		
        default:
			writelineEx(gBAP_Trace, CAPL_WRITE_LINE_INFORMATION, "DisplayConfig_ASG: Unhandled indication 0x%x in Indication_0x15_Display2Setup.", indication_header[2]);
		    break;
	}  
}

void Indication_0x16_Display2MainSelection(dword indication_header [], byte indication_data[], int datalength)
{
    switch (indication_header[2]) // indication
	{
		case Data_IND: 
            extractData_0x16_Display2MainSelection(indication_data);              
		    break;

		case Error_IND:
            writelineEx(gError_Trace, CAPL_WRITE_LINE_ERROR, "DisplayConfig_ASG: Error-Indication in Indication_0x16_Display2MainSelection: Error 0x%x", indication_header[5]);
		    break;
		
        default:
			writelineEx(gBAP_Trace, CAPL_WRITE_LINE_INFORMATION, "DisplayConfig_ASG: Unhandled indication 0x%x in Indication_0x16_Display2MainSelection.", indication_header[2]);
		    break;
	}  
}

void Indication_0x17_Display3Setup(dword indication_header [], byte indication_data[], int datalength)
{
    switch (indication_header[2]) // indication
	{
		case Data_IND: 
            extractData_0x17_Display3Setup(indication_data);              
		    break;

		case Error_IND:
            writelineEx(gError_Trace, CAPL_WRITE_LINE_ERROR, "DisplayConfig_ASG: Error-Indication in Indication_0x17_Display3Setup: Error 0x%x", indication_header[5]);
		    break;
		
        default:
			writelineEx(gBAP_Trace, CAPL_WRITE_LINE_INFORMATION, "DisplayConfig_ASG: Unhandled indication 0x%x in Indication_0x17_Display3Setup.", indication_header[2]);
		    break;
	}  
}

void Indication_0x18_Display3MainSelection(dword indication_header [], byte indication_data[], int datalength)
{
    switch (indication_header[2]) // indication
	{
		case Data_IND: 
            extractData_0x18_Display3MainSelection(indication_data);              
		    break;

		case Error_IND:
            writelineEx(gError_Trace, CAPL_WRITE_LINE_ERROR, "DisplayConfig_ASG: Error-Indication in Indication_0x18_Display3MainSelection: Error 0x%x", indication_header[5]);
		    break;
		
        default:
			writelineEx(gBAP_Trace, CAPL_WRITE_LINE_INFORMATION, "DisplayConfig_ASG: Unhandled indication 0x%x in Indication_0x18_Display3MainSelection.", indication_header[2]);
		    break;
	}  
}

void Indication_0x19_AdditionalInstrument(dword indication_header [], byte indication_data[], int datalength)
{
    switch (indication_header[2]) // indication
	{
		case Data_IND: 
            extractData_0x19_AdditionalInstrument(indication_data);              
		    break;

		case Error_IND:
            writelineEx(gError_Trace, CAPL_WRITE_LINE_ERROR, "DisplayConfig_ASG: Error-Indication in Indication_0x19_AdditionalInstrument: Error 0x%x", indication_header[5]);
		    break;
		
        default:
			writelineEx(gBAP_Trace, CAPL_WRITE_LINE_INFORMATION, "DisplayConfig_ASG: Unhandled indication 0x%x in Indication_0x19_AdditionalInstrument.", indication_header[2]);
		    break;
	}  
}

void Indication_0x1A_AdditionalInstrument2(dword indication_header [], byte indication_data[], int datalength)
{
    switch (indication_header[2]) // indication
	{
		case Data_IND: 
            extractData_0x1A_AdditionalInstrument2(indication_header[5]);              
		    break;

		case Error_IND:
            writelineEx(gError_Trace, CAPL_WRITE_LINE_ERROR, "DisplayConfig_ASG: Error-Indication in Indication_0x1A_AdditionalInstrument2: Error 0x%x", indication_header[5]);
		    break;
		
        default:
			writelineEx(gBAP_Trace, CAPL_WRITE_LINE_INFORMATION, "DisplayConfig_ASG: Unhandled indication 0x%x in Indication_0x1A_AdditionalInstrument2.", indication_header[2]);
		    break;
	}  
}

void Indication_0x1B_DisplayPresets(dword indication_header [], byte indication_data[], int datalength)
{
    int tnle;
    int i;

    tnle = @sysvar::DisplayConfig_ASG_DisplayPresets::x1B_DisplayPresets_TNLE;

    if(!@sysvar::DisplayConfig_ASG_DisplayPresets::x1B_DisplayPresets_control_onOff)
        return;

    switch (indication_header[2]) // indication
	{
		case Changed_IND:
            // Clear old Array data
            DisplayPresets_clearData_get();

            // Get First Element
            DisplayPresets_getElement(0);
		    break;

        case Data_IND:
			// if Status Array with MSB of ASG_ID == 1 -> broadcast -> handle as changedArray
			if(Array_DecodeFirstByte_getASGID(indication_data[0]) & 0x8 && indication_header[3] == Bap_ByteSequence)	// Don't listen to Acknowledge
			{
				// Clear old Array data
				DisplayPresets_clearData_get();
				// Get First Element
				DisplayPresets_getElement(0);
				return;
			}
			
            // Check right Addressing 
            if(Array_DecodeFirstByte_getASGID(indication_data[0]) != DISPLAY_PRESETS_ASGID                      	// Only evaluate messages with valid ASGID
            || Array_DecodeFirstByte_getTAID(indication_data[0]) != DisplayPresets_Data_lastRequestedTAID)     	// Only evaluate correct answered GetArrays
                return;

            // tnle == 0
            if(tnle >= indication_data[1] )                                             
                return;
			
            // Check if Get-Parameters are OK
            if(Array_DecodeModeByte_getShift(indication_data[2])            != 0                            				// No Shift
            || Array_DecodeModeByte_getDirection(indication_data[2])        != 0                            				// Forwards
            || Array_DecodeModeByte_getIdxSize(indication_data[2])          != 0                            				// 8 Bit
            || Array_DecodeModeByte_getRecordAddress(indication_data[2])    != DISPLAY_PRESETS_RECADDR_DISPLAY123// Full data
            || indication_data[4]                                           != 1)                           				// Elements
                return;

			// Everything OK, take Data
			extractData_0x1B_DisplayPresets(indication_data);

            // Get next element, if tnle>this
			tnle = indication_data[1];    

            if(@sysvar::DisplayConfig_ASG_DisplayPresets::x1B_DisplayPresets_TNLE < tnle)
                DisplayPresets_getElement(indication_data[5] + 1);

		    break;

		case Error_IND:
            writelineEx(gError_Trace, CAPL_WRITE_LINE_ERROR, "DisplayConfig_ASG: Error-Indication in Indication_0x1B_DisplayPresets: Error 0x%x", indication_header[5]);
		    break;
		
        default:
			writelineEx(gBAP_Trace, CAPL_WRITE_LINE_INFORMATION, "DisplayConfig_ASG: Unhandled indication 0x%x in Indication_0x1B_DisplayPresets.", indication_header[2]);
		    break;
	} 
}

void Indication_0x1C_DisplayDependency(dword indication_header [], byte indication_data[], int datalength)
{
    switch (indication_header[2]) // indication
	{
		case Data_IND: 
            extractData_0x1C_DisplayDependency(indication_data);              
		    break;

		case Error_IND:
            writelineEx(gError_Trace, CAPL_WRITE_LINE_ERROR, "DisplayConfig_ASG: Error-Indication in Indication_0x1C_DispalyDependency: Error 0x%x", indication_header[5]);
		    break;
		
        default:
			writelineEx(gBAP_Trace, CAPL_WRITE_LINE_INFORMATION, "DisplayConfig_ASG: Unhandled indication 0x%x in Indication_0x1C_DispalyDependency.", indication_header[2]);
		    break;
	}  
}

void Indication_0x1D_ActiveDisplayPreset(dword indication_header [], byte indication_data[], int datalength)
{
    switch (indication_header[2]) // indication
	{
		case Data_IND: 
            extractData_0x1D_ActiveDisplayPreset(indication_data);              
		    break;

		case Error_IND:
            writelineEx(gError_Trace, CAPL_WRITE_LINE_ERROR, "DisplayConfig_ASG: Error-Indication in Indication_0x1D_ActiveDisplayPreset: Error 0x%x", indication_header[5]);
		    break;
		
        default:
			writelineEx(gBAP_Trace, CAPL_WRITE_LINE_INFORMATION, "DisplayConfig_ASG: Unhandled indication 0x%x in Indication_0x1D_ActiveDisplayPreset.", indication_header[2]);
		    break;
	}  
}

void Indication_0x1E_DisplayViewConfiguration(dword indication_header [], byte indication_data[], int datalength)
{
    switch (indication_header[2]) // indication
	{
		case Data_IND: 
            extractData_0x1E_DisplayViewConfiguration(indication_data);              
		    break;

		case Error_IND:
            writelineEx(gError_Trace, CAPL_WRITE_LINE_ERROR, "DisplayConfig_ASG: Error-Indication in Indication_0x1E_DisplayViewConfiguration: Error 0x%x", indication_header[5]);
		    break;
		
        default:
			writelineEx(gBAP_Trace, CAPL_WRITE_LINE_INFORMATION, "DisplayConfig_ASG: Unhandled indication 0x%x in Indication_0x1E_DisplayViewConfiguration.", indication_header[2]);
		    break;
	}  
}

void Indication_0x1F_LED_Configuration(dword indication_header [], byte indication_data[], int datalength)
{
    switch (indication_header[2]) // indication
	{
		case Data_IND: 
            extractData_0x1F_LED_Configuration(indication_data);              
		    break;

		case Error_IND:
            writelineEx(gError_Trace, CAPL_WRITE_LINE_ERROR, "DisplayConfig_ASG: Error-Indication in Indication_0x1F_LED_Configuration: Error 0x%x", indication_header[5]);
		    break;
		
        default:
			writelineEx(gBAP_Trace, CAPL_WRITE_LINE_INFORMATION, "DisplayConfig_ASG: Unhandled indication 0x%x in Indication_0x1F_LED_Configuration.", indication_header[2]);
		    break;
	}  
}

void Request_0x04_HeartBeat (byte request)
{
    dword header [BAP_HEADER_SIZE];
    byte data[1];

    switch(request)
    {
        case DataGet_REQ_CAN:
            /*** NO FUNCTION WITH BAP DLL (CacheAvailability=true) -> Call via CAN ***/
            CAN_sendGetMessage(HEART_BEAT_FCT_ID);
            break;
        
        case DataGet_REQ:
            /*** Cache data request ***/
            BAP_createHeader(HEART_BEAT_FCT_ID, header, elCount(data), request);
            BAP_DLL_Request(request, header, data);
            break;

        default:
            break;
    }
}

on message CAN1.BAP_DisplayConfig_FSG_01  // ASG BAP-message
{
    int i, error;
    byte RX_Data[8];		    // received CAN-DATA
    dword RX_Header[3];		    // received CAN-Header

    RX_Header[0]=this.CAN; 
    RX_Header[1]=this.ID; 
    RX_Header[2]=this.DLC;      // received length
	
	// extract CAN data    																	
	for (i=0; i<this.DLC; i++) 														
	    RX_Data[i]=this.byte(i);		  
	        
	// send recieved CAN-data with CAN-header to BAP-DLL
	error =Bap180_CAN_SetRxDat(NODE_INDEX,RX_Header,RX_Data);	
	if(error !=0)
	    writelineEx(gError_Trace, CAPL_WRITE_LINE_ERROR, "ASG-DisplayConfig: BAP_CAN_SetRxData: %d", error);
}

void Indication_0x03_FunctionList(dword indication_header [], byte indication_data[], int datalength)
{
    switch (indication_header[2]) // indication
	{
		case Data_IND: 
			extractData_0x03_FunctionList(indication_data);
		    
            // Enable controls
            controls_enable_all();

            if(@sysvar::DisplayConfig_General::Smart)
                Request_0x01_GetAll(DataGet_REQ);

            break;		
		
        case Error_IND:
            writelineEx(gError_Trace, CAPL_WRITE_LINE_ERROR, "DisplayConfig_ASG: Error-Indication in Indication_0x03_FunctionList: Error 0x%x", indication_header[5]);
		    break;

		default:
			writelineEx(gBAP_Trace, CAPL_WRITE_LINE_INFORMATION, "DisplayConfig_ASG: Unhandled indication 0x%x in Indication_0x03_FunctionList.", indication_header[2]);
		    break;
	}
}

void Request_0x03_FunctionList(byte request)
{   
    dword header [BAP_HEADER_SIZE];
    byte data[1];

    switch(request)
    {
        case DataGet_REQ_CAN:
            /*** NO FUNCTION WITH BAP DLL (CacheAvailability=true) -> Call via CAN ***/
            CAN_sendGetMessage(FUNCTION_LIST_FCT_ID);
            break;
        
        case DataGet_REQ:
            /*** Cache data request ***/
            BAP_createHeader(FUNCTION_LIST_FCT_ID, header, elCount(data), request);
            BAP_DLL_Request(request, header, data);
            break;

        default:
            break;
    }
}

void init_variables()
{
    init_variables_properties(INIT_DISPLAY_CONFIG_STD);
	init_variables_array_ElementContentSelection();
	init_variables_array_DisplayPresets();
}

init_variables_array_DisplayPresets ()
{
    long i;
	
    @sysvar::DisplayConfig_ASG_DisplayPresets::x1B_DisplayPresets_ASGID                       = 0;
    @sysvar::DisplayConfig_ASG_DisplayPresets::x1B_DisplayPresets_TAID_hex                    = 0;
    @sysvar::DisplayConfig_ASG_DisplayPresets::x1B_DisplayPresets_TNLE                        = 0;

    @sysvar::DisplayConfig_ASG_DisplayPresets::x1B_DisplayPresets_AH_shift                    = 0;
	@sysvar::DisplayConfig_ASG_DisplayPresets::x1B_DisplayPresets_AH_direction                = 0;
	@sysvar::DisplayConfig_ASG_DisplayPresets::x1B_DisplayPresets_AH_transmitPos              = 0;
	@sysvar::DisplayConfig_ASG_DisplayPresets::x1B_DisplayPresets_AH_indexSize                = 0;
	
	@sysvar::DisplayConfig_ASG_DisplayPresets::x1B_DisplayPresets_AH_recordAddress            = 0;

    @sysvar::DisplayConfig_ASG_DisplayPresets::x1B_DisplayPresets_AH_start_hex                = 0;
	@sysvar::DisplayConfig_ASG_DisplayPresets::x1B_DisplayPresets_AH_elements_hex             = 0;
    

    @sysvar::DisplayConfig_ASG_DisplayPresets::x1B_DisplayPresets_control_default_external    = 0;

    DisplayPresets_init_static_get();
	DisplayPresets_init_static_setGet();
}

void Shutdown_DisplayConfig()
{
    // Timer
    canceltimer(TaskTimer);

    // BAP-Stack
    Bap180_Shutdown(NODE_INDEX,LSG_DisplayConfig);

    // Reset variables
    if(@sysvar::DisplayConfig_General::Smart)
        init_variables();
}

void Request_0x01_GetAll(byte request)
{
    dword header [BAP_HEADER_SIZE];
    byte data[1];
    switch(request)
    {
        case DataGet_REQ_CAN:
            /*** NO FUNCTION WITH BAP DLL (CacheAvailability=true) -> Call via CAN ***/
            CAN_sendGetMessage(GET_ALL_FCT_ID);
            break;
        
        case DataGet_REQ:
            /*** Cache data request ***/
            BAP_createHeader(GET_ALL_FCT_ID, header, elCount(data), request);
            BAP_DLL_Request(request, header, data);
            break;

        default:
            break;
    }
}

init_variables_array_ElementContentSelection ()
{
    long i;
	
    @sysvar::DisplayConfig_ASG_ElementContentSelection::x12_ElementContentSelection_ASGID                       = 0;
    @sysvar::DisplayConfig_ASG_ElementContentSelection::x12_ElementContentSelection_TAID_hex                    = 0;
    @sysvar::DisplayConfig_ASG_ElementContentSelection::x12_ElementContentSelection_TNLE                        = 0;

    @sysvar::DisplayConfig_ASG_ElementContentSelection::x12_ElementContentSelection_AH_shift                    = 0;
	@sysvar::DisplayConfig_ASG_ElementContentSelection::x12_ElementContentSelection_AH_direction                = 0;
	@sysvar::DisplayConfig_ASG_ElementContentSelection::x12_ElementContentSelection_AH_transmitPos              = 0;
	@sysvar::DisplayConfig_ASG_ElementContentSelection::x12_ElementContentSelection_AH_indexSize                = 0;
	
	@sysvar::DisplayConfig_ASG_ElementContentSelection::x12_ElementContentSelection_AH_recordAddress            = 0;

    @sysvar::DisplayConfig_ASG_ElementContentSelection::x12_ElementContentSelection_AH_start_hex                = 0;
	@sysvar::DisplayConfig_ASG_ElementContentSelection::x12_ElementContentSelection_AH_elements_hex             = 0;
    

    @sysvar::DisplayConfig_ASG_ElementContentSelection::x12_ElementContentSelection_control_default_external    = 0;
	@sysvar::DisplayConfig_ASG_ElementContentSelection::x12_ElementContentSelection_control_onOff    			= 0;

    ElementContentSelection_init_static_get();
	ElementContentSelection_init_static_setGet();
}

ElementContentSelection_init_static_get()
{
    // Clear old entries
    ElementContentSelection_clearData_get ();

    // Anctualize system variables for Panel
    ElementContentSelection_Data_startPos_get = Array_getFirstElementPos(ElementContentSelection_Data_Validity_get, 0);
    ElementContentSelection_actualize_sysvar_get ();
}

ElementContentSelection_init_static_setGet()
{
    // Clear old entries
    ElementContentSelection_clearData_setGet ();

    // Anctualize system variables for Panel
    ElementContentSelection_Data_startPos_setGet = Array_getFirstElementPos(ElementContentSelection_Data_Validity_setGet, 0);
    ElementContentSelection_actualize_sysvar_setGet ();
}

ElementContentSelection_init_CSV_setGet () //Byte & file selection
{
    int i = 0;
    int j = 0;
    int k = 0;

    byte dataBuffer[5000];
    int byteCount = 0;
    char file_complete[5000];

    // byte buffers to store characters
    char buffer_pos[5];
    char buffer_display[5];
    char buffer_additionalInfo[5];
	char buffer_element[5];
	char buffer_elementContent[5];
    int buffer_incrementator = 0;

    // differentiate data fields
    enum dataTypeEnum {pos, display, additionalInfo, element, elementContent};
    int dataType = pos;
    int inc_csv_line;
    inc_csv_line = 0;

    // catch if no file was selected
    if(sysGetVariableArrayLength(sysvar::DisplayConfig_ASG_ElementContentSelection::x12_ElementContentSelection_control_externalFilePath) == 0)
    {
        sysSetVariableString(sysvar::DisplayConfig_ASG_ElementContentSelection::x12_ElementContentSelection_control_loadReload_result, "Select file first!");
        @sysvar::DisplayConfig_ASG_ElementContentSelection::x12_ElementContentSelection_control_default_external    = 0;
        return;
    }

    // Get complete path
    sysGetVariableString(sysvar::DisplayConfig_ASG_ElementContentSelection::x12_ElementContentSelection_control_externalFilePath, file_complete, elCount(file_complete));

    byteCount = File_readCSV (dataBuffer, file_complete);
	
    // clear old data
    ElementContentSelection_clearData_setGet();

    /*** Parse data and create new ElementContentSelection ***/            
    for(i=0; i<byteCount; i++)
    {
        // nextline in *.csv -> "LF" and "CR" detected
        if( (dataBuffer[i] == 0x0D) && (dataBuffer[i+1] == 0x0A) )
        {
            // Take data if not in first line
            if(inc_csv_line > 0)
            {
                ElementContentSelection_Data_Pos_setGet[atol(buffer_pos)] = atol(buffer_pos);
				ElementContentSelection_Data_Validity_setGet[atol(buffer_pos)] = 1;
                ElementContentSelection_Data_Display_setGet[atol(buffer_pos)] = atol(buffer_display);
				ElementContentSelection_Data_AdditionalInfo_setGet[atol(buffer_pos)] = atol(buffer_additionalInfo);
				ElementContentSelection_Data_Element_setGet[atol(buffer_pos)] = atol(buffer_element);
				ElementContentSelection_Data_ElementContent_setGet[atol(buffer_pos)] = atol(buffer_elementContent);
            }

            inc_csv_line++;
            i++;                        // skip CR
            dataType = pos;             // starts with pos again
            buffer_incrementator = 0;   // first buffer position

            // clear all buffers
            for(j=0; j<elCount(buffer_pos); j++)
                buffer_pos[j] = 0;
            for(j=0; j<elCount(buffer_display); j++)
                buffer_display[j] = 0;
            for(j=0; j<elCount(buffer_additionalInfo); j++)
                buffer_additionalInfo[j] = 0;
			for(j=0; j<elCount(buffer_element); j++)
                buffer_element[j] = 0;
			for(j=0; j<elCount(buffer_elementContent); j++)
                buffer_elementContent[j] = 0;
        }
        else
        // Don't work in header line
        if(inc_csv_line > 0)
        {
            // detection of ';'
            if (dataBuffer[i] == 0x3B)
            {
                dataType++;
                buffer_incrementator = 0;
            }
            else // sign to read
            {
                switch(dataType)
                {
                    case pos:
                        buffer_pos[buffer_incrementator] = dataBuffer[i];
                        buffer_incrementator++;
                        break;

                    case display:
                        buffer_display[buffer_incrementator] = dataBuffer[i];
                        buffer_incrementator++;
                        break;

                    case additionalInfo:
                        buffer_additionalInfo[buffer_incrementator] = dataBuffer[i];
                        buffer_incrementator++;
                        break;
						
					case element:
                        buffer_element[buffer_incrementator] = dataBuffer[i];
                        buffer_incrementator++;
                        break;
                    
					case elementContent:
                        buffer_elementContent[buffer_incrementator] = dataBuffer[i];
                        buffer_incrementator++;
                        break;

                    default:    // undefined / error
                        writelineEx(gError_Trace, CAPL_WRITE_LINE_ERROR,"Fehler beim Lesen der .csv-Datei! Ungültiger Datentyp: %d", dataType);
                        break;
                }
            }
        }
    }

	sysSetVariableString(sysvar::DisplayConfig_ASG_ElementContentSelection::x12_ElementContentSelection_control_loadReload_result, "File successfully loaded!");

	ElementContentSelection_Data_startPos_setGet = Array_getFirstElementPos(ElementContentSelection_Data_Validity_setGet, 0);
    ElementContentSelection_actualize_sysvar_setGet ();

    enableControl("DisplayConfig_ASG_Array_ElementContentSelection", "btn_dataSource_external", TRUE);
}

File_separatePath (char completePath[], char path[], char file[])
{
    int i, j;
    int separators;
    int separatorCounter;
    int fileName_length;

    // clear buffer
    for(i=0; i<elCount(path); i++)
        path[i] = 0;
    for(i=0; i<elCount(file); i++)
        file[i] = 0;

    // Count separators
    i = 0;
    separators = 0;
    while (completePath[i] !=0)
    {
        if(completePath[i] == 0x5C)
            separators++;                
        i++;
    } 

    // Get position of last separator
    i = 0;
    separatorCounter = 0;
    while (separatorCounter != separators)
    {
        if(completePath[i] == 0x5C)
            separatorCounter++;                
        i++;
    }

    // Copy path to destination (stop on last separator position)
    strncpy(path, completePath, i);

    // get length of filename
    j = i;
    fileName_length = 0;
    while(completePath[j] != 0x00)
    {
        fileName_length++;
        j++;
    }

    // Copy filename to destination (start after last separator)
    for(j=0; j<fileName_length; j++)
        file[j] = completePath[i+j];
}

int File_readCSV (byte dataBuffer[], char file_complete[])
{
    char file_fileName[5000];
    char file_path[5000];
    dword CSVfileHandle = 0;

    int csv_byte_len = 0;

    File_separatePath (file_complete, file_path, file_fileName);

    //set path for *.csv file
    setFilePath(file_path, 0); 
    //open *.csv (binary-mode -> get the ASCII/UTF-8 code)
    CSVfileHandle = openFileRead(file_fileName,1); 
    if (CSVfileHandle == 0) //*.csv file access successful
        writelineEx(gError_Trace, CAPL_WRITE_LINE_ERROR,"Fehler beim Dateizugriff auf '%s'",file_complete);

    csv_byte_len = fileGetBinaryBlock (dataBuffer, elcount(dataBuffer), CSVfileHandle); // get data from *.csv and store the total number of byte in *.csv-file

    // close file
    if(fileClose (CSVfileHandle) == 0) // close not successful
        writelineEx(gError_Trace, CAPL_WRITE_LINE_ERROR,"Datei '%s' geschlossen", file_complete); // output result

    return csv_byte_len;
}

BAP_DLL_StackStart ()
{
    int error;

    // BAP Chache
    //error = BAP_DLL_Init_SendBuffer();
    if(error ==BAP_NO_ERROR)
	    writelineEx(gBAP_Trace, CAPL_WRITE_LINE_SUCCESS, "ASG-DisplayConfig BAP Cache Request successful");	
    else
	    writelineEx(gError_Trace, 0,"ASG-DisplayConfig error in BAP_DLL_StackStart () - BAP Chache: 0x%x", error);

    //BAP-Start
	error = Bap180_Start(NODE_INDEX, LSG_DisplayConfig);
		
    if(error == BAP_NO_ERROR)
		writelineEx(gBAP_Trace, CAPL_WRITE_LINE_SUCCESS, "ASG-DisplayConfig BAP_Start successful");
    else
	    writelineEx(gError_Trace, 0,"ASG-DisplayConfig error in BAP_DLL_StackStart () - BAP Start: 0x%x", error);

    writelineEx(gBAP_Trace, CAPL_WRITE_LINE_SUCCESS, "*********************************************************************************");
}

init_DisplayConfig ()
{	
    BAP_DLL_StackStart();	
}

init_variables_properties (int variant)
{
	switch(variant)
	{
		case INIT_DISPLAY_CONFIG_STD:
			extractData_0x03_FunctionList(FUNCTION_LIST_INIT_STD);
			extractData_0x04_HeartBeat(HEART_BEAT_INIT_STD);
			extractData_0x0D_FSG_Control(FSG_CONTROL_INIT_STD);
			extractData_0x0E_FSG_Setup(FSG_SETUP_INIT_STD);
			extractData_0x0F_FSG_OperationState(FSG_OPERATION_STATE_INIT_STD);
			extractData_0x10_Brightness(BRIGHTNESS_INIT_STD);
			extractData_0x11_Volume(VOLUME_INIT_STD);
			extractData_0x13_Display1Setup(DISPLAY_1_SETUP_INIT_STD);	
			extractData_0x14_Display1MainSelection(DISPLAY_1_MAIN_SELECTION_INIT_STD);	
			extractData_0x15_Display2Setup(DISPLAY_2_SETUP_INIT_STD);	
			extractData_0x16_Display2MainSelection(DISPLAY_2_MAIN_SELECTION_INIT_STD);	
			extractData_0x17_Display3Setup(DISPLAY_3_SETUP_INIT_STD);	
			extractData_0x18_Display3MainSelection(DISPLAY_3_MAIN_SELECTION_INIT_STD);	
			extractData_0x19_AdditionalInstrument(ADDITIONAL_INSTRUMENT_INIT_STD);
			extractData_0x1A_AdditionalInstrument2(ADDITIONAL_INSTRUMENT2_INIT_STD);
			extractData_0x1C_DisplayDependency(DISPLAY_DEPENDENCY_INIT_STD);
			extractData_0x1D_ActiveDisplayPreset(ACTIVE_DISPLAY_PRESET_INIT_STD);
			extractData_0x1E_DisplayViewConfiguration(DISPLAY_VIEW_CONFIGURATION_INIT_STD);
			extractData_0x1F_LED_Configuration(LED_CONFIGURATION_INIT_STD);
			break;
		
		default:
			writelineEx(gError_Trace, CAPL_WRITE_LINE_ERROR, "Error in init_variables_properties(int variant): tried init with 0x%x", variant);
			break;
    }
}

BAP_createHeader (dword FctID, dword headerBuffer[], dword datalength, dword requestType)
{
    dword datatype, length;

    if(elCount(headerBuffer) != BAP_HEADER_SIZE)                            // Buffer not as big as specified.
    {
        writeLineEx(gError_Trace, CAPL_WRITE_LINE_ERROR, "Wrong BAP Header size in BAP_createHeader (dword FctID, byte[] headerBuffer)! Not %d but %d bytes long!", BAP_HEADER_SIZE, elCount(headerBuffer));
        return;
    }
    
    switch(requestType)
    {
        case DataGet_REQ:
			// first, get bap data type, length and data
            switch(FctID)
            {
                case GET_ALL_FCT_ID:
                    datatype = Bap_Void;
					length = 0;
                    break;
        
                case BAP_CONFIG_FCT_ID:
                    datatype = Bap_Void;
					length = 0;
                    break;
        
                case FUNCTION_LIST_FCT_ID:
                    datatype = Bap_Void;
					length = 0;
                    break;

				case HEART_BEAT_FCT_ID:
                    datatype = Bap_Void;
					length = 0;
                    break;
				
				case FSG_CONTROL_FCT_ID:
                    datatype = Bap_Void;
					length = 0;
                    break;
        
                case FSG_SETUP_FCT_ID:
                    datatype = Bap_Void;
					length = 0;
                    break;

				case FSG_OPERATION_STATE_FCT_ID:
                    datatype = Bap_Void;
					length = 0;
                    break;

				case BRIGHTNESS_FCT_ID:
                    datatype = Bap_Void;
					length = 0;
                    break;

				case VOLUME_FCT_ID:
                    datatype = Bap_Void;
					length = 0;
                    break;

				case ELEMENT_CONTENT_SELECTION_FCT_ID:
                    datatype = ELEMENT_CONTENT_SELECTION_BAP_DATA_TYPE;
					length = datalength;
                    break;

				case DISPLAY_1_SETUP_FCT_ID:
                    datatype = Bap_Void;
					length = 0;
                    break;

				case DISPLAY_1_MAIN_SELECTION_FCT_ID:
                    datatype = Bap_Void;
					length = 0;
                    break;

				case DISPLAY_2_SETUP_FCT_ID:
                    datatype = Bap_Void;
					length = 0;
                    break;

				case DISPLAY_2_MAIN_SELECTION_FCT_ID:
                    datatype = Bap_Void;
					length = 0;
                    break;

				case DISPLAY_3_SETUP_FCT_ID:
                    datatype = Bap_Void;
					length = 0;
                    break;

				case DISPLAY_3_MAIN_SELECTION_FCT_ID:
                    datatype = Bap_Void;
					length = 0;
                    break;

				case ADDITIONAL_INSTRUMENT_FCT_ID:
                    datatype = Bap_Void;
					length = 0;
                    break;

				case ADDITIONAL_INSTRUMENT2_FCT_ID:
                    datatype = Bap_Void;
					length = 0;
                    break;

				case DISPLAY_PRESETS_FCT_ID:
                    datatype = DISPLAY_PRESETS_BAP_DATA_TYPE;
					length = datalength;
                    break;

				case DISPLAY_DEPENDENCY_FCT_ID:
                    datatype = Bap_Void;
					length = 0;
                    break;

				case ACTIVE_DISPLAY_PRESET_FCT_ID:
                    datatype = Bap_Void;
					length = 0;
                    break;

				case DISPLAY_VIEW_CONFIGURATION_FCT_ID:
                    datatype = Bap_Void;
					length = 0;
                    break;

				case LED_CONFIGURATION_FCT_ID:
                    datatype = Bap_Void;
					length = 0;
                    break;
                
				default:
                    writeLineEx(gError_Trace, CAPL_WRITE_LINE_ERROR, "Unknown Fct-ID in BAP_createHeader (dword FctID): %d", FctID);
            }
            break;
			
		case DataSetGet_REQ:
            // first, get bap data type, length and data
            switch(FctID)
            {
                case GET_ALL_FCT_ID:
                    datatype = GET_ALL_BAP_DATA_TYPE;
					length = GET_ALL_BAP_DATA_LENGTH;
                    break;
        
                case BAP_CONFIG_FCT_ID:
                    datatype = BAP_CONFIG_BAP_DATA_TYPE;
					length = BAP_CONFIG_BAP_DATA_LENGTH;
                    break;
        
                case FUNCTION_LIST_FCT_ID:
                    datatype = FUNCTION_LIST_BAP_DATA_TYPE;
					length = FUNCTION_LIST_BAP_DATA_LENGTH;
                    break;

				case HEART_BEAT_FCT_ID:
                    datatype = HEART_BEAT_BAP_DATA_TYPE;
					length = HEART_BEAT_BAP_DATA_LENGTH;
                    break;
				
				case FSG_CONTROL_FCT_ID:
                    datatype = FSG_CONTROL_BAP_DATA_TYPE;
					length = FSG_CONTROL_BAP_DATA_LENGTH;
                    break;
        
                case FSG_SETUP_FCT_ID:
                    datatype = FSG_SETUP_BAP_DATA_TYPE;
					length = FSG_SETUP_BAP_DATA_LENGTH;
                    break;

				case FSG_OPERATION_STATE_FCT_ID:
                    datatype = FSG_OPERATION_STATE_BAP_DATA_TYPE;
					length = FSG_OPERATION_STATE_BAP_DATA_LENGTH;
                    break;

				case BRIGHTNESS_FCT_ID:
                    datatype = BRIGHTNESS_BAP_DATA_TYPE;
					length = BRIGHTNESS_BAP_DATA_LENGTH;
                    break;

				case VOLUME_FCT_ID:
                    datatype = VOLUME_BAP_DATA_TYPE;
					length = VOLUME_BAP_DATA_LENGTH;
                    break;

				case ELEMENT_CONTENT_SELECTION_FCT_ID:
                    datatype = ELEMENT_CONTENT_SELECTION_BAP_DATA_TYPE;
					length = datalength;
                    break;

				case DISPLAY_1_SETUP_FCT_ID:
                    datatype = DISPLAY_1_SETUP_BAP_DATA_TYPE;
					length = DISPLAY_1_SETUP_BAP_DATA_LENGTH;
                    break;

				case DISPLAY_1_MAIN_SELECTION_FCT_ID:
                    datatype = DISPLAY_1_MAIN_SELECTION_BAP_DATA_TYPE;
					length = DISPLAY_1_MAIN_SELECTION_BAP_DATA_LENGTH;
                    break;

				case DISPLAY_2_SETUP_FCT_ID:
                    datatype = DISPLAY_2_SETUP_BAP_DATA_TYPE;
					length = DISPLAY_2_SETUP_BAP_DATA_LENGTH;
                    break;

				case DISPLAY_2_MAIN_SELECTION_FCT_ID:
                    datatype = DISPLAY_2_MAIN_SELECTION_BAP_DATA_TYPE;
					length = DISPLAY_2_MAIN_SELECTION_BAP_DATA_LENGTH;
                    break;

				case DISPLAY_3_SETUP_FCT_ID:
                    datatype = DISPLAY_3_SETUP_BAP_DATA_TYPE;
					length = DISPLAY_3_SETUP_BAP_DATA_LENGTH;
                    break;

				case DISPLAY_3_MAIN_SELECTION_FCT_ID:
                    datatype = DISPLAY_3_MAIN_SELECTION_BAP_DATA_TYPE;
					length = DISPLAY_3_MAIN_SELECTION_BAP_DATA_LENGTH;
                    break;

				case ADDITIONAL_INSTRUMENT_FCT_ID:
                    datatype = ADDITIONAL_INSTRUMENT_BAP_DATA_TYPE;
					length = ADDITIONAL_INSTRUMENT_BAP_DATA_LENGTH;
                    break;

				case ADDITIONAL_INSTRUMENT2_FCT_ID:
                    datatype = ADDITIONAL_INSTRUMENT2_BAP_DATA_TYPE;
					length = ADDITIONAL_INSTRUMENT2_BAP_DATA_LENGTH;
                    break;

				case DISPLAY_PRESETS_FCT_ID:
                    datatype = DISPLAY_PRESETS_BAP_DATA_TYPE;
					length = datalength;
                    break;

				case DISPLAY_DEPENDENCY_FCT_ID:
                    datatype = DISPLAY_DEPENDENCY_BAP_DATA_TYPE;
					length = DISPLAY_DEPENDENCY_BAP_DATA_LENGTH;
                    break;

				case ACTIVE_DISPLAY_PRESET_FCT_ID:
                    datatype = ACTIVE_DISPLAY_PRESET_BAP_DATA_TYPE;
					length = ACTIVE_DISPLAY_PRESET_BAP_DATA_LENGTH;
                    break;

				case DISPLAY_VIEW_CONFIGURATION_FCT_ID:
                    datatype = DISPLAY_VIEW_CONFIGURATION_BAP_DATA_TYPE;
					length = DISPLAY_VIEW_CONFIGURATION_BAP_DATA_LENGTH;
                    break;

				case LED_CONFIGURATION_FCT_ID:
                    datatype = LED_CONFIGURATION_BAP_DATA_TYPE;
					length = LED_CONFIGURATION_BAP_DATA_LENGTH;
                    break;
                
				default:
                    writeLineEx(gError_Trace, CAPL_WRITE_LINE_ERROR, "Unknown Fct-ID in BAP_createHeader (dword FctID): %d", FctID);
            }
            break;

        default:
            writeLineEx(gError_Trace, CAPL_WRITE_LINE_ERROR, "Unhandled RequestType in BAP_createHeader (dword FctID): %d", requestType);
    }

    // Create header
    headerBuffer[0] = LSG_DisplayConfig;			// LSG-ID
	headerBuffer[1] = FctID;		                // Fct-ID
	headerBuffer[2] = requestType;					// BAP requestType
	headerBuffer[3] = datatype;		                // BAP data-type (BapDataType_t)
	headerBuffer[4] = length;				    	// Length for data type byte sequence
	headerBuffer[5] = datalength;                       		// data (uint8/uint16/uint32 or Errorcode) or datalength
}

init_variables_controls ()
{
    @sysvar::DisplayConfig_ASG::control_OnOff              = 0;
    @sysvar::DisplayConfig_ASG::control_OnOff_indicator    = 0;
    
	enableControl("DisplayConfig_ASG_Main", "Ctrl_OnOff", FALSE);
	enableControl("DisplayConfig_ASG_Array_ElementContentSelection",	"btn_dataSource_external", 	FALSE);
    enableControl("DisplayConfig_ASG_Array_DisplayPresets", 			"btn_dataSource_external", 	FALSE);
}

int BAP_DLL_Request (byte request, dword Request_header[], byte Request_data[])
{
    int ret;                                                                                // Return value
    int i;

    Request_header[2] = request;
    
    if(elCount(Request_header)!= BAP_HEADER_SIZE)			                                // catch wrong header size
    {
        writeLineEx(gError_Trace, CAPL_WRITE_LINE_ERROR, "ASG: Wrong BAP Header size in BAP_DLL_Request (dword Request_header[], byte Request_data[])! Not %d but %d bytes long!", BAP_HEADER_SIZE, elCount(Request_header));
        return -1;
    }

    ret = Bap180_Request(NODE_INDEX, Request_header, Request_data);

    if(ret == 0x23) // BAP Stack Busy
    {
        if(Request_header[1] != 0x01)   // Hide GetAll (multiple calls by stack)
            writeLineEx(gBAP_Trace, CAPL_WRITE_LINE_WARNING, "ASG: BAP-Stack busy for Fct. 0x%x!", Request_header[1]);
    } else
    if(ret != 0)
    {
        writeLineEx(gError_Trace, CAPL_WRITE_LINE_ERROR, "ASG: BAP-Error in BAP_DLL_Request (dword Request_header[], byte Request_data[])! ErrorCode = 0x%x!", ret);

        for(i=0; i<elCount(Request_header); i++)
            writeLineEx(gError_Trace, CAPL_WRITE_LINE_ERROR, "Request_header[%d]=0x%x", i, Request_header[i]);
        for(i=0; i<Request_header[4]; i++)
            writeLineEx(gError_Trace, CAPL_WRITE_LINE_ERROR, "Request_data[%d]=0x%x", i, Request_data[i]);
    }
	
    return ret;
}

int ElementContentSelection_addArrayElementData (byte buffer[], int idx, int entry, int transmitPos, int recordAddress, int idxSize)
{
    int i;

    byte pos_upperByte, pos_lowerByte;
    byte byteBuffer;
    pos_upperByte = 0;
    pos_lowerByte = 0;

    // POS - if transmission is enabled via recordAddress or transmitPos
    if(transmitPos == 1 || recordAddress == ELEMENT_CONTENT_SELECTION_RECADDR_POS)
    {
        if(idxSize == 0)    // 8 bit
        {
            buffer[idx] = ElementContentSelection_Data_Pos_setGet[entry];
            idx++;
        }
        else                // 16 bit
        {
            pos_lowerByte = (ElementContentSelection_Data_Pos_setGet[entry] & 0x00FF);
            pos_upperByte = (ElementContentSelection_Data_Pos_setGet[entry] & 0xFF00) >> 8;
            buffer[idx] = pos_lowerByte;
            idx++;
            buffer[idx] = pos_upperByte;
            idx++;
        }
    }
    
    // Display, AdditionalInfo, Element - if transmission is enabled via recordAddress
    if(recordAddress == ELEMENT_CONTENT_SELECTION_RECADDR_ALL)
    {
		
		byteBuffer = 0;
		byteBuffer |= (ElementContentSelection_Data_Display_setGet[entry]		 	<< 4) & 0xF0;
		byteBuffer |= (ElementContentSelection_Data_AdditionalInfo_setGet[entry]	<< 0) & 0x0F;
		buffer[idx] = byteBuffer;
		idx++;
		
		buffer[idx] = ElementContentSelection_Data_Element_setGet[entry];
		idx++;
    }

    // ElementContent - if transmission is enabled via recordAddress
    if(recordAddress == ELEMENT_CONTENT_SELECTION_RECADDR_ALL || recordAddress == ELEMENT_CONTENT_SELECTION_RECADDR_EL_CONTENT)
    {
        buffer[idx] = ElementContentSelection_Data_ElementContent_setGet[entry];
		idx++;
    }

    return idx;   
}

ElementContentSelection_actualize_sysvar_get ()
{
	int nextPos;
    int tnle;
	int i;
	int first, next;
    tnle = Array_getTNLE(ElementContentSelection_Data_Validity_get);
	@sysvar::DisplayConfig_ASG_ElementContentSelection::x12_ElementContentSelection_TNLE = tnle;
	
	// Adapt panel
	enableControl("DisplayConfig_ASG_Array_ElementContentSelection", "ElementContentSelection_get_Element1", FALSE);
	enableControl("DisplayConfig_ASG_Array_ElementContentSelection", "ElementContentSelection_get_Element2", FALSE);
	enableControl("DisplayConfig_ASG_Array_ElementContentSelection", "ElementContentSelection_get_Element3", FALSE);
	enableControl("DisplayConfig_ASG_Array_ElementContentSelection", "ElementContentSelection_get_Element4", FALSE);
	enableControl("DisplayConfig_ASG_Array_ElementContentSelection", "Ctrl_ElementContentSelection_get_Up",  FALSE);
	enableControl("DisplayConfig_ASG_Array_ElementContentSelection", "Ctrl_ElementContentSelection_get_Down", FALSE);
	
	if(tnle == 0)
	{
		@sysvar::DisplayConfig_ASG_ElementContentSelection::x12_ElementContentSelection_list_get_pos_element1				= 0;
		@sysvar::DisplayConfig_ASG_ElementContentSelection::x12_ElementContentSelection_list_get_Display_element1			= 0;
		@sysvar::DisplayConfig_ASG_ElementContentSelection::x12_ElementContentSelection_list_get_AdditionalInfo_element1	= 0;
		@sysvar::DisplayConfig_ASG_ElementContentSelection::x12_ElementContentSelection_list_get_Element_element1			= 0;
		@sysvar::DisplayConfig_ASG_ElementContentSelection::x12_ElementContentSelection_list_get_ElementContent_element1	= 0;
		@sysvar::DisplayConfig_ASG_ElementContentSelection::x12_ElementContentSelection_list_get_pos_element2				= 0;
		@sysvar::DisplayConfig_ASG_ElementContentSelection::x12_ElementContentSelection_list_get_Display_element2			= 0;
		@sysvar::DisplayConfig_ASG_ElementContentSelection::x12_ElementContentSelection_list_get_AdditionalInfo_element2	= 0;
		@sysvar::DisplayConfig_ASG_ElementContentSelection::x12_ElementContentSelection_list_get_Element_element2			= 0;
		@sysvar::DisplayConfig_ASG_ElementContentSelection::x12_ElementContentSelection_list_get_ElementContent_element2	= 0;
		@sysvar::DisplayConfig_ASG_ElementContentSelection::x12_ElementContentSelection_list_get_pos_element3				= 0;
		@sysvar::DisplayConfig_ASG_ElementContentSelection::x12_ElementContentSelection_list_get_Display_element3			= 0;
		@sysvar::DisplayConfig_ASG_ElementContentSelection::x12_ElementContentSelection_list_get_AdditionalInfo_element3	= 0;
		@sysvar::DisplayConfig_ASG_ElementContentSelection::x12_ElementContentSelection_list_get_Element_element3			= 0;
		@sysvar::DisplayConfig_ASG_ElementContentSelection::x12_ElementContentSelection_list_get_ElementContent_element3	= 0;
		@sysvar::DisplayConfig_ASG_ElementContentSelection::x12_ElementContentSelection_list_get_pos_element4				= 0;
		@sysvar::DisplayConfig_ASG_ElementContentSelection::x12_ElementContentSelection_list_get_Display_element4			= 0;
		@sysvar::DisplayConfig_ASG_ElementContentSelection::x12_ElementContentSelection_list_get_AdditionalInfo_element4	= 0;
		@sysvar::DisplayConfig_ASG_ElementContentSelection::x12_ElementContentSelection_list_get_Element_element4			= 0;
		@sysvar::DisplayConfig_ASG_ElementContentSelection::x12_ElementContentSelection_list_get_ElementContent_element4	= 0;
		return;
	}
	if(ElementContentSelection_Data_startPos_get < 0)
		ElementContentSelection_Data_startPos_get = Array_getFirstElementPos(ElementContentSelection_Data_Validity_get, 0);

    // 1st element	
	nextPos = ElementContentSelection_Data_startPos_get;
	@sysvar::DisplayConfig_ASG_ElementContentSelection::x12_ElementContentSelection_list_get_pos_element1				= ElementContentSelection_Data_Pos_get				[nextPos];
	@sysvar::DisplayConfig_ASG_ElementContentSelection::x12_ElementContentSelection_list_get_Display_element1			= ElementContentSelection_Data_Display_get			[nextPos];
	@sysvar::DisplayConfig_ASG_ElementContentSelection::x12_ElementContentSelection_list_get_AdditionalInfo_element1	= ElementContentSelection_Data_AdditionalInfo_get	[nextPos];
	@sysvar::DisplayConfig_ASG_ElementContentSelection::x12_ElementContentSelection_list_get_Element_element1			= ElementContentSelection_Data_Element_get			[nextPos];
	@sysvar::DisplayConfig_ASG_ElementContentSelection::x12_ElementContentSelection_list_get_ElementContent_element1	= ElementContentSelection_Data_ElementContent_get	[nextPos];
  
    // 2nd element
	nextPos = Array_getNextElementPos_withWrap(ElementContentSelection_Data_Validity_get, nextPos, 0);
	if(nextPos == -1)
		nextPos = Array_getFirstElementPos(ElementContentSelection_Data_Validity_get, 0);
	@sysvar::DisplayConfig_ASG_ElementContentSelection::x12_ElementContentSelection_list_get_pos_element2				= ElementContentSelection_Data_Pos_get				[nextPos];
	@sysvar::DisplayConfig_ASG_ElementContentSelection::x12_ElementContentSelection_list_get_Display_element2			= ElementContentSelection_Data_Display_get			[nextPos];
	@sysvar::DisplayConfig_ASG_ElementContentSelection::x12_ElementContentSelection_list_get_AdditionalInfo_element2	= ElementContentSelection_Data_AdditionalInfo_get	[nextPos];
	@sysvar::DisplayConfig_ASG_ElementContentSelection::x12_ElementContentSelection_list_get_Element_element2			= ElementContentSelection_Data_Element_get			[nextPos];
	@sysvar::DisplayConfig_ASG_ElementContentSelection::x12_ElementContentSelection_list_get_ElementContent_element2	= ElementContentSelection_Data_ElementContent_get	[nextPos];
    
    // 3rd element
	nextPos = Array_getNextElementPos_withWrap(ElementContentSelection_Data_Validity_get, nextPos, 0);
	if(nextPos == -1)
		nextPos = Array_getFirstElementPos(ElementContentSelection_Data_Validity_get, 0);
	@sysvar::DisplayConfig_ASG_ElementContentSelection::x12_ElementContentSelection_list_get_pos_element3				= ElementContentSelection_Data_Pos_get				[nextPos];
	@sysvar::DisplayConfig_ASG_ElementContentSelection::x12_ElementContentSelection_list_get_Display_element3			= ElementContentSelection_Data_Display_get			[nextPos];
	@sysvar::DisplayConfig_ASG_ElementContentSelection::x12_ElementContentSelection_list_get_AdditionalInfo_element3	= ElementContentSelection_Data_AdditionalInfo_get	[nextPos];
	@sysvar::DisplayConfig_ASG_ElementContentSelection::x12_ElementContentSelection_list_get_Element_element3			= ElementContentSelection_Data_Element_get			[nextPos];
	@sysvar::DisplayConfig_ASG_ElementContentSelection::x12_ElementContentSelection_list_get_ElementContent_element3	= ElementContentSelection_Data_ElementContent_get	[nextPos];
    
    // 4th element
	nextPos = Array_getNextElementPos_withWrap(ElementContentSelection_Data_Validity_get, nextPos, 0);
	if(nextPos == -1)
		nextPos = Array_getFirstElementPos(ElementContentSelection_Data_Validity_get, 0);
	@sysvar::DisplayConfig_ASG_ElementContentSelection::x12_ElementContentSelection_list_get_pos_element4				= ElementContentSelection_Data_Pos_get				[nextPos];
	@sysvar::DisplayConfig_ASG_ElementContentSelection::x12_ElementContentSelection_list_get_Display_element4			= ElementContentSelection_Data_Display_get			[nextPos];
	@sysvar::DisplayConfig_ASG_ElementContentSelection::x12_ElementContentSelection_list_get_AdditionalInfo_element4	= ElementContentSelection_Data_AdditionalInfo_get	[nextPos];
	@sysvar::DisplayConfig_ASG_ElementContentSelection::x12_ElementContentSelection_list_get_Element_element4			= ElementContentSelection_Data_Element_get			[nextPos];
	@sysvar::DisplayConfig_ASG_ElementContentSelection::x12_ElementContentSelection_list_get_ElementContent_element4	= ElementContentSelection_Data_ElementContent_get	[nextPos];

	// Adapt Panel
    if(tnle>0)
        enableControl("DisplayConfig_ASG_Array_ElementContentSelection", "ElementContentSelection_get_Element1", TRUE);
    if(tnle>1)
        enableControl("DisplayConfig_ASG_Array_ElementContentSelection", "ElementContentSelection_get_Element2", TRUE);
    if(tnle>2)
        enableControl("DisplayConfig_ASG_Array_ElementContentSelection", "ElementContentSelection_get_Element3", TRUE);
    if(tnle>3)
        enableControl("DisplayConfig_ASG_Array_ElementContentSelection", "ElementContentSelection_get_Element4", TRUE);
    if(tnle>4)
    {
        enableControl("DisplayConfig_ASG_Array_ElementContentSelection", "Ctrl_ElementContentSelection_get_Up",  TRUE);
        enableControl("DisplayConfig_ASG_Array_ElementContentSelection", "Ctrl_ElementContentSelection_get_Down", TRUE);
    }
}

ElementContentSelection_actualize_sysvar_setGet ()
{
	int nextPos;
    int tnle;
	int i;
	int first, next;
    tnle = Array_getTNLE(ElementContentSelection_Data_Validity_setGet);

	// Adapt panel
	enableControl("DisplayConfig_ASG_Array_ElementContentSelection", "ElementContentSelection_setGet_Element1", FALSE);
	enableControl("DisplayConfig_ASG_Array_ElementContentSelection", "ElementContentSelection_setGet_Element2", FALSE);
	enableControl("DisplayConfig_ASG_Array_ElementContentSelection", "ElementContentSelection_setGet_Element3", FALSE);
	enableControl("DisplayConfig_ASG_Array_ElementContentSelection", "ElementContentSelection_setGet_Element4", FALSE);
	enableControl("DisplayConfig_ASG_Array_ElementContentSelection", "Ctrl_ElementContentSelection_setGet_Up",  FALSE);
	enableControl("DisplayConfig_ASG_Array_ElementContentSelection", "Ctrl_ElementContentSelection_setGet_Down", FALSE);
	
	if(tnle == 0)
	{
		@sysvar::DisplayConfig_ASG_ElementContentSelection::x12_ElementContentSelection_list_setGet_pos_element1				= 0;
		@sysvar::DisplayConfig_ASG_ElementContentSelection::x12_ElementContentSelection_list_setGet_Display_element1			= 0;
		@sysvar::DisplayConfig_ASG_ElementContentSelection::x12_ElementContentSelection_list_setGet_AdditionalInfo_element1		= 0;
		@sysvar::DisplayConfig_ASG_ElementContentSelection::x12_ElementContentSelection_list_setGet_Element_element1			= 0;
		@sysvar::DisplayConfig_ASG_ElementContentSelection::x12_ElementContentSelection_list_setGet_ElementContent_element1		= 0;
		@sysvar::DisplayConfig_ASG_ElementContentSelection::x12_ElementContentSelection_list_setGet_pos_element2				= 0;
		@sysvar::DisplayConfig_ASG_ElementContentSelection::x12_ElementContentSelection_list_setGet_Display_element2			= 0;
		@sysvar::DisplayConfig_ASG_ElementContentSelection::x12_ElementContentSelection_list_setGet_AdditionalInfo_element2		= 0;
		@sysvar::DisplayConfig_ASG_ElementContentSelection::x12_ElementContentSelection_list_setGet_Element_element2			= 0;
		@sysvar::DisplayConfig_ASG_ElementContentSelection::x12_ElementContentSelection_list_setGet_ElementContent_element2		= 0;
		@sysvar::DisplayConfig_ASG_ElementContentSelection::x12_ElementContentSelection_list_setGet_pos_element3				= 0;
		@sysvar::DisplayConfig_ASG_ElementContentSelection::x12_ElementContentSelection_list_setGet_Display_element3			= 0;
		@sysvar::DisplayConfig_ASG_ElementContentSelection::x12_ElementContentSelection_list_setGet_AdditionalInfo_element3		= 0;
		@sysvar::DisplayConfig_ASG_ElementContentSelection::x12_ElementContentSelection_list_setGet_Element_element3			= 0;
		@sysvar::DisplayConfig_ASG_ElementContentSelection::x12_ElementContentSelection_list_setGet_ElementContent_element3		= 0;
		@sysvar::DisplayConfig_ASG_ElementContentSelection::x12_ElementContentSelection_list_setGet_pos_element4				= 0;
		@sysvar::DisplayConfig_ASG_ElementContentSelection::x12_ElementContentSelection_list_setGet_Display_element4			= 0;
		@sysvar::DisplayConfig_ASG_ElementContentSelection::x12_ElementContentSelection_list_setGet_AdditionalInfo_element4		= 0;
		@sysvar::DisplayConfig_ASG_ElementContentSelection::x12_ElementContentSelection_list_setGet_Element_element4			= 0;
		@sysvar::DisplayConfig_ASG_ElementContentSelection::x12_ElementContentSelection_list_setGet_ElementContent_element4		= 0;
		return;
	}
	if(ElementContentSelection_Data_startPos_setGet < 0)
		ElementContentSelection_Data_startPos_setGet = Array_getFirstElementPos(ElementContentSelection_Data_Validity_setGet, 0);
	
    // 1st element	
	nextPos = ElementContentSelection_Data_startPos_setGet;
	@sysvar::DisplayConfig_ASG_ElementContentSelection::x12_ElementContentSelection_list_setGet_pos_element1				= ElementContentSelection_Data_Pos_setGet				[nextPos];
	@sysvar::DisplayConfig_ASG_ElementContentSelection::x12_ElementContentSelection_list_setGet_Display_element1			= ElementContentSelection_Data_Display_setGet			[nextPos];
	@sysvar::DisplayConfig_ASG_ElementContentSelection::x12_ElementContentSelection_list_setGet_AdditionalInfo_element1		= ElementContentSelection_Data_AdditionalInfo_setGet	[nextPos];
	@sysvar::DisplayConfig_ASG_ElementContentSelection::x12_ElementContentSelection_list_setGet_Element_element1			= ElementContentSelection_Data_Element_setGet			[nextPos];
	@sysvar::DisplayConfig_ASG_ElementContentSelection::x12_ElementContentSelection_list_setGet_ElementContent_element1		= ElementContentSelection_Data_ElementContent_setGet	[nextPos];
  
    // 2nd element
	nextPos = Array_getNextElementPos_withWrap(ElementContentSelection_Data_Validity_setGet, nextPos, 0);
	if(nextPos == -1)
		nextPos = Array_getFirstElementPos(ElementContentSelection_Data_Validity_setGet, 0);
	@sysvar::DisplayConfig_ASG_ElementContentSelection::x12_ElementContentSelection_list_setGet_pos_element2				= ElementContentSelection_Data_Pos_setGet				[nextPos];
	@sysvar::DisplayConfig_ASG_ElementContentSelection::x12_ElementContentSelection_list_setGet_Display_element2			= ElementContentSelection_Data_Display_setGet			[nextPos];
	@sysvar::DisplayConfig_ASG_ElementContentSelection::x12_ElementContentSelection_list_setGet_AdditionalInfo_element2		= ElementContentSelection_Data_AdditionalInfo_setGet	[nextPos];
	@sysvar::DisplayConfig_ASG_ElementContentSelection::x12_ElementContentSelection_list_setGet_Element_element2			= ElementContentSelection_Data_Element_setGet			[nextPos];
	@sysvar::DisplayConfig_ASG_ElementContentSelection::x12_ElementContentSelection_list_setGet_ElementContent_element2		= ElementContentSelection_Data_ElementContent_setGet	[nextPos];
    
    // 3rd element
	nextPos = Array_getNextElementPos_withWrap(ElementContentSelection_Data_Validity_setGet, nextPos, 0);
	if(nextPos == -1)
		nextPos = Array_getFirstElementPos(ElementContentSelection_Data_Validity_setGet, 0);
	@sysvar::DisplayConfig_ASG_ElementContentSelection::x12_ElementContentSelection_list_setGet_pos_element3				= ElementContentSelection_Data_Pos_setGet				[nextPos];
	@sysvar::DisplayConfig_ASG_ElementContentSelection::x12_ElementContentSelection_list_setGet_Display_element3			= ElementContentSelection_Data_Display_setGet			[nextPos];
	@sysvar::DisplayConfig_ASG_ElementContentSelection::x12_ElementContentSelection_list_setGet_AdditionalInfo_element3		= ElementContentSelection_Data_AdditionalInfo_setGet	[nextPos];
	@sysvar::DisplayConfig_ASG_ElementContentSelection::x12_ElementContentSelection_list_setGet_Element_element3			= ElementContentSelection_Data_Element_setGet			[nextPos];
	@sysvar::DisplayConfig_ASG_ElementContentSelection::x12_ElementContentSelection_list_setGet_ElementContent_element3		= ElementContentSelection_Data_ElementContent_setGet	[nextPos];
    
    // 4th element
	nextPos = Array_getNextElementPos_withWrap(ElementContentSelection_Data_Validity_setGet, nextPos, 0);
	if(nextPos == -1)
		nextPos = Array_getFirstElementPos(ElementContentSelection_Data_Validity_setGet, 0);
	@sysvar::DisplayConfig_ASG_ElementContentSelection::x12_ElementContentSelection_list_setGet_pos_element4				= ElementContentSelection_Data_Pos_setGet				[nextPos];
	@sysvar::DisplayConfig_ASG_ElementContentSelection::x12_ElementContentSelection_list_setGet_Display_element4			= ElementContentSelection_Data_Display_setGet			[nextPos];
	@sysvar::DisplayConfig_ASG_ElementContentSelection::x12_ElementContentSelection_list_setGet_AdditionalInfo_element4		= ElementContentSelection_Data_AdditionalInfo_setGet	[nextPos];
	@sysvar::DisplayConfig_ASG_ElementContentSelection::x12_ElementContentSelection_list_setGet_Element_element4			= ElementContentSelection_Data_Element_setGet			[nextPos];
	@sysvar::DisplayConfig_ASG_ElementContentSelection::x12_ElementContentSelection_list_setGet_ElementContent_element4		= ElementContentSelection_Data_ElementContent_setGet	[nextPos];

	// Adapt Panel
    if(tnle>0)
        enableControl("DisplayConfig_ASG_Array_ElementContentSelection", "ElementContentSelection_setGet_Element1", TRUE);
    if(tnle>1)
        enableControl("DisplayConfig_ASG_Array_ElementContentSelection", "ElementContentSelection_setGet_Element2", TRUE);
    if(tnle>2)
        enableControl("DisplayConfig_ASG_Array_ElementContentSelection", "ElementContentSelection_setGet_Element3", TRUE);
    if(tnle>3)
        enableControl("DisplayConfig_ASG_Array_ElementContentSelection", "ElementContentSelection_setGet_Element4", TRUE);
    if(tnle>4)
    {
        enableControl("DisplayConfig_ASG_Array_ElementContentSelection", "Ctrl_ElementContentSelection_setGet_Up",  TRUE);
        enableControl("DisplayConfig_ASG_Array_ElementContentSelection", "Ctrl_ElementContentSelection_setGet_Down", TRUE);
    }
}

DisplayPresets_actualize_sysvar_get ()
{
	int nextPos;
    int tnle;
	int i;
	int first, next;
    tnle = Array_getTNLE(DisplayPresets_Data_Validity_get);
	@sysvar::DisplayConfig_ASG_DisplayPresets::x1B_DisplayPresets_TNLE = tnle;

	// Adapt panel
    enableControl("DisplayConfig_ASG_Array_DisplayPresets", "DisplayPresets_get_Element1", FALSE);
    enableControl("DisplayConfig_ASG_Array_DisplayPresets", "Ctrl_DisplayPresets_get_Up",  FALSE);
    enableControl("DisplayConfig_ASG_Array_DisplayPresets", "Ctrl_DisplayPresets_get_Down", FALSE);
	
	if(tnle == 0)
	{
		@sysvar::DisplayConfig_ASG_DisplayPresets::x1B_DisplayPresets_list_get_pos							= 0;
		@sysvar::DisplayConfig_ASG_DisplayPresets::x1B_DisplayPresets_list_get_state						= 0;
		@sysvar::DisplayConfig_ASG_DisplayPresets::x1B_DisplayPresets_list_get_displayPresetType			= 0;
		@sysvar::DisplayConfig_ASG_DisplayPresets::x1B_DisplayPresets_list_get_displayPresetInstance		= 0;
		@sysvar::DisplayConfig_ASG_DisplayPresets::x1B_DisplayPresets_list_get_Display1MainSelection		= 0;
		@sysvar::DisplayConfig_ASG_DisplayPresets::x1B_DisplayPresets_list_get_Display1AdditionalInfo1_1	= 0;
		@sysvar::DisplayConfig_ASG_DisplayPresets::x1B_DisplayPresets_list_get_Display1AdditionalInfo1_2	= 0;
		@sysvar::DisplayConfig_ASG_DisplayPresets::x1B_DisplayPresets_list_get_Display1AdditionalInfo2_1	= 0;
		@sysvar::DisplayConfig_ASG_DisplayPresets::x1B_DisplayPresets_list_get_Display1AdditionalInfo2_2	= 0;
		@sysvar::DisplayConfig_ASG_DisplayPresets::x1B_DisplayPresets_list_get_Display2MainSelection		= 0;
		@sysvar::DisplayConfig_ASG_DisplayPresets::x1B_DisplayPresets_list_get_Display2AdditionalInfo1_1	= 0;
		@sysvar::DisplayConfig_ASG_DisplayPresets::x1B_DisplayPresets_list_get_Display2AdditionalInfo1_2	= 0;
		@sysvar::DisplayConfig_ASG_DisplayPresets::x1B_DisplayPresets_list_get_Display2AdditionalInfo2_1	= 0;
		@sysvar::DisplayConfig_ASG_DisplayPresets::x1B_DisplayPresets_list_get_Display2AdditionalInfo2_2	= 0;
		@sysvar::DisplayConfig_ASG_DisplayPresets::x1B_DisplayPresets_list_get_Display3MainSelection		= 0;
		@sysvar::DisplayConfig_ASG_DisplayPresets::x1B_DisplayPresets_list_get_Display3AdditionalInfo1_1	= 0;
		@sysvar::DisplayConfig_ASG_DisplayPresets::x1B_DisplayPresets_list_get_Display3AdditionalInfo1_2	= 0;
		@sysvar::DisplayConfig_ASG_DisplayPresets::x1B_DisplayPresets_list_get_Display3AdditionalInfo2_1	= 0;
		@sysvar::DisplayConfig_ASG_DisplayPresets::x1B_DisplayPresets_list_get_Display3AdditionalInfo2_2	= 0;
		return;
	}
	if(DisplayPresets_Data_startPos_get < 0)
		DisplayPresets_Data_startPos_get = Array_getFirstElementPos(DisplayPresets_Data_Validity_get, 0);

	// 1st element	
	nextPos = DisplayPresets_Data_startPos_get;
	@sysvar::DisplayConfig_ASG_DisplayPresets::x1B_DisplayPresets_list_get_pos							= DisplayPresets_Data_Pos_get						[nextPos];
	@sysvar::DisplayConfig_ASG_DisplayPresets::x1B_DisplayPresets_list_get_state						= DisplayPresets_Data_State_get						[nextPos];
	@sysvar::DisplayConfig_ASG_DisplayPresets::x1B_DisplayPresets_list_get_displayPresetType			= DisplayPresets_Data_DisplayPresetType_get			[nextPos];
	@sysvar::DisplayConfig_ASG_DisplayPresets::x1B_DisplayPresets_list_get_displayPresetInstance		= DisplayPresets_Data_DisplayPresetInstance_get		[nextPos];
	@sysvar::DisplayConfig_ASG_DisplayPresets::x1B_DisplayPresets_list_get_Display1MainSelection		= DisplayPresets_Data_Display1MainSelection_get		[nextPos];
	@sysvar::DisplayConfig_ASG_DisplayPresets::x1B_DisplayPresets_list_get_Display1AdditionalInfo1_1	= DisplayPresets_Data_Display1AdditionalInfo1_1_get	[nextPos];
	@sysvar::DisplayConfig_ASG_DisplayPresets::x1B_DisplayPresets_list_get_Display1AdditionalInfo1_2	= DisplayPresets_Data_Display1AdditionalInfo1_2_get	[nextPos];
	@sysvar::DisplayConfig_ASG_DisplayPresets::x1B_DisplayPresets_list_get_Display1AdditionalInfo2_1	= DisplayPresets_Data_Display1AdditionalInfo2_1_get	[nextPos];
	@sysvar::DisplayConfig_ASG_DisplayPresets::x1B_DisplayPresets_list_get_Display1AdditionalInfo2_2	= DisplayPresets_Data_Display1AdditionalInfo2_2_get	[nextPos];
	@sysvar::DisplayConfig_ASG_DisplayPresets::x1B_DisplayPresets_list_get_Display2MainSelection		= DisplayPresets_Data_Display2MainSelection_get		[nextPos];
	@sysvar::DisplayConfig_ASG_DisplayPresets::x1B_DisplayPresets_list_get_Display2AdditionalInfo1_1	= DisplayPresets_Data_Display2AdditionalInfo1_1_get	[nextPos];
	@sysvar::DisplayConfig_ASG_DisplayPresets::x1B_DisplayPresets_list_get_Display2AdditionalInfo1_2	= DisplayPresets_Data_Display2AdditionalInfo1_2_get	[nextPos];
	@sysvar::DisplayConfig_ASG_DisplayPresets::x1B_DisplayPresets_list_get_Display2AdditionalInfo2_1	= DisplayPresets_Data_Display2AdditionalInfo2_1_get	[nextPos];
	@sysvar::DisplayConfig_ASG_DisplayPresets::x1B_DisplayPresets_list_get_Display2AdditionalInfo2_2	= DisplayPresets_Data_Display2AdditionalInfo2_2_get	[nextPos];
	@sysvar::DisplayConfig_ASG_DisplayPresets::x1B_DisplayPresets_list_get_Display3MainSelection		= DisplayPresets_Data_Display3MainSelection_get		[nextPos];
	@sysvar::DisplayConfig_ASG_DisplayPresets::x1B_DisplayPresets_list_get_Display3AdditionalInfo1_1	= DisplayPresets_Data_Display3AdditionalInfo1_1_get	[nextPos];
	@sysvar::DisplayConfig_ASG_DisplayPresets::x1B_DisplayPresets_list_get_Display3AdditionalInfo1_2	= DisplayPresets_Data_Display3AdditionalInfo1_2_get	[nextPos];
	@sysvar::DisplayConfig_ASG_DisplayPresets::x1B_DisplayPresets_list_get_Display3AdditionalInfo2_1	= DisplayPresets_Data_Display3AdditionalInfo2_1_get	[nextPos];
	@sysvar::DisplayConfig_ASG_DisplayPresets::x1B_DisplayPresets_list_get_Display3AdditionalInfo2_2	= DisplayPresets_Data_Display3AdditionalInfo2_2_get	[nextPos];
	
	// Adapt panel
    if(tnle>0)
        enableControl("DisplayConfig_ASG_Array_DisplayPresets", "DisplayPresets_get_Element1", TRUE);
    if(tnle>1)
    {
        enableControl("DisplayConfig_ASG_Array_DisplayPresets", "Ctrl_DisplayPresets_get_Up",  TRUE);
        enableControl("DisplayConfig_ASG_Array_DisplayPresets", "Ctrl_DisplayPresets_get_Down", TRUE);
    }
}

DisplayPresets_actualize_sysvar_setGet ()
{
	int nextPos;
    int tnle;
	int i;
	int first, next;
    tnle = Array_getTNLE(DisplayPresets_Data_Validity_setGet);

	// Adapt panel
    enableControl("DisplayConfig_ASG_Array_DisplayPresets", "DisplayPresets_setGet_Element1", FALSE);
    enableControl("DisplayConfig_ASG_Array_DisplayPresets", "Ctrl_DisplayPresets_setGet_Up",  FALSE);
    enableControl("DisplayConfig_ASG_Array_DisplayPresets", "Ctrl_DisplayPresets_setGet_Down", FALSE);
	
	if(tnle == 0)
	{
		@sysvar::DisplayConfig_ASG_DisplayPresets::x1B_DisplayPresets_list_setGet_pos						= 0;
		@sysvar::DisplayConfig_ASG_DisplayPresets::x1B_DisplayPresets_list_setGet_state						= 0;
		@sysvar::DisplayConfig_ASG_DisplayPresets::x1B_DisplayPresets_list_setGet_displayPresetType			= 0;
		@sysvar::DisplayConfig_ASG_DisplayPresets::x1B_DisplayPresets_list_setGet_displayPresetInstance		= 0;
		@sysvar::DisplayConfig_ASG_DisplayPresets::x1B_DisplayPresets_list_setGet_Display1MainSelection		= 0;
		@sysvar::DisplayConfig_ASG_DisplayPresets::x1B_DisplayPresets_list_setGet_Display1AdditionalInfo1_1	= 0;
		@sysvar::DisplayConfig_ASG_DisplayPresets::x1B_DisplayPresets_list_setGet_Display1AdditionalInfo1_2	= 0;
		@sysvar::DisplayConfig_ASG_DisplayPresets::x1B_DisplayPresets_list_setGet_Display1AdditionalInfo2_1	= 0;
		@sysvar::DisplayConfig_ASG_DisplayPresets::x1B_DisplayPresets_list_setGet_Display1AdditionalInfo2_2	= 0;
		@sysvar::DisplayConfig_ASG_DisplayPresets::x1B_DisplayPresets_list_setGet_Display2MainSelection		= 0;
		@sysvar::DisplayConfig_ASG_DisplayPresets::x1B_DisplayPresets_list_setGet_Display2AdditionalInfo1_1	= 0;
		@sysvar::DisplayConfig_ASG_DisplayPresets::x1B_DisplayPresets_list_setGet_Display2AdditionalInfo1_2	= 0;
		@sysvar::DisplayConfig_ASG_DisplayPresets::x1B_DisplayPresets_list_setGet_Display2AdditionalInfo2_1	= 0;
		@sysvar::DisplayConfig_ASG_DisplayPresets::x1B_DisplayPresets_list_setGet_Display2AdditionalInfo2_2	= 0;
		@sysvar::DisplayConfig_ASG_DisplayPresets::x1B_DisplayPresets_list_setGet_Display3MainSelection		= 0;
		@sysvar::DisplayConfig_ASG_DisplayPresets::x1B_DisplayPresets_list_setGet_Display3AdditionalInfo1_1	= 0;
		@sysvar::DisplayConfig_ASG_DisplayPresets::x1B_DisplayPresets_list_setGet_Display3AdditionalInfo1_2	= 0;
		@sysvar::DisplayConfig_ASG_DisplayPresets::x1B_DisplayPresets_list_setGet_Display3AdditionalInfo2_1	= 0;
		@sysvar::DisplayConfig_ASG_DisplayPresets::x1B_DisplayPresets_list_setGet_Display3AdditionalInfo2_2	= 0;
		
		return;
	}
	if(DisplayPresets_Data_startPos_setGet < 0)
		DisplayPresets_Data_startPos_setGet = Array_getFirstElementPos(DisplayPresets_Data_Validity_setGet, 0);
    
	// 1st element	
	nextPos = DisplayPresets_Data_startPos_setGet;
	@sysvar::DisplayConfig_ASG_DisplayPresets::x1B_DisplayPresets_list_setGet_pos						= DisplayPresets_Data_Pos_setGet						[nextPos];
	@sysvar::DisplayConfig_ASG_DisplayPresets::x1B_DisplayPresets_list_setGet_state						= DisplayPresets_Data_State_setGet						[nextPos];
	@sysvar::DisplayConfig_ASG_DisplayPresets::x1B_DisplayPresets_list_setGet_displayPresetType			= DisplayPresets_Data_DisplayPresetType_setGet			[nextPos];
	@sysvar::DisplayConfig_ASG_DisplayPresets::x1B_DisplayPresets_list_setGet_displayPresetInstance		= DisplayPresets_Data_DisplayPresetInstance_setGet		[nextPos];
	@sysvar::DisplayConfig_ASG_DisplayPresets::x1B_DisplayPresets_list_setGet_Display1MainSelection		= DisplayPresets_Data_Display1MainSelection_setGet		[nextPos];
	@sysvar::DisplayConfig_ASG_DisplayPresets::x1B_DisplayPresets_list_setGet_Display1AdditionalInfo1_1	= DisplayPresets_Data_Display1AdditionalInfo1_1_setGet	[nextPos];
	@sysvar::DisplayConfig_ASG_DisplayPresets::x1B_DisplayPresets_list_setGet_Display1AdditionalInfo1_2	= DisplayPresets_Data_Display1AdditionalInfo1_2_setGet	[nextPos];
	@sysvar::DisplayConfig_ASG_DisplayPresets::x1B_DisplayPresets_list_setGet_Display1AdditionalInfo2_1	= DisplayPresets_Data_Display1AdditionalInfo2_1_setGet	[nextPos];
	@sysvar::DisplayConfig_ASG_DisplayPresets::x1B_DisplayPresets_list_setGet_Display1AdditionalInfo2_2	= DisplayPresets_Data_Display1AdditionalInfo2_2_setGet	[nextPos];
	@sysvar::DisplayConfig_ASG_DisplayPresets::x1B_DisplayPresets_list_setGet_Display2MainSelection		= DisplayPresets_Data_Display2MainSelection_setGet		[nextPos];
	@sysvar::DisplayConfig_ASG_DisplayPresets::x1B_DisplayPresets_list_setGet_Display2AdditionalInfo1_1	= DisplayPresets_Data_Display2AdditionalInfo1_1_setGet	[nextPos];
	@sysvar::DisplayConfig_ASG_DisplayPresets::x1B_DisplayPresets_list_setGet_Display2AdditionalInfo1_2	= DisplayPresets_Data_Display2AdditionalInfo1_2_setGet	[nextPos];
	@sysvar::DisplayConfig_ASG_DisplayPresets::x1B_DisplayPresets_list_setGet_Display2AdditionalInfo2_1	= DisplayPresets_Data_Display2AdditionalInfo2_1_setGet	[nextPos];
	@sysvar::DisplayConfig_ASG_DisplayPresets::x1B_DisplayPresets_list_setGet_Display2AdditionalInfo2_2	= DisplayPresets_Data_Display2AdditionalInfo2_2_setGet	[nextPos];
	@sysvar::DisplayConfig_ASG_DisplayPresets::x1B_DisplayPresets_list_setGet_Display3MainSelection		= DisplayPresets_Data_Display3MainSelection_setGet		[nextPos];
	@sysvar::DisplayConfig_ASG_DisplayPresets::x1B_DisplayPresets_list_setGet_Display3AdditionalInfo1_1	= DisplayPresets_Data_Display3AdditionalInfo1_1_setGet	[nextPos];
	@sysvar::DisplayConfig_ASG_DisplayPresets::x1B_DisplayPresets_list_setGet_Display3AdditionalInfo1_2	= DisplayPresets_Data_Display3AdditionalInfo1_2_setGet	[nextPos];
	@sysvar::DisplayConfig_ASG_DisplayPresets::x1B_DisplayPresets_list_setGet_Display3AdditionalInfo2_1	= DisplayPresets_Data_Display3AdditionalInfo2_1_setGet	[nextPos];
	@sysvar::DisplayConfig_ASG_DisplayPresets::x1B_DisplayPresets_list_setGet_Display3AdditionalInfo2_2	= DisplayPresets_Data_Display3AdditionalInfo2_2_setGet	[nextPos];
	
	// Adapt panel
    if(tnle>0)
        enableControl("DisplayConfig_ASG_Array_DisplayPresets", "DisplayPresets_setGet_Element1", TRUE);
    if(tnle>1)
    {
        enableControl("DisplayConfig_ASG_Array_DisplayPresets", "Ctrl_DisplayPresets_setGet_Up",  TRUE);
        enableControl("DisplayConfig_ASG_Array_DisplayPresets", "Ctrl_DisplayPresets_setGet_Down", TRUE);
    }
}

on sysvar sysvar::DisplayConfig_ASG_ElementContentSelection::x12_ElementContentSelection_control_get_down
{
    if(@this)
    {
        ElementContentSelection_Data_startPos_get = Array_getNextElementPos_withWrap(ElementContentSelection_Data_Validity_get, ElementContentSelection_Data_startPos_get, 1);
        ElementContentSelection_actualize_sysvar_get();
    }
}

on sysvar sysvar::DisplayConfig_ASG_ElementContentSelection::x12_ElementContentSelection_control_setGet_down
{
    if(@this)
    {
        ElementContentSelection_Data_startPos_setGet = Array_getNextElementPos_withWrap(ElementContentSelection_Data_Validity_setGet, ElementContentSelection_Data_startPos_setGet, 1);
        ElementContentSelection_actualize_sysvar_setGet();
    }
}

on sysvar sysvar::DisplayConfig_ASG_ElementContentSelection::x12_ElementContentSelection_control_get_up
{
    if(@this)
    {
        ElementContentSelection_Data_startPos_get = Array_getNextElementPos_withWrap(ElementContentSelection_Data_Validity_get, ElementContentSelection_Data_startPos_get, 0);
        ElementContentSelection_actualize_sysvar_get();
    }
}

on sysvar sysvar::DisplayConfig_ASG_ElementContentSelection::x12_ElementContentSelection_control_setGet_up
{
    if(@this)
    {
        ElementContentSelection_Data_startPos_setGet = Array_getNextElementPos_withWrap(ElementContentSelection_Data_Validity_setGet, ElementContentSelection_Data_startPos_setGet, 0);
        ElementContentSelection_actualize_sysvar_setGet();
    }
}

on sysvar sysvar::DisplayConfig_ASG_DisplayPresets::x1B_DisplayPresets_control_get_down
{
    if(@this)
    {
        DisplayPresets_Data_startPos_get = Array_getNextElementPos_withWrap(DisplayPresets_Data_Validity_get, DisplayPresets_Data_startPos_get, 1);
		DisplayPresets_actualize_sysvar_get();
    }
}

on sysvar sysvar::DisplayConfig_ASG_DisplayPresets::x1B_DisplayPresets_control_setGet_down
{
    if(@this)
    {
        DisplayPresets_Data_startPos_setGet = Array_getNextElementPos_withWrap(DisplayPresets_Data_Validity_setGet, DisplayPresets_Data_startPos_setGet, 1);
        DisplayPresets_actualize_sysvar_setGet();
    }
}

on sysvar sysvar::DisplayConfig_ASG_DisplayPresets::x1B_DisplayPresets_control_get_up
{
    if(@this)
    {
        DisplayPresets_Data_startPos_get = Array_getNextElementPos_withWrap(DisplayPresets_Data_Validity_get, DisplayPresets_Data_startPos_get, 0);
		DisplayPresets_actualize_sysvar_get();
    }
}

on sysvar sysvar::DisplayConfig_ASG_DisplayPresets::x1B_DisplayPresets_control_setGet_up
{
    if(@this)
    {
        DisplayPresets_Data_startPos_setGet = Array_getNextElementPos_withWrap(DisplayPresets_Data_Validity_setGet, DisplayPresets_Data_startPos_setGet, 0);
        DisplayPresets_actualize_sysvar_setGet();
    }
}

on sysvar sysvar::DisplayConfig_ASG_ElementContentSelection::x12_ElementContentSelection_control_clearAll
{
    if(@this)
        ElementContentSelection_clearData_setGet();
}

on sysvar sysvar::DisplayConfig_ASG_ElementContentSelection::x12_ElementContentSelection_control_default_external
{
	if(@this)
        ElementContentSelection_init_CSV_setGet();
    else
        ElementContentSelection_init_static_setGet();
}

on sysvar sysvar::DisplayConfig_ASG_DisplayPresets::x1B_DisplayPresets_control_clearAll
{
    if(@this)
        DisplayPresets_clearData_setGet();
}

on sysvar sysvar::DisplayConfig_ASG_DisplayPresets::x1B_DisplayPresets_control_default_external
{
	if(@this)
        DisplayPresets_init_CSV_setGet();
    else
        DisplayPresets_init_static_setGet();
}

on sysvar sysvar::DisplayConfig_ASG::x03_FctList_get
{
    if(@this)
        Request_0x03_FunctionList(DataGet_REQ_CAN);
}

on sysvar sysvar::DisplayConfig_ASG::x04_HeartBeat_HeartBeatTime_get
{
    if(@this)
		Request_0x04_HeartBeat(DataGet_REQ_CAN);
}

on sysvar sysvar::DisplayConfig_ASG::x0D_FSG_Control_get
{
    if(@this)
		Request_0x0D_FSG_Control(DataGet_REQ_CAN);
}

on sysvar sysvar::DisplayConfig_ASG::x0D_FSG_Control_setGet
{
    if(@this)
		Request_0x0D_FSG_Control(DataSetGet_REQ);
}

on sysvar sysvar::DisplayConfig_ASG::x0E_FSG_Setup_get
{
    if(@this)
		Request_0x0E_FSG_Setup(DataGet_REQ_CAN);
}

on sysvar sysvar::DisplayConfig_ASG::x0F_FSG_OperationState_get
{
    if(@this)
		Request_0x0F_FSG_OperationState(DataGet_REQ_CAN);
}
on sysvar sysvar::DisplayConfig_ASG_Prop::x10_Brightness_get
{
    if(@this)
		Request_0x10_Brightness(DataGet_REQ_CAN);
}
on sysvar sysvar::DisplayConfig_ASG_Prop::x10_Brightness_setGet
{
    if(@this)
		Request_0x10_Brightness(DataSetGet_REQ);
}
on sysvar sysvar::DisplayConfig_ASG_Prop::x11_Volume_get
{
    if(@this)
		Request_0x11_Volume(DataGet_REQ_CAN);
}
on sysvar sysvar::DisplayConfig_ASG_Prop::x11_Volume_setGet
{
    if(@this)
		Request_0x11_Volume(DataSetGet_REQ);
}
on sysvar sysvar::DisplayConfig_ASG_Prop_Display1::x13_Display1Setup_get
{
    if(@this)
		Request_0x13_Display1Setup(DataGet_REQ_CAN);
}
on sysvar sysvar::DisplayConfig_ASG_Prop_Display1::x14_Display1MainSelection_get
{
    if(@this)
		Request_0x14_Display1MainSelection(DataGet_REQ_CAN);
}
on sysvar sysvar::DisplayConfig_ASG_Prop_Display1::x14_Display1MainSelection_setGet
{
    if(@this)
		Request_0x14_Display1MainSelection(DataSetGet_REQ);
}
on sysvar sysvar::DisplayConfig_ASG_Prop_Display2::x15_Display2Setup_get
{
    if(@this)
		Request_0x15_Display2Setup(DataGet_REQ_CAN);
}
on sysvar sysvar::DisplayConfig_ASG_Prop_Display2::x16_Display2MainSelection_get
{
    if(@this)
		Request_0x16_Display2MainSelection(DataGet_REQ_CAN);
}
on sysvar sysvar::DisplayConfig_ASG_Prop_Display2::x16_Display2MainSelection_setGet
{
    if(@this)
		Request_0x16_Display2MainSelection(DataSetGet_REQ);
}
on sysvar sysvar::DisplayConfig_ASG_Prop_Display3::x17_Display3Setup_get
{
    if(@this)
		Request_0x17_Display3Setup(DataGet_REQ_CAN);
}
on sysvar sysvar::DisplayConfig_ASG_Prop_Display3::x18_Display3MainSelection_get
{
    if(@this)
		Request_0x18_Display3MainSelection(DataGet_REQ_CAN);
}
on sysvar sysvar::DisplayConfig_ASG_Prop_Display3::x18_Display3MainSelection_setGet
{
    if(@this)
		Request_0x18_Display3MainSelection(DataSetGet_REQ);
}

on sysvar sysvar::DisplayConfig_ASG_Prop_AdditionalInstrument::x19_AdditionalInstrument_get
{
    if(@this)
		Request_0x19_AdditionalInstrument(DataGet_REQ_CAN);
}
on sysvar sysvar::DisplayConfig_ASG_Prop_AdditionalInstrument::x19_AdditionalInstrument_setGet
{
    if(@this)
		Request_0x19_AdditionalInstrument(DataSetGet_REQ);
}
on sysvar sysvar::DisplayConfig_ASG_Prop::x1C_DisplayDependency_get
{
    if(@this)
		Request_0x1C_DisplayDependency(DataGet_REQ_CAN);
}
on sysvar sysvar::DisplayConfig_ASG_Prop::x1C_DisplayDependency_setGet
{
    if(@this)
		Request_0x1C_DisplayDependency(DataSetGet_REQ);
}
on sysvar sysvar::DisplayConfig_ASG_Prop::x1D_ActiveDisplayPreset_get
{
    if(@this)
		Request_0x1D_ActiveDisplayPreset(DataGet_REQ_CAN);
}
on sysvar sysvar::DisplayConfig_ASG_Prop::x1D_ActiveDisplayPreset_setGet
{
    if(@this)
		Request_0x1D_ActiveDisplayPreset(DataSetGet_REQ);
}
on sysvar sysvar::DisplayConfig_ASG_Prop::x1E_DisplayViewConfiguration_get
{
    if(@this)
		Request_0x1E_DisplayViewConfiguration(DataGet_REQ_CAN);
}
on sysvar sysvar::DisplayConfig_ASG_Prop::x1E_DisplayViewConfiguration_setGet
{
    if(@this)
		Request_0x1E_DisplayViewConfiguration(DataSetGet_REQ);
}
on sysvar sysvar::DisplayConfig_ASG_Prop::x1F_LED_Configuration_get
{
    if(@this)
		Request_0x1F_LED_Configuration(DataGet_REQ_CAN);
}
on sysvar sysvar::DisplayConfig_ASG_Prop::x1F_LED_Configuration_setGet
{
    if(@this)
		Request_0x1F_LED_Configuration(DataSetGet_REQ);
}


on sysvar sysvar::DisplayConfig_ASG_ElementContentSelection::x12_ElementContentSelection_control_GetArray
{
    if(@this)
    {
        Request_0x12_ElementContentSelection_get();

        if(@sysvar::DisplayConfig_General::Smart)
        {
            if(@sysvar::DisplayConfig_ASG_ElementContentSelection::x12_ElementContentSelection_TAID_hex >= 0xF)
                @sysvar::DisplayConfig_ASG_ElementContentSelection::x12_ElementContentSelection_TAID_hex = 1;
            else
                @sysvar::DisplayConfig_ASG_ElementContentSelection::x12_ElementContentSelection_TAID_hex = (@sysvar::DisplayConfig_ASG_ElementContentSelection::x12_ElementContentSelection_TAID_hex + 1);
        }
    }
}

on sysvar sysvar::DisplayConfig_ASG_DisplayPresets::x1B_DisplayPresets_control_GetArray
{
    if(@this)
    {
        Request_0x1B_DisplayPresets_get();

        if(@sysvar::DisplayConfig_General::Smart)
        {
            if(@sysvar::DisplayConfig_ASG_DisplayPresets::x1B_DisplayPresets_TAID_hex >= 0xF)
                @sysvar::DisplayConfig_ASG_DisplayPresets::x1B_DisplayPresets_TAID_hex = 1;
            else
                @sysvar::DisplayConfig_ASG_DisplayPresets::x1B_DisplayPresets_TAID_hex = (@sysvar::DisplayConfig_ASG_DisplayPresets::x1B_DisplayPresets_TAID_hex + 1);
        }
    }
}

on sysvar sysvar::DisplayConfig_ASG_ElementContentSelection::x12_ElementContentSelection_control_SetGetArray
{
	if(@this)
	{
        Request_0x12_ElementContentSelection_setGet ();
	    
		if(@sysvar::DisplayConfig_General::Smart)
        {
            if(@sysvar::DisplayConfig_ASG_ElementContentSelection::x12_ElementContentSelection_TAID_hex >= 0xF)
                @sysvar::DisplayConfig_ASG_ElementContentSelection::x12_ElementContentSelection_TAID_hex = 1;
            else
                @sysvar::DisplayConfig_ASG_ElementContentSelection::x12_ElementContentSelection_TAID_hex = (@sysvar::DisplayConfig_ASG_ElementContentSelection::x12_ElementContentSelection_TAID_hex + 1);
        }
    }
}

on sysvar sysvar::DisplayConfig_ASG_DisplayPresets::x1B_DisplayPresets_control_SetGetArray
{
	if(@this)
	{
        Request_0x1B_DisplayPresets_setGet ();
		
		if(@sysvar::DisplayConfig_General::Smart)
        {
            if(@sysvar::DisplayConfig_ASG_DisplayPresets::x1B_DisplayPresets_TAID_hex >= 0xF)
                @sysvar::DisplayConfig_ASG_DisplayPresets::x1B_DisplayPresets_TAID_hex = 1;
            else
                @sysvar::DisplayConfig_ASG_DisplayPresets::x1B_DisplayPresets_TAID_hex = (@sysvar::DisplayConfig_ASG_DisplayPresets::x1B_DisplayPresets_TAID_hex + 1);
        }
	}
}

byte createData_0x0D_FSG_Control()
{
	int temp;
	temp = @sysvar::DisplayConfig_ASG::x0D_FSG_Control_Controlcode_Bit0;
	return temp;
}

void createData_0x10_Brightness (byte buffer[])
{
	int idx;
	byte byteBuffer;

    for(idx=0; idx<elCount(buffer); idx++)
        buffer[idx] = 0;
	
	buffer[0]   = @sysvar::DisplayConfig_ASG_Prop::x10_Brightness_Setup;
	byteBuffer  = 0x00;
	byteBuffer |= (@sysvar::DisplayConfig_ASG_Prop::x10_Brightness_Reserve1 << 4) & 0xF0;
	byteBuffer |= (@sysvar::DisplayConfig_ASG_Prop::x10_Brightness_Reserve2 << 0) & 0x0F;
	buffer[1]   = byteBuffer;
}

void createData_0x11_Volume (byte buffer[])
{
	int idx;
	byte byteBuffer;

    for(idx=0; idx<elCount(buffer); idx++)
        buffer[idx] = 0;
	
	buffer[0]   = @sysvar::DisplayConfig_ASG_Prop::x11_Volume_Setup;
	byteBuffer  = 0x00;
	byteBuffer |= (@sysvar::DisplayConfig_ASG_Prop::x11_Volume_Reserve1 << 4) & 0xF0;
	byteBuffer |= (@sysvar::DisplayConfig_ASG_Prop::x11_Volume_Reserve2 << 0) & 0x0F;
	buffer[1]   = byteBuffer;
}

createData_0x16_Display2MainSelection (byte buffer[])
{
    int idx;
	byte byteBuffer;

    for(idx=0; idx<elCount(buffer); idx++)
        buffer[idx] = 0;
	
	// byte[0]
	byteBuffer = 0;
	byteBuffer |= (@sysvar::DisplayConfig_ASG_Prop_Display2::DisplayMainSelection_MainSelection_Bit00 << 0);
	byteBuffer |= (@sysvar::DisplayConfig_ASG_Prop_Display2::DisplayMainSelection_MainSelection_Bit01 << 1);
	byteBuffer |= (@sysvar::DisplayConfig_ASG_Prop_Display2::DisplayMainSelection_MainSelection_Bit02 << 2);
	byteBuffer |= (@sysvar::DisplayConfig_ASG_Prop_Display2::DisplayMainSelection_MainSelection_Bit03 << 3);
	byteBuffer |= (@sysvar::DisplayConfig_ASG_Prop_Display2::DisplayMainSelection_MainSelection_Bit04 << 4);
	byteBuffer |= (@sysvar::DisplayConfig_ASG_Prop_Display2::DisplayMainSelection_MainSelection_Bit05 << 5);
	byteBuffer |= (@sysvar::DisplayConfig_ASG_Prop_Display2::DisplayMainSelection_MainSelection_Bit06 << 6);
	byteBuffer |= (@sysvar::DisplayConfig_ASG_Prop_Display2::DisplayMainSelection_MainSelection_Bit07 << 7);
	buffer[0] = byteBuffer;
	// byte[1]
	byteBuffer = 0;
	byteBuffer |= (@sysvar::DisplayConfig_ASG_Prop_Display2::DisplayMainSelection_MainSelection_Bit08 << 0);
	byteBuffer |= (@sysvar::DisplayConfig_ASG_Prop_Display2::DisplayMainSelection_MainSelection_Bit09 << 1);
	byteBuffer |= (@sysvar::DisplayConfig_ASG_Prop_Display2::DisplayMainSelection_MainSelection_Bit10 << 2);
	byteBuffer |= (@sysvar::DisplayConfig_ASG_Prop_Display2::DisplayMainSelection_MainSelection_Bit11 << 3);
	byteBuffer |= (@sysvar::DisplayConfig_ASG_Prop_Display2::DisplayMainSelection_MainSelection_Bit12 << 4);
	byteBuffer |= (@sysvar::DisplayConfig_ASG_Prop_Display2::DisplayMainSelection_MainSelection_Bit13 << 5);
	byteBuffer |= (@sysvar::DisplayConfig_ASG_Prop_Display2::DisplayMainSelection_MainSelection_Bit14 << 6);
	byteBuffer |= (@sysvar::DisplayConfig_ASG_Prop_Display2::DisplayMainSelection_MainSelection_Bit15 << 7);
	buffer[1] = byteBuffer;
	// byte[2]
	byteBuffer = 0;
	byteBuffer |= (@sysvar::DisplayConfig_ASG_Prop_Display2::DisplayMainSelection_MainSelection_Bit16 << 0);
	byteBuffer |= (@sysvar::DisplayConfig_ASG_Prop_Display2::DisplayMainSelection_MainSelection_Bit17 << 1);
	byteBuffer |= (@sysvar::DisplayConfig_ASG_Prop_Display2::DisplayMainSelection_MainSelection_Bit18 << 2);
	byteBuffer |= (@sysvar::DisplayConfig_ASG_Prop_Display2::DisplayMainSelection_MainSelection_Bit19 << 3);
	byteBuffer |= (@sysvar::DisplayConfig_ASG_Prop_Display2::DisplayMainSelection_MainSelection_Bit20 << 4);
	byteBuffer |= (@sysvar::DisplayConfig_ASG_Prop_Display2::DisplayMainSelection_MainSelection_Bit21 << 5);
	byteBuffer |= (@sysvar::DisplayConfig_ASG_Prop_Display2::DisplayMainSelection_MainSelection_Bit22 << 6);
	byteBuffer |= (@sysvar::DisplayConfig_ASG_Prop_Display2::DisplayMainSelection_MainSelection_Bit23 << 7);
	buffer[2] = byteBuffer;
	// byte[3]
	byteBuffer = 0;
	byteBuffer |= (@sysvar::DisplayConfig_ASG_Prop_Display2::DisplayMainSelection_MainSelection_Bit24 << 0);
	byteBuffer |= (@sysvar::DisplayConfig_ASG_Prop_Display2::DisplayMainSelection_MainSelection_Bit25 << 1);
	byteBuffer |= (@sysvar::DisplayConfig_ASG_Prop_Display2::DisplayMainSelection_MainSelection_Bit26 << 2);
	byteBuffer |= (@sysvar::DisplayConfig_ASG_Prop_Display2::DisplayMainSelection_MainSelection_Bit27 << 3);
	byteBuffer |= (@sysvar::DisplayConfig_ASG_Prop_Display2::DisplayMainSelection_MainSelection_Bit28 << 4);
	buffer[3] = byteBuffer;
	// byte[4]
	byteBuffer = 0;
	byteBuffer |= (@sysvar::DisplayConfig_ASG_Prop_Display2::DisplayMainSelection_Extension1 << 4);
	byteBuffer |= (@sysvar::DisplayConfig_ASG_Prop_Display2::DisplayMainSelection_Extension2 << 0);
	buffer[4] = byteBuffer;
}

createData_0x14_Display1MainSelection (byte buffer[])
{
    int idx;
	byte byteBuffer;

    for(idx=0; idx<elCount(buffer); idx++)
        buffer[idx] = 0;
	
	// byte[0]
	byteBuffer = 0;
	byteBuffer |= (@sysvar::DisplayConfig_ASG_Prop_Display1::DisplayMainSelection_MainSelection_Bit00 << 0);
	byteBuffer |= (@sysvar::DisplayConfig_ASG_Prop_Display1::DisplayMainSelection_MainSelection_Bit01 << 1);
	byteBuffer |= (@sysvar::DisplayConfig_ASG_Prop_Display1::DisplayMainSelection_MainSelection_Bit02 << 2);
	byteBuffer |= (@sysvar::DisplayConfig_ASG_Prop_Display1::DisplayMainSelection_MainSelection_Bit03 << 3);
	byteBuffer |= (@sysvar::DisplayConfig_ASG_Prop_Display1::DisplayMainSelection_MainSelection_Bit04 << 4);
	byteBuffer |= (@sysvar::DisplayConfig_ASG_Prop_Display1::DisplayMainSelection_MainSelection_Bit05 << 5);
	byteBuffer |= (@sysvar::DisplayConfig_ASG_Prop_Display1::DisplayMainSelection_MainSelection_Bit06 << 6);
	byteBuffer |= (@sysvar::DisplayConfig_ASG_Prop_Display1::DisplayMainSelection_MainSelection_Bit07 << 7);
	buffer[0] = byteBuffer;
	// byte[1]
	byteBuffer = 0;
	byteBuffer |= (@sysvar::DisplayConfig_ASG_Prop_Display1::DisplayMainSelection_MainSelection_Bit08 << 0);
	byteBuffer |= (@sysvar::DisplayConfig_ASG_Prop_Display1::DisplayMainSelection_MainSelection_Bit09 << 1);
	byteBuffer |= (@sysvar::DisplayConfig_ASG_Prop_Display1::DisplayMainSelection_MainSelection_Bit10 << 2);
	byteBuffer |= (@sysvar::DisplayConfig_ASG_Prop_Display1::DisplayMainSelection_MainSelection_Bit11 << 3);
	byteBuffer |= (@sysvar::DisplayConfig_ASG_Prop_Display1::DisplayMainSelection_MainSelection_Bit12 << 4);
	byteBuffer |= (@sysvar::DisplayConfig_ASG_Prop_Display1::DisplayMainSelection_MainSelection_Bit13 << 5);
	byteBuffer |= (@sysvar::DisplayConfig_ASG_Prop_Display1::DisplayMainSelection_MainSelection_Bit14 << 6);
	byteBuffer |= (@sysvar::DisplayConfig_ASG_Prop_Display1::DisplayMainSelection_MainSelection_Bit15 << 7);
	buffer[1] = byteBuffer;
	// byte[2]
	byteBuffer = 0;
	byteBuffer |= (@sysvar::DisplayConfig_ASG_Prop_Display1::DisplayMainSelection_MainSelection_Bit16 << 0);
	byteBuffer |= (@sysvar::DisplayConfig_ASG_Prop_Display1::DisplayMainSelection_MainSelection_Bit17 << 1);
	byteBuffer |= (@sysvar::DisplayConfig_ASG_Prop_Display1::DisplayMainSelection_MainSelection_Bit18 << 2);
	byteBuffer |= (@sysvar::DisplayConfig_ASG_Prop_Display1::DisplayMainSelection_MainSelection_Bit19 << 3);
	byteBuffer |= (@sysvar::DisplayConfig_ASG_Prop_Display1::DisplayMainSelection_MainSelection_Bit20 << 4);
	byteBuffer |= (@sysvar::DisplayConfig_ASG_Prop_Display1::DisplayMainSelection_MainSelection_Bit21 << 5);
	byteBuffer |= (@sysvar::DisplayConfig_ASG_Prop_Display1::DisplayMainSelection_MainSelection_Bit22 << 6);
	byteBuffer |= (@sysvar::DisplayConfig_ASG_Prop_Display1::DisplayMainSelection_MainSelection_Bit23 << 7);
	buffer[2] = byteBuffer;
	// byte[3]
	byteBuffer = 0;
	byteBuffer |= (@sysvar::DisplayConfig_ASG_Prop_Display1::DisplayMainSelection_MainSelection_Bit24 << 0);
	byteBuffer |= (@sysvar::DisplayConfig_ASG_Prop_Display1::DisplayMainSelection_MainSelection_Bit25 << 1);
	byteBuffer |= (@sysvar::DisplayConfig_ASG_Prop_Display1::DisplayMainSelection_MainSelection_Bit26 << 2);
	byteBuffer |= (@sysvar::DisplayConfig_ASG_Prop_Display1::DisplayMainSelection_MainSelection_Bit27 << 3);
	byteBuffer |= (@sysvar::DisplayConfig_ASG_Prop_Display1::DisplayMainSelection_MainSelection_Bit28 << 4);
	buffer[3] = byteBuffer;
	// byte[4]
	byteBuffer = 0;
	byteBuffer |= (@sysvar::DisplayConfig_ASG_Prop_Display1::DisplayMainSelection_Extension1 << 4);
	byteBuffer |= (@sysvar::DisplayConfig_ASG_Prop_Display1::DisplayMainSelection_Extension2 << 0);
	buffer[4] = byteBuffer;
}

createData_0x18_Display3MainSelection (byte buffer[])
{
    int idx;
	byte byteBuffer;

    for(idx=0; idx<elCount(buffer); idx++)
        buffer[idx] = 0;
	
	// byte[0]
	byteBuffer = 0;
	byteBuffer |= (@sysvar::DisplayConfig_ASG_Prop_Display3::DisplayMainSelection_MainSelection_Bit00 << 0);
	byteBuffer |= (@sysvar::DisplayConfig_ASG_Prop_Display3::DisplayMainSelection_MainSelection_Bit01 << 1);
	byteBuffer |= (@sysvar::DisplayConfig_ASG_Prop_Display3::DisplayMainSelection_MainSelection_Bit02 << 2);
	byteBuffer |= (@sysvar::DisplayConfig_ASG_Prop_Display3::DisplayMainSelection_MainSelection_Bit03 << 3);
	byteBuffer |= (@sysvar::DisplayConfig_ASG_Prop_Display3::DisplayMainSelection_MainSelection_Bit04 << 4);
	byteBuffer |= (@sysvar::DisplayConfig_ASG_Prop_Display3::DisplayMainSelection_MainSelection_Bit05 << 5);
	byteBuffer |= (@sysvar::DisplayConfig_ASG_Prop_Display3::DisplayMainSelection_MainSelection_Bit06 << 6);
	byteBuffer |= (@sysvar::DisplayConfig_ASG_Prop_Display3::DisplayMainSelection_MainSelection_Bit07 << 7);
	buffer[0] = byteBuffer;
	// byte[1]
	byteBuffer = 0;
	byteBuffer |= (@sysvar::DisplayConfig_ASG_Prop_Display3::DisplayMainSelection_MainSelection_Bit08 << 0);
	byteBuffer |= (@sysvar::DisplayConfig_ASG_Prop_Display3::DisplayMainSelection_MainSelection_Bit09 << 1);
	byteBuffer |= (@sysvar::DisplayConfig_ASG_Prop_Display3::DisplayMainSelection_MainSelection_Bit10 << 2);
	byteBuffer |= (@sysvar::DisplayConfig_ASG_Prop_Display3::DisplayMainSelection_MainSelection_Bit11 << 3);
	byteBuffer |= (@sysvar::DisplayConfig_ASG_Prop_Display3::DisplayMainSelection_MainSelection_Bit12 << 4);
	byteBuffer |= (@sysvar::DisplayConfig_ASG_Prop_Display3::DisplayMainSelection_MainSelection_Bit13 << 5);
	byteBuffer |= (@sysvar::DisplayConfig_ASG_Prop_Display3::DisplayMainSelection_MainSelection_Bit14 << 6);
	byteBuffer |= (@sysvar::DisplayConfig_ASG_Prop_Display3::DisplayMainSelection_MainSelection_Bit15 << 7);
	buffer[1] = byteBuffer;
	// byte[2]
	byteBuffer = 0;
	byteBuffer |= (@sysvar::DisplayConfig_ASG_Prop_Display3::DisplayMainSelection_MainSelection_Bit16 << 0);
	byteBuffer |= (@sysvar::DisplayConfig_ASG_Prop_Display3::DisplayMainSelection_MainSelection_Bit17 << 1);
	byteBuffer |= (@sysvar::DisplayConfig_ASG_Prop_Display3::DisplayMainSelection_MainSelection_Bit18 << 2);
	byteBuffer |= (@sysvar::DisplayConfig_ASG_Prop_Display3::DisplayMainSelection_MainSelection_Bit19 << 3);
	byteBuffer |= (@sysvar::DisplayConfig_ASG_Prop_Display3::DisplayMainSelection_MainSelection_Bit20 << 4);
	byteBuffer |= (@sysvar::DisplayConfig_ASG_Prop_Display3::DisplayMainSelection_MainSelection_Bit21 << 5);
	byteBuffer |= (@sysvar::DisplayConfig_ASG_Prop_Display3::DisplayMainSelection_MainSelection_Bit22 << 6);
	byteBuffer |= (@sysvar::DisplayConfig_ASG_Prop_Display3::DisplayMainSelection_MainSelection_Bit23 << 7);
	buffer[2] = byteBuffer;
	// byte[3]
	byteBuffer = 0;
	byteBuffer |= (@sysvar::DisplayConfig_ASG_Prop_Display3::DisplayMainSelection_MainSelection_Bit24 << 0);
	byteBuffer |= (@sysvar::DisplayConfig_ASG_Prop_Display3::DisplayMainSelection_MainSelection_Bit25 << 1);
	byteBuffer |= (@sysvar::DisplayConfig_ASG_Prop_Display3::DisplayMainSelection_MainSelection_Bit26 << 2);
	byteBuffer |= (@sysvar::DisplayConfig_ASG_Prop_Display3::DisplayMainSelection_MainSelection_Bit27 << 3);
	byteBuffer |= (@sysvar::DisplayConfig_ASG_Prop_Display3::DisplayMainSelection_MainSelection_Bit28 << 4);
	buffer[3] = byteBuffer;
	// byte[4]
	byteBuffer = 0;
	byteBuffer |= (@sysvar::DisplayConfig_ASG_Prop_Display3::DisplayMainSelection_Extension1 << 4);
	byteBuffer |= (@sysvar::DisplayConfig_ASG_Prop_Display3::DisplayMainSelection_Extension2 << 0);
	buffer[4] = byteBuffer;
}

createData_0x19_AdditionalInstrument(byte buffer[])
{
	int idx;
	byte byteBuffer;

    for(idx=0; idx<elCount(buffer); idx++)
        buffer[idx] = 0;
	
	// create Data
	byteBuffer = 0;
	byteBuffer |= (@sysvar::DisplayConfig_ASG_Prop_AdditionalInstrument::x19_AdditionalInstrument_Setup_Bit00 << 0);
	byteBuffer |= (@sysvar::DisplayConfig_ASG_Prop_AdditionalInstrument::x19_AdditionalInstrument_Setup_Bit01 << 1);
	byteBuffer |= (@sysvar::DisplayConfig_ASG_Prop_AdditionalInstrument::x19_AdditionalInstrument_Setup_Bit02 << 2);
	buffer[0] = byteBuffer;
	buffer[1] = @sysvar::DisplayConfig_ASG_Prop_AdditionalInstrument::x19_AdditionalInstrument_Brightness;
	byteBuffer  = 0x00;
	byteBuffer |= (@sysvar::DisplayConfig_ASG_Prop_AdditionalInstrument::x19_AdditionalInstrument_Reserve1 << 4) & 0xF0;
	byteBuffer |= (@sysvar::DisplayConfig_ASG_Prop_AdditionalInstrument::x19_AdditionalInstrument_Reserve2 << 0) & 0x0F;
	buffer[2]   = byteBuffer;
}

byte createData_0x1A_AdditionalInstrument2()
{
	int idx;
	byte byteBuffer;

	// create Data
	byteBuffer = 0;
	byteBuffer |= (@sysvar::DisplayConfig_ASG_Prop_AdditionalInstrument::x1A_AdditionalInstrument2_Setup_Bit00 << 0);
	byteBuffer |= (@sysvar::DisplayConfig_ASG_Prop_AdditionalInstrument::x1A_AdditionalInstrument2_Setup_Bit01 << 1);
	byteBuffer |= (@sysvar::DisplayConfig_ASG_Prop_AdditionalInstrument::x1A_AdditionalInstrument2_Setup_Bit02 << 2);
	byteBuffer |= (@sysvar::DisplayConfig_ASG_Prop_AdditionalInstrument::x1A_AdditionalInstrument2_Setup_Bit03 << 3);
	byteBuffer |= (@sysvar::DisplayConfig_ASG_Prop_AdditionalInstrument::x1A_AdditionalInstrument2_Setup_Bit04 << 4);
	return byteBuffer;
}

createData_0x1C_DisplayDependency(byte buffer[])
{
	int idx;
	byte byteBuffer;

	// create Data
	byteBuffer  = 0;
    byteBuffer |= @sysvar::DisplayConfig_ASG_Prop::x1C_DisplayDependency_Setup_Bit0; 	// Setup (1 Byte)
	buffer[0]   = byteBuffer;
	buffer[1]= @sysvar::DisplayConfig_ASG_Prop::x1C_DisplayDependency_Extension1;
	buffer[2]= @sysvar::DisplayConfig_ASG_Prop::x1C_DisplayDependency_Extension2;
	byteBuffer  = 0x00;
	byteBuffer |= (@sysvar::DisplayConfig_ASG_Prop::x1C_DisplayDependency_Reserve1 << 4) & 0xF0;
	byteBuffer |= (@sysvar::DisplayConfig_ASG_Prop::x1C_DisplayDependency_Reserve2 << 0) & 0x0F;
	buffer[3] = byteBuffer;
}

createData_0x1D_ActiveDisplayPreset(byte buffer[])
{
	int idx;
	byte byteBuffer;

	// create Data
	buffer[0]   = @sysvar::DisplayConfig_ASG_Prop::x1D_ActiveDisplayPreset_PresetID;
	byteBuffer  = 0x00;
	byteBuffer |= (@sysvar::DisplayConfig_ASG_Prop::x1D_ActiveDisplayPreset_Reserve1 << 4) & 0xF0;
	byteBuffer |= (@sysvar::DisplayConfig_ASG_Prop::x1D_ActiveDisplayPreset_Reserve2 << 0) & 0x0F;
	buffer[1] = byteBuffer;
}

createData_0x1E_DisplayViewConfiguration(byte buffer[])
{
	int idx;
	byte byteBuffer;

	// create Data
	buffer[0]  	= @sysvar::DisplayConfig_ASG_Prop::x1E_DisplayViewConfiguration_ActiveDisplayView;
	buffer[1]	= @sysvar::DisplayConfig_ASG_Prop::x1E_DisplayViewConfiguration_Extension1;
	buffer[2]	= @sysvar::DisplayConfig_ASG_Prop::x1E_DisplayViewConfiguration_Extension2;
	byteBuffer  = 0x00;
	byteBuffer |= (@sysvar::DisplayConfig_ASG_Prop::x1E_DisplayViewConfiguration_Reserve1 << 4) & 0xF0;
	byteBuffer |= (@sysvar::DisplayConfig_ASG_Prop::x1E_DisplayViewConfiguration_Reserve2 << 0) & 0x0F;
	buffer[3] = byteBuffer;
}

createData_0x1F_LED_Configuration(byte buffer[])
{
	int idx;
	byte byteBuffer;

	// create Data
	byteBuffer  = 0x00;
	byteBuffer |= @sysvar::DisplayConfig_ASG_Prop::x1F_LED_Configuration_State_Bit0;
	buffer[0]   = byteBuffer;
	byteBuffer  = 0x00;
	byteBuffer |= (@sysvar::DisplayConfig_ASG_Prop::x1F_LED_Configuration_Reserve1 << 4) & 0xF0;
	byteBuffer |= (@sysvar::DisplayConfig_ASG_Prop::x1F_LED_Configuration_Reserve2 << 0) & 0x0F;
	buffer[1] = byteBuffer;
	buffer[2]= @sysvar::DisplayConfig_ASG_Prop::x1F_LED_Configuration_Extension1;
	buffer[3]= @sysvar::DisplayConfig_ASG_Prop::x1F_LED_Configuration_Extension2;
	buffer[4]= @sysvar::DisplayConfig_ASG_Prop::x1F_LED_Configuration_Extension3;
	buffer[5]= @sysvar::DisplayConfig_ASG_Prop::x1F_LED_Configuration_Extension4;
}

on sysvar sysvar::DisplayConfig_ASG::x02_BAPConfig_get
{
    if(@this)
        Request_0x02_BAP_Config(DataGet_REQ_CAN);
}

void Request_0x02_BAP_Config(byte request)
{
    dword header [BAP_HEADER_SIZE];
    byte data[1];

    switch(request)
    {
        case DataGet_REQ_CAN:
            /*** NO FUNCTION WITH BAP DLL (CacheAvailability=true) -> Call via CAN ***/
            CAN_sendGetMessage(BAP_CONFIG_FCT_ID);
            break;
        
        case DataGet_REQ:
            /*** Cache data request ***/
            BAP_createHeader(BAP_CONFIG_FCT_ID, header, elCount(data), request);
            BAP_DLL_Request(request, header, data);
            break;

        default:
            break;
    }
}

controls_setFunctionActive (int fctID, int bool)
{
    switch (fctID)
    {
        case GET_ALL_FCT_ID:
            enableControl("DisplayConfig_ASG_Main", "Ctrl_GetAll", bool);
            break;

        case BAP_CONFIG_FCT_ID:
            enableControl("DisplayConfig_ASG_Main", "Ctrl_BAP_Config", bool);
            break;

        case FUNCTION_LIST_FCT_ID:
            enableControl("DisplayConfig_ASG_Main", "Ctrl_FctList", bool);
            break;

        case HEART_BEAT_FCT_ID:
            enableControl("DisplayConfig_ASG_Main", "Ctrl_Heartbeat", bool);
            break;
		
		case FSG_CONTROL_FCT_ID:
			enableControl("DisplayConfig_ASG_Main", "Ctrl_FSG_Control", bool);
			break;
		
		case FSG_SETUP_FCT_ID:
			enableControl("DisplayConfig_ASG_Main", "Ctrl_FSG_Setup", bool);
			break;
		
		case FSG_OPERATION_STATE_FCT_ID:
			enableControl("DisplayConfig_ASG_Main", "Ctrl_FSG_OperationState", bool);
			break;
		
		case BRIGHTNESS_FCT_ID:
			enableControl("DisplayConfig_ASG_Properties", "Ctrl_Brightness", bool);
			break;
		
		case VOLUME_FCT_ID:
			enableControl("DisplayConfig_ASG_Properties", "Ctrl_Volume", bool);
			break;
		
		case ELEMENT_CONTENT_SELECTION_FCT_ID:
			break;
		
		case DISPLAY_1_SETUP_FCT_ID:
			enableControl("DisplayConfig_ASG_DisplaySetup_DisplayMainSelection", "Ctrl_Display1Setup", bool);
			break;
		
		case DISPLAY_1_MAIN_SELECTION_FCT_ID:
			enableControl("DisplayConfig_ASG_DisplaySetup_DisplayMainSelection", "Ctrl_Display1MainSelection", bool);
			break;
		
		case DISPLAY_2_SETUP_FCT_ID:
			enableControl("DisplayConfig_ASG_DisplaySetup_DisplayMainSelection", "Ctrl_Display2Setup", bool);
			break;
		
		case DISPLAY_2_MAIN_SELECTION_FCT_ID:
			enableControl("DisplayConfig_ASG_DisplaySetup_DisplayMainSelection", "Ctrl_Display2MainSelection", bool);
			break;
		
		case DISPLAY_3_SETUP_FCT_ID:
			enableControl("DisplayConfig_ASG_DisplaySetup_DisplayMainSelection", "Ctrl_Display3Setup", bool);
			break;
		
		case DISPLAY_3_MAIN_SELECTION_FCT_ID:
			enableControl("DisplayConfig_ASG_DisplaySetup_DisplayMainSelection", "Ctrl_Display3MainSelection", bool);
			break;
		
		case ADDITIONAL_INSTRUMENT_FCT_ID:
			enableControl("DisplayConfig_ASG_AdditionalInstrument", "Ctrl_AdditionalInstrument", bool);
			break;
		
		case ADDITIONAL_INSTRUMENT2_FCT_ID:
			enableControl("DisplayConfig_ASG_AdditionalInstrument", "Ctrl_AdditionalInstrument2", bool);
			break;
		
		case DISPLAY_PRESETS_FCT_ID:
			break;
		
		case DISPLAY_DEPENDENCY_FCT_ID:
			enableControl("DisplayConfig_ASG_Properties", "Ctrl_DisplayDependency", bool);
			break;
		
		case ACTIVE_DISPLAY_PRESET_FCT_ID:
			enableControl("DisplayConfig_ASG_Properties", "Ctrl_ActiveDisplayPreset", bool);
			break;
		
		case DISPLAY_VIEW_CONFIGURATION_FCT_ID:
			enableControl("DisplayConfig_ASG_Properties", "Ctrl_DisplayViewConfiguration", bool);
			break;
		
		case LED_CONFIGURATION_FCT_ID:
			enableControl("DisplayConfig_ASG_Properties", "Ctrl_LED_Configuration", bool);
			break;
        
        default:
            break;
    }
}
        
controls_enable_all ()
{
    byte fctIDs[23] =
	{	
		GET_ALL_FCT_ID, 
		BAP_CONFIG_FCT_ID,
		FUNCTION_LIST_FCT_ID,
		HEART_BEAT_FCT_ID,
		FSG_CONTROL_FCT_ID,
		FSG_SETUP_FCT_ID,
		FSG_OPERATION_STATE_FCT_ID,
		BRIGHTNESS_FCT_ID,
		VOLUME_FCT_ID,
		ELEMENT_CONTENT_SELECTION_FCT_ID,
		DISPLAY_1_SETUP_FCT_ID,
		DISPLAY_1_MAIN_SELECTION_FCT_ID,
		DISPLAY_2_SETUP_FCT_ID,
		DISPLAY_2_MAIN_SELECTION_FCT_ID,
		DISPLAY_3_SETUP_FCT_ID,
		DISPLAY_3_MAIN_SELECTION_FCT_ID,
		ADDITIONAL_INSTRUMENT_FCT_ID,
		ADDITIONAL_INSTRUMENT2_FCT_ID,
		DISPLAY_PRESETS_FCT_ID,
		DISPLAY_DEPENDENCY_FCT_ID,
		ACTIVE_DISPLAY_PRESET_FCT_ID,
		DISPLAY_VIEW_CONFIGURATION_FCT_ID,
		LED_CONFIGURATION_FCT_ID
    };
    int idx;
    
    // Disable all
    for(idx=0; idx<elCount(fctIDs); idx++)
        controls_setFunctionActive(fctIDs[idx], FALSE);
        
	enableControl("DisplayConfig_ASG_Main", "Btn_Properties", FALSE);
	enableControl("DisplayConfig_ASG_Main", "Btn_DisplaySetup", FALSE);
	enableControl("DisplayConfig_ASG_Main", "Btn_AdditionalInstrument", FALSE);  
	enableControl("DisplayConfig_ASG_Main", "Btn_ElementContentSelection", FALSE);
	enableControl("DisplayConfig_ASG_Main", "Btn_DisplayPresets", FALSE);
    
    if(@sysvar::DisplayConfig_General::Smart)
    {
        // Only enable related to FctList, if ON
        if(@sysvar::DisplayConfig_ASG::control_OnOff)
        {
            if(@sysvar::DisplayConfig_ASG::x03_FctList_0x01_GetAll)
                controls_setFunctionActive(GET_ALL_FCT_ID, TRUE);

            if(@sysvar::DisplayConfig_ASG::x03_FctList_0x02_BAPConfig)
                controls_setFunctionActive(BAP_CONFIG_FCT_ID, TRUE);
        
            if(@sysvar::DisplayConfig_ASG::x03_FctList_0x03_FctList)
                controls_setFunctionActive(FUNCTION_LIST_FCT_ID, TRUE);
            
            if(@sysvar::DisplayConfig_ASG::x03_FctList_0x04_HeartBeat)
                controls_setFunctionActive(HEART_BEAT_FCT_ID, TRUE);

			if(@sysvar::DisplayConfig_ASG::x03_FctList_0x0D_FSG_Control)
                controls_setFunctionActive(FSG_CONTROL_FCT_ID, TRUE);
			
			if(@sysvar::DisplayConfig_ASG::x03_FctList_0x0E_FSG_Setup)
                controls_setFunctionActive(FSG_SETUP_FCT_ID, TRUE);
			
			if(@sysvar::DisplayConfig_ASG::x03_FctList_0x0F_FSG_OperationState)
                controls_setFunctionActive(FSG_OPERATION_STATE_FCT_ID, TRUE);
			
			if(@sysvar::DisplayConfig_ASG::x03_FctList_0x10_Brightness)
                controls_setFunctionActive(BRIGHTNESS_FCT_ID, TRUE);
			
			if(@sysvar::DisplayConfig_ASG::x03_FctList_0x11_Volume)
                controls_setFunctionActive(VOLUME_FCT_ID, TRUE);
			
			if(@sysvar::DisplayConfig_ASG::x03_FctList_0x12_ElementContentSelection)
                controls_setFunctionActive(ELEMENT_CONTENT_SELECTION_FCT_ID, TRUE);
			
			if(@sysvar::DisplayConfig_ASG::x03_FctList_0x13_Display1Setup)
                controls_setFunctionActive(DISPLAY_1_SETUP_FCT_ID, TRUE);
			
			if(@sysvar::DisplayConfig_ASG::x03_FctList_0x14_Display1MainSelection)
                controls_setFunctionActive(DISPLAY_1_MAIN_SELECTION_FCT_ID, TRUE);
			
			if(@sysvar::DisplayConfig_ASG::x03_FctList_0x15_Display2Setup)
                controls_setFunctionActive(DISPLAY_2_SETUP_FCT_ID, TRUE);
			
			if(@sysvar::DisplayConfig_ASG::x03_FctList_0x16_Display2MainSelection)
                controls_setFunctionActive(DISPLAY_2_MAIN_SELECTION_FCT_ID, TRUE);
			
			if(@sysvar::DisplayConfig_ASG::x03_FctList_0x17_Display3Setup)
                controls_setFunctionActive(DISPLAY_3_SETUP_FCT_ID, TRUE);
			
			if(@sysvar::DisplayConfig_ASG::x03_FctList_0x18_Display3MainSelection)
                controls_setFunctionActive(DISPLAY_3_MAIN_SELECTION_FCT_ID, TRUE);
			
			if(@sysvar::DisplayConfig_ASG::x03_FctList_0x19_AdditionalInstrument)
                controls_setFunctionActive(ADDITIONAL_INSTRUMENT_FCT_ID, TRUE);
			
			if(@sysvar::DisplayConfig_ASG::x03_FctList_0x1A_AdditionalInstrument2)
                controls_setFunctionActive(ADDITIONAL_INSTRUMENT2_FCT_ID, TRUE);
			
			if(@sysvar::DisplayConfig_ASG::x03_FctList_0x1B_DisplayPresets)
                controls_setFunctionActive(DISPLAY_PRESETS_FCT_ID, TRUE);
			
			if(@sysvar::DisplayConfig_ASG::x03_FctList_0x1C_DisplayDependency)
                controls_setFunctionActive(DISPLAY_DEPENDENCY_FCT_ID, TRUE);
			
			if(@sysvar::DisplayConfig_ASG::x03_FctList_0x1D_ActiveDisplayPreset)
                controls_setFunctionActive(ACTIVE_DISPLAY_PRESET_FCT_ID, TRUE);
			
			if(@sysvar::DisplayConfig_ASG::x03_FctList_0x1E_DisplayViewConfiguration)
                controls_setFunctionActive(DISPLAY_VIEW_CONFIGURATION_FCT_ID, TRUE);
			
			if(@sysvar::DisplayConfig_ASG::x03_FctList_0x1F_LED_Configuration)
                controls_setFunctionActive(LED_CONFIGURATION_FCT_ID, TRUE);
			
            // Subpanels
            if(@sysvar::DisplayConfig_ASG::x03_FctList_0x10_Brightness
			|| @sysvar::DisplayConfig_ASG::x03_FctList_0x11_Volume
			|| @sysvar::DisplayConfig_ASG::x03_FctList_0x1C_DisplayDependency
			|| @sysvar::DisplayConfig_ASG::x03_FctList_0x1D_ActiveDisplayPreset
			|| @sysvar::DisplayConfig_ASG::x03_FctList_0x1E_DisplayViewConfiguration
			|| @sysvar::DisplayConfig_ASG::x03_FctList_0x1F_LED_Configuration)
                enableControl("DisplayConfig_ASG_Main", "Btn_Properties", TRUE);

            if(@sysvar::DisplayConfig_ASG::x03_FctList_0x13_Display1Setup
			|| @sysvar::DisplayConfig_ASG::x03_FctList_0x14_Display1MainSelection
			|| @sysvar::DisplayConfig_ASG::x03_FctList_0x15_Display2Setup	
            || @sysvar::DisplayConfig_ASG::x03_FctList_0x16_Display2MainSelection
			|| @sysvar::DisplayConfig_ASG::x03_FctList_0x17_Display3Setup	
			|| @sysvar::DisplayConfig_ASG::x03_FctList_0x18_Display3MainSelection)
				enableControl("DisplayConfig_ASG_Main", "Btn_DisplaySetup", TRUE);
			
			if(@sysvar::DisplayConfig_ASG::x03_FctList_0x19_AdditionalInstrument
			|| @sysvar::DisplayConfig_ASG::x03_FctList_0x1A_AdditionalInstrument2)
				enableControl("DisplayConfig_ASG_Main", "Btn_AdditionalInstrument", TRUE);  
			
			if(@sysvar::DisplayConfig_ASG::x03_FctList_0x12_ElementContentSelection)
				enableControl("DisplayConfig_ASG_Main", "Btn_ElementContentSelection", TRUE);
			
			if(@sysvar::DisplayConfig_ASG::x03_FctList_0x1B_DisplayPresets)
				enableControl("DisplayConfig_ASG_Main", "Btn_DisplayPresets", TRUE);
        }
    }
    else // not smart, all on
    {
        for(idx=0; idx<elCount(fctIDs); idx++)
            controls_setFunctionActive(fctIDs[idx], TRUE);
        
		enableControl("DisplayConfig_ASG_Main", "Btn_Properties", TRUE);
		enableControl("DisplayConfig_ASG_Main", "Btn_DisplaySetup", TRUE);
		enableControl("DisplayConfig_ASG_Main", "Btn_AdditionalInstrument", TRUE);  
		enableControl("DisplayConfig_ASG_Main", "Btn_ElementContentSelection", TRUE);
		enableControl("DisplayConfig_ASG_Main", "Btn_DisplayPresets", TRUE);

        if(!@sysvar::DisplayConfig_ASG::control_OnOff) // if off, function to insert data (status-fct off)
        {
            controls_setFunctionActive(GET_ALL_FCT_ID, FALSE);
            controls_setFunctionActive(BAP_CONFIG_FCT_ID, FALSE);
            controls_setFunctionActive(FUNCTION_LIST_FCT_ID, FALSE);
            controls_setFunctionActive(HEART_BEAT_FCT_ID, FALSE);
        }
    }
}

on sysvar sysvar::DisplayConfig_ASG::control_OnOff
{
	if(@this)               // Startup
    {
        init_DisplayConfig();
        setTimer(TaskTimer, 10);
        putValue(env_DisplayConfig_v100_PowerOnOff, 1); 
    }
	else                    // Must be a shutdown.	
    {
        Shutdown_DisplayConfig();
        cancelTimer(TaskTimer);
        putValue(env_DisplayConfig_v100_PowerOnOff, 0); 
    } 

    controls_enable_all();
}

int Array_getNextElementPos(byte validity[], int startPos, byte direction)
{
	int i;
	int startPosBackup;
	
	startPosBackup = startPos;
	
	if(direction == 0)
	{
		for(i=1; i+startPos<elCount(validity); i++)
			if(validity[i+startPos] != 0)
				return (i+startPos);
	}
	else
	{
		for(i=1; startPos-i >= 0; i++)
			if(validity[startPos-i] != 0)
				return (startPos-i);
    }
	return -1;
}

int Array_getTNLE(byte validity[])
{
	int i;
	int tnle;
	tnle = 0;
	
	for(i=0; i<elCount(validity); i++)
		if(validity[i] != 0)
			tnle++;
		
	return tnle;
}

int Array_getRequestedIndices (word buffer[], int startPos, byte direction, byte shift, int tnle, int elementsRequested, byte validity[])
{
    int nextEl;
    int numberOfElements;
    int i;
    numberOfElements = 0;

	if(validity[startPos] != 0)
		nextEl = startPos;
	else
	    nextEl = Array_getNextElementPos (validity, startPos, direction);
	// evaluate shift
	if(shift && nextEl == startPos)
		nextEl = Array_getNextElementPos (validity, nextEl, direction);
	else if(shift && startPos == 0)
		nextEl = Array_getNextElementPos_withWrap (validity, nextEl, direction);

    if(nextEl != -1)
    {
		buffer[numberOfElements] = nextEl;
		numberOfElements++;

		for(i=1; i<elementsRequested && i<elCount(validity); i++)
		{
			nextEl = Array_getNextElementPos (validity, nextEl, direction);
			if(nextEl == -1)
				break;
			else
			{
				buffer[numberOfElements] = nextEl;
				numberOfElements++;
            }
		}
    }

    return numberOfElements;
}

int Array_getNextElementPos_withWrap(byte validity[], int startPos, byte direction)
{
	int i;
	int startPosBackup;
	int nextPos;
	
	startPosBackup = startPos;
	
	nextPos = Array_getNextElementPos(validity, startPos, direction);

	if(nextPos == -1)
	{
		if(direction == 0)
			startPos = -1;
		else
			startPos = elCount(validity);

		nextPos = Array_getNextElementPos(validity, startPos, direction);
			if(nextPos != startPosBackup)	// catch if wrap around occured and same element is referenced
				return (nextPos);
    }
	
	return nextPos;
}

int Array_getFirstElementPos(byte validity[], byte direction)
{
	int i;
	
	if(direction == 0)
	{
		for(i=0; i<elCount(validity); i++)
			if(validity[i] != 0)
				return i;
	}
	else
	{
		for(i=elCount(validity)-1; i>=0; i--)
			if(validity[i] != 0)
				return i;
    }
	
	return -1;
}

on sysvar sysvar::DisplayConfig_ASG::x01_GetAll_GetAll
{
    if(@this)
        Request_0x01_GetAll(DataGet_REQ_CAN);
}


byte Array_DecodeModeByte_getShift (byte ModeByte)
{
    byte ret;
    ret = 0;

    ret = (ModeByte & 0x10) >> 4;

    return ret;
}

byte Array_DecodeModeByte_getDirection (byte ModeByte)
{
    byte ret;
    ret = 0;

    ret = (ModeByte & 0x20) >> 5;  
                                                       
    return ret;
}

byte Array_DecodeModeByte_getTransmitPos (byte ModeByte)
{
    byte ret;
    ret = 0;

    ret = (ModeByte & 0x40) >> 6;

    return ret;
}

byte Array_DecodeModeByte_getIdxSize (byte ModeByte)
{
    byte ret;
    ret = 0;

    ret = (ModeByte & 0x80) >> 7;

    return ret;
}

byte Array_DecodeModeByte_getRecordAddress (byte ModeByte)
{
    byte ret;
    ret = 0;

    ret = (ModeByte & 0x0F);

    return ret;
}

byte Array_DecodeFirstByte_getASGID (byte dataByte)
{
    byte ret;
    ret = 0;

    ret |= (dataByte & 0xF0) >> 4;
                                                       
    return ret;
}

byte Array_DecodeFirstByte_getTAID (byte dataByte)
{
    byte ret;
    ret = 0;

    ret |= (dataByte & 0x0F);   // databyte has to be indication_data[0]
                                                       
    return ret;
}

byte Array_createModeByte (byte shift, byte direction, byte transmitPos, byte idxSize, byte recordAddress)
{
    byte byteBuffer;
    byteBuffer = 0;

    if(shift)
        byteBuffer += (1);
    
    if(direction)
        byteBuffer += (1 << 1);
    
    if(transmitPos)
        byteBuffer += (1 << 2);
    
    if(idxSize)
        byteBuffer += (1 << 3);

    byteBuffer = (byteBuffer << 4);                                                          // upper nibble = Mode byte
    byteBuffer += recordAddress;                                                            // lower nibble = RecordAddress

    return byteBuffer;
}

int Array_createHeader_get (byte buffer[], word start_el, word elements, byte ASG_ID, byte TAID, byte modeByte, byte idxSize)
{
    byte byteBuffer;
    int nextPos;
    nextPos = 0;

    byteBuffer = 0;
    byteBuffer = (ASG_ID << 4);
    byteBuffer += TAID;
    buffer[0] = byteBuffer;

    buffer[1] = modeByte;

    if(idxSize == 0)                                                                        // 8 bit addressing
    {
        buffer[2] = start_el;
        buffer[3] = elements;
        nextPos = 4;
    }
    else                                                                                    // 16 bit addressing
    {
        byteBuffer = 0;
        byteBuffer = (start_el & 0xFF00) >> 8;
        buffer[2] = byteBuffer;

        byteBuffer = 0;
        byteBuffer = (start_el & 0x00FF);
        buffer[3] = byteBuffer;

        byteBuffer = 0;
        byteBuffer = (elements & 0xFF00) >> 8;
        buffer[4] = byteBuffer;

        byteBuffer = 0;
        byteBuffer = (elements & 0x00FF);
        buffer[5] = byteBuffer;

        nextPos = 6;
    }

    return nextPos;
}

int Array_createHeader_setGet (byte buffer[], word tnle, word start_el, word elements, byte ASG_ID, byte TAID, byte modeByte, byte idxSize)
{
    byte byteBuffer;
    int nextPos;
    nextPos = 0;

    byteBuffer = (ASG_ID << 4);
    byteBuffer += TAID;
    buffer[0] = byteBuffer;

    // buffer[1] = tnle;							// No TNLE in SetGet

    buffer[1] = modeByte;  

    if(idxSize == 0)								// 8 bit addressing
    {
        buffer[2] = start_el;
        buffer[3] = elements;
        nextPos = 4;
    }
    else											// 16 bit addressing
    {
        byteBuffer = 0;
        byteBuffer = (start_el & 0x00FF);
        buffer[2] = byteBuffer;

        byteBuffer = 0;
        byteBuffer = (start_el & 0xFF00) >> 8;
        buffer[3] = byteBuffer;

        byteBuffer = 0;
        byteBuffer = (elements & 0x00FF);
        buffer[4] = byteBuffer;

        byteBuffer = 0;
        byteBuffer = (elements & 0xFF00) >> 8;
        buffer[5] = byteBuffer;

        nextPos = 6;
    }

    return nextPos;
}

on timer initTimer
{
    @sysvar::DisplayConfig_ASG::control_OnOff_indicator = 1;
}

ElementContentSelection_clearData_get ()
{
    int i = 0;

	for(i=0;i<ELEMENT_CONTENT_SELECTION_ENTRIES;i++) 
	{
		ElementContentSelection_Data_Pos_get			[i] = 0;
     	ElementContentSelection_Data_Display_get		[i] = 0;
	 	ElementContentSelection_Data_AdditionalInfo_get	[i] = 0;
	 	ElementContentSelection_Data_Element_get		[i] = 0;
	 	ElementContentSelection_Data_ElementContent_get	[i] = 0;
	 	ElementContentSelection_Data_Validity_get		[i] = 0;
	}
    
    // Anctualize system variables for Panel
    ElementContentSelection_Data_startPos_get = Array_getFirstElementPos(ElementContentSelection_Data_Validity_get, 0);
    ElementContentSelection_actualize_sysvar_get ();
}

ElementContentSelection_clearData_setGet ()
{
    int i = 0;

	for(i=0;i<ELEMENT_CONTENT_SELECTION_ENTRIES;i++) 
	{
		ElementContentSelection_Data_Pos_setGet				[i] = 0;
     	ElementContentSelection_Data_Display_setGet			[i] = 0;
	 	ElementContentSelection_Data_AdditionalInfo_setGet	[i] = 0;
	 	ElementContentSelection_Data_Element_setGet			[i] = 0;
	 	ElementContentSelection_Data_ElementContent_setGet	[i] = 0;
	 	ElementContentSelection_Data_Validity_setGet		[i] = 0;
	}
    
    // Anctualize system variables for Panel
    ElementContentSelection_Data_startPos_setGet = Array_getFirstElementPos(ElementContentSelection_Data_Validity_setGet, 0);
    ElementContentSelection_actualize_sysvar_setGet ();
}

DisplayPresets_clearData_get ()
{
    int i = 0;

	for(i=0;i<DISPLAY_PRESETS_ENTRIES;i++) 
	{
		DisplayPresets_Data_Pos_get							[i] = 0;
		DisplayPresets_Data_State_get						[i] = 0;
		DisplayPresets_Data_DisplayPresetType_get			[i] = 0;
		DisplayPresets_Data_DisplayPresetInstance_get		[i] = 0;
		DisplayPresets_Data_Display1MainSelection_get		[i] = 0;
		DisplayPresets_Data_Display1AdditionalInfo1_1_get	[i] = 0;
		DisplayPresets_Data_Display1AdditionalInfo1_2_get	[i] = 0;
		DisplayPresets_Data_Display1AdditionalInfo2_1_get	[i] = 0;
		DisplayPresets_Data_Display1AdditionalInfo2_2_get	[i] = 0;
		DisplayPresets_Data_Display2MainSelection_get		[i] = 0;
		DisplayPresets_Data_Display2AdditionalInfo1_1_get	[i] = 0;
		DisplayPresets_Data_Display2AdditionalInfo1_2_get	[i] = 0;
		DisplayPresets_Data_Display2AdditionalInfo2_1_get	[i] = 0;
		DisplayPresets_Data_Display2AdditionalInfo2_2_get	[i] = 0;
		DisplayPresets_Data_Display3MainSelection_get		[i] = 0;
		DisplayPresets_Data_Display3AdditionalInfo1_1_get	[i] = 0;
		DisplayPresets_Data_Display3AdditionalInfo1_2_get	[i] = 0;
		DisplayPresets_Data_Display3AdditionalInfo2_1_get	[i] = 0;
		DisplayPresets_Data_Display3AdditionalInfo2_2_get	[i] = 0;
		DisplayPresets_Data_Validity_get					[i] = 0;
	}
    
    // Anctualize system variables for Panel
    DisplayPresets_Data_startPos_get = Array_getFirstElementPos(DisplayPresets_Data_Validity_get, 0);
    DisplayPresets_actualize_sysvar_get ();
}

DisplayPresets_clearData_setGet ()
{
    int i = 0;

	for(i=0;i<DISPLAY_PRESETS_ENTRIES;i++) 
	{
		DisplayPresets_Data_Pos_setGet							[i] = 0;
		DisplayPresets_Data_State_setGet						[i] = 0;
		DisplayPresets_Data_DisplayPresetType_setGet			[i] = 0;
		DisplayPresets_Data_DisplayPresetInstance_setGet		[i] = 0;
		DisplayPresets_Data_Display1MainSelection_setGet		[i] = 0;
		DisplayPresets_Data_Display1AdditionalInfo1_1_setGet	[i] = 0;
		DisplayPresets_Data_Display1AdditionalInfo1_2_setGet	[i] = 0;
		DisplayPresets_Data_Display1AdditionalInfo2_1_setGet	[i] = 0;
		DisplayPresets_Data_Display1AdditionalInfo2_2_setGet	[i] = 0;
		DisplayPresets_Data_Display2MainSelection_setGet		[i] = 0;
		DisplayPresets_Data_Display2AdditionalInfo1_1_setGet	[i] = 0;
		DisplayPresets_Data_Display2AdditionalInfo1_2_setGet	[i] = 0;
		DisplayPresets_Data_Display2AdditionalInfo2_1_setGet	[i] = 0;
		DisplayPresets_Data_Display2AdditionalInfo2_2_setGet	[i] = 0;
		DisplayPresets_Data_Display3MainSelection_setGet		[i] = 0;
		DisplayPresets_Data_Display3AdditionalInfo1_1_setGet	[i] = 0;
		DisplayPresets_Data_Display3AdditionalInfo1_2_setGet	[i] = 0;
		DisplayPresets_Data_Display3AdditionalInfo2_1_setGet	[i] = 0;
		DisplayPresets_Data_Display3AdditionalInfo2_2_setGet	[i] = 0;
		DisplayPresets_Data_Validity_setGet						[i] = 0;
	}
    
    // Anctualize system variables for Panel
    DisplayPresets_Data_startPos_setGet = Array_getFirstElementPos(DisplayPresets_Data_Validity_setGet, 0);
    DisplayPresets_actualize_sysvar_setGet ();
}

int DisplayPresets_addArrayElementData (byte buffer[], int idx, int entry, int transmitPos, int recordAddress, int idxSize)
{
    int i;

    byte pos_upperByte, pos_lowerByte;
    byte byteBuffer;
    pos_upperByte = 0;
    pos_lowerByte = 0;

    // POS - if transmission is enabled via recordAddress or transmitPos
    if(transmitPos == 1 || recordAddress == DISPLAY_PRESETS_RECADDR_POS)
    {
        if(idxSize == 0)    // 8 bit
        {
            buffer[idx] = DisplayPresets_Data_Pos_setGet[entry];
            idx++;
        }
        else                // 16 bit
        {
            pos_lowerByte = (ElementContentSelection_Data_Pos_setGet[entry] & 0x00FF);
            pos_upperByte = (ElementContentSelection_Data_Pos_setGet[entry] & 0xFF00) >> 8;
            buffer[idx] = pos_lowerByte;
            idx++;
            buffer[idx] = pos_upperByte;
            idx++;
        }
    }
    
    // Display, AdditionalInfo, Element - if transmission is enabled via recordAddress
    if(recordAddress == DISPLAY_PRESETS_RECADDR_DISPLAY12 || recordAddress == DISPLAY_PRESETS_RECADDR_DISPLAY123)
    {
		buffer[idx] = DisplayPresets_Data_State_setGet[entry];
		idx++;
		
		buffer[idx] = DisplayPresets_Data_DisplayPresetType_setGet[entry];
		idx++;
		
		buffer[idx] = DisplayPresets_Data_DisplayPresetInstance_setGet[entry];
		idx++;
		
		buffer[idx] = (DisplayPresets_Data_Display1MainSelection_setGet[entry] & 0x000000FF) >> 0;
		idx++;
		buffer[idx] = (DisplayPresets_Data_Display1MainSelection_setGet[entry] & 0x0000FF00) >> 8;
		idx++;
		buffer[idx] = (DisplayPresets_Data_Display1MainSelection_setGet[entry] & 0x00FF0000) >> 16;
		idx++;
		buffer[idx] = (DisplayPresets_Data_Display1MainSelection_setGet[entry] & 0xFF000000) >> 24;
		idx++;
		
		buffer[idx] = (DisplayPresets_Data_Display1AdditionalInfo1_1_setGet[entry] & 0x000000FF) >> 0;
		idx++;
		buffer[idx] = (DisplayPresets_Data_Display1AdditionalInfo1_1_setGet[entry] & 0x0000FF00) >> 8;
		idx++;
		buffer[idx] = (DisplayPresets_Data_Display1AdditionalInfo1_1_setGet[entry] & 0x00FF0000) >> 16;
		idx++;
		buffer[idx] = (DisplayPresets_Data_Display1AdditionalInfo1_1_setGet[entry] & 0xFF000000) >> 24;
		idx++;
		
		buffer[idx] = (DisplayPresets_Data_Display1AdditionalInfo1_2_setGet[entry] & 0x000000FF) >> 0;
		idx++;
		buffer[idx] = (DisplayPresets_Data_Display1AdditionalInfo1_2_setGet[entry] & 0x0000FF00) >> 8;
		idx++;
		buffer[idx] = (DisplayPresets_Data_Display1AdditionalInfo1_2_setGet[entry] & 0x00FF0000) >> 16;
		idx++;
		buffer[idx] = (DisplayPresets_Data_Display1AdditionalInfo1_2_setGet[entry] & 0xFF000000) >> 24;
		idx++;
		
		buffer[idx] = (DisplayPresets_Data_Display1AdditionalInfo2_1_setGet[entry] & 0x000000FF) >> 0;
		idx++;
		buffer[idx] = (DisplayPresets_Data_Display1AdditionalInfo2_1_setGet[entry] & 0x0000FF00) >> 8;
		idx++;
		buffer[idx] = (DisplayPresets_Data_Display1AdditionalInfo2_1_setGet[entry] & 0x00FF0000) >> 16;
		idx++;
		buffer[idx] = (DisplayPresets_Data_Display1AdditionalInfo2_1_setGet[entry] & 0xFF000000) >> 24;
		idx++;
		
		buffer[idx] = (DisplayPresets_Data_Display1AdditionalInfo2_2_setGet[entry] & 0x000000FF) >> 0;
		idx++;
		buffer[idx] = (DisplayPresets_Data_Display1AdditionalInfo2_2_setGet[entry] & 0x0000FF00) >> 8;
		idx++;
		buffer[idx] = (DisplayPresets_Data_Display1AdditionalInfo2_2_setGet[entry] & 0x00FF0000) >> 16;
		idx++;
		buffer[idx] = (DisplayPresets_Data_Display1AdditionalInfo2_2_setGet[entry] & 0xFF000000) >> 24;
		idx++;
		
		buffer[idx] = (DisplayPresets_Data_Display2MainSelection_setGet[entry] & 0x000000FF) >> 0;
		idx++;
		buffer[idx] = (DisplayPresets_Data_Display2MainSelection_setGet[entry] & 0x0000FF00) >> 8;
		idx++;
		buffer[idx] = (DisplayPresets_Data_Display2MainSelection_setGet[entry] & 0x00FF0000) >> 16;
		idx++;
		buffer[idx] = (DisplayPresets_Data_Display2MainSelection_setGet[entry] & 0xFF000000) >> 24;
		idx++;
		
		buffer[idx] = (DisplayPresets_Data_Display2AdditionalInfo1_1_setGet[entry] & 0x000000FF) >> 0;
		idx++;
		buffer[idx] = (DisplayPresets_Data_Display2AdditionalInfo1_1_setGet[entry] & 0x0000FF00) >> 8;
		idx++;
		buffer[idx] = (DisplayPresets_Data_Display2AdditionalInfo1_1_setGet[entry] & 0x00FF0000) >> 16;
		idx++;
		buffer[idx] = (DisplayPresets_Data_Display2AdditionalInfo1_1_setGet[entry] & 0xFF000000) >> 24;
		idx++;
		
		buffer[idx] = (DisplayPresets_Data_Display2AdditionalInfo1_2_setGet[entry] & 0x000000FF) >> 0;
		idx++;
		buffer[idx] = (DisplayPresets_Data_Display2AdditionalInfo1_2_setGet[entry] & 0x0000FF00) >> 8;
		idx++;
		buffer[idx] = (DisplayPresets_Data_Display2AdditionalInfo1_2_setGet[entry] & 0x00FF0000) >> 16;
		idx++;
		buffer[idx] = (DisplayPresets_Data_Display2AdditionalInfo1_2_setGet[entry] & 0xFF000000) >> 24;
		idx++;
		
		buffer[idx] = (DisplayPresets_Data_Display2AdditionalInfo2_1_setGet[entry] & 0x000000FF) >> 0;
		idx++;
		buffer[idx] = (DisplayPresets_Data_Display2AdditionalInfo2_1_setGet[entry] & 0x0000FF00) >> 8;
		idx++;
		buffer[idx] = (DisplayPresets_Data_Display2AdditionalInfo2_1_setGet[entry] & 0x00FF0000) >> 16;
		idx++;
		buffer[idx] = (DisplayPresets_Data_Display2AdditionalInfo2_1_setGet[entry] & 0xFF000000) >> 24;
		idx++;
		
		buffer[idx] = (DisplayPresets_Data_Display2AdditionalInfo2_2_setGet[entry] & 0x000000FF) >> 0;
		idx++;
		buffer[idx] = (DisplayPresets_Data_Display2AdditionalInfo2_2_setGet[entry] & 0x0000FF00) >> 8;
		idx++;
		buffer[idx] = (DisplayPresets_Data_Display2AdditionalInfo2_2_setGet[entry] & 0x00FF0000) >> 16;
		idx++;
		buffer[idx] = (DisplayPresets_Data_Display2AdditionalInfo2_2_setGet[entry] & 0xFF000000) >> 24;
		idx++;
    }

    // ElementContent - if transmission is enabled via recordAddress
    if(recordAddress == DISPLAY_PRESETS_RECADDR_DISPLAY123)
    {
        buffer[idx] = (DisplayPresets_Data_Display3MainSelection_setGet[entry] & 0x000000FF) >> 0;
		idx++;
		buffer[idx] = (DisplayPresets_Data_Display3MainSelection_setGet[entry] & 0x0000FF00) >> 8;
		idx++;
		buffer[idx] = (DisplayPresets_Data_Display3MainSelection_setGet[entry] & 0x00FF0000) >> 16;
		idx++;
		buffer[idx] = (DisplayPresets_Data_Display3MainSelection_setGet[entry] & 0xFF000000) >> 24;
		idx++;
		
		buffer[idx] = (DisplayPresets_Data_Display3AdditionalInfo1_1_setGet[entry] & 0x000000FF) >> 0;
		idx++;
		buffer[idx] = (DisplayPresets_Data_Display3AdditionalInfo1_1_setGet[entry] & 0x0000FF00) >> 8;
		idx++;
		buffer[idx] = (DisplayPresets_Data_Display3AdditionalInfo1_1_setGet[entry] & 0x00FF0000) >> 16;
		idx++;
		buffer[idx] = (DisplayPresets_Data_Display3AdditionalInfo1_1_setGet[entry] & 0xFF000000) >> 24;
		idx++;
		
		buffer[idx] = (DisplayPresets_Data_Display3AdditionalInfo1_2_setGet[entry] & 0x000000FF) >> 0;
		idx++;
		buffer[idx] = (DisplayPresets_Data_Display3AdditionalInfo1_2_setGet[entry] & 0x0000FF00) >> 8;
		idx++;
		buffer[idx] = (DisplayPresets_Data_Display3AdditionalInfo1_2_setGet[entry] & 0x00FF0000) >> 16;
		idx++;
		buffer[idx] = (DisplayPresets_Data_Display3AdditionalInfo1_2_setGet[entry] & 0xFF000000) >> 24;
		idx++;
		
		buffer[idx] = (DisplayPresets_Data_Display3AdditionalInfo2_1_setGet[entry] & 0x000000FF) >> 0;
		idx++;
		buffer[idx] = (DisplayPresets_Data_Display3AdditionalInfo2_1_setGet[entry] & 0x0000FF00) >> 8;
		idx++;
		buffer[idx] = (DisplayPresets_Data_Display3AdditionalInfo2_1_setGet[entry] & 0x00FF0000) >> 16;
		idx++;
		buffer[idx] = (DisplayPresets_Data_Display3AdditionalInfo2_1_setGet[entry] & 0xFF000000) >> 24;
		idx++;
		
		buffer[idx] = (DisplayPresets_Data_Display3AdditionalInfo2_2_setGet[entry] & 0x000000FF) >> 0;
		idx++;
		buffer[idx] = (DisplayPresets_Data_Display3AdditionalInfo2_2_setGet[entry] & 0x0000FF00) >> 8;
		idx++;
		buffer[idx] = (DisplayPresets_Data_Display3AdditionalInfo2_2_setGet[entry] & 0x00FF0000) >> 16;
		idx++;
		buffer[idx] = (DisplayPresets_Data_Display3AdditionalInfo2_2_setGet[entry] & 0xFF000000) >> 24;
		idx++;
    }

    return idx;   
}

on sysvar sysvar::DisplayConfig_ASG_ElementContentSelection::x12_ElementContentSelection_control_onOff
{
    ElementContentSelection_clearData_get ();
    
    if(@this)
        ElementContentSelection_getElement(0);
}

ElementContentSelection_getElement (int startElement)
{
    @sysvar::DisplayConfig_ASG_ElementContentSelection::x12_ElementContentSelection_ASGID            = ELEMENT_CONTENT_SELECTION_ASGID;              // Individual ASG ID

    if(@sysvar::DisplayConfig_ASG_ElementContentSelection::x12_ElementContentSelection_TAID_hex >= 0xF)
        @sysvar::DisplayConfig_ASG_ElementContentSelection::x12_ElementContentSelection_TAID_hex = 1;
    else
        @sysvar::DisplayConfig_ASG_ElementContentSelection::x12_ElementContentSelection_TAID_hex = (@sysvar::DisplayConfig_ASG_ElementContentSelection::x12_ElementContentSelection_TAID_hex + 1);

    @sysvar::DisplayConfig_ASG_ElementContentSelection::x12_ElementContentSelection_AH_shift         = 0;                              // No Shift
    @sysvar::DisplayConfig_ASG_ElementContentSelection::x12_ElementContentSelection_AH_direction     = 0;                              // Forwards
    @sysvar::DisplayConfig_ASG_ElementContentSelection::x12_ElementContentSelection_AH_transmitPos   = 1;                              // Transmit ArrayPos
    @sysvar::DisplayConfig_ASG_ElementContentSelection::x12_ElementContentSelection_AH_indexSize     = 0;                              // 8 Bit
    @sysvar::DisplayConfig_ASG_ElementContentSelection::x12_ElementContentSelection_AH_recordAddress = ELEMENT_CONTENT_SELECTION_RECADDR_ALL;    // Full data
    @sysvar::DisplayConfig_ASG_ElementContentSelection::x12_ElementContentSelection_AH_start_hex     = startElement;                   // following entry 
    @sysvar::DisplayConfig_ASG_ElementContentSelection::x12_ElementContentSelection_AH_elements_hex  = 1;                              // each element individual

    // Request new Array data
    ElementContentSelection_Data_lastRequestedTAID = @sysvar::DisplayConfig_ASG_ElementContentSelection::x12_ElementContentSelection_TAID_hex;
    Request_0x12_ElementContentSelection_get ();
}

DisplayPresets_getElement (int startElement)
{
    @sysvar::DisplayConfig_ASG_DisplayPresets::x1B_DisplayPresets_ASGID            = DISPLAY_PRESETS_ASGID;              // Individual ASG ID

    if(@sysvar::DisplayConfig_ASG_DisplayPresets::x1B_DisplayPresets_TAID_hex >= 0xF)
        @sysvar::DisplayConfig_ASG_DisplayPresets::x1B_DisplayPresets_TAID_hex = 1;
    else
        @sysvar::DisplayConfig_ASG_DisplayPresets::x1B_DisplayPresets_TAID_hex = (@sysvar::DisplayConfig_ASG_DisplayPresets::x1B_DisplayPresets_TAID_hex + 1);

    @sysvar::DisplayConfig_ASG_DisplayPresets::x1B_DisplayPresets_AH_shift         = 0;                              // No Shift
    @sysvar::DisplayConfig_ASG_DisplayPresets::x1B_DisplayPresets_AH_direction     = 0;                              // Forwards
    @sysvar::DisplayConfig_ASG_DisplayPresets::x1B_DisplayPresets_AH_transmitPos   = 1;                              // Transmit ArrayPos
    @sysvar::DisplayConfig_ASG_DisplayPresets::x1B_DisplayPresets_AH_indexSize     = 0;                              // 8 Bit
    @sysvar::DisplayConfig_ASG_DisplayPresets::x1B_DisplayPresets_AH_recordAddress = DISPLAY_PRESETS_RECADDR_DISPLAY123;    // Full data
    @sysvar::DisplayConfig_ASG_DisplayPresets::x1B_DisplayPresets_AH_start_hex     = startElement;                   // following entry 
    @sysvar::DisplayConfig_ASG_DisplayPresets::x1B_DisplayPresets_AH_elements_hex  = 1;                              // each element individual

    // Request new Array data
    DisplayPresets_Data_lastRequestedTAID = @sysvar::DisplayConfig_ASG_DisplayPresets::x1B_DisplayPresets_TAID_hex;
    Request_0x1B_DisplayPresets_get ();
}

DisplayPresets_init_CSV_setGet () //Byte & file selection
{
    int i = 0;
    int j = 0;
    int k = 0;

    byte dataBuffer[5000];
    int byteCount = 0;
    char file_complete[5000];

    // byte buffers to store characters
    char buffer_pos							[5];	// Byte: "0x00;"
    char buffer_state						[5];
    char buffer_displayPresetType			[5];
	char buffer_displayPresetInstance		[5];
	char buffer_Display1MainSelection		[11]; 	// 4 Byte: "0x00.00.00.00;"
	char buffer_Display1AdditionalInfo1_1	[11];
	char buffer_Display1AdditionalInfo1_2	[11];
	char buffer_Display1AdditionalInfo2_1	[11];
	char buffer_Display1AdditionalInfo2_2	[11];
	char buffer_Display2MainSelection		[11];
	char buffer_Display2AdditionalInfo1_1	[11];
	char buffer_Display2AdditionalInfo1_2	[11];
	char buffer_Display2AdditionalInfo2_1	[11];
	char buffer_Display2AdditionalInfo2_2	[11];
	char buffer_Display3MainSelection		[11];
	char buffer_Display3AdditionalInfo1_1	[11];
	char buffer_Display3AdditionalInfo1_2	[11];
	char buffer_Display3AdditionalInfo2_1	[11];
	char buffer_Display3AdditionalInfo2_2	[11];
    int buffer_incrementator = 0;

    // differentiate data fields
    enum dataTypeEnumDisplayPreset {posDisplayPreset, state, displayPresetType, displayPresetInstance,
		Display1MainSelection, Display1AdditionalInfo1_1, Display1AdditionalInfo1_2, Display1AdditionalInfo2_1, Display1AdditionalInfo2_2,
		Display2MainSelection, Display2AdditionalInfo1_1, Display2AdditionalInfo1_2, Display2AdditionalInfo2_1, Display2AdditionalInfo2_2,
		Display3MainSelection, Display3AdditionalInfo1_1, Display3AdditionalInfo1_2, Display3AdditionalInfo2_1, Display3AdditionalInfo2_2};
    int dataType = posDisplayPreset;
    int inc_csv_line;
    inc_csv_line = 0;

    // catch if no file was selected
    if(sysGetVariableArrayLength(sysvar::DisplayConfig_ASG_DisplayPresets::x1B_DisplayPresets_control_externalFilePath) == 0)
    {
        sysSetVariableString(sysvar::DisplayConfig_ASG_DisplayPresets::x1B_DisplayPresets_control_loadReload_result, "Select file first!");
        @sysvar::DisplayConfig_ASG_DisplayPresets::x1B_DisplayPresets_control_default_external    = 0;
        return;
    }

    // Get complete path
    sysGetVariableString(sysvar::DisplayConfig_ASG_DisplayPresets::x1B_DisplayPresets_control_externalFilePath, file_complete, elCount(file_complete));

    byteCount = File_readCSV (dataBuffer, file_complete);
	
    // clear old data
    DisplayPresets_clearData_setGet();

    /*** Parse data and create new DisplayPresets ***/            
    for(i=0; i<byteCount; i++)
    {
        // nextline in *.csv -> "LF" and "CR" detected
        if( (dataBuffer[i] == 0x0D) && (dataBuffer[i+1] == 0x0A) )
        {
            // Take data if not in first line
            if(inc_csv_line > 0)
            {
                DisplayPresets_Data_Pos_setGet						[atol(buffer_pos)] = atol(buffer_pos);
				DisplayPresets_Data_Validity_setGet					[atol(buffer_pos)] = 1;
				DisplayPresets_Data_State_setGet						[atol(buffer_pos)] = atol(buffer_state);
				DisplayPresets_Data_DisplayPresetType_setGet			[atol(buffer_pos)] = atol(buffer_displayPresetType);
				DisplayPresets_Data_DisplayPresetInstance_setGet		[atol(buffer_pos)] = atol(buffer_displayPresetInstance);
				DisplayPresets_Data_Display1MainSelection_setGet		[atol(buffer_pos)] = atol(buffer_Display1MainSelection);
				DisplayPresets_Data_Display1AdditionalInfo1_1_setGet	[atol(buffer_pos)] = atol(buffer_Display1AdditionalInfo1_1);
				DisplayPresets_Data_Display1AdditionalInfo1_2_setGet	[atol(buffer_pos)] = atol(buffer_Display1AdditionalInfo1_2);
				DisplayPresets_Data_Display1AdditionalInfo2_1_setGet	[atol(buffer_pos)] = atol(buffer_Display1AdditionalInfo2_1);
				DisplayPresets_Data_Display1AdditionalInfo2_2_setGet	[atol(buffer_pos)] = atol(buffer_Display1AdditionalInfo2_2);
				DisplayPresets_Data_Display2MainSelection_setGet		[atol(buffer_pos)] = atol(buffer_Display2MainSelection);
				DisplayPresets_Data_Display2AdditionalInfo1_1_setGet	[atol(buffer_pos)] = atol(buffer_Display2AdditionalInfo1_1);
				DisplayPresets_Data_Display2AdditionalInfo1_2_setGet	[atol(buffer_pos)] = atol(buffer_Display2AdditionalInfo1_2);
				DisplayPresets_Data_Display2AdditionalInfo2_1_setGet	[atol(buffer_pos)] = atol(buffer_Display2AdditionalInfo2_1);
				DisplayPresets_Data_Display2AdditionalInfo2_2_setGet	[atol(buffer_pos)] = atol(buffer_Display2AdditionalInfo2_2);
				DisplayPresets_Data_Display3MainSelection_setGet		[atol(buffer_pos)] = atol(buffer_Display3MainSelection);
				DisplayPresets_Data_Display3AdditionalInfo1_1_setGet	[atol(buffer_pos)] = atol(buffer_Display3AdditionalInfo1_1);
				DisplayPresets_Data_Display3AdditionalInfo1_2_setGet	[atol(buffer_pos)] = atol(buffer_Display3AdditionalInfo1_2);
				DisplayPresets_Data_Display3AdditionalInfo2_1_setGet	[atol(buffer_pos)] = atol(buffer_Display3AdditionalInfo2_1);
				DisplayPresets_Data_Display3AdditionalInfo2_2_setGet	[atol(buffer_pos)] = atol(buffer_Display3AdditionalInfo2_2);
            }

            inc_csv_line++;
            i++;                        // skip CR
            dataType = posDisplayPreset;// starts with pos again
            buffer_incrementator = 0;   // first buffer position

            // clear all buffers
            for(j=0; j<elCount(buffer_pos); j++)
                buffer_pos[j] = 0;
            for(j=0; j<elCount(buffer_state); j++)
                buffer_state[j] = 0;
            for(j=0; j<elCount(buffer_displayPresetType); j++)
                buffer_displayPresetType[j] = 0;
			for(j=0; j<elCount(buffer_displayPresetInstance); j++)
                buffer_displayPresetInstance[j] = 0;
			for(j=0; j<elCount(buffer_Display1MainSelection); j++)
                buffer_Display1MainSelection[j] = 0;
			for(j=0; j<elCount(buffer_Display1AdditionalInfo1_1); j++)
                buffer_Display1AdditionalInfo1_1[j] = 0;
			for(j=0; j<elCount(buffer_Display1AdditionalInfo1_2); j++)
                buffer_Display1AdditionalInfo1_2[j] = 0;
			for(j=0; j<elCount(buffer_Display1AdditionalInfo2_1); j++)
                buffer_Display1AdditionalInfo2_1[j] = 0;
			for(j=0; j<elCount(buffer_Display1AdditionalInfo2_2); j++)
                buffer_Display1AdditionalInfo2_2[j] = 0;
			for(j=0; j<elCount(buffer_Display2MainSelection); j++)
                buffer_Display2MainSelection[j] = 0;
			for(j=0; j<elCount(buffer_Display2AdditionalInfo1_1); j++)
                buffer_Display2AdditionalInfo1_1[j] = 0;
			for(j=0; j<elCount(buffer_Display2AdditionalInfo1_2); j++)
                buffer_Display2AdditionalInfo1_2[j] = 0;
			for(j=0; j<elCount(buffer_Display2AdditionalInfo2_1); j++)
                buffer_Display2AdditionalInfo2_1[j] = 0;
			for(j=0; j<elCount(buffer_Display2AdditionalInfo2_2); j++)
                buffer_Display2AdditionalInfo2_2[j] = 0;
			for(j=0; j<elCount(buffer_Display3MainSelection); j++)
                buffer_Display3MainSelection[j] = 0;
			for(j=0; j<elCount(buffer_Display3AdditionalInfo1_1); j++)
                buffer_Display3AdditionalInfo1_1[j] = 0;
			for(j=0; j<elCount(buffer_Display3AdditionalInfo1_2); j++)
                buffer_Display3AdditionalInfo1_2[j] = 0;
			for(j=0; j<elCount(buffer_Display3AdditionalInfo2_1); j++)
                buffer_Display3AdditionalInfo2_1[j] = 0;
			for(j=0; j<elCount(buffer_Display3AdditionalInfo2_2); j++)
                buffer_Display3AdditionalInfo2_2[j] = 0;
        }
        else
        // Don't work in header line
        if(inc_csv_line > 0)
        {
            // detection of ';'
            if (dataBuffer[i] == 0x3B)
            {
                dataType++;
                buffer_incrementator = 0;
            }
            else // sign to read
            {
                switch(dataType)
                {
                    case posDisplayPreset:
                        buffer_pos[buffer_incrementator] = dataBuffer[i];
                        buffer_incrementator++;
                        break;

                    case state:
                        buffer_state[buffer_incrementator] = dataBuffer[i];
                        buffer_incrementator++;
                        break;

                    case displayPresetType:
                        buffer_displayPresetType[buffer_incrementator] = dataBuffer[i];
                        buffer_incrementator++;
                        break;
						
					case displayPresetInstance:
                        buffer_displayPresetInstance[buffer_incrementator] = dataBuffer[i];
                        buffer_incrementator++;
                        break;
                    
					case Display1MainSelection:
                        buffer_Display1MainSelection[buffer_incrementator] = dataBuffer[i];
                        buffer_incrementator++;
                        break;
						
					case Display1AdditionalInfo1_1:
                        buffer_Display1AdditionalInfo1_1[buffer_incrementator] = dataBuffer[i];
                        buffer_incrementator++;
                        break;
						
					case Display1AdditionalInfo1_2:
                        buffer_Display1AdditionalInfo1_2[buffer_incrementator] = dataBuffer[i];
                        buffer_incrementator++;
                        break;
						
					case Display1AdditionalInfo2_1:
                        buffer_Display1AdditionalInfo2_1[buffer_incrementator] = dataBuffer[i];
                        buffer_incrementator++;
                        break;
						
					case Display1AdditionalInfo2_2:
                        buffer_Display1AdditionalInfo2_2[buffer_incrementator] = dataBuffer[i];
                        buffer_incrementator++;
                        break;

					case Display2MainSelection:
                        buffer_Display2MainSelection[buffer_incrementator] = dataBuffer[i];
                        buffer_incrementator++;
                        break;
						
					case Display2AdditionalInfo1_1:
                        buffer_Display2AdditionalInfo1_1[buffer_incrementator] = dataBuffer[i];
                        buffer_incrementator++;
                        break;
						
					case Display2AdditionalInfo1_2:
                        buffer_Display2AdditionalInfo1_2[buffer_incrementator] = dataBuffer[i];
                        buffer_incrementator++;
                        break;
						
					case Display2AdditionalInfo2_1:
                        buffer_Display2AdditionalInfo2_1[buffer_incrementator] = dataBuffer[i];
                        buffer_incrementator++;
                        break;
						
					case Display2AdditionalInfo2_2:
                        buffer_Display2AdditionalInfo2_2[buffer_incrementator] = dataBuffer[i];
                        buffer_incrementator++;
                        break;
						
					case Display3MainSelection:
                        buffer_Display3MainSelection[buffer_incrementator] = dataBuffer[i];
                        buffer_incrementator++;
                        break;
						
					case Display3AdditionalInfo1_1:
                        buffer_Display3AdditionalInfo1_1[buffer_incrementator] = dataBuffer[i];
                        buffer_incrementator++;
                        break;
						
					case Display3AdditionalInfo1_2:
                        buffer_Display3AdditionalInfo1_2[buffer_incrementator] = dataBuffer[i];
                        buffer_incrementator++;
                        break;
						
					case Display3AdditionalInfo2_1:
                        buffer_Display3AdditionalInfo2_1[buffer_incrementator] = dataBuffer[i];
                        buffer_incrementator++;
                        break;
						
					case Display3AdditionalInfo2_2:
                        buffer_Display3AdditionalInfo2_2[buffer_incrementator] = dataBuffer[i];
                        buffer_incrementator++;
                        break;
						
                    default:    // undefined / error
                        writelineEx(gError_Trace, CAPL_WRITE_LINE_ERROR,"Fehler beim Lesen der .csv-Datei! Ungültiger Datentyp: %d", dataType);
                        break;
                }
            }
        }
    }

	sysSetVariableString(sysvar::DisplayConfig_ASG_DisplayPresets::x1B_DisplayPresets_control_loadReload_result, "File successfully loaded!");

	DisplayPresets_Data_startPos_setGet = Array_getFirstElementPos(DisplayPresets_Data_Validity_setGet, 0);
    DisplayPresets_actualize_sysvar_setGet ();

    enableControl("DisplayConfig_ASG_Array_DisplayPresets", "btn_dataSource_external", TRUE);
}

DisplayPresets_init_static_get()
{
    // Clear old entries
    DisplayPresets_clearData_get ();

    // Anctualize system variables for Panel
    DisplayPresets_Data_startPos_get = Array_getFirstElementPos(DisplayPresets_Data_Validity_get, 0);
    DisplayPresets_actualize_sysvar_get ();
}

DisplayPresets_init_static_setGet()
{
    // Clear old entries
    DisplayPresets_clearData_setGet ();

    // Anctualize system variables for Panel
    DisplayPresets_Data_startPos_setGet = Array_getFirstElementPos(DisplayPresets_Data_Validity_setGet, 0);
    DisplayPresets_actualize_sysvar_setGet ();
}

CAN_sendGetMessage (byte function)
{
    DispalyConfig_ASG_CAN_Message.DLC      = ASG_GET_MESSAGE_DLC;
    DispalyConfig_ASG_CAN_Message.byte(0)  = ASG_GET_MESSAGE_BYTE0;
    DispalyConfig_ASG_CAN_Message.byte(1)  = function;
    output(DispalyConfig_ASG_CAN_Message);
}

void Indication_0x01_GetAll(dword indication_header [], byte indication_data[], int datalength)
{
    switch (indication_header[2])
	{
		case Data_IND:
			setTimer(startupTimer, 1500);
            break;

        case Error_IND:
            writelineEx(gError_Trace, CAPL_WRITE_LINE_ERROR, "DisplayConfig_ASG: Error-Indication in Indication_0x01_GetAll: Error 0x%x", indication_header[5]);
		    break;

        default:
			writelineEx(gBAP_Trace, CAPL_WRITE_LINE_INFORMATION, "DisplayConfig_ASG: Unhandled indication 0x%x in Indication_0x01_GetAll.", indication_header[2]);
		    break;
	} 
}

void Indication_0x02_BAP_Config(dword indication_header [], byte indication_data[], int datalength)
{
    switch (indication_header[2])
	{
		case Data_IND:
        case Reset_IND:
			extractData_0x02_BAP_Config(indication_data);
			
			if(@sysvar::DisplayConfig_General::Smart)
        		Request_0x03_FunctionList(DataGet_REQ);	
            break;
        
		case Error_IND:
            writelineEx(gError_Trace, CAPL_WRITE_LINE_ERROR, "DisplayConfig_ASG: Error-Indication in Indication_0x02_BAP_Config: Error 0x%x", indication_header[5]);
		    break;
			
        default:
			writelineEx(gBAP_Trace, CAPL_WRITE_LINE_INFORMATION, "DisplayConfig_ASG: Unhandled indication 0x%x in Indication_0x02_BAP_Config.", indication_header[2]);
		    break;
	}
    
    controls_setFunctionActive(FUNCTION_LIST_FCT_ID, TRUE);
}

void extractData_0x02_BAP_Config(byte indication_data[])
{
	@sysvar::DisplayConfig_ASG::x02_BAPConfig_BAP_major 	= indication_data[0];
	@sysvar::DisplayConfig_ASG::x02_BAPConfig_BAP_minor 	= indication_data[1];
	@sysvar::DisplayConfig_ASG::x02_BAPConfig_LSG_Class 	= indication_data[2];
	@sysvar::DisplayConfig_ASG::x02_BAPConfig_LSG_SubClass 	= indication_data[3];
	@sysvar::DisplayConfig_ASG::x02_BAPConfig_DF_VerMajor 	= indication_data[4];
	@sysvar::DisplayConfig_ASG::x02_BAPConfig_DF_VerMinor 	= indication_data[5];
}

void extractData_0x03_FunctionList(byte indication_data[])
{
	// Byte [0]
	@sysvar::DisplayConfig_ASG::x03_FctList_0x01_GetAll            			= (indication_data[0] >> 6) & 0x01;
	@sysvar::DisplayConfig_ASG::x03_FctList_0x02_BAPConfig        			= (indication_data[0] >> 5) & 0x01;
	@sysvar::DisplayConfig_ASG::x03_FctList_0x03_FctList           			= (indication_data[0] >> 4) & 0x01;
	@sysvar::DisplayConfig_ASG::x03_FctList_0x04_HeartBeat         			= (indication_data[0] >> 3) & 0x01;
	
	// Byte [1]
	@sysvar::DisplayConfig_ASG::x03_FctList_0x0D_FSG_Control      			= (indication_data[1] >> 2) & 0x01;
	@sysvar::DisplayConfig_ASG::x03_FctList_0x0E_FSG_Setup        			= (indication_data[1] >> 1) & 0x01;
	@sysvar::DisplayConfig_ASG::x03_FctList_0x0F_FSG_OperationState			= (indication_data[1] >> 0) & 0x01;
	
	// Byte [2]
	@sysvar::DisplayConfig_ASG::x03_FctList_0x10_Brightness					= (indication_data[2] >> 7) & 0x01;
	@sysvar::DisplayConfig_ASG::x03_FctList_0x11_Volume						= (indication_data[2] >> 6) & 0x01;
	@sysvar::DisplayConfig_ASG::x03_FctList_0x12_ElementContentSelection	= (indication_data[2] >> 5) & 0x01;
	@sysvar::DisplayConfig_ASG::x03_FctList_0x13_Display1Setup				= (indication_data[2] >> 4) & 0x01;
	@sysvar::DisplayConfig_ASG::x03_FctList_0x14_Display1MainSelection		= (indication_data[2] >> 3) & 0x01;
	@sysvar::DisplayConfig_ASG::x03_FctList_0x15_Display2Setup				= (indication_data[2] >> 2) & 0x01;
	@sysvar::DisplayConfig_ASG::x03_FctList_0x16_Display2MainSelection		= (indication_data[2] >> 1) & 0x01;
	@sysvar::DisplayConfig_ASG::x03_FctList_0x17_Display3Setup				= (indication_data[2] >> 0) & 0x01;
		
	// Byte [3]	
	@sysvar::DisplayConfig_ASG::x03_FctList_0x18_Display3MainSelection		= (indication_data[3] >> 7) & 0x01;
	@sysvar::DisplayConfig_ASG::x03_FctList_0x19_AdditionalInstrument		= (indication_data[3] >> 6) & 0x01;
	@sysvar::DisplayConfig_ASG::x03_FctList_0x1A_AdditionalInstrument2		= (indication_data[3] >> 5) & 0x01;
	@sysvar::DisplayConfig_ASG::x03_FctList_0x1B_DisplayPresets				= (indication_data[3] >> 4) & 0x01;
	@sysvar::DisplayConfig_ASG::x03_FctList_0x1C_DisplayDependency			= (indication_data[3] >> 3) & 0x01;
	@sysvar::DisplayConfig_ASG::x03_FctList_0x1D_ActiveDisplayPreset		= (indication_data[3] >> 2) & 0x01;
	@sysvar::DisplayConfig_ASG::x03_FctList_0x1E_DisplayViewConfiguration	= (indication_data[3] >> 1) & 0x01;
	@sysvar::DisplayConfig_ASG::x03_FctList_0x1F_LED_Configuration			= (indication_data[3] >> 0) & 0x01;
}

void extractData_0x04_HeartBeat(byte headerValue)
{
	@sysvar::DisplayConfig_ASG::x04_HeartBeat_HeartBeatTime = headerValue;  
}

void extractData_0x0D_FSG_Control(byte headerValue)
{
	@sysvar::DisplayConfig_ASG::x0D_FSG_Control_Controlcode_Bit0 = (headerValue >> 0) & 0x01;
}

void extractData_0x0E_FSG_Setup(byte indication_data[])
{
	byte byteBuffer;
	@sysvar::DisplayConfig_ASG::x0E_FSG_Setup_MaxVolume = indication_data[0];

	@sysvar::DisplayConfig_ASG::x0E_FSG_Setup_FunctionSupport_Bit0 = (indication_data[1] >> 0) & 0x01;

	@sysvar::DisplayConfig_ASG::x0E_FSG_Setup_Extension1 = indication_data[2];
	@sysvar::DisplayConfig_ASG::x0E_FSG_Setup_Extension2 = indication_data[3];
	@sysvar::DisplayConfig_ASG::x0E_FSG_Setup_Extension3 = indication_data[4];
	@sysvar::DisplayConfig_ASG::x0E_FSG_Setup_Extension4 = indication_data[5];
}

void extractData_0x0F_FSG_OperationState(byte headerValue)
{
	@sysvar::DisplayConfig_ASG::x0F_FSG_OperationState_OPState = headerValue;
}

void extractData_0x10_Brightness(byte indication_data[])
{
	@sysvar::DisplayConfig_ASG_Prop::x10_Brightness_Setup 					= indication_data[0];
	@sysvar::DisplayConfig_ASG_Prop::x10_Brightness_ModificationReason 		= (indication_data[1] >> 4) & 0x0F;
	@sysvar::DisplayConfig_ASG_Prop::x10_Brightness_ModificationState_Bit0 	= (indication_data[1] >> 0) & 0x01;
}

void extractData_0x11_Volume(byte indication_data[])
{
	@sysvar::DisplayConfig_ASG_Prop::x11_Volume_Setup 					= indication_data[0];
	@sysvar::DisplayConfig_ASG_Prop::x11_Volume_ModificationReason 		= (indication_data[1] >> 4) & 0x0F;
	@sysvar::DisplayConfig_ASG_Prop::x11_Volume_ModificationState_Bit0 	= (indication_data[1] >> 0) & 0x01;
}

void extractData_0x12_ElementContentSelection(byte indication_data[])
{
	byte transmitPos, recordAddress, idxSize, direction, shift;
	int startEl, elements;
	word wordBuffer;
	int byteCounter, actualPos;
	int i;
	
	// Init helper variable
	transmitPos 	= Array_DecodeModeByte_getTransmitPos(indication_data[2]);
	recordAddress	= Array_DecodeModeByte_getRecordAddress(indication_data[2]);
	idxSize			= Array_DecodeModeByte_getIdxSize(indication_data[2]);
	direction		= Array_DecodeModeByte_getDirection(indication_data[2]);
	shift			= Array_DecodeModeByte_getShift(indication_data[2]);
	
	// Catch invalid RecordAddress
	if    (recordAddress != ELEMENT_CONTENT_SELECTION_RECADDR_RESERVED
		&& recordAddress != ELEMENT_CONTENT_SELECTION_RECADDR_ALL
		&& recordAddress != ELEMENT_CONTENT_SELECTION_RECADDR_EL_CONTENT
		&& recordAddress != ELEMENT_CONTENT_SELECTION_RECADDR_POS)
		return;
	
	//buffer[0] = ASG_ID/TAID;
    //buffer[1] = tnle;
    //buffer[2] = modeByte;  
    if(idxSize == 0)                                                                        // 8 bit addressing
    {
        startEl = indication_data[3];
        elements = indication_data[4];
		byteCounter = 5;
    }
    else                                                                                    // 16 bit addressing
    {
		wordBuffer = indication_data[4];
		wordBuffer = (wordBuffer << 8);
        wordBuffer |= indication_data[3];
		startEl = wordBuffer;

		wordBuffer = indication_data[6];
		wordBuffer = (wordBuffer << 8);
        wordBuffer |= indication_data[5];
		elements = wordBuffer;
		
		byteCounter = 7;
    }
	
	// use Pos parameter to differentiate elements
	if(transmitPos == 1 || recordAddress == ELEMENT_CONTENT_SELECTION_RECADDR_POS)
    {
		for(i=0; i<elements; i++)
		{
			if(idxSize == 0)
			{
				actualPos = indication_data[byteCounter];
				byteCounter++;
			}
			else
			{
				wordBuffer = indication_data[byteCounter + 1];
				wordBuffer = (wordBuffer << 8);
        		wordBuffer |= indication_data[byteCounter];
				actualPos = wordBuffer;
				byteCounter++;
				byteCounter++;
            }
			byteCounter = extractData_0x12_ElementContentSelection_singleElement(indication_data, recordAddress, actualPos, byteCounter);
		}
	}
	// use start, shift, direction and elements parameter
	else
	{
		actualPos = startEl;
		if(direction == 0)
		{
			if (shift == 1)
				actualPos++;
			
			for(i=0; i<elements; i++)
			{
				byteCounter = extractData_0x12_ElementContentSelection_singleElement(indication_data, recordAddress, actualPos, byteCounter);
				actualPos++;
			}
		}
		else
		{
			if (shift == 1)
				actualPos--;
			
			for(i=0; i<elements; i++)
			{
				byteCounter = extractData_0x12_ElementContentSelection_singleElement(indication_data, recordAddress, actualPos, byteCounter);
				actualPos--;
			}
		}
    }
}

int extractData_0x12_ElementContentSelection_singleElement(byte indication_data[], byte recordAddress, word pos, int startByte)
{
	int idx;
	byte byteBuffer;
	idx = startByte;
	
	ElementContentSelection_Data_Validity_get[pos] 				= 1;
	ElementContentSelection_Data_Pos_get[pos] 					= pos;
	
	if(recordAddress == ELEMENT_CONTENT_SELECTION_RECADDR_RESERVED)
	{
		ElementContentSelection_Data_Display_get[pos] 			= 1;
		ElementContentSelection_Data_AdditionalInfo_get[pos] 	= 1;

		ElementContentSelection_Data_Element_get[pos]			= 1;
		
		ElementContentSelection_Data_ElementContent_get[pos] 	= 0;
    }
	
    // Display, AdditionalInfo, Element - if transmission is enabled via recordAddress
	if(recordAddress == ELEMENT_CONTENT_SELECTION_RECADDR_ALL)
	{
		byteBuffer = indication_data[idx];
		ElementContentSelection_Data_Display_get[pos] 			= (byteBuffer & 0xF0) >> 4;
		ElementContentSelection_Data_AdditionalInfo_get[pos] 	= (byteBuffer & 0x0F) >> 0;
		idx++;

		ElementContentSelection_Data_Element_get[pos]			= indication_data[idx];
		idx++;
		
		ElementContentSelection_Data_ElementContent_get[pos] 	= indication_data[idx];
		idx++;
    }
	
    // ElementContent - if transmission is enabled via recordAddress
	if(recordAddress == ELEMENT_CONTENT_SELECTION_RECADDR_EL_CONTENT)
	{
		ElementContentSelection_Data_Display_get[pos] 			= 1;
		ElementContentSelection_Data_AdditionalInfo_get[pos] 	= 1;

		ElementContentSelection_Data_Element_get[pos]			= 1;
		
		ElementContentSelection_Data_ElementContent_get[pos] 	= indication_data[idx];
		idx++;
    }
	
	ElementContentSelection_actualize_sysvar_get();
	
	return idx;
}

void extractData_0x13_Display1Setup(byte indication_data[])
{
	// start MainSetup (4 byte)
	@sysvar::DisplayConfig_ASG_Prop_Display1::DisplaySetup_MainSetup_Bit00 = (indication_data[0] >> 0) & 0x01;
	@sysvar::DisplayConfig_ASG_Prop_Display1::DisplaySetup_MainSetup_Bit01 = (indication_data[0] >> 1) & 0x01;
	@sysvar::DisplayConfig_ASG_Prop_Display1::DisplaySetup_MainSetup_Bit02 = (indication_data[0] >> 2) & 0x01;
	@sysvar::DisplayConfig_ASG_Prop_Display1::DisplaySetup_MainSetup_Bit03 = (indication_data[0] >> 3) & 0x01;
	@sysvar::DisplayConfig_ASG_Prop_Display1::DisplaySetup_MainSetup_Bit04 = (indication_data[0] >> 4) & 0x01;
	@sysvar::DisplayConfig_ASG_Prop_Display1::DisplaySetup_MainSetup_Bit05 = (indication_data[0] >> 5) & 0x01;
	@sysvar::DisplayConfig_ASG_Prop_Display1::DisplaySetup_MainSetup_Bit06 = (indication_data[0] >> 6) & 0x01;
	@sysvar::DisplayConfig_ASG_Prop_Display1::DisplaySetup_MainSetup_Bit07 = (indication_data[0] >> 7) & 0x01;

	@sysvar::DisplayConfig_ASG_Prop_Display1::DisplaySetup_MainSetup_Bit08 = (indication_data[1] >> 0) & 0x01;
	@sysvar::DisplayConfig_ASG_Prop_Display1::DisplaySetup_MainSetup_Bit09 = (indication_data[1] >> 1) & 0x01;
	@sysvar::DisplayConfig_ASG_Prop_Display1::DisplaySetup_MainSetup_Bit10 = (indication_data[1] >> 2) & 0x01;
	@sysvar::DisplayConfig_ASG_Prop_Display1::DisplaySetup_MainSetup_Bit11 = (indication_data[1] >> 3) & 0x01;
	@sysvar::DisplayConfig_ASG_Prop_Display1::DisplaySetup_MainSetup_Bit12 = (indication_data[1] >> 4) & 0x01;
	@sysvar::DisplayConfig_ASG_Prop_Display1::DisplaySetup_MainSetup_Bit13 = (indication_data[1] >> 5) & 0x01;
	@sysvar::DisplayConfig_ASG_Prop_Display1::DisplaySetup_MainSetup_Bit14 = (indication_data[1] >> 6) & 0x01;
	@sysvar::DisplayConfig_ASG_Prop_Display1::DisplaySetup_MainSetup_Bit15 = (indication_data[1] >> 7) & 0x01;

	@sysvar::DisplayConfig_ASG_Prop_Display1::DisplaySetup_MainSetup_Bit16 = (indication_data[2] >> 0) & 0x01;
	@sysvar::DisplayConfig_ASG_Prop_Display1::DisplaySetup_MainSetup_Bit17 = (indication_data[2] >> 1) & 0x01;
	@sysvar::DisplayConfig_ASG_Prop_Display1::DisplaySetup_MainSetup_Bit18 = (indication_data[2] >> 2) & 0x01;
	@sysvar::DisplayConfig_ASG_Prop_Display1::DisplaySetup_MainSetup_Bit19 = (indication_data[2] >> 3) & 0x01;
	@sysvar::DisplayConfig_ASG_Prop_Display1::DisplaySetup_MainSetup_Bit20 = (indication_data[2] >> 4) & 0x01;
	@sysvar::DisplayConfig_ASG_Prop_Display1::DisplaySetup_MainSetup_Bit21 = (indication_data[2] >> 5) & 0x01;
	@sysvar::DisplayConfig_ASG_Prop_Display1::DisplaySetup_MainSetup_Bit22 = (indication_data[2] >> 6) & 0x01;
	@sysvar::DisplayConfig_ASG_Prop_Display1::DisplaySetup_MainSetup_Bit23 = (indication_data[2] >> 7) & 0x01;
	
	@sysvar::DisplayConfig_ASG_Prop_Display1::DisplaySetup_MainSetup_Bit24 = (indication_data[3] >> 0) & 0x01;
	@sysvar::DisplayConfig_ASG_Prop_Display1::DisplaySetup_MainSetup_Bit25 = (indication_data[3] >> 1) & 0x01;
	@sysvar::DisplayConfig_ASG_Prop_Display1::DisplaySetup_MainSetup_Bit26 = (indication_data[3] >> 2) & 0x01;
	@sysvar::DisplayConfig_ASG_Prop_Display1::DisplaySetup_MainSetup_Bit27 = (indication_data[3] >> 3) & 0x01;
	@sysvar::DisplayConfig_ASG_Prop_Display1::DisplaySetup_MainSetup_Bit28 = (indication_data[3] >> 4) & 0x01;
	
	// start DisplayedAdditionalInfos (1 byte)
	@sysvar::DisplayConfig_ASG_Prop_Display1::DisplaySetup_DisplayedAdditionalInfos_Bit00 = (indication_data[4] >> 0) & 0x01;
	@sysvar::DisplayConfig_ASG_Prop_Display1::DisplaySetup_DisplayedAdditionalInfos_Bit01 = (indication_data[4] >> 1) & 0x01;
	
	// start AdditionalInfo1_1 (4 byte)
	@sysvar::DisplayConfig_ASG_Prop_Display1::DisplaySetup_AdditionalInfo_1_1_Bit00 = (indication_data[5] >> 0) & 0x01;
	@sysvar::DisplayConfig_ASG_Prop_Display1::DisplaySetup_AdditionalInfo_1_1_Bit01 = (indication_data[5] >> 1) & 0x01;
	@sysvar::DisplayConfig_ASG_Prop_Display1::DisplaySetup_AdditionalInfo_1_1_Bit02 = (indication_data[5] >> 2) & 0x01;
	@sysvar::DisplayConfig_ASG_Prop_Display1::DisplaySetup_AdditionalInfo_1_1_Bit03 = (indication_data[5] >> 3) & 0x01;
	@sysvar::DisplayConfig_ASG_Prop_Display1::DisplaySetup_AdditionalInfo_1_1_Bit04 = (indication_data[5] >> 4) & 0x01;
	@sysvar::DisplayConfig_ASG_Prop_Display1::DisplaySetup_AdditionalInfo_1_1_Bit05 = (indication_data[5] >> 5) & 0x01;
	@sysvar::DisplayConfig_ASG_Prop_Display1::DisplaySetup_AdditionalInfo_1_1_Bit06 = (indication_data[5] >> 6) & 0x01;
	@sysvar::DisplayConfig_ASG_Prop_Display1::DisplaySetup_AdditionalInfo_1_1_Bit07 = (indication_data[5] >> 7) & 0x01;

	@sysvar::DisplayConfig_ASG_Prop_Display1::DisplaySetup_AdditionalInfo_1_1_Bit08 = (indication_data[6] >> 0) & 0x01;
	@sysvar::DisplayConfig_ASG_Prop_Display1::DisplaySetup_AdditionalInfo_1_1_Bit09 = (indication_data[6] >> 1) & 0x01;
	@sysvar::DisplayConfig_ASG_Prop_Display1::DisplaySetup_AdditionalInfo_1_1_Bit10 = (indication_data[6] >> 2) & 0x01;
	@sysvar::DisplayConfig_ASG_Prop_Display1::DisplaySetup_AdditionalInfo_1_1_Bit11 = (indication_data[6] >> 3) & 0x01;
	@sysvar::DisplayConfig_ASG_Prop_Display1::DisplaySetup_AdditionalInfo_1_1_Bit12 = (indication_data[6] >> 4) & 0x01;
	@sysvar::DisplayConfig_ASG_Prop_Display1::DisplaySetup_AdditionalInfo_1_1_Bit13 = (indication_data[6] >> 5) & 0x01;
	@sysvar::DisplayConfig_ASG_Prop_Display1::DisplaySetup_AdditionalInfo_1_1_Bit14 = (indication_data[6] >> 6) & 0x01;
	@sysvar::DisplayConfig_ASG_Prop_Display1::DisplaySetup_AdditionalInfo_1_1_Bit15 = (indication_data[6] >> 7) & 0x01;
	
	@sysvar::DisplayConfig_ASG_Prop_Display1::DisplaySetup_AdditionalInfo_1_1_Bit16 = (indication_data[7] >> 0) & 0x01;
	@sysvar::DisplayConfig_ASG_Prop_Display1::DisplaySetup_AdditionalInfo_1_1_Bit17 = (indication_data[7] >> 1) & 0x01;
	@sysvar::DisplayConfig_ASG_Prop_Display1::DisplaySetup_AdditionalInfo_1_1_Bit18 = (indication_data[7] >> 2) & 0x01;
	@sysvar::DisplayConfig_ASG_Prop_Display1::DisplaySetup_AdditionalInfo_1_1_Bit19 = (indication_data[7] >> 3) & 0x01;
	@sysvar::DisplayConfig_ASG_Prop_Display1::DisplaySetup_AdditionalInfo_1_1_Bit20 = (indication_data[7] >> 4) & 0x01;
	@sysvar::DisplayConfig_ASG_Prop_Display1::DisplaySetup_AdditionalInfo_1_1_Bit21 = (indication_data[7] >> 5) & 0x01;
	@sysvar::DisplayConfig_ASG_Prop_Display1::DisplaySetup_AdditionalInfo_1_1_Bit22 = (indication_data[7] >> 6) & 0x01;
	@sysvar::DisplayConfig_ASG_Prop_Display1::DisplaySetup_AdditionalInfo_1_1_Bit23 = (indication_data[7] >> 7) & 0x01;
	
	@sysvar::DisplayConfig_ASG_Prop_Display1::DisplaySetup_AdditionalInfo_1_1_Bit24 = (indication_data[8] >> 0) & 0x01;
	@sysvar::DisplayConfig_ASG_Prop_Display1::DisplaySetup_AdditionalInfo_1_1_Bit25 = (indication_data[8] >> 1) & 0x01;
	@sysvar::DisplayConfig_ASG_Prop_Display1::DisplaySetup_AdditionalInfo_1_1_Bit26 = (indication_data[8] >> 2) & 0x01;
	@sysvar::DisplayConfig_ASG_Prop_Display1::DisplaySetup_AdditionalInfo_1_1_Bit27 = (indication_data[8] >> 3) & 0x01;
	@sysvar::DisplayConfig_ASG_Prop_Display1::DisplaySetup_AdditionalInfo_1_1_Bit28 = (indication_data[8] >> 4) & 0x01;
	@sysvar::DisplayConfig_ASG_Prop_Display1::DisplaySetup_AdditionalInfo_1_1_Bit29 = (indication_data[8] >> 5) & 0x01;
	@sysvar::DisplayConfig_ASG_Prop_Display1::DisplaySetup_AdditionalInfo_1_1_Bit30 = (indication_data[8] >> 6) & 0x01;
	@sysvar::DisplayConfig_ASG_Prop_Display1::DisplaySetup_AdditionalInfo_1_1_Bit31 = (indication_data[8] >> 7) & 0x01;
	
	// start AdditionalInfo1_2 (4 byte)
	@sysvar::DisplayConfig_ASG_Prop_Display1::DisplaySetup_AdditionalInfo_1_2_Bit00 = (indication_data[9] >> 0) & 0x01;
	@sysvar::DisplayConfig_ASG_Prop_Display1::DisplaySetup_AdditionalInfo_1_2_Bit01 = (indication_data[9] >> 1) & 0x01;
	@sysvar::DisplayConfig_ASG_Prop_Display1::DisplaySetup_AdditionalInfo_1_2_Bit02 = (indication_data[9] >> 2) & 0x01;
	@sysvar::DisplayConfig_ASG_Prop_Display1::DisplaySetup_AdditionalInfo_1_2_Bit03 = (indication_data[9] >> 3) & 0x01;
	@sysvar::DisplayConfig_ASG_Prop_Display1::DisplaySetup_AdditionalInfo_1_2_Bit04 = (indication_data[9] >> 4) & 0x01;
	@sysvar::DisplayConfig_ASG_Prop_Display1::DisplaySetup_AdditionalInfo_1_2_Bit05 = (indication_data[9] >> 5) & 0x01;
	@sysvar::DisplayConfig_ASG_Prop_Display1::DisplaySetup_AdditionalInfo_1_2_Bit06 = (indication_data[9] >> 6) & 0x01;
	@sysvar::DisplayConfig_ASG_Prop_Display1::DisplaySetup_AdditionalInfo_1_2_Bit07 = (indication_data[9] >> 7) & 0x01;

	@sysvar::DisplayConfig_ASG_Prop_Display1::DisplaySetup_AdditionalInfo_1_2_Bit08 = (indication_data[10] >> 0) & 0x01;
	@sysvar::DisplayConfig_ASG_Prop_Display1::DisplaySetup_AdditionalInfo_1_2_Bit09 = (indication_data[10] >> 1) & 0x01;
	@sysvar::DisplayConfig_ASG_Prop_Display1::DisplaySetup_AdditionalInfo_1_2_Bit10 = (indication_data[10] >> 2) & 0x01;
	@sysvar::DisplayConfig_ASG_Prop_Display1::DisplaySetup_AdditionalInfo_1_2_Bit11 = (indication_data[10] >> 3) & 0x01;
	@sysvar::DisplayConfig_ASG_Prop_Display1::DisplaySetup_AdditionalInfo_1_2_Bit12 = (indication_data[10] >> 4) & 0x01;
	@sysvar::DisplayConfig_ASG_Prop_Display1::DisplaySetup_AdditionalInfo_1_2_Bit13 = (indication_data[10] >> 5) & 0x01;
	@sysvar::DisplayConfig_ASG_Prop_Display1::DisplaySetup_AdditionalInfo_1_2_Bit14 = (indication_data[10] >> 6) & 0x01;
	@sysvar::DisplayConfig_ASG_Prop_Display1::DisplaySetup_AdditionalInfo_1_2_Bit15 = (indication_data[10] >> 7) & 0x01;
	
	@sysvar::DisplayConfig_ASG_Prop_Display1::DisplaySetup_AdditionalInfo_1_2_Bit16 = (indication_data[11] >> 0) & 0x01;
	@sysvar::DisplayConfig_ASG_Prop_Display1::DisplaySetup_AdditionalInfo_1_2_Bit17 = (indication_data[11] >> 1) & 0x01;
	@sysvar::DisplayConfig_ASG_Prop_Display1::DisplaySetup_AdditionalInfo_1_2_Bit18 = (indication_data[11] >> 2) & 0x01;
	@sysvar::DisplayConfig_ASG_Prop_Display1::DisplaySetup_AdditionalInfo_1_2_Bit19 = (indication_data[11] >> 3) & 0x01;
	@sysvar::DisplayConfig_ASG_Prop_Display1::DisplaySetup_AdditionalInfo_1_2_Bit20 = (indication_data[11] >> 4) & 0x01;
	@sysvar::DisplayConfig_ASG_Prop_Display1::DisplaySetup_AdditionalInfo_1_2_Bit21 = (indication_data[11] >> 5) & 0x01;
	@sysvar::DisplayConfig_ASG_Prop_Display1::DisplaySetup_AdditionalInfo_1_2_Bit22 = (indication_data[11] >> 6) & 0x01;
	@sysvar::DisplayConfig_ASG_Prop_Display1::DisplaySetup_AdditionalInfo_1_2_Bit23 = (indication_data[11] >> 7) & 0x01;
	
	@sysvar::DisplayConfig_ASG_Prop_Display1::DisplaySetup_AdditionalInfo_1_2_Bit24 = (indication_data[12] >> 0) & 0x01;
	@sysvar::DisplayConfig_ASG_Prop_Display1::DisplaySetup_AdditionalInfo_1_2_Bit25 = (indication_data[12] >> 1) & 0x01;
	@sysvar::DisplayConfig_ASG_Prop_Display1::DisplaySetup_AdditionalInfo_1_2_Bit26 = (indication_data[12] >> 2) & 0x01;
	@sysvar::DisplayConfig_ASG_Prop_Display1::DisplaySetup_AdditionalInfo_1_2_Bit27 = (indication_data[12] >> 3) & 0x01;
	@sysvar::DisplayConfig_ASG_Prop_Display1::DisplaySetup_AdditionalInfo_1_2_Bit28 = (indication_data[12] >> 4) & 0x01;
	@sysvar::DisplayConfig_ASG_Prop_Display1::DisplaySetup_AdditionalInfo_1_2_Bit29 = (indication_data[12] >> 5) & 0x01;
	
		// start AdditionalInfo2_1 (4 byte)
	@sysvar::DisplayConfig_ASG_Prop_Display1::DisplaySetup_AdditionalInfo_2_1_Bit00 = (indication_data[13] >> 0) & 0x01;
	@sysvar::DisplayConfig_ASG_Prop_Display1::DisplaySetup_AdditionalInfo_2_1_Bit01 = (indication_data[13] >> 1) & 0x01;
	@sysvar::DisplayConfig_ASG_Prop_Display1::DisplaySetup_AdditionalInfo_2_1_Bit02 = (indication_data[13] >> 2) & 0x01;
	@sysvar::DisplayConfig_ASG_Prop_Display1::DisplaySetup_AdditionalInfo_2_1_Bit03 = (indication_data[13] >> 3) & 0x01;
	@sysvar::DisplayConfig_ASG_Prop_Display1::DisplaySetup_AdditionalInfo_2_1_Bit04 = (indication_data[13] >> 4) & 0x01;
	@sysvar::DisplayConfig_ASG_Prop_Display1::DisplaySetup_AdditionalInfo_2_1_Bit05 = (indication_data[13] >> 5) & 0x01;
	@sysvar::DisplayConfig_ASG_Prop_Display1::DisplaySetup_AdditionalInfo_2_1_Bit06 = (indication_data[13] >> 6) & 0x01;
	@sysvar::DisplayConfig_ASG_Prop_Display1::DisplaySetup_AdditionalInfo_2_1_Bit07 = (indication_data[13] >> 7) & 0x01;

	@sysvar::DisplayConfig_ASG_Prop_Display1::DisplaySetup_AdditionalInfo_2_1_Bit08 = (indication_data[14] >> 0) & 0x01;
	@sysvar::DisplayConfig_ASG_Prop_Display1::DisplaySetup_AdditionalInfo_2_1_Bit09 = (indication_data[14] >> 1) & 0x01;
	@sysvar::DisplayConfig_ASG_Prop_Display1::DisplaySetup_AdditionalInfo_2_1_Bit10 = (indication_data[14] >> 2) & 0x01;
	@sysvar::DisplayConfig_ASG_Prop_Display1::DisplaySetup_AdditionalInfo_2_1_Bit11 = (indication_data[14] >> 3) & 0x01;
	@sysvar::DisplayConfig_ASG_Prop_Display1::DisplaySetup_AdditionalInfo_2_1_Bit12 = (indication_data[14] >> 4) & 0x01;
	@sysvar::DisplayConfig_ASG_Prop_Display1::DisplaySetup_AdditionalInfo_2_1_Bit13 = (indication_data[14] >> 5) & 0x01;
	@sysvar::DisplayConfig_ASG_Prop_Display1::DisplaySetup_AdditionalInfo_2_1_Bit14 = (indication_data[14] >> 6) & 0x01;
	@sysvar::DisplayConfig_ASG_Prop_Display1::DisplaySetup_AdditionalInfo_2_1_Bit15 = (indication_data[14] >> 7) & 0x01;
	
	@sysvar::DisplayConfig_ASG_Prop_Display1::DisplaySetup_AdditionalInfo_2_1_Bit16 = (indication_data[15] >> 0) & 0x01;
	@sysvar::DisplayConfig_ASG_Prop_Display1::DisplaySetup_AdditionalInfo_2_1_Bit17 = (indication_data[15] >> 1) & 0x01;
	@sysvar::DisplayConfig_ASG_Prop_Display1::DisplaySetup_AdditionalInfo_2_1_Bit18 = (indication_data[15] >> 2) & 0x01;
	@sysvar::DisplayConfig_ASG_Prop_Display1::DisplaySetup_AdditionalInfo_2_1_Bit19 = (indication_data[15] >> 3) & 0x01;
	@sysvar::DisplayConfig_ASG_Prop_Display1::DisplaySetup_AdditionalInfo_2_1_Bit20 = (indication_data[15] >> 4) & 0x01;
	@sysvar::DisplayConfig_ASG_Prop_Display1::DisplaySetup_AdditionalInfo_2_1_Bit21 = (indication_data[15] >> 5) & 0x01;
	@sysvar::DisplayConfig_ASG_Prop_Display1::DisplaySetup_AdditionalInfo_2_1_Bit22 = (indication_data[15] >> 6) & 0x01;
	@sysvar::DisplayConfig_ASG_Prop_Display1::DisplaySetup_AdditionalInfo_2_1_Bit23 = (indication_data[15] >> 7) & 0x01;
	
	@sysvar::DisplayConfig_ASG_Prop_Display1::DisplaySetup_AdditionalInfo_2_1_Bit24 = (indication_data[16] >> 0) & 0x01;
	@sysvar::DisplayConfig_ASG_Prop_Display1::DisplaySetup_AdditionalInfo_2_1_Bit25 = (indication_data[16] >> 1) & 0x01;
	@sysvar::DisplayConfig_ASG_Prop_Display1::DisplaySetup_AdditionalInfo_2_1_Bit26 = (indication_data[16] >> 2) & 0x01;
	@sysvar::DisplayConfig_ASG_Prop_Display1::DisplaySetup_AdditionalInfo_2_1_Bit27 = (indication_data[16] >> 3) & 0x01;
	@sysvar::DisplayConfig_ASG_Prop_Display1::DisplaySetup_AdditionalInfo_2_1_Bit28 = (indication_data[16] >> 4) & 0x01;
	@sysvar::DisplayConfig_ASG_Prop_Display1::DisplaySetup_AdditionalInfo_2_1_Bit29 = (indication_data[16] >> 5) & 0x01;
	@sysvar::DisplayConfig_ASG_Prop_Display1::DisplaySetup_AdditionalInfo_2_1_Bit30 = (indication_data[16] >> 6) & 0x01;
	@sysvar::DisplayConfig_ASG_Prop_Display1::DisplaySetup_AdditionalInfo_2_1_Bit31 = (indication_data[16] >> 7) & 0x01;
	
		// start AdditionalInfo2_2 (4 byte)
	@sysvar::DisplayConfig_ASG_Prop_Display1::DisplaySetup_AdditionalInfo_2_2_Bit00 = (indication_data[17] >> 0) & 0x01;
	@sysvar::DisplayConfig_ASG_Prop_Display1::DisplaySetup_AdditionalInfo_2_2_Bit01 = (indication_data[17] >> 1) & 0x01;
	@sysvar::DisplayConfig_ASG_Prop_Display1::DisplaySetup_AdditionalInfo_2_2_Bit02 = (indication_data[17] >> 2) & 0x01;
	@sysvar::DisplayConfig_ASG_Prop_Display1::DisplaySetup_AdditionalInfo_2_2_Bit03 = (indication_data[17] >> 3) & 0x01;
	@sysvar::DisplayConfig_ASG_Prop_Display1::DisplaySetup_AdditionalInfo_2_2_Bit04 = (indication_data[17] >> 4) & 0x01;
	@sysvar::DisplayConfig_ASG_Prop_Display1::DisplaySetup_AdditionalInfo_2_2_Bit05 = (indication_data[17] >> 5) & 0x01;
	@sysvar::DisplayConfig_ASG_Prop_Display1::DisplaySetup_AdditionalInfo_2_2_Bit06 = (indication_data[17] >> 6) & 0x01;
	@sysvar::DisplayConfig_ASG_Prop_Display1::DisplaySetup_AdditionalInfo_2_2_Bit07 = (indication_data[17] >> 7) & 0x01;

	@sysvar::DisplayConfig_ASG_Prop_Display1::DisplaySetup_AdditionalInfo_2_2_Bit08 = (indication_data[18] >> 0) & 0x01;
	@sysvar::DisplayConfig_ASG_Prop_Display1::DisplaySetup_AdditionalInfo_2_2_Bit09 = (indication_data[18] >> 1) & 0x01;
	@sysvar::DisplayConfig_ASG_Prop_Display1::DisplaySetup_AdditionalInfo_2_2_Bit10 = (indication_data[18] >> 2) & 0x01;
	@sysvar::DisplayConfig_ASG_Prop_Display1::DisplaySetup_AdditionalInfo_2_2_Bit11 = (indication_data[18] >> 3) & 0x01;
	@sysvar::DisplayConfig_ASG_Prop_Display1::DisplaySetup_AdditionalInfo_2_2_Bit12 = (indication_data[18] >> 4) & 0x01;
	@sysvar::DisplayConfig_ASG_Prop_Display1::DisplaySetup_AdditionalInfo_2_2_Bit13 = (indication_data[18] >> 5) & 0x01;
	@sysvar::DisplayConfig_ASG_Prop_Display1::DisplaySetup_AdditionalInfo_2_2_Bit14 = (indication_data[18] >> 6) & 0x01;
	@sysvar::DisplayConfig_ASG_Prop_Display1::DisplaySetup_AdditionalInfo_2_2_Bit15 = (indication_data[18] >> 7) & 0x01;
	
	@sysvar::DisplayConfig_ASG_Prop_Display1::DisplaySetup_AdditionalInfo_2_2_Bit16 = (indication_data[19] >> 0) & 0x01;
	@sysvar::DisplayConfig_ASG_Prop_Display1::DisplaySetup_AdditionalInfo_2_2_Bit17 = (indication_data[19] >> 1) & 0x01;
	@sysvar::DisplayConfig_ASG_Prop_Display1::DisplaySetup_AdditionalInfo_2_2_Bit18 = (indication_data[19] >> 2) & 0x01;
	@sysvar::DisplayConfig_ASG_Prop_Display1::DisplaySetup_AdditionalInfo_2_2_Bit19 = (indication_data[19] >> 3) & 0x01;
	@sysvar::DisplayConfig_ASG_Prop_Display1::DisplaySetup_AdditionalInfo_2_2_Bit20 = (indication_data[19] >> 4) & 0x01;
	@sysvar::DisplayConfig_ASG_Prop_Display1::DisplaySetup_AdditionalInfo_2_2_Bit21 = (indication_data[19] >> 5) & 0x01;
	@sysvar::DisplayConfig_ASG_Prop_Display1::DisplaySetup_AdditionalInfo_2_2_Bit22 = (indication_data[19] >> 6) & 0x01;
	@sysvar::DisplayConfig_ASG_Prop_Display1::DisplaySetup_AdditionalInfo_2_2_Bit23 = (indication_data[19] >> 7) & 0x01;
	
	@sysvar::DisplayConfig_ASG_Prop_Display1::DisplaySetup_AdditionalInfo_2_2_Bit24 = (indication_data[20] >> 0) & 0x01;
	@sysvar::DisplayConfig_ASG_Prop_Display1::DisplaySetup_AdditionalInfo_2_2_Bit25 = (indication_data[20] >> 1) & 0x01;
	@sysvar::DisplayConfig_ASG_Prop_Display1::DisplaySetup_AdditionalInfo_2_2_Bit26 = (indication_data[20] >> 2) & 0x01;
	@sysvar::DisplayConfig_ASG_Prop_Display1::DisplaySetup_AdditionalInfo_2_2_Bit27 = (indication_data[20] >> 3) & 0x01;
	@sysvar::DisplayConfig_ASG_Prop_Display1::DisplaySetup_AdditionalInfo_2_2_Bit28 = (indication_data[20] >> 4) & 0x01;
	@sysvar::DisplayConfig_ASG_Prop_Display1::DisplaySetup_AdditionalInfo_2_2_Bit29 = (indication_data[20] >> 5) & 0x01;
}

void extractData_0x14_Display1MainSelection(byte indication_data[])
{
	// byte[0]
	@sysvar::DisplayConfig_ASG_Prop_Display1::DisplayMainSelection_MainSelection_Bit00 = (indication_data[0] >> 0) & 0x01;
	@sysvar::DisplayConfig_ASG_Prop_Display1::DisplayMainSelection_MainSelection_Bit01 = (indication_data[0] >> 1) & 0x01;
	@sysvar::DisplayConfig_ASG_Prop_Display1::DisplayMainSelection_MainSelection_Bit02 = (indication_data[0] >> 2) & 0x01;
	@sysvar::DisplayConfig_ASG_Prop_Display1::DisplayMainSelection_MainSelection_Bit03 = (indication_data[0] >> 3) & 0x01;
	@sysvar::DisplayConfig_ASG_Prop_Display1::DisplayMainSelection_MainSelection_Bit04 = (indication_data[0] >> 4) & 0x01;
	@sysvar::DisplayConfig_ASG_Prop_Display1::DisplayMainSelection_MainSelection_Bit05 = (indication_data[0] >> 5) & 0x01;
	@sysvar::DisplayConfig_ASG_Prop_Display1::DisplayMainSelection_MainSelection_Bit06 = (indication_data[0] >> 6) & 0x01;
	@sysvar::DisplayConfig_ASG_Prop_Display1::DisplayMainSelection_MainSelection_Bit07 = (indication_data[0] >> 7) & 0x01;
	// byte[1]
	@sysvar::DisplayConfig_ASG_Prop_Display1::DisplayMainSelection_MainSelection_Bit08 = (indication_data[1] >> 0) & 0x01;
	@sysvar::DisplayConfig_ASG_Prop_Display1::DisplayMainSelection_MainSelection_Bit09 = (indication_data[1] >> 1) & 0x01;
	@sysvar::DisplayConfig_ASG_Prop_Display1::DisplayMainSelection_MainSelection_Bit10 = (indication_data[1] >> 2) & 0x01;
	@sysvar::DisplayConfig_ASG_Prop_Display1::DisplayMainSelection_MainSelection_Bit11 = (indication_data[1] >> 3) & 0x01;
	@sysvar::DisplayConfig_ASG_Prop_Display1::DisplayMainSelection_MainSelection_Bit12 = (indication_data[1] >> 4) & 0x01;
	@sysvar::DisplayConfig_ASG_Prop_Display1::DisplayMainSelection_MainSelection_Bit13 = (indication_data[1] >> 5) & 0x01;
	@sysvar::DisplayConfig_ASG_Prop_Display1::DisplayMainSelection_MainSelection_Bit14 = (indication_data[1] >> 6) & 0x01;
	@sysvar::DisplayConfig_ASG_Prop_Display1::DisplayMainSelection_MainSelection_Bit15 = (indication_data[1] >> 7) & 0x01;
	// byte[2]
	@sysvar::DisplayConfig_ASG_Prop_Display1::DisplayMainSelection_MainSelection_Bit16 = (indication_data[2] >> 0) & 0x01;
	@sysvar::DisplayConfig_ASG_Prop_Display1::DisplayMainSelection_MainSelection_Bit17 = (indication_data[2] >> 1) & 0x01;
	@sysvar::DisplayConfig_ASG_Prop_Display1::DisplayMainSelection_MainSelection_Bit18 = (indication_data[2] >> 2) & 0x01;
	@sysvar::DisplayConfig_ASG_Prop_Display1::DisplayMainSelection_MainSelection_Bit19 = (indication_data[2] >> 3) & 0x01;
	@sysvar::DisplayConfig_ASG_Prop_Display1::DisplayMainSelection_MainSelection_Bit20 = (indication_data[2] >> 4) & 0x01;
	@sysvar::DisplayConfig_ASG_Prop_Display1::DisplayMainSelection_MainSelection_Bit21 = (indication_data[2] >> 5) & 0x01;
	@sysvar::DisplayConfig_ASG_Prop_Display1::DisplayMainSelection_MainSelection_Bit22 = (indication_data[2] >> 6) & 0x01;
	@sysvar::DisplayConfig_ASG_Prop_Display1::DisplayMainSelection_MainSelection_Bit23 = (indication_data[2] >> 7) & 0x01;
	// byte[3]
	@sysvar::DisplayConfig_ASG_Prop_Display1::DisplayMainSelection_MainSelection_Bit24 = (indication_data[3] >> 0) & 0x01;
	@sysvar::DisplayConfig_ASG_Prop_Display1::DisplayMainSelection_MainSelection_Bit25 = (indication_data[3] >> 1) & 0x01;
	@sysvar::DisplayConfig_ASG_Prop_Display1::DisplayMainSelection_MainSelection_Bit26 = (indication_data[3] >> 2) & 0x01;
	@sysvar::DisplayConfig_ASG_Prop_Display1::DisplayMainSelection_MainSelection_Bit27 = (indication_data[3] >> 3) & 0x01;
	@sysvar::DisplayConfig_ASG_Prop_Display1::DisplayMainSelection_MainSelection_Bit28 = (indication_data[3] >> 4) & 0x01;
	// byte[4]
	@sysvar::DisplayConfig_ASG_Prop_Display1::DisplayMainSelection_Extension1 = (indication_data[4] >> 4) & 0x0F;
	@sysvar::DisplayConfig_ASG_Prop_Display1::DisplayMainSelection_Extension2 = (indication_data[4] >> 0) & 0x0F;
}

void extractData_0x15_Display2Setup(byte indication_data[])
{
	// start MainSetup (4 byte)
	@sysvar::DisplayConfig_ASG_Prop_Display2::DisplaySetup_MainSetup_Bit00 = (indication_data[0] >> 0) & 0x01;
	@sysvar::DisplayConfig_ASG_Prop_Display2::DisplaySetup_MainSetup_Bit01 = (indication_data[0] >> 1) & 0x01;
	@sysvar::DisplayConfig_ASG_Prop_Display2::DisplaySetup_MainSetup_Bit02 = (indication_data[0] >> 2) & 0x01;
	@sysvar::DisplayConfig_ASG_Prop_Display2::DisplaySetup_MainSetup_Bit03 = (indication_data[0] >> 3) & 0x01;
	@sysvar::DisplayConfig_ASG_Prop_Display2::DisplaySetup_MainSetup_Bit04 = (indication_data[0] >> 4) & 0x01;
	@sysvar::DisplayConfig_ASG_Prop_Display2::DisplaySetup_MainSetup_Bit05 = (indication_data[0] >> 5) & 0x01;
	@sysvar::DisplayConfig_ASG_Prop_Display2::DisplaySetup_MainSetup_Bit06 = (indication_data[0] >> 6) & 0x01;
	@sysvar::DisplayConfig_ASG_Prop_Display2::DisplaySetup_MainSetup_Bit07 = (indication_data[0] >> 7) & 0x01;

	@sysvar::DisplayConfig_ASG_Prop_Display2::DisplaySetup_MainSetup_Bit08 = (indication_data[1] >> 0) & 0x01;
	@sysvar::DisplayConfig_ASG_Prop_Display2::DisplaySetup_MainSetup_Bit09 = (indication_data[1] >> 1) & 0x01;
	@sysvar::DisplayConfig_ASG_Prop_Display2::DisplaySetup_MainSetup_Bit10 = (indication_data[1] >> 2) & 0x01;
	@sysvar::DisplayConfig_ASG_Prop_Display2::DisplaySetup_MainSetup_Bit11 = (indication_data[1] >> 3) & 0x01;
	@sysvar::DisplayConfig_ASG_Prop_Display2::DisplaySetup_MainSetup_Bit12 = (indication_data[1] >> 4) & 0x01;
	@sysvar::DisplayConfig_ASG_Prop_Display2::DisplaySetup_MainSetup_Bit13 = (indication_data[1] >> 5) & 0x01;
	@sysvar::DisplayConfig_ASG_Prop_Display2::DisplaySetup_MainSetup_Bit14 = (indication_data[1] >> 6) & 0x01;
	@sysvar::DisplayConfig_ASG_Prop_Display2::DisplaySetup_MainSetup_Bit15 = (indication_data[1] >> 7) & 0x01;

	@sysvar::DisplayConfig_ASG_Prop_Display2::DisplaySetup_MainSetup_Bit16 = (indication_data[2] >> 0) & 0x01;
	@sysvar::DisplayConfig_ASG_Prop_Display2::DisplaySetup_MainSetup_Bit17 = (indication_data[2] >> 1) & 0x01;
	@sysvar::DisplayConfig_ASG_Prop_Display2::DisplaySetup_MainSetup_Bit18 = (indication_data[2] >> 2) & 0x01;
	@sysvar::DisplayConfig_ASG_Prop_Display2::DisplaySetup_MainSetup_Bit19 = (indication_data[2] >> 3) & 0x01;
	@sysvar::DisplayConfig_ASG_Prop_Display2::DisplaySetup_MainSetup_Bit20 = (indication_data[2] >> 4) & 0x01;
	@sysvar::DisplayConfig_ASG_Prop_Display2::DisplaySetup_MainSetup_Bit21 = (indication_data[2] >> 5) & 0x01;
	@sysvar::DisplayConfig_ASG_Prop_Display2::DisplaySetup_MainSetup_Bit22 = (indication_data[2] >> 6) & 0x01;
	@sysvar::DisplayConfig_ASG_Prop_Display2::DisplaySetup_MainSetup_Bit23 = (indication_data[2] >> 7) & 0x01;
	
	@sysvar::DisplayConfig_ASG_Prop_Display2::DisplaySetup_MainSetup_Bit24 = (indication_data[3] >> 0) & 0x01;
	@sysvar::DisplayConfig_ASG_Prop_Display2::DisplaySetup_MainSetup_Bit25 = (indication_data[3] >> 1) & 0x01;
	@sysvar::DisplayConfig_ASG_Prop_Display2::DisplaySetup_MainSetup_Bit26 = (indication_data[3] >> 2) & 0x01;
	@sysvar::DisplayConfig_ASG_Prop_Display2::DisplaySetup_MainSetup_Bit27 = (indication_data[3] >> 3) & 0x01;
	@sysvar::DisplayConfig_ASG_Prop_Display2::DisplaySetup_MainSetup_Bit28 = (indication_data[3] >> 4) & 0x01;
	
	// start DisplayedAdditionalInfos (1 byte)
	@sysvar::DisplayConfig_ASG_Prop_Display2::DisplaySetup_DisplayedAdditionalInfos_Bit00 = (indication_data[4] >> 0) & 0x01;
	@sysvar::DisplayConfig_ASG_Prop_Display2::DisplaySetup_DisplayedAdditionalInfos_Bit01 = (indication_data[4] >> 1) & 0x01;
	
	// start AdditionalInfo1_1 (4 byte)
	@sysvar::DisplayConfig_ASG_Prop_Display2::DisplaySetup_AdditionalInfo_1_1_Bit00 = (indication_data[5] >> 0) & 0x01;
	@sysvar::DisplayConfig_ASG_Prop_Display2::DisplaySetup_AdditionalInfo_1_1_Bit01 = (indication_data[5] >> 1) & 0x01;
	@sysvar::DisplayConfig_ASG_Prop_Display2::DisplaySetup_AdditionalInfo_1_1_Bit02 = (indication_data[5] >> 2) & 0x01;
	@sysvar::DisplayConfig_ASG_Prop_Display2::DisplaySetup_AdditionalInfo_1_1_Bit03 = (indication_data[5] >> 3) & 0x01;
	@sysvar::DisplayConfig_ASG_Prop_Display2::DisplaySetup_AdditionalInfo_1_1_Bit04 = (indication_data[5] >> 4) & 0x01;
	@sysvar::DisplayConfig_ASG_Prop_Display2::DisplaySetup_AdditionalInfo_1_1_Bit05 = (indication_data[5] >> 5) & 0x01;
	@sysvar::DisplayConfig_ASG_Prop_Display2::DisplaySetup_AdditionalInfo_1_1_Bit06 = (indication_data[5] >> 6) & 0x01;
	@sysvar::DisplayConfig_ASG_Prop_Display2::DisplaySetup_AdditionalInfo_1_1_Bit07 = (indication_data[5] >> 7) & 0x01;

	@sysvar::DisplayConfig_ASG_Prop_Display2::DisplaySetup_AdditionalInfo_1_1_Bit08 = (indication_data[6] >> 0) & 0x01;
	@sysvar::DisplayConfig_ASG_Prop_Display2::DisplaySetup_AdditionalInfo_1_1_Bit09 = (indication_data[6] >> 1) & 0x01;
	@sysvar::DisplayConfig_ASG_Prop_Display2::DisplaySetup_AdditionalInfo_1_1_Bit10 = (indication_data[6] >> 2) & 0x01;
	@sysvar::DisplayConfig_ASG_Prop_Display2::DisplaySetup_AdditionalInfo_1_1_Bit11 = (indication_data[6] >> 3) & 0x01;
	@sysvar::DisplayConfig_ASG_Prop_Display2::DisplaySetup_AdditionalInfo_1_1_Bit12 = (indication_data[6] >> 4) & 0x01;
	@sysvar::DisplayConfig_ASG_Prop_Display2::DisplaySetup_AdditionalInfo_1_1_Bit13 = (indication_data[6] >> 5) & 0x01;
	@sysvar::DisplayConfig_ASG_Prop_Display2::DisplaySetup_AdditionalInfo_1_1_Bit14 = (indication_data[6] >> 6) & 0x01;
	@sysvar::DisplayConfig_ASG_Prop_Display2::DisplaySetup_AdditionalInfo_1_1_Bit15 = (indication_data[6] >> 7) & 0x01;
	
	@sysvar::DisplayConfig_ASG_Prop_Display2::DisplaySetup_AdditionalInfo_1_1_Bit16 = (indication_data[7] >> 0) & 0x01;
	@sysvar::DisplayConfig_ASG_Prop_Display2::DisplaySetup_AdditionalInfo_1_1_Bit17 = (indication_data[7] >> 1) & 0x01;
	@sysvar::DisplayConfig_ASG_Prop_Display2::DisplaySetup_AdditionalInfo_1_1_Bit18 = (indication_data[7] >> 2) & 0x01;
	@sysvar::DisplayConfig_ASG_Prop_Display2::DisplaySetup_AdditionalInfo_1_1_Bit19 = (indication_data[7] >> 3) & 0x01;
	@sysvar::DisplayConfig_ASG_Prop_Display2::DisplaySetup_AdditionalInfo_1_1_Bit20 = (indication_data[7] >> 4) & 0x01;
	@sysvar::DisplayConfig_ASG_Prop_Display2::DisplaySetup_AdditionalInfo_1_1_Bit21 = (indication_data[7] >> 5) & 0x01;
	@sysvar::DisplayConfig_ASG_Prop_Display2::DisplaySetup_AdditionalInfo_1_1_Bit22 = (indication_data[7] >> 6) & 0x01;
	@sysvar::DisplayConfig_ASG_Prop_Display2::DisplaySetup_AdditionalInfo_1_1_Bit23 = (indication_data[7] >> 7) & 0x01;
	
	@sysvar::DisplayConfig_ASG_Prop_Display2::DisplaySetup_AdditionalInfo_1_1_Bit24 = (indication_data[8] >> 0) & 0x01;
	@sysvar::DisplayConfig_ASG_Prop_Display2::DisplaySetup_AdditionalInfo_1_1_Bit25 = (indication_data[8] >> 1) & 0x01;
	@sysvar::DisplayConfig_ASG_Prop_Display2::DisplaySetup_AdditionalInfo_1_1_Bit26 = (indication_data[8] >> 2) & 0x01;
	@sysvar::DisplayConfig_ASG_Prop_Display2::DisplaySetup_AdditionalInfo_1_1_Bit27 = (indication_data[8] >> 3) & 0x01;
	@sysvar::DisplayConfig_ASG_Prop_Display2::DisplaySetup_AdditionalInfo_1_1_Bit28 = (indication_data[8] >> 4) & 0x01;
	@sysvar::DisplayConfig_ASG_Prop_Display2::DisplaySetup_AdditionalInfo_1_1_Bit29 = (indication_data[8] >> 5) & 0x01;
	@sysvar::DisplayConfig_ASG_Prop_Display2::DisplaySetup_AdditionalInfo_1_1_Bit30 = (indication_data[8] >> 6) & 0x01;
	@sysvar::DisplayConfig_ASG_Prop_Display2::DisplaySetup_AdditionalInfo_1_1_Bit31 = (indication_data[8] >> 7) & 0x01;
	
	// start AdditionalInfo1_2 (4 byte)
	@sysvar::DisplayConfig_ASG_Prop_Display2::DisplaySetup_AdditionalInfo_1_2_Bit00 = (indication_data[9] >> 0) & 0x01;
	@sysvar::DisplayConfig_ASG_Prop_Display2::DisplaySetup_AdditionalInfo_1_2_Bit01 = (indication_data[9] >> 1) & 0x01;
	@sysvar::DisplayConfig_ASG_Prop_Display2::DisplaySetup_AdditionalInfo_1_2_Bit02 = (indication_data[9] >> 2) & 0x01;
	@sysvar::DisplayConfig_ASG_Prop_Display2::DisplaySetup_AdditionalInfo_1_2_Bit03 = (indication_data[9] >> 3) & 0x01;
	@sysvar::DisplayConfig_ASG_Prop_Display2::DisplaySetup_AdditionalInfo_1_2_Bit04 = (indication_data[9] >> 4) & 0x01;
	@sysvar::DisplayConfig_ASG_Prop_Display2::DisplaySetup_AdditionalInfo_1_2_Bit05 = (indication_data[9] >> 5) & 0x01;
	@sysvar::DisplayConfig_ASG_Prop_Display2::DisplaySetup_AdditionalInfo_1_2_Bit06 = (indication_data[9] >> 6) & 0x01;
	@sysvar::DisplayConfig_ASG_Prop_Display2::DisplaySetup_AdditionalInfo_1_2_Bit07 = (indication_data[9] >> 7) & 0x01;

	@sysvar::DisplayConfig_ASG_Prop_Display2::DisplaySetup_AdditionalInfo_1_2_Bit08 = (indication_data[10] >> 0) & 0x01;
	@sysvar::DisplayConfig_ASG_Prop_Display2::DisplaySetup_AdditionalInfo_1_2_Bit09 = (indication_data[10] >> 1) & 0x01;
	@sysvar::DisplayConfig_ASG_Prop_Display2::DisplaySetup_AdditionalInfo_1_2_Bit10 = (indication_data[10] >> 2) & 0x01;
	@sysvar::DisplayConfig_ASG_Prop_Display2::DisplaySetup_AdditionalInfo_1_2_Bit11 = (indication_data[10] >> 3) & 0x01;
	@sysvar::DisplayConfig_ASG_Prop_Display2::DisplaySetup_AdditionalInfo_1_2_Bit12 = (indication_data[10] >> 4) & 0x01;
	@sysvar::DisplayConfig_ASG_Prop_Display2::DisplaySetup_AdditionalInfo_1_2_Bit13 = (indication_data[10] >> 5) & 0x01;
	@sysvar::DisplayConfig_ASG_Prop_Display2::DisplaySetup_AdditionalInfo_1_2_Bit14 = (indication_data[10] >> 6) & 0x01;
	@sysvar::DisplayConfig_ASG_Prop_Display2::DisplaySetup_AdditionalInfo_1_2_Bit15 = (indication_data[10] >> 7) & 0x01;
	
	@sysvar::DisplayConfig_ASG_Prop_Display2::DisplaySetup_AdditionalInfo_1_2_Bit16 = (indication_data[11] >> 0) & 0x01;
	@sysvar::DisplayConfig_ASG_Prop_Display2::DisplaySetup_AdditionalInfo_1_2_Bit17 = (indication_data[11] >> 1) & 0x01;
	@sysvar::DisplayConfig_ASG_Prop_Display2::DisplaySetup_AdditionalInfo_1_2_Bit18 = (indication_data[11] >> 2) & 0x01;
	@sysvar::DisplayConfig_ASG_Prop_Display2::DisplaySetup_AdditionalInfo_1_2_Bit19 = (indication_data[11] >> 3) & 0x01;
	@sysvar::DisplayConfig_ASG_Prop_Display2::DisplaySetup_AdditionalInfo_1_2_Bit20 = (indication_data[11] >> 4) & 0x01;
	@sysvar::DisplayConfig_ASG_Prop_Display2::DisplaySetup_AdditionalInfo_1_2_Bit21 = (indication_data[11] >> 5) & 0x01;
	@sysvar::DisplayConfig_ASG_Prop_Display2::DisplaySetup_AdditionalInfo_1_2_Bit22 = (indication_data[11] >> 6) & 0x01;
	@sysvar::DisplayConfig_ASG_Prop_Display2::DisplaySetup_AdditionalInfo_1_2_Bit23 = (indication_data[11] >> 7) & 0x01;
	
	@sysvar::DisplayConfig_ASG_Prop_Display2::DisplaySetup_AdditionalInfo_1_2_Bit24 = (indication_data[12] >> 0) & 0x01;
	@sysvar::DisplayConfig_ASG_Prop_Display2::DisplaySetup_AdditionalInfo_1_2_Bit25 = (indication_data[12] >> 1) & 0x01;
	@sysvar::DisplayConfig_ASG_Prop_Display2::DisplaySetup_AdditionalInfo_1_2_Bit26 = (indication_data[12] >> 2) & 0x01;
	@sysvar::DisplayConfig_ASG_Prop_Display2::DisplaySetup_AdditionalInfo_1_2_Bit27 = (indication_data[12] >> 3) & 0x01;
	@sysvar::DisplayConfig_ASG_Prop_Display2::DisplaySetup_AdditionalInfo_1_2_Bit28 = (indication_data[12] >> 4) & 0x01;
	@sysvar::DisplayConfig_ASG_Prop_Display2::DisplaySetup_AdditionalInfo_1_2_Bit29 = (indication_data[12] >> 5) & 0x01;
	
		// start AdditionalInfo2_1 (4 byte)
	@sysvar::DisplayConfig_ASG_Prop_Display2::DisplaySetup_AdditionalInfo_2_1_Bit00 = (indication_data[13] >> 0) & 0x01;
	@sysvar::DisplayConfig_ASG_Prop_Display2::DisplaySetup_AdditionalInfo_2_1_Bit01 = (indication_data[13] >> 1) & 0x01;
	@sysvar::DisplayConfig_ASG_Prop_Display2::DisplaySetup_AdditionalInfo_2_1_Bit02 = (indication_data[13] >> 2) & 0x01;
	@sysvar::DisplayConfig_ASG_Prop_Display2::DisplaySetup_AdditionalInfo_2_1_Bit03 = (indication_data[13] >> 3) & 0x01;
	@sysvar::DisplayConfig_ASG_Prop_Display2::DisplaySetup_AdditionalInfo_2_1_Bit04 = (indication_data[13] >> 4) & 0x01;
	@sysvar::DisplayConfig_ASG_Prop_Display2::DisplaySetup_AdditionalInfo_2_1_Bit05 = (indication_data[13] >> 5) & 0x01;
	@sysvar::DisplayConfig_ASG_Prop_Display2::DisplaySetup_AdditionalInfo_2_1_Bit06 = (indication_data[13] >> 6) & 0x01;
	@sysvar::DisplayConfig_ASG_Prop_Display2::DisplaySetup_AdditionalInfo_2_1_Bit07 = (indication_data[13] >> 7) & 0x01;

	@sysvar::DisplayConfig_ASG_Prop_Display2::DisplaySetup_AdditionalInfo_2_1_Bit08 = (indication_data[14] >> 0) & 0x01;
	@sysvar::DisplayConfig_ASG_Prop_Display2::DisplaySetup_AdditionalInfo_2_1_Bit09 = (indication_data[14] >> 1) & 0x01;
	@sysvar::DisplayConfig_ASG_Prop_Display2::DisplaySetup_AdditionalInfo_2_1_Bit10 = (indication_data[14] >> 2) & 0x01;
	@sysvar::DisplayConfig_ASG_Prop_Display2::DisplaySetup_AdditionalInfo_2_1_Bit11 = (indication_data[14] >> 3) & 0x01;
	@sysvar::DisplayConfig_ASG_Prop_Display2::DisplaySetup_AdditionalInfo_2_1_Bit12 = (indication_data[14] >> 4) & 0x01;
	@sysvar::DisplayConfig_ASG_Prop_Display2::DisplaySetup_AdditionalInfo_2_1_Bit13 = (indication_data[14] >> 5) & 0x01;
	@sysvar::DisplayConfig_ASG_Prop_Display2::DisplaySetup_AdditionalInfo_2_1_Bit14 = (indication_data[14] >> 6) & 0x01;
	@sysvar::DisplayConfig_ASG_Prop_Display2::DisplaySetup_AdditionalInfo_2_1_Bit15 = (indication_data[14] >> 7) & 0x01;
	
	@sysvar::DisplayConfig_ASG_Prop_Display2::DisplaySetup_AdditionalInfo_2_1_Bit16 = (indication_data[15] >> 0) & 0x01;
	@sysvar::DisplayConfig_ASG_Prop_Display2::DisplaySetup_AdditionalInfo_2_1_Bit17 = (indication_data[15] >> 1) & 0x01;
	@sysvar::DisplayConfig_ASG_Prop_Display2::DisplaySetup_AdditionalInfo_2_1_Bit18 = (indication_data[15] >> 2) & 0x01;
	@sysvar::DisplayConfig_ASG_Prop_Display2::DisplaySetup_AdditionalInfo_2_1_Bit19 = (indication_data[15] >> 3) & 0x01;
	@sysvar::DisplayConfig_ASG_Prop_Display2::DisplaySetup_AdditionalInfo_2_1_Bit20 = (indication_data[15] >> 4) & 0x01;
	@sysvar::DisplayConfig_ASG_Prop_Display2::DisplaySetup_AdditionalInfo_2_1_Bit21 = (indication_data[15] >> 5) & 0x01;
	@sysvar::DisplayConfig_ASG_Prop_Display2::DisplaySetup_AdditionalInfo_2_1_Bit22 = (indication_data[15] >> 6) & 0x01;
	@sysvar::DisplayConfig_ASG_Prop_Display2::DisplaySetup_AdditionalInfo_2_1_Bit23 = (indication_data[15] >> 7) & 0x01;
	
	@sysvar::DisplayConfig_ASG_Prop_Display2::DisplaySetup_AdditionalInfo_2_1_Bit24 = (indication_data[16] >> 0) & 0x01;
	@sysvar::DisplayConfig_ASG_Prop_Display2::DisplaySetup_AdditionalInfo_2_1_Bit25 = (indication_data[16] >> 1) & 0x01;
	@sysvar::DisplayConfig_ASG_Prop_Display2::DisplaySetup_AdditionalInfo_2_1_Bit26 = (indication_data[16] >> 2) & 0x01;
	@sysvar::DisplayConfig_ASG_Prop_Display2::DisplaySetup_AdditionalInfo_2_1_Bit27 = (indication_data[16] >> 3) & 0x01;
	@sysvar::DisplayConfig_ASG_Prop_Display2::DisplaySetup_AdditionalInfo_2_1_Bit28 = (indication_data[16] >> 4) & 0x01;
	@sysvar::DisplayConfig_ASG_Prop_Display2::DisplaySetup_AdditionalInfo_2_1_Bit29 = (indication_data[16] >> 5) & 0x01;
	@sysvar::DisplayConfig_ASG_Prop_Display2::DisplaySetup_AdditionalInfo_2_1_Bit30 = (indication_data[16] >> 6) & 0x01;
	@sysvar::DisplayConfig_ASG_Prop_Display2::DisplaySetup_AdditionalInfo_2_1_Bit31 = (indication_data[16] >> 7) & 0x01;
	
		// start AdditionalInfo2_2 (4 byte)
	@sysvar::DisplayConfig_ASG_Prop_Display2::DisplaySetup_AdditionalInfo_2_2_Bit00 = (indication_data[17] >> 0) & 0x01;
	@sysvar::DisplayConfig_ASG_Prop_Display2::DisplaySetup_AdditionalInfo_2_2_Bit01 = (indication_data[17] >> 1) & 0x01;
	@sysvar::DisplayConfig_ASG_Prop_Display2::DisplaySetup_AdditionalInfo_2_2_Bit02 = (indication_data[17] >> 2) & 0x01;
	@sysvar::DisplayConfig_ASG_Prop_Display2::DisplaySetup_AdditionalInfo_2_2_Bit03 = (indication_data[17] >> 3) & 0x01;
	@sysvar::DisplayConfig_ASG_Prop_Display2::DisplaySetup_AdditionalInfo_2_2_Bit04 = (indication_data[17] >> 4) & 0x01;
	@sysvar::DisplayConfig_ASG_Prop_Display2::DisplaySetup_AdditionalInfo_2_2_Bit05 = (indication_data[17] >> 5) & 0x01;
	@sysvar::DisplayConfig_ASG_Prop_Display2::DisplaySetup_AdditionalInfo_2_2_Bit06 = (indication_data[17] >> 6) & 0x01;
	@sysvar::DisplayConfig_ASG_Prop_Display2::DisplaySetup_AdditionalInfo_2_2_Bit07 = (indication_data[17] >> 7) & 0x01;

	@sysvar::DisplayConfig_ASG_Prop_Display2::DisplaySetup_AdditionalInfo_2_2_Bit08 = (indication_data[18] >> 0) & 0x01;
	@sysvar::DisplayConfig_ASG_Prop_Display2::DisplaySetup_AdditionalInfo_2_2_Bit09 = (indication_data[18] >> 1) & 0x01;
	@sysvar::DisplayConfig_ASG_Prop_Display2::DisplaySetup_AdditionalInfo_2_2_Bit10 = (indication_data[18] >> 2) & 0x01;
	@sysvar::DisplayConfig_ASG_Prop_Display2::DisplaySetup_AdditionalInfo_2_2_Bit11 = (indication_data[18] >> 3) & 0x01;
	@sysvar::DisplayConfig_ASG_Prop_Display2::DisplaySetup_AdditionalInfo_2_2_Bit12 = (indication_data[18] >> 4) & 0x01;
	@sysvar::DisplayConfig_ASG_Prop_Display2::DisplaySetup_AdditionalInfo_2_2_Bit13 = (indication_data[18] >> 5) & 0x01;
	@sysvar::DisplayConfig_ASG_Prop_Display2::DisplaySetup_AdditionalInfo_2_2_Bit14 = (indication_data[18] >> 6) & 0x01;
	@sysvar::DisplayConfig_ASG_Prop_Display2::DisplaySetup_AdditionalInfo_2_2_Bit15 = (indication_data[18] >> 7) & 0x01;
	
	@sysvar::DisplayConfig_ASG_Prop_Display2::DisplaySetup_AdditionalInfo_2_2_Bit16 = (indication_data[19] >> 0) & 0x01;
	@sysvar::DisplayConfig_ASG_Prop_Display2::DisplaySetup_AdditionalInfo_2_2_Bit17 = (indication_data[19] >> 1) & 0x01;
	@sysvar::DisplayConfig_ASG_Prop_Display2::DisplaySetup_AdditionalInfo_2_2_Bit18 = (indication_data[19] >> 2) & 0x01;
	@sysvar::DisplayConfig_ASG_Prop_Display2::DisplaySetup_AdditionalInfo_2_2_Bit19 = (indication_data[19] >> 3) & 0x01;
	@sysvar::DisplayConfig_ASG_Prop_Display2::DisplaySetup_AdditionalInfo_2_2_Bit20 = (indication_data[19] >> 4) & 0x01;
	@sysvar::DisplayConfig_ASG_Prop_Display2::DisplaySetup_AdditionalInfo_2_2_Bit21 = (indication_data[19] >> 5) & 0x01;
	@sysvar::DisplayConfig_ASG_Prop_Display2::DisplaySetup_AdditionalInfo_2_2_Bit22 = (indication_data[19] >> 6) & 0x01;
	@sysvar::DisplayConfig_ASG_Prop_Display2::DisplaySetup_AdditionalInfo_2_2_Bit23 = (indication_data[19] >> 7) & 0x01;
	
	@sysvar::DisplayConfig_ASG_Prop_Display2::DisplaySetup_AdditionalInfo_2_2_Bit24 = (indication_data[20] >> 0) & 0x01;
	@sysvar::DisplayConfig_ASG_Prop_Display2::DisplaySetup_AdditionalInfo_2_2_Bit25 = (indication_data[20] >> 1) & 0x01;
	@sysvar::DisplayConfig_ASG_Prop_Display2::DisplaySetup_AdditionalInfo_2_2_Bit26 = (indication_data[20] >> 2) & 0x01;
	@sysvar::DisplayConfig_ASG_Prop_Display2::DisplaySetup_AdditionalInfo_2_2_Bit27 = (indication_data[20] >> 3) & 0x01;
	@sysvar::DisplayConfig_ASG_Prop_Display2::DisplaySetup_AdditionalInfo_2_2_Bit28 = (indication_data[20] >> 4) & 0x01;
	@sysvar::DisplayConfig_ASG_Prop_Display2::DisplaySetup_AdditionalInfo_2_2_Bit29 = (indication_data[20] >> 5) & 0x01;
}

void extractData_0x16_Display2MainSelection(byte indication_data[])
{
	// byte[0]
	@sysvar::DisplayConfig_ASG_Prop_Display2::DisplayMainSelection_MainSelection_Bit00 = (indication_data[0] >> 0) & 0x01;
	@sysvar::DisplayConfig_ASG_Prop_Display2::DisplayMainSelection_MainSelection_Bit01 = (indication_data[0] >> 1) & 0x01;
	@sysvar::DisplayConfig_ASG_Prop_Display2::DisplayMainSelection_MainSelection_Bit02 = (indication_data[0] >> 2) & 0x01;
	@sysvar::DisplayConfig_ASG_Prop_Display2::DisplayMainSelection_MainSelection_Bit03 = (indication_data[0] >> 3) & 0x01;
	@sysvar::DisplayConfig_ASG_Prop_Display2::DisplayMainSelection_MainSelection_Bit04 = (indication_data[0] >> 4) & 0x01;
	@sysvar::DisplayConfig_ASG_Prop_Display2::DisplayMainSelection_MainSelection_Bit05 = (indication_data[0] >> 5) & 0x01;
	@sysvar::DisplayConfig_ASG_Prop_Display2::DisplayMainSelection_MainSelection_Bit06 = (indication_data[0] >> 6) & 0x01;
	@sysvar::DisplayConfig_ASG_Prop_Display2::DisplayMainSelection_MainSelection_Bit07 = (indication_data[0] >> 7) & 0x01;
	// byte[1]
	@sysvar::DisplayConfig_ASG_Prop_Display2::DisplayMainSelection_MainSelection_Bit08 = (indication_data[1] >> 0) & 0x01;
	@sysvar::DisplayConfig_ASG_Prop_Display2::DisplayMainSelection_MainSelection_Bit09 = (indication_data[1] >> 1) & 0x01;
	@sysvar::DisplayConfig_ASG_Prop_Display2::DisplayMainSelection_MainSelection_Bit10 = (indication_data[1] >> 2) & 0x01;
	@sysvar::DisplayConfig_ASG_Prop_Display2::DisplayMainSelection_MainSelection_Bit11 = (indication_data[1] >> 3) & 0x01;
	@sysvar::DisplayConfig_ASG_Prop_Display2::DisplayMainSelection_MainSelection_Bit12 = (indication_data[1] >> 4) & 0x01;
	@sysvar::DisplayConfig_ASG_Prop_Display2::DisplayMainSelection_MainSelection_Bit13 = (indication_data[1] >> 5) & 0x01;
	@sysvar::DisplayConfig_ASG_Prop_Display2::DisplayMainSelection_MainSelection_Bit14 = (indication_data[1] >> 6) & 0x01;
	@sysvar::DisplayConfig_ASG_Prop_Display2::DisplayMainSelection_MainSelection_Bit15 = (indication_data[1] >> 7) & 0x01;
	// byte[2]
	@sysvar::DisplayConfig_ASG_Prop_Display2::DisplayMainSelection_MainSelection_Bit16 = (indication_data[2] >> 0) & 0x01;
	@sysvar::DisplayConfig_ASG_Prop_Display2::DisplayMainSelection_MainSelection_Bit17 = (indication_data[2] >> 1) & 0x01;
	@sysvar::DisplayConfig_ASG_Prop_Display2::DisplayMainSelection_MainSelection_Bit18 = (indication_data[2] >> 2) & 0x01;
	@sysvar::DisplayConfig_ASG_Prop_Display2::DisplayMainSelection_MainSelection_Bit19 = (indication_data[2] >> 3) & 0x01;
	@sysvar::DisplayConfig_ASG_Prop_Display2::DisplayMainSelection_MainSelection_Bit20 = (indication_data[2] >> 4) & 0x01;
	@sysvar::DisplayConfig_ASG_Prop_Display2::DisplayMainSelection_MainSelection_Bit21 = (indication_data[2] >> 5) & 0x01;
	@sysvar::DisplayConfig_ASG_Prop_Display2::DisplayMainSelection_MainSelection_Bit22 = (indication_data[2] >> 6) & 0x01;
	@sysvar::DisplayConfig_ASG_Prop_Display2::DisplayMainSelection_MainSelection_Bit23 = (indication_data[2] >> 7) & 0x01;
	// byte[3]
	@sysvar::DisplayConfig_ASG_Prop_Display2::DisplayMainSelection_MainSelection_Bit24 = (indication_data[3] >> 0) & 0x01;
	@sysvar::DisplayConfig_ASG_Prop_Display2::DisplayMainSelection_MainSelection_Bit25 = (indication_data[3] >> 1) & 0x01;
	@sysvar::DisplayConfig_ASG_Prop_Display2::DisplayMainSelection_MainSelection_Bit26 = (indication_data[3] >> 2) & 0x01;
	@sysvar::DisplayConfig_ASG_Prop_Display2::DisplayMainSelection_MainSelection_Bit27 = (indication_data[3] >> 3) & 0x01;
	@sysvar::DisplayConfig_ASG_Prop_Display2::DisplayMainSelection_MainSelection_Bit28 = (indication_data[3] >> 4) & 0x01;
	// byte[4]
	@sysvar::DisplayConfig_ASG_Prop_Display2::DisplayMainSelection_Extension1 = (indication_data[4] >> 4) & 0x0F;
	@sysvar::DisplayConfig_ASG_Prop_Display2::DisplayMainSelection_Extension2 = (indication_data[4] >> 0) & 0x0F;
}

void extractData_0x17_Display3Setup(byte indication_data[])
{
	// start MainSetup (4 byte)
	@sysvar::DisplayConfig_ASG_Prop_Display3::DisplaySetup_MainSetup_Bit00 = (indication_data[0] >> 0) & 0x01;
	@sysvar::DisplayConfig_ASG_Prop_Display3::DisplaySetup_MainSetup_Bit01 = (indication_data[0] >> 1) & 0x01;
	@sysvar::DisplayConfig_ASG_Prop_Display3::DisplaySetup_MainSetup_Bit02 = (indication_data[0] >> 2) & 0x01;
	@sysvar::DisplayConfig_ASG_Prop_Display3::DisplaySetup_MainSetup_Bit03 = (indication_data[0] >> 3) & 0x01;
	@sysvar::DisplayConfig_ASG_Prop_Display3::DisplaySetup_MainSetup_Bit04 = (indication_data[0] >> 4) & 0x01;
	@sysvar::DisplayConfig_ASG_Prop_Display3::DisplaySetup_MainSetup_Bit05 = (indication_data[0] >> 5) & 0x01;
	@sysvar::DisplayConfig_ASG_Prop_Display3::DisplaySetup_MainSetup_Bit06 = (indication_data[0] >> 6) & 0x01;
	@sysvar::DisplayConfig_ASG_Prop_Display3::DisplaySetup_MainSetup_Bit07 = (indication_data[0] >> 7) & 0x01;

	@sysvar::DisplayConfig_ASG_Prop_Display3::DisplaySetup_MainSetup_Bit08 = (indication_data[1] >> 0) & 0x01;
	@sysvar::DisplayConfig_ASG_Prop_Display3::DisplaySetup_MainSetup_Bit09 = (indication_data[1] >> 1) & 0x01;
	@sysvar::DisplayConfig_ASG_Prop_Display3::DisplaySetup_MainSetup_Bit10 = (indication_data[1] >> 2) & 0x01;
	@sysvar::DisplayConfig_ASG_Prop_Display3::DisplaySetup_MainSetup_Bit11 = (indication_data[1] >> 3) & 0x01;
	@sysvar::DisplayConfig_ASG_Prop_Display3::DisplaySetup_MainSetup_Bit12 = (indication_data[1] >> 4) & 0x01;
	@sysvar::DisplayConfig_ASG_Prop_Display3::DisplaySetup_MainSetup_Bit13 = (indication_data[1] >> 5) & 0x01;
	@sysvar::DisplayConfig_ASG_Prop_Display3::DisplaySetup_MainSetup_Bit14 = (indication_data[1] >> 6) & 0x01;
	@sysvar::DisplayConfig_ASG_Prop_Display3::DisplaySetup_MainSetup_Bit15 = (indication_data[1] >> 7) & 0x01;

	@sysvar::DisplayConfig_ASG_Prop_Display3::DisplaySetup_MainSetup_Bit16 = (indication_data[2] >> 0) & 0x01;
	@sysvar::DisplayConfig_ASG_Prop_Display3::DisplaySetup_MainSetup_Bit17 = (indication_data[2] >> 1) & 0x01;
	@sysvar::DisplayConfig_ASG_Prop_Display3::DisplaySetup_MainSetup_Bit18 = (indication_data[2] >> 2) & 0x01;
	@sysvar::DisplayConfig_ASG_Prop_Display3::DisplaySetup_MainSetup_Bit19 = (indication_data[2] >> 3) & 0x01;
	@sysvar::DisplayConfig_ASG_Prop_Display3::DisplaySetup_MainSetup_Bit20 = (indication_data[2] >> 4) & 0x01;
	@sysvar::DisplayConfig_ASG_Prop_Display3::DisplaySetup_MainSetup_Bit21 = (indication_data[2] >> 5) & 0x01;
	@sysvar::DisplayConfig_ASG_Prop_Display3::DisplaySetup_MainSetup_Bit22 = (indication_data[2] >> 6) & 0x01;
	@sysvar::DisplayConfig_ASG_Prop_Display3::DisplaySetup_MainSetup_Bit23 = (indication_data[2] >> 7) & 0x01;
	
	@sysvar::DisplayConfig_ASG_Prop_Display3::DisplaySetup_MainSetup_Bit24 = (indication_data[3] >> 0) & 0x01;
	@sysvar::DisplayConfig_ASG_Prop_Display3::DisplaySetup_MainSetup_Bit25 = (indication_data[3] >> 1) & 0x01;
	@sysvar::DisplayConfig_ASG_Prop_Display3::DisplaySetup_MainSetup_Bit26 = (indication_data[3] >> 2) & 0x01;
	@sysvar::DisplayConfig_ASG_Prop_Display3::DisplaySetup_MainSetup_Bit27 = (indication_data[3] >> 3) & 0x01;
	@sysvar::DisplayConfig_ASG_Prop_Display3::DisplaySetup_MainSetup_Bit28 = (indication_data[3] >> 4) & 0x01;
	
	// start DisplayedAdditionalInfos (1 byte)
	@sysvar::DisplayConfig_ASG_Prop_Display3::DisplaySetup_DisplayedAdditionalInfos_Bit00 = (indication_data[4] >> 0) & 0x01;
	@sysvar::DisplayConfig_ASG_Prop_Display3::DisplaySetup_DisplayedAdditionalInfos_Bit01 = (indication_data[4] >> 1) & 0x01;
	
	// start AdditionalInfo1_1 (4 byte)
	@sysvar::DisplayConfig_ASG_Prop_Display3::DisplaySetup_AdditionalInfo_1_1_Bit00 = (indication_data[5] >> 0) & 0x01;
	@sysvar::DisplayConfig_ASG_Prop_Display3::DisplaySetup_AdditionalInfo_1_1_Bit01 = (indication_data[5] >> 1) & 0x01;
	@sysvar::DisplayConfig_ASG_Prop_Display3::DisplaySetup_AdditionalInfo_1_1_Bit02 = (indication_data[5] >> 2) & 0x01;
	@sysvar::DisplayConfig_ASG_Prop_Display3::DisplaySetup_AdditionalInfo_1_1_Bit03 = (indication_data[5] >> 3) & 0x01;
	@sysvar::DisplayConfig_ASG_Prop_Display3::DisplaySetup_AdditionalInfo_1_1_Bit04 = (indication_data[5] >> 4) & 0x01;
	@sysvar::DisplayConfig_ASG_Prop_Display3::DisplaySetup_AdditionalInfo_1_1_Bit05 = (indication_data[5] >> 5) & 0x01;
	@sysvar::DisplayConfig_ASG_Prop_Display3::DisplaySetup_AdditionalInfo_1_1_Bit06 = (indication_data[5] >> 6) & 0x01;
	@sysvar::DisplayConfig_ASG_Prop_Display3::DisplaySetup_AdditionalInfo_1_1_Bit07 = (indication_data[5] >> 7) & 0x01;

	@sysvar::DisplayConfig_ASG_Prop_Display3::DisplaySetup_AdditionalInfo_1_1_Bit08 = (indication_data[6] >> 0) & 0x01;
	@sysvar::DisplayConfig_ASG_Prop_Display3::DisplaySetup_AdditionalInfo_1_1_Bit09 = (indication_data[6] >> 1) & 0x01;
	@sysvar::DisplayConfig_ASG_Prop_Display3::DisplaySetup_AdditionalInfo_1_1_Bit10 = (indication_data[6] >> 2) & 0x01;
	@sysvar::DisplayConfig_ASG_Prop_Display3::DisplaySetup_AdditionalInfo_1_1_Bit11 = (indication_data[6] >> 3) & 0x01;
	@sysvar::DisplayConfig_ASG_Prop_Display3::DisplaySetup_AdditionalInfo_1_1_Bit12 = (indication_data[6] >> 4) & 0x01;
	@sysvar::DisplayConfig_ASG_Prop_Display3::DisplaySetup_AdditionalInfo_1_1_Bit13 = (indication_data[6] >> 5) & 0x01;
	@sysvar::DisplayConfig_ASG_Prop_Display3::DisplaySetup_AdditionalInfo_1_1_Bit14 = (indication_data[6] >> 6) & 0x01;
	@sysvar::DisplayConfig_ASG_Prop_Display3::DisplaySetup_AdditionalInfo_1_1_Bit15 = (indication_data[6] >> 7) & 0x01;
	
	@sysvar::DisplayConfig_ASG_Prop_Display3::DisplaySetup_AdditionalInfo_1_1_Bit16 = (indication_data[7] >> 0) & 0x01;
	@sysvar::DisplayConfig_ASG_Prop_Display3::DisplaySetup_AdditionalInfo_1_1_Bit17 = (indication_data[7] >> 1) & 0x01;
	@sysvar::DisplayConfig_ASG_Prop_Display3::DisplaySetup_AdditionalInfo_1_1_Bit18 = (indication_data[7] >> 2) & 0x01;
	@sysvar::DisplayConfig_ASG_Prop_Display3::DisplaySetup_AdditionalInfo_1_1_Bit19 = (indication_data[7] >> 3) & 0x01;
	@sysvar::DisplayConfig_ASG_Prop_Display3::DisplaySetup_AdditionalInfo_1_1_Bit20 = (indication_data[7] >> 4) & 0x01;
	@sysvar::DisplayConfig_ASG_Prop_Display3::DisplaySetup_AdditionalInfo_1_1_Bit21 = (indication_data[7] >> 5) & 0x01;
	@sysvar::DisplayConfig_ASG_Prop_Display3::DisplaySetup_AdditionalInfo_1_1_Bit22 = (indication_data[7] >> 6) & 0x01;
	@sysvar::DisplayConfig_ASG_Prop_Display3::DisplaySetup_AdditionalInfo_1_1_Bit23 = (indication_data[7] >> 7) & 0x01;
	
	@sysvar::DisplayConfig_ASG_Prop_Display3::DisplaySetup_AdditionalInfo_1_1_Bit24 = (indication_data[8] >> 0) & 0x01;
	@sysvar::DisplayConfig_ASG_Prop_Display3::DisplaySetup_AdditionalInfo_1_1_Bit25 = (indication_data[8] >> 1) & 0x01;
	@sysvar::DisplayConfig_ASG_Prop_Display3::DisplaySetup_AdditionalInfo_1_1_Bit26 = (indication_data[8] >> 2) & 0x01;
	@sysvar::DisplayConfig_ASG_Prop_Display3::DisplaySetup_AdditionalInfo_1_1_Bit27 = (indication_data[8] >> 3) & 0x01;
	@sysvar::DisplayConfig_ASG_Prop_Display3::DisplaySetup_AdditionalInfo_1_1_Bit28 = (indication_data[8] >> 4) & 0x01;
	@sysvar::DisplayConfig_ASG_Prop_Display3::DisplaySetup_AdditionalInfo_1_1_Bit29 = (indication_data[8] >> 5) & 0x01;
	@sysvar::DisplayConfig_ASG_Prop_Display3::DisplaySetup_AdditionalInfo_1_1_Bit30 = (indication_data[8] >> 6) & 0x01;
	@sysvar::DisplayConfig_ASG_Prop_Display3::DisplaySetup_AdditionalInfo_1_1_Bit31 = (indication_data[8] >> 7) & 0x01;
	
	// start AdditionalInfo1_2 (4 byte)
	@sysvar::DisplayConfig_ASG_Prop_Display3::DisplaySetup_AdditionalInfo_1_2_Bit00 = (indication_data[9] >> 0) & 0x01;
	@sysvar::DisplayConfig_ASG_Prop_Display3::DisplaySetup_AdditionalInfo_1_2_Bit01 = (indication_data[9] >> 1) & 0x01;
	@sysvar::DisplayConfig_ASG_Prop_Display3::DisplaySetup_AdditionalInfo_1_2_Bit02 = (indication_data[9] >> 2) & 0x01;
	@sysvar::DisplayConfig_ASG_Prop_Display3::DisplaySetup_AdditionalInfo_1_2_Bit03 = (indication_data[9] >> 3) & 0x01;
	@sysvar::DisplayConfig_ASG_Prop_Display3::DisplaySetup_AdditionalInfo_1_2_Bit04 = (indication_data[9] >> 4) & 0x01;
	@sysvar::DisplayConfig_ASG_Prop_Display3::DisplaySetup_AdditionalInfo_1_2_Bit05 = (indication_data[9] >> 5) & 0x01;
	@sysvar::DisplayConfig_ASG_Prop_Display3::DisplaySetup_AdditionalInfo_1_2_Bit06 = (indication_data[9] >> 6) & 0x01;
	@sysvar::DisplayConfig_ASG_Prop_Display3::DisplaySetup_AdditionalInfo_1_2_Bit07 = (indication_data[9] >> 7) & 0x01;

	@sysvar::DisplayConfig_ASG_Prop_Display3::DisplaySetup_AdditionalInfo_1_2_Bit08 = (indication_data[10] >> 0) & 0x01;
	@sysvar::DisplayConfig_ASG_Prop_Display3::DisplaySetup_AdditionalInfo_1_2_Bit09 = (indication_data[10] >> 1) & 0x01;
	@sysvar::DisplayConfig_ASG_Prop_Display3::DisplaySetup_AdditionalInfo_1_2_Bit10 = (indication_data[10] >> 2) & 0x01;
	@sysvar::DisplayConfig_ASG_Prop_Display3::DisplaySetup_AdditionalInfo_1_2_Bit11 = (indication_data[10] >> 3) & 0x01;
	@sysvar::DisplayConfig_ASG_Prop_Display3::DisplaySetup_AdditionalInfo_1_2_Bit12 = (indication_data[10] >> 4) & 0x01;
	@sysvar::DisplayConfig_ASG_Prop_Display3::DisplaySetup_AdditionalInfo_1_2_Bit13 = (indication_data[10] >> 5) & 0x01;
	@sysvar::DisplayConfig_ASG_Prop_Display3::DisplaySetup_AdditionalInfo_1_2_Bit14 = (indication_data[10] >> 6) & 0x01;
	@sysvar::DisplayConfig_ASG_Prop_Display3::DisplaySetup_AdditionalInfo_1_2_Bit15 = (indication_data[10] >> 7) & 0x01;
	
	@sysvar::DisplayConfig_ASG_Prop_Display3::DisplaySetup_AdditionalInfo_1_2_Bit16 = (indication_data[11] >> 0) & 0x01;
	@sysvar::DisplayConfig_ASG_Prop_Display3::DisplaySetup_AdditionalInfo_1_2_Bit17 = (indication_data[11] >> 1) & 0x01;
	@sysvar::DisplayConfig_ASG_Prop_Display3::DisplaySetup_AdditionalInfo_1_2_Bit18 = (indication_data[11] >> 2) & 0x01;
	@sysvar::DisplayConfig_ASG_Prop_Display3::DisplaySetup_AdditionalInfo_1_2_Bit19 = (indication_data[11] >> 3) & 0x01;
	@sysvar::DisplayConfig_ASG_Prop_Display3::DisplaySetup_AdditionalInfo_1_2_Bit20 = (indication_data[11] >> 4) & 0x01;
	@sysvar::DisplayConfig_ASG_Prop_Display3::DisplaySetup_AdditionalInfo_1_2_Bit21 = (indication_data[11] >> 5) & 0x01;
	@sysvar::DisplayConfig_ASG_Prop_Display3::DisplaySetup_AdditionalInfo_1_2_Bit22 = (indication_data[11] >> 6) & 0x01;
	@sysvar::DisplayConfig_ASG_Prop_Display3::DisplaySetup_AdditionalInfo_1_2_Bit23 = (indication_data[11] >> 7) & 0x01;
	
	@sysvar::DisplayConfig_ASG_Prop_Display3::DisplaySetup_AdditionalInfo_1_2_Bit24 = (indication_data[12] >> 0) & 0x01;
	@sysvar::DisplayConfig_ASG_Prop_Display3::DisplaySetup_AdditionalInfo_1_2_Bit25 = (indication_data[12] >> 1) & 0x01;
	@sysvar::DisplayConfig_ASG_Prop_Display3::DisplaySetup_AdditionalInfo_1_2_Bit26 = (indication_data[12] >> 2) & 0x01;
	@sysvar::DisplayConfig_ASG_Prop_Display3::DisplaySetup_AdditionalInfo_1_2_Bit27 = (indication_data[12] >> 3) & 0x01;
	@sysvar::DisplayConfig_ASG_Prop_Display3::DisplaySetup_AdditionalInfo_1_2_Bit28 = (indication_data[12] >> 4) & 0x01;
	@sysvar::DisplayConfig_ASG_Prop_Display3::DisplaySetup_AdditionalInfo_1_2_Bit29 = (indication_data[12] >> 5) & 0x01;
	
		// start AdditionalInfo2_1 (4 byte)
	@sysvar::DisplayConfig_ASG_Prop_Display3::DisplaySetup_AdditionalInfo_2_1_Bit00 = (indication_data[13] >> 0) & 0x01;
	@sysvar::DisplayConfig_ASG_Prop_Display3::DisplaySetup_AdditionalInfo_2_1_Bit01 = (indication_data[13] >> 1) & 0x01;
	@sysvar::DisplayConfig_ASG_Prop_Display3::DisplaySetup_AdditionalInfo_2_1_Bit02 = (indication_data[13] >> 2) & 0x01;
	@sysvar::DisplayConfig_ASG_Prop_Display3::DisplaySetup_AdditionalInfo_2_1_Bit03 = (indication_data[13] >> 3) & 0x01;
	@sysvar::DisplayConfig_ASG_Prop_Display3::DisplaySetup_AdditionalInfo_2_1_Bit04 = (indication_data[13] >> 4) & 0x01;
	@sysvar::DisplayConfig_ASG_Prop_Display3::DisplaySetup_AdditionalInfo_2_1_Bit05 = (indication_data[13] >> 5) & 0x01;
	@sysvar::DisplayConfig_ASG_Prop_Display3::DisplaySetup_AdditionalInfo_2_1_Bit06 = (indication_data[13] >> 6) & 0x01;
	@sysvar::DisplayConfig_ASG_Prop_Display3::DisplaySetup_AdditionalInfo_2_1_Bit07 = (indication_data[13] >> 7) & 0x01;

	@sysvar::DisplayConfig_ASG_Prop_Display3::DisplaySetup_AdditionalInfo_2_1_Bit08 = (indication_data[14] >> 0) & 0x01;
	@sysvar::DisplayConfig_ASG_Prop_Display3::DisplaySetup_AdditionalInfo_2_1_Bit09 = (indication_data[14] >> 1) & 0x01;
	@sysvar::DisplayConfig_ASG_Prop_Display3::DisplaySetup_AdditionalInfo_2_1_Bit10 = (indication_data[14] >> 2) & 0x01;
	@sysvar::DisplayConfig_ASG_Prop_Display3::DisplaySetup_AdditionalInfo_2_1_Bit11 = (indication_data[14] >> 3) & 0x01;
	@sysvar::DisplayConfig_ASG_Prop_Display3::DisplaySetup_AdditionalInfo_2_1_Bit12 = (indication_data[14] >> 4) & 0x01;
	@sysvar::DisplayConfig_ASG_Prop_Display3::DisplaySetup_AdditionalInfo_2_1_Bit13 = (indication_data[14] >> 5) & 0x01;
	@sysvar::DisplayConfig_ASG_Prop_Display3::DisplaySetup_AdditionalInfo_2_1_Bit14 = (indication_data[14] >> 6) & 0x01;
	@sysvar::DisplayConfig_ASG_Prop_Display3::DisplaySetup_AdditionalInfo_2_1_Bit15 = (indication_data[14] >> 7) & 0x01;
	
	@sysvar::DisplayConfig_ASG_Prop_Display3::DisplaySetup_AdditionalInfo_2_1_Bit16 = (indication_data[15] >> 0) & 0x01;
	@sysvar::DisplayConfig_ASG_Prop_Display3::DisplaySetup_AdditionalInfo_2_1_Bit17 = (indication_data[15] >> 1) & 0x01;
	@sysvar::DisplayConfig_ASG_Prop_Display3::DisplaySetup_AdditionalInfo_2_1_Bit18 = (indication_data[15] >> 2) & 0x01;
	@sysvar::DisplayConfig_ASG_Prop_Display3::DisplaySetup_AdditionalInfo_2_1_Bit19 = (indication_data[15] >> 3) & 0x01;
	@sysvar::DisplayConfig_ASG_Prop_Display3::DisplaySetup_AdditionalInfo_2_1_Bit20 = (indication_data[15] >> 4) & 0x01;
	@sysvar::DisplayConfig_ASG_Prop_Display3::DisplaySetup_AdditionalInfo_2_1_Bit21 = (indication_data[15] >> 5) & 0x01;
	@sysvar::DisplayConfig_ASG_Prop_Display3::DisplaySetup_AdditionalInfo_2_1_Bit22 = (indication_data[15] >> 6) & 0x01;
	@sysvar::DisplayConfig_ASG_Prop_Display3::DisplaySetup_AdditionalInfo_2_1_Bit23 = (indication_data[15] >> 7) & 0x01;
	
	@sysvar::DisplayConfig_ASG_Prop_Display3::DisplaySetup_AdditionalInfo_2_1_Bit24 = (indication_data[16] >> 0) & 0x01;
	@sysvar::DisplayConfig_ASG_Prop_Display3::DisplaySetup_AdditionalInfo_2_1_Bit25 = (indication_data[16] >> 1) & 0x01;
	@sysvar::DisplayConfig_ASG_Prop_Display3::DisplaySetup_AdditionalInfo_2_1_Bit26 = (indication_data[16] >> 2) & 0x01;
	@sysvar::DisplayConfig_ASG_Prop_Display3::DisplaySetup_AdditionalInfo_2_1_Bit27 = (indication_data[16] >> 3) & 0x01;
	@sysvar::DisplayConfig_ASG_Prop_Display3::DisplaySetup_AdditionalInfo_2_1_Bit28 = (indication_data[16] >> 4) & 0x01;
	@sysvar::DisplayConfig_ASG_Prop_Display3::DisplaySetup_AdditionalInfo_2_1_Bit29 = (indication_data[16] >> 5) & 0x01;
	@sysvar::DisplayConfig_ASG_Prop_Display3::DisplaySetup_AdditionalInfo_2_1_Bit30 = (indication_data[16] >> 6) & 0x01;
	@sysvar::DisplayConfig_ASG_Prop_Display3::DisplaySetup_AdditionalInfo_2_1_Bit31 = (indication_data[16] >> 7) & 0x01;
	
		// start AdditionalInfo2_2 (4 byte)
	@sysvar::DisplayConfig_ASG_Prop_Display3::DisplaySetup_AdditionalInfo_2_2_Bit00 = (indication_data[17] >> 0) & 0x01;
	@sysvar::DisplayConfig_ASG_Prop_Display3::DisplaySetup_AdditionalInfo_2_2_Bit01 = (indication_data[17] >> 1) & 0x01;
	@sysvar::DisplayConfig_ASG_Prop_Display3::DisplaySetup_AdditionalInfo_2_2_Bit02 = (indication_data[17] >> 2) & 0x01;
	@sysvar::DisplayConfig_ASG_Prop_Display3::DisplaySetup_AdditionalInfo_2_2_Bit03 = (indication_data[17] >> 3) & 0x01;
	@sysvar::DisplayConfig_ASG_Prop_Display3::DisplaySetup_AdditionalInfo_2_2_Bit04 = (indication_data[17] >> 4) & 0x01;
	@sysvar::DisplayConfig_ASG_Prop_Display3::DisplaySetup_AdditionalInfo_2_2_Bit05 = (indication_data[17] >> 5) & 0x01;
	@sysvar::DisplayConfig_ASG_Prop_Display3::DisplaySetup_AdditionalInfo_2_2_Bit06 = (indication_data[17] >> 6) & 0x01;
	@sysvar::DisplayConfig_ASG_Prop_Display3::DisplaySetup_AdditionalInfo_2_2_Bit07 = (indication_data[17] >> 7) & 0x01;

	@sysvar::DisplayConfig_ASG_Prop_Display3::DisplaySetup_AdditionalInfo_2_2_Bit08 = (indication_data[18] >> 0) & 0x01;
	@sysvar::DisplayConfig_ASG_Prop_Display3::DisplaySetup_AdditionalInfo_2_2_Bit09 = (indication_data[18] >> 1) & 0x01;
	@sysvar::DisplayConfig_ASG_Prop_Display3::DisplaySetup_AdditionalInfo_2_2_Bit10 = (indication_data[18] >> 2) & 0x01;
	@sysvar::DisplayConfig_ASG_Prop_Display3::DisplaySetup_AdditionalInfo_2_2_Bit11 = (indication_data[18] >> 3) & 0x01;
	@sysvar::DisplayConfig_ASG_Prop_Display3::DisplaySetup_AdditionalInfo_2_2_Bit12 = (indication_data[18] >> 4) & 0x01;
	@sysvar::DisplayConfig_ASG_Prop_Display3::DisplaySetup_AdditionalInfo_2_2_Bit13 = (indication_data[18] >> 5) & 0x01;
	@sysvar::DisplayConfig_ASG_Prop_Display3::DisplaySetup_AdditionalInfo_2_2_Bit14 = (indication_data[18] >> 6) & 0x01;
	@sysvar::DisplayConfig_ASG_Prop_Display3::DisplaySetup_AdditionalInfo_2_2_Bit15 = (indication_data[18] >> 7) & 0x01;
	
	@sysvar::DisplayConfig_ASG_Prop_Display3::DisplaySetup_AdditionalInfo_2_2_Bit16 = (indication_data[19] >> 0) & 0x01;
	@sysvar::DisplayConfig_ASG_Prop_Display3::DisplaySetup_AdditionalInfo_2_2_Bit17 = (indication_data[19] >> 1) & 0x01;
	@sysvar::DisplayConfig_ASG_Prop_Display3::DisplaySetup_AdditionalInfo_2_2_Bit18 = (indication_data[19] >> 2) & 0x01;
	@sysvar::DisplayConfig_ASG_Prop_Display3::DisplaySetup_AdditionalInfo_2_2_Bit19 = (indication_data[19] >> 3) & 0x01;
	@sysvar::DisplayConfig_ASG_Prop_Display3::DisplaySetup_AdditionalInfo_2_2_Bit20 = (indication_data[19] >> 4) & 0x01;
	@sysvar::DisplayConfig_ASG_Prop_Display3::DisplaySetup_AdditionalInfo_2_2_Bit21 = (indication_data[19] >> 5) & 0x01;
	@sysvar::DisplayConfig_ASG_Prop_Display3::DisplaySetup_AdditionalInfo_2_2_Bit22 = (indication_data[19] >> 6) & 0x01;
	@sysvar::DisplayConfig_ASG_Prop_Display3::DisplaySetup_AdditionalInfo_2_2_Bit23 = (indication_data[19] >> 7) & 0x01;
	
	@sysvar::DisplayConfig_ASG_Prop_Display3::DisplaySetup_AdditionalInfo_2_2_Bit24 = (indication_data[20] >> 0) & 0x01;
	@sysvar::DisplayConfig_ASG_Prop_Display3::DisplaySetup_AdditionalInfo_2_2_Bit25 = (indication_data[20] >> 1) & 0x01;
	@sysvar::DisplayConfig_ASG_Prop_Display3::DisplaySetup_AdditionalInfo_2_2_Bit26 = (indication_data[20] >> 2) & 0x01;
	@sysvar::DisplayConfig_ASG_Prop_Display3::DisplaySetup_AdditionalInfo_2_2_Bit27 = (indication_data[20] >> 3) & 0x01;
	@sysvar::DisplayConfig_ASG_Prop_Display3::DisplaySetup_AdditionalInfo_2_2_Bit28 = (indication_data[20] >> 4) & 0x01;
	@sysvar::DisplayConfig_ASG_Prop_Display3::DisplaySetup_AdditionalInfo_2_2_Bit29 = (indication_data[20] >> 5) & 0x01;
}

void extractData_0x18_Display3MainSelection(byte indication_data[])
{
	// byte[0]
	@sysvar::DisplayConfig_ASG_Prop_Display3::DisplayMainSelection_MainSelection_Bit00 = (indication_data[0] >> 0) & 0x01;
	@sysvar::DisplayConfig_ASG_Prop_Display3::DisplayMainSelection_MainSelection_Bit01 = (indication_data[0] >> 1) & 0x01;
	@sysvar::DisplayConfig_ASG_Prop_Display3::DisplayMainSelection_MainSelection_Bit02 = (indication_data[0] >> 2) & 0x01;
	@sysvar::DisplayConfig_ASG_Prop_Display3::DisplayMainSelection_MainSelection_Bit03 = (indication_data[0] >> 3) & 0x01;
	@sysvar::DisplayConfig_ASG_Prop_Display3::DisplayMainSelection_MainSelection_Bit04 = (indication_data[0] >> 4) & 0x01;
	@sysvar::DisplayConfig_ASG_Prop_Display3::DisplayMainSelection_MainSelection_Bit05 = (indication_data[0] >> 5) & 0x01;
	@sysvar::DisplayConfig_ASG_Prop_Display3::DisplayMainSelection_MainSelection_Bit06 = (indication_data[0] >> 6) & 0x01;
	@sysvar::DisplayConfig_ASG_Prop_Display3::DisplayMainSelection_MainSelection_Bit07 = (indication_data[0] >> 7) & 0x01;
	// byte[1]
	@sysvar::DisplayConfig_ASG_Prop_Display3::DisplayMainSelection_MainSelection_Bit08 = (indication_data[1] >> 0) & 0x01;
	@sysvar::DisplayConfig_ASG_Prop_Display3::DisplayMainSelection_MainSelection_Bit09 = (indication_data[1] >> 1) & 0x01;
	@sysvar::DisplayConfig_ASG_Prop_Display3::DisplayMainSelection_MainSelection_Bit10 = (indication_data[1] >> 2) & 0x01;
	@sysvar::DisplayConfig_ASG_Prop_Display3::DisplayMainSelection_MainSelection_Bit11 = (indication_data[1] >> 3) & 0x01;
	@sysvar::DisplayConfig_ASG_Prop_Display3::DisplayMainSelection_MainSelection_Bit12 = (indication_data[1] >> 4) & 0x01;
	@sysvar::DisplayConfig_ASG_Prop_Display3::DisplayMainSelection_MainSelection_Bit13 = (indication_data[1] >> 5) & 0x01;
	@sysvar::DisplayConfig_ASG_Prop_Display3::DisplayMainSelection_MainSelection_Bit14 = (indication_data[1] >> 6) & 0x01;
	@sysvar::DisplayConfig_ASG_Prop_Display3::DisplayMainSelection_MainSelection_Bit15 = (indication_data[1] >> 7) & 0x01;
	// byte[2]
	@sysvar::DisplayConfig_ASG_Prop_Display3::DisplayMainSelection_MainSelection_Bit16 = (indication_data[2] >> 0) & 0x01;
	@sysvar::DisplayConfig_ASG_Prop_Display3::DisplayMainSelection_MainSelection_Bit17 = (indication_data[2] >> 1) & 0x01;
	@sysvar::DisplayConfig_ASG_Prop_Display3::DisplayMainSelection_MainSelection_Bit18 = (indication_data[2] >> 2) & 0x01;
	@sysvar::DisplayConfig_ASG_Prop_Display3::DisplayMainSelection_MainSelection_Bit19 = (indication_data[2] >> 3) & 0x01;
	@sysvar::DisplayConfig_ASG_Prop_Display3::DisplayMainSelection_MainSelection_Bit20 = (indication_data[2] >> 4) & 0x01;
	@sysvar::DisplayConfig_ASG_Prop_Display3::DisplayMainSelection_MainSelection_Bit21 = (indication_data[2] >> 5) & 0x01;
	@sysvar::DisplayConfig_ASG_Prop_Display3::DisplayMainSelection_MainSelection_Bit22 = (indication_data[2] >> 6) & 0x01;
	@sysvar::DisplayConfig_ASG_Prop_Display3::DisplayMainSelection_MainSelection_Bit23 = (indication_data[2] >> 7) & 0x01;
	// byte[3]
	@sysvar::DisplayConfig_ASG_Prop_Display3::DisplayMainSelection_MainSelection_Bit24 = (indication_data[3] >> 0) & 0x01;
	@sysvar::DisplayConfig_ASG_Prop_Display3::DisplayMainSelection_MainSelection_Bit25 = (indication_data[3] >> 1) & 0x01;
	@sysvar::DisplayConfig_ASG_Prop_Display3::DisplayMainSelection_MainSelection_Bit26 = (indication_data[3] >> 2) & 0x01;
	@sysvar::DisplayConfig_ASG_Prop_Display3::DisplayMainSelection_MainSelection_Bit27 = (indication_data[3] >> 3) & 0x01;
	@sysvar::DisplayConfig_ASG_Prop_Display3::DisplayMainSelection_MainSelection_Bit28 = (indication_data[3] >> 4) & 0x01;
	// byte[4]
	@sysvar::DisplayConfig_ASG_Prop_Display3::DisplayMainSelection_Extension1 = (indication_data[4] >> 4) & 0x0F;
	@sysvar::DisplayConfig_ASG_Prop_Display3::DisplayMainSelection_Extension2 = (indication_data[4] >> 0) & 0x0F;
}

void extractData_0x19_AdditionalInstrument(byte indication_data[])
{
	@sysvar::DisplayConfig_ASG_Prop_AdditionalInstrument::x19_AdditionalInstrument_Setup_Bit00 				= (indication_data[0] >> 0) & 0x01;
	@sysvar::DisplayConfig_ASG_Prop_AdditionalInstrument::x19_AdditionalInstrument_Setup_Bit01 				= (indication_data[0] >> 1) & 0x01;
	@sysvar::DisplayConfig_ASG_Prop_AdditionalInstrument::x19_AdditionalInstrument_Setup_Bit02 				= (indication_data[0] >> 2) & 0x01;
	
	@sysvar::DisplayConfig_ASG_Prop_AdditionalInstrument::x19_AdditionalInstrument_Brightness 				= indication_data[1];
	
	@sysvar::DisplayConfig_ASG_Prop_AdditionalInstrument::x19_AdditionalInstrument_ModificationReason 		= (indication_data[2] >> 4) & 0x0F;
	@sysvar::DisplayConfig_ASG_Prop_AdditionalInstrument::x19_AdditionalInstrument_ModificationState_Bit0	= (indication_data[2] >> 0) & 0x01;
}

void extractData_0x1A_AdditionalInstrument2(byte headerData)
{
	@sysvar::DisplayConfig_ASG_Prop_AdditionalInstrument::x1A_AdditionalInstrument2_Setup_Bit00 = (headerData >> 0) & 0x01;
	@sysvar::DisplayConfig_ASG_Prop_AdditionalInstrument::x1A_AdditionalInstrument2_Setup_Bit01 = (headerData >> 1) & 0x01;
	@sysvar::DisplayConfig_ASG_Prop_AdditionalInstrument::x1A_AdditionalInstrument2_Setup_Bit02 = (headerData >> 2) & 0x01;
	@sysvar::DisplayConfig_ASG_Prop_AdditionalInstrument::x1A_AdditionalInstrument2_Setup_Bit03 = (headerData >> 3) & 0x01;
	@sysvar::DisplayConfig_ASG_Prop_AdditionalInstrument::x1A_AdditionalInstrument2_Setup_Bit04 = (headerData >> 4) & 0x01;
}

void extractData_0x1B_DisplayPresets(byte indication_data[])
{
	byte transmitPos, recordAddress, idxSize, direction, shift;
	int startEl, elements;
	word wordBuffer;
	int byteCounter, actualPos;
	int i;
	
	// Init helper variable
	transmitPos 	= Array_DecodeModeByte_getTransmitPos(indication_data[2]);
	recordAddress	= Array_DecodeModeByte_getRecordAddress(indication_data[2]);
	idxSize			= Array_DecodeModeByte_getIdxSize(indication_data[2]);
	direction		= Array_DecodeModeByte_getDirection(indication_data[2]);
	shift			= Array_DecodeModeByte_getShift(indication_data[2]);
	
	// Catch invalid RecordAddress
	if    (recordAddress != DISPLAY_PRESETS_RECADDR_POS
		&& recordAddress != DISPLAY_PRESETS_RECADDR_DISPLAY12
		&& recordAddress != DISPLAY_PRESETS_RECADDR_DISPLAY123)
		return;
	
	//buffer[0] = ASG_ID/TAID;
    //buffer[1] = tnle;
    //buffer[2] = modeByte;  
    if(idxSize == 0)                                                                        // 8 bit addressing
    {
        startEl = indication_data[3];
        elements = indication_data[4];
		byteCounter = 5;
    }
    else                                                                                    // 16 bit addressing
    {
		wordBuffer = indication_data[4];
		wordBuffer = (wordBuffer << 8);
        wordBuffer |= indication_data[3];
		startEl = wordBuffer;

		wordBuffer = indication_data[6];
		wordBuffer = (wordBuffer << 8);
        wordBuffer |= indication_data[5];
		elements = wordBuffer;
		
		byteCounter = 7;
    }
	
	// use Pos parameter to differentiate elements
	if(transmitPos == 1 || recordAddress == DISPLAY_PRESETS_RECADDR_POS)
    {
		for(i=0; i<elements; i++)
		{
			if(idxSize == 0)
			{
				actualPos = indication_data[byteCounter];
				byteCounter++;
			}
			else
			{
				wordBuffer = indication_data[byteCounter + 1];
				wordBuffer = (wordBuffer << 8);
        		wordBuffer |= indication_data[byteCounter];
				actualPos = wordBuffer;
				byteCounter++;
				byteCounter++;
            }
			byteCounter = extractData_0x1B_DisplayPresets_singleElement(indication_data, recordAddress, actualPos, byteCounter);
		}
	}
	// use start, shift, direction and elements parameter
	else
	{
		actualPos = startEl;
		if(direction == 0)
		{
			if (shift == 1)
				actualPos++;
			
			for(i=0; i<elements; i++)
			{
				byteCounter = extractData_0x1B_DisplayPresets_singleElement(indication_data, recordAddress, actualPos, byteCounter);
				actualPos++;
			}
		}
		else
		{
			if (shift == 1)
				actualPos--;
			
			for(i=0; i<elements; i++)
			{
				byteCounter = extractData_0x1B_DisplayPresets_singleElement(indication_data, recordAddress, actualPos, byteCounter);
				actualPos--;
			}
		}
    }
}

int extractData_0x1B_DisplayPresets_singleElement(byte indication_data[], byte recordAddress, word pos, int startByte)
{

	int idx;
	dWord dwordBuffer;
	idx = startByte;
	
	DisplayPresets_Data_Validity_get[pos] 				= 1;
	DisplayPresets_Data_Pos_get[pos] 					= pos;
    
    // Display1, Display2 - if transmission is enabled via recordAddress
    if(recordAddress == DISPLAY_PRESETS_RECADDR_DISPLAY12 || recordAddress == DISPLAY_PRESETS_RECADDR_DISPLAY123)
    {
		DisplayPresets_Data_State_get[pos]					= indication_data[idx];
		idx++;
		
		DisplayPresets_Data_DisplayPresetType_get[pos]		= indication_data[idx];
		idx++;
		
		DisplayPresets_Data_DisplayPresetInstance_get[pos]	= indication_data[idx];
		idx++;
		
		dwordBuffer = 0;
		dwordBuffer |= (indication_data[idx] << 0);
		idx++;
		dwordBuffer |= (indication_data[idx] << 8);
		idx++;
		dwordBuffer |= (indication_data[idx] << 16);
		idx++;
		dwordBuffer |= (indication_data[idx] << 24);
		idx++;
		DisplayPresets_Data_Display1MainSelection_get[pos] = dwordBuffer;
		
		dwordBuffer = 0;
		dwordBuffer |= (indication_data[idx] << 0);
		idx++;
		dwordBuffer |= (indication_data[idx] << 8);
		idx++;
		dwordBuffer |= (indication_data[idx] << 16);
		idx++;
		dwordBuffer |= (indication_data[idx] << 24);
		idx++;
		DisplayPresets_Data_Display1AdditionalInfo1_1_get[pos] = dwordBuffer;
		
		dwordBuffer = 0;
		dwordBuffer |= (indication_data[idx] << 0);
		idx++;
		dwordBuffer |= (indication_data[idx] << 8);
		idx++;
		dwordBuffer |= (indication_data[idx] << 16);
		idx++;
		dwordBuffer |= (indication_data[idx] << 24);
		idx++;
		DisplayPresets_Data_Display1AdditionalInfo1_2_get[pos] = dwordBuffer;
		
		dwordBuffer = 0;
		dwordBuffer |= (indication_data[idx] << 0);
		idx++;
		dwordBuffer |= (indication_data[idx] << 8);
		idx++;
		dwordBuffer |= (indication_data[idx] << 16);
		idx++;
		dwordBuffer |= (indication_data[idx] << 24);
		idx++;
		DisplayPresets_Data_Display1AdditionalInfo2_1_get[pos] = dwordBuffer;
		
		dwordBuffer = 0;
		dwordBuffer |= (indication_data[idx] << 0);
		idx++;
		dwordBuffer |= (indication_data[idx] << 8);
		idx++;
		dwordBuffer |= (indication_data[idx] << 16);
		idx++;
		dwordBuffer |= (indication_data[idx] << 24);
		idx++;
		DisplayPresets_Data_Display1AdditionalInfo2_2_get[pos] = dwordBuffer;
		
		dwordBuffer = 0;
		dwordBuffer |= (indication_data[idx] << 0);
		idx++;
		dwordBuffer |= (indication_data[idx] << 8);
		idx++;
		dwordBuffer |= (indication_data[idx] << 16);
		idx++;
		dwordBuffer |= (indication_data[idx] << 24);
		idx++;
		DisplayPresets_Data_Display2MainSelection_get[pos] = dwordBuffer;
		
		dwordBuffer = 0;
		dwordBuffer |= (indication_data[idx] << 0);
		idx++;
		dwordBuffer |= (indication_data[idx] << 8);
		idx++;
		dwordBuffer |= (indication_data[idx] << 16);
		idx++;
		dwordBuffer |= (indication_data[idx] << 24);
		idx++;
		DisplayPresets_Data_Display2AdditionalInfo1_1_get[pos] = dwordBuffer;
		
		dwordBuffer = 0;
		dwordBuffer |= (indication_data[idx] << 0);
		idx++;
		dwordBuffer |= (indication_data[idx] << 8);
		idx++;
		dwordBuffer |= (indication_data[idx] << 16);
		idx++;
		dwordBuffer |= (indication_data[idx] << 24);
		idx++;
		DisplayPresets_Data_Display2AdditionalInfo1_2_get[pos] = dwordBuffer;
		
		dwordBuffer = 0;
		dwordBuffer |= (indication_data[idx] << 0);
		idx++;
		dwordBuffer |= (indication_data[idx] << 8);
		idx++;
		dwordBuffer |= (indication_data[idx] << 16);
		idx++;
		dwordBuffer |= (indication_data[idx] << 24);
		idx++;
		DisplayPresets_Data_Display2AdditionalInfo2_1_get[pos] = dwordBuffer;
		
		dwordBuffer = 0;
		dwordBuffer |= (indication_data[idx] << 0);
		idx++;
		dwordBuffer |= (indication_data[idx] << 8);
		idx++;
		dwordBuffer |= (indication_data[idx] << 16);
		idx++;
		dwordBuffer |= (indication_data[idx] << 24);
		idx++;
		DisplayPresets_Data_Display2AdditionalInfo2_2_get[pos] = dwordBuffer;
    }

    // Display3 - if transmission is enabled via recordAddress
    if(recordAddress == DISPLAY_PRESETS_RECADDR_DISPLAY123)
    {
        dwordBuffer = 0;
		dwordBuffer |= (indication_data[idx] << 0);
		idx++;
		dwordBuffer |= (indication_data[idx] << 8);
		idx++;
		dwordBuffer |= (indication_data[idx] << 16);
		idx++;
		dwordBuffer |= (indication_data[idx] << 24);
		idx++;
		DisplayPresets_Data_Display3MainSelection_get[pos] = dwordBuffer;
		
		dwordBuffer = 0;
		dwordBuffer |= (indication_data[idx] << 0);
		idx++;
		dwordBuffer |= (indication_data[idx] << 8);
		idx++;
		dwordBuffer |= (indication_data[idx] << 16);
		idx++;
		dwordBuffer |= (indication_data[idx] << 24);
		idx++;
		DisplayPresets_Data_Display3AdditionalInfo1_1_get[pos] = dwordBuffer;
		
		dwordBuffer = 0;
		dwordBuffer |= (indication_data[idx] << 0);
		idx++;
		dwordBuffer |= (indication_data[idx] << 8);
		idx++;
		dwordBuffer |= (indication_data[idx] << 16);
		idx++;
		dwordBuffer |= (indication_data[idx] << 24);
		idx++;
		DisplayPresets_Data_Display3AdditionalInfo1_2_get[pos] = dwordBuffer;
		
		dwordBuffer = 0;
		dwordBuffer |= (indication_data[idx] << 0);
		idx++;
		dwordBuffer |= (indication_data[idx] << 8);
		idx++;
		dwordBuffer |= (indication_data[idx] << 16);
		idx++;
		dwordBuffer |= (indication_data[idx] << 24);
		idx++;
		DisplayPresets_Data_Display3AdditionalInfo2_1_get[pos] = dwordBuffer;
		
		dwordBuffer = 0;
		dwordBuffer |= (indication_data[idx] << 0);
		idx++;
		dwordBuffer |= (indication_data[idx] << 8);
		idx++;
		dwordBuffer |= (indication_data[idx] << 16);
		idx++;
		dwordBuffer |= (indication_data[idx] << 24);
		idx++;
		DisplayPresets_Data_Display3AdditionalInfo2_2_get[pos] = dwordBuffer;
    }
		
	DisplayPresets_actualize_sysvar_get();
	
	return idx;
}

void extractData_0x1C_DisplayDependency(byte indication_data[])
{
	@sysvar::DisplayConfig_ASG_Prop::x1C_DisplayDependency_Setup_Bit0				= (indication_data[0] >> 0) & 0x01;	
	
	@sysvar::DisplayConfig_ASG_Prop::x1C_DisplayDependency_Extension1				= indication_data[1];
	@sysvar::DisplayConfig_ASG_Prop::x1C_DisplayDependency_Extension2				= indication_data[2];

	@sysvar::DisplayConfig_ASG_Prop::x1C_DisplayDependency_ModificationReason		= (indication_data[3] >> 4) & 0x0F;
	@sysvar::DisplayConfig_ASG_Prop::x1C_DisplayDependency_ModificationState_Bit0	= (indication_data[3] >> 0) & 0x01;

}

void extractData_0x1D_ActiveDisplayPreset(byte indication_data[])
{
	@sysvar::DisplayConfig_ASG_Prop::x1D_ActiveDisplayPreset_PresetID				= indication_data[0];	

	@sysvar::DisplayConfig_ASG_Prop::x1D_ActiveDisplayPreset_ModificationReason		= (indication_data[1] >> 4) & 0x0F;
	@sysvar::DisplayConfig_ASG_Prop::x1D_ActiveDisplayPreset_ModificationState_Bit0	= (indication_data[1] >> 0) & 0x01;

}
void extractData_0x1E_DisplayViewConfiguration(byte indication_data[])
{
    @sysvar::DisplayConfig_ASG_Prop::x1E_DisplayViewConfiguration_ActiveDisplayView			= indication_data[0];		

	@sysvar::DisplayConfig_ASG_Prop::x1E_DisplayViewConfiguration_Extension1				= indication_data[1];
	@sysvar::DisplayConfig_ASG_Prop::x1E_DisplayViewConfiguration_Extension2				= indication_data[2];

	@sysvar::DisplayConfig_ASG_Prop::x1E_DisplayViewConfiguration_ModificationReason		= (indication_data[3] >> 4) & 0x0F;
	@sysvar::DisplayConfig_ASG_Prop::x1E_DisplayViewConfiguration_ModificationState_Bit0	= (indication_data[3] >> 0) & 0x01;

}
void extractData_0x1F_LED_Configuration(byte indication_data[])
{
	@sysvar::DisplayConfig_ASG_Prop::x1F_LED_Configuration_State_Bit0				= (indication_data[0] >> 0) & 0x01;

	@sysvar::DisplayConfig_ASG_Prop::x1F_LED_Configuration_ModificationReason 		= (indication_data[1] >> 4) & 0x0F;
	@sysvar::DisplayConfig_ASG_Prop::x1F_LED_Configuration_ModificationState_Bit0	= (indication_data[1] >> 0) & 0x01;

	@sysvar::DisplayConfig_ASG_Prop::x1F_LED_Configuration_Extension1 				= indication_data[2];
	@sysvar::DisplayConfig_ASG_Prop::x1F_LED_Configuration_Extension2 				= indication_data[3];
	@sysvar::DisplayConfig_ASG_Prop::x1F_LED_Configuration_Extension3 				= indication_data[4];
	@sysvar::DisplayConfig_ASG_Prop::x1F_LED_Configuration_Extension4 				= indication_data[5];
}

on sysvar sysvar::DisplayConfig_General::Smart
{
    controls_enable_all();
}

on sysvar sysvar::DisplayConfig_ASG_ElementContentSelection::x12_ElementContentSelection_control_loadReload
{
    if(@this)
    {
        ElementContentSelection_init_CSV_setGet();
        @sysvar::DisplayConfig_ASG_ElementContentSelection::x12_ElementContentSelection_control_default_external = 1;
    }
}

on sysvar sysvar::DisplayConfig_ASG_DisplayPresets::x1B_DisplayPresets_control_onOff
{
    DisplayPresets_clearData_get ();
    
    if(@this)
        DisplayPresets_getElement(1);
}

on sysvar sysvar::DisplayConfig_ASG_DisplayPresets::x1B_DisplayPresets_control_loadReload
{
    if(@this)
    {
        DisplayPresets_init_CSV_setGet();
        @sysvar::DisplayConfig_ASG_DisplayPresets::x1B_DisplayPresets_control_default_external = 1;
    }
}

on sysvar sysvar::DisplayConfig_ASG::control_OnOff_indicator
{
    if(@this)
        enableControl("DisplayConfig_ASG_Main", "Ctrl_OnOff", TRUE);
    else
        enableControl("DisplayConfig_ASG_Main", "Ctrl_OnOff", FALSE);
}

on envvar env_ASG_Panel_DisplayConfig
{
    if(@this)
    {
        OpenPanel("DisplayConfig_ASG_Main");
    }
}
