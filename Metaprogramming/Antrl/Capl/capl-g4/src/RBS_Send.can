/*@!Encoding:1252*/
includes
{
//    #include "messages\message_Klima_03.cin"
//   #include "messages\message_Klima_12.cin"
//    #include "messages\message_Klima_16.cin"
}

variables
{
    message Anhaenger_01 _mAnhaenger_01;  // AAG
    msTimer _tAnhaenger_01;
    msTimer _totAnhaenger_01;

    message ASTA_Sensor_01 _mASTA_Sensor_01;  // AAG
    msTimer _tASTA_Sensor_01;
    msTimer _totASTA_Sensor_01;
 
    message AZK_01 _mAZK_01;  // BCM
    msTimer _tAZK_01;
    msTimer _totAZK_01;

    /*  message BAP_BC_ASG_02 _mBAP_BC_ASG_02;*/
    msTimer _tBAP_BC_ASG_02;
    msTimer _totBAP_BC_ASG_02;

    message BCM_01 _mBCM_01;  // BCM
    msTimer _tBCM_01;
    msTimer _totBCM_01;
    msTimer _tinhBCM_01;
    byte _bsiBCM_01 = 0; // send inhibited
    byte _bsaiBCM_01 = 0; // send after inhibited

    // delaytime=50 , i don't know why is implemented cycle only
    message BCM_03 _mBCM_03;  // BCM
    msTimer _tBCM_03;
    msTimer _totBCM_03;
  
    // delaytime=20 , i don't know why is implemented cycle only
    message BCM_04 _mBCM_04;  // BCM
    msTimer _tBCM_04;
    msTimer _totBCM_04;

    // new
    message BCM_05 _mBCM_05; 
    msTimer _tBCM_05;
    msTimer _totBCM_05;
    msTimer _tinhBCM_05;
    byte _bsiBCM_05 = 0; // send inhibited
    byte _bsaiBCM_05 = 0; // send after inhibited

    // new
    message BCM_06 _mBCM_06;
    msTimer _tBCM_06;
    msTimer _totBCM_06;
    msTimer _tinhBCM_06;
    byte _bsiBCM_06 = 0; // send inhibited
    byte _bsaiBCM_06 = 0; // send after inhibited

    // new
    message BCM_Kessy_01 _mBCM_Kessy_01;
    msTimer _tBCM_Kessy_01;
    msTimer _totBCM_Kessy_01;
    msTimer _tinhBCM_Kessy_01;
    byte _bsiBCM_Kessy_01 = 0; // send inhibited
    byte _bsaiBCM_Kessy_01 = 0; // send after inhibited
    byte _bBCM_Kessy_01Active = 0;

    // new
    message BCM_Kessy_02 _mBCM_Kessy_02;
    msTimer _tBCM_Kessy_02;
    msTimer _totBCM_Kessy_02;
    msTimer _tinhBCM_Kessy_02;
    byte _bsiBCM_Kessy_02 = 0; // send inhibited
    byte _bsaiBCM_Kessy_02 = 0; // send after inhibited
    byte _bBCM_Kessy_02Active = 0;

    // new
    message BCM_Taster_02 _mBCM_Taster_02;
    msTimer _tBCM_Taster_02;
    msTimer _totBCM_Taster_02;
    msTimer _tinhBCM_Taster_02;
    byte _bsiBCM_Taster_02 = 0; // send inhibited
    byte _bsaiBCM_Taster_02 = 0; // send after inhibited
    byte _bBCM_Taster_02Active = 0;

    message Blinkmodi_02 _mBlinkmodi_02;
    msTimer _tBlinkmodi_02;
    msTimer _totBlinkmodi_02;
    msTimer _tinhBlinkmodi_02;
    byte _bsiBlinkmodi_02 = 0; // send inhibited
    byte _bsaiBlinkmodi_02 = 0; // send after inhibited
    byte _bBlinkmodi_02Active = 0;

    //new
    message DiETa_01 _mDiETa_01;
    msTimer _tDiETa_01;
    msTimer _totDiETa_01;

    message Dimmung_01 _mDimmung_01;
    msTimer _tDimmung_01;
    msTimer _totDimmung_01;
    msTimer _tinhDimmung_01;
    byte _bsiDimmung_01 = 0; // send inhibited
    byte _bsaiDimmung_01 = 0; // send after inhibited

    //new
    message Einheiten_01 _mEinheiten_01;
    msTimer _tEinheiten_01;
    msTimer _totEinheiten_01;
    msTimer _tinhEinheiten_01;
    byte _bsiEinheiten_01 = 0; // send inhibited
    byte _bsaiEinheiten_01 = 0; // send after inhibited

    message ELV_01 _mELV_01;
    msTimer _tELV_01;
    msTimer _totELV_01;
    msTimer _tinhELV_01;
    byte _bsiELV_01 = 0; // send inhibited
    byte _bsaiELV_01 = 0; // send after inhibited

    //new
    message ELV_WFS_Anfrage _mELV_WFS_Anfrage;
    msTimer _tELV_WFS_Anfrage;
    msTimer _totELV_WFS_Anfrage;

    //new
    message EmpfEinheit_STSG_HBFS_01 _mEmpfEinheit_STSG_HBFS_01;
    msTimer _tEmpfEinheit_STSG_HBFS_01;
    msTimer _totEmpfEinheit_STSG_HBFS_01;
    msTimer _tinhEmpfEinheit_STSG_HBFS_01;
    byte _bsiEmpfEinheit_STSG_HBFS_01 = 0; // send inhibited
    byte _bsaiEmpfEinheit_STSG_HBFS_01 = 0; // send after inhibited
    byte _s_pdu_codeEmpfEinheit_STSG_HBFS_01[16] = { 0x12,0xcd,0x45,0xcb,0x39,0x7c,0x29,0x47,0x3d,0x59,0x69,0xd7,0x98,0xc5,0x11,0xd2 };

    message GRA_ACC_01 _mGRA_ACC_01;
    msTimer _tGRA_ACC_01;
    msTimer _totGRA_ACC_01;

    message HDSG_01 _mHDSG_01;
    msTimer _tHDSG_01;
    msTimer _totHDSG_01;
    msTimer _tinhHDSG_01;
    byte _bsiHDSG_01 = 0; // send inhibited
    byte _bsaiHDSG_01 = 0; // send after inhibited

    /*message HSP_01 _mHSP_01;*/
    msTimer _tHSP_01;
    msTimer _totHSP_01;
  
    message HUD_01 _mHUD_01;
    msTimer _tHUD_01;
    msTimer _totHUD_01;

    message Innenlicht_11 _mInnenlicht_11;
    msTimer _tInnenlicht_11;
    msTimer _totInnenlicht_11;
    msTimer _tinhInnenlicht_11;
    byte _bsiInnenlicht_11 = 0; // send inhibited
    byte _bsaiInnenlicht_11 = 0; // send after inhibited

    message Kessy_03 _mKessy_03;
    msTimer _tKessy_03;
    msTimer _totKessy_03;
    msTimer _tinhKessy_03;
    byte _bsiKessy_03 = 0; // send inhibited
    byte _bsaiKessy_03 = 0; // send after inhibited
    byte _bKessy_03Active = 0;

    message Kessy_04 _mKessy_04;
    msTimer _tKessy_04;
    msTimer _totKessy_04;
    msTimer _tinhKessy_04;
    byte _bsiKessy_04 = 0; // send inhibited
    byte _bsaiKessy_04 = 0; // send after inhibited

    message Klemmen_Status_01 _mKlemmen_Status_01;
    msTimer _tKlemmen_Status_01;
    msTimer _totKlemmen_Status_01;
    msTimer _tinhKlemmen_Status_01;
    byte _bsiKlemmen_Status_01 = 0; // send inhibited
    byte _bsaiKlemmen_Status_01 = 0; // send after inhibited
    byte _s_pdu_codeKlemmen_Status_01[16] = { 0xc3,0xc3,0xc3,0xc3,0xc3,0xc3,0xc3,0xc3,0xc3,0xc3,0xc3,0xc3,0xc3,0xc3,0xc3,0xc3 };

    message Klemmen_Status_02 _mKlemmen_Status_02;
    msTimer _tKlemmen_Status_02;
    msTimer _totKlemmen_Status_02;
    msTimer _tinhKlemmen_Status_02;
    byte _bsiKlemmen_Status_02 = 0; // send inhibited
    byte _bsaiKlemmen_Status_02 = 0; // send after inhibited
    byte _bKlemmen_Status_02Active = 0;
  
  //this msg have delaytime, and cycleFast , i don't know why is implemented like this
    message Klemmen_Steuerung_01 _mKlemmen_Steuerung_01;
    msTimer _tKlemmen_Steuerung_01;
    msTimer _totKlemmen_Steuerung_01;
  
 // message Klemmen_Steuerung_01 _mKlemmen_Steuerung_01;
 // msTimer _tKlemmen_Steuerung_01;
 // msTimer _totKlemmen_Steuerung_01;
 // msTimer _tinhKlemmen_Steuerung_01;
 // byte _bsiKlemmen_Steuerung_01 = 0; // send inhibited
 // byte _bsaiKlemmen_Steuerung_01 = 0; // send after inhibited
 // byte _bKlemmen_Steuerung_01Active = 0;
//  byte _s_pdu_codeKlemmen_Steuerung_01[16]
 //   = { 0x9b,0xb5,0x9d,0x06,0x01,0xe7,0x8f,0xc1,0xd0,0x10,0x47,0xe9,0xd3,0xca,0x05,0xf0 };
 
 //    Klima_03 -->  message_Klima_03.cin
 //    Klima_06 -->  message_Klima_06.cin
 
 message Klima_11 _mKlima_11;
  msTimer _tKlima_11;
  msTimer _totKlima_11;

 //    Klima_12 -->  message_Klima_12.cin
 //    Klima_16 -->  message_Klima_16.cin

 message Klima_EV_03 _mKlima_EV_03;
  msTimer _tKlima_EV_03;
  msTimer _totKlima_EV_03;
  
 message Klima_EV_04 _mKlima_EV_04;
  msTimer _tKlima_EV_04;
  msTimer _totKlima_EV_04;
  
 message Klima_EV_05 _mKlima_EV_05;
  msTimer _tKlima_EV_05;
  msTimer _totKlima_EV_05;
  
 message Klima_EV_06 _mKlima_EV_06;
  msTimer _tKlima_EV_06;
  msTimer _totKlima_EV_06;
  
 message Klima_hinten_04 _mKlima_hinten_04;
  msTimer _tKlima_hinten_04;
  msTimer _totKlima_hinten_04;
  msTimer _tinhKlima_hinten_04;
  byte _bsiKlima_hinten_04 = 0; // send inhibited
  byte _bsaiKlima_hinten_04 = 0; // send after inhibited
  
 message Klima_SDA_01 _mKlima_SDA_01;
  msTimer _tKlima_SDA_01;
  msTimer _totKlima_SDA_01;
  
 message Klima_Sensor_01 _mKlima_Sensor_01;
  msTimer _tKlima_Sensor_01;
  msTimer _totKlima_Sensor_01;
  
    message Klima_Sensor_02 _mKlima_Sensor_02;
    msTimer _tKlima_Sensor_02;
    msTimer _totKlima_Sensor_02;

 message Klima_Sensor_03 _mKlima_Sensor_03;
  msTimer _tKlima_Sensor_03;
  msTimer _totKlima_Sensor_03;
  
 message Klima_Sensor_04 _mKlima_Sensor_04;
  msTimer _tKlima_Sensor_04;
  msTimer _totKlima_Sensor_04;
  
 message Kombi_HUD_01 _mKombi_HUD_01;
  msTimer _tKombi_HUD_01;
  msTimer _totKombi_HUD_01;
  msTimer _tinhKombi_HUD_01;
  byte _bsiKombi_HUD_01 = 0; // send inhibited
  byte _bsaiKombi_HUD_01 = 0; // send after inhibited
  
 message KN_AAG _mKN_AAG;
  msTimer _tKN_AAG;
  msTimer _totKN_AAG;

 message KN_BCM1 _mKN_BCM1;
  msTimer _tKN_BCM1;
  msTimer _totKN_BCM1;

 message KN_ELV _mKN_ELV;
  msTimer _tKN_ELV;
  msTimer _totKN_ELV;

 message KN_HDSG _mKN_HDSG;
  msTimer _tKN_HDSG;
  msTimer _totKN_HDSG;

/* message KN_HUD _mKN_HUD;
  msTimer _tKN_HUD;
  msTimer _totKN_HUD;*/

 message KN_Klima _mKN_Klima;
  msTimer _tKN_Klima;
  msTimer _totKN_Klima;

/* message KN_Kombi _mKN_Kombi;
  msTimer _tKN_Kombi;
  msTimer _totKN_Kombi;*/

 message KN_MFG _mKN_MFG;
  msTimer _tKN_MFG;
  msTimer _totKN_MFG;

 message KN_SAD _mKN_SAD;
  msTimer _tKN_SAD;
  msTimer _totKN_SAD;

 message KN_Sitzmemo_BFS _mKN_Sitzmemo_BFS;
  msTimer _tKN_Sitzmemo_BFS;
  msTimer _totKN_Sitzmemo_BFS;

 message KN_Sitzmemo_FS _mKN_Sitzmemo_FS;
  msTimer _tKN_Sitzmemo_FS;
  msTimer _totKN_Sitzmemo_FS;

 message KN_STSG_HBFS _mKN_STSG_HBFS;
  msTimer _tKN_STSG_HBFS;
  msTimer _totKN_STSG_HBFS;

 message KN_STSG_HFS _mKN_STSG_HFS;
  msTimer _tKN_STSG_HFS;
  msTimer _totKN_STSG_HFS;

 message KN_TCO _mKN_TCO;
  msTimer _tKN_TCO;
  msTimer _totKN_TCO;

 message KN_TSG_BFS _mKN_TSG_BFS;
  msTimer _tKN_TSG_BFS;
  msTimer _totKN_TSG_BFS;

 message KN_TSG_FS _mKN_TSG_FS;
  msTimer _tKN_TSG_FS;
  msTimer _totKN_TSG_FS;

 message KN_TSG_HBFS _mKN_TSG_HBFS;
  msTimer _tKN_TSG_HBFS;
  msTimer _totKN_TSG_HBFS;

 message KN_TSG_HFS _mKN_TSG_HFS;
  msTimer _tKN_TSG_HFS;
  msTimer _totKN_TSG_HFS;

 message KN_VSG _mKN_VSG;
  msTimer _tKN_VSG;
  msTimer _totKN_VSG;

 message LCM_Soll_Fkt _mLCM_Soll_Fkt;
  msTimer _tLCM_Soll_Fkt;
  msTimer _totLCM_Soll_Fkt;
  msTimer _tinhLCM_Soll_Fkt;
  byte _bsiLCM_Soll_Fkt = 0; // send inhibited
  byte _bsaiLCM_Soll_Fkt = 0; // send after inhibited
    byte _s_pdu_codeLCM_Soll_Fkt[16] = { 0xbd,0x44,0x90,0x8d,0x74,0xfa,0x91,0x89,0x41,0x4a,0xbe,0x82,0xb3,0x05,0x84,0xcf };

    message Licht_Anf_01 _mLicht_Anf_01;
    msTimer _tLicht_Anf_01;
    msTimer _totLicht_Anf_01;
 // msTimer _tinhLicht_Anf_01;
//  byte _bsiLicht_Anf_01 = 0; // send inhibited
 // byte _bsaiLicht_Anf_01 = 0; // send after inhibited
 // byte _s_pdu_codeLicht_Anf_01[16] = { 0xc5,0x39,0xc7,0xf9,0x92,0xd8,0x24,0xce,0xf1,0xb5,0x7a,0xc4,0xbc,0x60,0xe3,0xd1 };

    message Licht_hinten_01 _mLicht_hinten_01;
    msTimer _tLicht_hinten_01;
    msTimer _totLicht_hinten_01;

    message Licht_vorne_01 _mLicht_vorne_01;
    msTimer _tLicht_vorne_01;
    msTimer _totLicht_vorne_01;
    msTimer _tinhLicht_vorne_01;
    byte _bsiLicht_vorne_01 = 0; // send inhibited
    byte _bsaiLicht_vorne_01 = 0; // send after inhibited

    message LoGeWa_03 _mLoGeWa_03;
    msTimer _tLoGeWa_03;
    msTimer _totLoGeWa_03;
    msTimer _tinhLoGeWa_03;
    byte _bsiLoGeWa_03 = 0; // send inhibited
    byte _bsaiLoGeWa_03 = 0; // send after inhibited

    message LWR_AFS_01 _mLWR_AFS_01;
    msTimer _tLWR_AFS_01;
    msTimer _totLWR_AFS_01;
    msTimer _tinhLWR_AFS_01;
    byte _bsiLWR_AFS_01 = 0; // send inhibited
    byte _bsaiLWR_AFS_01 = 0; // send after inhibited

    message Mem_BFS_01 _mMem_BFS_01;
    msTimer _tMem_BFS_01;
    msTimer _totMem_BFS_01;
    msTimer _tinhMem_BFS_01;
    byte _bsiMem_BFS_01 = 0; // send inhibited
    byte _bsaiMem_BFS_01 = 0; // send after inhibited

    message Mem_FS_01 _mMem_FS_01;
    msTimer _tMem_FS_01;
    msTimer _totMem_FS_01;
    msTimer _tinhMem_FS_01;
    byte _bsiMem_FS_01 = 0; // send inhibited
    byte _bsaiMem_FS_01 = 0; // send after inhibited

    message Mem_Taster_BT_01 _mMem_Taster_BT_01;
    msTimer _tMem_Taster_BT_01;
    msTimer _totMem_Taster_BT_01;
    msTimer _tinhMem_Taster_BT_01;
    byte _bsiMem_Taster_BT_01 = 0; // send inhibited
    byte _bsaiMem_Taster_BT_01 = 0; // send after inhibited
    byte _bMem_Taster_BT_01Active = 0;
    byte _s_pdu_codeMem_Taster_BT_01[16] = { 0x98,0x98,0x98,0x98,0x98,0x98,0x98,0x98,0x98,0x98,0x98,0x98,0x98,0x98,0x98,0x98 };

    message Mem_Taster_FT_01 _mMem_Taster_FT_01;
    msTimer _tMem_Taster_FT_01;
    msTimer _totMem_Taster_FT_01;
    msTimer _tinhMem_Taster_FT_01;
    byte _bsiMem_Taster_FT_01 = 0; // send inhibited
    byte _bsaiMem_Taster_FT_01 = 0; // send after inhibited
    byte _bMem_Taster_FT_01Active = 0;
    byte _s_pdu_codeMem_Taster_FT_01[16] = { 0x96,0x96,0x96,0x96,0x96,0x96,0x96,0x96,0x96,0x96,0x96,0x96,0x96,0x96,0x96,0x96 };

    message MFG_01 _mMFG_01;
    msTimer _tMFG_01;
    msTimer _totMFG_01;
    msTimer _tinhMFG_01;
    byte _bsiMFG_01 = 0; // send inhibited
    byte _bsaiMFG_01 = 0; // send after inhibited
    byte _s_pdu_codeMFG_01[16] = { 0x97,0x97,0x97,0x97,0x97,0x97,0x97,0x97,0x97,0x97,0x97,0x97,0x97,0x97,0x97,0x97 };

    message MFG_02 _mMFG_02;
    msTimer _tMFG_02;
    msTimer _totMFG_02;
  
    message MFG_03 _mMFG_03;
    msTimer _tMFG_03;
    msTimer _totMFG_03;
    msTimer _tinhMFG_03;
    byte _bsiMFG_03 = 0; // send inhibited
    byte _bsaiMFG_03 = 0; // send after inhibited
    byte _bMFG_03Active = 0;

    message NMH_BCM1 _mNMH_BCM1;
    msTimer _tNMH_BCM1;
    msTimer _totNMH_BCM1;

    message PAO_Status_01 _mPAO_Status_01;
    msTimer _tPAO_Status_01;
    msTimer _totPAO_Status_01;
  
  //???
    message Personalisierung_01 _mPersonalisierung_01;
    msTimer _tPersonalisierung_01;
    msTimer _totPersonalisierung_01;

  //message Personalisierung_01 _mPersonalisierung_01;
  //msTimer _tPersonalisierung_01;
  //msTimer _totPersonalisierung_01;
  //msTimer _tinhPersonalisierung_01;
  //byte _bsiPersonalisierung_01 = 0; // send inhibited
  //byte _bsaiPersonalisierung_01 = 0; // send after inhibited
  //byte _bPersonalisierung_01Active = 0;
  
    message PTC_01 _mPTC_01;
    msTimer _tPTC_01;
    msTimer _totPTC_01;
  
    message Reset _mReset;
    msTimer _tReset;
    msTimer _totReset;
  
    message RLS_01 _mRLS_01;
    msTimer _tRLS_01;
    msTimer _totRLS_01;

    message SAD_01 _mSAD_01;
    msTimer _tSAD_01;
    msTimer _totSAD_01;
    msTimer _tinhSAD_01;
    byte _bsiSAD_01 = 0; // send inhibited
    byte _bsaiSAD_01 = 0; // send after inhibited
  
 message Sensorik_Dimmung_01 _mSensorik_Dimmung_01;
  msTimer _tSensorik_Dimmung_01;
  msTimer _totSensorik_Dimmung_01;
  msTimer _tinhSensorik_Dimmung_01;
  byte _bsiSensorik_Dimmung_01 = 0; // send inhibited
  byte _bsaiSensorik_Dimmung_01 = 0; // send after inhibited
  
 message Service_Key_01 _mService_Key_01;
  msTimer _tService_Key_01;
  msTimer _totService_Key_01;
  
 message SM_LAPP_01 _mSM_LAPP_01;
  msTimer _tSM_LAPP_01;
  msTimer _totSM_LAPP_01;
  msTimer _tinhSM_LAPP_01;
  byte _bsiSM_LAPP_01 = 0; // send inhibited
  byte _bsaiSM_LAPP_01 = 0; // send after inhibited
  
 /*message  SAD_01 _mSAD_01;
  msTimer _tSAD_01;
  msTimer _totSAD_01;
  msTimer _tinhSAD_01;
  byte _bsiSAD_01 = 0; // send inhibited
  byte _bsaiSAD_01 = 0; // send after inhibited*/
  
 /*message Sensorik_mDimmung_01 _mSensorik_mDimmung_01;
  msTimer _tSensorik_mDimmung_01;
  msTimer _totSensorik_mDimmung_01;
  msTimer _tinhSensorik_mDimmung_01;
  byte _bsiSensorik_mDimmung_01 = 0; // send inhibited
  byte _bsaiSensorik_mDimmung_01 = 0; // send after inhibited*/
  
 /*message Service_Key_01 _mService_Key_01;
  msTimer _tService_Key_01;
  msTimer _totService_Key_01;*/
  
/* message SM_LAPP_01 _mSM_LAPP_01;
  msTimer _tSM_LAPP_01;
  msTimer _totSM_LAPP_01;
  msTimer _tinhSM_LAPP_01;
  byte _bsiSM_LAPP_01 = 0; // send inhibited
  byte _bsaiSM_LAPP_01 = 0; // send after inhibited
  
 message SM_LAPP_02 _mSM_LAPP_02;
  msTimer _tSM_LAPP_02;
  msTimer _totSM_LAPP_02;
  msTimer _tinhSM_LAPP_02;
  byte _bsiSM_LAPP_02 = 0; // send inhibited
  byte _bsaiSM_LAPP_02 = 0; // send after inhibited*/
  
  message  SM_LAPP_02 _mSM_LAPP_02;
  msTimer _tSM_LAPP_02;
  msTimer _totSM_LAPP_02;
  msTimer _tinhSM_LAPP_02;
  byte _bsiSM_LAPP_02 = 0; // send inhibited
  byte _bsaiSM_LAPP_02 = 0; // send after inhibited
  
    message SMLS_01 _mSMLS_01;
    msTimer _tSMLS_01;
    msTimer _totSMLS_01;
    msTimer _tinhSMLS_01;
    byte _bsiSMLS_01 = 0; // send inhibited
    byte _bsaiSMLS_01 = 0; // send after inhibited
    byte _bSMLS_01Active = 0;
    byte _s_pdu_codeSMLS_01[16] = { 0xc3,0x79,0xbf,0xdb,0xe9,0x11,0x46,0x86,0x69,0xb6,0x9b,0x29,0x15,0x9c,0x45,0x0d };

    message SoSe_01 _mSoSe_01;
    msTimer _tSoSe_01;
    msTimer _totSoSe_01;
  
    message Spiegel_01 _mSpiegel_01;
    msTimer _tSpiegel_01;
    msTimer _totSpiegel_01;
    msTimer _tinhSpiegel_01;
    byte _bsiSpiegel_01 = 0; // send inhibited
    byte _bsaiSpiegel_01 = 0; // send after inhibited
  
    message STH_01 _mSTH_01;
    msTimer _tSTH_01;
    msTimer _totSTH_01;

 message STSG_HBFS_01 _mSTSG_HBFS_01;
  msTimer _tSTSG_HBFS_01;
  msTimer _totSTSG_HBFS_01;
  msTimer _tinhSTSG_HBFS_01;
  byte _bsiSTSG_HBFS_01 = 0; // send inhibited
  byte _bsaiSTSG_HBFS_01 = 0; // send after inhibited

 message STSG_HFS_01 _mSTSG_HFS_01;
  msTimer _tSTSG_HFS_01;
  msTimer _totSTSG_HFS_01;
  msTimer _tinhSTSG_HFS_01;
  byte _bsiSTSG_HFS_01 = 0; // send inhibited
  byte _bsaiSTSG_HFS_01 = 0; // send after inhibited

    message TCO_01 _mTCO_01;
    msTimer _tTCO_01;
    msTimer _totTCO_01;

 //    Thermo_Verbrauch_01 -->  message_Thermo_Verbrauch_01.cin

    message TimeDate _mTimeDate;
    msTimer _tTimeDate;
    msTimer _totTimeDate;
  
    message TM_01 _mTM_01;
    msTimer _tTM_01;
    msTimer _totTM_01;
  
 message TSG_BT_01 _mTSG_BT_01;
  msTimer _tTSG_BT_01;
  msTimer _totTSG_BT_01;
  msTimer _tinhTSG_BT_01;
  byte _bsiTSG_BT_01 = 0; // send inhibited
  byte _bsaiTSG_BT_01 = 0; // send after inhibited

    message TSG_FT_01 _mTSG_FT_01;
    msTimer _tTSG_FT_01;
    msTimer _totTSG_FT_01;
    msTimer _tinhTSG_FT_01;
    byte _bsiTSG_FT_01 = 0; // send inhibited
    byte _bsaiTSG_FT_01 = 0; // send after inhibited

    message TSG_FT_02 _mTSG_FT_02;
    msTimer _tTSG_FT_02;
    msTimer _totTSG_FT_02;
    msTimer _tinhTSG_FT_02;
    byte _bsiTSG_FT_02 = 0; // send inhibited
    byte _bsaiTSG_FT_02 = 0; // send after inhibited
    byte _s_pdu_codeTSG_FT_02[16] = { 0xc4,0x6a,0x69,0x30,0xcf,0x61,0x58,0x51,0x1b,0x86,0x99,0xd3,0xf6,0x1d,0x9a,0x37 };

 message TSG_HBFS_01 _mTSG_HBFS_01;
  msTimer _tTSG_HBFS_01;
  msTimer _totTSG_HBFS_01;
  msTimer _tinhTSG_HBFS_01;
  byte _bsiTSG_HBFS_01 = 0; // send inhibited
  byte _bsaiTSG_HBFS_01 = 0; // send after inhibited
  
 message TSG_HFS_01 _mTSG_HFS_01;
  msTimer _tTSG_HFS_01;
  msTimer _totTSG_HFS_01;
  msTimer _tinhTSG_HFS_01;
  byte _bsiTSG_HFS_01 = 0; // send inhibited
  byte _bsaiTSG_HFS_01 = 0; // send after inhibited
  
    message Uhrzeit_01 _mUhrzeit_01;
    msTimer _tUhrzeit_01;
    msTimer _totUhrzeit_01;

    message VehiDist _mVehiDist;
    msTimer _tVehiDist;
    msTimer _totVehiDist;

    message Verdeck_01 _mVerdeck_01;
    msTimer _tVerdeck_01;
    msTimer _totVerdeck_01;
    msTimer _tinhVerdeck_01;
    byte _bsiVerdeck_01 = 0; // send inhibited
    byte _bsaiVerdeck_01 = 0; // send after inhibited
    byte _bVerdeck_01Active = 0;

    message VIN_01 _mVIN_01;
    msTimer _tVIN_01;
    msTimer _totVIN_01;
  
    message VLK_01 _mVLK_01;
    msTimer _tVLK_01;
    msTimer _totVLK_01;
    msTimer _tinhVLK_01;
    byte _bsiVLK_01 = 0; // send inhibited
    byte _bsaiVLK_01 = 0; // send after inhibited

    message WFS_01 _mWFS_01;
    msTimer _tWFS_01;
    msTimer _totWFS_01;
//  msTimer _tinhWFS_01;
//  byte _bsiWFS_01 = 0; // send inhibited
//  byte _bsaiWFS_01 = 0; // send after inhibited

    message WFS_Transponder_Status_02 _mWFS_Transponder_Status_02;
    msTimer _tWFS_Transponder_Status_02;
    msTimer _totWFS_Transponder_Status_02;
    msTimer _tinhWFS_Transponder_Status_02;
    byte _bsiWFS_Transponder_Status_02 = 0; // send inhibited
    byte _bsaiWFS_Transponder_Status_02 = 0; // send after inhibited

    message Wischer_01 _mWischer_01;
    msTimer _tWischer_01;
    msTimer _totWischer_01;
    msTimer _tinhWischer_01;
    byte _bsiWischer_01 = 0; // send inhibited
    byte _bsaiWischer_01 = 0; // send after inhibited

    message WLC1_01 _mWLC1_01;
    msTimer _tWLC1_01;
    msTimer _totWLC1_01;
    msTimer _tinhWLC1_01;
    byte _bsiWLC1_01 = 0; // send inhibited
    byte _bsaiWLC1_01 = 0; // send after inhibited

    message ZFH_01 _mZFH_01;
    msTimer _tZFH_01;
    msTimer _totZFH_01;
    msTimer _tinhZFH_01;
    byte _bsiZFH_01 = 0; // send inhibited
    byte _bsaiZFH_01 = 0; // send after inhibited
    byte _bZFH_01Active = 0;
  
    message ZV_01 _mZV_01;
    msTimer _tZV_01;
    msTimer _totZV_01;
  
    message ZV_02 _mZV_02;
    msTimer _tZV_02;
    msTimer _totZV_02;
    msTimer _tinhZV_02;
    byte _bsiZV_02 = 0; // send inhibited
    byte _bsaiZV_02 = 0; // send after inhibited
    byte _bZV_02Active = 0;


  msTimer _tLog_Datenlogger_Req;
  msTimer _totLog_Datenlogger_Req;

  msTimer _tLog_Kombi_Req;
  msTimer _totLog_Kombi_Req;

  
    byte _CRC8[256] = { 0x00, 0x2f, 0x5e, 0x71, 0xbc, 0x93, 0xe2, 0xcd, 0x57, 0x78, 0x09, 0x26, 0xeb, 0xc4, 0xb5, 0x9a,
                        0xae, 0x81, 0xf0, 0xdf, 0x12, 0x3d, 0x4c, 0x63, 0xf9, 0xd6, 0xa7, 0x88, 0x45, 0x6a, 0x1b, 0x34,
                        0x73, 0x5c, 0x2d, 0x02, 0xcf, 0xe0, 0x91, 0xbe, 0x24, 0x0b, 0x7a, 0x55, 0x98, 0xb7, 0xc6, 0xe9,
                        0xdd, 0xf2, 0x83, 0xac, 0x61, 0x4e, 0x3f, 0x10, 0x8a, 0xa5, 0xd4, 0xfb, 0x36, 0x19, 0x68, 0x47,
                        0xe6, 0xc9, 0xb8, 0x97, 0x5a, 0x75, 0x04, 0x2b, 0xb1, 0x9e, 0xef, 0xc0, 0x0d, 0x22, 0x53, 0x7c,
                        0x48, 0x67, 0x16, 0x39, 0xf4, 0xdb, 0xaa, 0x85, 0x1f, 0x30, 0x41, 0x6e, 0xa3, 0x8c, 0xfd, 0xd2,
                        0x95, 0xba, 0xcb, 0xe4, 0x29, 0x06, 0x77, 0x58, 0xc2, 0xed, 0x9c, 0xb3, 0x7e, 0x51, 0x20, 0x0f,
                        0x3b, 0x14, 0x65, 0x4a, 0x87, 0xa8, 0xd9, 0xf6, 0x6c, 0x43, 0x32, 0x1d, 0xd0, 0xff, 0x8e, 0xa1,
                        0xe3, 0xcc, 0xbd, 0x92, 0x5f, 0x70, 0x01, 0x2e, 0xb4, 0x9b, 0xea, 0xc5, 0x08, 0x27, 0x56, 0x79,
                        0x4d, 0x62, 0x13, 0x3c, 0xf1, 0xde, 0xaf, 0x80, 0x1a, 0x35, 0x44, 0x6b, 0xa6, 0x89, 0xf8, 0xd7,
                        0x90, 0xbf, 0xce, 0xe1, 0x2c, 0x03, 0x72, 0x5d, 0xc7, 0xe8, 0x99, 0xb6, 0x7b, 0x54, 0x25, 0x0a,
                        0x3e, 0x11, 0x60, 0x4f, 0x82, 0xad, 0xdc, 0xf3, 0x69, 0x46, 0x37, 0x18, 0xd5, 0xfa, 0x8b, 0xa4,
                        0x05, 0x2a, 0x5b, 0x74, 0xb9, 0x96, 0xe7, 0xc8, 0x52, 0x7d, 0x0c, 0x23, 0xee, 0xc1, 0xb0, 0x9f,
                        0xab, 0x84, 0xf5, 0xda, 0x17, 0x38, 0x49, 0x66, 0xfc, 0xd3, 0xa2, 0x8d, 0x40, 0x6f, 0x1e, 0x31,
                        0x76, 0x59, 0x28, 0x07, 0xca, 0xe5, 0x94, 0xbb, 0x21, 0x0e, 0x7f, 0x50, 0x9d, 0xb2, 0xc3, 0xec,
                        0xd8, 0xf7, 0x86, 0xa9, 0x64, 0x4b, 0x3a, 0x15, 0x8f, 0xa0, 0xd1, 0xfe, 0x33, 0x1c, 0x6d, 0x42
                      };

}

on envVar eSendEnabled
{
    if( getValue( this ) )
    {
        if( getValue( eSendAnhaenger_01 ))  sendAnhaenger_01();
        if( getValue( eSendASTA_Sensor_01 ))  sendASTA_Sensor_01();
        if( getValue( eSendAZK_01 ))  sendAZK_01();
        if( getValue( eSendBAP_BC_ASG_02 ))  sendBAP_BC_ASG_02();
        if( getValue( eSendBCM_01 ))  sendBCM_01();
        if( getValue( eSendBCM_03 ))  sendBCM_03();
        if( getValue( eSendBCM_04 ))  sendBCM_04();
        if( getValue( eSendBlinkmodi_02 ))  sendBlinkmodi_02();
        if( getValue( eSendDimmung_01 ))  sendDimmung_01();
        if( getValue( eSendELV_01 ))  sendELV_01();
        if( getValue( eSendHSP_01 ))  sendHSP_01();
        if( getValue( eSendHUD_01 ))  sendHUD_01();
        if( getValue( eSendKessy_04 ))  sendKessy_04();
        if( getValue( eSendKlemmen_Status_01 ))  sendKlemmen_Status_01();
        if( getValue( eSendKlemmen_Steuerung_01 ))  sendKlemmen_Steuerung_01();
 //       if( getValue( eSendKlima_03 ))  sendKlima_03();
 //       if( getValue( eSendKlima_12 ))  sendKlima_12();
 //       if( getValue( eSendKlima_16 ))  sendKlima_16();
        if( getValue( eSendKlima_Sensor_02 ))  sendKlima_Sensor_02();
        if( getValue( eSendLicht_Anf_01 ))  sendLicht_Anf_01();
        if( getValue( eSendLicht_hinten_01 ))  sendLicht_hinten_01();
        if( getValue( eSendLicht_vorne_01 ))  sendLicht_vorne_01();
        if( getValue( eSendLoGeWa_03 ))  sendLoGeWa_03();
        if( getValue( eSendLog_Datenlogger_Req ))  sendLog_Datenlogger_Req();
        if( getValue( eSendLog_Kombi_Req ))  sendLog_Kombi_Req();
        if( getValue( eSendMem_BFS_01 ))  sendMem_BFS_01();
        if( getValue( eSendMem_FS_01 ))  sendMem_FS_01();
        if( getValue( eSendMFG_01 ))  sendMFG_01();
        if( getValue( eSendMFG_03 ))  sendMFG_03();
        if( getValue( eSendPersonalisierung_01 ))  sendPersonalisierung_01();
        if( getValue( eSendRLS_01 ))  sendRLS_01();
        if( getValue( eSendSMLS_01 ))  sendSMLS_01();
        if( getValue( eSendSTH_01 ))  sendSTH_01();
        if( getValue( eSendTCO_01 ))  sendTCO_01();
  //      if( getValue( eSendThermo_Verbrauch_01 ))  sendThermo_Verbrauch_01();
        if( getValue( eSendTimeDate ))  sendTimeDate();
        if( getValue( eSendTM_01 ))  sendTM_01();
        if( getValue( eSendTSG_FT_01 ))  sendTSG_FT_01();
        if( getValue( eSendTSG_FT_02 ))  sendTSG_FT_02();
        if( getValue( eSendVehiDist ))  sendVehiDist();
        if( getValue( eSendVerdeck_01 ))  sendVerdeck_01();
        if( getValue( eSendWFS_01 ))  sendWFS_01();
        if( getValue( eSendWischer_01 ))  sendWischer_01();
  //      if( getValue( eSendZV_01 ))  sendZV_01();
        if( getValue( eSendZV_02 ))  sendZV_02();
    }
}

on Start
{
 //   Klima_03_LoadDefaultValues();
 //   Klima_12_LoadDefaultValues();
 //   Klima_16_LoadDefaultValues();
}

on envVar eLoadSettings
{
 //   Klima_03_readEnvVars( "RBS.ini" );
 //   Klima_12_readEnvVars( "RBS.ini" );
 //   Klima_16_saveEnvVars( "RBS.ini" );
}

on envVar eSaveSettings
{
 //   Klima_03_saveEnvVars( "RBS.ini" );
 //   Klima_12_saveEnvVars( "RBS.ini" );
 //   Klima_16_saveEnvVars( "RBS.ini"  );
}

on envVar eLog_Datalogger_Req_DataKombi_MQ
{
}

byte getCRC8( message* m, byte s_pdu_code[] )
{
  byte crc;
  byte byte_index;
  crc = 0xFF;
  for (byte_index = 1;  byte_index < m.DLC;  ++byte_index)
  {
    crc = _CRC8[ m.byte( byte_index ) ^ crc ];
  }
  crc = _CRC8[ s_pdu_code[ m.byte( 1 ) & 0x0F ] ^ crc ];
  return ~crc;
}

on Timer _tAnhaenger_01
{
    if( getValue( eTAnhaenger_01 ) <= 0)  putValue( eSendAnhaenger_01, 0 );
    if( (getValue( eSendEnabled ) && getValue( eSendAnhaenger_01 )) || getValue( eDlcOnceAnhaenger_01 ))  sendAnhaenger_01();
}

on envVar eSendAnhaenger_01
{
    if( getValue( eSendEnabled ) && getValue( eSendAnhaenger_01 ))  sendAnhaenger_01();
}

on envVar eTimeoutAnhaenger_01
{
    cancelTimer( _tAnhaenger_01 );
    cancelTimer( _totAnhaenger_01 );
    if( getValue( this ))
        setTimer( _totAnhaenger_01, (getValue( eSendEnabled ) && getValue( eSendAnhaenger_01 ) && (getValue( eTOTAnhaenger_01 ) > 0)) ? getValue( eTOTAnhaenger_01 ) : 1 );
    else
        if( getValue( eSendEnabled ) && getValue( eSendAnhaenger_01 ))  sendAnhaenger_01();
}

on Timer _totAnhaenger_01
{
    putValue( eTimeoutAnhaenger_01, 0 );
}

on envVar eDlcOnceAnhaenger_01
{
    if( getValue( eDlcOnceAnhaenger_01 ) && !(getValue( eSendEnabled ) && getValue( eSendAnhaenger_01 )))  setTimer( _tAnhaenger_01, 1 );
}

void sendAnhaenger_01()
{
    if( getValue( eChangeAnhaenger_01 ))
    {
        if( getValue( eDlcOnceAnhaenger_01 ) || getValue( eDlcWrongAnhaenger_01 ))
        {
            putValue( eDlcOnceAnhaenger_01, 0 );
            _mAnhaenger_01.DLC = getValue( eDlcAnhaenger_01 );
        }
        else
        {
            _mAnhaenger_01.DLC = 8;
        }
    }
    else
    {
        _mAnhaenger_01.DLC = 8;
    }

    output( _mAnhaenger_01 );
    cancelTimer( _tAnhaenger_01 );
    if( getValue( eTAnhaenger_01 ) > 0)  setTimer( _tAnhaenger_01, getValue( eTAnhaenger_01 ) );  else  setTimer( _tAnhaenger_01, 1 );
}

Anhaenger_01Changed()
{
}

on envVar eAAG_BZS
{
    _mAnhaenger_01.AAG_BZ.phys = getValue( this );
    Anhaenger_01Changed();
}

on envVar eAAG_Anhaenger_abgestecktS
{
    _mAnhaenger_01.AAG_Anhaenger_abgesteckt.phys = getValue( this );
    Anhaenger_01Changed();
}

on envVar eAAG_Anhaenger_erkanntS
{
    _mAnhaenger_01.AAG_Anhaenger_erkannt.phys = getValue( this );
    Anhaenger_01Changed();
}

on envVar eAAG_AVS_Fehler_02S
{
    _mAnhaenger_01.AAG_AVS_Fehler_02.phys = getValue( this );
    Anhaenger_01Changed();
}

on envVar KCAN_AAG_AVS_Fehler_02_inv
{
    _mAnhaenger_01.AAG_AVS_Fehler_02_inv.phys = getValue( this );
    Anhaenger_01Changed();
}

on envVar eAAG_AVS_StatiS
{
    _mAnhaenger_01.AAG_AVS_Stati.phys = getValue( this );
    Anhaenger_01Changed();
}

on envVar eAAG_Blinker_H_aktivS
{
    _mAnhaenger_01.AAG_Blinker_H_aktiv.phys = getValue( this );
    Anhaenger_01Changed();
}

on envVar eAAG_Blinker_HL_defS
{
    _mAnhaenger_01.AAG_Blinker_HL_def.phys = getValue( this );
    Anhaenger_01Changed();
}

on envVar eAAG_Blinker_HR_defS
{
    _mAnhaenger_01.AAG_Blinker_HR_def.phys = getValue( this );
    Anhaenger_01Changed();
}

on envVar eAAG_Bremsl_durch_ECDS
{
    _mAnhaenger_01.AAG_Bremsl_durch_ECD.phys = getValue( this );
    Anhaenger_01Changed();
}

on envVar eAAG_Bremslicht_H_defS
{
    _mAnhaenger_01.AAG_Bremslicht_H_def.phys = getValue( this );
    Anhaenger_01Changed();
}

on envVar KCAN_AAG_Bremslicht_Reku
{
    _mAnhaenger_01.AAG_Bremslicht_Reku.phys = getValue( this );
   Anhaenger_01Changed();
}

on envVar KCAN_AAG_LED_aktiv
{
    _mAnhaenger_01.AAG_LED_aktiv.phys = getValue( this );
    Anhaenger_01Changed();
}

on envVar eAAG_NSL_aktivS
{
    _mAnhaenger_01.AAG_NSL_aktiv.phys = getValue( this );
    Anhaenger_01Changed();
}

on envVar eAAG_Schlusslicht_HL_defS
{
    _mAnhaenger_01.AAG_Schlusslicht_HL_def.phys = getValue( this );
    Anhaenger_01Changed();
}

on envVar eAAG_Schlusslicht_HR_defS
{
    _mAnhaenger_01.AAG_Schlusslicht_HR_def.phys = getValue( this );
    Anhaenger_01Changed();
}

on Timer _tASTA_Sensor_01
{
    if( getValue( eTASTA_Sensor_01 ) <= 0)  putValue( eSendASTA_Sensor_01, 0 );
    if( (getValue( eSendEnabled ) && getValue( eSendASTA_Sensor_01 )) || getValue( eDlcOnceASTA_Sensor_01 ))  sendASTA_Sensor_01();
}

on envVar eSendASTA_Sensor_01
{
    if( getValue( eSendEnabled ) && getValue( this ))  sendASTA_Sensor_01();
}

on envVar eTimeoutASTA_Sensor_01
{
    cancelTimer( _tASTA_Sensor_01 );
    cancelTimer( _totASTA_Sensor_01 );
    if( getValue( this ))
        setTimer( _totASTA_Sensor_01, (getValue( eSendEnabled ) && getValue( eSendASTA_Sensor_01 ) && (getValue( eTOTASTA_Sensor_01 ) > 0)) ? getValue( eTOTASTA_Sensor_01 ) : 1 );
    else
        if( getValue( eSendEnabled ) && getValue( eSendASTA_Sensor_01 ))  sendASTA_Sensor_01();
}

on Timer _totASTA_Sensor_01
{
    putValue( eTimeoutASTA_Sensor_01, 0 );
}

on envVar eDlcOnceASTA_Sensor_01
{
    if( getValue( eDlcOnceASTA_Sensor_01 ) && !(getValue( eSendEnabled ) && getValue( eSendASTA_Sensor_01 )))  setTimer( _tASTA_Sensor_01, 1 );
}

void sendASTA_Sensor_01()
{
    if( getValue( eChangeASTA_Sensor_01 ))
    {
        if( getValue( eDlcOnceASTA_Sensor_01 ) || getValue( eDlcWrongASTA_Sensor_01 ))
        {
            putValue( eDlcOnceASTA_Sensor_01, 0 );
            _mASTA_Sensor_01.DLC = getValue( eDlcASTA_Sensor_01 );
        }
        else
        {
            _mASTA_Sensor_01.DLC = 8;
        }
    }
    else
    {
        _mASTA_Sensor_01.DLC = 8;
    }

    output( _mASTA_Sensor_01 );
    cancelTimer( _tASTA_Sensor_01 );
    if( getValue( eTASTA_Sensor_01 ) > 0)  setTimer( _tASTA_Sensor_01, getValue( eTASTA_Sensor_01 ) );  else  setTimer( _tASTA_Sensor_01, 1 );
}

ASTA_Sensor_01Changed()
{
}

on envVar eAAG_ASTA_StatusS
{
    _mASTA_Sensor_01.AAG_ASTA_Status.phys = getValue( this );
    ASTA_Sensor_01Changed();
}

on envVar eASTA_AnhaengerlastS
{
    _mASTA_Sensor_01.ASTA_Anhaengerlast.phys = getValue( this );
    ASTA_Sensor_01Changed();
}

on envVar eASTA_EinheitS
{
    _mASTA_Sensor_01.ASTA_Einheit.phys = getValue( this );
    ASTA_Sensor_01Changed();
}

on envVar eASTA_StuetzlastS
{
    _mASTA_Sensor_01.ASTA_Stuetzlast.phys = getValue( this );
    ASTA_Sensor_01Changed();
}

on envVar eASTAs_01_altS
{
    _mASTA_Sensor_01.ASTAs_01_alt.phys = getValue( this );
    ASTA_Sensor_01Changed();
}

on Timer _tAZK_01
{
    if( getValue( eTAZK_01 ) <= 0)  putValue( eSendAZK_01, 0 );
    if( (getValue( eSendEnabled ) && getValue( eSendAZK_01 )) || getValue( eDlcOnceAZK_01 ))  sendAZK_01();
}

on envVar eSendAZK_01
{
    if( getValue( eSendEnabled ) && getValue( eSendAZK_01 ))  sendAZK_01();
}

on envVar eTimeoutAZK_01
{
    cancelTimer( _tAZK_01 );
    cancelTimer( _totAZK_01 );
    if( getValue( this ))
        setTimer( _totAZK_01, (getValue( eSendEnabled ) && getValue( eSendAZK_01 ) && (getValue( eTOTAZK_01 ) > 0)) ? getValue( eTOTAZK_01 ) : 1 );
    else
        if( getValue( eSendEnabled ) && getValue( eSendAZK_01 ))  sendAZK_01();
}

on Timer _totAZK_01
{
    putValue( eTimeoutAZK_01, 0 );
}

on envVar eDlcOnceAZK_01
{
    if( getValue( eDlcOnceAZK_01 ) && !(getValue( eSendEnabled ) && getValue( eSendAZK_01 )))  setTimer( _tAZK_01, 1 );
}

void sendAZK_01()
{
    if( getValue(eChangeAZK_01))
    {    
        if( getValue( eDlcOnceAZK_01 ) || getValue( eDlcWrongAZK_01 ))
        {
            putValue( eDlcOnceAZK_01, 0 );
            _mAZK_01.DLC = getValue( eDlcAZK_01 );
        } 
        else
        {        
            _mAZK_01.DLC = 8;
        }   
    }
    else
    { 
        _mAZK_01.DLC = 8;
    }
    output( _mAZK_01 );
    
    cancelTimer( _tAZK_01 );
    if( getValue( eTAZK_01 ) > 0)  setTimer( _tAZK_01, getValue( eTAZK_01 ) );  else  setTimer( _tAZK_01, 1 );
}

on envVar eAZK_Kessy_defektS
{
    _mAZK_01.AZK_Kessy_defekt.phys = getValue(eAZK_Kessy_defektS);
}

on envVar eAZK_Kessy_nicht_gefundenS
{
    _mAZK_01.AZK_Kessy_nicht_gefunden.phys = getValue(eAZK_Kessy_nicht_gefundenS);
}

on envVar eAZK_MobileKey_defektS
{
    _mAZK_01.AZK_MobileKey_defekt.phys = getValue(eAZK_MobileKey_defektS);
}

on envVar eAZK_Mobilgeraet_nicht_gefundenS
{
    _mAZK_01.AZK_Mobilgeraet_nicht_gefunden .phys = getValue(eAZK_Mobilgeraet_nicht_gefundenS);
}

on envVar eAZK_Schluessel_im_FzgS
{
    _mAZK_01.AZK_Schluessel_im_Fzg .phys = getValue(eAZK_Schluessel_im_FzgS);
}

on envVar eAZK_Weiterfahrt_mit_MobilgeraetS
{
    _mAZK_01.AZK_Weiterfahrt_mit_Mobilgeraet.phys = getValue(eAZK_Weiterfahrt_mit_MobilgeraetS);
}

on envVar eAZK_Weiterfahrt_mit_SchluesselS
{
    _mAZK_01.AZK_Weiterfahrt_mit_Schluessel .phys = getValue(eAZK_Weiterfahrt_mit_SchluesselS);
}

on Timer _tBCM_01
{
    if( getValue( eTBCM_01 ) <= 0)  putValue( eSendBCM_01, 0 );
    if( (getValue( eSendEnabled ) && getValue( eSendBCM_01 )) || getValue( eDlcOnceBCM_01 ))  sendBCM_01();
}

on envVar eSendBCM_01
{
    if( getValue( eSendEnabled ) && getValue( eSendBCM_01 ))  sendBCM_01();
}

on envVar eTimeoutBCM_01
{
    cancelTimer( _tBCM_01 );
    cancelTimer( _totBCM_01 );
    if( getValue( this ))
        setTimer( _totBCM_01, (getValue( eSendEnabled ) && getValue( eSendBCM_01 ) && (getValue( eTOTBCM_01 ) > 0)) ? getValue( eTOTBCM_01 ) : 1 );
    else
        if( getValue( eSendEnabled ) && getValue( eSendBCM_01 ))  sendBCM_01();
}

on Timer _totBCM_01
{
    putValue( eTimeoutBCM_01, 0 );
}

on envVar eDlcOnceBCM_01
{
    if( getValue( eDlcOnceBCM_01 ) && !(getValue( eSendEnabled ) && getValue( eSendBCM_01 )))  setTimer( _tBCM_01, 1 );
}

on Timer _tinhBCM_01
{
    _bsiBCM_01 = 0;
    if( _bsaiBCM_01 && getValue( eSendEnabled ))  sendBCM_01();
}

void sendBCM_01()
{
    if( getValue(eChangeBCM_01))
    {
        if( getValue( eDlcOnceBCM_01 ) || getValue( eDlcWrongBCM_01 ))
        {
            putValue( eDlcOnceBCM_01, 0 );
            _mBCM_01.DLC = getValue( eDlcBCM_01 );
        }
        else
        {
            _mBCM_01.DLC = 8;
        }
    }
    else
    {
        _mBCM_01.DLC = 8;
    }

    output( _mBCM_01 );
    cancelTimer( _tBCM_01 );
    if( getValue( eTBCM_01 ) > 0)  setTimer( _tBCM_01, getValue( eTBCM_01 ) );  else  setTimer( _tBCM_01, 1 );
    _bsaiBCM_01 = 0;
    _bsiBCM_01 = 1;
    cancelTimer( _tinhBCM_01 );  setTimer( _tinhBCM_01, 100 );
}

BCM_01Changed()
{
    if( getValue( eSendEnabled ) && getValue( eSendBCM_01 ))
        if( _bsiBCM_01)
            _bsaiBCM_01 = 1;
        else
            sendBCM_01();
}

on envVar eAPS_Tongeber_defektS
{
    _mBCM_01.APS_Tongeber_defekt.phys = getValue( this );
    BCM_01Changed();
}

on envVar eBCM_Anf_AAW_MoLaWaS
{
    _mBCM_01.BCM_Anf_AAW_MoLaWa.phys = getValue( this );
    BCM_01Changed();
}

on envVar eBCM_Bremsbelag_SensorS
{
    _mBCM_01.BCM_Bremsbelag_Sensor.phys = getValue( this );
    BCM_01Changed();
}

on envVar eBCM_Bremsfluessigkeit_SensorS
{
    _mBCM_01.BCM_Bremsfluessigkeit_Sensor.phys = getValue( this );
    BCM_01Changed();
}

on envVar eBCM_Charisma_Taste2S
{
    _mBCM_01.BCM_Charisma_Taste2.phys = getValue( this );
    BCM_01Changed();
}

on envVar eBCM_Eco_Charisma_TasteS
{
    _mBCM_01.BCM_Eco_Charisma_Taste.phys = getValue( this );
    BCM_01Changed();
}

on envVar eBCM_Handbremse_HinweisS
{
    _mBCM_01.BCM_Handbremse_Hinweis.phys = getValue( this );
    BCM_01Changed();
}

on envVar eBCM_HDF_betaetigtS
{
    _mBCM_01.BCM_HDF_betaetigt.phys = getValue( this );
    BCM_01Changed();
}

on envVar eBCM_Hybrid_StartStopp_TasteS
{
    _mBCM_01.BCM_Hybrid_StartStopp_Taste.phys = getValue( this );
    BCM_01Changed();
}

on envVar eBCM_Hybrid_StSt_Taste_FehlerS
{
    _mBCM_01.BCM_Hybrid_StSt_Taste_Fehler.phys = getValue( this );
    BCM_01Changed();
}

on envVar eBCM_Kuehlmittel_SensorS
{
    _mBCM_01.BCM_Kuehlmittel_Sensor.phys = getValue( this );
    BCM_01Changed();
}

on envVar eBCM_Kuehlmittel_Sensor_02S
{
    _mBCM_01.BCM_Kuehlmittel_Sensor_02.phys = getValue( this );
    BCM_01Changed();
}

on envVar eBCM_Offroad_TasteS
{
    _mBCM_01.BCM_Offroad_Taste.phys = getValue( this );
    BCM_01Changed();
}

on envVar eBCM_ValetTaster_Fkts_LEDS
{
    _mBCM_01.BCM_ValetTaster_Fkts_LED.phys = getValue( this );
    BCM_01Changed();
}

on envVar eBCM_Waehlhebel_P_HinweisS
{
    _mBCM_01.BCM_Waehlhebel_P_Hinweis.phys = getValue( this );
    BCM_01Changed();
}

on envVar eBCM_Waschwasser_SensorS
{
    _mBCM_01.BCM_Waschwasser_Sensor.phys = getValue( this );
    BCM_01Changed();
}

on envVar eBCM1_AFS_LampeS
{
    _mBCM_01.BCM1_AFS_Lampe.phys = getValue( this );
    BCM_01Changed();
}

on envVar eBCM1_EasyEntry_StatusS
{
    _mBCM_01.BCM1_EasyEntry_Status.phys = getValue( this );
    BCM_01Changed();
}

on envVar eBCM1_Fahrlicht_HinweisS
{
    _mBCM_01.BCM1_Fahrlicht_Hinweis.phys = getValue( this );
    BCM_01Changed();
}

on envVar eBCM1_Hinweis_Lichtnachlauf
{
    _mBCM_01.BCM1_Hinweis_Lichtnachlauf.phys = getValue( this );
    BCM_01Changed();
}

on envVar eBCM1_Kl_15_HW_erkanntS
{
    _mBCM_01.BCM1_Kl_15_HW_erkannt.phys = getValue( this );
    BCM_01Changed();
}

on envVar eBCM1_Kl_15_Sig_HW_erkanntS
{
    _mBCM_01.BCM1_Kl_15_Sig_HW_erkannt.phys = getValue( this );
    BCM_01Changed();
}

on envVar eBCM1_LDS_StellungS
{
    _mBCM_01.BCM1_LDS_Stellung.phys = getValue( this );
    BCM_01Changed();
}

on envVar eBCM1_Lenksaeule_aktivS
{
    _mBCM_01.BCM1_Lenksaeule_aktiv.phys = getValue( this );
    BCM_01Changed();
}

on envVar eBCM1_Licht_WarnS
{
    _mBCM_01.BCM1_Licht_Warn.phys = getValue( this );
    BCM_01Changed();
}

on envVar eBCM1_Lichtwarn_TexteS
{
    _mBCM_01.BCM1_Lichtwarn_Texte.phys = getValue( this );
    BCM_01Changed();
}

on envVar eBCM1_MH_SchalterS
{
    _mBCM_01.BCM1_MH_Schalter.phys = getValue( this );
    BCM_01Changed();
}

on envVar eBCM1_MH_WIV_SchalterS
{
    _mBCM_01.BCM1_MH_WIV_Schalter.phys = getValue( this );
    BCM_01Changed();
}

on envVar eBCM1_NV_TasterS
{
    _mBCM_01.BCM1_NV_Taster.phys = getValue( this );
    BCM_01Changed();
}

on envVar eBCM1_Reisemodus_TexteS
{
    _mBCM_01.BCM1_Reisemodus_Texte.phys = getValue( this );
    BCM_01Changed();
}

on envVar eBCM1_Rueckfahrlicht_SchalterS
{
    _mBCM_01.BCM1_Rueckfahrlicht_Schalter.phys = getValue( this );
    BCM_01Changed();
}

on envVar eBCM1_Spannungs_AnfS
{
    _mBCM_01.BCM1_Spannungs_Anf.phys = getValue( this );
    BCM_01Changed();
}

on envVar eBCM1_Valet_Parking_TasterS
{
    _mBCM_01.BCM1_Valet_Parking_Taster.phys = getValue( this );
    BCM_01Changed();
}

on envVar eBCM1_Warnblink_TasterS
{
    _mBCM_01.BCM1_Warnblink_Taster.phys = getValue( this );
    BCM_01Changed();
}

on envVar eDWA_AlarmquelleS
{
    _mBCM_01.DWA_Alarmquelle.phys = getValue( this );
    BCM_01Changed();
}

on envVar eDWA_EinschraenkungS
{
    _mBCM_01.DWA_Einschraenkung.phys = getValue( this );
    BCM_01Changed();
}

on envVar eGong_TFL_Umschaltung
{
    _mBCM_01.Gong_TFL_Umschaltung.phys = getValue( this );
    BCM_01Changed();
}

on envVar eLRH_TasterS
{
    _mBCM_01.LRH_Taster.phys = getValue( this );
    BCM_01Changed();
}

on Timer _tBCM_03
{
    if( getValue( eTBCM_03 ) <= 0)  putValue( eSendBCM_03, 0 );
    if( (getValue( eSendEnabled ) && getValue( eSendBCM_03 )) || getValue( eDlcOnceBCM_03 ))  sendBCM_03();
}

on envVar eSendBCM_03
{
    if( getValue( eSendEnabled ) && getValue( eSendBCM_03 ))  sendBCM_03();
}

on envVar eTimeoutBCM_03
{
    cancelTimer( _tBCM_03 );
    cancelTimer( _totBCM_03 );
    if( getValue( this ))
        setTimer( _totBCM_03, (getValue( eSendEnabled ) && getValue( eSendBCM_03 ) && (getValue( eTOTBCM_03 ) > 0)) ? getValue( eTOTBCM_03 ) : 1 );
    else
        if( getValue( eSendEnabled ) && getValue( eSendBCM_03 ))  sendBCM_03();
}

on Timer _totBCM_03
{
    putValue( eTimeoutBCM_03, 0 );
}

on envVar eDlcOnceBCM_03
{
    if( getValue( eDlcOnceBCM_03 ) && !(getValue( eSendEnabled ) && getValue( eSendBCM_03 )))  setTimer( _tBCM_03, 1 );
}

void sendBCM_03()
{
    if( getValue(eChangeBCM_03))
    {
        if( getValue( eDlcOnceBCM_03 ) || getValue( eDlcWrongBCM_03 ))
        {
            putValue( eDlcOnceBCM_03, 0 );
            _mBCM_03.DLC = getValue( eDlcBCM_03 );
        }
        else
        {
            _mBCM_03.DLC = 8;
        }
    }
    else
    {
        _mBCM_03.DLC = 8;
    }

    output( _mBCM_03 );
    cancelTimer( _tBCM_03 );
    if( getValue( eTBCM_03 ) > 0)  setTimer( _tBCM_03, getValue( eTBCM_03 ) );  else  setTimer( _tBCM_03, 1 );
}

BCM_03Changed()
{
}

on envVar eBCM_anf_VLWS
{
    _mBCM_03.BCM_anf_VLW.phys = getValue( this );
}

on envVar eBCM_LTM_Allwetterl_StatusS
{
    _mBCM_03.BCM_LTM_Allwetterl_Status.phys = getValue( this );
    BCM_03Changed();
}

on envVar eBCM_LTM_Nebell_StatusS
{
    _mBCM_03.BCM_LTM_Nebell_Status.phys = getValue( this );
    BCM_03Changed();
}

on envVar eBCM_LTM_Nebelschluss_StatusS
{
    _mBCM_03.BCM_LTM_Nebelschluss_Status.phys = getValue( this );
    BCM_03Changed();
}

on envVar eBCM_LTM_PopUp_AnfS
{
    _mBCM_03.BCM_LTM_PopUp_Anf.phys = getValue( this );
    BCM_03Changed();
}

on envVar eBCM_LTM_PopUp_InhaltS
{
    _mBCM_03.BCM_LTM_PopUp_Inhalt.phys = getValue( this );
    BCM_03Changed();
}

on envVar eBCM_LTM_PopUp_StatusS
{
    _mBCM_03.BCM_LTM_PopUp_Status.phys = getValue( this );
    BCM_03Changed();
}

on Timer _tBCM_04
{
    if( getValue( eTBCM_04 ) <= 0)  putValue( eSendBCM_04, 0 );
    if( (getValue( eSendEnabled ) && getValue( eSendBCM_04 )) || getValue( eDlcOnceBCM_04 ))  sendBCM_04();
}

on envVar eSendBCM_04
{
    if( getValue( eSendEnabled ) && getValue( this ))  sendBCM_04();
}

on envVar eTimeoutBCM_04
{
    cancelTimer( _tBCM_04 );
    cancelTimer( _totBCM_04 );
    if( getValue( this ))
        setTimer( _totBCM_04, (getValue( eSendEnabled ) && getValue( eSendBCM_04 ) && (getValue( eTOTBCM_04 ) > 0)) ? getValue( eTOTBCM_04 ) : 1 );
    else
        if( getValue( eSendEnabled ) && getValue( eSendBCM_04 ))  sendBCM_04();
}

on Timer _totBCM_04
{
    putValue( eTimeoutBCM_04, 0 );
}

on envVar eDlcOnceBCM_04
{
    if( getValue( eDlcOnceBCM_04 ) && !(getValue( eSendEnabled ) && getValue( eSendBCM_04 )))  setTimer( _tBCM_04, 1 );
}

void sendBCM_04()
{
    if( getValue(eChangeBCM_04))
    {
        if( getValue( eDlcOnceBCM_04 ) || getValue( eDlcWrongBCM_04 ))
        {
            putValue( eDlcOnceBCM_04, 0 );
            _mBCM_04.DLC = getValue( eDlcBCM_04 );
        }
        else
        {
            _mBCM_04.DLC = 8;
        }
    }
    else
    {
        _mBCM_04.DLC = 8;
    }
    
    output( _mBCM_04 );
    cancelTimer( _tBCM_04 );
    if( getValue( eTBCM_04 ) > 0)  setTimer( _tBCM_04, getValue( eTBCM_04 ) );  else  setTimer( _tBCM_04, 1 );
}

BCM_04Changed()
{
}

on envVar eBCM_RGB_BlauS
{
    _mBCM_04.BCM_RGB_Blau.phys = getValue( this );
    BCM_04Changed();
}

on envVar eBCM_RGB_GruenS
{
    _mBCM_04.BCM_RGB_Gruen.phys = getValue( this );
    BCM_04Changed();
}

on envVar eBCM_RGB_RotS
{
    _mBCM_04.BCM_RGB_Rot.phys = getValue( this );
    BCM_04Changed();
}

// END MSG BCM_04
// MSG BCM_05

on Timer _tBCM_05
{
    if( getValue( eTBCM_05 ) <= 0)  putValue( eSendBCM_05, 0 );
    if( (getValue( eSendEnabled ) && getValue( eSendBCM_05 )) || getValue( eDlcOnceBCM_05 ))  sendBCM_05();
}

on envVar eSendBCM_05
{
    if( getValue( eSendEnabled ) && getValue( eSendBCM_05 ))  sendBCM_05();
}

on envVar eTimeoutBCM_05
{
    cancelTimer( _tBCM_05 );
    cancelTimer( _totBCM_05 );
    if( getValue( this ))
        setTimer( _totBCM_05, (getValue( eSendEnabled ) && getValue( eSendBCM_05 ) && (getValue( eTOTBCM_05 ) > 0)) ? getValue( eTOTBCM_05 ) : 1 );
    else
        if( getValue( eSendEnabled ) && getValue( eSendBCM_05 ))  sendBCM_05();
}

on Timer _totBCM_05
{
    putValue( eTimeoutBCM_05, 0 );
}

on envVar eDlcOnceBCM_05
{
    if( getValue( eDlcOnceBCM_05 ) && !(getValue( eSendEnabled ) && getValue( eSendBCM_05 )))  setTimer( _tBCM_05, 1 );
}

on Timer _tinhBCM_05
{
    _bsiBCM_05 = 0;
    if( _bsaiBCM_05 && getValue( eSendEnabled ))  sendBCM_05();
}

void sendBCM_05()
{
    if( getValue(eChangeBCM_05))
    {
        if( getValue( eDlcOnceBCM_05 ) || getValue( eDlcWrongBCM_05 ))
        {
            putValue( eDlcOnceBCM_05, 0 );
            _mBCM_05.DLC = getValue( eDlcBCM_05 );
        }
        else
        {
            _mBCM_05.DLC = 8;
        }
    }
    else
    {
        _mBCM_05.DLC = 8;
    }

    output( _mBCM_05 );
    cancelTimer( _tBCM_05 );
    if( getValue( eTBCM_05 ) > 0)  setTimer( _tBCM_05, getValue( eTBCM_05 ) );  else  setTimer( _tBCM_05, 1 );
    _bsaiBCM_05 = 0;
    _bsiBCM_05 = 1;
    cancelTimer( _tinhBCM_05 );  setTimer( _tinhBCM_05, 100 );
}

BCM_05Changed()
{
    if( getValue( eSendEnabled ) && getValue( eSendBCM_05 ))
        if( _bsiBCM_05)
            _bsaiBCM_05 = 1;
        else
            sendBCM_05();
}

on envVar KCAN_BCM_Relais_2_Batterie
{
    _mBCM_05.BCM_Relais_2_Batterie.phys = getValue(  this  );
    BCM_05Changed();
}

on envVar KCAN_FA_Hoehenwert_HL_01
{
    _mBCM_05.FA_Hoehenwert_HL_01.phys = getValue(  this  );
    BCM_05Changed();
}

on envVar KCAN_FA_Hoehenwert_VL_01
{
    _mBCM_05.FA_Hoehenwert_VL_01.phys = getValue(  this  );
    BCM_05Changed();
}

on envVar KCAN_HSH_LED
{
    _mBCM_05.HSH_LED.phys = getValue(  this  );
    BCM_05Changed();
}

on envVar KCAN_HSH_Status
{
    _mBCM_05.HSH_Status.phys = getValue(  this  );
    BCM_05Changed();
}

on envVar KCAN_KRH_Stufe_LED_li
{
    _mBCM_05.KRH_Stufe_LED_li.phys = getValue(  this  );
    BCM_05Changed();
}

on envVar KCAN_KRH_Stufe_LED_re
{
    _mBCM_05.KRH_Stufe_LED_re.phys = getValue(  this  );
    BCM_05Changed();
}

on envVar KCAN_Niveausensor_HL_verbaut
{
    _mBCM_05.Niveausensor_HL_verbaut.phys = getValue(  this  );
    BCM_05Changed();
}

on envVar KCAN_Niveausensor_VL_verbaut
{
    _mBCM_05.Niveausensor_VL_verbaut.phys = getValue(  this  );
    BCM_05Changed();
}

on envVar KCAN_SIL_Stufe_LED_li
{
    _mBCM_05.SIL_Stufe_LED_li.phys = getValue(  this  );
    BCM_05Changed();
}

on envVar KCAN_SIL_Stufe_LED_re
{
    _mBCM_05.SIL_Stufe_LED_re.phys = getValue(  this  );
    BCM_05Changed();
}

on Timer _tBCM_06
{
    if( getValue( eTBCM_06 ) <= 0)  putValue( eSendBCM_06, 0 );
    if( (getValue( eSendEnabled ) && getValue( eSendBCM_06 )) || getValue( eDlcOnceBCM_06 ))  sendBCM_06();
}

on envVar eSendBCM_06
{
    if( getValue( eSendEnabled ) && getValue( eSendBCM_06 ))  sendBCM_06();
}

on envVar eTimeoutBCM_06
{
    cancelTimer( _tBCM_06 );
    cancelTimer( _totBCM_06 );
    if( getValue( this ))
        setTimer( _totBCM_06, (getValue( eSendEnabled ) && getValue( eSendBCM_06 ) && (getValue( eTOTBCM_06 ) > 0)) ? getValue( eTOTBCM_06 ) : 1 );
    else
        if( getValue( eSendEnabled ) && getValue( eSendBCM_06 ))  sendBCM_06();
}

on Timer _totBCM_06
{
    putValue( eTimeoutBCM_06, 0 );
}

on envVar eDlcOnceBCM_06
{
    if( getValue( eDlcOnceBCM_06 ) && !(getValue( eSendEnabled ) && getValue( eSendBCM_06 )))  setTimer( _tBCM_06, 1 );
}

on Timer _tinhBCM_06
{
    _bsiBCM_06 = 0;
    if( _bsaiBCM_06 && getValue( eSendEnabled ))  sendBCM_06();
}

void sendBCM_06()
{
    if( getValue(eChangeBCM_06))
    {
        if( getValue( eDlcOnceBCM_06 ) || getValue( eDlcWrongBCM_06 ))
        {
            putValue( eDlcOnceBCM_06, 0 );
            _mBCM_06.DLC = getValue( eDlcBCM_06 );
        }
        else
        {
            _mBCM_06.DLC = 8;
        }
    }
    else
    {
        _mBCM_06.DLC = 8;
    }

    output( _mBCM_06 );
    cancelTimer( _tBCM_06 );
    if( getValue( eTBCM_06 ) > 0)  setTimer( _tBCM_06, getValue( eTBCM_06 ) );  else  setTimer( _tBCM_06, 1 );
    _bsaiBCM_06 = 0;
    _bsiBCM_06 = 1;
    cancelTimer( _tinhBCM_06 );  setTimer( _tinhBCM_06, 100 );
}

BCM_06Changed()
{
    if( getValue( eSendEnabled ) && getValue( eSendBCM_06 ))
        if( _bsiBCM_06)
            _bsaiBCM_06 = 1;
        else
            sendBCM_06();
}

on envVar KCAN_DR_Drehwinkel_HL_BCM_06
{
    _mBCM_06.DR_Drehwinkel_HL.phys = getValue(  this  );
    BCM_06Changed();
}

on envVar KCAN_DR_Drehwinkel_VL_BCM_06
{
    _mBCM_06.DR_Drehwinkel_VL.phys = getValue(  this  );
    BCM_06Changed();
}

on envVar KCAN_DR_Drehwinkelsensortausch_HL_BCM_06
{
    _mBCM_06.DR_Drehwinkelsensortausch_HL.phys = getValue(  this  );
    BCM_06Changed();
}

on envVar KCAN_DR_Drehwinkelsensortausch_VL_BCM_06
{
    _mBCM_06.DR_Drehwinkelsensortausch_VL.phys = getValue(  this  );
    BCM_06Changed();
}

on Timer _tBCM_Kessy_01
{
    if( getValue( eTBCM_Kessy_01 ) <= 0)  putValue( eSendBCM_Kessy_01, 0 );
    if( (getValue( eSendEnabled ) && getValue( eSendBCM_Kessy_01 )) || getValue( eDlcOnceBCM_Kessy_01 ))  sendBCM_Kessy_01();
}

on envVar eSendBCM_Kessy_01
{
    if( getValue( eSendEnabled ) && getValue( eSendBCM_Kessy_01 ))  sendBCM_Kessy_01();
}

on envVar eTimeoutBCM_Kessy_01
{
    cancelTimer( _tBCM_Kessy_01 );
    cancelTimer( _totBCM_Kessy_01 );
    if( getValue( this ))
        setTimer( _totBCM_Kessy_01, (getValue( eSendEnabled ) && getValue( eSendBCM_Kessy_01 ) && (getValue( eTOTBCM_Kessy_01 ) > 0)) ? getValue( eTOTBCM_Kessy_01 ) : 1 );
    else
        if( getValue( eSendEnabled ) && getValue( eSendBCM_Kessy_01 ))  sendBCM_Kessy_01();
}

on Timer _totBCM_Kessy_01
{
    putValue( eTimeoutBCM_Kessy_01, 0 );
}

on envVar eDlcOnceBCM_Kessy_01
{
    if( getValue( eDlcOnceBCM_Kessy_01 ) && !(getValue( eSendEnabled ) && getValue( eSendBCM_Kessy_01 )))  setTimer( _tBCM_Kessy_01, 1 );
}

on Timer _tinhBCM_Kessy_01
{
    _bsiBCM_Kessy_01 = 0;
    if( _bsaiBCM_Kessy_01 && getValue( eSendEnabled ))  sendBCM_Kessy_01();
}

void sendBCM_Kessy_01()
{
    if( getValue(eChangeBCM_Kessy_01))
    {
        if( getValue( eDlcOnceBCM_Kessy_01 ) || getValue( eDlcWrongBCM_Kessy_01 ))
        {
            putValue( eDlcOnceBCM_Kessy_01, 0 );
            _mBCM_Kessy_01.DLC = getValue( eDlcBCM_Kessy_01 );
        }
        else
        {
            _mBCM_Kessy_01.DLC = 8;
        }
    }
    else
    {
        _mBCM_Kessy_01.DLC = 8;
    }

    output( _mBCM_Kessy_01 );
    cancelTimer( _tBCM_Kessy_01 );
    if( getValue( eTBCM_Kessy_01 ) > 0)  setTimer( _tBCM_Kessy_01, getValue( eTBCM_Kessy_01 ) );  else  setTimer( _tBCM_Kessy_01, 1 );
    _bsaiBCM_Kessy_01 = 0;
    _bsiBCM_Kessy_01 = 1;
    cancelTimer( _tinhBCM_Kessy_01 );  setTimer( _tinhBCM_Kessy_01, 100 );
}

byte isBCM_Kessy_01Active()
{
    if( getValue( eKY_Anf_ReichwbegrS ) != 0)  return 1;
    if( getValue( eKY_Anf_Reichwbegr_GesamtS ) != 0)  return 1;
    if( getValue( eKY_Autofunktion_AktivS ) != 0)  return 1;
    if( getValue( eKY_BedienstelleS ) != 0)  return 1;
    if( getValue( eKY_EntriegelnS ) != 0)  return 1;
    if( getValue( eKY_FFB_in_LF_ReichwS ) != 0)  return 1;
  //  if( getValue( eKY_HD_Verriegelung_AutorisiertS ) != 0)  return 1;
    if( getValue( eKY_IDGeber_1_BatS ) != 0)  return 1;
    if( getValue( eKY_IDGeber_1_StatusS ) != 0)  return 1;
    if( getValue( eKY_IDGeber_2_BatS ) != 0)  return 1;
    if( getValue( eKY_IDGeber_2_StatusS ) != 0)  return 1;
    if( getValue( eKY_IDGeber_3_BatS ) != 0)  return 1;
    if( getValue( eKY_IDGeber_3_StatusS ) != 0)  return 1;
    if( getValue( eKY_IDGeber_4_BatS ) != 0)  return 1;
    if( getValue( eKY_IDGeber_4_StatusS ) != 0)  return 1;
    if( getValue( eKY_KessyEntryExit_AktS ) != 0)  return 1;
    if( getValue( eKY_Nr_IDGeber_AutofktS ) != 0)  return 1;
    if( getValue( eKY_RSSI_WertS ) != 0)  return 1;
    if( getValue( eKY_SchluesselnrS ) != 0)  return 1;
    if( getValue( eKY_SofttouchS ) != 0)  return 1;
    if( getValue( eKY_VerriegelnS ) != 0)  return 1;
    if( getValue( eKY_ZV_CMDS ) != 0)  return 1;
    //if( getValue( eZV_Anf_Abschaltung_ZuendungS ) != 0)  return 1;
    return 0;
}

BCM_Kessy_01Changed()
{
    _bBCM_Kessy_01Active = isBCM_Kessy_01Active();
    if( getValue( eSendEnabled ) && getValue( eSendBCM_Kessy_01 ))
        if( _bsiBCM_Kessy_01)
            _bsaiBCM_Kessy_01 = 1;
        else
            sendBCM_Kessy_01();
}

on envVar eKY_Anf_ReichwbegrS
{
    _mBCM_Kessy_01.KY_Anf_Reichwbegr.phys = getValue( this );
    BCM_Kessy_01Changed();
}

on envVar eKY_Anf_Reichwbegr_GesamtS
{
    _mBCM_Kessy_01.KY_Anf_Reichwbegr_Gesamt.phys = getValue( this );
    BCM_Kessy_01Changed();
}

on envVar eKY_Autofunktion_AktivS
{
    _mBCM_Kessy_01.KY_Autofunktion_Aktiv.phys = getValue( this );
    BCM_Kessy_01Changed();
}

on envVar eKY_BedienstelleS
{
    _mBCM_Kessy_01.KY_Bedienstelle.phys = getValue( this );
    BCM_Kessy_01Changed();
}

on envVar eKY_EntriegelnS
{
    _mBCM_Kessy_01.KY_Entriegeln.phys = getValue( this );
    BCM_Kessy_01Changed();
}

on envVar eKY_FFB_in_LF_ReichwS
{
    _mBCM_Kessy_01.KY_FFB_in_LF_Reichw.phys = getValue( this );
    BCM_Kessy_01Changed();
}

on envVar KCAN_KY_HD_Verriegelung_Autorisiert
{
    _mBCM_Kessy_01.KY_HD_Verriegelung_Autorisiert.phys = getValue( this );
    BCM_Kessy_01Changed();
}

on envVar eKY_IDGeber_1_BatS
{
    _mBCM_Kessy_01.KY_IDGeber_1_Bat.phys = getValue( this );
    BCM_Kessy_01Changed();
}

on envVar eKY_IDGeber_1_StatusS
{
    _mBCM_Kessy_01.KY_IDGeber_1_Status.phys = getValue( this );
    BCM_Kessy_01Changed();
}

on envVar eKY_IDGeber_2_BatS
{
    _mBCM_Kessy_01.KY_IDGeber_2_Bat.phys = getValue( this );
    BCM_Kessy_01Changed();
}

on envVar eKY_IDGeber_2_StatusS
{
    _mBCM_Kessy_01.KY_IDGeber_2_Status.phys = getValue( this );
    BCM_Kessy_01Changed();
}

on envVar eKY_IDGeber_3_BatS
{
    _mBCM_Kessy_01.KY_IDGeber_3_Bat.phys = getValue( this );
    BCM_Kessy_01Changed();
}

on envVar eKY_IDGeber_3_StatusS
{
    _mBCM_Kessy_01.KY_IDGeber_3_Status.phys = getValue( this );
    BCM_Kessy_01Changed();
}

on envVar eKY_IDGeber_4_BatS
{
    _mBCM_Kessy_01.KY_IDGeber_4_Bat.phys = getValue( this );
    BCM_Kessy_01Changed();
}

on envVar eKY_IDGeber_4_StatusS
{
    _mBCM_Kessy_01.KY_IDGeber_4_Status.phys = getValue( this );
    BCM_Kessy_01Changed();
}

on envVar eKY_KessyEntryExit_AktS
{
    _mBCM_Kessy_01.KY_KessyEntryExit_Akt.phys = getValue( this );
    BCM_Kessy_01Changed();
}

on envVar eKY_Nr_IDGeber_AutofktS
{
    _mBCM_Kessy_01.KY_Nr_IDGeber_Autofkt.phys = getValue( this );
    BCM_Kessy_01Changed();
}

on envVar eKY_RSSI_WertS
{
    _mBCM_Kessy_01.KY_RSSI_Wert.phys = getValue( this );
    BCM_Kessy_01Changed();
}

on envVar eKY_SchluesselnrS
{
    _mBCM_Kessy_01.KY_Schluesselnr.phys = getValue( this );
    BCM_Kessy_01Changed();
}

on envVar eKY_SofttouchS
{
    _mBCM_Kessy_01.KY_Softtouch.phys = getValue( this );
    BCM_Kessy_01Changed();
}

on envVar eKY_VerriegelnS
{
    _mBCM_Kessy_01.KY_Verriegeln.phys = getValue( this );
    BCM_Kessy_01Changed();
}

on envVar eKY_ZV_CMDS
{
    _mBCM_Kessy_01.KY_ZV_CMD.phys = getValue( this );
    BCM_Kessy_01Changed();
}

on envVar KCAN_ZV_Anf_Abschaltung_Zuendung
{
    _mBCM_Kessy_01.ZV_Anf_Abschaltung_Zuendung.phys = getValue( this );
    BCM_Kessy_01Changed();
}

on Timer _tBCM_Kessy_02
{
    if( getValue( eTBCM_Kessy_02 ) <= 0)  putValue( eSendBCM_Kessy_02, 0 );
    if( (getValue( eSendEnabled ) && getValue( eSendBCM_Kessy_02 )) || getValue( eDlcOnceBCM_Kessy_02 ))  sendBCM_Kessy_02();
}

on envVar eSendBCM_Kessy_02
{
    if( getValue( eSendEnabled ) && getValue( eSendBCM_Kessy_02 ))  sendBCM_Kessy_02();
}

on envVar eTimeoutBCM_Kessy_02
{
    cancelTimer( _tBCM_Kessy_02 );
    cancelTimer( _totBCM_Kessy_02 );
    if( getValue( this ))
        setTimer( _totBCM_Kessy_02, (getValue( eSendEnabled ) && getValue( eSendBCM_Kessy_02 ) && (getValue( eTOTBCM_Kessy_02 ) > 0)) ? getValue( eTOTBCM_Kessy_02 ) : 1 );
    else
        if( getValue( eSendEnabled ) && getValue( eSendBCM_Kessy_02 ))  sendBCM_Kessy_02();
}

on Timer _totBCM_Kessy_02
{
    putValue( eTimeoutBCM_Kessy_02, 0 );
}

on envVar eDlcOnceBCM_Kessy_02
{
    if( getValue( eDlcOnceBCM_Kessy_02 ) && !(getValue( eSendEnabled ) && getValue( eSendBCM_Kessy_02 )))  setTimer( _tBCM_Kessy_02, 1 );
}

on Timer _tinhBCM_Kessy_02
{
    _bsiBCM_Kessy_02 = 0;
    if( _bsaiBCM_Kessy_02 && getValue( eSendEnabled ))  sendBCM_Kessy_02();
}

void sendBCM_Kessy_02()
{
    if( getValue(eChangeBCM_Kessy_02))
    {
        if( getValue( eDlcOnceBCM_Kessy_02 ) || getValue( eDlcWrongBCM_Kessy_02 ))
        {
            putValue( eDlcOnceBCM_Kessy_02, 0 );
            _mBCM_Kessy_02.DLC = getValue( eDlcBCM_Kessy_02 );
        }
        else
        {
            _mBCM_Kessy_02.DLC = 8;
        }
    }
    else
    {
        _mBCM_Kessy_02.DLC = 8;
    }

    output( _mBCM_Kessy_02 );
    cancelTimer( _tBCM_Kessy_02 );
    if( getValue( eTBCM_Kessy_02 ) > 0)  setTimer( _tBCM_Kessy_02, getValue( eTBCM_Kessy_02 ) );  else  setTimer( _tBCM_Kessy_02, 1 );
    _bsaiBCM_Kessy_02 = 0;
    _bsiBCM_Kessy_02 = 1;
    cancelTimer( _tinhBCM_Kessy_02 );  setTimer( _tinhBCM_Kessy_02, 100 );
}

byte isBCM_Kessy_02Active()
{
    if( getValue( eKY_GoAuthent_RespS ) != 0)  return 1;
    if( getValue( eKY_GoTransponder_IDS ) != 0)  return 1;
    if( getValue( eKY_ID_Geber_1S ) != 0)  return 1;
    if( getValue( eKY_ID_Geber_2S ) != 0)  return 1;
    if( getValue( eKY_ID_Geber_3S ) != 0)  return 1;
    if( getValue( eKY_ID_Geber_4S ) != 0)  return 1;
    ///if( getValue( eKY_ID_Geber_autorisiert_HeckS ) != 0)  return 1;
    //if( getValue( eKY_RSSI_ID_GeberS ) != 0)  return 1;
    if( getValue( eKY_WFS_KeyDataS ) != 0)  return 1;
    return 0;
}

BCM_Kessy_02Changed()
{
    _bBCM_Kessy_02Active = isBCM_Kessy_02Active();
    if( getValue( eSendEnabled ) && getValue( eSendBCM_Kessy_02 ))
        if( _bsiBCM_Kessy_02)
            _bsaiBCM_Kessy_02 = 1;
        else
            sendBCM_Kessy_02();
}

on envVar eKY_GoAuthent_RespS
{
    _mBCM_Kessy_02.KY_GoAuthent_Resp.phys = getValue( this );
    BCM_Kessy_02Changed();
}

on envVar eKY_GoTransponder_IDS
{
    _mBCM_Kessy_02.KY_GoTransponder_ID.phys = getValue( this );
    BCM_Kessy_02Changed();
}

on envVar eKY_ID_Geber_1S
{
    _mBCM_Kessy_02.KY_ID_Geber_1.phys = getValue( this );
    BCM_Kessy_02Changed();
}

on envVar eKY_ID_Geber_2S
{
    _mBCM_Kessy_02.KY_ID_Geber_2.phys = getValue( this );
    BCM_Kessy_02Changed();
}

on envVar eKY_ID_Geber_3S
{
    _mBCM_Kessy_02.KY_ID_Geber_3.phys = getValue( this );
    BCM_Kessy_02Changed();
}

on envVar eKY_ID_Geber_4S
{
    _mBCM_Kessy_02.KY_ID_Geber_4.phys = getValue( this );
    BCM_Kessy_02Changed();
}

on envVar KCAN_KY_ID_Geber_autorisiert_Heck
{
    _mBCM_Kessy_02.KY_ID_Geber_autorisiert_Heck.phys = getValue( this );
    BCM_Kessy_02Changed();
}

on envVar KCAN_KY_RSSI_ID_Geber
{
    _mBCM_Kessy_02.KY_RSSI_ID_Geber.phys = getValue( this );
    BCM_Kessy_02Changed();
}

on envVar eKY_WFS_KeyDataS
{
    _mBCM_Kessy_02.KY_WFS_KeyData.phys = getValue( this );
    BCM_Kessy_02Changed();
}

//END MSG BCM_Kessy_02

// MSG BCM_Taster_02

on Timer _tBCM_Taster_02
{
  if( getValue( eTBCM_Taster_02 ) <= 0)  putValue( eSendBCM_Taster_02, 0 );
  if( (getValue( eSendEnabled ) && getValue( eSendBCM_Taster_02 )) || getValue( eDlcOnceBCM_Taster_02 ))  sendBCM_Taster_02();
}

on envVar eSendBCM_Taster_02
{
  if( getValue( eSendEnabled ) && getValue( eSendBCM_Taster_02 ))  sendBCM_Taster_02();
}

on envVar eTimeoutBCM_Taster_02
{
  cancelTimer( _tBCM_Taster_02 );
  cancelTimer( _totBCM_Taster_02 );
  if( getValue( this ))
    setTimer( _totBCM_Taster_02, (getValue( eSendEnabled ) && getValue( eSendBCM_Taster_02 ) && (getValue( eTOTBCM_Taster_02 ) > 0)) ? getValue( eTOTBCM_Taster_02 ) : 1 );
  else
    if( getValue( eSendEnabled ) && getValue( eSendBCM_Taster_02 ))  sendBCM_Taster_02();
}

on Timer _totBCM_Taster_02
{
  putValue( eTimeoutBCM_Taster_02, 0 );
}

on envVar eDlcOnceBCM_Taster_02
{
  if( getValue( eDlcOnceBCM_Taster_02 ) && !(getValue( eSendEnabled ) && getValue( eSendBCM_Taster_02 )))  setTimer( _tBCM_Taster_02, 1 );
}

on Timer _tinhBCM_Taster_02
{
  _bsiBCM_Taster_02 = 0;
  if( _bsaiBCM_Taster_02 && getValue( eSendEnabled ))  sendBCM_Taster_02();
}

void sendBCM_Taster_02()
{
  if( getValue(eChangeBCM_Taster_02))
  {
    if( getValue( eDlcOnceBCM_Taster_02 ) || getValue( eDlcWrongBCM_Taster_02 ))
    {
        putValue( eDlcOnceBCM_Taster_02, 0 );
        _mBCM_Taster_02.DLC = getValue( eDlcBCM_Taster_02 );
    }
    else
    {
        _mBCM_Taster_02.DLC = 8;
    }
  }
  else
  {
    _mBCM_Taster_02.DLC = 8;
  }

  output( _mBCM_Taster_02 );
  cancelTimer( _tBCM_Taster_02 );
  if( getValue( eTBCM_Taster_02 ) > 0)  setTimer( _tBCM_Taster_02, getValue( eTBCM_Taster_02 ) );  else  setTimer( _tBCM_Taster_02, 1 );
  _bsaiBCM_Taster_02 = 0;
  _bsiBCM_Taster_02 = 1;
  cancelTimer( _tinhBCM_Taster_02 );  setTimer( _tinhBCM_Taster_02, 100 );
}

byte isBCM_Taster_02Active()
{
    //if( getValue( eLIM_bCall_TasterS ) != 0)  return 1;
    //if( getValue( eLIM_iCall_TasterS ) != 0)  return 1;
    //if( getValue( eLIM_S_Rollo_hiS ) != 0)  return 1;
    //if( getValue( eLIM_S_Rollo_voS ) != 0)  return 1;
   // if( getValue( eLIM_S_SAD_hiS ) != 0)  return 1;
   // if( getValue( eLIM_S_SAD_VoS ) != 0)  return 1;
    return 0;
}

BCM_Taster_02Changed()
{
  _bBCM_Taster_02Active = isBCM_Taster_02Active();
  if( getValue( eSendEnabled ) && getValue( eSendBCM_Taster_02 ))
    if( _bsiBCM_Taster_02)
      _bsaiBCM_Taster_02 = 1;
    else
      sendBCM_Taster_02();
}

on envVar KCAN_LIM_bCall_Taster
{
  _mBCM_Taster_02.LIM_bCall_Taster = getValue(  this  );
   BCM_Taster_02Changed();
}

on envVar KCAN_LIM_iCall_Taster
{
  _mBCM_Taster_02.LIM_iCall_Taster = getValue(  this  );
   BCM_Taster_02Changed();
}

on envVar KCAN_LIM_S_Rollo_hi
{
  _mBCM_Taster_02.LIM_S_Rollo_hi = getValue(  this  );
   BCM_Taster_02Changed();
}

on envVar KCAN_LIM_S_Rollo_vo
{
  _mBCM_Taster_02.LIM_S_Rollo_vo = getValue(  this  );
   BCM_Taster_02Changed();
}

on envVar KCAN_LIM_S_SAD_hi
{
  _mBCM_Taster_02.LIM_S_SAD_hi = getValue(  this  );
   BCM_Taster_02Changed();
}

on envVar KCAN_LIM_S_SAD_Vo
{
  _mBCM_Taster_02.LIM_S_SAD_Vo = getValue(  this  );
   BCM_Taster_02Changed();
}

on Timer _tBlinkmodi_02
{
    if( getValue( eTBlinkmodi_02 ) <= 0)  putValue( eSendBlinkmodi_02, 0 );
    if( (getValue( eSendEnabled ) && getValue( eSendBlinkmodi_02 )) || getValue( eDlcOnceBlinkmodi_02 ))  sendBlinkmodi_02();
}

on envVar eSendBlinkmodi_02
{
    if( getValue( eSendEnabled ) && getValue( eSendBlinkmodi_02 ))  sendBlinkmodi_02();
}

on envVar eTimeoutBlinkmodi_02
{
    cancelTimer( _tBlinkmodi_02 );
    cancelTimer( _totBlinkmodi_02 );
    if( getValue( this ))
        setTimer( _totBlinkmodi_02, (getValue( eSendEnabled ) && getValue( eSendBlinkmodi_02 ) && (getValue( eTOTBlinkmodi_02 ) > 0)) ? getValue( eTOTBlinkmodi_02 ) : 1 );
    else
        if( getValue( eSendEnabled ) && getValue( eSendBlinkmodi_02 ))  sendBlinkmodi_02();
}

on Timer _totBlinkmodi_02
{
    putValue( eTimeoutBlinkmodi_02, 0 );
}

on envVar eDlcOnceBlinkmodi_02
{
    if( getValue( eDlcOnceBlinkmodi_02 ) && !(getValue( eSendEnabled ) && getValue( eSendBlinkmodi_02 )))  setTimer( _tBlinkmodi_02, 1 );
}

on Timer _tinhBlinkmodi_02
{
    _bsiBlinkmodi_02 = 0;
    if( _bsaiBlinkmodi_02 && getValue( eSendEnabled ))  sendBlinkmodi_02();
}

void sendBlinkmodi_02()
{
    if( getValue(eChangeBlinkmodi_02))
    {
        if( getValue( eDlcOnceBlinkmodi_02 ) || getValue( eDlcWrongBlinkmodi_02 ))
        {
            putValue( eDlcOnceBlinkmodi_02, 0 );
            _mBlinkmodi_02.DLC = getValue( eDlcBlinkmodi_02 );
        }
        else
        {
            _mBlinkmodi_02.DLC = 8;
        }
    }
    else
    {
        _mBlinkmodi_02.DLC = 8;
    }

    output( _mBlinkmodi_02 );
    cancelTimer( _tBlinkmodi_02 );
    if( _bBlinkmodi_02Active)
        setTimer( _tBlinkmodi_02, 50 );
    else
        if( getValue( eTBlinkmodi_02 ) > 0)  setTimer( _tBlinkmodi_02, getValue( eTBlinkmodi_02 ) );  else  setTimer( _tBlinkmodi_02, 1 );
    _bsaiBlinkmodi_02 = 0;
    _bsiBlinkmodi_02 = 1;
    cancelTimer( _tinhBlinkmodi_02 );  setTimer( _tinhBlinkmodi_02, 10 );
}

byte isBlinkmodi_02Active()
{
    if( getValue( eBlinken_li_Fzg_TaktS ) != 0)  return 1;
    if( getValue( eBlinken_li_Kombi_TaktS ) != 0)  return 1;
    if( getValue( eBlinken_re_Fzg_TaktS ) != 0)  return 1;
    if( getValue( eBlinken_re_Kombi_TaktS ) != 0)  return 1;
    if( getValue( eBM_CrashS ) != 0)  return 1;
    if( getValue( eBM_DWA_AlarmS ) != 0)  return 1;
    if( getValue( eBM_DWA_einS ) != 0)  return 1;
    if( getValue( eBM_GDOS ) != 0)  return 1;
    if( getValue( eBM_linksS ) != 0)  return 1;
    if( getValue( eBM_NBA_n_codiert_n_aktivS ) != 0)  return 1;
    if( getValue( eBM_NBA_StatusS ) != 0)  return 1;
    if( getValue( eBM_Not_BremsungS ) != 0)  return 1;
    if( getValue( eBM_PanikS ) != 0)  return 1;
    if( getValue( eBM_rechtsS ) != 0)  return 1;
    if( getValue( eBM_Taxi_NotalarmS ) != 0)  return 1;
    if( getValue( eBM_TelematikS ) != 0)  return 1;
    if( getValue( eBM_WarnblinkenS ) != 0)  return 1;
    if( getValue( eBM_ZV_aufS ) != 0)  return 1;
    if( getValue( eBM_ZV_zuS ) != 0)  return 1;
    return 0;
}

Blinkmodi_02Changed()
{
    _bBlinkmodi_02Active = isBlinkmodi_02Active();
    if( getValue( eSendEnabled ) && getValue( eSendBlinkmodi_02 ))
        if( _bsiBlinkmodi_02)
            _bsaiBlinkmodi_02 = 1;
        else
            sendBlinkmodi_02();
}

on envVar eBlinken_li_Fzg_TaktS
{
    _mBlinkmodi_02.Blinken_li_Fzg_Takt.phys = getValue( this );
    Blinkmodi_02Changed();
}

on envVar eBlinken_li_Kombi_TaktS
{
    _mBlinkmodi_02.Blinken_li_Kombi_Takt.phys = getValue( this );
    Blinkmodi_02Changed();
}

on envVar eBlinken_re_Fzg_TaktS
{
    _mBlinkmodi_02.Blinken_re_Fzg_Takt.phys = getValue( this );
    Blinkmodi_02Changed();
}

on envVar eBlinken_re_Kombi_TaktS
{
    _mBlinkmodi_02.Blinken_re_Kombi_Takt.phys = getValue( this );
    Blinkmodi_02Changed();
}

on envVar KCAN_BM_Autobahn
{
    _mBlinkmodi_02.BM_Autobahn.phys = getValue( this );
    Blinkmodi_02Changed();
}

on envVar eBM_CrashS
{
    _mBlinkmodi_02.BM_Crash.phys = getValue( this );
    Blinkmodi_02Changed();
}

on envVar eBM_DWA_AlarmS
{
    _mBlinkmodi_02.BM_DWA_Alarm.phys = getValue( this );
    Blinkmodi_02Changed();
}

on envVar eBM_DWA_einS
{
    _mBlinkmodi_02.BM_DWA_ein.phys = getValue( this );
    Blinkmodi_02Changed();
}

on envVar eBM_GDOS
{
    _mBlinkmodi_02.BM_GDO.phys = getValue( this );
    Blinkmodi_02Changed();
}

on envVar KCAN_BM_HD_Oeffnung_angelernt
{
    _mBlinkmodi_02.BM_HD_Oeffnung_angelernt.phys = getValue( this );
    Blinkmodi_02Changed();
}

on envVar eBM_linksS
{
    _mBlinkmodi_02.BM_links.phys = getValue( this );
    Blinkmodi_02Changed();
}

on envVar eBM_NBA_n_codiert_n_aktivS
{
    _mBlinkmodi_02.BM_NBA_n_codiert_n_aktiv.phys = getValue( this );
    Blinkmodi_02Changed();
}

on envVar eBM_NBA_StatusS
{
    _mBlinkmodi_02.BM_NBA_Status.phys = getValue( this );
    Blinkmodi_02Changed();
}

on envVar eBM_Not_BremsungS
{
    _mBlinkmodi_02.BM_Not_Bremsung.phys = getValue( this );
    Blinkmodi_02Changed();
}

on envVar eBM_PanikS
{
    _mBlinkmodi_02.BM_Panik.phys = getValue( this );
    Blinkmodi_02Changed();
}

on envVar KCAN_BM_PiloPa
{
    _mBlinkmodi_02.BM_PiloPa.phys = getValue( this );
    Blinkmodi_02Changed();
}

on envVar KCAN_BM_Recas
{
    _mBlinkmodi_02.BM_Recas.phys = getValue( this );
    Blinkmodi_02Changed();
}

on envVar eBM_rechtsS
{
    _mBlinkmodi_02.BM_rechts.phys = getValue( this );
    Blinkmodi_02Changed();
}

on envVar KCAN_BM_Rollenmodus_Blinken
{
    _mBlinkmodi_02.BM_Rollenmodus_Blinken.phys = getValue( this );
    Blinkmodi_02Changed();
}

on envVar eBM_Taxi_NotalarmS
{
    _mBlinkmodi_02.BM_Taxi_Notalarm.phys = getValue( this );
    Blinkmodi_02Changed();
}

on envVar eBM_TelematikS
{
    _mBlinkmodi_02.BM_Telematik.phys = getValue( this );
    Blinkmodi_02Changed();
}

on envVar KCAN_BM_Telematik_Abbruchgrund
{
    _mBlinkmodi_02.BM_Telematik_Abbruchgrund.phys = getValue( this );
    Blinkmodi_02Changed();
}

on envVar eBM_WarnblinkenS
{
    _mBlinkmodi_02.BM_Warnblinken.phys = getValue( this );
    Blinkmodi_02Changed();
}

on envVar KCAN_BM_WBT_Beleuchtung
{
    _mBlinkmodi_02.BM_WBT_Beleuchtung.phys = getValue( this );
    Blinkmodi_02Changed();
}

on envVar KCAN_BM_Wischblinken
{
    _mBlinkmodi_02.BM_Wischblinken.phys = getValue( this );
    Blinkmodi_02Changed();
}

on envVar eBM_ZV_aufS
{
    _mBlinkmodi_02.BM_ZV_auf.phys = getValue( this );
    Blinkmodi_02Changed();
}

on envVar eBM_ZV_zuS
{
    _mBlinkmodi_02.BM_ZV_zu.phys = getValue( this );
    Blinkmodi_02Changed();
}

// END MSG Blinkmodi_02

// MSG DiETa_01

on Timer _tDiETa_01
{
  if( getValue( eTDiETa_01 ) <= 0)  putValue( eSendDiETa_01, 0 );
  if( (getValue( eSendEnabled ) && getValue( eSendDiETa_01 )) || getValue( eDlcOnceDiETa_01 ))  sendDiETa_01();
}

on envVar eSendDiETa_01
{
  if( getValue( eSendEnabled ) && getValue( eSendDiETa_01 ))  sendDiETa_01();
}

on envVar eTimeoutDiETa_01
{
  cancelTimer( _tDiETa_01 );
  cancelTimer( _totDiETa_01 );
  if( getValue( this ))
    setTimer( _totDiETa_01, (getValue( eSendEnabled ) && getValue( eSendDiETa_01 ) && (getValue( eTOTDiETa_01 ) > 0)) ? getValue( eTOTDiETa_01 ) : 1 );
  else
    if( getValue( eSendEnabled ) && getValue( eSendDiETa_01 ))  sendDiETa_01();
}

on Timer _totDiETa_01
{
  putValue( eTimeoutDiETa_01, 0 );
}

on envVar eDlcOnceDiETa_01
{
  if( getValue( eDlcOnceDiETa_01 ) && !(getValue( eSendEnabled ) && getValue( eSendDiETa_01 )))  setTimer( _tDiETa_01, 1 );
}

void sendDiETa_01()
{
  if( getValue(eChangeDiETa_01))
  {
     if( getValue( eDlcOnceDiETa_01 ) || getValue( eDlcWrongDiETa_01 ))
     { 
        putValue( eDlcOnceDiETa_01, 0 );
        _mDiETa_01.DLC = getValue( eDlcDiETa_01 );
     }
     else
     {
      _mDiETa_01.DLC = 8;
     }
   }
   else
   {
        _mDiETa_01.DLC = 8;
   }

   output( _mDiETa_01 );
  cancelTimer( _tDiETa_01 );
  if( getValue( eTDiETa_01 ) > 0)  setTimer( _tDiETa_01, getValue( eTDiETa_01 ) );  else  setTimer( _tDiETa_01, 1 );
}

on envVar KCAN_DiETa_Car
{
  _mDiETa_01.DiETa_Car = getValue( this );
}

on envVar KCAN_DiETa_Defrost_Taste
{
  _mDiETa_01.DiETa_Defrost_Taste = getValue(  this  );
}

on envVar KCAN_DiETa_FAS_Stufe
{
  _mDiETa_01.DiETa_FAS_Stufe = getValue(  this  );
}

on envVar KCAN_DiETa_FSH_Taste
{
  _mDiETa_01.DiETa_FSH_Taste = getValue(  this  );
}

on envVar KCAN_DiETa_HSH_Taste
{
  _mDiETa_01.DiETa_HSH_Taste = getValue(  this  );
}

on envVar KCAN_DiETa_Klima
{
  _mDiETa_01.DiETa_Klima = getValue(  this  );
}

on envVar KCAN_DiETa_Lock_Unlock_Taste
{
  _mDiETa_01.DiETa_Lock_Unlock_Taste = getValue(  this  );
}

on envVar KCAN_DiETa_Mode
{
  _mDiETa_01.DiETa_Mode = getValue(  this  );
}

on envVar KCAN_DiETa_Mode_roh
{
  _mDiETa_01.DiETa_Mode_roh = getValue(  this  );
}

on envVar KCAN_DiETa_PAO_OFF_Status
{
  _mDiETa_01.DiETa_PAO_OFF_Status = getValue(  this  );
}

on envVar KCAN_DiETa_PAO_ON_Status
{
  _mDiETa_01.DiETa_PAO_ON_Status = getValue(  this  );
}

on envVar KCAN_DiETa_Parken
{
  _mDiETa_01.DiETa_Parken = getValue(  this  );
}

on envVar KCAN_DiETa_Reserve_Byte2_4
{
  _mDiETa_01.DiETa_Reserve_Byte2_4 = getValue(  this  );
}

on envVar KCAN_DiETa_Mode2
{
  _mDiETa_01.DiETa_Mode2 = getValue(  this  );
}

on envVar KCAN_DiETa_Reserve_Byte6_3
{
  _mDiETa_01.DiETa_Reserve_Byte6_3 = getValue(  this  );
}

on envVar KCAN_DiETa_Reserve_Byte7
{
  _mDiETa_01.DiETa_Reserve_Byte7 = getValue(  this  );
}

on envVar KCAN_DiETa_Reserve_Byte8
{
  _mDiETa_01.DiETa_Reserve_Byte8 = getValue(  this  );
}

on envVar KCAN_DiETa_ResponseError
{
  _mDiETa_01.DiETa_ResponseError = getValue(  this  );
}

on envVar KCAN_DiETa_Status
{
  _mDiETa_01.DiETa_Status = getValue(  this  );
}

on envVar KCAN_DiETa_Warnblink_Taste
{
  _mDiETa_01.DiETa_Warnblink_Taste = getValue(  this  );
}

on envVar KCAN_DiETas_01_BZ
{
  _mDiETa_01.DiETas_01_BZ = getValue(  this  );
}

on envVar KCAN_DiETas_01_CRC
{
  _mDiETa_01.DiETas_01_CRC = getValue(  this  );
}

on Timer _tDimmung_01
{
    if( getValue( eTDimmung_01 ) <= 0)  putValue( eSendDimmung_01, 0 );
    if( (getValue( eSendEnabled ) && getValue( eSendDimmung_01 )) || getValue( eDlcOnceDimmung_01 ))  sendDimmung_01();
}

on envVar eSendDimmung_01
{
    if( getValue( eSendEnabled ) && getValue( eSendDimmung_01 ))  sendDimmung_01();
}

on envVar eTimeoutDimmung_01
{
    cancelTimer( _tDimmung_01 );
    cancelTimer( _totDimmung_01 );
    if( getValue( this ))
        setTimer( _totDimmung_01, (getValue( eSendEnabled ) && getValue( eSendDimmung_01 ) && (getValue( eTOTDimmung_01 ) > 0)) ? getValue( eTOTDimmung_01 ) : 1 );
    else
        if( getValue( eSendEnabled ) && getValue( eSendDimmung_01 ))  sendDimmung_01();
}

on Timer _totDimmung_01
{
    putValue( eTimeoutDimmung_01, 0 );
}

on envVar eDlcOnceDimmung_01
{
    if( getValue( eDlcOnceDimmung_01 ) && !(getValue( eSendEnabled ) && getValue( eSendDimmung_01 )))  setTimer( _tDimmung_01, 1 );
}

on Timer _tinhDimmung_01
{
    _bsiDimmung_01 = 0;
    if( _bsaiDimmung_01 && getValue( eSendEnabled ))  sendDimmung_01();
}

void sendDimmung_01()
{
    if( getValue(eChangeDimmung_01))
    {
        if( getValue( eDlcOnceDimmung_01 ) || getValue( eDlcWrongDimmung_01 ))
        {
            putValue( eDlcOnceDimmung_01, 0 );
            _mDimmung_01.DLC = getValue( eDlcDimmung_01 );
        }
        else
        {
            _mDimmung_01.DLC = 8;
        }
    }
    else
    {
        _mDimmung_01.DLC = 8;
    }

    output( _mDimmung_01 );
    cancelTimer( _tDimmung_01 );
    if( getValue( eTDimmung_01 ) > 0)  setTimer( _tDimmung_01, getValue( eTDimmung_01 ) );  else  setTimer( _tDimmung_01, 1 );
    _bsaiDimmung_01 = 0;
    _bsiDimmung_01 = 1;
    cancelTimer( _tinhDimmung_01 );  setTimer( _tinhDimmung_01, 50 );
}

Dimmung_01Changed()
{
    if( getValue( eSendEnabled ) && getValue( eSendDimmung_01 ))
        if( _bsiDimmung_01)
            _bsaiDimmung_01 = 1;
        else
            sendDimmung_01();
}

on envVar KCAN_BCM1_Stellgroesse_Kl_58s
{
    _mDimmung_01.BCM1_Stellgroesse_Kl_58s.phys = getValue( this );
    Dimmung_01Changed();
}

on envVar eDI_Display_NachtdesignS
{
    _mDimmung_01.DI_Display_Nachtdesign.phys = getValue( this );
    Dimmung_01Changed();
}

on envVar eDI_FotosensorS
{
    _mDimmung_01.DI_Fotosensor.phys = getValue( this );
    Dimmung_01Changed();
}

on envVar eDI_KL_58xdS
{
    _mDimmung_01.DI_KL_58xd.phys = getValue( this );
    Dimmung_01Changed();
}

on envVar eDI_KL_58xsS
{
    _mDimmung_01.DI_KL_58xs.phys = getValue( this );
    Dimmung_01Changed();
}

on envVar eDI_KL_58xtS
{
    _mDimmung_01.DI_KL_58xt.phys = getValue( this );
    Dimmung_01Changed();
}

// END MSG Dimmung_01

// MSG Einheiten_01

on Timer _tEinheiten_01
{
    if( getValue( eTEinheiten_01 ) <= 0)  putValue( eSendEinheiten_01, 0 );
    if( ( getValue( eSendEnabled ) && getValue( eSendEinheiten_01 )) || getValue( eDlcOnceEinheiten_01 ))  sendEinheiten_01();
}

on envVar eSendEinheiten_01
{
    if( getValue( eSendEnabled ) && getValue( eSendEinheiten_01 ))  sendEinheiten_01();
}

on envVar eTimeoutEinheiten_01
{
    cancelTimer( _tEinheiten_01 );
    cancelTimer( _totEinheiten_01 );
    if( getValue( this ))
        setTimer( _totEinheiten_01, (getValue( eSendEnabled ) && getValue( eSendEinheiten_01 ) && (getValue( eTOTEinheiten_01 ) > 0)) ? getValue( eTOTEinheiten_01 ) : 1 );
    else
        if( getValue( eSendEnabled ) && getValue( eSendEinheiten_01 ))  sendEinheiten_01();
}

on Timer _totEinheiten_01
{
    putValue( eTimeoutEinheiten_01, 0 );
}

on envVar eDlcOnceEinheiten_01
{
    if( getValue( eDlcOnceEinheiten_01 ) && !(getValue( eSendEnabled ) && getValue( eSendEinheiten_01 )))  setTimer( _tEinheiten_01, 1 );
}

on Timer _tinhEinheiten_01
{
    _bsiEinheiten_01 = 0;
    if( _bsaiEinheiten_01 && getValue( eSendEnabled ))  sendEinheiten_01();
}

void sendEinheiten_01()
{
    if( getValue(eChangeEinheiten_01))
    {
        if( getValue( eDlcOnceEinheiten_01 ) || getValue( eDlcWrongEinheiten_01 ))
        {
            putValue( eDlcOnceEinheiten_01, 0 );
            _mEinheiten_01.DLC = getValue( eDlcEinheiten_01 );
        }
        else
        {
            _mEinheiten_01.DLC = 8;
        }
    }
    else
    {
        _mEinheiten_01.DLC = 8;
    }

    output( _mEinheiten_01 );
    cancelTimer( _tEinheiten_01 );
    if( getValue( eTEinheiten_01 ) > 0)  setTimer( _tEinheiten_01, getValue( eTEinheiten_01 ) );  else  setTimer( _tEinheiten_01, 1 );
    _bsaiEinheiten_01 = 0;
    _bsiEinheiten_01 = 1;
    cancelTimer( _tinhEinheiten_01 );  setTimer( _tinhEinheiten_01, 100 );
}

Einheiten_01Changed()
{
    if( getValue( eSendEnabled ) && getValue( eSendEinheiten_01 ))
        if( _bsiEinheiten_01)
            _bsaiEinheiten_01 = 1;
        else
            sendEinheiten_01();
}

on envVar KCAN_KBI_Einheit_Datum
{
    _mEinheiten_01.KBI_Einheit_Datum = getValue( this );
    Einheiten_01Changed();
}

on envVar KCAN_KBI_Einheit_Druck
{
    _mEinheiten_01.KBI_Einheit_Druck = getValue( this );
    Einheiten_01Changed();
}

on envVar KCAN_KBI_Einheit_Masse
{
    _mEinheiten_01.KBI_Einheit_Masse = getValue( this );
    Einheiten_01Changed();
}

on envVar KCAN_KBI_Einheit_Sprache
{
    _mEinheiten_01.KBI_Einheit_Sprache = getValue( this );
    Einheiten_01Changed();
}

on envVar KCAN_KBI_Einheit_Streckenanz
{
    _mEinheiten_01.KBI_Einheit_Streckenanz = getValue( this );
    Einheiten_01Changed();
}

on envVar KCAN_KBI_Einheit_Temp
{
    _mEinheiten_01.KBI_Einheit_Temp = getValue( this );
    Einheiten_01Changed();
}

on envVar KCAN_KBI_Einheit_Uhrzeit
{
    _mEinheiten_01.KBI_Einheit_Uhrzeit = getValue( this );
    Einheiten_01Changed();
}

on envVar KCAN_KBI_Einheit_Verbrauch
{
    _mEinheiten_01.KBI_Einheit_Verbrauch = getValue( this );
    Einheiten_01Changed();
}

on envVar KCAN_KBI_Einheit_Verbrauch_elektr
{
    _mEinheiten_01.KBI_Einheit_Verbrauch_elektr = getValue( this );
    Einheiten_01Changed();
}

on envVar KCAN_KBI_Einheit_Verbrauch_Gas
{
    _mEinheiten_01.KBI_Einheit_Verbrauch_Gas = getValue( this );
    Einheiten_01Changed();
}

on envVar KCAN_KBI_Einheit_Volumen
{
    _mEinheiten_01.KBI_Einheit_Volumen = getValue( this );
    Einheiten_01Changed();
}

on envVar KCAN_KBI_MFA_v_Einheit_02
{
    _mEinheiten_01.KBI_MFA_v_Einheit_02 = getValue( this );
    Einheiten_01Changed();
}

on Timer _tELV_01
{
    if( getValue( eTELV_01 ) <= 0)  putValue( eSendELV_01, 0 );
    if( (getValue( eSendEnabled ) && getValue( eSendELV_01 )) || getValue( eDlcOnceELV_01 ))  sendELV_01();
}

on envVar eSendELV_01
{
    if( getValue( eSendEnabled ) && getValue( eSendELV_01 ))  sendELV_01();
}

on envVar eTimeoutELV_01
{
    cancelTimer( _tELV_01 );
    cancelTimer( _totELV_01 );
    if( getValue( this ))
        setTimer( _totELV_01, (getValue( eSendEnabled ) && getValue( eSendELV_01 ) && (getValue( eTOTELV_01 ) > 0)) ? getValue( eTOTELV_01 ) : 1 );
    else
        if( getValue( eSendEnabled ) && getValue( eSendELV_01 ))  sendELV_01();
}

on Timer _totELV_01
{
    putValue( eTimeoutELV_01, 0 );
}

on envVar eDlcOnceELV_01
{
    if( getValue( eDlcOnceELV_01 ) && !( getValue( eSendEnabled ) && getValue( eSendELV_01 )))  setTimer( _tELV_01, 1 );
}

on Timer _tinhELV_01
{
    _bsiELV_01 = 0;
    if( _bsaiELV_01 && getValue( eSendEnabled ))  sendELV_01();
}

void sendELV_01()
{
    if( getValue(eChangeELV_01))
    {
        if( getValue( eDlcOnceELV_01 ) || getValue( eDlcWrongELV_01 ))
        {
            putValue( eDlcOnceELV_01, 0 );
            _mELV_01.DLC = getValue( eDlcELV_01 );
        }
        else
        {
                    _mELV_01.DLC = 8;
                }
            }
            else
            {
                _mELV_01.DLC = 8;
            }

    {
        output( _mELV_01 );
    }
    cancelTimer( _tELV_01 );
    if( getValue( eTELV_01 ) > 0)  setTimer( _tELV_01, getValue( eTELV_01 ) );  else  setTimer( _tELV_01, 1 );
    _bsaiELV_01 = 0;
    _bsiELV_01 = 1;
    cancelTimer( _tinhELV_01 );  setTimer( _tinhELV_01, 50 );
}

ELV_01Changed()
{
    if( getValue( eSendEnabled ) && getValue( eSendELV_01 ))
        if( _bsiELV_01)
            _bsaiELV_01 = 1;
        else
            sendELV_01();
}

on envVar KCAN_ELV_01_Sendestatus
{
    _mELV_01.ELV_01_Sendestatus.phys = getValue( this );
    ELV_01Changed();
}

on envVar KCAN_ELV_Abbruch_Anf_Klemmenfreigabe
{
    _mELV_01.ELV_Abbruch_Anf_Klemmenfreigabe.phys = getValue( this );
    ELV_01Changed();
}

on envVar eELV_Anf_Klemme_15S
{
    putValue( KCAN_ELV_Anf_Klemme_15, getValue( this ) );
}

on envVar KCAN_ELV_Anf_Klemme_15
{
    _mELV_01.ELV_Anf_Klemme_15.phys = getValue( this );
    ELV_01Changed();
}

on envVar eELV_Anf_Klemme_50S
{
    putValue( KCAN_ELV_Anf_Klemme_50, getValue( this ) );
}

on envVar KCAN_ELV_Anf_Klemme_50
{
    _mELV_01.ELV_Anf_Klemme_50.phys = getValue( this );
    ELV_01Changed();
}

on envVar eELV_Anf_Klemme_SS
{
    putValue( KCAN_ELV_Anf_Klemme_S, getValue( this ) );
}

on envVar KCAN_ELV_Anf_Klemme_S
{
    _mELV_01.ELV_Anf_Klemme_S.phys = getValue( this );
    ELV_01Changed();
}

on envVar eELV_AnlernmodusS
{
    putValue( KCAN_ELV_Anlernmodus, getValue( this ) );
}

on envVar KCAN_ELV_Anlernmodus
{
    _mELV_01.ELV_Anlernmodus.phys = getValue( this );
    ELV_01Changed();
}

on envVar eELV_EntriegeltS
{
    putValue( KCAN_ELV_Entriegelt, getValue( this ) );
}

on envVar KCAN_ELV_Entriegelt
{
    _mELV_01.ELV_Entriegelt.phys = getValue( this );
    ELV_01Changed();
}

on envVar KCAN_ELV_Klemmenfreigabe
{
    _mELV_01.ELV_Klemmenfreigabe.phys = getValue( this );
    ELV_01Changed();
}

on envVar eELV_LebenszustandS
{
    putValue( KCAN_ELV_Lebenszustand, getValue( this ) );
}

on envVar KCAN_ELV_Lebenszustand
{
    _mELV_01.ELV_Lebenszustand.phys = getValue( this );
    ELV_01Changed();
}

on envVar eELV_LED_GelbS
{
    putValue( KCAN_ELV_LED_Gelb, getValue( this ) );
}

on envVar KCAN_ELV_LED_Gelb
{
    _mELV_01.ELV_LED_Gelb.phys = getValue( this );
    ELV_01Changed();
}

on envVar eELV_LED_RotS
{
    putValue( KCAN_ELV_LED_Rot, getValue( this ) );
}

on envVar KCAN_ELV_LED_Rot
{
    _mELV_01.ELV_LED_Rot.phys = getValue( this );
    ELV_01Changed();
}

on envVar eELV_P_VerriegeltS
{
    putValue( KCAN_ELV_P_verriegelt, getValue( this ) );
}

on envVar KCAN_ELV_P_verriegelt
{
    _mELV_01.ELV_P_verriegelt.phys = getValue( this );
    ELV_01Changed();
}

on envVar eELV_Txt_BremseS
{
    putValue( KCAN_ELV_Txt_Bremse, getValue( this ) );
}

on envVar KCAN_ELV_Txt_Bremse
{
    _mELV_01.ELV_Txt_Bremse.phys = getValue( this );
    ELV_01Changed();
}

on envVar eELV_Txt_DefektS
{
    putValue( KCAN_ELV_Txt_Defekt, getValue( this ) );
}

on envVar KCAN_ELV_Txt_Defekt
{
    _mELV_01.ELV_Txt_Defekt.phys = getValue( this );
    ELV_01Changed();
}

on envVar eELV_Txt_KupplungS
{
    putValue( KCAN_ELV_Txt_Kupplung, getValue( this ) );
}

on envVar KCAN_ELV_Txt_Kupplung
{
    _mELV_01.ELV_Txt_Kupplung.phys = getValue( this );
    ELV_01Changed();
}

on envVar eELV_Txt_Lkg_BewegenS
{
    putValue( KCAN_ELV_Txt_Lkg_Bewegen, getValue( this ) );
}

on envVar KCAN_ELV_Txt_Lkg_Bewegen
{
    _mELV_01.ELV_Txt_Lkg_Bewegen.phys = getValue( this );
    ELV_01Changed();
}

on envVar eELV_Txt_P_GangS
{
    putValue( KCAN_ELV_Txt_P_Gang, getValue( this ) );
}

on envVar KCAN_ELV_Txt_P_Gang
{
    _mELV_01.ELV_Txt_P_Gang.phys = getValue( this );
    ELV_01Changed();
}

on envVar eELV_Txt_PanikabschaltungS
{
    putValue( KCAN_ELV_Txt_Panikabschaltung, getValue( this ) );
}

on envVar KCAN_ELV_Txt_Panikabschaltung
{
    _mELV_01.ELV_Txt_Panikabschaltung.phys = getValue( this );
    ELV_01Changed();
}

on envVar eELV_Txt_PN_GangS
{
    putValue( KCAN_ELV_Txt_PN_Gang, getValue( this ) );
}

on envVar KCAN_ELV_Txt_PN_Gang
{
    _mELV_01.ELV_Txt_PN_Gang.phys = getValue( this );
    ELV_01Changed();
}

on envVar eELV_Txt_WerkstattS
{
    putValue( KCAN_ELV_Txt_Werkstatt, getValue( this ) );
}

on envVar KCAN_ELV_Txt_Werkstatt
{
    _mELV_01.ELV_Txt_Werkstatt.phys = getValue( this );
    ELV_01Changed();
}

on envVar eELV_VerriegeltS
{
    putValue( KCAN_ELV_Verriegelt, getValue( this ) );
}

on envVar KCAN_ELV_Verriegelt
{
    _mELV_01.ELV_Verriegelt.phys = getValue( this );
    ELV_01Changed();
}

on envVar eELV_ZAT_betaetigtS
{
    putValue( KCAN_ELV_ZAT_betaetigt, getValue( this ) );
}

on envVar KCAN_ELV_ZAT_betaetigt
{
    _mELV_01.ELV_ZAT_betaetigt.phys = getValue( this );
    ELV_01Changed();
}

on envVar KCAN_KST_Anf_ZV_Verriegelung_ELV_01
{
    _mELV_01.KST_Anf_ZV_Verriegelung.phys = getValue( this );
    ELV_01Changed();
}

on envVar KCAN_KST_aut_Abschaltung_Zuendung_ELV_01
{
    _mELV_01.KST_aut_Abschaltung_Zuendung.phys = getValue( this );
    ELV_01Changed();
}

on envVar eKST_Txt_KomfortabschaltungS
{
    putValue( KCAN_KST_Txt_Komfortabschaltung_ELV_01, getValue( this ) );
}

on envVar KCAN_KST_Txt_Komfortabschaltung_ELV_01
{
    _mELV_01.KST_Txt_Komfortabschaltung.phys = getValue( this );
    ELV_01Changed();
}

on envVar eKST_Unterdr_ZuendungsmeldungS
{
    putValue( KCAN_KST_Unterdr_Zuendungsmeldung_ELV_01, getValue( this ) );
}

on envVar KCAN_KST_Unterdr_Zuendungsmeldung_ELV_01
{
    _mELV_01.KST_Unterdr_Zuendungsmeldung.phys = getValue( this );
    ELV_01Changed();
}

on Timer _tELV_WFS_Anfrage
{
    if( getValue( eTELV_WFS_Anfrage ) <= 0)  putValue( eSendELV_WFS_Anfrage, 0 );
    if( (getValue( eSendEnabled ) && getValue( eSendELV_WFS_Anfrage )) || getValue( eDlcOnceELV_WFS_Anfrage ))  sendELV_WFS_Anfrage();
}

on envVar eSendELV_WFS_Anfrage
{
    if( getValue( eSendEnabled ) && getValue( eSendELV_WFS_Anfrage ))  sendELV_WFS_Anfrage();
}

on envVar eTimeoutELV_WFS_Anfrage
{
    cancelTimer( _tELV_WFS_Anfrage );
    cancelTimer( _totELV_WFS_Anfrage );
    if( getValue( this ))
        setTimer( _totELV_WFS_Anfrage, (getValue( eSendEnabled ) && getValue( eSendELV_WFS_Anfrage ) && (getValue( eTOTELV_WFS_Anfrage ) > 0)) ? getValue( eTOTELV_WFS_Anfrage ) : 1 );
    else
        if( getValue( eSendEnabled ) && getValue( eSendELV_WFS_Anfrage ))  sendELV_WFS_Anfrage();
}

on Timer _totELV_WFS_Anfrage
{
    putValue( eTimeoutELV_WFS_Anfrage, 0 );
}

on envVar eDlcOnceELV_WFS_Anfrage
{
    if( getValue( eDlcOnceELV_WFS_Anfrage ) && !(getValue( eSendEnabled ) && getValue( eSendELV_WFS_Anfrage )))  setTimer( _tELV_WFS_Anfrage, 1 );
}

void sendELV_WFS_Anfrage()
{
    if( getValue( eChangeELV_WFS_Anfrage ))
    {
        if( getValue( eDlcOnceELV_WFS_Anfrage ) || getValue( eDlcWrongELV_WFS_Anfrage ))
        {
            putValue( eDlcOnceELV_WFS_Anfrage, 0 );
            _mELV_WFS_Anfrage.DLC = getValue( eDlcELV_WFS_Anfrage );
        }
        else
        {
            _mELV_WFS_Anfrage.DLC = 8;
        }
    }
    else
    {
        _mELV_WFS_Anfrage.DLC = 8;
    }

    output( _mELV_WFS_Anfrage );
    cancelTimer( _tELV_WFS_Anfrage );
    if( getValue( eTELV_WFS_Anfrage ) > 0)  setTimer( _tELV_WFS_Anfrage, getValue( eTELV_WFS_Anfrage ) );  else  setTimer( _tELV_WFS_Anfrage, 1 );
}

void ELV_WFS_AnfrageChanged()
{
}

on envVar KCAN_ELV_WFS_Anfrage_CRC
{
    _mELV_WFS_Anfrage.ELV_WFS_Anfrage_CRC.phys = getValue( this );
    ELV_WFS_AnfrageChanged();
}

on envVar KCAN_ELV_WFS_Anfrage_Status
{
    _mELV_WFS_Anfrage.ELV_WFS_Anfrage_Status.phys = getValue( this );
    ELV_WFS_AnfrageChanged();
}

on envVar KCAN_ELV_WFS_Anfrage_Typ
{
    _mELV_WFS_Anfrage.ELV_WFS_Anfrage_Typ.phys = getValue( this );
    ELV_WFS_AnfrageChanged();
}

// END MSG ELV_WFS_Anfrage

// MSG EmpfEinheit_STSG_HBFS_01

//END MSG EmpfEinheit_STSG_HBFS_01

// MSG EmpfEinheit_STSG_HFS_01

//END MSG EmpfEinheit_STSG_HFS_01

// MSG GRA_ACC_01

// END MSG GRA_ACC_01

on Timer _tHSP_01
{
    if( getValue( eTHSP_01 ) <= 0)  putValue( eSendHSP_01, 0 );
    if( (getValue( eSendEnabled ) && getValue( eSendHSP_01 )) || getValue( eDlcOnceHSP_01 ))  sendHSP_01();
}

on envVar eSendHSP_01
{
    if( getValue( eSendEnabled ) && getValue( eSendHSP_01 ))  sendHSP_01();
}

on envVar eTimeoutHSP_01
{
    cancelTimer( _tHSP_01 );
    cancelTimer( _totHSP_01 );
    if( getValue( this ))
        setTimer( _totHSP_01, (getValue( eSendEnabled ) && getValue( eSendHSP_01 ) && (getValue( eTOTHSP_01 ) > 0)) ? getValue( eTOTHSP_01 ) : 1 );
    else
        if( getValue( eSendEnabled ) && getValue( eSendHSP_01 ))  sendHSP_01();
}

on Timer _totHSP_01
{
    putValue( eTimeoutHSP_01, 0 );
}

on envVar eDlcOnceHSP_01
{
    if( getValue( eDlcOnceHSP_01 ) && !(getValue( eSendEnabled ) && getValue( eSendHSP_01 )))  setTimer( _tHSP_01, 1 );
}

void sendHSP_01()
{
  if( getValue(eChangeHSP_01))
  {
    if( getValue( eDlcOnceHSP_01 ) || getValue( eDlcWrongHSP_01 ))
    {
        putValue( eDlcOnceHSP_01, 0 );
    }
  }
  else

  cancelTimer( _tHSP_01 );
  if( getValue( eTHSP_01 ) > 0)  setTimer( _tHSP_01, getValue( eTHSP_01 ) );  else  setTimer( _tHSP_01, 1 );
}

on envVar eHSP_Warnung_Text
{
}

// MSG HDSG_01

//END MSG HDSG_01

// MSG Innenlicht_11


//END MSG Innenlicht_11

// MSG Kessy_03


//END MSG Kessy_03


// MSG Kessy_04
on Timer _tKessy_04
{
    if( getValue( eTKessy_04 ) <= 0)  putValue( eSendKessy_04, 0 );
    if( ( getValue( eSendEnabled ) && getValue( eSendKessy_04 )) || getValue( eDlcOnceKessy_04 ))  sendKessy_04();
}

on envVar eSendKessy_04
{
    if( getValue( eSendEnabled ) && getValue( eSendKessy_04 ))  sendKessy_04();
}

on envVar eTimeoutKessy_04
{
    cancelTimer( _tKessy_04 );
    cancelTimer( _totKessy_04 );
    if( getValue( this ))
        setTimer( _totKessy_04, (getValue( eSendEnabled ) && getValue( eSendKessy_04 ) && (getValue( eTOTKessy_04 ) > 0)) ? getValue( eTOTKessy_04 ) : 1 );
    else
        if( getValue( eSendEnabled ) && getValue( eSendKessy_04 ))  sendKessy_04();
}

on Timer _totKessy_04
{
    putValue( eTimeoutKessy_04, 0 );
}

on envVar eDlcOnceKessy_04
{
    if( getValue( eDlcOnceKessy_04 ) && !(getValue( eSendEnabled ) && getValue( eSendKessy_04 )))  setTimer( _tKessy_04, 1 );
}

on Timer _tinhKessy_04
{
    _bsiKessy_04 = 0;
    if( _bsaiKessy_04 && getValue( eSendEnabled ))  sendKessy_04();
}

void sendKessy_04()
{
    if( getValue(eChangeKessy_04))
    {
        if( getValue( eDlcOnceKessy_04 ) || getValue( eDlcWrongKessy_04 ))
        {
            putValue( eDlcOnceKessy_04, 0 );
            _mKessy_04.DLC = getValue( eDlcKessy_04 );
        }
        else
        {
            _mKessy_04.DLC = 8;
        }
    }
    else
    {
        _mKessy_04.DLC = 8;
    }

    output( _mKessy_04 );
    cancelTimer( _tKessy_04 );
    if( getValue( eTKessy_04 ) > 0)  setTimer( _tKessy_04, getValue( eTKessy_04 ) );  else  setTimer( _tKessy_04, 1 );
    _bsaiKessy_04 = 0;
    _bsiKessy_04 = 1;
    cancelTimer( _tinhKessy_04 );  setTimer( _tinhKessy_04, 20 );
}

Kessy_04Changed()
{
    if( getValue( eSendEnabled ) && getValue( eSendKessy_04 ))
        if( _bsiKessy_04)
            _bsaiKessy_04 = 1;
        else
            sendKessy_04();
}

on envVar eKY_Aktive_LFScansS
{
    _mKessy_04.KY_Aktive_LFScans.phys = getValue( this );
    Kessy_04Changed();
}

on envVar eKY_AnzKoord_InfoS
{
    _mKessy_04.KY_AnzKoord_Info.phys = getValue( this );
    Kessy_04Changed();
}

on envVar eKY_EasyClose_AbbruchS
{
    _mKessy_04.KY_EasyClose_Abbruch.phys = getValue( this );
    Kessy_04Changed();
}

on envVar eKY_EasyClose_StatusS
{
    _mKessy_04.KY_EasyClose_Status.phys = getValue( this );
    Kessy_04Changed();
}

on envVar eKY_Fzg_Verlassen_erkanntS
{
    _mKessy_04.KY_Fzg_Verlassen_erkannt.phys = getValue( this );
    Kessy_04Changed();
}

on envVar eKY_Fzg_Zugang_erkanntS
{
    _mKessy_04.KY_Fzg_Zugang_erkannt.phys = getValue( this );
    Kessy_04Changed();
}

on envVar eKY_Gestik_HDS
{
    _mKessy_04.KY_Gestik_HD.phys = getValue( this );
    Kessy_04Changed();
}

on envVar eKY_Gong_600S
{
    _mKessy_04.KY_Gong_600.phys = getValue( this );
    Kessy_04Changed();
}

on envVar eKY_HD_AuffahrtS
{
    _mKessy_04.KY_HD_Auffahrt.phys = getValue( this );
    Kessy_04Changed();
}

on envVar eKY_HD_ZufahrtS
{
    _mKessy_04.KY_HD_Zufahrt.phys = getValue( this );
    Kessy_04Changed();
}

on envVar eKY_ID_Geber_SucheS
{
    _mKessy_04.KY_ID_Geber_Suche.phys = getValue( this );
    Kessy_04Changed();
}

on envVar eKY_ID_Geber1_im_FzgS
{
    _mKessy_04.KY_ID_Geber1_im_Fzg.phys = getValue( this );
    Kessy_04Changed();
}

on envVar eKY_ID_Geber2_im_FzgS
{
    _mKessy_04.KY_ID_Geber2_im_Fzg.phys = getValue( this );
    Kessy_04Changed();
}

on envVar eKY_ID_Geber3_im_FzgS
{
    _mKessy_04.KY_ID_Geber3_im_Fzg.phys = getValue( this );
    Kessy_04Changed();
}

on envVar eKY_ID_Geber4_im_FzgS
{
    _mKessy_04.KY_ID_Geber4_im_Fzg.phys = getValue( this );
    Kessy_04Changed();
}

on envVar eKY_LF_AktivS
{
    _mKessy_04.KY_LF_Aktiv.phys = getValue( this );
    Kessy_04Changed();
}

on envVar eKY_MeldungenS
{
    _mKessy_04.KY_Meldungen.phys = getValue( this );
    Kessy_04Changed();
}

on envVar eKY_Passiv_AutolockS
{
    _mKessy_04.KY_Passiv_Autolock.phys = getValue( this );
    Kessy_04Changed();
}

on envVar eKY_Passiv_Autolock_AktS
{
    _mKessy_04.KY_Passiv_Autolock_Akt.phys = getValue( this );
    Kessy_04Changed();
}

on envVar eKY_Passiv_Autolock_MenueS
{
    _mKessy_04.KY_Passiv_Autolock_Menue.phys = getValue( this );
    Kessy_04Changed();
}

on envVar eKY_Passiv_AutounlockS
{
    _mKessy_04.KY_Passiv_Autounlock.phys = getValue( this );
    Kessy_04Changed();
}

on envVar eKY_Startknopf_BelS
{
    _mKessy_04.KY_Startknopf_Bel.phys = getValue( this );
    Kessy_04Changed();
}

on envVar eKY_StartStopp_InfoS
{
    _mKessy_04.KY_StartStopp_Info.phys = getValue( this );
    Kessy_04Changed();
}

//END MSG Kessy_04

//MSG Klemmen_Status_01

on Timer _tKlemmen_Status_01
{
    if( getValue( eTKlemmen_Status_01 ) <= 0)  putValue( eSendKlemmen_Status_01, 0 );
    if( (getValue( eSendEnabled ) && getValue( eSendKlemmen_Status_01 )) || getValue( eDlcOnceKlemmen_Status_01 ))  sendKlemmen_Status_01();
}

on envVar eSendKlemmen_Status_01
{
    if( getValue( eSendEnabled ) && getValue( eSendKlemmen_Status_01 ))  sendKlemmen_Status_01();
}

on envVar eTimeoutKlemmen_Status_01
{
    cancelTimer( _tKlemmen_Status_01 );
    cancelTimer( _totKlemmen_Status_01 );
    if( getValue( this ))
        setTimer( _totKlemmen_Status_01, (getValue( eSendEnabled ) && getValue( eSendKlemmen_Status_01 ) && (getValue( eTOTKlemmen_Status_01 ) > 0)) ? getValue( eTOTKlemmen_Status_01 ) : 1 );
    else
        if( getValue( eSendEnabled ) && getValue( eSendKlemmen_Status_01 ))  sendKlemmen_Status_01();
}

on Timer _totKlemmen_Status_01
{
    putValue( eTimeoutKlemmen_Status_01, 0 );
}

on envVar eDlcOnceKlemmen_Status_01
{
    if( getValue( eDlcOnceKlemmen_Status_01 ) && !(getValue( eSendEnabled ) && getValue( eSendKlemmen_Status_01 )))  setTimer( _tKlemmen_Status_01, 1 );
}

on Timer _tinhKlemmen_Status_01
{
    _bsiKlemmen_Status_01 = 0;
    if( _bsaiKlemmen_Status_01 && getValue( eSendEnabled ))  sendKlemmen_Status_01();
}

void sendKlemmen_Status_01()
{
    byte crc;
    dword bz;

    if( getValue(eChangeKlemmen_Status_01))
    {
        if( getValue( eDlcOnceKlemmen_Status_01 ) || getValue( eDlcWrongKlemmen_Status_01 ))
        {
            putValue( eDlcOnceKlemmen_Status_01, 0 );
            _mKlemmen_Status_01.DLC = getValue( eDlcKlemmen_Status_01 );
        }
        else
        {
            _mKlemmen_Status_01.DLC = 4;
        }

        crc = getCRC8( _mKlemmen_Status_01, _s_pdu_codeKlemmen_Status_01 );
        _mKlemmen_Status_01.Klemmen_Status_01_CRC = crc ^ (1 - getValue( eCrcKlemmen_Status_01 ));

        if( getValue( eBZKlemmen_Status_01 ))
        {
            bz = getValue( eKlemmen_Status_01_BZS );
            bz = bz + getValue( eBZStepKlemmen_Status_01 );
            putValue( eKlemmen_Status_01_BZS, bz % 16 );
        }
    }
    else
    {
        _mKlemmen_Status_01.DLC = 4;

        crc = getCRC8( _mKlemmen_Status_01, _s_pdu_codeKlemmen_Status_01 );
        _mKlemmen_Status_01.Klemmen_Status_01_CRC = crc ^ (1 - getValue( eCrcKlemmen_Status_01 ));

        bz = getValue( eKlemmen_Status_01_BZS ) + 1;
        putValue( eKlemmen_Status_01_BZS, bz % 16 );
    }
    output( _mKlemmen_Status_01 );

    cancelTimer( _tKlemmen_Status_01 );
    if( getValue( eTKlemmen_Status_01 ) > 0)  setTimer( _tKlemmen_Status_01, getValue( eTKlemmen_Status_01 ) );  else  setTimer( _tKlemmen_Status_01, 1 );
    _bsaiKlemmen_Status_01 = 0;
    _bsiKlemmen_Status_01 = 1;
    cancelTimer( _tinhKlemmen_Status_01 );  setTimer( _tinhKlemmen_Status_01, 10 );
}

Klemmen_Status_01Changed()
{
    if( getValue( eSendEnabled ) && getValue( eSendKlemmen_Status_01 ))
        if( _bsiKlemmen_Status_01)
            _bsaiKlemmen_Status_01 = 1;
        else
            sendKlemmen_Status_01();
}

on envVar KCAN_BCM_Ausparken_Betrieb
{
    _mKlemmen_Status_01.BCM_Ausparken_Betrieb.phys = getValue( this );
    Klemmen_Status_01Changed();
}

on envVar KCAN_BCM_Remotestart_Betrieb
{
    _mKlemmen_Status_01.BCM_Remotestart_Betrieb.phys = getValue( this );
    Klemmen_Status_01Changed();
}

on envVar eBCM_Remotestart_KL15_AnfS
{
    putValue( KCAN_BCM_Remotestart_KL15_Anf, getValue( this ) );
}

on envVar KCAN_BCM_Remotestart_KL15_Anf
{
    _mKlemmen_Status_01.BCM_Remotestart_KL15_Anf.phys = getValue( this );
    Klemmen_Status_01Changed();
}

on envVar KCAN_BCM_Remotestart_MO_Start
{
    _mKlemmen_Status_01.BCM_Remotestart_MO_Start.phys = getValue( this );
    Klemmen_Status_01Changed();
}

on envVar eKST_Fahrerhinweis_1S
{
    putValue( KCAN_KST_Fahrerhinweis_1, getValue( this ) );
}

on envVar KCAN_KST_Fahrerhinweis_1
{
    _mKlemmen_Status_01.KST_Fahrerhinweis_1.phys = getValue( this );
    Klemmen_Status_01Changed();
}

on envVar eKST_Fahrerhinweis_2S
{
    putValue( KCAN_KST_Fahrerhinweis_2, getValue( this ) );
}

on envVar KCAN_KST_Fahrerhinweis_2
{
    _mKlemmen_Status_01.KST_Fahrerhinweis_2.phys = getValue( this );
    Klemmen_Status_01Changed();
}

on envVar KCAN_KST_Fahrerhinweis_4
{
    _mKlemmen_Status_01.KST_Fahrerhinweis_4.phys = getValue( this );
    Klemmen_Status_01Changed();
}

on envVar eKST_Fahrerhinweis_5S
{
    putValue( KCAN_KST_Fahrerhinweis_5, getValue( this ) );
}

on envVar KCAN_KST_Fahrerhinweis_5
{
    _mKlemmen_Status_01.KST_Fahrerhinweis_5.phys = getValue( this );
    Klemmen_Status_01Changed();
}

on envVar eKST_Fahrerhinweis_6S
{
    putValue( KCAN_KST_Fahrerhinweis_6, getValue( this ) );
}

on envVar KCAN_KST_Fahrerhinweis_6
{
    _mKlemmen_Status_01.KST_Fahrerhinweis_6.phys = getValue( this );
    Klemmen_Status_01Changed();
}

on envVar KCAN_KST_Warn_P1_ZST_def
{
    _mKlemmen_Status_01.KST_Warn_P1_ZST_def.phys = getValue( this );
    Klemmen_Status_01Changed();
}

on envVar eKST_Warn_P2_ZST_def
{
    putValue( KCAN_KST_Warn_P2_ZST_def, getValue( this ) );
}

on envVar KCAN_KST_Warn_P2_ZST_def
{
    _mKlemmen_Status_01.KST_Warn_P2_ZST_def.phys = getValue( this );
    Klemmen_Status_01Changed();
}

on envVar eRSt_FahrerhinweiseS
{
    putValue( KCAN_RSt_Fahrerhinweise, getValue( this ) );
}

on envVar KCAN_RSt_Fahrerhinweise
{
    _mKlemmen_Status_01.RSt_Fahrerhinweise.phys = getValue( this );
    Klemmen_Status_01Changed();
}

on envVar eZAS_Kl_15S
{
    putValue( KCAN_ZAS_Kl_15, getValue( this ) );
}

on envVar KCAN_ZAS_Kl_15
{
    _mKlemmen_Status_01.ZAS_Kl_15.phys = getValue( this );

    if( getValue(this))
    {
        if( getValue(eMFL_LSS_switch) == 1)
        {
            putValue(eSendAtOnceMFL_Tasten_Kon_01, 1);
            putValue (eModeSwitchStatus, "Current Mode is MFL");
        }
        else
        {
            putValue (eModeSwitchStatus, "Current Mode is LSS");
        }
    }
    Klemmen_Status_01Changed();
}

on envVar eZAS_Kl_50_StartanforderungS
{
    putValue( KCAN_ZAS_Kl_50_Startanforderung, getValue( this ) );
}

on envVar KCAN_ZAS_Kl_50_Startanforderung
{
    _mKlemmen_Status_01.ZAS_Kl_50_Startanforderung.phys = getValue( this );
    Klemmen_Status_01Changed();
}

on envVar KCAN_ZAS_Kl_Infotainment
{
    _mKlemmen_Status_01.ZAS_Kl_Infotainment.phys = getValue( this );
    Klemmen_Status_01Changed();
}

on envVar eZAS_Kl_SS
{
    putValue( KCAN_ZAS_Kl_S, getValue( this ) );
}

on envVar KCAN_ZAS_Kl_S
{
    _mKlemmen_Status_01.ZAS_Kl_S.phys = getValue( this );
    Klemmen_Status_01Changed();
}

on envVar eZAS_Kl_XS
{
    putValue( KCAN_ZAS_Kl_X, getValue( this ) );
}

on envVar KCAN_ZAS_Kl_X
{
    _mKlemmen_Status_01.ZAS_Kl_X.phys = getValue( this );
    Klemmen_Status_01Changed();
}

//END MSG Klemmen_Status_01

// MSG Klemmen_Status_02

on Timer _tKlemmen_Status_02
{
    if( getValue( eTKlemmen_Status_02 ) <= 0)  putValue( eSendKlemmen_Status_02, 0 );
    if( ( getValue( eSendEnabled ) && getValue( eSendKlemmen_Status_02 )) || getValue( eDlcOnceKlemmen_Status_02 ))  sendKlemmen_Status_02();
}

on envVar eSendKlemmen_Status_02
{
    if( getValue( eSendEnabled ) && getValue( eSendKlemmen_Status_02 ))  sendKlemmen_Status_02();
}

on envVar eTimeoutKlemmen_Status_02
{
    cancelTimer( _tKlemmen_Status_02 );
    cancelTimer( _totKlemmen_Status_02 );
    if( getValue( this ))
        setTimer( _totKlemmen_Status_02, (getValue( eSendEnabled ) && getValue( eSendKlemmen_Status_02 ) && (getValue( eTOTKlemmen_Status_02 ) > 0)) ? getValue( eTOTKlemmen_Status_02 ) : 1 );
    else
        if( getValue( eSendEnabled ) && getValue( eSendKlemmen_Status_02 ))  sendKlemmen_Status_02();
}

on Timer _totKlemmen_Status_02
{
    putValue( eTimeoutKlemmen_Status_02, 0 );
}

on envVar eDlcOnceKlemmen_Status_02
{
    if( getValue( eDlcOnceKlemmen_Status_02 ) && !(getValue( eSendEnabled ) && getValue( eSendKlemmen_Status_02 )))  setTimer( _tKlemmen_Status_02, 1 );
}

on Timer _tinhKlemmen_Status_02
{
    _bsiKlemmen_Status_02 = 0;
    if( _bsaiKlemmen_Status_02 && getValue( eSendEnabled ))  sendKlemmen_Status_02();
}

void sendKlemmen_Status_02()
{
    if( getValue(eChangeKlemmen_Status_02))
    {
        if( getValue( eDlcOnceKlemmen_Status_02 ) || getValue( eDlcWrongKlemmen_Status_02 ))
        {
        putValue( eDlcOnceKlemmen_Status_02, 0 );
        _mKlemmen_Status_02.DLC = getValue( eDlcKlemmen_Status_02 );
    }
    else
    {
        _mKlemmen_Status_02.DLC = 8;
    }
  }
  else
  {
    _mKlemmen_Status_02.DLC = 8;
  }

  output( _mKlemmen_Status_02 );
  cancelTimer( _tKlemmen_Status_02 );
  if( getValue( eTKlemmen_Status_02 ) > 0)  setTimer( _tKlemmen_Status_02, getValue( eTKlemmen_Status_02 ) );  else  setTimer( _tKlemmen_Status_02, 1 );
  _bsaiKlemmen_Status_02 = 0;
  _bsiKlemmen_Status_02 = 1;
  cancelTimer( _tinhKlemmen_Status_02 );  setTimer( _tinhKlemmen_Status_02, 100 );
}

byte isKlemmen_Status_02Active()
{
  
//  if( getValue( eKST_Sonderzustand_AnforderungS ) != 0)  return 1;
  
 // if( getValue( eKST_Sonderzustand_StatusS ) != 0)  return 1;
  
 // if( getValue( eKST_WFS_Fahrfreigabe_AnforderungS ) != 0)  return 1;
  
  return 0;
}

Klemmen_Status_02Changed()
{
  _bKlemmen_Status_02Active = isKlemmen_Status_02Active();
  if( getValue( eSendEnabled ) && getValue( eSendKlemmen_Status_02 ))
    if( _bsiKlemmen_Status_02)
      _bsaiKlemmen_Status_02 = 1;
    else
      sendKlemmen_Status_02();
}

on envVar KCAN_KST_Sonderzustand_Anforderung
{
  _mKlemmen_Status_02.KST_Sonderzustand_Anforderung = getValue( this );
   Klemmen_Status_02Changed();
}

on envVar KCAN_KST_Sonderzustand_Status
{
  _mKlemmen_Status_02.KST_Sonderzustand_Status = getValue( this );
   Klemmen_Status_02Changed();
}

on envVar KCAN_KST_WFS_Fahrfreigabe_Anforderung
{
  _mKlemmen_Status_02.KST_WFS_Fahrfreigabe_Anforderung = getValue( this );
   Klemmen_Status_02Changed();
}

//END MSG Klemmen_Status_02


// MSG Klemmen_Steuerung_01 this msg has delay time but is implemented without so i commented changed function
on Timer _tKlemmen_Steuerung_01
{
    if( getValue( eTKlemmen_Steuerung_01 ) <= 0)  putValue( eSendKlemmen_Steuerung_01, 0 );
    if( (getValue( eSendEnabled ) && getValue( eSendKlemmen_Steuerung_01 )) || getValue( eDlcOnceKlemmen_Steuerung_01 ))  sendKlemmen_Steuerung_01();
}

on envVar eSendKlemmen_Steuerung_01
{
    if( getValue( eSendEnabled ) && getValue( eSendKlemmen_Steuerung_01 ))  sendKlemmen_Steuerung_01();
}

on envVar eTimeoutKlemmen_Steuerung_01
{
    cancelTimer( _tKlemmen_Steuerung_01 );
    cancelTimer( _totKlemmen_Steuerung_01 );
    if( getValue( this ))
        setTimer( _totKlemmen_Steuerung_01, (getValue( eSendEnabled ) && getValue( eSendKlemmen_Steuerung_01 ) && (getValue( eTOTKlemmen_Steuerung_01 ) > 0)) ? getValue( eTOTKlemmen_Steuerung_01 ) : 1 );
    else
        if( getValue( eSendEnabled ) && getValue( eSendKlemmen_Steuerung_01 ))  sendKlemmen_Steuerung_01();
}

on Timer _totKlemmen_Steuerung_01
{
    putValue( eTimeoutKlemmen_Steuerung_01, 0 );
}

on envVar eDlcOnceKlemmen_Steuerung_01
{
    if( getValue( eDlcOnceKlemmen_Steuerung_01 ) && !( getValue( eSendEnabled ) && getValue( eSendKlemmen_Steuerung_01 )))  setTimer( _tKlemmen_Steuerung_01, 1 );
}

void sendKlemmen_Steuerung_01()
{
    if( getValue(eChangeKlemmen_Steuerung_01))
    {
        if( getValue( eDlcOnceKlemmen_Steuerung_01 ) || getValue( eDlcWrongKlemmen_Steuerung_01 ))
        {
            putValue( eDlcOnceKlemmen_Steuerung_01, 0 );
            _mKlemmen_Steuerung_01.DLC = getValue( eDlcKlemmen_Steuerung_01 );
        }
        else
        {
                    _mKlemmen_Steuerung_01.DLC = 8;
                }
            }
            else
            {
                _mKlemmen_Steuerung_01.DLC = 8;
            }
    {
        output( _mKlemmen_Steuerung_01 );
    }
    cancelTimer( _tKlemmen_Steuerung_01 );
    if( getValue( eTKlemmen_Steuerung_01 ) > 0)  setTimer( _tKlemmen_Steuerung_01, getValue( eTKlemmen_Steuerung_01 ) );  else  setTimer( _tKlemmen_Steuerung_01, 1 );
}

Klemmen_Steuerung_01Changed()
{
}

on envVar KCAN_KST_Anf_Klemme_15
{
    _mKlemmen_Steuerung_01.KST_Anf_Klemme_15.phys = getValue( this );
    Klemmen_Steuerung_01Changed();
}

on envVar KCAN_KST_Anf_Klemme_50
{
    _mKlemmen_Steuerung_01.KST_Anf_Klemme_50.phys = getValue( this );
    Klemmen_Steuerung_01Changed();
}

on envVar KCAN_KST_Anf_Klemme_S
{
    _mKlemmen_Steuerung_01.KST_Anf_Klemme_S.phys = getValue( this );
    Klemmen_Steuerung_01Changed();
}

on envVar KCAN_KST_Anf_Klemmenfreigabe_ELV
{
    _mKlemmen_Steuerung_01.KST_Anf_Klemmenfreigabe_ELV.phys = getValue( this );
    Klemmen_Steuerung_01Changed();
}

on envVar KCAN_KST_Anf_Klemmenfreigabe_WFS
{
    _mKlemmen_Steuerung_01.KST_Anf_Klemmenfreigabe_WFS.phys = getValue( this );
    Klemmen_Steuerung_01Changed();
}

on envVar KCAN_KST_Anf_ZV_Verriegelung_Klemmen_Steuerung_01
{
    _mKlemmen_Steuerung_01.KST_Anf_ZV_Verriegelung.phys = getValue( this );
    Klemmen_Steuerung_01Changed();
}

on envVar KCAN_KST_aut_Abschaltung_Zuendung_Klemmen_Steuerung_01
{
    _mKlemmen_Steuerung_01.KST_aut_Abschaltung_Zuendung.phys = getValue( this );
    Klemmen_Steuerung_01Changed();
}

on envVar eKST_Txt_Komfortabschaltung_Klemmen_Steuerung_01S
{
    putValue( KCAN_KST_Txt_Komfortabschaltung_Klemmen_Steuerung_01, getValue( this ) );
}

on envVar KCAN_KST_Txt_Komfortabschaltung_Klemmen_Steuerung_01
{
    _mKlemmen_Steuerung_01.KST_Txt_Komfortabschaltung.phys = getValue( this );
    Klemmen_Steuerung_01Changed();
}

on envVar eKST_Txt_P_GangS
{
    putValue( KCAN_KST_Txt_P_Gang, getValue( this ) );
}

on envVar KCAN_KST_Txt_P_Gang
{
    _mKlemmen_Steuerung_01.KST_Txt_P_Gang.phys = getValue( this );
    Klemmen_Steuerung_01Changed();
}

on envVar eKST_Txt_PanikabschaltungS
{
    putValue( KCAN_KST_Txt_Panikabschaltung, getValue( this ) );
}

on envVar KCAN_KST_Txt_Panikabschaltung
{
    _mKlemmen_Steuerung_01.KST_Txt_Panikabschaltung.phys = getValue( this );
    Klemmen_Steuerung_01Changed();
}

on envVar eKST_Txt_WerkstattS
{
    putValue( KCAN_KST_Txt_Werkstatt, getValue( this ) );
}

on envVar KCAN_KST_Txt_Werkstatt
{
    _mKlemmen_Steuerung_01.KST_Txt_Werkstatt.phys = getValue( this );
    Klemmen_Steuerung_01Changed();
}

on envVar eKST_Unterdr_Zuendungsmeldung_Klemmen_Steuerung_01S
{
    putValue( KCAN_KST_Unterdr_Zuendungsmeldung_Klemmen_Steuerung_01, getValue( this ) );
}

on envVar KCAN_KST_Unterdr_Zuendungsmeldung_Klemmen_Steuerung_01
{
    _mKlemmen_Steuerung_01.KST_Unterdr_Zuendungsmeldung.phys = getValue( this );
    Klemmen_Steuerung_01Changed();
}

on envVar eKST_ZAT_betaetigtS
{
    putValue( KCAN_KST_ZAT_betaetigt, getValue( this ) );
}

on envVar KCAN_KST_ZAT_betaetigt
{
    _mKlemmen_Steuerung_01.KST_ZAT_betaetigt.phys = getValue( this );
    Klemmen_Steuerung_01Changed();
}

on envVar eKST_ZuendungswarnungS
{
    _mKlemmen_Steuerung_01.KST_Zuendungswarnung.phys = getValue(this);
    Klemmen_Steuerung_01Changed();
}

on envVar KCAN_Relais_VoKo_angesteuert
{
    _mKlemmen_Steuerung_01.Relais_VoKo_angesteuert = getValue( this );
    Klemmen_Steuerung_01Changed();
}

on envVar KCAN_RSt_Anforderung_HMS
{
    _mKlemmen_Steuerung_01.RSt_Anforderung_HMS = getValue( this );
    Klemmen_Steuerung_01Changed();
}

//END MSG Klemmen_Steuerung_01

// MSG Klima_03
//    Klima_03 -->  message_Klima_03.cin
//END MSG Klima_03//

// MSG Klima_06
//    Klima_06 -->  message_Klima_06.cin
//END MSG Klima_06//

// MSG Klima_11

// END MSG Klima_11

// MSG Klima_12
//    Klima_12 -->  message_Klima_12.cin
//END MSG Klima_12

// MSG Klima_16
//    Klima_16 -->  message_Klima_16.cin
//END MSG Klima_16

// MSG Klima_EV_03

// END MSG Klima_EV_03

// MSG Klima_EV_04

// END MSG Klima_EV_04
// MSG Klima_EV_05

// END MSG Klima_EV_05
// MSG Klima_EV_06

// END MSG Klima_EV_06
// MSG Klima_hinten_04


//END MSG Klima_hinten_04
// MSG Klima_SDA_01

// END MSG Klima_SDA_01

// MSG Klima_Sensor_01

// END MSG Klima_Sensor_01

// MSG Klima_Sensor_02

on Timer _tKlima_Sensor_02
{
    if( getValue( eTKlima_Sensor_02 ) <= 0)  putValue( eSendKlima_Sensor_02, 0 );
    if( (getValue( eSendEnabled ) && getValue( eSendKlima_Sensor_02 )) || getValue( eDlcOnceKlima_Sensor_02 ))  sendKlima_Sensor_02();
}

on envVar eSendKlima_Sensor_02
{
    if( getValue( eSendEnabled ) && getValue( eSendKlima_Sensor_02 ))  sendKlima_Sensor_02();
}

on envVar eTimeoutKlima_Sensor_02
{
    cancelTimer( _tKlima_Sensor_02 );
    cancelTimer( _totKlima_Sensor_02 );
    if( getValue( this ))
        setTimer( _totKlima_Sensor_02, (getValue( eSendEnabled ) && getValue( eSendKlima_Sensor_02 ) && (getValue( eTOTKlima_Sensor_02 ) > 0)) ? getValue( eTOTKlima_Sensor_02 ) : 1 );
    else
        if( getValue( eSendEnabled ) && getValue( eSendKlima_Sensor_02 ))  sendKlima_Sensor_02();
}

on Timer _totKlima_Sensor_02
{
    putValue( eTimeoutKlima_Sensor_02, 0 );
}

on envVar eDlcOnceKlima_Sensor_02
{
    if( getValue( eDlcOnceKlima_Sensor_02 ) && !(getValue( eSendEnabled ) && getValue( eSendKlima_Sensor_02 )))  setTimer( _tKlima_Sensor_02, 1 );
}

void sendKlima_Sensor_02()
{
    if( getValue( eChangeKlima_Sensor_02 ))
    {
        if( getValue( eDlcOnceKlima_Sensor_02 ) || getValue( eDlcWrongKlima_Sensor_02 ))
        {
            putValue( eDlcOnceKlima_Sensor_02, 0 );
            _mKlima_Sensor_02.DLC = getValue( eDlcKlima_Sensor_02 );
        }
        else
        {
            _mKlima_Sensor_02.DLC = 8;
        }
    }
    else
    {
        _mKlima_Sensor_02.DLC = 8;
    }

    output( _mKlima_Sensor_02 );
    cancelTimer( _tKlima_Sensor_02 );
    if( getValue( eTKlima_Sensor_02 ) > 0)  setTimer( _tKlima_Sensor_02, getValue( eTKlima_Sensor_02 ) );  else  setTimer( _tKlima_Sensor_02, 1 );
}

Klima_Sensor_02Changed()
{
}

on envVar eBCM1_Aussen_Temp_ungefS
{
    _mKlima_Sensor_02.BCM1_Aussen_Temp_ungef.phys = getValue( this );
    Klima_Sensor_02Changed();
}

on envVar eBCM1_FStatus_Aussentemp_ungefS
{
    _mKlima_Sensor_02.BCM1_FStatus_Aussentemp_ungef.phys = getValue( this );
    Klima_Sensor_02Changed();
}

on envVar eBCM1_OBD_FStatus_ATempS
{
    _mKlima_Sensor_02.BCM1_OBD_FStatus_ATemp.phys = getValue( this );
    Klima_Sensor_02Changed();
}

//END MSG Klima_Sensor_02

// MSG Klima_Sensor_03

// END MSG Klima_Sensor_03

// MSG Klima_Sensor_04

// END MSG Klima_Sensor_04


// MSG Kombi_HUD_01
on envVar eHUD_FAS_Anzeige_KombiS
{
    _mHUD_01.HUD_FAS_Anzeige_Kombi.phys = getValue(eHUD_FAS_Anzeige_KombiS);
}

on envVar eHUD_KDK_Anzeige_KombiS
{
    _mHUD_01.HUD_KDK_Anzeige_Kombi.phys = getValue(eHUD_KDK_Anzeige_KombiS);
}

on envVar eHUD_PEA_Anzeige_KombiS
{
    _mHUD_01.HUD_PEA_Anzeige_Kombi.phys = getValue(eHUD_PEA_Anzeige_KombiS);
}

on envVar eHUD_VZE_AIO_Anzeige_KombiS
{
    _mHUD_01.HUD_VZE_AIO_Anzeige_Kombi.phys = getValue(eHUD_VZE_AIO_Anzeige_KombiS);
}

on Timer _tHUD_01
{
  if( getValue( eTHUD_01 ) <= 0)  putValue( eSendHUD_01, 0 );
  if( (getValue( eSendEnabled ) && getValue( eSendHUD_01 )) || getValue( eDlcOnceHUD_01 ))  sendHUD_01();
}

on Timer _totHUD_01
{
  putValue( eTimeoutHUD_01, 0 );
}

void sendHUD_01()
{
  if( getValue(eChangeHUD_01))
  {    
    if( getValue( eDlcOnceHUD_01 ) || getValue( eDlcWrongHUD_01 ))
    {
        putValue( eDlcOnceHUD_01, 0 );
        _mHUD_01.DLC = getValue( eDlcHUD_01 );
    } 
    else
    {        
        _mHUD_01.DLC = 8;
    }   
  }
  else
  { 
    _mHUD_01.DLC = 8;
  }
  output( _mHUD_01 );
  cancelTimer( _tHUD_01 );
  if( getValue( eTHUD_01 ) > 0)  setTimer( _tHUD_01, getValue( eTHUD_01 ) );  else  setTimer( _tHUD_01, 1 );
}

on envVar eSendHUD_01
{
  if( getValue( eSendEnabled ) && getValue( eSendHUD_01 ))  sendHUD_01();
}

on envVar eTimeoutHUD_01
{
  cancelTimer( _tHUD_01 );
  cancelTimer( _totHUD_01 );
  if( getValue( this ))
    setTimer( _totHUD_01, (getValue( eSendEnabled ) && getValue( eSendHUD_01 ) && (getValue( eTOTHUD_01 ) > 0)) ? getValue( eTOTHUD_01 ) : 1 );
  else
    if( getValue( eSendEnabled ) && getValue( eSendHUD_01 ))  sendHUD_01();
}

on envVar eDlcOnceHUD_01
{
  if( getValue( eDlcOnceHUD_01 ) && !(getValue( eSendEnabled ) && getValue( eSendHUD_01 )))  setTimer( _tHUD_01, 1 );
}


//END MSG Kombi_HUD_01

// MSG KN_AAG

// END MSG KN_AAG
// MSG KN_BCM1

// END MSG KN_BCM1
// MSG KN_ELV

// END MSG KN_ELV
// MSG KN_HDSG

// END MSG KN_HDSG
// MSG KN_HUD

// END MSG KN_HUD
// MSG KN_Klima

// END MSG KN_Klima
// MSG KN_Kombi

// END MSG KN_Kombi
// MSG KN_MFG

// END MSG KN_MFG
// MSG KN_SAD

// END MSG KN_SAD
// MSG KN_Sitzmemo_BFS

// END MSG KN_Sitzmemo_BFS
// MSG KN_Sitzmemo_FS
// END MSG KN_Sitzmemo_FS
// MSG KN_STSG_HBFS

// END MSG KN_STSG_HBFS
// MSG KN_STSG_HFS

// END MSG KN_STSG_HFS
// MSG KN_TCO
// END MSG KN_TCO
// MSG KN_TSG_BFS
// END MSG KN_TSG_BFS
// MSG KN_TSG_FS

// END MSG KN_TSG_FS
// MSG KN_TSG_HBFS
// END MSG KN_TSG_HBFS
// MSG KN_TSG_HFS

// END MSG KN_TSG_HFS
// MSG KN_VSG

// END MSG KN_VSG


// MSG LCM_Soll_Fkt

//END MSG LCM_Soll_Fkt

//MSG Licht_Anf_01 - this msg has delay time but was implemented without before so i commented changed function

on Timer _tLicht_Anf_01
{
    if( getValue( eTLicht_Anf_01 ) <= 0)  putValue( eSendLicht_Anf_01, 0 );
    if( (getValue( eSendEnabled ) && getValue( eSendLicht_Anf_01 )) || getValue( eDlcOnceLicht_Anf_01 ))  sendLicht_Anf_01();
}

on envVar eSendLicht_Anf_01
{
  if( getValue( eSendEnabled ) && getValue( eSendLicht_Anf_01 ))  sendLicht_Anf_01();
}

on envVar eTimeoutLicht_Anf_01
{
  cancelTimer( _tLicht_Anf_01 );
  cancelTimer( _totLicht_Anf_01 );
  if( getValue( this ))
    setTimer( _totLicht_Anf_01, (getValue( eSendEnabled ) && getValue( eSendLicht_Anf_01 ) && (getValue( eTOTLicht_Anf_01 ) > 0)) ? getValue( eTOTLicht_Anf_01 ) : 1 );
  else
    if( getValue( eSendEnabled ) && getValue( eSendLicht_Anf_01 ))  sendLicht_Anf_01();
}

on Timer _totLicht_Anf_01
{
  putValue( eTimeoutLicht_Anf_01, 0 );
}

on envVar eDlcOnceLicht_Anf_01
{
  if( getValue( eDlcOnceLicht_Anf_01 ) && !(getValue( eSendEnabled ) && getValue( eSendLicht_Anf_01 )))  setTimer( _tLicht_Anf_01, 1 );
}
void sendLicht_Anf_01()
{
    if( getValue(eChangeLicht_Anf_01))
    {
        if( getValue( eDlcOnceLicht_Anf_01 ) || getValue( eDlcWrongLicht_Anf_01 ))
        {
            putValue( eDlcOnceLicht_Anf_01, 0 );
            _mLicht_Anf_01.DLC = getValue( eDlcLicht_Anf_01 );
        }
        else
        {
                    _mLicht_Anf_01.DLC = 8;
    }
        }
    else
    {
        _mLicht_Anf_01.DLC = 8;
    }


    {
        output( _mLicht_Anf_01 );
    }

    cancelTimer( _tLicht_Anf_01 );
    if( getValue( eTLicht_Anf_01 ) > 0)  setTimer( _tLicht_Anf_01, getValue( eTLicht_Anf_01 ) );  else  setTimer( _tLicht_Anf_01, 1 );
}

//END MSG Licht_Anf_01

// MSG Licht_hinten_01

on Timer _tLicht_hinten_01
{
  if( getValue( eTLicht_hinten_01 ) <= 0)  putValue( eSendLicht_hinten_01, 0 );
  if( (getValue( eSendEnabled ) && getValue( eSendLicht_hinten_01 )) || getValue( eDlcOnceLicht_hinten_01 ))  sendLicht_hinten_01();
}

on envVar eSendLicht_hinten_01
{
  if( getValue( eSendEnabled ) && getValue( eSendLicht_hinten_01 ))  sendLicht_hinten_01();
}

on envVar eTimeoutLicht_hinten_01
{
  cancelTimer( _tLicht_hinten_01 );
  cancelTimer( _totLicht_hinten_01 );
  if( getValue( this ))
    setTimer( _totLicht_hinten_01, (getValue( eSendEnabled ) && getValue( eSendLicht_hinten_01 ) && (getValue( eTOTLicht_hinten_01 ) > 0)) ? getValue( eTOTLicht_hinten_01 ) : 1 );
  else
    if( getValue( eSendEnabled ) && getValue( eSendLicht_hinten_01 ))  sendLicht_hinten_01();
}

on Timer _totLicht_hinten_01
{
  putValue( eTimeoutLicht_hinten_01, 0 );
}

on envVar eDlcOnceLicht_hinten_01
{
  if( getValue( eDlcOnceLicht_hinten_01 ) && !(getValue( eSendEnabled ) && getValue( eSendLicht_hinten_01 )))  setTimer( _tLicht_hinten_01, 1 );
}

void sendLicht_hinten_01()
{
  dword bz;

    if( getValue(eChangeLicht_hinten_01))
    {
        if( getValue( eDlcOnceLicht_hinten_01 ) || getValue( eDlcWrongLicht_hinten_01 ))
        {
            putValue( eDlcOnceLicht_hinten_01, 0 );
            _mLicht_hinten_01.DLC = getValue( eDlcLicht_hinten_01 );
        }
        else
        {
            _mLicht_hinten_01.DLC = 8;
        }

        if( getValue( eBZLicht_hinten_01 ))
        {
            bz = getValue( eLicht_hinten_01_BZS );
            bz = bz + getValue( eBZStepLicht_hinten_01 );
            putValue( eLicht_hinten_01_BZS, bz % 16 );
        } 
    }
    else
    {
        _mLicht_hinten_01.DLC = 8;

        bz = getValue( eLicht_hinten_01_BZS ) + 1;        
        putValue( eLicht_hinten_01_BZS, bz % 16 );
    }
    output( _mLicht_hinten_01 );
  
    cancelTimer( _tLicht_hinten_01 );
    if( getValue( eTLicht_hinten_01 ) > 0)  setTimer( _tLicht_hinten_01, getValue( eTLicht_hinten_01 ) );  else  setTimer( _tLicht_hinten_01, 1 );
}

on envVar eLicht_hinten_01_BZS
{
   _mLicht_hinten_01.Licht_hinten_01_BZ = getValue( this );
}

on envVar eBCM2_Bremsl_durch_ECDS
{
   _mLicht_hinten_01.BCM2_Bremsl_durch_ECD.phys = getValue( this );
}

on envVar eLH_3_Bremsl_defS
{
   _mLicht_hinten_01.LH_3_Bremsl_def.phys = getValue( this );
}

on envVar eLH_Aussenlicht_defS
{
   _mLicht_hinten_01.LH_Aussenlicht_def.phys = getValue( this );
}

on envVar eLH_Blinker_HL_aktS
{
   _mLicht_hinten_01.LH_Blinker_HL_akt.phys = getValue( this );
}

on envVar eLH_Blinker_HR_aktS
{
   _mLicht_hinten_01.LH_Blinker_HR_akt.phys = getValue( this );
}

on envVar eLH_Blinker_li_defS
{
   _mLicht_hinten_01.LH_Blinker_li_def.phys = getValue( this );
}

on envVar eLH_Blinker_re_defS
{
   _mLicht_hinten_01.LH_Blinker_re_def.phys = getValue( this );
}

on envVar eLH_Brems_Blk_li_defS
{
   _mLicht_hinten_01.LH_Brems_Blk_li_def.phys = getValue( this );
}

on envVar eLH_Brems_Blk_re_defS
{
   _mLicht_hinten_01.LH_Brems_Blk_re_def.phys = getValue( this );
}

on envVar eLH_Bremsl_li_defS
{
   _mLicht_hinten_01.LH_Bremsl_li_def.phys = getValue( this );
}

on envVar eLH_Bremsl_li_ges_defS
{
   _mLicht_hinten_01.LH_Bremsl_li_ges_def.phys = getValue( this );
}

on envVar eLH_Bremsl_re_defS
{
   _mLicht_hinten_01.LH_Bremsl_re_def.phys = getValue( this );
}

on envVar eLH_Bremsl_re_ges_defS
{
   _mLicht_hinten_01.LH_Bremsl_re_ges_def.phys = getValue( this );
}

on envVar eLH_Bremslicht_H_aktivS
{
   _mLicht_hinten_01.LH_Bremslicht_H_aktiv.phys = getValue( this );
}

on envVar KCAN_LH_Diag_Status_li_def
{
   _mLicht_hinten_01.LH_Diag_Status_li_def.phys = getValue( this );
}
  
on envVar KCAN_LH_Diag_Status_re_def
{
   _mLicht_hinten_01.LH_Diag_Status_re_def.phys = getValue( this );
}

on envVar KCAN_LH_Diag_LED_li_def
{
   _mLicht_hinten_01.LH_Diag_LED_li_def.phys = getValue( this );
}

on envVar KCAN_LH_Diag_LED_re_def
{
   _mLicht_hinten_01.LH_Diag_LED_re_def.phys = getValue( this );
}

on envVar eLH_Kennzl_defS
{
   _mLicht_hinten_01.LH_Kennzl_def.phys = getValue( this );
}

on envVar eLH_Nebel_li_defS
{
   _mLicht_hinten_01.LH_Nebel_li_def.phys = getValue( this );
}

on envVar eLH_Nebel_mi_defS
{
   _mLicht_hinten_01.LH_Nebel_mi_def.phys = getValue( this );
}

on envVar eLH_Nebel_re_defS
{
   _mLicht_hinten_01.LH_Nebel_re_def.phys = getValue( this );
}

on envVar eLH_Nebelschluss_aktivS
{
   _mLicht_hinten_01.LH_Nebelschluss_aktiv.phys = getValue( this );
}

on envVar eLH_Parklicht_HL_aktivS
{
   _mLicht_hinten_01.LH_Parklicht_HL_aktiv.phys = getValue( this );
}

on envVar eLH_Parklicht_HR_aktivS
{
   _mLicht_hinten_01.LH_Parklicht_HR_aktiv.phys = getValue( this );
}

on envVar eLH_Rueckf_li_defS
{
   _mLicht_hinten_01.LH_Rueckf_li_def.phys = getValue( this );
}

on envVar eLH_Rueckf_mi_defS
{
   _mLicht_hinten_01.LH_Rueckf_mi_def.phys = getValue( this );
}

on envVar eLH_Rueckf_re_defS
{
    _mLicht_hinten_01.LH_Rueckf_re_def.phys = getValue( this );
}

on envVar eLH_Rueckfahrlicht_aktivS
{
    _mLicht_hinten_01.LH_Rueckfahrlicht_aktiv.phys = getValue( this );
}

on envVar eLH_Schluss_Brems_li_defS
{
    _mLicht_hinten_01.LH_Schluss_Brems_li_def.phys = getValue( this );
}

on envVar eLH_Schluss_Brems_Nebel_li_defS
{
    _mLicht_hinten_01.LH_Schluss_Brems_Nebel_li_def.phys = getValue( this );
}

on envVar eLH_Schluss_Brems_Nebel_re_defS
{
    _mLicht_hinten_01.LH_Schluss_Brems_Nebel_re_def.phys = getValue( this );
}

on envVar eLH_Schluss_Brems_re_defS
{
    _mLicht_hinten_01.LH_Schluss_Brems_re_def.phys = getValue( this );
}

on envVar eLH_Schluss_Nebel_li_defS
{
    _mLicht_hinten_01.LH_Schluss_Nebel_li_def.phys = getValue( this );
}

on envVar eLH_Schluss_Nebel_re_defS
{
    _mLicht_hinten_01.LH_Schluss_Nebel_re_def.phys = getValue( this );
}

on envVar eLH_Schlusslicht_li_defS
{
    _mLicht_hinten_01.LH_Schlusslicht_li_def.phys = getValue( this );
}

on envVar eLH_Schlusslicht_re_defS
{
    _mLicht_hinten_01.LH_Schlusslicht_re_def.phys = getValue( this );
}

on envVar eLH_SL_BRL_BLK_li_defS
{
   _mLicht_hinten_01.LH_SL_BRL_BLK_li_def.phys = getValue( this );
}

on envVar eLH_SL_BRL_BLK_re_defS
{
   _mLicht_hinten_01.LH_SL_BRL_BLK_re_def.phys = getValue( this );
}

on envVar eLH_Standlicht_H_aktivS
{
   _mLicht_hinten_01.LH_Standlicht_H_aktiv.phys = getValue( this );
}

//END MSG Licht_hinten_01

// MSG Licht_vorne_01

on Timer _tLicht_vorne_01
{
    if( getValue( eTLicht_vorne_01 ) <= 0)  putValue( eSendLicht_vorne_01, 0 );
    if( (getValue( eSendEnabled ) && getValue( eSendLicht_vorne_01 )) || getValue( eDlcOnceLicht_vorne_01 ))  sendLicht_vorne_01();
}

on envVar eSendLicht_vorne_01
{
    if( getValue( eSendEnabled ) && getValue( eSendLicht_vorne_01 ))  sendLicht_vorne_01();
}

on envVar eTimeoutLicht_vorne_01
{
    cancelTimer( _tLicht_vorne_01 );
    cancelTimer( _totLicht_vorne_01 );
    if( getValue( this ))
        setTimer( _totLicht_vorne_01, (getValue( eSendEnabled ) && getValue( eSendLicht_vorne_01 ) && (getValue( eTOTLicht_vorne_01 ) > 0)) ? getValue( eTOTLicht_vorne_01 ) : 1 );
    else
        if( getValue( eSendEnabled ) && getValue( eSendLicht_vorne_01 ))  sendLicht_vorne_01();
}

on Timer _totLicht_vorne_01
{
    putValue( eTimeoutLicht_vorne_01, 0 );
}

on envVar eDlcOnceLicht_vorne_01
{
    if( getValue( eDlcOnceLicht_vorne_01 ) && !(getValue( eSendEnabled ) && getValue( eSendLicht_vorne_01 )))  setTimer( _tLicht_vorne_01, 1 );
}

on Timer _tinhLicht_vorne_01
{
    _bsiLicht_vorne_01 = 0;
    if( _bsaiLicht_vorne_01 && getValue( eSendEnabled ))  sendLicht_vorne_01();
}

void sendLicht_vorne_01()
{
    if( getValue(eChangeLicht_vorne_01))
    {
        if( getValue( eDlcOnceLicht_vorne_01 ) || getValue( eDlcWrongLicht_vorne_01 ))
        {
            putValue( eDlcOnceLicht_vorne_01, 0 );
            _mLicht_vorne_01.DLC = getValue( eDlcLicht_vorne_01 );
        }
        else
        {
            _mLicht_vorne_01.DLC = 8;
        }
    }
    else
    {
        _mLicht_vorne_01.DLC = 8;
    }

    output( _mLicht_vorne_01 );
    cancelTimer( _tLicht_vorne_01 );
    if( getValue( eTLicht_vorne_01 ) > 0)  setTimer( _tLicht_vorne_01, getValue( eTLicht_vorne_01 ) );  else  setTimer( _tLicht_vorne_01, 1 );
    _bsaiLicht_vorne_01 = 0;
    _bsiLicht_vorne_01 = 1;
    cancelTimer( _tinhLicht_vorne_01 );  setTimer( _tinhLicht_vorne_01, 100 );
}

Licht_vorne_01Changed()
{
    if( getValue( eSendEnabled ) && getValue( eSendLicht_vorne_01 ))
        if( _bsiLicht_vorne_01)
            _bsaiLicht_vorne_01 = 1;
        else
            sendLicht_vorne_01();
}

on envVar eBCM1_Licht_Dunkelheit_aktivS
{
    _mLicht_vorne_01.BCM1_Licht_Dunkelheit_aktiv.phys = getValue( this );
    Licht_vorne_01Changed();
}

on envVar eLV_Abblend_Fernlicht_li_defS
{
    _mLicht_vorne_01.LV_Abblend_Fernlicht_li_def.phys = getValue( this );
    Licht_vorne_01Changed();
}

on envVar eLV_Abblend_Fernlicht_re_defS
{
    _mLicht_vorne_01.LV_Abblend_Fernlicht_re_def.phys = getValue( this );
    Licht_vorne_01Changed();
}

on envVar eLV_Abblendlicht_AnzeigeS
{
    _mLicht_vorne_01.LV_Abblendlicht_Anzeige.phys = getValue( this );
    Licht_vorne_01Changed();
}

on envVar eLV_Abblendlicht_li_defS
{
    _mLicht_vorne_01.LV_Abblendlicht_li_def.phys = getValue( this );
    Licht_vorne_01Changed();
}

on envVar eLV_Abblendlicht_re_defS
{
    _mLicht_vorne_01.LV_Abblendlicht_re_def.phys = getValue( this );
    Licht_vorne_01Changed();
}

on envVar eLV_Abblendlicht_TFL_li_defS
{
    _mLicht_vorne_01.LV_Abblendlicht_TFL_li_def.phys = getValue( this );
    Licht_vorne_01Changed();
}

on envVar eLV_Abblendlicht_TFL_re_defS
{
    _mLicht_vorne_01.LV_Abblendlicht_TFL_re_def.phys = getValue( this );
    Licht_vorne_01Changed();
}

on envVar eLV_AFL_aktiv_AnzeigeS
{
    _mLicht_vorne_01.LV_AFL_aktiv_Anzeige.phys = getValue( this );
    Licht_vorne_01Changed();
}

on envVar eLV_AFL_defektS
{
    _mLicht_vorne_01.LV_AFL_defekt.phys = getValue( this );
    Licht_vorne_01Changed();
}

on envVar eLV_Aussenlicht_defS
{
    _mLicht_vorne_01.LV_Aussenlicht_def.phys = getValue( this );
    Licht_vorne_01Changed();
}

on envVar eLV_Blinker_li_defS
{
    _mLicht_vorne_01.LV_Blinker_li_def.phys = getValue( this );
    Licht_vorne_01Changed();
}

on envVar eLV_Blinker_re_defS
{
    _mLicht_vorne_01.LV_Blinker_re_def.phys = getValue( this );
    Licht_vorne_01Changed();
}

on envVar eLV_Blk_li_Seite_defS
{
    _mLicht_vorne_01.LV_Blk_li_Seite_def.phys = getValue( this );
    Licht_vorne_01Changed();
}

on envVar eLV_Blk_re_Seite_defS
{
    _mLicht_vorne_01.LV_Blk_re_Seite_def.phys = getValue( this );
    Licht_vorne_01Changed();
}

on envVar eLV_Fernlicht_AnzeigeS
{
    _mLicht_vorne_01.LV_Fernlicht_Anzeige.phys = getValue( this );
    Licht_vorne_01Changed();
}

on envVar eLV_Fernlicht_li_defS
{
    _mLicht_vorne_01.LV_Fernlicht_li_def.phys = getValue( this );
    Licht_vorne_01Changed();
}

on envVar eLV_Fernlicht_re_defS
{
    _mLicht_vorne_01.LV_Fernlicht_re_def.phys = getValue( this );
    Licht_vorne_01Changed();
}

on envVar eLV_FLA_aktiv_AnzeigeS
{
    _mLicht_vorne_01.LV_FLA_aktiv_Anzeige.phys = getValue( this );
    Licht_vorne_01Changed();
}

on envVar eLV_FLA_defektS
{
    _mLicht_vorne_01.LV_FLA_defekt.phys = getValue( this );
    Licht_vorne_01Changed();
}

on envVar eLV_FLA_Sensor_blockiertS
{
    _mLicht_vorne_01.LV_FLA_Sensor_blockiert.phys = getValue( this );
    Licht_vorne_01Changed();
}

on envVar eLV_LED_Scheinwerfer_li_defS
{
    _mLicht_vorne_01.LV_LED_Scheinwerfer_li_def.phys = getValue( this );
    Licht_vorne_01Changed();
}

on envVar eLV_LED_Scheinwerfer_re_defS
{
    _mLicht_vorne_01.LV_LED_Scheinwerfer_re_def.phys = getValue( this );
    Licht_vorne_01Changed();
}

on envVar eLV_Nebellicht_AnzeigeS
{
    _mLicht_vorne_01.LV_Nebellicht_Anzeige.phys = getValue( this );
    Licht_vorne_01Changed();
}

on envVar eLV_Nebellicht_li_defS
{
    _mLicht_vorne_01.LV_Nebellicht_li_def.phys = getValue( this );
    Licht_vorne_01Changed();
}

on envVar eLV_Nebellicht_re_defS
{
    _mLicht_vorne_01.LV_Nebellicht_re_def.phys = getValue( this );
    Licht_vorne_01Changed();
}

on envVar eLV_Nebellicht_TFL_li_defS
{
    _mLicht_vorne_01.LV_Nebellicht_TFL_li_def.phys = getValue( this );
    Licht_vorne_01Changed();
}

on envVar eLV_Nebellicht_TFL_re_defS
{
    _mLicht_vorne_01.LV_Nebellicht_TFL_re_def.phys = getValue( this );
    Licht_vorne_01Changed();
}

on envVar eLV_Nebelschlusslicht_AnzeigeS
{
    _mLicht_vorne_01.LV_Nebelschlusslicht_Anzeige.phys = getValue( this );
    Licht_vorne_01Changed();
}

on envVar eLV_Standlicht_AnzeigeS
{
    _mLicht_vorne_01.LV_Standlicht_Anzeige.phys = getValue( this );
    Licht_vorne_01Changed();
}

on envVar eLV_Standlicht_li_defS
{
    _mLicht_vorne_01.LV_Standlicht_li_def.phys = getValue( this );
    Licht_vorne_01Changed();
}

on envVar eLV_Standlicht_re_defS
{
    _mLicht_vorne_01.LV_Standlicht_re_def.phys = getValue( this );
    Licht_vorne_01Changed();
}

on envVar eLV_Standlicht_TFL_li_defS
{
    _mLicht_vorne_01.LV_Standlicht_TFL_li_def.phys = getValue( this );
    Licht_vorne_01Changed();
}

on envVar eLV_Standlicht_TFL_re_defS
{
    _mLicht_vorne_01.LV_Standlicht_TFL_re_def.phys = getValue( this );
    Licht_vorne_01Changed();
}

on envVar eLV_Tagfahrlicht_AnzeigeS
{
    _mLicht_vorne_01.LV_Tagfahrlicht_Anzeige.phys = getValue( this );
    Licht_vorne_01Changed();
}

on envVar eLV_Tagfahrlicht_li_defS
{
    _mLicht_vorne_01.LV_Tagfahrlicht_li_def.phys = getValue( this );
    Licht_vorne_01Changed();
}

on envVar eLV_Tagfahrlicht_re_defS
{
    _mLicht_vorne_01.LV_Tagfahrlicht_re_def.phys = getValue( this );
    Licht_vorne_01Changed();
}

//END MSG Licht_vorne_01

// MSG LoGeWa_03

on Timer _tLoGeWa_03
{
  if( getValue( eTLoGeWa_03 ) <= 0)  putValue( eSendLoGeWa_03, 0 );
  if( (getValue( eSendEnabled ) && getValue( eSendLoGeWa_03 )) || getValue( eDlcOnceLoGeWa_03 ))  sendLoGeWa_03();
}

on envVar eSendLoGeWa_03
{
  if( getValue( eSendEnabled ) && getValue( eSendLoGeWa_03 ))  sendLoGeWa_03();
}

on envVar eTimeoutLoGeWa_03
{
  cancelTimer( _tLoGeWa_03 );
  cancelTimer( _totLoGeWa_03 );
  if( getValue( this ))
    setTimer( _totLoGeWa_03, (getValue( eSendEnabled ) && getValue( eSendLoGeWa_03 ) && (getValue( eTOTLoGeWa_03 ) > 0)) ? getValue( eTOTLoGeWa_03 ) : 1 );
  else
    if( getValue( eSendEnabled ) && getValue( eSendLoGeWa_03 ))  sendLoGeWa_03();
}

on Timer _totLoGeWa_03
{
  putValue( eTimeoutLoGeWa_03, 0 );
}

on envVar eDlcOnceLoGeWa_03
{
  if( getValue( eDlcOnceLoGeWa_03 ) && !(getValue( eSendEnabled ) && getValue( eSendLoGeWa_03 )))  setTimer( _tLoGeWa_03, 1 );
}

on Timer _tinhLoGeWa_03
{
  _bsiLoGeWa_03 = 0;
  if( _bsaiLoGeWa_03 && getValue( eSendEnabled ))  sendLoGeWa_03();
}

void sendLoGeWa_03()
{
  if( getValue(eChangeLoGeWa_03))
  {
    if( getValue( eDlcOnceLoGeWa_03 ) || getValue( eDlcWrongLoGeWa_03 ))
    {
        putValue( eDlcOnceLoGeWa_03, 0 );
        _mLoGeWa_03.DLC = getValue( eDlcLoGeWa_03 );
    }
    else
    {
        _mLoGeWa_03.DLC = 8;
    }
  }
  else
  {
    _mLoGeWa_03.DLC = 8;
  }

  output( _mLoGeWa_03 );
  cancelTimer( _tLoGeWa_03 );
  if( getValue( eTLoGeWa_03 ) > 0)  setTimer( _tLoGeWa_03, getValue( eTLoGeWa_03 ) );  else  setTimer( _tLoGeWa_03, 1 );
  _bsaiLoGeWa_03 = 0;
  _bsiLoGeWa_03 = 1;
  cancelTimer( _tinhLoGeWa_03 );  setTimer( _tinhLoGeWa_03, 100 );
}

LoGeWa_03Changed()
{
  if( getValue( eSendEnabled ) && getValue( eSendLoGeWa_03 ))
    if( _bsiLoGeWa_03)
      _bsaiLoGeWa_03 = 1;
    else
      sendLoGeWa_03();
}

on envVar eLoGeWa_C2C_Event_EinheitS
{
  _mLoGeWa_03.LoGeWa_C2C_Event_Einheit = getValue( this );
   LoGeWa_03Changed();
}

on envVar eLoGeWa_C2C_Event_EntfernungS
{
  _mLoGeWa_03.LoGeWa_C2C_Event_Entfernung = getValue( this );
   LoGeWa_03Changed();
}

on envVar eLoGeWa_C2C_Event_RichtungS
{
  _mLoGeWa_03.LoGeWa_C2C_Event_Richtung = getValue( this );
   LoGeWa_03Changed();
}

on envVar eLoGeWa_C2C_Event_StatusS
{
  _mLoGeWa_03.LoGeWa_C2C_Event_Status = getValue( this );
   LoGeWa_03Changed();
}

on envVar eLoGeWa_C2C_Event_WarnungS
{
  _mLoGeWa_03.LoGeWa_C2C_Event_Warnung = getValue( this );
   LoGeWa_03Changed();
}

on envVar KCAN_SOK_C2C_LoGeWa_Signatur
{
  _mLoGeWa_03.SOK_C2C_LoGeWa_Signatur = getValue( this );
   LoGeWa_03Changed();
}

//END MSG LoGeWa_03

// MSG LWR_AFS_01

on Timer _tLWR_AFS_01
{
  if( getValue( eTLWR_AFS_01 ) <= 0)  putValue( eSendLWR_AFS_01, 0 );
  if( (getValue( eSendEnabled ) && getValue( eSendLWR_AFS_01 )) || getValue( eDlcOnceLWR_AFS_01 ))  sendLWR_AFS_01();
}

on envVar eSendLWR_AFS_01
{
  if( getValue( eSendEnabled ) && getValue( eSendLWR_AFS_01 ))  sendLWR_AFS_01();
}

on envVar eTimeoutLWR_AFS_01
{
  cancelTimer( _tLWR_AFS_01 );
  cancelTimer( _totLWR_AFS_01 );
  if( getValue( this ))
    setTimer( _totLWR_AFS_01, (getValue( eSendEnabled ) && getValue( eSendLWR_AFS_01 ) && (getValue( eTOTLWR_AFS_01 ) > 0)) ? getValue( eTOTLWR_AFS_01 ) : 1 );
  else
    if( getValue( eSendEnabled ) && getValue( eSendLWR_AFS_01 ))  sendLWR_AFS_01();
}

on Timer _totLWR_AFS_01
{
  putValue( eTimeoutLWR_AFS_01, 0 );
}

on envVar eDlcOnceLWR_AFS_01
{
  if( getValue( eDlcOnceLWR_AFS_01 ) && !(getValue( eSendEnabled ) && getValue( eSendLWR_AFS_01 )))  setTimer( _tLWR_AFS_01, 1 );
}

on Timer _tinhLWR_AFS_01
{
  _bsiLWR_AFS_01 = 0;
  if( _bsaiLWR_AFS_01 && getValue( eSendEnabled ))  sendLWR_AFS_01();
}

void sendLWR_AFS_01()
{
  byte crc;
  dword bz;
  int hw;
  byte dlc;

  if( getValue(eChangeLWR_AFS_01))
  {    
    if( getValue( eDlcOnceLWR_AFS_01 ) || getValue( eDlcWrongLWR_AFS_01 ))
    {
        putValue( eDlcOnceLWR_AFS_01, 0 );
        _mLWR_AFS_01.DLC = getValue( eDlcLWR_AFS_01 );
    }
    else
    {
    /*    if(GetValue(eLWR_AFS_01_ChngDLCEnabled))
        {
          dlc=GetValue(eLWR_AFS_01_ChngDLCData);
          if(dlc>0)
          {
            dlc--;
            putValue( eLWR_AFS_01_ChngDLCData, dlc );
            _mLWR_AFS_01.DLC = getValue( eDlcLWR_AFS_01 );
          }
          else
          {
            putValue( eLWR_AFS_01_ChngDLCData, 0 );
            _mLWR_AFS_01.DLC = 8;
          }
        }        
        else
        {
          _mLWR_AFS_01.DLC = 8;
        }        */
    }
 /*   if(GetValue(eLWR_AFS_01_BZS_SingleJumpEnabled))
    {
        PutValue(eLWR_AFS_01_BZS_SingleJumpEnabled,0);
        _mLWR_AFS_01.LWR_AFS_01_BZ=(_mLWR_AFS_01.LWR_AFS_01_BZ+GetValue(eLWR_AFS_01_BZS_SingleJumpData))&0xf;
    }
    if(GetValue(eLWR_AFS_01_BZS_ResetJumpEnabled))
    {

        if(GetValue(eLWR_AFS_01_BZS_ResetJumpData)==_mLWR_AFS_01.LWR_AFS_01_BZ)
        {
            PutValue(eLWR_AFS_01_BZS_ResetJumpEnabled,0);
            _mLWR_AFS_01.LWR_AFS_01_BZ=0;
            putValue(eLWR_AFS_01_BZS,15);
        }
    }*/
  //  crc = getCRC8( _mLWR_AFS_01, _s_pdu_codeLWR_AFS_01 );
 //   if(GetValue(eLWR_AFS_01_CRC_FalseEnabled))
    {
        
        crc=~crc;
   //     hw=GetValue(eLWR_AFS_01_CRC_FalseData);
        if(hw)
        {
            hw--;
   //         PutValue(eLWR_AFS_01_CRC_FalseData,hw);
        }
        if(hw==0)
        {
   //         PutValue(eLWR_AFS_01_CRC_FalseEnabled,0);
        }

    }
 //   _mLWR_AFS_01.LWR_AFS_01_CRC = crc ^ (1 - getValue( eCrcLWR_AFS_01 ));    
    
    if( getValue( eBZLWR_AFS_01 ))
    {
        bz = getValue( eLWR_AFS_01_BZS );
        bz = bz + getValue( eBZStepLWR_AFS_01 );
        putValue( eLWR_AFS_01_BZS, bz % 16 );
    }
  }
  else
  {
    _mLWR_AFS_01.DLC = 8;

   // crc = getCRC8( _mLWR_AFS_01, _s_pdu_codeLWR_AFS_01 );
   // _mLWR_AFS_01.LWR_AFS_01_CRC = crc ^ (1 - getValue( eCrcLWR_AFS_01 ));
    
  //  bz = getValue( eLWR_AFS_01_BZS ) + 1;    
  //  putValue( eLWR_AFS_01_BZS, bz % 16 );
  }
    
  /*if(GetValue(eLWR_AFS_01_NoMsgEnabled))
  {
      hw=GetValue(eLWR_AFS_01_NoMsgEnabledData);
      if(hw)
      {
        hw--;
        PutValue(eLWR_AFS_01_NoMsgEnabledData,hw);
      }
      if(hw==0)
      {
        PutValue(eLWR_AFS_01_NoMsgEnabled,0);
      }        
  }
  else*/
  {
    output( _mLWR_AFS_01 );
  }
    
  cancelTimer( _tLWR_AFS_01 );
  if( getValue( eTLWR_AFS_01 ) > 0)  setTimer( _tLWR_AFS_01, getValue( eTLWR_AFS_01 ) );  else  setTimer( _tLWR_AFS_01, 1 );
}

LWR_AFS_01Changed()
{
  if( getValue( eSendEnabled ) && getValue( eSendLWR_AFS_01 ))
    if( _bsiLWR_AFS_01)
      _bsaiLWR_AFS_01 = 1;
    else
      sendLWR_AFS_01();
}

on envVar eLWR_AFS_01_BZS
{
  _mLWR_AFS_01.LWR_AFS_01_BZ = getValue( this );
}

on envVar eAFS_Abbiegelicht_Dimm_AnfS
{
  _mLWR_AFS_01.AFS_Abbiegelicht_Dimm_Anf = getValue( this );
   LWR_AFS_01Changed();
}

on envVar eAFS_Abbiegelicht_li_AnfS
{
  _mLWR_AFS_01.AFS_Abbiegelicht_li_Anf = getValue( this );
   LWR_AFS_01Changed();
}

on envVar eAFS_Abbiegelicht_re_AnfS
{
  _mLWR_AFS_01.AFS_Abbiegelicht_re_Anf = getValue( this );
   LWR_AFS_01Changed();
}

on envVar eAFS_adaptive_LV_verbautS
{
  _mLWR_AFS_01.AFS_adaptive_LV_verbaut = getValue( this );
   LWR_AFS_01Changed();
}

on envVar eAFS_AllwetterlichtS
{
  _mLWR_AFS_01.AFS_Allwetterlicht = getValue( this );
   LWR_AFS_01Changed();
}

on envVar eAFS_Charisma_FahrPrS
{
  _mLWR_AFS_01.AFS_Charisma_FahrPr = getValue( this );
   LWR_AFS_01Changed();
}

on envVar eAFS_Charisma_StatusS
{
  _mLWR_AFS_01.AFS_Charisma_Status = getValue( this );
   LWR_AFS_01Changed();
}

on envVar eAFS_Ersatzlicht_LinksS
{
  _mLWR_AFS_01.AFS_Ersatzlicht_Links = getValue( this );
   LWR_AFS_01Changed();
}

on envVar eAFS_Ersatzlicht_RechtsS
{
  _mLWR_AFS_01.AFS_Ersatzlicht_Rechts = getValue( this );
   LWR_AFS_01Changed();
}

on envVar eAFS_FehlertextS
{
  _mLWR_AFS_01.AFS_Fehlertext = getValue( this );
   LWR_AFS_01Changed();
}

on envVar eAFS_Fernlicht_li_defektS
{
  _mLWR_AFS_01.AFS_Fernlicht_li_defekt = getValue( this );
   LWR_AFS_01Changed();
}

on envVar eAFS_Fernlicht_re_defektS
{
  _mLWR_AFS_01.AFS_Fernlicht_re_defekt = getValue( this );
   LWR_AFS_01Changed();
}

on envVar eAFS_Fernlicht_StatusS
{
  _mLWR_AFS_01.AFS_Fernlicht_Status = getValue( this );
   LWR_AFS_01Changed();
}

on envVar eAFS_LampeS
{
  _mLWR_AFS_01.AFS_Lampe = getValue( this );
   LWR_AFS_01Changed();
}

on envVar eAFS_LED_BlinkmodeS
{
  _mLWR_AFS_01.AFS_LED_Blinkmode = getValue( this );
   LWR_AFS_01Changed();
}

on envVar eAFS_Status_adaptive_LVS
{
  _mLWR_AFS_01.AFS_Status_adaptive_LV = getValue( this );
   LWR_AFS_01Changed();
}

on envVar eAFS_Verfuegbarkeit_GLWS
{
  _mLWR_AFS_01.AFS_Verfuegbarkeit_GLW = getValue( this );
   LWR_AFS_01Changed();
}

on envVar eLWR_AFS_GrundeinstellungS
{
  _mLWR_AFS_01.LWR_AFS_Grundeinstellung = getValue( this );
   LWR_AFS_01Changed();
}

on envVar eLWR_AFS_ParametrisierungS
{
  _mLWR_AFS_01.LWR_AFS_Parametrisierung = getValue( this );
   LWR_AFS_01Changed();
}

on envVar eLWR_Hoehenwert_HLS
{
  _mLWR_AFS_01.LWR_Hoehenwert_HL = getValue( this );
   LWR_AFS_01Changed();
}

on envVar eLWR_Hoehenwert_VLS
{
  _mLWR_AFS_01.LWR_Hoehenwert_VL = getValue( this );
   LWR_AFS_01Changed();
}

on envVar eLWR_InitialisierungslaufS
{
  _mLWR_AFS_01.LWR_Initialisierungslauf = getValue( this );
   LWR_AFS_01Changed();
}

on envVar eLWR_LampeS
{
  _mLWR_AFS_01.LWR_Lampe = getValue( this );
   LWR_AFS_01Changed();
}

on envVar eLWR_ModusS
{
  _mLWR_AFS_01.LWR_Modus = getValue( this );
   LWR_AFS_01Changed();
}

on envVar eLWR_Pos_SchrittmotorS
{
  _mLWR_AFS_01.LWR_Pos_Schrittmotor = getValue( this );
   LWR_AFS_01Changed();
}

on envVar eLWR_Reisemodus_TexteS
{
  _mLWR_AFS_01.LWR_Reisemodus_Texte = getValue( this );
   LWR_AFS_01Changed();
}

on envVar eLWR_SicherheitspositionS
{
  _mLWR_AFS_01.LWR_Sicherheitsposition = getValue( this );
   LWR_AFS_01Changed();
}

on envVar eLWR_Touristenmodus_aktivS
{
  _mLWR_AFS_01.LWR_Touristenmodus_aktiv = getValue( this );
   LWR_AFS_01Changed();
}

on envVar eLWR_Touristenmodus_verbautS
{
  _mLWR_AFS_01.LWR_Touristenmodus_verbaut = getValue( this );
   LWR_AFS_01Changed();
}

//END MSG LWR_AFS_01

// MSG Mem_BFS_01

on Timer _tMem_BFS_01
{
  if( getValue( eTMem_BFS_01 ) <= 0)  putValue( eSendMem_BFS_01, 0 );
  if( (getValue( eSendEnabled ) && getValue( eSendMem_BFS_01 )) || getValue( eDlcOnceMem_BFS_01 ))  sendMem_BFS_01();
}

on envVar eSendMem_BFS_01
{
  if( getValue( eSendEnabled ) && getValue( eSendMem_BFS_01 ))  sendMem_BFS_01();
}

on envVar eTimeoutMem_BFS_01
{
  cancelTimer( _tMem_BFS_01 );
  cancelTimer( _totMem_BFS_01 );
  if( getValue( this ))
    setTimer( _totMem_BFS_01, (getValue( eSendEnabled ) && getValue( eSendMem_BFS_01 ) && (getValue( eTOTMem_BFS_01 ) > 0)) ? getValue( eTOTMem_BFS_01 ) : 1 );
  else
    if( getValue( eSendEnabled ) && getValue( eSendMem_BFS_01 ))  sendMem_BFS_01();
}

on Timer _totMem_BFS_01
{
  putValue( eTimeoutMem_BFS_01, 0 );
}

on envVar eDlcOnceMem_BFS_01
{
  if( getValue( eDlcOnceMem_BFS_01 ) && !(getValue( eSendEnabled ) && getValue( eSendMem_BFS_01 )))  setTimer( _tMem_BFS_01, 1 );
}

on Timer _tinhMem_BFS_01
{
  _bsiMem_BFS_01 = 0;
  if( _bsaiMem_BFS_01 && getValue( eSendEnabled ))  sendMem_BFS_01();
}

void sendMem_BFS_01()
{
    if( getValue(eChangeMem_BFS_01))
    {
        if( getValue( eDlcOnceMem_BFS_01 ) || getValue( eDlcWrongMem_BFS_01 ))
        {
            putValue( eDlcOnceMem_BFS_01, 0 );
            _mMem_BFS_01.DLC = getValue( eDlcMem_BFS_01 );
        }
        else
        {
            _mMem_BFS_01.DLC = 8;
        }
    }
    else
    {
        _mMem_BFS_01.DLC = 8;
    }

    output( _mMem_BFS_01 );

    cancelTimer( _tMem_BFS_01 );
    if( getValue( eTMem_BFS_01 ) > 0)  setTimer( _tMem_BFS_01, getValue( eTMem_BFS_01 ) );  else  setTimer( _tMem_BFS_01, 1 );
    _bsaiMem_BFS_01 = 0;
    _bsiMem_BFS_01 = 1;
    cancelTimer( _tinhMem_BFS_01 );  setTimer( _tinhMem_BFS_01, 50 );
}

Mem_BFS_01Changed()
{
    if( getValue( eSendEnabled ) && getValue( eSendMem_BFS_01 ))
        if( _bsiMem_BFS_01)
            _bsaiMem_BFS_01 = 1;
        else
            sendMem_BFS_01();
}

on envVar eBFS_Fond_Bed_AckS
{
    _mMem_BFS_01.BFS_Fond_Bed_Ack = getValue( this );
    Mem_BFS_01Changed();
}

on envVar eBFS_GHV_aktivS
{
    _mMem_BFS_01.BFS_GHV_aktiv = getValue( this );
    Mem_BFS_01Changed();
}

on envVar eBFS_Klapptisch_offenS
{
    _mMem_BFS_01.BFS_Klapptisch_offen = getValue( this );
    Mem_BFS_01Changed();
}

on envVar eBFS_KSS_Fahrt_aktivS
{
    _mMem_BFS_01.BFS_KSS_Fahrt_aktiv = getValue( this );
    Mem_BFS_01Changed();
}

on envVar eBFS_KSV_aktivS
{
    _mMem_BFS_01.BFS_KSV_aktiv = getValue( this );
    Mem_BFS_01Changed();
}

on envVar eBFS_Lehne_nicht_verriegeltS
{
    _mMem_BFS_01.BFS_Lehne_nicht_verriegelt = getValue( this );
    Mem_BFS_01Changed();
}

on envVar eBFS_LHV_aktivS
{
    _mMem_BFS_01.BFS_LHV_aktiv = getValue( this );
    Mem_BFS_01Changed();
}

on envVar eBFS_LKV_aktivS
{
    _mMem_BFS_01.BFS_LKV_aktiv = getValue( this );
    Mem_BFS_01Changed();
}

on envVar eBFS_LNV_aktivS
{
  _mMem_BFS_01.BFS_LNV_aktiv = getValue( this );
  Mem_BFS_01Changed();
}

on envVar eBFS_LWV_aktivS
{
  _mMem_BFS_01.BFS_LWV_aktiv = getValue( this );
  Mem_BFS_01Changed();
}

on envVar eBFS_MMB_glob_stopS
{
  _mMem_BFS_01.BFS_MMB_glob_stop = getValue( this );
  Mem_BFS_01Changed();
}

on envVar eBFS_MMB_lokal_StopS
{
  _mMem_BFS_01.BFS_MMB_lokal_Stop = getValue( this );
  Mem_BFS_01Changed();
}

on envVar eBFS_MMB_storageS
{
  _mMem_BFS_01.BFS_MMB_storage = getValue( this );
  Mem_BFS_01Changed();
}

on envVar eBFS_MMB_storage_beepS
{
  _mMem_BFS_01.BFS_MMB_storage_beep = getValue( this );
  Mem_BFS_01Changed();
}

on envVar eBFS_MMB_storeS
{
  _mMem_BFS_01.BFS_MMB_store = getValue( this );
  Mem_BFS_01Changed();
}

on envVar eBFS_MMB_store_LED_onS
{
  _mMem_BFS_01.BFS_MMB_store_LED_on = getValue( this );
  Mem_BFS_01Changed();
}

on envVar eBFS_MMB_tastS
{
  _mMem_BFS_01.BFS_MMB_tast = getValue( this );
  Mem_BFS_01Changed();
}

on envVar eBFS_MMB_tippS
{
  _mMem_BFS_01.BFS_MMB_tipp = getValue( this );
  Mem_BFS_01Changed();
}

on envVar eBFS_Ruhestellung_StatusS
{
  _mMem_BFS_01.BFS_Ruhestellung_Status = getValue( this );
  Mem_BFS_01Changed();
}

on envVar eBFS_SHV_aktivS
{
  _mMem_BFS_01.BFS_SHV_aktiv = getValue( this );
  Mem_BFS_01Changed();
}

on envVar eBFS_Sitzfahrt_aktivS
{
  _mMem_BFS_01.BFS_Sitzfahrt_aktiv = getValue( this );
  Mem_BFS_01Changed();
}

on envVar eBFS_Sitzsym_Fahrt_aktivS
{
  _mMem_BFS_01.BFS_Sitzsym_Fahrt_aktiv = getValue( this );
  Mem_BFS_01Changed();
}

on envVar eBFS_SLV_aktivS
{
  _mMem_BFS_01.BFS_SLV_aktiv = getValue( this );
  Mem_BFS_01Changed();
}

on envVar eBFS_SNV_aktivS
{
  _mMem_BFS_01.BFS_SNV_aktiv = getValue( this );
  Mem_BFS_01Changed();
}

on envVar eBFS_STV_aktivS
{
  _mMem_BFS_01.BFS_STV_aktiv = getValue( this );
  Mem_BFS_01Changed();
}

//on envVar eBFS_KD_FehlerS
//{
//  _mMem_BFS_01.BFS_KD_Fehler = getValue( this );
//  Mem_BFS_01Changed();
//}

//END MSG Mem_BFS_01

// MSG Mem_FS_01

on Timer _tMem_FS_01
{
  if( getValue( eTMem_FS_01 ) <= 0)  putValue( eSendMem_FS_01, 0 );
  if( (getValue( eSendEnabled ) && getValue( eSendMem_FS_01 )) || getValue( eDlcOnceMem_FS_01 ))  sendMem_FS_01();
}

on envVar eSendMem_FS_01
{
  if( getValue( eSendEnabled ) && getValue( eSendMem_FS_01 ))  sendMem_FS_01();
}

on envVar eTimeoutMem_FS_01
{
  cancelTimer( _tMem_FS_01 );
  cancelTimer( _totMem_FS_01 );
  if( getValue( this ))
    setTimer( _totMem_FS_01, (getValue( eSendEnabled ) && getValue( eSendMem_FS_01 ) && (getValue( eTOTMem_FS_01 ) > 0)) ? getValue( eTOTMem_FS_01 ) : 1 );
  else
    if( getValue( eSendEnabled ) && getValue( eSendMem_FS_01 ))  sendMem_FS_01();
}

on Timer _totMem_FS_01
{
  putValue( eTimeoutMem_FS_01, 0 );
}

on envVar eDlcOnceMem_FS_01
{
  if( getValue( eDlcOnceMem_FS_01 ) && !(getValue( eSendEnabled ) && getValue( eSendMem_FS_01 )))  setTimer( _tMem_FS_01, 1 );
}

on Timer _tinhMem_FS_01
{
  _bsiMem_FS_01 = 0;
  if( _bsaiMem_FS_01 && getValue( eSendEnabled ))  sendMem_FS_01();
}

void sendMem_FS_01()
{
    if( getValue(eChangeMem_BFS_01))
    {
        if( getValue( eDlcOnceMem_FS_01 ) || getValue( eDlcWrongMem_FS_01 ))
        {
            putValue( eDlcOnceMem_FS_01, 0 );
            _mMem_FS_01.DLC = getValue( eDlcMem_FS_01 );
        }
        else
        {
            _mMem_FS_01.DLC = 8;
        }
    }
    else
    {
        _mMem_FS_01.DLC = 8;
    }

    output( _mMem_FS_01 );

    cancelTimer( _tMem_FS_01 );
    if( getValue( eTMem_FS_01 ) > 0)  setTimer( _tMem_FS_01, getValue( eTMem_FS_01 ) );  else  setTimer( _tMem_FS_01, 1 );
    _bsaiMem_FS_01 = 0;
    _bsiMem_FS_01 = 1;
    cancelTimer( _tinhMem_FS_01 );  setTimer( _tinhMem_FS_01, 50 );
}

Mem_FS_01Changed()
{
    if( getValue( eSendEnabled ) && getValue( eSendMem_FS_01 ))
        if( _bsiMem_FS_01)
            _bsaiMem_FS_01 = 1;
        else
            sendMem_FS_01();
}

on envVar eFS_BFS_Fond_Verst_enableS
{
    _mMem_FS_01.FS_BFS_Fond_Verst_enable = getValue( this );
    Mem_FS_01Changed();
}

on envVar eFS_BFS_KSS_AnfahrtS
{
    _mMem_FS_01.FS_BFS_KSS_Anfahrt = getValue( this );
    Mem_FS_01Changed();
}

on envVar eFS_BFS_Sitzsym_AnfahrtS
{
    _mMem_FS_01.FS_BFS_Sitzsym_Anfahrt = getValue( this );
    Mem_FS_01Changed();
}

on envVar eFS_EE_BFS_enableS
{
    _mMem_FS_01.FS_EE_BFS_enable = getValue( this );
    Mem_FS_01Changed();
}

on envVar eFS_EE_Fond_BFS_enableS
{
    _mMem_FS_01.FS_EE_Fond_BFS_enable = getValue( this );
    Mem_FS_01Changed();
}

on envVar eFS_EE_Fond_FS_enableS
{
    _mMem_FS_01.FS_EE_Fond_FS_enable = getValue( this );
    Mem_FS_01Changed();
}

on envVar eFS_Fond_Bed_enableS
{
    _mMem_FS_01.FS_Fond_Bed_enable = getValue( this );
    Mem_FS_01Changed();
}

on envVar eFS_GHV_aktivS
{
    _mMem_FS_01.FS_GHV_aktiv = getValue( this );
    Mem_FS_01Changed();
}

on envVar eFS_KSV_aktivS
{
    _mMem_FS_01.FS_KSV_aktiv = getValue( this );
    Mem_FS_01Changed();
}

on envVar eFS_Lehne_nicht_verriegeltS
{
    _mMem_FS_01.FS_Lehne_nicht_verriegelt = getValue( this );
    Mem_FS_01Changed();
}

on envVar eFS_LHV_aktivS
{
    _mMem_FS_01.FS_LHV_aktiv = getValue( this );
    Mem_FS_01Changed();
}

on envVar eFS_LKV_aktivS
{
    _mMem_FS_01.FS_LKV_aktiv = getValue( this );
    Mem_FS_01Changed();
}

on envVar eFS_LNV_aktivS
{
    _mMem_FS_01.FS_LNV_aktiv = getValue( this );
    Mem_FS_01Changed();
}

on envVar eFS_LWV_aktivS
{
    _mMem_FS_01.FS_LWV_aktiv = getValue( this );
    Mem_FS_01Changed();
}

on envVar eFS_MMB_glob_stopS
{
    _mMem_FS_01.FS_MMB_glob_stop = getValue( this );
    Mem_FS_01Changed();
}

on envVar eFS_MMB_lokal_StopS
{
    _mMem_FS_01.FS_MMB_lokal_Stop = getValue( this );
    Mem_FS_01Changed();
}

on envVar eFS_MMB_storageS
{
    _mMem_FS_01.FS_MMB_storage = getValue( this );
    Mem_FS_01Changed();
}

on envVar eFS_MMB_storage_beepS
{
    _mMem_FS_01.FS_MMB_storage_beep = getValue( this );
    Mem_FS_01Changed();
}

on envVar eFS_MMB_storeS
{
    _mMem_FS_01.FS_MMB_store = getValue( this );
    Mem_FS_01Changed();
}

on envVar eFS_MMB_store_LED_onS
{
    _mMem_FS_01.FS_MMB_store_LED_on = getValue( this );
    Mem_FS_01Changed();
}

on envVar eFS_MMB_tastS
{
    _mMem_FS_01.FS_MMB_tast = getValue( this );
    Mem_FS_01Changed();
}

on envVar eFS_MMB_tippS
{
    _mMem_FS_01.FS_MMB_tipp = getValue( this );
    Mem_FS_01Changed();
}

on envVar eFS_SHV_aktivS
{
    _mMem_FS_01.FS_SHV_aktiv = getValue( this );
    Mem_FS_01Changed();
}

on envVar eFS_Sitzfahrt_aktivS
{
    _mMem_FS_01.FS_Sitzfahrt_aktiv = getValue( this );
    Mem_FS_01Changed();
}

on envVar eFS_SLV_aktivS
{
    _mMem_FS_01.FS_SLV_aktiv = getValue( this );
    Mem_FS_01Changed();
}

on envVar eFS_SNV_aktivS
{
    _mMem_FS_01.FS_SNV_aktiv = getValue( this );
    Mem_FS_01Changed();
}

on envVar eFS_Spezialposition_anfahrenS
{
    _mMem_FS_01.FS_Spezialposition_anfahren = getValue( this );
    Mem_FS_01Changed();
}

on envVar eFS_STV_aktivS
{
    _mMem_FS_01.FS_STV_aktiv = getValue( this );
    Mem_FS_01Changed();
}

//on envVar eBFS_SIH_StatusS
//{
//  _mMem_BFS_01.BFS_SIH_Status = getValue( this );
//  Mem_BFS_01Changed();
//}
//
//on envVar eBFS_SLR_ReglerstatusS
//{
//  _mMem_BFS_01.BFS_SLR_Reglerstatus = getValue( this );
//  Mem_BFS_01Changed();
//}

//END MSG Mem_FS_01

// MSG Mem_Taster_BT_01

on Timer _tMem_Taster_BT_01
{
 // if( getValue( eTMem_Taster_BT_01 ) <= 0)  putValue( eSendMem_Taster_BT_01, 0 );
 // if( (getValue( eSendEnabled ) && getValue( eSendMem_Taster_BT_01 )) || getValue( eDlcOnceMem_Taster_BT_01 ))  sendMem_Taster_BT_01();
}

on Timer _totMem_Taster_BT_01
{
  //putValue( eTimeoutMem_Taster_BT_01, 0 );
}

on Timer _tinhMem_Taster_BT_01
{
  _bsiMem_Taster_BT_01 = 0;
  if( _bsaiMem_Taster_BT_01 && getValue( eSendEnabled ))  sendMem_Taster_BT_01();
}

void sendMem_Taster_BT_01()
{
  byte crc;
  dword bz;
  int hw;
  byte dlc;

 /* if( getValue(eChangeMem_Taster_BT_01))
  {    
    if( getValue( eDlcOnceMem_Taster_BT_01 ) || getValue( eDlcWrongMem_Taster_BT_01 ))
    {
        putValue( eDlcOnceMem_Taster_BT_01, 0 );
        _mMem_Taster_BT_01.DLC = getValue( eDlcMem_Taster_BT_01 );
    }
    else
    {
        if(GetValue(eMem_Taster_BT_01_ChngDLCEnabled))
        {
          dlc=GetValue(eMem_Taster_BT_01_ChngDLCData);
          if(dlc>0)
          {
            dlc--;
            putValue( eMem_Taster_BT_01_ChngDLCData, dlc );
            _mMem_Taster_BT_01.DLC = getValue( eDlcMem_Taster_BT_01 );
          }
          else
          {
            putValue( eMem_Taster_BT_01_ChngDLCData, 0 );
            _mMem_Taster_BT_01.DLC = 8;
          }
        }        
        else
        {
          _mMem_Taster_BT_01.DLC = 8;
        }
    }
    if(GetValue(eMem_Taster_BT_01_BZS_SingleJumpEnabled))
    {
        PutValue(eMem_Taster_BT_01_BZS_SingleJumpEnabled,0);
        _mMem_Taster_BT_01.Mem_Taster_BT_01_BZ=(_mMem_Taster_BT_01.Mem_Taster_BT_01_BZ+GetValue(eMem_Taster_BT_01_BZS_SingleJumpData))&0xf;
    }
    if(GetValue(eMem_Taster_BT_01_BZS_ResetJumpEnabled))
    {

        if(GetValue(eMem_Taster_BT_01_BZS_ResetJumpData)==_mMem_Taster_BT_01.Mem_Taster_BT_01_BZ)
        {
            PutValue(eMem_Taster_BT_01_BZS_ResetJumpEnabled,0);
            _mMem_Taster_BT_01.Mem_Taster_BT_01_BZ=0;
            putValue(eMem_Taster_BT_01_BZS,15);
        }
    }
    crc = getCRC8( _mMem_Taster_BT_01, _s_pdu_codeMem_Taster_BT_01 );
    if(GetValue(eMem_Taster_BT_01_CRC_FalseEnabled))
    {
        
        crc=~crc;
        hw=GetValue(eMem_Taster_BT_01_CRC_FalseData);
        if(hw)
        {
            hw--;
            PutValue(eMem_Taster_BT_01_CRC_FalseData,hw);
        }
        if(hw==0)
        {
            PutValue(eMem_Taster_BT_01_CRC_FalseEnabled,0);
        }

    }
    if( getValue(eMem_Taster_BT_01_CRC_ON)==0x01)
    _mMem_Taster_BT_01.Mem_Taster_BT_01_CRC = crc ^ (1 - getValue( eCrcMem_Taster_BT_01 ));    
    
    if( getValue( eBZMem_Taster_BT_01 ))
    {
        bz = getValue( eMem_Taster_BT_01_BZS );
        bz = bz + getValue( eBZStepMem_Taster_BT_01 );
        putValue( eMem_Taster_BT_01_BZS, bz % 16 );
    }
  }
  else
  {
    _mMem_Taster_BT_01.DLC = 8;

    crc = getCRC8( _mMem_Taster_BT_01, _s_pdu_codeMem_Taster_BT_01 );
     if( getValue(eMem_Taster_BT_01_CRC_ON)==0x01)
    _mMem_Taster_BT_01.Mem_Taster_BT_01_CRC = crc ^ (1 - getValue( eCrcMem_Taster_BT_01 ));
   
    
    bz = getValue( eMem_Taster_BT_01_BZS ) + 1;    
    putValue( eMem_Taster_BT_01_BZS, bz % 16 );
  }
    
  if(GetValue(eMem_Taster_BT_01_NoMsgEnabled))
  {
      hw=GetValue(eMem_Taster_BT_01_NoMsgEnabledData);
      if(hw)
      {
        hw--;
        PutValue(eMem_Taster_BT_01_NoMsgEnabledData,hw);
      }
      if(hw==0)
      {
        PutValue(eMem_Taster_BT_01_NoMsgEnabled,0);
      }        
  }
  else
  {
    output( _mMem_Taster_BT_01 );
    if( getValue(eMem_Taster_BT_01_CRC_ON)==0x01)
     putValue(eMem_Taster_BT_01_CRCS, _mMem_Taster_BT_01.Mem_Taster_BT_01_CRC);
  }
    
  cancelTimer( _tMem_Taster_BT_01 );
  if( getValue( eTMem_Taster_BT_01 ) > 0)  setTimer( _tMem_Taster_BT_01, getValue( eTMem_Taster_BT_01 ) );  else  setTimer( _tMem_Taster_BT_01, 1 );
*/}

byte isMem_Taster_BT_01Active()
{
  
 /* if( getValue( eMem_Taster_BT_01_BZS ) != 0)  return 1;
  
  if( getValue( eMem_Taster_BT_01_CRCS ) != 0)  return 1;
  
  if( getValue( eMTBT_M_TasteS ) != 0)  return 1;
  
  if( getValue( eMTBT_On_OffS ) != 0)  return 1;
  
  if( getValue( eMTBT_Pos1S ) != 0)  return 1;
  
  if( getValue( eMTBT_Pos2S ) != 0)  return 1;
  
  if( getValue( eMTBT_Pos3S ) != 0)  return 1;
  
  if( getValue( eMTBT_Pos4S ) != 0)  return 1;*/
  
  return 0;
}

Mem_Taster_BT_01Changed()
{
 /* _bMem_Taster_BT_01Active = isMem_Taster_BT_01Active();
  if( getValue( eSendEnabled ) && getValue( eSendMem_Taster_BT_01 ))
    if( _bsiMem_Taster_BT_01)
      _bsaiMem_Taster_BT_01 = 1;
    else
      sendMem_Taster_BT_01();*/
}

// END MSG Mem_Taster_BT_01

// MSG Mem_Taster_FT_01

on Timer _tMem_Taster_FT_01
{
 // if( getValue( eTMem_Taster_FT_01 ) <= 0)  putValue( eSendMem_Taster_FT_01, 0 );
 // if( (getValue( eSendEnabled ) && getValue( eSendMem_Taster_FT_01 )) || getValue( eDlcOnceMem_Taster_FT_01 ))  sendMem_Taster_FT_01();
}

on Timer _totMem_Taster_FT_01
{
 // putValue( eTimeoutMem_Taster_FT_01, 0 );
}

on Timer _tinhMem_Taster_FT_01
{
  _bsiMem_Taster_FT_01 = 0;
  if( _bsaiMem_Taster_FT_01 && getValue( eSendEnabled ))  sendMem_Taster_FT_01();
}

void sendMem_Taster_FT_01()
{
  byte crc;
  dword bz;
  int hw;
  byte dlc;

  /*if( getValue(eChangeMem_Taster_FT_01))
  {    
    if( getValue( eDlcOnceMem_Taster_FT_01 ) || getValue( eDlcWrongMem_Taster_FT_01 ))
    {
        putValue( eDlcOnceMem_Taster_FT_01, 0 );
        _mMem_Taster_FT_01.DLC = getValue( eDlcMem_Taster_FT_01 );
    }
    else
    {
        if(GetValue(eMem_Taster_FT_01_ChngDLCEnabled))
        {
          dlc=GetValue(eMem_Taster_FT_01_ChngDLCData);
          if(dlc>0)
          {
            dlc--;
            putValue( eMem_Taster_FT_01_ChngDLCData, dlc );
            _mMem_Taster_FT_01.DLC = getValue( eDlcMem_Taster_FT_01 );
          }
          else
          {
            putValue( eMem_Taster_FT_01_ChngDLCData, 0 );
            _mMem_Taster_FT_01.DLC = 8;
          }
        }        
        else
        {
          _mMem_Taster_FT_01.DLC = 8;
        }
    }
    if(GetValue(eMem_Taster_FT_01_BZS_SingleJumpEnabled))
    {
        PutValue(eMem_Taster_FT_01_BZS_SingleJumpEnabled,0);
        _mMem_Taster_FT_01.Mem_Taster_FT_01_BZ=(_mMem_Taster_FT_01.Mem_Taster_FT_01_BZ+GetValue(eMem_Taster_FT_01_BZS_SingleJumpData))&0xf;
    }
    if(GetValue(eMem_Taster_FT_01_BZS_ResetJumpEnabled))
    {

        if(GetValue(eMem_Taster_FT_01_BZS_ResetJumpData)==_mMem_Taster_FT_01.Mem_Taster_FT_01_BZ)
        {
            PutValue(eMem_Taster_FT_01_BZS_ResetJumpEnabled,0);
            _mMem_Taster_FT_01.Mem_Taster_FT_01_BZ=0;
            putValue(eMem_Taster_FT_01_BZS,15);
        }
    }
    crc = getCRC8( _mMem_Taster_FT_01, _s_pdu_codeMem_Taster_FT_01 );
    if(GetValue(eMem_Taster_FT_01_CRC_FalseEnabled))
    {
        
        crc=~crc;
        hw=GetValue(eMem_Taster_FT_01_CRC_FalseData);
        if(hw)
        {
            hw--;
            PutValue(eMem_Taster_FT_01_CRC_FalseData,hw);
        }
        if(hw==0)
        {
            PutValue(eMem_Taster_FT_01_CRC_FalseEnabled,0);
        }

    }
    if( getValue(eMem_Taster_FT_01_CRC_ON)==0x01)
    _mMem_Taster_FT_01.Mem_Taster_FT_01_CRC = crc ^ (1 - getValue( eCrcMem_Taster_FT_01 ));    
    
    if( getValue( eBZMem_Taster_FT_01 ))
    {
        bz = getValue( eMem_Taster_FT_01_BZS );
        bz = bz + getValue( eBZStepMem_Taster_FT_01 );
        putValue( eMem_Taster_FT_01_BZS, bz % 16 );
    }
  }
  else
  {
    _mMem_Taster_FT_01.DLC = 8;

    crc = getCRC8( _mMem_Taster_FT_01, _s_pdu_codeMem_Taster_FT_01 );
     if( getValue(eMem_Taster_FT_01_CRC_ON)==0x01)
    _mMem_Taster_FT_01.Mem_Taster_FT_01_CRC = crc ^ (1 - getValue( eCrcMem_Taster_FT_01 ));
   
    
    bz = getValue( eMem_Taster_FT_01_BZS ) + 1;    
    putValue( eMem_Taster_FT_01_BZS, bz % 16 );
  }
    
  if(GetValue(eMem_Taster_FT_01_NoMsgEnabled))
  {
      hw=GetValue(eMem_Taster_FT_01_NoMsgEnabledData);
      if(hw)
      {
        hw--;
        PutValue(eMem_Taster_FT_01_NoMsgEnabledData,hw);
      }
      if(hw==0)
      {
        PutValue(eMem_Taster_FT_01_NoMsgEnabled,0);
      }        
  }
  else
  {
    output( _mMem_Taster_FT_01 );
    if( getValue(eMem_Taster_FT_01_CRC_ON)==0x01)
     putValue(eMem_Taster_FT_01_CRCS, _mMem_Taster_FT_01.Mem_Taster_FT_01_CRC);
  }
    
  cancelTimer( _tMem_Taster_FT_01 );
  if( getValue( eTMem_Taster_FT_01 ) > 0)  setTimer( _tMem_Taster_FT_01, getValue( eTMem_Taster_FT_01 ) );  else  setTimer( _tMem_Taster_FT_01, 1 );
*/}

byte isMem_Taster_FT_01Active()
{
  
 /* if( getValue( eMem_Taster_FT_01_BZS ) != 0)  return 1;
  
  if( getValue( eMem_Taster_FT_01_CRCS ) != 0)  return 1;
  
  if( getValue( eMTFT_M_TasteS ) != 0)  return 1;
  
  if( getValue( eMTFT_On_OffS ) != 0)  return 1;
  
  if( getValue( eMTFT_Pos1_EES ) != 0)  return 1;
  
  if( getValue( eMTFT_Pos2S ) != 0)  return 1;
  
  if( getValue( eMTFT_Pos3S ) != 0)  return 1;
  
  if( getValue( eMTFT_Pos4S ) != 0)  return 1;
  
  if( getValue( eMTFT_Verst_aktS ) != 0)  return 1;*/
  
  return 0;
}

Mem_Taster_FT_01Changed()
{
  /*_bMem_Taster_FT_01Active = isMem_Taster_FT_01Active();
  if( getValue( eSendEnabled ) && getValue( eSendMem_Taster_FT_01 ))
    if( _bsiMem_Taster_FT_01)
      _bsaiMem_Taster_FT_01 = 1;
    else
      sendMem_Taster_FT_01();*/
}

// END MSG Mem_Taster_FT_01


// MSG MFG_01

on Timer _tMFG_01
{
    if( getValue( eTMFG_01 ) <= 0)  putValue( eSendMFG_01, 0 );
    if( (getValue( eSendEnabled ) && getValue( eSendMFG_01 )) || getValue( eDlcOnceMFG_01 ))  sendMFG_01();
}

on envVar eSendMFG_01
{
    if( getValue( eSendEnabled ) && getValue( eSendMFG_01 ))  sendMFG_01();
}

on envVar eTimeoutMFG_01
{
    cancelTimer( _tMFG_01 );
    cancelTimer( _totMFG_01 );
    if( getValue( this ))
        setTimer( _totMFG_01, (getValue( eSendEnabled ) && getValue( eSendMFG_01 ) && (getValue( eTOTMFG_01 ) > 0)) ? getValue( eTOTMFG_01 ) : 1 );
    else
        if( getValue( eSendEnabled ) && getValue( eSendMFG_01 ))  sendMFG_01();
}

on Timer _totMFG_01
{
    putValue( eTimeoutMFG_01, 0 );
}

on envVar eDlcOnceMFG_01
{
    if( getValue( eDlcOnceMFG_01 ) && !(getValue( eSendEnabled ) && getValue( eSendMFG_01 )))  setTimer( _tMFG_01, 1 );
}

on Timer _tinhMFG_01
{
    _bsiMFG_01 = 0;
    if( _bsaiMFG_01 && getValue( eSendEnabled ))  sendMFG_01();
}

void sendMFG_01()
{
    byte crc;
    dword bz;

    if( getValue(eChangeMFG_01))
    {
        if( getValue( eDlcOnceMFG_01 ) || getValue( eDlcWrongMFG_01 ))
        {
            putValue( eDlcOnceMFG_01, 0 );
            _mMFG_01.DLC = getValue( eDlcMFG_01 );
        }
        else
        {
            _mMFG_01.DLC = 8;
    }
            crc = getCRC8( _mMFG_01, _s_pdu_codeMFG_01 );
        _mMFG_01.MFG_01_CRC = crc ^ (1 - getValue( eCrcMFG_01 ));

        if( getValue( eBZMFG_01 ))
        {
            bz = getValue( eMFG_01_BZS );
            bz = bz + getValue( eBZStepMFG_01 );
            putValue( eMFG_01_BZS, bz % 16 );
        }
    }
    else
    {
        _mMFG_01.DLC = 8;

        crc = getCRC8( _mMFG_01, _s_pdu_codeMFG_01 );
        _mMFG_01.MFG_01_CRC = crc ^ (1 - getValue( eCrcMFG_01 ));

        bz = getValue( eMFG_01_BZS ) + 1;
        putValue( eMFG_01_BZS, bz % 16 );
    }

    {
        output( _mMFG_01 );
    }

    cancelTimer( _tMFG_01 );
    if( getValue( eTMFG_01 ) > 0)  setTimer( _tMFG_01, getValue( eTMFG_01 ) );  else  setTimer( _tMFG_01, 1 );
    _bsaiMFG_01 = 0;
    _bsiMFG_01 = 1;
    cancelTimer( _tinhMFG_01 );  setTimer( _tinhMFG_01, 20 );
}

MFG_01Changed()
{
    if( getValue( eSendEnabled ) && getValue( eSendMFG_01 ))
        if( _bsiMFG_01)
            _bsaiMFG_01 = 1;
        else
            sendMFG_01();
}

on envVar eMF_AbzugssperreS
{
    _mMFG_01.MF_Abzugssperre.phys = getValue( this );
    MFG_01Changed();
}

on envVar eMF_Alarm_BlinkerS
{
    _mMFG_01.MF_Alarm_Blinker.phys = getValue( this );
    MFG_01Changed();
}

on envVar eMF_Alarm_BlinkertaktS
{
    _mMFG_01.MF_Alarm_Blinkertakt.phys = getValue( this );
    MFG_01Changed();
}

on envVar eMF_AnlassersperreS
{
    _mMFG_01.MF_Anlassersperre.phys = getValue( this );
    MFG_01Changed();
}

on envVar eMF_Blk_liS
{
    _mMFG_01.MF_Blk_li.phys = getValue( this );
    MFG_01Changed();
}

on envVar eMF_Blk_reS
{
    _mMFG_01.MF_Blk_re.phys = getValue( this );
    MFG_01Changed();
}

on envVar eMF_FahrlichtS
{
  _mMFG_01.MF_Fahrlicht = getValue( this );
  MFG_01Changed();
}

on envVar eMF_Fernbed_einS
{
  _mMFG_01.MF_Fernbed_ein = getValue( this );
  MFG_01Changed();
}

on envVar eMF_FernlichtS
{
  _mMFG_01.MF_Fernlicht = getValue( this );
  MFG_01Changed();
}

on envVar eMF_FH_BT_hochS
{
  _mMFG_01.MF_FH_BT_hoch = getValue( this );
  MFG_01Changed();
}

on envVar eMF_FH_BT_tiefS
{
  _mMFG_01.MF_FH_BT_tief = getValue( this );
  MFG_01Changed();
}

on envVar eMF_FH_FT_hochS
{
  _mMFG_01.MF_FH_FT_hoch = getValue( this );
  MFG_01Changed();
}

on envVar eMF_FH_FT_tiefS
{
  _mMFG_01.MF_FH_FT_tief = getValue( this );
  MFG_01Changed();
}

on envVar eMF_FrontintervallS
{
  _mMFG_01.MF_Frontintervall = getValue( this );
  MFG_01Changed();
}

on envVar eMF_FrontwaschenS
{
  _mMFG_01.MF_Frontwaschen = getValue( this );
  MFG_01Changed();
}

on envVar eMF_FussraumbelS
{
  _mMFG_01.MF_Fussraumbel = getValue( this );
  MFG_01Changed();
}

on envVar eMF_HeckintervallS
{
  _mMFG_01.MF_Heckintervall = getValue( this );
  MFG_01Changed();
}

on envVar eMF_HeckwaschenS
{
  _mMFG_01.MF_Heckwaschen = getValue( this );
  MFG_01Changed();
}

on envVar eMF_InnenraumbelS
{
  _mMFG_01.MF_Innenraumbel = getValue( this );
  MFG_01Changed();
}

on envVar eMF_Innenraumbel_UnterdrueckS
{
  _mMFG_01.MF_Innenraumbel_Unterdrueck = getValue( this );
  MFG_01Changed();
}

on envVar eMF_interm_FahrlichtS
{
  _mMFG_01.MF_interm_Fahrlicht = getValue( this );
  MFG_01Changed();
}

on envVar eMF_interm_FernlichtS
{
  _mMFG_01.MF_interm_Fernlicht = getValue( this );
  MFG_01Changed();
}

on envVar eMF_interm_TaktS
{
  _mMFG_01.MF_interm_Takt = getValue( this );
  MFG_01Changed();
}

on envVar eMF_LichthupeS
{
  _mMFG_01.MF_Lichthupe = getValue( this );
  MFG_01Changed();
}

on envVar eMF_MotorweiterlaufS
{
  _mMFG_01.MF_Motorweiterlauf = getValue( this );
  MFG_01Changed();
}

on envVar eMF_Schluessel_scanS
{
  _mMFG_01.MF_Schluessel_scan = getValue( this );
  MFG_01Changed();
}

on envVar eMF_SignalhornS
{
  _mMFG_01.MF_Signalhorn = getValue( this );
  MFG_01Changed();
}

on envVar eMF_StandlichtS
{
  _mMFG_01.MF_Standlicht = getValue( this );
  MFG_01Changed();
}

on envVar eMF_StartStopp_InfoS
{
  _mMFG_01.MF_StartStopp_Info = getValue( this );
  MFG_01Changed();
}

on envVar eMF_SummerS
{
  _mMFG_01.MF_Summer = getValue( this );
  MFG_01Changed();
}

on envVar eMF_TFL_AbschaltungS
{
  _mMFG_01.MF_TFL_Abschaltung = getValue( this );
  MFG_01Changed();
}

on envVar eMF_TippwischenS
{
  _mMFG_01.MF_Tippwischen = getValue( this );
  MFG_01Changed();
}

on envVar eMF_Tuerentriegelung_hintenS
{
  _mMFG_01.MF_Tuerentriegelung_hinten = getValue( this );
  MFG_01Changed();
}

on envVar eMF_VarianteS
{
  _mMFG_01.MF_Variante = getValue( this );
  MFG_01Changed();
}

on envVar eMF_WarnblinkerS
{
  _mMFG_01.MF_Warnblinker = getValue( this );
  MFG_01Changed();
}

on envVar eMF_Wischerstufe_1S
{
  _mMFG_01.MF_Wischerstufe_1 = getValue( this );
  MFG_01Changed();
}

on envVar eMF_Wischerstufe_2S
{
  _mMFG_01.MF_Wischerstufe_2 = getValue( this );
  MFG_01Changed();
}

on envVar eMFG_01_BZS
{
  _mMFG_01.MFG_01_BZ = getValue( this );
  //MFG_01Chaged();
}

//END MSG MFG_01

// MSG MFG_02

on Timer _tMFG_02
{
//  if( getValue( eTMFG_02 ) <= 0)  putValue( eSendMFG_02, 0 );
 // if( (getValue( eSendEnabled ) && getValue( eSendMFG_02 )) || getValue( eDlcOnceMFG_02 ))  sendMFG_02();
}

on Timer _totMFG_02
{
//  putValue( eTimeoutMFG_02, 0 );
}

void sendMFG_02()
{
  /*if( getValue(eChangeMFG_02))
  {
     if( getValue( eDlcOnceMFG_02 ) || getValue( eDlcWrongMFG_02 ))
     { 
        putValue( eDlcOnceMFG_02, 0 );
        _mMFG_02.DLC = getValue( eDlcMFG_02 );
     }
     else
     {
      _mMFG_02.DLC = 8;
     }
   }
   else
   {
        _mMFG_02.DLC = 8;
   }

   output( _mMFG_02 );
  cancelTimer( _tMFG_02 );
  if( getValue( eTMFG_02 ) > 0)  setTimer( _tMFG_02, getValue( eTMFG_02 ) );  else  setTimer( _tMFG_02, 1 );*/
}

// END MSG MFG_02

// MSG MFG_03 // cyclicifActiveFast but has nr of repetition property in DBC---strange

on Timer _tMFG_03
{
    if( getValue( eTMFG_03 ) <= 0)  putValue( eSendMFG_03, 0 );
    if( (getValue( eSendEnabled ) && getValue( eSendMFG_03 )) || getValue( eDlcOnceMFG_03 ))  sendMFG_03();
}

on Timer _totMFG_03
{
    putValue( eTimeoutMFG_03, 0 );
}

on Timer _tinhMFG_03
{
    _bsiMFG_03 = 0;
    if( _bsaiMFG_03 && getValue( eSendEnabled ))  sendMFG_03();
}

void sendMFG_03()
{
    if( getValue(eChangeMFG_03))
    {
        if( getValue( eDlcOnceMFG_03 ) || getValue( eDlcWrongMFG_03 ))
        {
            putValue( eDlcOnceMFG_03, 0 );
            _mMFG_03.DLC = getValue( eDlcMFG_03 );
        }
        else
        {
            _mMFG_03.DLC = 8;
        }
    }
    else
    {
        _mMFG_03.DLC = 8;
    }

    output( _mMFG_03 );
    cancelTimer( _tMFG_03 );
    if( getValue( eTMFG_03 ) > 0)  setTimer( _tMFG_03, getValue( eTMFG_03 ) );  else  setTimer( _tMFG_03, 1 );
    _bsaiMFG_03 = 0;
    _bsiMFG_03 = 1;
    cancelTimer( _tinhMFG_03 );  setTimer( _tinhMFG_03, 100 );
}

byte isMFG_03Active()
{
  
  if( getValue( eMF_2BatSOCzugeringS ) != 0)  return 1;
  
  if( getValue( eMF_2BattAbS ) != 0)  return 1;
  
  if( getValue( eMF_2BattHlkAnfS ) != 0)  return 1;
  
  if( getValue( eMF_2BattLadWarnS ) != 0)  return 1;
  
  if( getValue( eMF_2BattLlaAnfS ) != 0)  return 1;
  
  if( getValue( eMF_2BattSpannungsAnfS ) != 0)  return 1;
  
  if( getValue( eMF_BatteriediagnoseS ) != 0)  return 1;
  
  if( getValue( eMF_Blinker_L_StaS ) != 0)  return 1;
  
  if( getValue( eMF_Blinker_R_StaS ) != 0)  return 1;
  
  if( getValue( eMF_ExterneLadungWarnS ) != 0)  return 1;
  
  if( getValue( eMF_FahrerhinweisS ) != 0)  return 1;
  
  if( getValue( eMF_GeneratordiagnoseS ) != 0)  return 1;
  
  if( getValue( eMF_Heck_entriegelnS ) != 0)  return 1;
  
  if( getValue( eMF_Heck_verriegelnS ) != 0)  return 1;
  
  if( getValue( eMF_interm_NebelscheinwerferS ) != 0)  return 1;
  
  if( getValue( eMF_LampenausfallS ) != 0)  return 1;
  
  if( getValue( eMF_LSH_AbschaltstufeS ) != 0)  return 1;
  
  if( getValue( eMF_LSH_EinschaltverbotS ) != 0)  return 1;
  
  if( getValue( eMF_LSH_ZielzeitS ) != 0)  return 1;
  
  if( getValue( eMF_NotStartAktivS ) != 0)  return 1;
  
  if( getValue( eMF_Tuerverriegelung_hintenS ) != 0)  return 1;
  
  if( getValue( eMF_ZV_UnlockS ) != 0)  return 1;
  
  if( getValue( eMFG_AppConnect_AnfS ) != 0)  return 1;
  
  return 0;
}

MFG_03Changed()
{
  _bMFG_03Active = isMFG_03Active();
  if( getValue( eSendEnabled ) && getValue( eSendMFG_03 ))
    if( _bsiMFG_03)
      _bsaiMFG_03 = 1;
    else
      sendMFG_03();
}
on envVar eMF_2BatSOCzugeringS
{
    _mMFG_03.MF_2BatSOCzugering = getValue( this );
    MFG_03Changed();
}

on envVar eMF_2BattAbS
{
    _mMFG_03.MF_2BattAb = getValue( this );
    MFG_03Changed();
}

on envVar eMF_2BattHlkAnfS
{
    _mMFG_03.MF_2BattHlkAnf = getValue( this );
    MFG_03Changed();
}

on envVar eMF_2BattLadWarnS
{
    _mMFG_03.MF_2BattLadWarn = getValue( this );
    MFG_03Changed();
}

on envVar eMF_2BattLlaAnfS
{
    _mMFG_03.MF_2BattLlaAnf = getValue( this );
    MFG_03Changed();
}

on envVar eMF_2BattSpannungsAnfS
{
    _mMFG_03.MF_2BattSpannungsAnf = getValue( this );
    MFG_03Changed();
}

on envVar eMF_BatteriediagnoseS
{
    _mMFG_03.MF_Batteriediagnose = getValue( this );
    MFG_03Changed();
}

on envVar eMF_Blinker_L_StaS
{
    _mMFG_03.MF_Blinker_L_Sta = getValue( this );
    MFG_03Changed();
}

on envVar eMF_Blinker_R_StaS
{
    _mMFG_03.MF_Blinker_R_Sta = getValue( this );
    MFG_03Changed();
}

on envVar eMF_ExterneLadungWarnS
{
    _mMFG_03.MF_ExterneLadungWarn = getValue( this );
    MFG_03Changed();
}

on envVar eMF_FahrerhinweisS
{
    _mMFG_03.MF_Fahrerhinweis = getValue( this );
    MFG_03Changed();
}

on envVar eMF_GeneratordiagnoseS
{
    _mMFG_03.MF_Generatordiagnose = getValue( this );
    MFG_03Changed();
}

on envVar eMF_Heck_entriegelnS
{
    _mMFG_03.MF_Heck_entriegeln = getValue( this );
    MFG_03Changed();
}

on envVar eMF_Heck_verriegelnS
{
    _mMFG_03.MF_Heck_verriegeln = getValue( this );
    MFG_03Changed();
}

on envVar eMF_interm_NebelscheinwerferS
{
    _mMFG_03.MF_interm_Nebelscheinwerfer = getValue( this );
    MFG_03Changed();
}

on envVar eMF_LampenausfallS
{
    _mMFG_03.MF_Lampenausfall = getValue( this );
    MFG_03Changed();
}

on envVar eMF_LSH_AbschaltstufeS
{
    _mMFG_03.MF_LSH_Abschaltstufe = getValue( this );
    MFG_03Changed();
}

on envVar eMF_LSH_EinschaltverbotS
{
    _mMFG_03.MF_LSH_Einschaltverbot = getValue( this );
    MFG_03Changed();
}

on envVar eMF_LSH_ZielzeitS
{
    _mMFG_03.MF_LSH_Zielzeit = getValue( this );
    MFG_03Changed();
}

on envVar eMF_NotStartAktivS
{
    _mMFG_03.MF_NotStartAktiv = getValue( this );
    MFG_03Changed();
}

on envVar eMF_Tuerverriegelung_hintenS
{
    _mMFG_03.MF_Tuerverriegelung_hinten = getValue( this );
     MFG_03Changed();
}

on envVar eMF_ZV_UnlockS
{
    _mMFG_03.MF_ZV_Unlock = getValue( this );
    MFG_03Changed();
}

on envVar eMFG_AppConnect_AnfS
{
    _mMFG_03.MFG_AppConnect_Anf = getValue( this );
    MFG_03Changed();
}


//END MSG MFG_03

//NMH BLOCK

// MSG PAO_Status_01

on Timer _tPAO_Status_01
{
 // if( getValue( eTPAO_Status_01 ) <= 0)  putValue( eSendPAO_Status_01, 0 );
 // if( (getValue( eSendEnabled ) && getValue( eSendPAO_Status_01 )) || getValue( eDlcOncePAO_Status_01 ))  sendPAO_Status_01();
}

on Timer _totPAO_Status_01
{
  //putValue( eTimeoutPAO_Status_01, 0 );
}

void sendPAO_Status_01()
{
 /* if( getValue(eChangePAO_Status_01))
  {
     if( getValue( eDlcOncePAO_Status_01 ) || getValue( eDlcWrongPAO_Status_01 ))
     { 
        putValue( eDlcOncePAO_Status_01, 0 );
        _mPAO_Status_01.DLC = getValue( eDlcPAO_Status_01 );
     }
     else
     {
      _mPAO_Status_01.DLC = 8;
     }
   }
   else
   {
        _mPAO_Status_01.DLC = 8;
   }

   output( _mPAO_Status_01 );
  cancelTimer( _tPAO_Status_01 );
  if( getValue( eTPAO_Status_01 ) > 0)  setTimer( _tPAO_Status_01, getValue( eTPAO_Status_01 ) );  else  setTimer( _tPAO_Status_01, 1 );*/
}

// END MSG PAO_Status_01

// MSG NMH_BCM1

on Timer _tNMH_BCM1
{
 // if( getValue( eTNMH_BCM1 ) <= 0)  putValue( eSendNMH_BCM1, 0 );
 // if( (getValue( eSendEnabled ) && getValue( eSendNMH_BCM1 )) || getValue( eDlcOnceNMH_BCM1 ))  sendNMH_BCM1();
}

on Timer _totNMH_BCM1
{
 // putValue( eTimeoutNMH_BCM1, 0 );
}

void sendNMH_BCM1()
{
 /* if( getValue(eChangeNMH_BCM1))
  {
     if( getValue( eDlcOnceNMH_BCM1 ) || getValue( eDlcWrongNMH_BCM1 ))
     { 
        putValue( eDlcOnceNMH_BCM1, 0 );
        _mNMH_BCM1.DLC = getValue( eDlcNMH_BCM1 );
     }
     else
     {
      _mNMH_BCM1.DLC = 8;
     }
   }
   else
   {
        _mNMH_BCM1.DLC = 8;
   }

   output( _mNMH_BCM1 );
  cancelTimer( _tNMH_BCM1 );
  if( getValue( eTNMH_BCM1 ) > 0)  setTimer( _tNMH_BCM1, getValue( eTNMH_BCM1 ) );  else  setTimer( _tNMH_BCM1, 1 );*/
}

// END MSG NMH_BCM1


// MSG Personalisierung_01 - this msg has delay time 

on Timer _tPersonalisierung_01
{
  if( getValue( eTPersonalisierung_01 ) <= 0)  putValue( eSendPersonalisierung_01, 0 );
  if( (getValue( eSendEnabled ) && getValue( eSendPersonalisierung_01 )) || getValue( eDlcOncePersonalisierung_01 ))  sendPersonalisierung_01();
}

on Timer _totPersonalisierung_01
{
  putValue( eTimeoutPersonalisierung_01, 0 );
}

//IssueList #173 MR 55685

void sendPersonalisierung_01()
{
    if( getValue(eChangePersonalisierung_01))
    {    
        if( getValue( eDlcOncePersonalisierung_01 ) || getValue( eDlcWrongPersonalisierung_01 ))
        {
            putValue( eDlcOncePersonalisierung_01, 0 );
            _mPersonalisierung_01.DLC = getValue( eDlcPersonalisierung_01 );
        } 
        else
        {        
            _mPersonalisierung_01.DLC = 8;
        }   
    }
    else
    { 
        _mPersonalisierung_01.DLC = 8;
    }
    output( _mPersonalisierung_01 );

    cancelTimer( _tPersonalisierung_01 );
    if( getValue( eTPersonalisierung_01 ) > 0)  setTimer( _tPersonalisierung_01, getValue( eTPersonalisierung_01 ) );  else  setTimer( _tPersonalisierung_01, 1 );
}

on envVar eSendPersonalisierung_01
{
    if( getValue( eSendEnabled ) && getValue( eSendPersonalisierung_01 ))  sendPersonalisierung_01();
}

on envVar eTimeoutPersonalisierung_01
{
    cancelTimer( _tPersonalisierung_01 );
    cancelTimer( _totPersonalisierung_01 );
    if( getValue( this ))
        setTimer( _totPersonalisierung_01, (getValue( eSendEnabled ) && getValue( eSendPersonalisierung_01 ) && (getValue( eTOTPersonalisierung_01 ) > 0)) ? getValue( eTOTPersonalisierung_01 ) : 1 );
    else
        if( getValue( eSendEnabled ) && getValue( eSendPersonalisierung_01 ))  sendPersonalisierung_01();
}

on envVar eDlcOncePersonalisierung_01
{
    if( getValue( eDlcOncePersonalisierung_01 ) && !(getValue( eSendEnabled ) && getValue( eSendPersonalisierung_01 )))  setTimer( _tPersonalisierung_01, 1 );
}

on envVar ePerso_KontonummerS
{
    _mPersonalisierung_01.Perso_Kontonummer.phys = getValue( this );
//  Personalisierung_01Changed();
}

on envVar ePerso_StatusS
{
    _mPersonalisierung_01.Perso_Status.phys = getValue( this );
 // Personalisierung_01Changed();
}

on envVar ePerso_SteuerungS
{
    _mPersonalisierung_01.Perso_Steuerung.phys = getValue( this );
//  Personalisierung_01Changed();
}

on envVar ePerso_SteuerungsparameterS
{
    _mPersonalisierung_01.Perso_Steuerungsparameter.phys = getValue( this );
//  Personalisierung_01Changed();
}

//END MSG Personalisierung_01

// MSG PTC_01

on Timer _tPTC_01
{
 // if( getValue( eTPTC_01 ) <= 0)  putValue( eSendPTC_01, 0 );
 // if( (getValue( eSendEnabled ) && getValue( eSendPTC_01 )) || getValue( eDlcOncePTC_01 ))  sendPTC_01();
}

on Timer _totPTC_01
{
 // putValue( eTimeoutPTC_01, 0 );
}

void sendPTC_01()
{
 /* if( getValue(eChangePTC_01))
  {
     if( getValue( eDlcOncePTC_01 ) || getValue( eDlcWrongPTC_01 ))
     { 
        putValue( eDlcOncePTC_01, 0 );
        _mPTC_01.DLC = getValue( eDlcPTC_01 );
     }
     else
     {
      _mPTC_01.DLC = 8;
     }
   }
   else
   {
        _mPTC_01.DLC = 8;
   }

   output( _mPTC_01 );
  cancelTimer( _tPTC_01 );
  if( getValue( eTPTC_01 ) > 0)  setTimer( _tPTC_01, getValue( eTPTC_01 ) );  else  setTimer( _tPTC_01, 1 );*/
}

// END MSG PTC_01

// MSG Reset

on Timer _tReset
{
 // if( getValue( eTReset ) <= 0)  putValue( eSendReset, 0 );
 // if( (getValue( eSendEnabled ) && getValue( eSendReset )) || getValue( eDlcOnceReset ))  sendReset();
}

on Timer _totReset
{
 // putValue( eTimeoutReset, 0 );
}

void sendReset()
{
 /* if( getValue(eChangeReset))
  {
     if( getValue( eDlcOnceReset ) || getValue( eDlcWrongReset ))
     { 
        putValue( eDlcOnceReset, 0 );
        _mReset.DLC = getValue( eDlcReset );
     }
     else
     {
      _mReset.DLC = 8;
     }
   }
   else
   {
        _mReset.DLC = 8;
   }

   output( _mReset );
  cancelTimer( _tReset );
  if( getValue( eTReset ) > 0)  setTimer( _tReset, getValue( eTReset ) );  else  setTimer( _tReset, 1 );*/
}

// END MSG Reset

// MSG RLS_01

on Timer _tRLS_01
{
    if( getValue( eTRLS_01 ) <= 0)  putValue( eSendRLS_01, 0 );
    if( ( getValue( eSendEnabled ) && getValue( eSendRLS_01 )) || getValue( eDlcOnceRLS_01 ))  sendRLS_01();
}

on envVar eSendRLS_01
{
    if( getValue( eSendEnabled ) && getValue( eSendRLS_01 ))  sendRLS_01();
}

on envVar eTimeoutRLS_01
{
    cancelTimer( _tRLS_01 );
    cancelTimer( _totRLS_01 );
    if( getValue( this ))
        setTimer( _totRLS_01, (getValue( eSendEnabled ) && getValue( eSendRLS_01 ) && (getValue( eTOTRLS_01 ) > 0)) ? getValue( eTOTRLS_01 ) : 1 );
    else
        if( getValue( eSendEnabled ) && getValue( eSendRLS_01 ))  sendRLS_01();
}

on Timer _totRLS_01
{
    putValue( eTimeoutRLS_01, 0 );
}

on envVar eDlcOnceRLS_01
{
    if( getValue( eDlcOnceRLS_01 ) && !(getValue( eSendEnabled ) && getValue( eSendRLS_01 )))  setTimer( _tRLS_01, 1 );
}

void sendRLS_01()
{
    if( getValue(eChangeRLS_01))
    {
        if( getValue( eDlcOnceRLS_01 ) || getValue( eDlcWrongRLS_01 ))
        {
            putValue( eDlcOnceRLS_01, 0 );
            _mRLS_01.DLC = getValue( eDlcRLS_01 );
        }
        else
        {
            _mRLS_01.DLC = 5;
        }
    }
    else
    {
        _mRLS_01.DLC = 5;        
    }

    output( _mRLS_01 );

    cancelTimer( _tRLS_01 );
    if( getValue( eTRLS_01 ) > 0)  setTimer( _tRLS_01, getValue( eTRLS_01 ) );  else  setTimer( _tRLS_01, 1 );
}

on envVar eLS_defektS
{
    _mRLS_01.LS_defekt.phys = getValue( this );
}

on envVar eLS_Helligkeit_FWS
{
    _mRLS_01.LS_Helligkeit_FW.phys = getValue( this );
}

on envVar eLS_Helligkeit_IRS
{
    _mRLS_01.LS_Helligkeit_IR.phys = getValue( this );
}

on envVar eLS_VerbauS
{
    _mRLS_01.LS_Verbau.phys = getValue( this );
}

on envVar eRS_defektS
{
    _mRLS_01.RS_defekt.phys = getValue( this );
}

on envVar eRS_RegenmengeS
{
    _mRLS_01.RS_Regenmenge.phys = getValue( this );
}

on envVar eRS_VerbauS
{
    _mRLS_01.RS_Verbau.phys = getValue( this );
}

on envVar eRS_Verglasung_schliessenS
{
    _mRLS_01.RS_Verglasung_schliessen.phys = getValue( this );
}

on envVar eRS_WischergeschwindigkeitS
{
    _mRLS_01.RS_Wischergeschwindigkeit.phys = getValue( this );
}

// END MSG RLS_01

// MSG SAD_01

on Timer _tSAD_01
{
 // if( getValue( eTSAD_01 ) <= 0)  putValue( eSendSAD_01, 0 );
 // if( (getValue( eSendEnabled ) && getValue( eSendSAD_01 )) || getValue( eDlcOnceSAD_01 ))  sendSAD_01();
}

on Timer _totSAD_01
{
 // putValue( eTimeoutSAD_01, 0 );
}

on Timer _tinhSAD_01
{
  _bsiSAD_01 = 0;
  if( _bsaiSAD_01 && getValue( eSendEnabled ))  sendSAD_01();
}

void sendSAD_01()
{
 /* if( getValue(eChangeSAD_01))
  {
    if( getValue( eDlcOnceSAD_01 ) || getValue( eDlcWrongSAD_01 ))
    {
        putValue( eDlcOnceSAD_01, 0 );
        _mSAD_01.DLC = getValue( eDlcSAD_01 );
    }
    else
    {
        _mSAD_01.DLC = 8;
    }
  }
  else
  {
    _mSAD_01.DLC = 8;
  }

  output( _mSAD_01 );
  cancelTimer( _tSAD_01 );
  if( getValue( eTSAD_01 ) > 0)  setTimer( _tSAD_01, getValue( eTSAD_01 ) );  else  setTimer( _tSAD_01, 1 );
  _bsaiSAD_01 = 0;
  _bsiSAD_01 = 1;
  cancelTimer( _tinhSAD_01 );  setTimer( _tinhSAD_01, 100 );*/
}

SAD_01Changed()
{
/*  if( getValue( eSendEnabled ) && getValue( eSendSAD_01 ))
    if( _bsiSAD_01)
      _bsaiSAD_01 = 1;
    else
      sendSAD_01();*/
}

//END MSG SAD_01

// MSG Sensorik_mDimmung_01

on Timer _tSensorik_Dimmung_01
{
//  if( getValue( eTSensorik_Dimmung_01 ) <= 0)  putValue( eSendSensorik_mDimmung_01, 0 );
 // if( (getValue( eSendEnabled ) && getValue( eSendSensorik_Dimmung_01 )) || getValue( eDlcOnceSensorik_Dimmung_01 ))  sendSensorik_Dimmung_01();
}

on Timer _totSensorik_Dimmung_01
{
 // putValue( eTimeoutSensorik_Dimmung_01, 0 );
}

on Timer _tinhSensorik_Dimmung_01
{
  _bsiSensorik_Dimmung_01 = 0;
//  if( _bsaiSensorik_Dimmung_01 && getValue( eSendEnabled ))  sendSensorik_Dimmung_01();
}

void sendSensorik_Dimmung_01()
{
 /* if( getValue(eChangeSensorik_mDimmung_01))
  {
    if( getValue( eDlcOnceSensorik_mDimmung_01 ) || getValue( eDlcWrongSensorik_mDimmung_01 ))
    {
        putValue( eDlcOnceSensorik_mDimmung_01, 0 );
        _mSensorik_mDimmung_01.DLC = getValue( eDlcSensorik_mDimmung_01 );
    }
    else
    {
        _mSensorik_mDimmung_01.DLC = 8;
    }
  }
  else
  {
    _mSensorik_mDimmung_01.DLC = 8;
  }

  output( _mSensorik_mDimmung_01 );
  cancelTimer( _tSensorik_mDimmung_01 );
  if( getValue( eTSensorik_mDimmung_01 ) > 0)  setTimer( _tSensorik_mDimmung_01, getValue( eTSensorik_mDimmung_01 ) );  else  setTimer( _tSensorik_mDimmung_01, 1 );
  _bsaiSensorik_mDimmung_01 = 0;
  _bsiSensorik_mDimmung_01 = 1;
  cancelTimer( _tinhSensorik_mDimmung_01 );  setTimer( _tinhSensorik_mDimmung_01, 100 );*/
}

Sensorik_mDimmung_01Changed()
{
  /*if( getValue( eSendEnabled ) && getValue( eSendSensorik_mDimmung_01 ))
    if( _bsiSensorik_mDimmung_01)
      _bsaiSensorik_mDimmung_01 = 1;
    else
      sendSensorik_mDimmung_01();*/
}

//END MSG Sensorik_mDimmung_01

// MSG Service_Key_01

on Timer _tService_Key_01
{
 // if( getValue( eTService_Key_01 ) <= 0)  putValue( eSendService_Key_01, 0 );
 // if( (getValue( eSendEnabled ) && getValue( eSendService_Key_01 )) || getValue( eDlcOnceService_Key_01 ))  sendService_Key_01();
}

on Timer _totService_Key_01
{
 // putValue( eTimeoutService_Key_01, 0 );
}

void sendService_Key_01()
{
/*  if( getValue(eChangeService_Key_01))
  {
     if( getValue( eDlcOnceService_Key_01 ) || getValue( eDlcWrongService_Key_01 ))
     { 
        putValue( eDlcOnceService_Key_01, 0 );
        _mService_Key_01.DLC = getValue( eDlcService_Key_01 );
     }
     else
     {
      _mService_Key_01.DLC = 8;
     }
   }
   else
   {
        _mService_Key_01.DLC = 8;
   }

   output( _mService_Key_01 );
  cancelTimer( _tService_Key_01 );
  if( getValue( eTService_Key_01 ) > 0)  setTimer( _tService_Key_01, getValue( eTService_Key_01 ) );  else  setTimer( _tService_Key_01, 1 );*/
}

// END MSG Service_Key_01
// MSG SM_LAPP_01

on Timer _tSM_LAPP_01
{
//  if( getValue( eTSM_LAPP_01 ) <= 0)  putValue( eSendSM_LAPP_01, 0 );
//  if( (getValue( eSendEnabled ) && getValue( eSendSM_LAPP_01 )) || getValue( eDlcOnceSM_LAPP_01 ))  sendSM_LAPP_01();
}

on Timer _totSM_LAPP_01
{
 // putValue( eTimeoutSM_LAPP_01, 0 );
}

on Timer _tinhSM_LAPP_01
{
  _bsiSM_LAPP_01 = 0;
  if( _bsaiSM_LAPP_01 && getValue( eSendEnabled ))  sendSM_LAPP_01();
}

void sendSM_LAPP_01()
{
 /* if( getValue(eChangeSM_LAPP_01))
  {
    if( getValue( eDlcOnceSM_LAPP_01 ) || getValue( eDlcWrongSM_LAPP_01 ))
    {
        putValue( eDlcOnceSM_LAPP_01, 0 );
        _mSM_LAPP_01.DLC = getValue( eDlcSM_LAPP_01 );
    }
    else
    {
        _mSM_LAPP_01.DLC = 8;
    }
  }
  else
  {
    _mSM_LAPP_01.DLC = 8;
  }

  output( _mSM_LAPP_01 );
  cancelTimer( _tSM_LAPP_01 );
  if( getValue( eTSM_LAPP_01 ) > 0)  setTimer( _tSM_LAPP_01, getValue( eTSM_LAPP_01 ) );  else  setTimer( _tSM_LAPP_01, 1 );
  _bsaiSM_LAPP_01 = 0;
  _bsiSM_LAPP_01 = 1;
  cancelTimer( _tinhSM_LAPP_01 );  setTimer( _tinhSM_LAPP_01, 100 );*/
}

SM_LAPP_01Changed()
{
/*  if( getValue( eSendEnabled ) && getValue( eSendSM_LAPP_01 ))
    if( _bsiSM_LAPP_01)
      _bsaiSM_LAPP_01 = 1;
    else
      sendSM_LAPP_01();*/
}

//END MSG SM_LAPP_01

// MSG SM_LAPP_02

on Timer _tSM_LAPP_02
{
 // if( getValue( eTSM_LAPP_02 ) <= 0)  putValue( eSendSM_LAPP_02, 0 );
 // if( (getValue( eSendEnabled ) && getValue( eSendSM_LAPP_02 )) || getValue( eDlcOnceSM_LAPP_02 ))  sendSM_LAPP_02();
}

on Timer _totSM_LAPP_02
{
 // putValue( eTimeoutSM_LAPP_02, 0 );
}

on Timer _tinhSM_LAPP_02
{
  _bsiSM_LAPP_02 = 0;
  if( _bsaiSM_LAPP_02 && getValue( eSendEnabled ))  sendSM_LAPP_02();
}

void sendSM_LAPP_02()
{
 /* if( getValue(eChangeSM_LAPP_02))
  {
    if( getValue( eDlcOnceSM_LAPP_02 ) || getValue( eDlcWrongSM_LAPP_02 ))
    {
        putValue( eDlcOnceSM_LAPP_02, 0 );
        _mSM_LAPP_02.DLC = getValue( eDlcSM_LAPP_02 );
    }
    else
    {
        _mSM_LAPP_02.DLC = 8;
    }
  }
  else
  {
    _mSM_LAPP_02.DLC = 8;
  }

  output( _mSM_LAPP_02 );
  cancelTimer( _tSM_LAPP_02 );
  if( getValue( eTSM_LAPP_02 ) > 0)  setTimer( _tSM_LAPP_02, getValue( eTSM_LAPP_02 ) );  else  setTimer( _tSM_LAPP_02, 1 );
  _bsaiSM_LAPP_02 = 0;
  _bsiSM_LAPP_02 = 1;
  cancelTimer( _tinhSM_LAPP_02 );  setTimer( _tinhSM_LAPP_02, 100 );*/
}

SM_LAPP_02Changed()
{
 /* if( getValue( eSendEnabled ) && getValue( eSendSM_LAPP_02 ))
    if( _bsiSM_LAPP_02)
      _bsaiSM_LAPP_02 = 1;
    else
      sendSM_LAPP_02();*/
}

//END MSG SM_LAPP_02

// MSG SMLS_01
on Timer _tSMLS_01
{
    if( getValue( eTSMLS_01 ) <= 0)  putValue( eSendSMLS_01, 0 );
    if( (getValue( eSendEnabled ) && getValue( eSendSMLS_01 )) || getValue( eDlcOnceSMLS_01 ))  sendSMLS_01();
}

on envVar eSendSMLS_01
{
    if( getValue( eSendEnabled ) && getValue( eSendSMLS_01 ))  sendSMLS_01();
}

on envVar eTimeoutSMLS_01
{
    if( getValue( this ) == 0x00 )
    if( getValue( eSendEnabled ) && getValue( eSendSMLS_01 ))  sendSMLS_01();
}

on Timer _totSMLS_01
{
    putValue( eTimeoutSMLS_01, 0 );
}

on envVar eDlcOnceSMLS_01
{
    if( getValue( eDlcOnceSMLS_01 ) && !( getValue( eSendEnabled ) && getValue( eSendSMLS_01 )))  setTimer( _tSMLS_01, 1 );
}

on Timer _tinhSMLS_01
{
    _bsiSMLS_01 = 0;
    if( _bsaiSMLS_01 && getValue( eSendEnabled ))  sendSMLS_01();
}

void sendSMLS_01()
{
    byte crc;
    dword bz;
    int hw;
    byte dlc;

    if( getValue(eChangeSMLS_01))
    {
        if( getValue( eDlcOnceSMLS_01 ) || getValue( eDlcWrongSMLS_01 ))
        {
            putValue( eDlcOnceSMLS_01, 0 );
            _mSMLS_01.DLC = getValue( eDlcSMLS_01 );
        }
        else
        {
            if(GetValue(eSMLS_01_ChngDLCEnabled))
            {
                dlc=GetValue(eSMLS_01_ChngDLCData);
                if(dlc>0)
                {
                    dlc--;
                    putValue( eSMLS_01_ChngDLCData, dlc );
                    _mSMLS_01.DLC = getValue( eDlcSMLS_01 );
                }
                else
                {
                    putValue( eSMLS_01_ChngDLCData, 0 );
                    _mSMLS_01.DLC = 8;
                }
            }
            else
            {
                _mSMLS_01.DLC = 8;
            }
        }
        if( getValue( eSMLS_01_BZS_SingleJumpEnabled ))
        {
            putValue( eSMLS_01_BZS_SingleJumpEnabled,0 );
            _mSMLS_01.SMLS_01_BZ=(_mSMLS_01.SMLS_01_BZ + getValue( eSMLS_01_BZS_SingleJumpData )) & 0xf;
        }
        if( getValue( eSMLS_01_BZS_ResetJumpEnabled ))
        {
            if( getValue( eSMLS_01_BZS_ResetJumpData ) == _mSMLS_01.SMLS_01_BZ)
            {
                putValue( eSMLS_01_BZS_ResetJumpEnabled,0 );
                    _mSMLS_01.SMLS_01_BZ=0;
                putValue( eSMLS_01_BZS,15 );
            }
        }
        crc = getCRC8( _mSMLS_01, _s_pdu_codeSMLS_01 );
        if( getValue( eSMLS_01_CRC_FalseEnabled ))
        {
            crc = ~crc;
            hw = getValue( eSMLS_01_CRC_FalseData );
            if(hw)
            {
                hw--;
                putValue( eSMLS_01_CRC_FalseData,hw );
            }
            if(hw==0)
            {
                putValue( eSMLS_01_CRC_FalseEnabled,0 );
            }
        }
        if( getValue( eSMLS_01_CRC_ON) == 0x01 )
            _mSMLS_01.SMLS_01_CRC = crc ^ (1 - getValue( eCrcSMLS_01 ));

        if( getValue( eBZSMLS_01 ))
        {
            bz = getValue( eSMLS_01_BZS );
            bz = bz + getValue( eBZStepSMLS_01 );
            putValue( eSMLS_01_BZS, bz % 16 );
        }
    }
    else
    {
        _mSMLS_01.DLC = 8;
        crc = getCRC8( _mSMLS_01, _s_pdu_codeSMLS_01 );
        if( getValue( eSMLS_01_CRC_ON) == 0x01 )
            _mSMLS_01.SMLS_01_CRC = crc ^ (1 - getValue( eCrcSMLS_01 ));

        bz = getValue( eSMLS_01_BZS ) + 1;
        putValue( eSMLS_01_BZS, bz % 16 );
    }

    if( getValue( eSMLS_01_NoMsgEnabled ))
    {
        hw = getValue( eSMLS_01_NoMsgEnabledData );
        if(hw)
        {
            hw--;
            putValue( eSMLS_01_NoMsgEnabledData,hw );
        }
        if( hw == 0 )
        {
            putValue( eSMLS_01_NoMsgEnabled,0 );
        }
    }
    else
    {
        output( _mSMLS_01 );
        if( getValue( eSMLS_01_CRC_ON ) == 0x01 )
        putValue(eSMLS_01_CRCS, _mSMLS_01.SMLS_01_CRC );
    }

    cancelTimer( _tSMLS_01 );
    if( getValue( eTSMLS_01 ) > 0)  setTimer( _tSMLS_01, getValue( eTSMLS_01 ) );  else  setTimer( _tSMLS_01, 1 );
}

byte isSMLS_01Active()
{
    if( getValue( eBH_Blinker_liS ) != 0)  return 1;
    if( getValue( eBH_Blinker_reS ) != 0)  return 1;
    if( getValue( eBH_LichthupeS ) != 0)  return 1;
    if( getValue( eBH_FernlichtS ) != 0)  return 1;
    if( getValue( eWH_TipwischenS ) != 0)  return 1;
    if( getValue( eWH_IntervallS ) != 0)  return 1;
    if( getValue( eWH_WischerStufe1S ) != 0)  return 1;
    if( getValue( eWH_WischerStufe2S ) != 0)  return 1;
    if( getValue( eWH_FrontwaschenS ) != 0)  return 1;
    if( getValue( eWH_HeckwaschenS ) != 0)  return 1;
    if( getValue( eWH_IntervallstufenS ) != 0)  return 1;
    if( getValue( eFAS_TasterS ) != 0)  return 1;
    if( getValue( eFAS_Taster_FehlerS ) != 0)  return 1;
    if( getValue( eSMLS_HupeS ) != 0)  return 1;
    if( getValue( eLRH_on_offS ) != 0)  return 1;
    if( getValue( eLSS_TastencodeS ) != 0)  return 1;
    return 0;
}

SMLS_01Changed()
{
    _bSMLS_01Active = isSMLS_01Active();
    if( getValue( eSendEnabled ) && getValue( eSendSMLS_01 ))
        if( _bsiSMLS_01)
            _bsaiSMLS_01 = 1;
        else
            sendSMLS_01();
}

on message SMLS_01
{ 
    if( getValue( eTimeoutSMLS_01 ))
    {
        cancelTimer( _tSMLS_01 );
        cancelTimer( _totSMLS_01 );
        setTimer( _totSMLS_01, (getValue( eSendEnabled ) && getValue( eSendSMLS_01 ) && (getValue( eTOTSMLS_01 ) > 0)) ? getValue( eTOTSMLS_01 ) : 1 );
    }
}

on envVar eSMLS_01_BZS
{
    _mSMLS_01.SMLS_01_BZ.phys = getValue( this );
 // SMLS_01Changed();
}

on envVar eSMLS_01_CRCS
{
    if( getValue( eSMLS_01_CRC_ON ) == 0x00 )
        _mSMLS_01.SMLS_01_CRC = getValue( eSMLS_01_CRCS );
}

on envVar eBH_Blinker_liS
{
    _mSMLS_01.BH_Blinker_li.phys = getValue( this );
    SMLS_01Changed();
}

on envVar eBH_Blinker_reS
{
    _mSMLS_01.BH_Blinker_re.phys = getValue( this );
    SMLS_01Changed();
}

on envVar eBH_FernlichtS
{
    _mSMLS_01.BH_Fernlicht.phys = getValue( this );
    SMLS_01Changed();
}

on envVar eBH_LichthupeS
{
    _mSMLS_01.BH_Lichthupe.phys = getValue( this );
    SMLS_01Changed();
}

on envVar eFAS_TasterS
{
    _mSMLS_01.FAS_Taster.phys = getValue( this );
    SMLS_01Changed();
}

on envVar eFAS_Taster_FehlerS
{
    _mSMLS_01.FAS_Taster_Fehler.phys = getValue( this );
    SMLS_01Changed();
}

on envVar eLRH_on_offS
{
    _mSMLS_01.LRH_on_off.phys = getValue( this );
    SMLS_01Changed();
}

on envVar eLSS_TastencodeS
{
    _mSMLS_01.LSS_Tastencode.phys = getValue( this );
    SMLS_01Changed();
}

on envVar eSMLS_HupeS
{
    _mSMLS_01.SMLS_Hupe.phys = getValue( this );
    SMLS_01Changed();
}

on envVar eSMLS_P_verriegeltS
{
    _mSMLS_01.SMLS_P_verriegelt.phys = getValue( this );
    SMLS_01Changed();
}

on envVar eWH_FrontwaschenS
{
    _mSMLS_01.WH_Frontwaschen.phys = getValue( this );
    SMLS_01Changed();
}

on envVar eWH_HeckintervallS
{
    _mSMLS_01.WH_Heckintervall.phys = getValue( this );
    SMLS_01Changed();
}

on envVar eWH_HeckwaschenS
{
    _mSMLS_01.WH_Heckwaschen.phys = getValue( this );
    SMLS_01Changed();
}

on envVar eWH_IntervallS
{
    _mSMLS_01.WH_Intervall.phys = getValue( this );
    SMLS_01Changed();
}

on envVar eWH_IntervallstufenS
{
    _mSMLS_01.WH_Intervallstufen.phys = getValue( this );
    SMLS_01Changed();
}

on envVar eWH_TipwischenS
{
    _mSMLS_01.WH_Tipwischen.phys = getValue( this );
    SMLS_01Changed();
}

on envVar eWH_WischerStufe1S
{
    _mSMLS_01.WH_WischerStufe1.phys = getValue( this );
    SMLS_01Changed();
}

on envVar eWH_WischerStufe2S
{
    _mSMLS_01.WH_WischerStufe2.phys = getValue( this );
    SMLS_01Changed();
}

// END MSG SMLS_01


// MSG SoSe_01

on Timer _tSoSe_01
{
 // if( getValue( eTSoSe_01 ) <= 0)  putValue( eSendSoSe_01, 0 );
 // if( (getValue( eSendEnabled ) && getValue( eSendSoSe_01 )) || getValue( eDlcOnceSoSe_01 ))  sendSoSe_01();
}

on Timer _totSoSe_01
{
 // putValue( eTimeoutSoSe_01, 0 );
}

void sendSoSe_01()
{
 /* if( getValue(eChangeSoSe_01))
  {
     if( getValue( eDlcOnceSoSe_01 ) || getValue( eDlcWrongSoSe_01 ))
     { 
        putValue( eDlcOnceSoSe_01, 0 );
        _mSoSe_01.DLC = getValue( eDlcSoSe_01 );
     }
     else
     {
      _mSoSe_01.DLC = 8;
     }
   }
   else
   {
        _mSoSe_01.DLC = 8;
   }

   output( _mSoSe_01 );
  cancelTimer( _tSoSe_01 );
  if( getValue( eTSoSe_01 ) > 0)  setTimer( _tSoSe_01, getValue( eTSoSe_01 ) );  else  setTimer( _tSoSe_01, 1 );*/
}

// END MSG SoSe_01

// MSG Spiegel_01

on Timer _tSpiegel_01
{
 // if( getValue( eTSpiegel_01 ) <= 0)  putValue( eSendSpiegel_01, 0 );
 // if( (getValue( eSendEnabled ) && getValue( eSendSpiegel_01 )) || getValue( eDlcOnceSpiegel_01 ))  sendSpiegel_01();
}

on Timer _totSpiegel_01
{
 // putValue( eTimeoutSpiegel_01, 0 );
}

on Timer _tinhSpiegel_01
{
  _bsiSpiegel_01 = 0;
  if( _bsaiSpiegel_01 && getValue( eSendEnabled ))  sendSpiegel_01();
}

void sendSpiegel_01()
{
 /* if( getValue(eChangeSpiegel_01))
  {
    if( getValue( eDlcOnceSpiegel_01 ) || getValue( eDlcWrongSpiegel_01 ))
    {
        putValue( eDlcOnceSpiegel_01, 0 );
        _mSpiegel_01.DLC = getValue( eDlcSpiegel_01 );
    }
    else
    {
        _mSpiegel_01.DLC = 8;
    }
  }
  else
  {
    _mSpiegel_01.DLC = 8;
  }

  output( _mSpiegel_01 );
  cancelTimer( _tSpiegel_01 );
  if( getValue( eTSpiegel_01 ) > 0)  setTimer( _tSpiegel_01, getValue( eTSpiegel_01 ) );  else  setTimer( _tSpiegel_01, 1 );
  _bsaiSpiegel_01 = 0;
  _bsiSpiegel_01 = 1;
  cancelTimer( _tinhSpiegel_01 );  setTimer( _tinhSpiegel_01, 100 );*/
}

Spiegel_01Changed()
{
 /* if( getValue( eSendEnabled ) && getValue( eSendSpiegel_01 ))
    if( _bsiSpiegel_01)
      _bsaiSpiegel_01 = 1;
    else
      sendSpiegel_01();*/
}

//END MSG Spiegel_01

// MSG STSG_HBFS_01

on Timer _tSTH_01
{
    if( getValue( eTSTH_01 ) <= 0)  putValue( eSendSTH_01, 0 );
    if( (getValue( eSendEnabled ) && getValue( eSendSTH_01 )) || getValue( eDlcOnceSTH_01 ))  sendSTH_01();
}

on Timer _totSTH_01
{
    putValue( eTimeoutSTH_01, 0 );
}

on envVar eSendSTH_01
{
    if( getValue( eSendEnabled ) && getValue( eSendSTH_01 ))  sendSTH_01();
}

on envVar eTimeoutSTH_01
{
    cancelTimer( _tSTH_01 );
    cancelTimer( _totSTH_01 );
    if( getValue( this ))
        setTimer( _totSTH_01, (getValue( eSendEnabled ) && getValue( eSendSTH_01 ) && (getValue( eTOTSTH_01 ) > 0)) ? getValue( eTOTSTH_01 ) : 1 );
    else
        if( getValue( eSendEnabled ) && getValue( eSendSTH_01 ))  sendSTH_01();
}

on envVar eDlcOnceSTH_01
{
    if( getValue( eDlcOnceSTH_01 ) && !(getValue( eSendEnabled ) && getValue( eSendSTH_01 )))  setTimer( _tSTH_01, 1 );
}

void sendSTH_01()
{
    calculate_STH_consumption ();

    if( getValue(eChangeSTH_01))
    {
        if( getValue( eDlcOnceSTH_01 ) || getValue( eDlcWrongSTH_01 ))
        {
            putValue( eDlcOnceSTH_01, 0 );
            _mSTH_01.DLC = getValue( eDlcSTH_01 );
        }
        else
        {
            _mSTH_01.DLC = 8;
        }
    }
    else
    {
        _mSTH_01.DLC = 8;
    }

    output( _mSTH_01 );

    cancelTimer( _tSTH_01 );
    if( getValue( eTSTH_01 ) > 0)  setTimer( _tSTH_01, getValue( eTSTH_01 ) );  else  setTimer( _tSTH_01, 1 );
}

void calculate_STH_consumption()
{
    dword consumption;
    dword oldAccu;
    dword newAccu;

    consumption = (dword)(getValue( eSTH_Consumption ) / 3.6 * getValue( eTSTH_01 ) + 0.5 );
    oldAccu = getValue( eSTH_KVS );
    newAccu = ( oldAccu + consumption ) & 0x1FFF;
    putValue( eSTH_KVS, newAccu );
 
    if( newAccu < oldAccu )  putValue( eSTH_KVS_Ueberlauf, 1 );
}

on envVar KCAN_STH_EKP_Anst
{
    _mSTH_01.STH_EKP_Anst.phys = getValue( this );
}

on envVar KCAN_STH_Fehler_ElWaPu
{
    _mSTH_01.STH_Fehler_ElWaPu.phys = getValue( this );
}

on envVar KCAN_STH_Fehlerstatus
{
    _mSTH_01.STH_Fehlerstatus.phys = getValue( this );
}

on envVar KCAN_STH_Funk_aus
{
    _mSTH_01.STH_Funk_aus.phys = getValue( this );
}

on envVar KCAN_STH_Funk_ein
{
    _mSTH_01.STH_Funk_ein.phys = getValue( this );
}

on envVar KCAN_STH_Geblaese
{
    _mSTH_01.STH_Geblaese.phys = getValue( this );
}

on envVar eSTH_HeizleistungS
{
    putValue( KCAN_STH_Heizleistung, getValue( this ) );
}

on envVar KCAN_STH_Heizleistung
{
    _mSTH_01.STH_Heizleistung.phys = getValue( this );
}

on envVar KCAN_STH_KL_HUP
{
    _mSTH_01.STH_KL_HUP.phys = getValue( this );
}

on envVar eSTH_KVS
{
    putValue( KCAN_STH_KVS,getValue( this ) );
}

on envVar KCAN_STH_KVS
{
    _mSTH_01.STH_KVS.phys = getValue( this );
}

on envVar eSTH_KVS_Ueberlauf
{
    putValue( KCAN_STH_KVS_Ueberlauf, getValue( this ));
}

on envVar KCAN_STH_KVS_Ueberlauf
{
    _mSTH_01.STH_KVS_Ueberlauf.phys = getValue( this );
}

on envVar KCAN_STH_LED
{
    _mSTH_01.STH_LED.phys = getValue( this );
}

on envVar KCAN_STH_Motorvorwaermung
{
    _mSTH_01.STH_Motorvorwaermung.phys = getValue( this );
}

on envVar KCAN_STH_Pumpe_ein
{
    _mSTH_01.STH_Pumpe_ein.phys = getValue( this );
}

on envVar KCAN_STH_Pumpen_Anf_extern
{
    _mSTH_01.STH_Pumpen_Anf_extern.phys = getValue( this );
}

on envVar KCAN_STH_Servicemode
{
    _mSTH_01.STH_Servicemode.phys = getValue( this );
}

on envVar KCAN_STH_SH_ZH
{
    _mSTH_01.STH_SH_ZH.phys = getValue( this );
}

on envVar KCAN_STH_Start_folgt
{
    _mSTH_01.STH_Start_folgt.phys = getValue( this );
}

on envVar eSTH_Texte
{
    putValue( KCAN_STH_Texte, getValue( this ) );
}

on envVar KCAN_STH_Texte
{
    _mSTH_01.STH_Texte.phys = getValue( this );
}

on envVar KCAN_STH_Ventil_Status
{
    _mSTH_01.STH_Ventil_Status.phys = getValue( this );
}

on envVar KCAN_STH_Ventiloeffnungszeit
{
    _mSTH_01.STH_Ventiloeffnungszeit.phys = getValue( this );
}

on envVar KCAN_STH_Waermeeintrag
{
    _mSTH_01.STH_Waermeeintrag.phys = getValue( this );
}

on envVar KCAN_STH_war_aktiv
{
    _mSTH_01.STH_war_aktiv.phys = getValue( this );
}

on envVar KCAN_STH_Wassertemp
{
    _mSTH_01.STH_Wassertemp.phys = getValue( this );
}

on envVar KCAN_STH_Zusatzheizung
{
    _mSTH_01.STH_Zusatzheizung.phys = getValue( this );
}

on Timer _tSTSG_HBFS_01
{
 // if( getValue( eTSTSG_HBFS_01 ) <= 0)  putValue( eSendSTSG_HBFS_01, 0 );
 // if( (getValue( eSendEnabled ) && getValue( eSendSTSG_HBFS_01 )) || getValue( eDlcOnceSTSG_HBFS_01 ))  sendSTSG_HBFS_01();
}

on Timer _totSTSG_HBFS_01
{
  //putValue( eTimeoutSTSG_HBFS_01, 0 );
}

on Timer _tinhSTSG_HBFS_01
{
  _bsiSTSG_HBFS_01 = 0;
  if( _bsaiSTSG_HBFS_01 && getValue( eSendEnabled ))  sendSTSG_HBFS_01();
}

void sendSTSG_HBFS_01()
{
 /* if( getValue(eChangeSTSG_HBFS_01))
  {
    if( getValue( eDlcOnceSTSG_HBFS_01 ) || getValue( eDlcWrongSTSG_HBFS_01 ))
    {
        putValue( eDlcOnceSTSG_HBFS_01, 0 );
        _mSTSG_HBFS_01.DLC = getValue( eDlcSTSG_HBFS_01 );
    }
    else
    {
        _mSTSG_HBFS_01.DLC = 8;
    }
  }
  else
  {
    _mSTSG_HBFS_01.DLC = 8;
  }

  output( _mSTSG_HBFS_01 );
  cancelTimer( _tSTSG_HBFS_01 );
  if( getValue( eTSTSG_HBFS_01 ) > 0)  setTimer( _tSTSG_HBFS_01, getValue( eTSTSG_HBFS_01 ) );  else  setTimer( _tSTSG_HBFS_01, 1 );
  _bsaiSTSG_HBFS_01 = 0;
  _bsiSTSG_HBFS_01 = 1;
  cancelTimer( _tinhSTSG_HBFS_01 );  setTimer( _tinhSTSG_HBFS_01, 100 );*/
}

STSG_HBFS_01Changed()
{
 /* if( getValue( eSendEnabled ) && getValue( eSendSTSG_HBFS_01 ))
    if( _bsiSTSG_HBFS_01)
      _bsaiSTSG_HBFS_01 = 1;
    else
      sendSTSG_HBFS_01();*/
}

//END MSG STSG_HBFS_01

// MSG STSG_HFS_01

on Timer _tSTSG_HFS_01
{
 // if( getValue( eTSTSG_HFS_01 ) <= 0)  putValue( eSendSTSG_HFS_01, 0 );
 // if( (getValue( eSendEnabled ) && getValue( eSendSTSG_HFS_01 )) || getValue( eDlcOnceSTSG_HFS_01 ))  sendSTSG_HFS_01();
}

on Timer _totSTSG_HFS_01
{
//  putValue( eTimeoutSTSG_HFS_01, 0 );
}

on Timer _tinhSTSG_HFS_01
{
  _bsiSTSG_HFS_01 = 0;
  if( _bsaiSTSG_HFS_01 && getValue( eSendEnabled ))  sendSTSG_HFS_01();
}

void sendSTSG_HFS_01()
{
 /* if( getValue(eChangeSTSG_HFS_01))
  {
    if( getValue( eDlcOnceSTSG_HFS_01 ) || getValue( eDlcWrongSTSG_HFS_01 ))
    {
        putValue( eDlcOnceSTSG_HFS_01, 0 );
        _mSTSG_HFS_01.DLC = getValue( eDlcSTSG_HFS_01 );
    }
    else
    {
        _mSTSG_HFS_01.DLC = 8;
    }
  }
  else
  {
    _mSTSG_HFS_01.DLC = 8;
  }

  output( _mSTSG_HFS_01 );
  cancelTimer( _tSTSG_HFS_01 );
  if( getValue( eTSTSG_HFS_01 ) > 0)  setTimer( _tSTSG_HFS_01, getValue( eTSTSG_HFS_01 ) );  else  setTimer( _tSTSG_HFS_01, 1 );
  _bsaiSTSG_HFS_01 = 0;
  _bsiSTSG_HFS_01 = 1;
  cancelTimer( _tinhSTSG_HFS_01 );  setTimer( _tinhSTSG_HFS_01, 100 );*/
}

STSG_HFS_01Changed()
{
 /* if( getValue( eSendEnabled ) && getValue( eSendSTSG_HFS_01 ))
    if( _bsiSTSG_HFS_01)
      _bsaiSTSG_HFS_01 = 1;
    else
      sendSTSG_HFS_01();*/
}

//END MSG STSG_HFS_01

// MSG TSG_BT_01
//END MSG TSG_BT_01

// MSG Thermo_Verbrauch_01

// END MSG Thermo_Verbrauch_01
//MSG TSG_FT_01

on Timer _tTSG_FT_01
{
    if( getValue( eTTSG_FT_01 ) <= 0)  putValue( eSendTSG_FT_01, 0 );
    if( (getValue( eSendEnabled ) && getValue( eSendTSG_FT_01 )) || getValue( eDlcOnceTSG_FT_01 ))  sendTSG_FT_01();
}

on Timer _totTSG_FT_01
{
    putValue( eTimeoutTSG_FT_01, 0 );
}

on envVar eSendTSG_FT_01
{
    if( getValue( eSendEnabled ) && getValue( eSendTSG_FT_01 ))  sendTSG_FT_01();
}

on envVar eTimeoutTSG_FT_01
{
    cancelTimer( _tTSG_FT_01 );
    cancelTimer( _totTSG_FT_01 );
    if( getValue( this ))
        setTimer( _totTSG_FT_01, (getValue( eSendEnabled ) && getValue( eSendTSG_FT_01 ) && (getValue( eTOTTSG_FT_01 ) > 0)) ? getValue( eTOTTSG_FT_01 ) : 1 );
    else
        if( getValue( eSendEnabled ) && getValue( eSendTSG_FT_01 ))  sendTSG_FT_01();
}

on envVar eDlcOnceTSG_FT_01
{
    if( getValue( eDlcOnceTSG_FT_01 ) && !(getValue( eSendEnabled ) && getValue( eSendTSG_FT_01 )))  setTimer( _tTSG_FT_01, 1 );
}

void sendTSG_FT_01()
{
    if( getValue(eChangeTSG_FT_01))
    {
        if( getValue( eDlcOnceTSG_FT_01 ) || getValue( eDlcWrongTSG_FT_01 ))
        {
            putValue( eDlcOnceTSG_FT_01, 0 );
            _mTSG_FT_01.DLC = getValue( eDlcTSG_FT_01 );
        }
        else
        { 
            _mTSG_FT_01.DLC = 8;
        }
    }
    else
    {
        _mTSG_FT_01.DLC = 8;
    }

    output( _mTSG_FT_01 );
    cancelTimer( _tTSG_FT_01 );
    if( getValue( eTTSG_FT_01 ) > 0)  setTimer( _tTSG_FT_01, getValue( eTTSG_FT_01 ) );  else  setTimer( _tTSG_FT_01, 1 );
}

on envVar eFT_Kisi_FehlerS
{
    _mTSG_FT_01.FT_Kisi_Fehler.phys = getValue( this );
}

on envVar eFT_Tuer_geoeffnetS
{
    _mTSG_FT_01.FT_Tuer_geoeffnet.phys = getValue( this );
}

// END MSG TSG_FT_01

//MSG TSG_FT_02

on Timer _tTSG_FT_02
{
    if( getValue( eTTSG_FT_02 ) <= 0)  putValue( eSendTSG_FT_02, 0 );
    if( (getValue( eSendEnabled ) && getValue( eSendTSG_FT_02 )) || getValue( eDlcOnceTSG_FT_02 ))  sendTSG_FT_02();
}

on envVar eSendTSG_FT_02
{
    if( getValue( eSendEnabled ) && getValue( eSendTSG_FT_02 ))  sendTSG_FT_02();
}

on envVar eTimeoutTSG_FT_02
{
    cancelTimer( _tTSG_FT_02 );
    cancelTimer( _totTSG_FT_02 );
    if( getValue( this ))
        setTimer( _totTSG_FT_02, (getValue( eSendEnabled ) && getValue( eSendTSG_FT_02 ) && (getValue( eTOTTSG_FT_02 ) > 0)) ? getValue( eTOTTSG_FT_02 ) : 1 );
    else
        if( getValue( eSendEnabled ) && getValue( eSendTSG_FT_02 ))  sendTSG_FT_02();
}

on Timer _totTSG_FT_02
{
    putValue( eTimeoutTSG_FT_02, 0 );
}

on envVar eDlcOnceTSG_FT_02
{
    if( getValue( eDlcOnceTSG_FT_02 ) && !( getValue( eSendEnabled ) && getValue( eSendTSG_FT_02 )))  setTimer( _tTSG_FT_02, 1 );
}

on Timer _tinhTSG_FT_02
{
    _bsiTSG_FT_02 = 0;
    if( _bsaiTSG_FT_02 && getValue( eSendEnabled ))  
    {    
        sendTSG_FT_02();
    }
}

void sendTSG_FT_02()
{
    byte crc;
    dword bz;
    int hw;
    byte dlc;

    if( getValue(eChangeTSG_FT_02))
    {    
        if( getValue( eDlcOnceTSG_FT_02 ) || getValue( eDlcWrongTSG_FT_02 ))
        {
            putValue( eDlcOnceTSG_FT_02, 0 );
            _mTSG_FT_02.DLC = getValue( eDlcTSG_FT_02 );
        }
        else
        {
            if(GetValue(eTSG_FT_02_ChngDLCEnabled))
            {
                dlc=GetValue(eTSG_FT_02_ChngDLCData);
                if(dlc>0)
                {
                    dlc--;
                    putValue( eTSG_FT_02_ChngDLCData, dlc );
                    _mTSG_FT_02.DLC = getValue( eDlcTSG_FT_02 );
                }
                else
                {
                    putValue( eTSG_FT_02_ChngDLCData, 0 );
                    _mTSG_FT_02.DLC = 8;
                }
            }        
            else
            {
              _mTSG_FT_02.DLC = 8;
            }        
        }
        if(GetValue(eTSG_FT_02_BZS_SingleJumpEnabled))
        {
            PutValue(eTSG_FT_02_BZS_SingleJumpEnabled,0);
            _mTSG_FT_02.TSG_FT_02_BZ=(_mTSG_FT_02.TSG_FT_02_BZ+GetValue(eTSG_FT_02_BZS_SingleJumpData))&0xf;
        }
        if(GetValue(eTSG_FT_02_BZS_ResetJumpEnabled))
        {

            if(GetValue(eTSG_FT_02_BZS_ResetJumpData)==_mTSG_FT_02.TSG_FT_02_BZ)
            {
                PutValue(eTSG_FT_02_BZS_ResetJumpEnabled,0);
                _mTSG_FT_02.TSG_FT_02_BZ=0;
                putValue(eTSG_FT_02_BZS,15);
            }
        }
        crc = getCRC8( _mTSG_FT_02, _s_pdu_codeTSG_FT_02 );
        if(GetValue(eTSG_FT_02_CRC_FalseEnabled))
        {
        
            crc=~crc;
            hw=GetValue(eTSG_FT_02_CRC_FalseData);
            if(hw)
            {
                hw--;
                PutValue(eTSG_FT_02_CRC_FalseData,hw);
            }
            if(hw==0)
            {
                PutValue(eTSG_FT_02_CRC_FalseEnabled,0);
            }

        }
        _mTSG_FT_02.TSG_FT_02_CRC = crc ^ (1 - getValue( eCrcTSG_FT_02 ));    
    
        if( getValue( eBZTSG_FT_02 ))
        {
            bz = getValue( eTSG_FT_02_BZS );
            bz = bz + getValue( eBZStepTSG_FT_02 );
            putValue( eTSG_FT_02_BZS, bz % 16 );
        }
    }
    else
    {
        _mTSG_FT_02.DLC = 8;

        crc = getCRC8( _mTSG_FT_02, _s_pdu_codeTSG_FT_02 );
        _mTSG_FT_02.TSG_FT_02_CRC = crc ^ (1 - getValue( eCrcTSG_FT_02 ));
    
        bz = getValue( eTSG_FT_02_BZS ) + 1;    
        putValue( eTSG_FT_02_BZS, bz % 16 );
    }
    
    if(GetValue(eTSG_FT_02_NoMsgEnabled))
    {
        hw=GetValue(eTSG_FT_02_NoMsgEnabledData);
        if(hw)
        {
            hw--;
            PutValue(eTSG_FT_02_NoMsgEnabledData,hw);
        }
        if(hw==0)
        {
            PutValue(eTSG_FT_02_NoMsgEnabled,0);
        }        
    }
    else
    {
      output( _mTSG_FT_02 );
    }
    
    cancelTimer( _tTSG_FT_02 );
    if( getValue( eTTSG_FT_02 ) > 0)  setTimer( _tTSG_FT_02, getValue( eTTSG_FT_02 ) );  else  setTimer( _tTSG_FT_02, 1 );
}

TSG_FT_02Changed()
{
    if( getValue( eSendEnabled ) && getValue( eSendTSG_FT_02 ))
        if( _bsiTSG_FT_02)
            _bsaiTSG_FT_02 = 1;
        else
            sendTSG_FT_02();
}

on envVar eTSG_FT_02_BZS
{
    _mTSG_FT_02.TSG_FT_02_BZ = getValue( this );
}

on envVar KCAN_FT_BFS_Tuer_Status
{
    _mTSG_FT_02.FT_BFS_Tuer_Status.phys = getValue( this );
    TSG_FT_02Changed();
}

on envVar KCAN_FT_HBFS_Tuer_Status
{
    _mTSG_FT_02.FT_HBFS_Tuer_Status.phys = getValue( this );
    TSG_FT_02Changed();
}

on envVar KCAN_FT_HFS_Tuer_Status
{
    _mTSG_FT_02.FT_HFS_Tuer_Status.phys = getValue( this );
    TSG_FT_02Changed();
}

on envVar KCAN_FT_Kisi_Taster_li_02
{
    _mTSG_FT_02.FT_Kisi_Taster_li_02.phys = getValue( this );
    TSG_FT_02Changed();
}

on envVar KCAN_FT_Kisi_Taster_re_02
{
    _mTSG_FT_02.FT_Kisi_Taster_re_02.phys = getValue( this );
    TSG_FT_02Changed();
}

on envVar KCAN_FT_Lock_Taster_02
{
    _mTSG_FT_02.FT_Lock_Taster_02.phys = getValue( this );
    TSG_FT_02Changed();
}

on envVar KCAN_FT_Schluesselschalter_zu_02
{
    _mTSG_FT_02.FT_Schluesselschalter_zu_02.phys = getValue( this );
    TSG_FT_02Changed();
}

on envVar KCAN_FT_SP_Heizung_ein
{
    _mTSG_FT_02.FT_SP_Heizung_ein.phys = getValue( this );
    TSG_FT_02Changed();
}

on envVar KCAN_FT_TD_Taste_Status
{
    _mTSG_FT_02.FT_TD_Taste_Status.phys = getValue( this );
    TSG_FT_02Changed();
}

on envVar eFT_Tuer_Status
{
    putValue( KCAN_FT_Tuer_Status, getValue( this ) );
}

on envVar KCAN_FT_Tuer_Status
{
    _mTSG_FT_02.FT_Tuer_Status.phys = getValue( this );
    TSG_FT_02Changed();
}

on envVar KCAN_FT_Tuer_Status_QBit
{
    _mTSG_FT_02.FT_Tuer_Status_QBit.phys = getValue( this );
    TSG_FT_02Changed();
}

on envVar KCAN_FT_Tueroeffnen_Warnung
{
    _mTSG_FT_02.FT_Tueroeffnen_Warnung.phys = getValue( this );
    TSG_FT_02Changed();
}

// END MSG TSG_FT_02

// MSG TSG_HBFS_01

//END MSG TSG_HBFS_01

// MSG TSG_HFS_01

//END MSG TSG_HFS_01

// MSG Uhrzeit_01

on Timer _tLog_Datenlogger_Req
{
  if( getValue( eTLog_Datenlogger_Req ) <= 0)  putValue( eSendLog_Datenlogger_Req, 0 );
  if( (getValue( eSendEnabled ) && getValue( eSendLog_Datenlogger_Req )) || getValue( eDlcOnceLog_Datenlogger_Req ))  sendLog_Datenlogger_Req();
}

on envVar eSendLog_Datenlogger_Req
{
  if( getValue( eSendEnabled ) && getValue( eSendLog_Datenlogger_Req ))  sendLog_Datenlogger_Req();
}

on envVar eTimeoutLog_Datenlogger_Req
{
  cancelTimer( _tLog_Datenlogger_Req );
  cancelTimer( _totLog_Datenlogger_Req );
  if( getValue( this ))
    setTimer( _totLog_Datenlogger_Req, (getValue( eSendEnabled ) && getValue( eSendLog_Datenlogger_Req ) && (getValue( eTOTLog_Datenlogger_Req ) > 0)) ? getValue( eTOTLog_Datenlogger_Req ) : 1 );
  else
    if( getValue( eSendEnabled ) && getValue( eSendLog_Datenlogger_Req ))  sendLog_Datenlogger_Req();
}

on Timer _totLog_Datenlogger_Req
{
  putValue( eTimeoutLog_Datenlogger_Req, 0 );
}

on envVar eDlcOnceLog_Datenlogger_Req
{
  if( getValue( eDlcOnceLog_Datenlogger_Req ) && !(getValue( eSendEnabled ) && getValue( eSendLog_Datenlogger_Req )))  setTimer( _tLog_Datenlogger_Req, 1 );
}

on Timer _tLog_Kombi_Req
{
  if( getValue( eTLog_Kombi_Req ) <= 0)  putValue( eSendLog_Kombi_Req, 0 );
  if( (getValue( eSendEnabled ) && getValue( eSendLog_Kombi_Req )) || getValue( eDlcOnceLog_Kombi_Req ))  sendLog_Kombi_Req();
}

on envVar eSendLog_Kombi_Req
{
  if( getValue( eSendEnabled ) && getValue( eSendLog_Kombi_Req ))  sendLog_Kombi_Req();
}

on envVar eTimeoutLog_Kombi_Req
{
  cancelTimer( _tLog_Kombi_Req );
  cancelTimer( _totLog_Kombi_Req );
  if( getValue( this ))
    setTimer( _totLog_Kombi_Req, (getValue( eSendEnabled ) && getValue( eSendLog_Kombi_Req ) && (getValue( eTOTLog_Kombi_Req ) > 0)) ? getValue( eTOTLog_Kombi_Req ) : 1 );
  else
    if( getValue( eSendEnabled ) && getValue( eSendLog_Kombi_Req ))  sendLog_Kombi_Req();
}

on Timer _totLog_Kombi_Req
{
  putValue( eTimeoutLog_Kombi_Req, 0 );
}

on envVar eDlcOnceLog_Kombi_Req
{
  if( getValue( eDlcOnceLog_Kombi_Req ) && !(getValue( eSendEnabled ) && getValue( eSendLog_Kombi_Req )))  setTimer( _tLog_Kombi_Req, 1 );
}

void sendLog_Datenlogger_Req()
{
  if( getValue(eChangeLog_Datenlogger_Req))
  {
    if( getValue( eDlcOnceLog_Datenlogger_Req ) || getValue( eDlcWrongLog_Datenlogger_Req ))
    {
        putValue( eDlcOnceLog_Datenlogger_Req, 0 );
    }
  }

  cancelTimer( _tLog_Datenlogger_Req );
  if( getValue( eTLog_Datenlogger_Req ) > 0)  setTimer( _tLog_Datenlogger_Req, getValue( eTLog_Datenlogger_Req ) );  else  setTimer( _tLog_Datenlogger_Req, 1 );
}

void sendLog_Kombi_Req()
{
  if( getValue(eChangeLog_Kombi_Req))
  {
    if( getValue( eDlcOnceLog_Kombi_Req ) || getValue( eDlcWrongLog_Kombi_Req ))
    {
        putValue( eDlcOnceLog_Kombi_Req, 0 );
    }
  }

  cancelTimer( _tLog_Kombi_Req );
  if( getValue( eTLog_Kombi_Req ) > 0)  setTimer( _tLog_Kombi_Req, getValue( eTLog_Kombi_Req ) );  else  setTimer( _tLog_Kombi_Req, 1 );
}

on Timer _tTCO_01
{
  if( getValue( eTTCO_01 ) <= 0)  putValue( eSendTCO_01, 0 );
  if( (getValue( eSendEnabled ) && getValue( eSendTCO_01 )) || getValue( eDlcOnceTCO_01 ))  sendTCO_01();
}

on envVar eSendTCO_01
{
    if( getValue( eSendEnabled ) && getValue( eSendTCO_01 ))  sendTCO_01();
}

on envVar eTimeoutTCO_01
{
    cancelTimer( _tTCO_01 );
    cancelTimer( _totTCO_01 );
    if( getValue( this ))
        setTimer( _totTCO_01, (getValue( eSendEnabled ) && getValue( eSendTCO_01 ) && (getValue( eTOTTCO_01 ) > 0)) ? getValue( eTOTTCO_01 ) : 1 );
    else
        if( getValue( eSendEnabled ) && getValue( eSendTCO_01 ))  sendTCO_01();
}

on Timer _totTCO_01
{
    putValue( eTimeoutTCO_01, 0 );
}

on envVar eDlcOnceTCO_01
{
    if( getValue( eDlcOnceTCO_01 ) && !(getValue( eSendEnabled ) && getValue( eSendTCO_01 )))  setTimer( _tTCO_01, 1 );
}

void sendTCO_01()
{
    if( getValue( eChangeTCO_01 ))
    {
        if( getValue( eDlcOnceTCO_01 ) || getValue( eDlcWrongTCO_01 ))
        {
            putValue( eDlcOnceTCO_01, 0 );
            _mTCO_01.DLC = getValue( eDlcTCO_01 );
        }
        else
        {
            _mTCO_01.DLC = 8;
        }
    }
    else
    {
        _mTCO_01.DLC = 8;
    }

    output( _mTCO_01 );
    cancelTimer( _tTCO_01 );
    if( getValue( eTTCO_01 ) > 0)  setTimer( _tTCO_01, getValue( eTTCO_01 ) );  else  setTimer( _tTCO_01, 1 );
}

TCO_01Changed()
{
}

on envVar eTCO_Dir_IndS
{
    _mTCO_01.TCO_Dir_Ind.phys = getValue( this );
    TCO_01Changed();
}

on envVar eTCO_Driver1_DSS
{
    _mTCO_01.TCO_Driver1_DS.phys = getValue( this );
    TCO_01Changed();
}

on envVar eTCO_Driver1_StS
{
    _mTCO_01.TCO_Driver1_St.phys = getValue( this );
    TCO_01Changed();
}

on envVar eTCO_Driver2_DSS
{
    _mTCO_01.TCO_Driver2_DS.phys = getValue( this );
    TCO_01Changed();
}

on envVar eTCO_Driver2_StS
{
    _mTCO_01.TCO_Driver2_St.phys = getValue( this );
    TCO_01Changed();
}

on envVar eTCO_FahrerkennS
{
    _mTCO_01.TCO_Fahrerkenn.phys = getValue( this );
    TCO_01Changed();
}

on envVar eTCO_Handle_InfS
{
    _mTCO_01.TCO_Handle_Inf.phys = getValue( this );
    TCO_01Changed();
}

on envVar eTCO_Outp_SpeedS
{
    _mTCO_01.TCO_Outp_Speed.phys = getValue( this );
    TCO_01Changed();
}

on envVar eTCO_Sys_PerfS
{
    _mTCO_01.TCO_Sys_Perf.phys = getValue( this );
    TCO_01Changed();
}

on envVar eTCO_System_EvS
{
    _mTCO_01.TCO_System_Ev.phys = getValue( this );
    TCO_01Changed();
}

on envVar eTCO_Vehicle_SpeedS
{
    _mTCO_01.TCO_Vehicle_Speed.phys = getValue( this );
    TCO_01Changed();
}

// MSG Thermo_Verbrauch_01
//    Thermo_Verbrauch_01 -->  message_Thermo_Verbrauch_01.cin
// END MSG Thermo_Verbrauch_01

on Timer _tTimeDate
{
    if( getValue( eTTimeDate ) <= 0)  putValue( eSendTimeDate, 0 );
    if( (getValue( eSendEnabled ) && getValue( eSendTimeDate )) || getValue( eDlcOnceTimeDate ))  sendTimeDate();
}

on envVar eSendTimeDate
{
    if( getValue( eSendEnabled ) && getValue( eSendTimeDate ))  sendTimeDate();
}

on envVar eTimeoutTimeDate
{
    cancelTimer( _tTimeDate );
    cancelTimer( _totTimeDate );
    if( getValue( this ))
        setTimer( _totTimeDate, (getValue( eSendEnabled ) && getValue( eSendTimeDate ) && (getValue( eTOTTimeDate ) > 0)) ? getValue( eTOTTimeDate ) : 1 );
    else
        if( getValue( eSendEnabled ) && getValue( eSendTimeDate ))  sendTimeDate();
}

on Timer _totTimeDate
{
    putValue( eTimeoutTimeDate, 0 );
}

on envVar eDlcOnceTimeDate
{
    if( getValue( eDlcOnceTimeDate ) && !(getValue( eSendEnabled ) && getValue( eSendTimeDate )))  setTimer( _tTimeDate, 1 );
}

void sendTimeDate()
{
    if( getValue( eChangeTimeDate ))
    {
        if( getValue( eDlcOnceTimeDate ) || getValue( eDlcWrongTimeDate ))
        {
            putValue( eDlcOnceTimeDate, 0 );
            _mTimeDate.DLC = getValue( eDlcTimeDate );
        }
        else
        {
            _mTimeDate.DLC = 8;
        }
    }
    else
    {
        _mTimeDate.DLC = 8;
    }

    output( _mTimeDate );
    cancelTimer( _tTimeDate );
    if( getValue( eTTimeDate ) > 0)  setTimer( _tTimeDate, getValue( eTTimeDate ) );  else  setTimer( _tTimeDate, 1 );
}

TimeDateChanged()
{
}

on envVar eTD_JahrS
{
    _mTimeDate.TD_Jahr.phys = getValue( this );
    TimeDateChanged();
}

on envVar eTD_Lok_Hour_offsS
{
    _mTimeDate.TD_Lok_Hour_offs.phys = getValue( this );
    TimeDateChanged();
}

on envVar eTD_Lok_Minute_offsS
{
    _mTimeDate.TD_Lok_Minute_offs.phys = getValue( this );
    TimeDateChanged();
}

on envVar eTD_MinutenS
{
    _mTimeDate.TD_Minuten.phys = getValue( this );
    TimeDateChanged();
}

on envVar eTD_MonatS
{
    _mTimeDate.TD_Monat.phys = getValue( this );
    TimeDateChanged();
}

on envVar eTD_SekundenS
{
    _mTimeDate.TD_Sekunden.phys = getValue( this );
    TimeDateChanged();
}

on envVar eTD_StundenS
{
    _mTimeDate.TD_Stunden.phys = getValue( this );
    TimeDateChanged();
}

on envVar eTD_TagS
{
    _mTimeDate.TD_Tag.phys = getValue( this );
    TimeDateChanged();
}

on Timer _tTM_01
{
    if( getValue( eTTM_01 ) <= 0)  putValue( eSendTM_01, 0 );
    if( (getValue( eSendEnabled ) && getValue( eSendTM_01 )) || getValue( eDlcOnceTM_01 ))  sendTM_01();
}

on envVar eSendTM_01
{
    if( getValue( eSendEnabled ) && getValue( eSendTM_01 ))  sendTM_01();
}

on envVar eTimeoutTM_01
{
    cancelTimer( _tTM_01 );
    cancelTimer( _totTM_01 );
    if( getValue( this ))
        setTimer( _totTM_01, (getValue( eSendEnabled ) && getValue( eSendTM_01 ) && (getValue( eTOTTM_01 ) > 0)) ? getValue( eTOTTM_01 ) : 1 );
    else
        if( getValue( eSendEnabled ) && getValue( eSendTM_01 ))  sendTM_01();
}

on Timer _totTM_01
{
    putValue( eTimeoutTM_01, 0 );
}

on envVar eDlcOnceTM_01
{
    if( getValue( eDlcOnceTM_01 ) && !(getValue( eSendEnabled ) && getValue( eSendTM_01 )))  setTimer( _tTM_01, 1 );
}

void sendTM_01()
{
    if( getValue( eChangeTM_01 ))
    {
        if( getValue( eDlcOnceTM_01 ) || getValue( eDlcWrongTM_01 ))
        {
            putValue( eDlcOnceTM_01, 0 );
            _mTM_01.DLC = getValue( eDlcTM_01 );
        }
        else
        {
            _mTM_01.DLC = 8;
        }
    }
    else
    {
        _mTM_01.DLC = 8;
    }

    output( _mTM_01 );
    cancelTimer( _tTM_01 );
    if( getValue( eTTM_01 ) > 0)  setTimer( _tTM_01, getValue( eTTM_01 ) );  else  setTimer( _tTM_01, 1 );
}

TM_01Changed()
{
}

on envVar eFoD_Anz_FunktionsabschaltungS
{
    _mTM_01.FoD_Anz_Funktionsabschaltung.phys = getValue( this );
    TM_01Changed();
}

on envVar eMOD_Request_ServiceKeyS
{
    _mTM_01.MOD_Request_ServiceKey.phys = getValue( this );
    TM_01Changed();
}

on envVar eeCall_FunktionsstatusS
{
    _mTM_01.eCall_Funktionsstatus.phys = getValue( this );
    TM_01Changed();
}

on Timer _tVehiDist
{
    if( getValue( eTVehiDist ) <= 0)  putValue( eSendVehiDist, 0 );
    if( (getValue( eSendEnabled ) && getValue( eSendVehiDist )) || getValue( eDlcOnceVehiDist ))  sendVehiDist();
}

on envVar eSendVehiDist
{
    if( getValue( eSendEnabled ) && getValue( eSendVehiDist ))  sendVehiDist();
}

on envVar eTimeoutVehiDist
{
    cancelTimer( _tVehiDist );
    cancelTimer( _totVehiDist );
    if( getValue( this ))
        setTimer( _totVehiDist, (getValue( eSendEnabled ) && getValue( eSendVehiDist ) && (getValue( eTOTVehiDist ) > 0)) ? getValue( eTOTVehiDist ) : 1 );
    else
        if( getValue( eSendEnabled ) && getValue( eSendVehiDist ))  sendVehiDist();
}

on Timer _totVehiDist
{
    putValue( eTimeoutVehiDist, 0 );
}

on envVar eDlcOnceVehiDist
{
    if( getValue( eDlcOnceVehiDist ) && !(getValue( eSendEnabled ) && getValue( eSendVehiDist )))  setTimer( _tVehiDist, 1 );
}

void sendVehiDist()
{
    if( getValue( eChangeVehiDist ))
    {
        if( getValue( eDlcOnceVehiDist ) || getValue( eDlcWrongVehiDist ))
        {
            putValue( eDlcOnceVehiDist, 0 );
            _mVehiDist.DLC = getValue( eDlcVehiDist );
        }
        else
        {
            _mVehiDist.DLC = 8;
        }
    }
    else
    {
        _mVehiDist.DLC = 8;
    }

    output( _mVehiDist );
    cancelTimer( _tVehiDist );
    if( getValue( eTVehiDist ) > 0)  setTimer( _tVehiDist, getValue( eTVehiDist ) );  else  setTimer( _tVehiDist, 1 );
}

VehiDistChanged()
{
}

on envVar eVDI_T_distS
{
    _mVehiDist.VDI_T_dist.phys = getValue( this );
    VehiDistChanged();
}

on envVar eVDI_V_distS
{
    _mVehiDist.VDI_V_dist.phys = getValue( this );
    VehiDistChanged();
}

// END MSG Uhrzeit_01

// MSG Verdeck_01

on Timer _tVerdeck_01
{
    if( getValue( eTVerdeck_01 ) <= 0)  putValue( eSendVerdeck_01, 0 );
    if( (getValue( eSendEnabled ) && getValue( eSendVerdeck_01 )) || getValue( eDlcOnceVerdeck_01 ))  sendVerdeck_01();
}

on envVar eSendVerdeck_01
{
    if( getValue( eSendEnabled ) && getValue( eSendVerdeck_01 ))  sendVerdeck_01();
    if( getValue( this )== 2) putValue(eTimeoutVerdeck_01,1);
}

on envVar eTimeoutVerdeck_01
{
    cancelTimer( _tVerdeck_01 );
    cancelTimer( _totVerdeck_01 );
    if( getValue( this ))
        setTimer( _totVerdeck_01, (getValue( eSendEnabled ) && getValue( eSendVerdeck_01 ) && (getValue( eTOTVerdeck_01 ) > 0)) ? getValue( eTOTVerdeck_01 ) : 1 );
    else
        if( getValue( eSendEnabled ) && getValue( eSendVerdeck_01 ))  sendVerdeck_01();
}

on Timer _totVerdeck_01
{
  putValue( eTimeoutVerdeck_01, 0 );
  putValue(eSendVerdeck_01,1);
}

on envVar eDlcOnceVerdeck_01
{
    if( getValue( eDlcOnceVerdeck_01 ) && !(getValue( eSendEnabled ) && getValue( eSendVerdeck_01 )))  setTimer( _tVerdeck_01, 1 );
}

void sendVerdeck_01()
{
    if( getValue(eChangeVerdeck_01))
    {    
        if( getValue( eDlcOnceVerdeck_01 ) || getValue( eDlcWrongVerdeck_01 ))
        {
            putValue( eDlcOnceVerdeck_01, 0 );
            _mVerdeck_01.DLC = getValue( eDlcVerdeck_01 );
        } 
        else
        {        
            _mVerdeck_01.DLC = 8;
        }   
    }
    else
    { 
        _mVerdeck_01.DLC = 8;
    }
    output( _mVerdeck_01 );
    cancelTimer( _tVerdeck_01 );
    if( getValue( eTVerdeck_01 ) > 0)  setTimer( _tVerdeck_01, getValue( eTVerdeck_01 ) );  else  setTimer( _tVerdeck_01, 1 );
}

Verdeck_01Changed()
{
}

on envVar KCAN_VD_SpannungsAnf
{
    _mVerdeck_01.VD_SpannungsAnf.phys = getValue( this );
    Verdeck_01Changed();
}

on envVar KCAN_VS_BFS_AutoHoch
{
    _mVerdeck_01.VS_BFS_AutoHoch.phys = getValue( this );
    Verdeck_01Changed();
}

on envVar KCAN_VS_BFS_AutoTief
{
    _mVerdeck_01.VS_BFS_AutoTief.phys = getValue( this );
    Verdeck_01Changed();
}

on envVar KCAN_VS_BFS_ManHoch
{
    _mVerdeck_01.VS_BFS_ManHoch.phys = getValue( this );
    Verdeck_01Changed();
}

on envVar KCAN_VS_BFS_ManTief
{
    _mVerdeck_01.VS_BFS_ManTief.phys = getValue( this );
    Verdeck_01Changed();
}

on envVar KCAN_VS_Buzzer
{
    _mVerdeck_01.VS_Buzzer.phys = getValue( this );
    Verdeck_01Changed();
}

on envVar KCAN_VS_FH_BT_Langhub
{
    _mVerdeck_01.VS_FH_BT_Langhub.phys = getValue( this );
    Verdeck_01Changed();
}

on envVar KCAN_VS_FH_FT_Langhub
{
    _mVerdeck_01.VS_FH_FT_Langhub.phys = getValue( this );
    Verdeck_01Changed();
}

on envVar KCAN_VS_FH_HBFS_Langhub
{
    _mVerdeck_01.VS_FH_HBFS_Langhub.phys = getValue( this );
    Verdeck_01Changed();
}

on envVar KCAN_VS_FH_HFS_Langhub
{
    _mVerdeck_01.VS_FH_HFS_Langhub.phys = getValue( this );
    Verdeck_01Changed();
}

on envVar KCAN_VS_FS_AutoHoch
{
    _mVerdeck_01.VS_FS_AutoHoch.phys = getValue( this );
    Verdeck_01Changed();
}

on envVar KCAN_VS_FS_AutoTief
{
    _mVerdeck_01.VS_FS_AutoTief.phys = getValue( this );
    Verdeck_01Changed();
}

on envVar KCAN_VS_FS_ManHoch
{
    _mVerdeck_01.VS_FS_ManHoch.phys = getValue( this );
    Verdeck_01Changed();
}

on envVar KCAN_VS_FS_ManTief
{
    _mVerdeck_01.VS_FS_ManTief.phys = getValue( this );
    Verdeck_01Changed();
}

on envVar KCAN_VS_Hardtop
{
    _mVerdeck_01.VS_Hardtop.phys = getValue( this );
    Verdeck_01Changed();
}

on envVar KCAN_VS_HBFS_AutoHoch
{
    _mVerdeck_01.VS_HBFS_AutoHoch.phys = getValue( this );
    Verdeck_01Changed();
}

on envVar KCAN_VS_HBFS_AutoTief
{
    _mVerdeck_01.VS_HBFS_AutoTief.phys = getValue( this );
    Verdeck_01Changed();
}

on envVar KCAN_VS_HBFS_ManHoch
{
    _mVerdeck_01.VS_HBFS_ManHoch.phys = getValue( this );
    Verdeck_01Changed();
}

on envVar KCAN_VS_HBFS_ManTief
{
    _mVerdeck_01.VS_HBFS_ManTief.phys = getValue( this );
    Verdeck_01Changed();
}

on envVar KCAN_VS_HD_sperren
{
    _mVerdeck_01.VS_HD_sperren.phys = getValue( this );
    Verdeck_01Changed();
}

on envVar KCAN_VS_Heckschloss_auf
{
    _mVerdeck_01.VS_Heckschloss_auf.phys = getValue( this );
    Verdeck_01Changed();
}

on envVar KCAN_VS_HFS_AutoHoch
{
    _mVerdeck_01.VS_HFS_AutoHoch.phys = getValue( this );
    Verdeck_01Changed();
}

on envVar KCAN_VS_HFS_AutoTief
{
    _mVerdeck_01.VS_HFS_AutoTief.phys = getValue( this );
    Verdeck_01Changed();
}

on envVar KCAN_VS_HFS_ManHoch
{
    _mVerdeck_01.VS_HFS_ManHoch.phys = getValue( this );
    Verdeck_01Changed();
}

on envVar KCAN_VS_HFS_ManTief
{
    _mVerdeck_01.VS_HFS_ManTief.phys = getValue( this );
    Verdeck_01Changed();
}

on envVar KCAN_VS_HHS_enable
{
    _mVerdeck_01.VS_HHS_enable.phys = getValue( this );
    Verdeck_01Changed();
}

on envVar KCAN_VS_Lampe_Blk
{
    _mVerdeck_01.VS_Lampe_Blk.phys = getValue( this );
    Verdeck_01Changed();
}

on envVar KCAN_VS_StartStopp_Info
{
    _mVerdeck_01.VS_StartStopp_Info.phys = getValue( this );
    Verdeck_01Changed();
}

on envVar KCAN_VS_VD_Bew_auf
{
    _mVerdeck_01.VS_VD_Bew_auf.phys = getValue( this );
    Verdeck_01Changed();
}

on envVar KCAN_VS_VD_Bew_zu
{
    _mVerdeck_01.VS_VD_Bew_zu.phys = getValue( this );
    Verdeck_01Changed();
}

on envVar KCAN_VS_VD_entriegelt
{
    _mVerdeck_01.VS_VD_entriegelt.phys = getValue( this );
    Verdeck_01Changed();
}

on envVar KCAN_VS_VD_Fehler
{
    _mVerdeck_01.VS_VD_Fehler.phys = getValue( this );
    Verdeck_01Changed();
}

on envVar KCAN_VS_VD_offen_ver
{
    _mVerdeck_01.VS_VD_offen_ver.phys = getValue( this );
    Verdeck_01Changed();
}

on envVar KCAN_VS_VD_zu_ver
{
    _mVerdeck_01.VS_VD_zu_ver.phys = getValue( this );
    Verdeck_01Changed();
}

on envVar KCAN_VS_VD_Zwischenposition
{
    _mVerdeck_01.VS_VD_Zwischenposition.phys = getValue( this );
    Verdeck_01Changed();
}

on envVar KCAN_VS_Verdeck_Anf
{
    _mVerdeck_01.VS_Verdeck_Anf.phys = getValue( this );
    Verdeck_01Changed();
}

on envVar KCAN_VS_VDKD_auf
{
    _mVerdeck_01.VS_VDKD_auf.phys = getValue( this );
    Verdeck_01Changed();
}

on envVar KCAN_VS_Windschott_nicht_abgelegt
{
    _mVerdeck_01.VS_Windschott_nicht_abgelegt.phys = getValue( this );
    Verdeck_01Changed();
}

on envVar eVSG_MeldungenS
{
    putValue( KCAN_VSG_Meldungen, getValue( this ) );
}

on envVar KCAN_VSG_Meldungen
{
    _mVerdeck_01.VSG_Meldungen.phys = getValue( this );
    Verdeck_01Changed();
}

//END MSG Verdeck_01

// MSG VIN_01

on Timer _tVIN_01
{
 // if( getValue( eTVIN_01 ) <= 0)  putValue( eSendVIN_01, 0 );
 // if( (getValue( eSendEnabled ) && getValue( eSendVIN_01 )) || getValue( eDlcOnceVIN_01 ))  sendVIN_01();
}

// END MSG VIN_01
// MSG VLK_01

//END MSG VLK_01

// MSG WFS_01

on Timer _tWFS_01
{
    if( getValue( eTWFS_01 ) <= 0)  putValue( eSendWFS_01, 0 );
    if( (getValue( eSendEnabled ) && getValue( eSendWFS_01 )) || getValue( eDlcOnceWFS_01 ))  sendWFS_01();
}

on envVar eSendWFS_01
{
    if( getValue( eSendEnabled ) && getValue( eSendWFS_01 ))  sendWFS_01();
}

on envVar eTimeoutWFS_01
{
    cancelTimer( _tWFS_01 );
    cancelTimer( _totWFS_01 );
    if( getValue( this ))
        setTimer( _totWFS_01, (getValue( eSendEnabled ) && getValue( eSendWFS_01 ) && (getValue( eTOTWFS_01 ) > 0)) ? getValue( eTOTWFS_01 ) : 1 );
    else
        if( getValue( eSendEnabled ) && getValue( eSendWFS_01 ))  sendWFS_01();
}

on Timer _totWFS_01
{
  putValue( eTimeoutWFS_01, 0 );
}

on envVar eDlcOnceWFS_01
{
    if( getValue( eDlcOnceWFS_01 ) && !(getValue( eSendEnabled ) && getValue( eSendWFS_01 )))  setTimer( _tWFS_01, 1 );
}

void sendWFS_01()
{
    if( getValue(eChangeWFS_01))
    {    
        if( getValue( eDlcOnceWFS_01 ) || getValue( eDlcWrongWFS_01 ))
        {
            putValue( eDlcOnceWFS_01, 0 );
            _mWFS_01.DLC = getValue( eDlcWFS_01 );
        } 
        else
        {        
            _mWFS_01.DLC = 8;
        }   
    }
    else
    { 
        _mWFS_01.DLC = 8;
    }
    output( _mWFS_01 );
    cancelTimer( _tWFS_01 );
    if( getValue( eTWFS_01 ) > 0)  setTimer( _tWFS_01, getValue( eTWFS_01 ) );  else  setTimer( _tWFS_01, 1 );
}

on envVar eWFS_FahrerhinweiseS
{
    _mWFS_01.WFS_Fahrerhinweise.phys = getValue( this );
}

on envVar eWFS_LZS
{
    _mWFS_01.WFS_LZ.phys = getValue( this );
}

on envVar eWFS_SafeS
{
    _mWFS_01.WFS_Safe.phys = getValue( this );
}

on envVar eWFS_Schluessel_IstS
{
    _mWFS_01.WFS_Schluessel_Ist.phys = getValue( this );
}

on envVar eWFS_Schluessel_SollS
{
    _mWFS_01.WFS_Schluessel_Soll.phys = getValue( this );
}

// END MSG WFS_01

// MSG WFS_Transponder_Status_02



// END MSG WFS_Transponder_Status_02

// MSG Wischer_01

on Timer _tWischer_01
{
    if( getValue( eTWischer_01 ) <= 0)  putValue( eSendWischer_01, 0 );
    if( (getValue( eSendEnabled ) && getValue( eSendWischer_01 )) || getValue( eDlcOnceWischer_01 ))  sendWischer_01();
}

on envVar eSendWischer_01
{
    if( getValue( eSendEnabled ) && getValue( eSendWischer_01 ))  sendWischer_01();
}

on envVar eTimeoutWischer_01
{
    cancelTimer( _tWischer_01 );
    cancelTimer( _totWischer_01 );
    if( getValue( this ))
        setTimer( _totWischer_01, (getValue( eSendEnabled ) && getValue( eSendWischer_01 ) && (getValue( eTOTWischer_01 ) > 0)) ? getValue( eTOTWischer_01 ) : 1 );
    else
        if( getValue( eSendEnabled ) && getValue( eSendWischer_01 ))  sendWischer_01();
}

on Timer _totWischer_01
{
    putValue( eTimeoutWischer_01, 0 );
}

on envVar eDlcOnceWischer_01
{
    if( getValue( eDlcOnceWischer_01 ) && !(getValue( eSendEnabled ) && getValue( eSendWischer_01 )))  setTimer( _tWischer_01, 1 );
}

on Timer _tinhWischer_01
{
    _bsiWischer_01 = 0;
    if( _bsaiWischer_01 && getValue( eSendEnabled ))  sendWischer_01();
}

void sendWischer_01()
{
    if( getValue(eChangeWischer_01))
    {
        if( getValue( eDlcOnceWischer_01 ) || getValue( eDlcWrongWischer_01 ))
        {
            putValue( eDlcOnceWischer_01, 0 );
            _mWischer_01.DLC = getValue( eDlcWischer_01 );
        }
        else
        {
            _mWischer_01.DLC = 2;
        }
    }
    else
    {
        _mWischer_01.DLC = 2;
    }

    output( _mWischer_01 );
    cancelTimer( _tWischer_01 );
    if( getValue( eTWischer_01 ) > 0)  setTimer( _tWischer_01, getValue( eTWischer_01 ) );  else  setTimer( _tWischer_01, 1 );
    _bsaiWischer_01 = 0;
    _bsiWischer_01 = 1;
    cancelTimer( _tinhWischer_01 );  setTimer( _tinhWischer_01, 50 );
}

Wischer_01Changed()
{
    if( getValue( eSendEnabled ) && getValue( eSendWischer_01 ))
        if( _bsiWischer_01)
            _bsaiWischer_01 = 1;
        else
            sendWischer_01();
}

on envVar eWischer_vorne_aktivS
{
    _mWischer_01.Wischer_vorne_aktiv.phys = getValue( this );
    Wischer_01Changed();
}

on envVar eWaschen_vorne_aktivS
{
    _mWischer_01.Waschen_vorne_aktiv.phys = getValue( this );
    Wischer_01Changed();
}

on envVar eWischer_vorne_NormalS
{
    _mWischer_01.Wischer_vorne_Normal.phys = getValue( this );
    Wischer_01Changed();
}

on envVar eWischer_vorne_ParklageS
{
    _mWischer_01.Wischer_vorne_Parklage.phys = getValue( this );
    Wischer_01Changed();
}

on envVar eWischer_vorne_defektS
{
    _mWischer_01.Wischer_vorne_defekt.phys = getValue( this );
    Wischer_01Changed();
}

on envVar eWischer_vorne_blockiertS
{
    _mWischer_01.Wischer_vorne_blockiert.phys = getValue( this );
    Wischer_01Changed();
}

on envVar eWischer_vorne_SchnellS
{
    _mWischer_01.Wischer_vorne_Schnell.phys = getValue( this );
    Wischer_01Changed();
}

// END MSG Wischer_01

// MSG WLC1_01

//END MSG WLC1_01

// MSG ZFH_01

//END MSG ZFH_01

// MSG ZV_01

// END MSG ZV_01

//MSG ZV_02

on Timer _tZV_02
{
  if( getValue( eTZV_02 ) <= 0)  putValue( eSendZV_02, 0 );
  if( (getValue( eSendEnabled ) && getValue( eSendZV_02 )) || getValue( eDlcOnceZV_02 ))  sendZV_02();
}

on envVar eSendZV_02
{
    if( getValue( eSendEnabled ) && getValue( eSendZV_02 ))  sendZV_02();
}

on envVar eTimeoutZV_02
{
    cancelTimer( _tZV_02 );
    cancelTimer( _totZV_02 );
    if( getValue( this ))
        setTimer( _totZV_02, (getValue( eSendEnabled ) && getValue( eSendZV_02 ) && (getValue( eTOTZV_02 ) > 0)) ? getValue( eTOTZV_02 ) : 1 );
    else
        if( getValue( eSendEnabled ) && getValue( eSendZV_02 ))  sendZV_02();
}

on Timer _totZV_02
{
    putValue( eTimeoutZV_02, 0 );
}

on envVar eDlcOnceZV_02
{
    if( getValue( eDlcOnceZV_02 ) && !(getValue( eSendEnabled ) && getValue( eSendZV_02 )))  setTimer( _tZV_02, 1 );
}

on Timer _tinhZV_02
{
    _bsiZV_02 = 0;
    if( _bsaiZV_02 && getValue( eSendEnabled ))  sendZV_02();
}

void sendZV_02()
{
    if( getValue(eChangeZV_02))
    {
        if( getValue( eDlcOnceZV_02 ) || getValue( eDlcWrongZV_02 ))
        {
            putValue( eDlcOnceZV_02, 0 );
            _mZV_02.DLC = getValue( eDlcZV_02 );
        }
        else
        {
            _mZV_02.DLC = 8;
        }
    }
    else
    {
        _mZV_02.DLC = 8;
    }

    output( _mZV_02 );
    cancelTimer( _tZV_02 );
    if( _bZV_02Active)
        setTimer( _tZV_02, 50 );
    else
        if( getValue( eTZV_02 ) > 0)  setTimer( _tZV_02, getValue( eTZV_02 ) );  else  setTimer( _tZV_02, 1 );
    _bsaiZV_02 = 0;
    _bsiZV_02 = 1;
    cancelTimer( _tinhZV_02 );  setTimer( _tinhZV_02, 50 );
}

byte isZV_02Active()
{
    if( getValue( eBCM_FH_FreigabeS ) != 0)  return 1;
    if( getValue( eBCM_HSK_FreigabeS ) != 0)  return 1;
    if( getValue( eBCM_Komfortfkt_FreigabeS ) != 0)  return 1;
    if( getValue( KCAN_BCM_Tankklappensteller_Fehler ) != 0)  return 1;
    if( getValue( eBCM_Verdeck_FreigabeS ) != 0 )  return 1;
    if( getValue( eDWA_aktivS ) != 0 )  return 1;
    if( getValue( eFBS_IDG_in_ReichweiteS ) != 0 )  return 1;
    if( getValue( eFBS_Warn_Schluessel_BattS ) != 0 )  return 1;
    if( getValue( eFFB_Auf_TasteS ) != 0 )  return 1;
    if( getValue( eFFB_CarFinderS ) != 0 )  return 1;
    if( getValue( eFFB_HDF_TasteS ) != 0 )  return 1;
    if( getValue( eFFB_KomfortoeffnenS ) != 0 )  return 1;
    if( getValue( eFFB_KomfortschliessenS ) != 0 )  return 1;
    if( getValue( eFFB_Panik_TasteS ) != 0 )  return 1;
    if( getValue( eFFB_Zu_TasteS ) != 0 )  return 1;
    if( getValue( KCAN_HBFS_gesafet ) != 0 )  return 1;
    if( getValue( KCAN_HBFS_verriegelt ) != 0 )  return 1;
    if( getValue( eHD_HauptrasteS ) != 0 )  return 1;
    if( getValue( eHD_VorrasteS ) != 0 )  return 1;
    if( getValue( KCAN_HFS_gesafet ) != 0 )  return 1;
    if( getValue( KCAN_HFS_verriegelt ) != 0 )  return 1;
    if( getValue( eIRUE_aktivS ) != 0 )  return 1;
    if( getValue( KCAN_IRUE_Taster_Fkts_LED ) != 0 )  return 1;
    if( getValue( eZV_BT_offenS ) != 0 )  return 1;
    if( getValue( eZV_EinzeltuerentriegelungS ) != 0 )  return 1;
    if( getValue( KCAN_ZV_eRWK_Umfeld_Pruefung ) != 0 )  return 1;
    if( getValue( eZV_FT_offenS ) != 0 )  return 1;
    if( getValue( eZV_gesafet_extern_istS ) != 0 )  return 1;
    if( getValue( eZV_gesafet_extern_sollS ) != 0 )  return 1;
    if( getValue( eZV_HBFS_offenS ) != 0 )  return 1;
    if( getValue( eZV_HD_offenS ) != 0 )  return 1;
    if( getValue( eZV_HeckeinzelentriegelungS ) != 0 )  return 1;
    if( getValue( eZV_HFS_offenS ) != 0 )  return 1;
    if( getValue( eZV_HS_offenS ) != 0 )  return 1;
    if( getValue( KCAN_ZV_ist_Zustand_verfuegbar ) != 0 )  return 1;
    if( getValue( KCAN_ZV_Oeffnungsmodus ) != 0 )  return 1;
    if( getValue( KCAN_ZV_Rollo_auf ) != 0 )  return 1;
    if( getValue( KCAN_ZV_Rollo_zu ) != 0 )  return 1;
    if( getValue( KCAN_ZV_SAD_auf ) != 0 )  return 1;
    if( getValue( KCAN_ZV_SAD_zu ) != 0 )  return 1;
    if( getValue( eZV_SafeFunktion_aktivS ) != 0 )  return 1;
    if( getValue( KCAN_ZV_Schluessel_Zugang ) != 0 )  return 1;
    if( getValue( KCAN_ZV_STSG_HBFS_Anf ) != 0 )  return 1;
    if( getValue( KCAN_ZV_STSG_HFS_Anf ) != 0 )  return 1;
    if( getValue( KCAN_ZV_Tankklappe_offen ) != 0 )  return 1;
    if( getValue( KCAN_ZV_verriegeln_Anf ) != 0 )  return 1;
    if( getValue( eZV_verriegelt_extern_istS ) != 0 )  return 1;
    if( getValue( eZV_verriegelt_extern_sollS ) != 0 )  return 1;
    if( getValue( eZV_verriegelt_intern_istS ) != 0 )  return 1;
    if( getValue( eZV_verriegelt_intern_sollS ) != 0 )  return 1;
    if( getValue( KCAN_ZV_verriegelt_soll ) != 0 )  return 1;
  return 0;
}

ZV_02Changed()
{
    _bZV_02Active = isZV_02Active();
    if( getValue( eSendEnabled ) && getValue( eSendZV_02 ))
        if( _bsiZV_02)
            _bsaiZV_02 = 1;
        else
            sendZV_02();
}

on envVar eBCM_FH_FreigabeS
{
    putValue( KCAN_BCM_FH_Freigabe, getValue( this ) );
}

on envVar KCAN_BCM_FH_Freigabe
{
    _mZV_02.BCM_FH_Freigabe.phys = getValue( this );
    ZV_02Changed();
}

on envVar eBCM_HSK_FreigabeS
{
    putValue( KCAN_BCM_HSK_Freigabe, getValue( this ) );
}

on envVar KCAN_BCM_HSK_Freigabe
{
    _mZV_02.BCM_HSK_Freigabe.phys = getValue( this );
    ZV_02Changed();
}

on envVar eBCM_Komfortfkt_FreigabeS
{
    putValue( KCAN_BCM_Komfortfkt_Freigabe, getValue( this ) );
}

on envVar KCAN_BCM_Komfortfkt_Freigabe
{
    _mZV_02.BCM_Komfortfkt_Freigabe.phys = getValue( this );
    ZV_02Changed();
}

on envVar KCAN_BCM_Tankklappensteller_Fehler
{
    _mZV_02.BCM_Tankklappensteller_Fehler.phys = getValue( this );
    ZV_02Changed();
}

on envVar eBCM_Verdeck_FreigabeS
{
    putValue( KCAN_BCM_Verdeck_Freigabe, getValue( this ) );
}

on envVar KCAN_BCM_Verdeck_Freigabe
{
    _mZV_02.BCM_Verdeck_Freigabe.phys = getValue( this );
    ZV_02Changed();
}

on envVar eDWA_aktivS
{
    putValue( KCAN_DWA_aktiv, getValue( this ) );
}

on envVar KCAN_DWA_aktiv
{
    _mZV_02.DWA_aktiv.phys = getValue( this );
    ZV_02Changed();
}

on envVar eFBS_IDG_in_ReichweiteS
{
    putValue( KCAN_FBS_IDG_in_Reichweite, getValue( this ) );
}

on envVar KCAN_FBS_IDG_in_Reichweite
{
    _mZV_02.FBS_IDG_in_Reichweite.phys = getValue( this );
    ZV_02Changed();
}

on envVar eFBS_Warn_Schluessel_BattS
{
    putValue( KCAN_FBS_Warn_Schluessel_Batt, getValue( this ) );
}

on envVar KCAN_FBS_Warn_Schluessel_Batt
{
    _mZV_02.FBS_Warn_Schluessel_Batt.phys = getValue( this );
    ZV_02Changed();
}

on envVar eFFB_Auf_TasteS
{
    putValue( KCAN_FFB_Auf_Taste, getValue( this ) );
}

on envVar KCAN_FFB_Auf_Taste
{
    _mZV_02.FFB_Auf_Taste.phys = getValue( this );
    ZV_02Changed();
}

on envVar eFFB_CarFinderS
{
    putValue( KCAN_FFB_CarFinder, getValue( this ) );
}

on envVar KCAN_FFB_CarFinder
{
    _mZV_02.FFB_CarFinder.phys = getValue( this );
    ZV_02Changed();
}

on envVar eFFB_HDF_TasteS
{
    putValue( KCAN_FFB_HDF_Taste, getValue( this ) );
}

on envVar KCAN_FFB_HDF_Taste
{
    _mZV_02.FFB_HDF_Taste.phys = getValue( this );
    ZV_02Changed();
}

on envVar eFFB_KomfortoeffnenS
{
    putValue( KCAN_FFB_Komfortoeffnen, getValue( this ) );
}

on envVar KCAN_FFB_Komfortoeffnen
{
    _mZV_02.FFB_Komfortoeffnen.phys = getValue( this );
    ZV_02Changed();
}

on envVar eFFB_KomfortschliessenS
{
    putValue( KCAN_FFB_Komfortschliessen, getValue( this ) );
}

on envVar KCAN_FFB_Komfortschliessen
{
    _mZV_02.FFB_Komfortschliessen.phys = getValue( this );
    ZV_02Changed();
}

on envVar eFFB_Panik_TasteS
{
    putValue( KCAN_FFB_Panik_Taste, getValue( this ) );
}

on envVar KCAN_FFB_Panik_Taste
{
    _mZV_02.FFB_Panik_Taste.phys = getValue( this );
    ZV_02Changed();
}

on envVar eFFB_Zu_TasteS
{
    putValue( KCAN_FFB_Zu_Taste, getValue( this ) );
}

on envVar KCAN_FFB_Zu_Taste
{
    _mZV_02.FFB_Zu_Taste.phys = getValue( this );
    ZV_02Changed();
}

on envVar KCAN_HBFS_gesafet
{
    _mZV_02.HBFS_gesafet.phys = getValue( this );
    ZV_02Changed();
}

on envVar KCAN_HBFS_verriegelt
{
    _mZV_02.HBFS_verriegelt.phys = getValue( this );
    ZV_02Changed();
}

on envVar eHD_HauptrasteS
{
    putValue( KCAN_HD_Hauptraste, getValue( this ) );
}

on envVar KCAN_HD_Hauptraste
{
    _mZV_02.HD_Hauptraste.phys = getValue( this );
    ZV_02Changed();
}

on envVar eHD_VorrasteS
{
    putValue( KCAN_HD_Vorraste, getValue( this ) );
}

on envVar KCAN_HD_Vorraste
{
    _mZV_02.HD_Vorraste.phys = getValue( this );
    ZV_02Changed();
}

on envVar KCAN_HFS_gesafet
{
    _mZV_02.HFS_gesafet.phys = getValue( this );
    ZV_02Changed();
}

on envVar KCAN_HFS_verriegelt
{
    _mZV_02.HFS_verriegelt.phys = getValue( this );
    ZV_02Changed();
}

on envVar eIRUE_aktivS
{
    putValue( KCAN_IRUE_aktiv, getValue( this ) );
}

on envVar KCAN_IRUE_aktiv
{
    _mZV_02.IRUE_aktiv.phys = getValue( this );
    ZV_02Changed();
}

on envVar KCAN_IRUE_Taster_Fkts_LED
{
    _mZV_02.IRUE_Taster_Fkts_LED.phys = getValue( this );
    ZV_02Changed();
}

on envVar eZV_BT_offenS
{
    putValue( KCAN_ZV_BT_offen, getValue( this ) );
}

on envVar KCAN_ZV_BT_offen
{
    _mZV_02.ZV_BT_offen.phys = getValue( this );
    ZV_02Changed();
}

on envVar eZV_EinzeltuerentriegelungS
{
    putValue( KCAN_ZV_Einzeltuerentriegelung, getValue( this ) );
}

on envVar KCAN_ZV_Einzeltuerentriegelung
{
    _mZV_02.ZV_Einzeltuerentriegelung.phys = getValue( this );
    ZV_02Changed();
}

on envVar eZV_FT_offenS
{
    putValue( KCAN_ZV_FT_offen, getValue( this ) );
}

on envVar KCAN_ZV_FT_offen
{
    _mZV_02.ZV_FT_offen.phys = getValue( this );
    ZV_02Changed();
}

on envVar eZV_gesafet_extern_istS
{
    putValue( KCAN_ZV_gesafet_extern_ist, getValue( this ) );
}

on envVar KCAN_ZV_gesafet_extern_ist
{
    _mZV_02.ZV_gesafet_extern_ist.phys = getValue( this );
    ZV_02Changed();
}

on envVar eZV_gesafet_extern_sollS
{
    putValue( KCAN_ZV_gesafet_extern_soll, getValue( this ) );
}

on envVar KCAN_ZV_gesafet_extern_soll
{
    _mZV_02.ZV_gesafet_extern_soll.phys = getValue( this );
    ZV_02Changed();
}

on envVar eZV_HBFS_offenS
{
    putValue( KCAN_ZV_HBFS_offen, getValue( this ) );
}

on envVar KCAN_ZV_HBFS_offen
{
    _mZV_02.ZV_HBFS_offen.phys = getValue( this );
    ZV_02Changed();
}

on envVar eZV_HD_offenS
{
    putValue( KCAN_ZV_HD_offen, getValue( this ) );
}

on envVar KCAN_ZV_HD_offen
{
    _mZV_02.ZV_HD_offen.phys = getValue( this );
    ZV_02Changed();
}

on envVar eZV_HeckeinzelentriegelungS
{
    putValue( KCAN_ZV_Heckeinzelentriegelung, getValue( this ) );
}

on envVar KCAN_ZV_Heckeinzelentriegelung
{
    _mZV_02.ZV_Heckeinzelentriegelung.phys = getValue( this );
    ZV_02Changed();
}

on envVar eZV_HFS_offenS
{
    putValue( KCAN_ZV_HFS_offen, getValue( this ) );
}

on envVar KCAN_ZV_HFS_offen
{
    _mZV_02.ZV_HFS_offen.phys = getValue( this );
    ZV_02Changed();
}

on envVar eZV_HS_offenS
{
    putValue( KCAN_ZV_HS_offen, getValue( this ) );
}

on envVar KCAN_ZV_HS_offen
{
    _mZV_02.ZV_HS_offen.phys = getValue( this );
    ZV_02Changed();
}

on envVar KCAN_ZV_ist_Zustand_verfuegbar
{
    _mZV_02.ZV_ist_Zustand_verfuegbar.phys = getValue( this );
    ZV_02Changed();
}

on envVar KCAN_ZV_Oeffnungsmodus
{
    _mZV_02.ZV_Oeffnungsmodus.phys = getValue( this );
    ZV_02Changed();
}

on envVar KCAN_ZV_Rollo_auf
{
    _mZV_02.ZV_Rollo_auf.phys = getValue( this );
    ZV_02Changed();
}

on envVar KCAN_ZV_Rollo_zu
{
    _mZV_02.ZV_Rollo_zu.phys = getValue( this );
    ZV_02Changed();
}

on envVar KCAN_ZV_SAD_auf
{
    _mZV_02.ZV_SAD_auf.phys = getValue( this );
    ZV_02Changed();
}

on envVar KCAN_ZV_SAD_zu
{
    _mZV_02.ZV_SAD_zu.phys = getValue( this );
    ZV_02Changed();
}

on envVar eZV_SafeFunktion_aktivS
{
    putValue( KCAN_ZV_SafeFunktion_aktiv, getValue( this ) );
}

on envVar KCAN_ZV_SafeFunktion_aktiv
{
    _mZV_02.ZV_SafeFunktion_aktiv.phys = getValue( this );
    ZV_02Changed();
}

on envVar eZV_Schluessel_ZugangS
{
    putValue( KCAN_ZV_Schluessel_Zugang, getValue( this ) );
}

on envVar KCAN_ZV_Schluessel_Zugang
{
    _mZV_02.ZV_Schluessel_Zugang.phys = getValue( this );
    ZV_02Changed();
}

on envVar KCAN_ZV_STSG_HBFS_Anf
{
    _mZV_02.ZV_STSG_HBFS_Anf.phys = getValue( this );
    ZV_02Changed();
}

on envVar KCAN_ZV_STSG_HFS_Anf
{
    _mZV_02.ZV_STSG_HFS_Anf.phys = getValue( this );
    ZV_02Changed();
}

on envVar eZV_Tankklappe_offenS
{
    putValue( KCAN_ZV_Tankklappe_offen, getValue( this ) );
}

on envVar KCAN_ZV_Tankklappe_offen
{
    _mZV_02.ZV_Tankklappe_offen.phys = getValue( this );
    ZV_02Changed();
}

on envVar KCAN_ZV_verriegeln_Anf
{
    _mZV_02.ZV_verriegeln_Anf.phys = getValue( this );
    ZV_02Changed();
}

on envVar eZV_verriegelt_extern_istS
{
    putValue( KCAN_ZV_verriegelt_extern_ist, getValue( this ) );
}

on envVar KCAN_ZV_verriegelt_extern_ist
{
    _mZV_02.ZV_verriegelt_extern_ist.phys = getValue( this );
    ZV_02Changed();
}

on envVar eZV_verriegelt_extern_sollS
{
    putValue( KCAN_ZV_verriegelt_extern_soll, getValue( this ) );
}

on envVar KCAN_ZV_verriegelt_extern_soll
{
    _mZV_02.ZV_verriegelt_extern_soll.phys = getValue( this );
    ZV_02Changed();
}

on envVar eZV_verriegelt_intern_istS
{
    putValue( KCAN_ZV_verriegelt_intern_ist, getValue( this ) );
}

on envVar KCAN_ZV_verriegelt_intern_ist
{
    _mZV_02.ZV_verriegelt_intern_ist.phys = getValue( this );
    ZV_02Changed();
}

on envVar eZV_verriegelt_intern_sollS
{
    putValue( KCAN_ZV_verriegelt_intern_soll, getValue( this ) );
}

on envVar KCAN_ZV_verriegelt_intern_soll
{
    _mZV_02.ZV_verriegelt_intern_soll.phys = getValue( this );
    ZV_02Changed();
}

on envVar KCAN_ZV_verriegelt_soll
{
    _mZV_02.ZV_verriegelt_soll.phys = getValue( this );
    ZV_02Changed();
}

// END MSG ZV_02


on busOff
{
    putValue( eSendEnabled, 0x0 );
}

on errorActive
{
 if(( this.can==1)&&(@PlayReplayblock==0))//only for KI-Can not for ICOM @RV
    putValue(eSendEnabled, 0x1);
}

on errorPassive
{
 if(( this.can==1)&&(@PlayReplayblock==0))//only for KI-Can not for ICOM @RV
    putValue(eSendEnabled, 0x1);
}

on Timer _tBAP_BC_ASG_02
{
    if( getValue( eTBAP_BC_ASG_02 ) <= 0)  putValue( eSendBAP_BC_ASG_02, 0 );
    if( ( getValue( eSendEnabled ) && getValue( eSendBAP_BC_ASG_02 )) || getValue( eDlcOnceBAP_BC_ASG_02 ))  sendBAP_BC_ASG_02();
}

on Timer _totBAP_BC_ASG_02
{
    putValue( eTimeoutBAP_BC_ASG_02, 0 );
}

void sendBAP_BC_ASG_02()
{
    if( getValue(eChangeBAP_BC_ASG_02))
    {
        if( getValue( eDlcOnceBAP_BC_ASG_02 ) || getValue( eDlcWrongBAP_BC_ASG_02 ))
        {
        putValue( eDlcOnceBAP_BC_ASG_02, 0 );
   //     _mBAP_BC_ASG_02.DLC = getValue( eDlcBAP_BC_ASG_02 );
    }
    else
    {
  //      _mBAP_BC_ASG_02.DLC = 8;
    }
  }
  else
  {
 //   _mBAP_BC_ASG_02.DLC = 8;
  }
 // output( _mBAP_BC_ASG_02 );
  cancelTimer( _tBAP_BC_ASG_02 );
//  if( getValue( eTBAP_BC_ASG_02 ) > 0)  setTimer( _tBAP_BC_ASG_02, getValue( eTBAP_BC_ASG_02 ) );  else  setTimer( _tBAP_BC_ASG_02, 1 );
}

on envVar eSendBAP_BC_ASG_02
{
  if( getValue( eSendEnabled ) && getValue( eSendBAP_BC_ASG_02 ))  sendBAP_BC_ASG_02();
}

on envVar eTimeoutBAP_BC_ASG_02
{
  cancelTimer( _tBAP_BC_ASG_02 );
  cancelTimer( _totBAP_BC_ASG_02 );
  if( getValue( this ))
    setTimer( _totBAP_BC_ASG_02, (getValue( eSendEnabled ) && getValue( eSendBAP_BC_ASG_02 ) && (getValue( eTOTBAP_BC_ASG_02 ) > 0)) ? getValue( eTOTBAP_BC_ASG_02 ) : 1 );
  else
    if( getValue( eSendEnabled ) && getValue( eSendBAP_BC_ASG_02 ))  sendBAP_BC_ASG_02();
}

on envVar eDlcOnceBAP_BC_ASG_02
{
  if( getValue( eDlcOnceBAP_BC_ASG_02 ) && !(getValue( eSendEnabled ) && getValue( eSendBAP_BC_ASG_02 )))  setTimer( _tBAP_BC_ASG_02, 1 );
}

on envVar eBAP_BC_ASG_02_HeaderS

{
//_mBAP_BC_ASG_02.BAP_BC_ASG_02_Header.phys = getValue(eBAP_BC_ASG_02_HeaderS);

}

