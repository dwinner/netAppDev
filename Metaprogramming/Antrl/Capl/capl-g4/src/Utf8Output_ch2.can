/*@@var:*/
variables
{
    byte utf08Table[1024][7];
    byte utf16Table[1024][2];
}
/*@@end*/

/*@@startStart:Start:*/
on start
{


}
/*@@end*/

/*@@envVar:ed_OutputMsg:*/
on envVar ed_OutputMsg
{
    if(!getvalue(this)) return;
    outputMessage();
}
/*@@end*/

/*@@caplFunc:outputMessage():*///function
void outputMessage()
{

      qword msgID; 
      message * freeTelegram;
      byte buffer[1024],i;
      int index=0,length;

      if(getvalue(ed_Channel)!=2) return;
      
      msgID=getvalue(ed_frameID);

      if(getValue(ed_extendedID)){
        freeTelegram.ID=mkExtId(msgID);
      }else{
        freeTelegram.ID=msgID;
      }

      freeTelegram.DLC=8;

      length=getvalue(ed_frame,buffer);
      
      index=0;
      do{
        for(i=0;i<8&i<length;i++){
            freeTelegram.BYTE(i)=buffer[index];
            index++;
        }

        for(;i<8;i++){
            freeTelegram.BYTE(i)=0xAA;

        }
        output(freeTelegram);
      }while(index<length);
}
/*@@end*/

/*@@envVar:ed_PhoneBookTelNum_OutputFrame:*/

/*@@end*/

/*@@envVar:ed_PhoneBookTelNum_CreateFrame:*/

/*@@end*/

