/*@!Encoding:1252*/
variables
{
}

on EnvVar eLoadSettings
{

  char orgfile[1024];   // original filename/path
  char modfile[1024];   // modified name
  char modpath[1024];   // modified path
  dword handle;         // fileread result
  int orgidx;           // original file array index
  int nameidx;          // modified name index
  int pathidx;          // modified path index
  int bslctr;           // backslash counter     (to find how many)
  int bslctr2;          // backslash counter2    (to know when filename starts)
  int ctr;              // general purpose counter

  // init arrays
  for (ctr = 0; ctr < 1024; ctr++)
  {
    orgfile[ctr] = 0;   // init original filename/path
    modfile[ctr] = 0;   // init modified filename
    modpath[ctr] = 0;   // init modified path
  }

  if (getValue( this ))
  {
    getValue( eLoadSettingsFile, orgfile );

    // count the number of "backslash"
    bslctr = 0;
    orgidx = 0;
    while (orgfile[orgidx] != 0)
    {
      if (orgfile[orgidx] == 0x5C)
      {
        bslctr++;   // backslash counter
      }
      orgidx++;
    }

    // store path and filename
    orgidx = 0;
    bslctr2 = 0;
    pathidx = 0;
    nameidx = 0;
    while (orgfile[orgidx] != 0)
    {
      if (bslctr2 != bslctr)    // store path until last backslash
      {
        if (orgfile[orgidx] == 0x5C)
        {
          bslctr2++;
        }
        // store path
        modpath[pathidx] = orgfile[orgidx];
        pathidx++;
      }
      else
      {
        // store filename
        modfile[nameidx] = orgfile[orgidx];
        nameidx++;
      }
      orgidx++;
    }

    setFilePath(modpath, 0);      //set path for *.ini file
    handle = openFileRead( modfile, 1 );

    if (handle > 0)
    {
      fileClose( handle );
      loadSettings( modfile );
      strncat( modfile, " LOADED", elcount( modfile ) );

    }
    else
    {
      strncat( modfile, " NOT FOUND", elcount( modfile ) );
    }
    putValue( eSettingsResult, modfile );
  }
}

on EnvVar eSaveSettings
{
  char file[1024], filepath[1200], dirpath[1200], StrFileName[100];
  dword handle, i =0, j =0, index =0, StrLength =0;

  if (getValue( this ))
  {
    getValue( eSaveSettingsFile, file );

    //write("\n Selected file path is %s", file);

    while(file[i] != '\0')
    {
        if (file[i] != '\\')
        {
            filepath[j] = file[i];
            j++;
            i++;
        }
        else
        {
            index = j;
            filepath[j] = file[i];
            filepath[j+1] = file[i];
            j+=2;
            i++;
        }
    }

    filepath[j] = '\0';
    StrLength = strlen(filepath);

    for(i=0; i<index; i++)
    {
        dirpath[i] = filepath[i];
    }
    dirpath[i] = '\0';

    j=0;
    for(i=index+2; i<StrLength; i++)
    {
        StrFileName[j] = filepath[i];
        j++;
    }

    StrFileName[j] = '\0';

    //write("\n Dir path is %s", dirpath);
    //write("\n File name is %s", StrFileName);

    setWritePath(dirpath);
    /*handle = openFileWrite (file, 1);
    if (handle > 0)
    {
        saveSettings(file);
        fileClose( handle );
    }*/
    saveSettings(StrFileName);

    if (writeProfileInt( "Settings", "Test", 1, StrFileName ) == 0)
    {
      strncat( StrFileName, " NOT", elcount( StrFileName ) );
    }
    strncat( StrFileName, " WRITTEN", elcount( StrFileName ) );
    putValue( eSettingsResult, StrFileName );

    file[0] = '\0';
    filepath[0] = '\0';
    dirpath[0] = '\0';
    StrFileName[0] = '\0';
    i=j=index=StrLength=0;

    setWritePath("");
  }
}

on start
{
    putValue( eSaveSettings_To_ini, 1 ); /*Initialising the value for the Load seetings Button*/
    //IssueList #58
    putValue( eSynchronizeDiagnose_01, 1 );
    putValue( eSMLS_01_CRC_ON, 1 );
    loadSettings( "RBS.ini" );

    start1();
    start1G();
    start2();
    start2G();

    //IssueList #200
    if( getValue( ON_OFF_BAP_LoadSave_INI ) == 0x00 )
    {
        EnableControl("Main", "EnvVar:eBAPLoadSettings",0);
        EnableControl("Main", "EnvVar:eBAPSaveSettings",0);
        EnableControl("Main", "EnvVar:eLoadAllSettings",0);
        EnableControl("Main", "EnvVar:eSaveAllSettings",0);
    }
}

void start1()
{
    putValue( eSaveSettings_To_ini, 1 ); /*Initialising the value for the Load seetings Button*/
    putValue( eLog_Kombi_Req_DataS, 4294967295 );  putValue( eLog_Kombi_Req_DataS, 0 );
    putValue( eLog_Datalogger_Req_DataKombi_MQ, 4294967295 );  putValue( eLog_Datalogger_Req_DataKombi_MQ, 0 );
    putValue( eAAG_Bremsl_durch_ECDS, 1 );  putValue( eAAG_Bremsl_durch_ECDS, 0 );
    putValue( eAAG_Anhaenger_abgestecktS, 1 );  putValue( eAAG_Anhaenger_abgestecktS, 0 );
    putValue( eAAG_NSL_aktivS, 1 );  putValue( eAAG_NSL_aktivS, 0 );
    putValue( eAAG_Anhaenger_erkanntS, 1 );  putValue( eAAG_Anhaenger_erkanntS, 0 );
    putValue( eAAG_Blinker_H_aktivS, 1 );  putValue( eAAG_Blinker_H_aktivS, 0 );
    putValue( eAAG_Blinker_HL_defS, 1 );  putValue( eAAG_Blinker_HL_defS, 0 );
    putValue( eAAG_Blinker_HR_defS, 1 );  putValue( eAAG_Blinker_HR_defS, 0 );
    putValue( eAAG_Bremslicht_H_defS, 1 );  putValue( eAAG_Bremslicht_H_defS, 0 );
    putValue( eAAG_Schlusslicht_HL_defS, 1 );  putValue( eAAG_Schlusslicht_HL_defS, 0 );
    putValue( eAAG_Schlusslicht_HR_defS, 1 );  putValue( eAAG_Schlusslicht_HR_defS, 0 );
    putValue( eAAG_AVS_Fehler_02S, 3 );  putValue( eAAG_AVS_Fehler_02S, 0 );
    putValue( eAAG_AVS_StatiS, 15 );  putValue( eAAG_AVS_StatiS, 0 );
    putValue( eBCM_Bremsbelag_SensorS, 1 );  putValue( eBCM_Bremsbelag_SensorS, 0 );
    putValue( eBCM_Bremsfluessigkeit_SensorS, 1 );  putValue( eBCM_Bremsfluessigkeit_SensorS, 0 );
    putValue( eBCM1_Licht_WarnS, 1 );  putValue( eBCM1_Licht_WarnS, 0 );
    putValue( eBCM_Waschwasser_SensorS, 1 );  putValue( eBCM_Waschwasser_SensorS, 0 );
    putValue( eBCM_Kuehlmittel_SensorS, 1 );  putValue( eBCM_Kuehlmittel_SensorS, 0 );
    putValue( eBCM1_Kl_15_HW_erkanntS, 1 );  putValue( eBCM1_Kl_15_HW_erkanntS, 0 );
    putValue( eZZH_Endlage_obenS, 1 );  putValue( eZZH_Endlage_obenS, 0 );
    putValue( eZZH_Endlage_untenS, 1 );  putValue( eZZH_Endlage_untenS, 0 );
    putValue( eZZH_Endlage_unplausibelS, 1 );  putValue( eZZH_Endlage_unplausibelS, 0 );
    putValue( eBCM2_EZS_gedruecktS, 1 );  putValue( eBCM2_EZS_gedruecktS, 0 );
    putValue( eBCM2_SST_gedruecktS, 1 );  putValue( eBCM2_SST_gedruecktS, 0 );
    putValue( eBCM1_Warnblink_TasterS, 1 );  putValue( eBCM1_Warnblink_TasterS, 0 );
    putValue( eBCM1_Valet_Parking_TasterS, 1 );  putValue( eBCM1_Valet_Parking_TasterS, 0 );
    putValue( eBCM1_HSK_TasterS, 1 );  putValue( eBCM1_HSK_TasterS, 0 );
    putValue( eBCM1_Heckrollo_TasterS, 1 );  putValue( eBCM1_Heckrollo_TasterS, 0 );
    putValue( eBCM1_Rueckfahrlicht_SchalterS, 1 );  putValue( eBCM1_Rueckfahrlicht_SchalterS, 0 );
    putValue( eBCM1_MH_SchalterS, 1 );  putValue( eBCM1_MH_SchalterS, 0 );
    putValue( eBCM1_MH_WIV_SchalterS, 1 );  putValue( eBCM1_MH_WIV_SchalterS, 0 );
    putValue( eBCM1_Lichtwarn_TexteS, 3 );  putValue( eBCM1_Lichtwarn_TexteS, 0 );
    putValue( eKY_IDGeber_1_StatusS, 7 );  putValue( eKY_IDGeber_1_StatusS, 0 );
    putValue( eKY_IDGeber_2_StatusS, 7 );  putValue( eKY_IDGeber_2_StatusS, 0 );
    putValue( eKY_SofttouchS, 1 );  putValue( eKY_SofttouchS, 0 );
    putValue( eKY_IDGeber_3_StatusS, 7 );  putValue( eKY_IDGeber_3_StatusS, 0 );
    putValue( eKY_IDGeber_4_StatusS, 7 );  putValue( eKY_IDGeber_4_StatusS, 0 );
    putValue( eKY_FFB_in_LF_ReichwS, 1 );  putValue( eKY_FFB_in_LF_ReichwS, 0 );
    putValue( eKY_IDGeber_1_BatS, 3 );  putValue( eKY_IDGeber_1_BatS, 0 );
    putValue( eKY_IDGeber_2_BatS, 3 );  putValue( eKY_IDGeber_2_BatS, 0 );
    putValue( eKY_IDGeber_3_BatS, 3 );  putValue( eKY_IDGeber_3_BatS, 0 );
    putValue( eKY_IDGeber_4_BatS, 3 );  putValue( eKY_IDGeber_4_BatS, 0 );
    putValue( eKY_RSSI_WertS, 65535 );  putValue( eKY_RSSI_WertS, 0 );
    putValue( eKY_Nr_IDGeber_AutofktS, 15 );  putValue( eKY_Nr_IDGeber_AutofktS, 0 );
    putValue( eKY_KessyEntryExit_AktS, 1 );  putValue( eKY_KessyEntryExit_AktS, 0 );
    putValue( eKY_Autofunktion_AktivS, 1 );  putValue( eKY_Autofunktion_AktivS, 0 );
    putValue( eKY_Anf_ReichwbegrS, 1 );  putValue( eKY_Anf_ReichwbegrS, 0 );
    putValue( eKY_Anf_Reichwbegr_GesamtS, 1 );  putValue( eKY_Anf_Reichwbegr_GesamtS, 0 );
    putValue( eKY_BedienstelleS, 63 );  putValue( eKY_BedienstelleS, 0 );
    putValue( eKY_VerriegelnS, 1 );  putValue( eKY_VerriegelnS, 0 );
    putValue( eKY_EntriegelnS, 1 );  putValue( eKY_EntriegelnS, 0 );
    putValue( eKY_ZV_CMDS, 15 );  putValue( eKY_ZV_CMDS, 0 );
    putValue( eKY_SchluesselnrS, 15 );  putValue( eKY_SchluesselnrS, 0 );
    putValue( eKY_WFS_KeyDataS, 4294967295 );  putValue( eKY_WFS_KeyDataS, 0 );
    putValue( eKY_ID_Geber_1S, 1 );  putValue( eKY_ID_Geber_1S, 0 );
    putValue( eKY_ID_Geber_2S, 1 );  putValue( eKY_ID_Geber_2S, 0 );
    putValue( eKY_ID_Geber_3S, 1 );  putValue( eKY_ID_Geber_3S, 0 );
    putValue( eKY_ID_Geber_4S, 1 );  putValue( eKY_ID_Geber_4S, 0 );
    putValue( eKY_GoTransponder_IDS, 1 );  putValue( eKY_GoTransponder_IDS, 0 );
    putValue( eKY_GoAuthent_RespS, 1 );  putValue( eKY_GoAuthent_RespS, 0 );
    putValue( eBM_ZV_aufS, 1 );  putValue( eBM_ZV_aufS, 0 );
    putValue( eBM_ZV_zuS, 1 );  putValue( eBM_ZV_zuS, 0 );
    putValue( eBM_DWA_einS, 1 );  putValue( eBM_DWA_einS, 0 );
    putValue( eBM_DWA_AlarmS, 1 );  putValue( eBM_DWA_AlarmS, 0 );
    putValue( eBM_CrashS, 1 );  putValue( eBM_CrashS, 0 );
    putValue( eBM_PanikS, 1 );  putValue( eBM_PanikS, 0 );
    putValue( eBM_Not_BremsungS, 1 );  putValue( eBM_Not_BremsungS, 0 );
    putValue( eBM_GDOS, 1 );  putValue( eBM_GDOS, 0 );
    putValue( eBM_WarnblinkenS, 1 );  putValue( eBM_WarnblinkenS, 0 );
    putValue( eBM_Taxi_NotalarmS, 1 );  putValue( eBM_Taxi_NotalarmS, 0 );
    putValue( eBM_TelematikS, 1 );  putValue( eBM_TelematikS, 0 );
    putValue( eBM_linksS, 1 );  putValue( eBM_linksS, 0 );
    putValue( eBM_rechtsS, 1 );  putValue( eBM_rechtsS, 0 );
    putValue( eBlinken_li_Fzg_TaktS, 1 );  putValue( eBlinken_li_Fzg_TaktS, 0 );
    putValue( eBlinken_re_Fzg_TaktS, 1 );  putValue( eBlinken_re_Fzg_TaktS, 0 );
    putValue( eBlinken_li_Kombi_TaktS, 1 );  putValue( eBlinken_li_Kombi_TaktS, 0 );
    putValue( eBlinken_re_Kombi_TaktS, 1 );  putValue( eBlinken_re_Kombi_TaktS, 0 );
    putValue( eBM_NBA_n_codiert_n_aktivS, 1 );  putValue( eBM_NBA_n_codiert_n_aktivS, 0 );
    putValue( eBM_NBA_StatusS, 3 );  putValue( eBM_NBA_StatusS, 0 );
    putValue( eDI_KL_58xd254, 1 );  putValue( eDI_KL_58xd254, 0 );
    putValue( eDI_KL_58xdS, 253 );  putValue( eDI_KL_58xdS, 0 );
    putValue( eDI_KL_58xsS, 100 );  putValue( eDI_KL_58xsS, 0 );
    putValue( eDI_Display_NachtdesignS, 1 );  putValue( eDI_Display_NachtdesignS, 0 );
    putValue( eDI_KL_58xtS, 100 );  putValue( eDI_KL_58xtS, 0 );
    putValue( eDI_FotosensorS, 65535 );  putValue( eDI_FotosensorS, 0 );
    putValue( eELV_Anf_Klemme_SS, 1 );  putValue( eELV_Anf_Klemme_SS, 0 );
    putValue( eELV_Anf_Klemme_15S, 1 );  putValue( eELV_Anf_Klemme_15S, 0 );
    putValue( eELV_Anf_Klemme_50S, 1 );  putValue( eELV_Anf_Klemme_50S, 0 );
    putValue( eELV_VerriegeltS, 1 );  putValue( eELV_VerriegeltS, 0 );
    putValue( eELV_EntriegeltS, 1 );  putValue( eELV_EntriegeltS, 0 );
    putValue( eELV_LebenszustandS, 1 );  putValue( eELV_LebenszustandS, 0 );
    putValue( eELV_AnlernmodusS, 1 );  putValue( eELV_AnlernmodusS, 0 );
    putValue( eELV_Akustik_1S, 1 );  putValue( eELV_Akustik_1S, 0 );
    putValue( eELV_Akustik_2S, 1 );  putValue( eELV_Akustik_2S, 0 );
    putValue( eELV_Blink_LEDS, 1 );  putValue( eELV_Blink_LEDS, 0 );
    putValue( eELV_LED_RotS, 1 );  putValue( eELV_LED_RotS, 0 );
    putValue( eELV_LED_BremseS, 1 );  putValue( eELV_LED_BremseS, 0 );
    putValue( eELV_Txt_Lkg_BewegenS, 1 );  putValue( eELV_Txt_Lkg_BewegenS, 0 );
    putValue( eELV_Txt_WerkstattS, 1 );  putValue( eELV_Txt_WerkstattS, 0 );
    putValue( eELV_Txt_DefektS, 1 );  putValue( eELV_Txt_DefektS, 0 );
    putValue( eELV_P_VerriegeltS, 1 );  putValue( eELV_P_VerriegeltS, 0 );
    putValue( eELV_WFS_RNDS, 4294967295 );  putValue( eELV_WFS_RNDS, 0 );
    putValue( eELV_WFS_CRCS, 4294967295 );  putValue( eELV_WFS_CRCS, 0 );
    putValue( eKY_ID_Geber1_im_FzgS, 1 );  putValue( eKY_ID_Geber1_im_FzgS, 0 );
    putValue( eKY_ID_Geber2_im_FzgS, 1 );  putValue( eKY_ID_Geber2_im_FzgS, 0 );
    putValue( eKY_ID_Geber3_im_FzgS, 1 );  putValue( eKY_ID_Geber3_im_FzgS, 0 );
    putValue( eKY_ID_Geber4_im_FzgS, 1 );  putValue( eKY_ID_Geber4_im_FzgS, 0 );
    putValue( eKY_Startknopf_BelS, 1 );  putValue( eKY_Startknopf_BelS, 0 );
    putValue( eKY_ID_Geber_SucheS, 1 );  putValue( eKY_ID_Geber_SucheS, 0 );
    putValue( eKY_MeldungenS, 15 );  putValue( eKY_MeldungenS, 0 );
    putValue( eKY_Gong_600S, 1 );  putValue( eKY_Gong_600S, 0 );
    putValue( eKY_Passiv_Autolock_MenueS, 1 );  putValue( eKY_Passiv_Autolock_MenueS, 0 );
    putValue( eKY_Passiv_Autolock_AktS, 1 );  putValue( eKY_Passiv_Autolock_AktS, 0 );
    putValue( eKY_Passiv_AutolockS, 1 );  putValue( eKY_Passiv_AutolockS, 0 );
    putValue( eKY_Passiv_AutounlockS, 1 );  putValue( eKY_Passiv_AutounlockS, 0 );
    putValue( eKY_Gestik_HDS, 1 );  putValue( eKY_Gestik_HDS, 0 );
    putValue( eKY_StartStopp_InfoS, 3 );  putValue( eKY_StartStopp_InfoS, 0 );
    putValue( eZAS_Kl_SS, 1 );  putValue( eZAS_Kl_SS, 0 );
    putValue( eZAS_Kl_15S, 1 );  putValue( eZAS_Kl_15S, 0 );
    putValue( eZAS_Kl_XS, 1 );  putValue( eZAS_Kl_XS, 0 );
    putValue( KCAN_ZAS_Kl_50_Startanforderung, 1 );  putValue( KCAN_ZAS_Kl_50_Startanforderung, 0 );
    putValue( eBCM1_Aussen_Temp_ungefS, 76 );  putValue( eBCM1_Aussen_Temp_ungefS, -50 );
    putValue( eBCM1_FStatus_Aussentemp_ungefS, 1 );  putValue( eBCM1_FStatus_Aussentemp_ungefS, 0 );
    putValue( eBCM1_OBD_FStatus_ATempS, 15 );  putValue( eBCM1_OBD_FStatus_ATempS, 0 );
    putValue( eBCM1_Kurvenlicht_links_AnfS, 1 );  putValue( eBCM1_Kurvenlicht_links_AnfS, 0 );
    putValue( eBCM1_Kurvenlicht_rechts_AnfS, 1 );  putValue( eBCM1_Kurvenlicht_rechts_AnfS, 0 );
    putValue( eBCM1_Standlicht_AnfS, 1 );  putValue( eBCM1_Standlicht_AnfS, 0 );
    putValue( eBCM1_Abblendlicht_AnfS, 1 );  putValue( eBCM1_Abblendlicht_AnfS, 0 );
    putValue( eBCM1_Fernlicht_AnfS, 1 );  putValue( eBCM1_Fernlicht_AnfS, 0 );
    putValue( eBCM1_Nebellicht_AnfS, 1 );  putValue( eBCM1_Nebellicht_AnfS, 0 );
    putValue( eBCM1_Parklicht_li_AnfS, 1 );  putValue( eBCM1_Parklicht_li_AnfS, 0 );
    putValue( eBCM1_Parklicht_re_AnfS, 1 );  putValue( eBCM1_Parklicht_re_AnfS, 0 );
    putValue( eBCM1_Nebelschluss_Ahg_AnfS, 1 );  putValue( eBCM1_Nebelschluss_Ahg_AnfS, 0 );
    putValue( eBCM1_Nebelschluss_Fzg_AnfS, 1 );  putValue( eBCM1_Nebelschluss_Fzg_AnfS, 0 );
    putValue( eBCM1_Schlusslicht_AnfS, 1 );  putValue( eBCM1_Schlusslicht_AnfS, 0 );
    putValue( eBCM1_RFahrlicht_Fzg_AnfS, 1 );  putValue( eBCM1_RFahrlicht_Fzg_AnfS, 0 );
    putValue( eBCM1_Umfeldleuchten_AnfS, 1 );  putValue( eBCM1_Umfeldleuchten_AnfS, 0 );
    putValue( eBCM1_Tagfahrlicht_AnfS, 1 );  putValue( eBCM1_Tagfahrlicht_AnfS, 0 );
    putValue( eBCM1_Regenlicht_AnfS, 1 );  putValue( eBCM1_Regenlicht_AnfS, 0 );
    putValue( eBCM1_Autobahnlicht_AnfS, 1 );  putValue( eBCM1_Autobahnlicht_AnfS, 0 );
    putValue( eBCM1_Touristen_Licht_AnfS, 1 );  putValue( eBCM1_Touristen_Licht_AnfS, 0 );
    putValue( eBCM1_Gleitende_Leuchtw_AnfS, 1 );  putValue( eBCM1_Gleitende_Leuchtw_AnfS, 0 );
    putValue( eBCM1_GLW_Fernlicht_AnfS, 1 );  putValue( eBCM1_GLW_Fernlicht_AnfS, 0 );
    putValue( eBCM1_Adaptive_Lichtvert_AnfS, 1 );  putValue( eBCM1_Adaptive_Lichtvert_AnfS, 0 );
    putValue( eLicht_hinten_01_BZS, 15 );  putValue( eLicht_hinten_01_BZS, 0 );
    putValue( eBCM2_Bremsl_durch_ECDS, 1 );  putValue( eBCM2_Bremsl_durch_ECDS, 0 );
    putValue( eLH_Aussenlicht_defS, 1 );  putValue( eLH_Aussenlicht_defS, 0 );
    putValue( eLH_Standlicht_H_aktivS, 1 );  putValue( eLH_Standlicht_H_aktivS, 0 );
    putValue( eLH_Parklicht_HL_aktivS, 1 );  putValue( eLH_Parklicht_HL_aktivS, 0 );
    putValue( eLH_Parklicht_HR_aktivS, 1 );  putValue( eLH_Parklicht_HR_aktivS, 0 );
    putValue( eLH_Bremslicht_H_aktivS, 1 );  putValue( eLH_Bremslicht_H_aktivS, 0 );
    putValue( eLH_Nebelschluss_aktivS, 1 );  putValue( eLH_Nebelschluss_aktivS, 0 );
    putValue( eLH_Rueckfahrlicht_aktivS, 1 );  putValue( eLH_Rueckfahrlicht_aktivS, 0 );
    putValue( eLH_Blinker_HL_aktS, 1 );  putValue( eLH_Blinker_HL_aktS, 0 );
    putValue( eLH_Blinker_HR_aktS, 1 );  putValue( eLH_Blinker_HR_aktS, 0 );
    putValue( eLH_Blinker_li_defS, 1 );  putValue( eLH_Blinker_li_defS, 0 );
    putValue( eLH_Bremsl_li_defS, 1 );  putValue( eLH_Bremsl_li_defS, 0 );
    putValue( eLH_Schlusslicht_li_defS, 1 );  putValue( eLH_Schlusslicht_li_defS, 0 );
    putValue( eLH_Rueckf_li_defS, 1 );  putValue( eLH_Rueckf_li_defS, 0 );
    putValue( eLH_Nebel_li_defS, 1 );  putValue( eLH_Nebel_li_defS, 0 );
    putValue( eLH_Schluss_Brems_Nebel_li_defS, 1 );  putValue( eLH_Schluss_Brems_Nebel_li_defS, 0 );
    putValue( eLH_Schluss_Brems_Nebel_re_defS, 1 );  putValue( eLH_Schluss_Brems_Nebel_re_defS, 0 );
    putValue( eLH_Schluss_Brems_li_defS, 1 );  putValue( eLH_Schluss_Brems_li_defS, 0 );
    putValue( eLH_Schluss_Nebel_li_defS, 1 );  putValue( eLH_Schluss_Nebel_li_defS, 0 );
    putValue( eLH_SL_BRL_BLK_li_defS, 1 );  putValue( eLH_SL_BRL_BLK_li_defS, 0 );
    putValue( eLH_Brems_Blk_li_defS, 1 );  putValue( eLH_Brems_Blk_li_defS, 0 );
    putValue( eLH_Blinker_re_defS, 1 );  putValue( eLH_Blinker_re_defS, 0 );
    putValue( eLH_Bremsl_re_defS, 1 );  putValue( eLH_Bremsl_re_defS, 0 );
    putValue( eLH_Schlusslicht_re_defS, 1 );  putValue( eLH_Schlusslicht_re_defS, 0 );
    putValue( eLH_Rueckf_re_defS, 1 );  putValue( eLH_Rueckf_re_defS, 0 );
    putValue( eLH_Nebel_re_defS, 1 );  putValue( eLH_Nebel_re_defS, 0 );
    putValue( eLH_Schluss_Brems_re_defS, 1 );  putValue( eLH_Schluss_Brems_re_defS, 0 );
    putValue( eLH_Schluss_Nebel_re_defS, 1 );  putValue( eLH_Schluss_Nebel_re_defS, 0 );
    putValue( eLH_SL_BRL_BLK_re_defS, 1 );  putValue( eLH_SL_BRL_BLK_re_defS, 0 );
    putValue( eLH_Brems_Blk_re_defS, 1 );  putValue( eLH_Brems_Blk_re_defS, 0 );
    putValue( eLH_Kennzl_defS, 1 );  putValue( eLH_Kennzl_defS, 0 );
    putValue( eLH_3_Bremsl_defS, 1 );  putValue( eLH_3_Bremsl_defS, 0 );
    putValue( eLH_Nebel_mi_defS, 1 );  putValue( eLH_Nebel_mi_defS, 0 );
    putValue( eLH_Rueckf_mi_defS, 1 );  putValue( eLH_Rueckf_mi_defS, 0 );
    putValue( eLH_Bremsl_li_ges_defS, 1 );  putValue( eLH_Bremsl_li_ges_defS, 0 );
    putValue( eLH_Bremsl_re_ges_defS, 1 );  putValue( eLH_Bremsl_re_ges_defS, 0 );
    putValue( eLV_Standlicht_AnzeigeS, 1 );  putValue( eLV_Standlicht_AnzeigeS, 0 );
    putValue( eLV_Abblendlicht_AnzeigeS, 1 );  putValue( eLV_Abblendlicht_AnzeigeS, 0 );
    putValue( eLV_Fernlicht_AnzeigeS, 1 );  putValue( eLV_Fernlicht_AnzeigeS, 0 );
    putValue( eLV_Nebellicht_AnzeigeS, 1 );  putValue( eLV_Nebellicht_AnzeigeS, 0 );
    putValue( eLV_Nebelschlusslicht_AnzeigeS, 1 );  putValue( eLV_Nebelschlusslicht_AnzeigeS, 0 );
    putValue( eLV_Tagfahrlicht_AnzeigeS, 1 );  putValue( eLV_Tagfahrlicht_AnzeigeS, 0 );
    putValue( eLV_AFL_aktiv_AnzeigeS, 1 );  putValue( eLV_AFL_aktiv_AnzeigeS, 0 );
    putValue( eLV_AFL_defektS, 1 );  putValue( eLV_AFL_defektS, 0 );
    putValue( eLV_Blinker_li_defS, 1 );  putValue( eLV_Blinker_li_defS, 0 );
    putValue( eLV_Standlicht_li_defS, 1 );  putValue( eLV_Standlicht_li_defS, 0 );
    putValue( eLV_Abblendlicht_li_defS, 1 );  putValue( eLV_Abblendlicht_li_defS, 0 );
    putValue( eLV_Fernlicht_li_defS, 1 );  putValue( eLV_Fernlicht_li_defS, 0 );
    putValue( eLV_Nebellicht_li_defS, 1 );  putValue( eLV_Nebellicht_li_defS, 0 );
    putValue( eLV_Blk_li_Seite_defS, 1 );  putValue( eLV_Blk_li_Seite_defS, 0 );
    putValue( eLV_Tagfahrlicht_li_defS, 1 );  putValue( eLV_Tagfahrlicht_li_defS, 0 );
    putValue( eLV_FLA_aktiv_AnzeigeS, 1 );  putValue( eLV_FLA_aktiv_AnzeigeS, 0 );
    putValue( eLV_FLA_defektS, 1 );  putValue( eLV_FLA_defektS, 0 );
    putValue( eLV_FLA_Sensor_blockiertS, 1 );  putValue( eLV_FLA_Sensor_blockiertS, 0 );
    putValue( eLV_Blinker_re_defS, 1 );  putValue( eLV_Blinker_re_defS, 0 );
    putValue( eLV_Standlicht_re_defS, 1 );  putValue( eLV_Standlicht_re_defS, 0 );
    putValue( eLV_Abblendlicht_re_defS, 1 );  putValue( eLV_Abblendlicht_re_defS, 0 );
    putValue( eLV_Fernlicht_re_defS, 1 );  putValue( eLV_Fernlicht_re_defS, 0 );
    putValue( eLV_Nebellicht_re_defS, 1 );  putValue( eLV_Nebellicht_re_defS, 0 );
    putValue( eLV_Blk_re_Seite_defS, 1 );  putValue( eLV_Blk_re_Seite_defS, 0 );
    putValue( eLV_Tagfahrlicht_re_defS, 1 );  putValue( eLV_Tagfahrlicht_re_defS, 0 );
    putValue( eLV_Aussenlicht_defS, 1 );  putValue( eLV_Aussenlicht_defS, 0 );
    putValue( eLV_Abblendlicht_TFL_li_defS, 1 );  putValue( eLV_Abblendlicht_TFL_li_defS, 0 );
    putValue( eLV_Nebellicht_TFL_li_defS, 1 );  putValue( eLV_Nebellicht_TFL_li_defS, 0 );
    putValue( eLV_Standlicht_TFL_li_defS, 1 );  putValue( eLV_Standlicht_TFL_li_defS, 0 );
    putValue( eLV_Abblend_Fernlicht_li_defS, 1 );  putValue( eLV_Abblend_Fernlicht_li_defS, 0 );
    putValue( eLV_Abblendlicht_TFL_re_defS, 1 );  putValue( eLV_Abblendlicht_TFL_re_defS, 0 );
    putValue( eLV_Nebellicht_TFL_re_defS, 1 );  putValue( eLV_Nebellicht_TFL_re_defS, 0 );
    putValue( eLV_Standlicht_TFL_re_defS, 1 );  putValue( eLV_Standlicht_TFL_re_defS, 0 );
    putValue( eLV_Abblend_Fernlicht_re_defS, 1 );  putValue( eLV_Abblend_Fernlicht_re_defS, 0 );
    putValue( eBFS_Fond_Bed_AckS, 1 );  putValue( eBFS_Fond_Bed_AckS, 0 );
    putValue( eBFS_Lehne_nicht_verriegeltS, 1 );  putValue( eBFS_Lehne_nicht_verriegeltS, 0 );
    putValue( eBFS_Klapptisch_offenS, 1 );  putValue( eBFS_Klapptisch_offenS, 0 );
    putValue( eBFS_KD_FehlerS, 1 );  putValue( eBFS_KD_FehlerS, 0 );
    putValue( eBFS_Sitzsym_Fahrt_aktivS, 1 );  putValue( eBFS_Sitzsym_Fahrt_aktivS, 0 );
    putValue( eBFS_Sitzfahrt_aktivS, 1 );  putValue( eBFS_Sitzfahrt_aktivS, 0 );
    putValue( eBFS_SLV_aktivS, 1 );  putValue( eBFS_SLV_aktivS, 0 );
    putValue( eBFS_SHV_aktivS, 1 );  putValue( eBFS_SHV_aktivS, 0 );
    putValue( eBFS_LNV_aktivS, 1 );  putValue( eBFS_LNV_aktivS, 0 );
    putValue( eBFS_SNV_aktivS, 1 );  putValue( eBFS_SNV_aktivS, 0 );
    putValue( eBFS_KSV_aktivS, 1 );  putValue( eBFS_KSV_aktivS, 0 );
    putValue( eBFS_LKV_aktivS, 1 );  putValue( eBFS_LKV_aktivS, 0 );
    putValue( eBFS_STV_aktivS, 1 );  putValue( eBFS_STV_aktivS, 0 );
    putValue( eBFS_LHV_aktivS, 1 );  putValue( eBFS_LHV_aktivS, 0 );
    putValue( eBFS_LWV_aktivS, 1 );  putValue( eBFS_LWV_aktivS, 0 );
    putValue( eBFS_GHV_aktivS, 1 );  putValue( eBFS_GHV_aktivS, 0 );
    putValue( eBFS_KSS_Fahrt_aktivS, 1 );  putValue( eBFS_KSS_Fahrt_aktivS, 0 );
    putValue( eBFS_MMB_lokal_StopS, 1 );  putValue( eBFS_MMB_lokal_StopS, 0 );
    putValue( eBFS_Ruhestellung_StatusS, 1 );  putValue( eBFS_Ruhestellung_StatusS, 0 );
    putValue( eBFS_MMB_storageS, 15 );  putValue( eBFS_MMB_storageS, 0 );
  //IssueList #58
    putValue(eSynchronizeDiagnose_01,1);
    putValue(eSMLS_01_CRC_ON,1);
}

void start1G()
{
    putValue( eMO_Kuehlerluefter_MUXS, 1 );  putValue( eMO_Kuehlerluefter_MUXS, 0 );
    putValue( eMO_HYB_Status_HV_LadungS, 7 );  putValue( eMO_HYB_Status_HV_LadungS, 0 );
    putValue( eWIV_Anzeige_aktivS, 1 );  putValue( eWIV_Anzeige_aktivS, 0 );
    putValue( eWIV_Oelmin_WarnS, 1 );  putValue( eWIV_Oelmin_WarnS, 0 );
    putValue( eWIV_SensorfehlerS, 1 );  putValue( eWIV_SensorfehlerS, 0 );
    putValue( eWIV_SchieflageS, 1 );  putValue( eWIV_SchieflageS, 0 );
    putValue( eWIV_OelstandS, 100 );  putValue( eWIV_OelstandS, 0 );
    putValue( eMO_Zustand_HWPS, 3 );  putValue( eMO_Zustand_HWPS, 0 );
    putValue( eWIV_Oelsystem_aktivS, 1 );  putValue( eWIV_Oelsystem_aktivS, 0 );
    putValue( eWIV_nicht_betriebswarmS, 1 );  putValue( eWIV_nicht_betriebswarmS, 0 );
    putValue( eWIV_Ueberfuell_WarnS, 1 );  putValue( eWIV_Ueberfuell_WarnS, 0 );
    putValue( eWIV_laufender_MotorS, 1 );  putValue( eWIV_laufender_MotorS, 0 );
    putValue( eMO_Text_MotorstartS, 15 );  putValue( eMO_Text_MotorstartS, 0 );
    putValue( eMO_Text_Partikelfil_RegS, 1 );  putValue( eMO_Text_Partikelfil_RegS, 0 );
    putValue( eWIV_OelmengeS, 3875 );  putValue( eWIV_OelmengeS, 0 );
    putValue( eMO_SystemlampeS, 1 );  putValue( eMO_SystemlampeS, 0 );
    putValue( eMO_OBD2_LampeS, 1 );  putValue( eMO_OBD2_LampeS, 0 );
    putValue( eMO_HeissleuchteS, 1 );  putValue( eMO_HeissleuchteS, 0 );
    putValue( eMO_Partikel_LampeS, 1 );  putValue( eMO_Partikel_LampeS, 0 );
    putValue( eMO_WinterfahrprogS, 1 );  putValue( eMO_WinterfahrprogS, 0 );
    putValue( eWIV_Oelstand_nicht_vorhandenS, 1 );  putValue( eWIV_Oelstand_nicht_vorhandenS, 0 );
    putValue( eWIV_nachfuellanzeige_einS, 1 );  putValue( eWIV_nachfuellanzeige_einS, 0 );
    putValue( eWIV_Ueberfuell_deaktivS, 1 );  putValue( eWIV_Ueberfuell_deaktivS, 0 );
    putValue( eWIV_Unterfuell_WarnS, 1 );  putValue( eWIV_Unterfuell_WarnS, 0 );
    putValue( eMO_Text_TankdeckelwarnS, 1 );  putValue( eMO_Text_TankdeckelwarnS, 0 );
    putValue( eWIV_Enable_Oeldr_MotorS, 1 );  putValue( eWIV_Enable_Oeldr_MotorS, 0 );
    putValue( eWIV_Oeldr_Warn_MotorS, 1 );  putValue( eWIV_Oeldr_Warn_MotorS, 0 );
    putValue( eMO_Kuehlerluefter_1S, 100 );  putValue( eMO_Kuehlerluefter_1S, 0 );
    putValue( eMO_Kuehlerluefter_2S, 100 );  putValue( eMO_Kuehlerluefter_2S, 0 );
    putValue( eACC_Wunschgeschw_02S, 327.04 );  putValue( eACC_Wunschgeschw_02S, 0 );
    putValue( eACC_Status_Prim_AnzS, 3 );  putValue( eACC_Status_Prim_AnzS, 0 );
    putValue( eACC_Abstandsindex_02S, 1021 );  putValue( eACC_Abstandsindex_02S, 1 );
    putValue( eACC_Akustik_02S, 3 );  putValue( eACC_Akustik_02S, 0 );
    putValue( eACC_Gesetzte_ZeitlueckeS, 7 );  putValue( eACC_Gesetzte_ZeitlueckeS, 0 );
    putValue( eACC_Optischer_FahrerhinweisS, 1 );  putValue( eACC_Optischer_FahrerhinweisS, 0 );
    putValue( eACC_Typ_TachokranzS, 1 );  putValue( eACC_Typ_TachokranzS, 0 );
    putValue( eACC_Anzeige_ZeitlueckeS, 1 );  putValue( eACC_Anzeige_ZeitlueckeS, 0 );
    putValue( eACC_TachokranzS, 1 );  putValue( eACC_TachokranzS, 0 );
    putValue( eACC_Display_PrioS, 3 );  putValue( eACC_Display_PrioS, 0 );
    putValue( eACC_Relevantes_ObjektS, 3 );  putValue( eACC_Relevantes_ObjektS, 0 );
    putValue( eACC_Texte_PrimaeranzS, 127 );  putValue( eACC_Texte_PrimaeranzS, 0 );
    putValue( eACC_Wunschgeschw_erreichtS, 1 );  putValue( eACC_Wunschgeschw_erreichtS, 0 );
    putValue( eACC_Status_AnzeigeS, 7 );  putValue( eACC_Status_AnzeigeS, 0 );
    putValue( eACC_Texte_ZusatzanzS, 63 );  putValue( eACC_Texte_ZusatzanzS, 0 );
    putValue( eACC_Status_ZusatzanzS, 31 );  putValue( eACC_Status_ZusatzanzS, 0 );
    putValue( eACC_TexteS, 31 );  putValue( eACC_TexteS, 0 );
    putValue( eACC_Texte_braking_guardS, 7 );  putValue( eACC_Texte_braking_guardS, 0 );
    putValue( eACC_WarnhinweisS, 1 );  putValue( eACC_WarnhinweisS, 0 );
    putValue( eACC_Geschw_ZielfahrzeugS, 326.72 );  putValue( eACC_Geschw_ZielfahrzeugS, 0 );
    putValue( eACC_Charisma_FahrPrS, 15 );  putValue( eACC_Charisma_FahrPrS, 0 );
    putValue( eACC_Charisma_StatusS, 3 );  putValue( eACC_Charisma_StatusS, 0 );
    putValue( eAB_RGS_AnstS, 15 );  putValue( eAB_RGS_AnstS, 0 );
    putValue( eAB_Front_CrashS, 1 );  putValue( eAB_Front_CrashS, 0 );
    putValue( eAB_Heck_CrashS, 1 );  putValue( eAB_Heck_CrashS, 0 );
    putValue( eAB_SF_CrashS, 1 );  putValue( eAB_SF_CrashS, 0 );
    putValue( eAB_SB_CrashS, 1 );  putValue( eAB_SB_CrashS, 0 );
    putValue( eAB_Rollover_CrashS, 1 );  putValue( eAB_Rollover_CrashS, 0 );
    putValue( eAB_Crash_IntS, 7 );  putValue( eAB_Crash_IntS, 0 );
    putValue( eAB_LampeS, 1 );  putValue( eAB_LampeS, 0 );
    putValue( eAB_DeaktiviertS, 1 );  putValue( eAB_DeaktiviertS, 0 );
    putValue( eAB_VB_deaktiviertS, 1 );  putValue( eAB_VB_deaktiviertS, 0 );
    putValue( eAB_SystemfehlerS, 1 );  putValue( eAB_SystemfehlerS, 0 );
    putValue( eAB_DiagnoseS, 1 );  putValue( eAB_DiagnoseS, 0 );
    putValue( eAB_StellgliedtestS, 1 );  putValue( eAB_StellgliedtestS, 0 );
    putValue( eAB_Erh_Auf_VBS, 3 );  putValue( eAB_Erh_Auf_VBS, 0 );
    putValue( eAB_Gurtwarn_VFS, 1 );  putValue( eAB_Gurtwarn_VFS, 0 );
    putValue( eAB_Gurtwarn_VBS, 1 );  putValue( eAB_Gurtwarn_VBS, 0 );
    putValue( eAB_Anzeige_FussgS, 3 );  putValue( eAB_Anzeige_FussgS, 0 );
    putValue( eAB_Texte_AKSS, 3 );  putValue( eAB_Texte_AKSS, 0 );
    putValue( eAB_PAO_Leuchte_AnfS, 1 );  putValue( eAB_PAO_Leuchte_AnfS, 0 );
    putValue( eAB_MKB_gueltigS, 1 );  putValue( eAB_MKB_gueltigS, 0 );
    putValue( eAB_MKB_AnforderungS, 1 );  putValue( eAB_MKB_AnforderungS, 0 );
    putValue( eAB_VersorgungsspannungS, 1 );  putValue( eAB_VersorgungsspannungS, 0 );
    putValue( eAB_Belegung_VBS, 3 );  putValue( eAB_Belegung_VBS, 0 );
    putValue( eAB_Gurtschloss_FAS, 3 );  putValue( eAB_Gurtschloss_FAS, 0 );
    putValue( eAB_Gurtschloss_BFS, 3 );  putValue( eAB_Gurtschloss_BFS, 0 );
    putValue( eAB_Gurtschloss_Reihe2_FAS, 3 );  putValue( eAB_Gurtschloss_Reihe2_FAS, 0 );
    putValue( eAB_Gurtschloss_Reihe2_MIS, 3 );  putValue( eAB_Gurtschloss_Reihe2_MIS, 0 );
    putValue( eAB_Gurtschloss_Reihe2_BFS, 3 );  putValue( eAB_Gurtschloss_Reihe2_BFS, 0 );
    putValue( eAB_Gurtschloss_Reihe3_FAS, 3 );  putValue( eAB_Gurtschloss_Reihe3_FAS, 0 );
    putValue( eAB_Gurtschloss_Reihe3_MIS, 3 );  putValue( eAB_Gurtschloss_Reihe3_MIS, 0 );
    putValue( eAB_Gurtschloss_Reihe3_BFS, 3 );  putValue( eAB_Gurtschloss_Reihe3_BFS, 0 );
    putValue( eAB_Sitzpos_Sens_FAS, 3 );  putValue( eAB_Sitzpos_Sens_FAS, 0 );
    putValue( eAB_Sitzpos_Sens_BFS, 3 );  putValue( eAB_Sitzpos_Sens_BFS, 0 );
    putValue( eBEM_02_AbschaltstufenS, 7 );  putValue( eBEM_02_AbschaltstufenS, 0 );
    putValue( eBEM_STH_ZielzeitS, 60 );  putValue( eBEM_STH_ZielzeitS, 0 );
    putValue( eBEM_MMI_VorwarnungS, 1 );  putValue( eBEM_MMI_VorwarnungS, 0 );
    putValue( eBEM_HL_KontingentierungS, 1000 );  putValue( eBEM_HL_KontingentierungS, -1000 );
    putValue( eBEM_GeneratordiagnoseS, 3 );  putValue( eBEM_GeneratordiagnoseS, 0 );
    putValue( eBEM_Red_InnengeblaeseS, 3 );  putValue( eBEM_Red_InnengeblaeseS, 0 );
    putValue( eBEM_STH_EinschaltverbotS, 1 );  putValue( eBEM_STH_EinschaltverbotS, 0 );
    putValue( eBEM_HL_Regelung_StatusS, 7 );  putValue( eBEM_HL_Regelung_StatusS, 0 );
    putValue( eBEM_LadezustandS, 100 );  putValue( eBEM_LadezustandS, 0 );
    putValue( eBEM_BatteriediagnoseS, 7 );  putValue( eBEM_BatteriediagnoseS, 0 );
    putValue( eBEM_DFMS, 100 );  putValue( eBEM_DFMS, 0.025 );
    putValue( eBEM_REK_aktivS, 1 );  putValue( eBEM_REK_aktivS, 0 );
    putValue( eBEM_EMLIN_ungueltigS, 1 );  putValue( eBEM_EMLIN_ungueltigS, 0 );
    putValue( eBEM_Batt_AbS, 1 );  putValue( eBEM_Batt_AbS, 0 );
    putValue( eBEM_UBDMS, 17.7 );  putValue( eBEM_UBDMS, 5.05 );
    putValue( eBEM_UGenSollS, 16 );  putValue( eBEM_UGenSollS, 10.6 );
    putValue( eCHA_Eco_Charisma_LEDS, 3 );  putValue( eCHA_Eco_Charisma_LEDS, 0 );
    putValue( eCHA_Ziel_FahrPr_AMBS, 15 );  putValue( eCHA_Ziel_FahrPr_AMBS, 0 );
    putValue( eCHA_Ziel_FahrPr_IVBS, 15 );  putValue( eCHA_Ziel_FahrPr_IVBS, 0 );
    putValue( eCHA_Kombi_TexteS, 15 );  putValue( eCHA_Kombi_TexteS, 0 );
    putValue( eCHA_Ziel_FahrPr_KLS, 15 );  putValue( eCHA_Ziel_FahrPr_KLS, 0 );
    putValue( eCHA_Ziel_FahrPr_NAV_RouteS, 15 );  putValue( eCHA_Ziel_FahrPr_NAV_RouteS, 0 );
    putValue( eCHA_Ziel_FahrPr_NAV_SegelS, 15 );  putValue( eCHA_Ziel_FahrPr_NAV_SegelS, 0 );
    putValue( eCHA_Ziel_FahrPr_03_01S, 15 );  putValue( eCHA_Ziel_FahrPr_03_01S, 0 );
    putValue( eCHA_Ziel_FahrPr_03_02S, 15 );  putValue( eCHA_Ziel_FahrPr_03_02S, 0 );
    putValue( eDR_SystemstatusS, 7 );  putValue( eDR_SystemstatusS, 0 );
    putValue( eLF_TexteS, 3 );  putValue( eLF_TexteS, 0 );
    putValue( eDR_TasterS, 1 );  putValue( eDR_TasterS, 0 );
    putValue( eDR_Gelbe_WarnlampeS, 3 );  putValue( eDR_Gelbe_WarnlampeS, 0 );
    putValue( eDR_Daempferreg_TexteS, 15 );  putValue( eDR_Daempferreg_TexteS, 0 );
    putValue( eDGN_VerlernzaehlerS, 254 );  putValue( eDGN_VerlernzaehlerS, 0 );
    putValue( eKBI_Kilometerstand_1S, 1048573 );  putValue( eKBI_Kilometerstand_1S, 0 );
    putValue( eUH_Jahr_1S, 2127 );  putValue( eUH_Jahr_1S, 2000 );
    putValue( eUH_Monat_1S, 12 );  putValue( eUH_Monat_1S, 1 );
    putValue( eUH_Tag_1S, 31 );  putValue( eUH_Tag_1S, 1 );
    putValue( eUH_Stunde_1S, 23 );  putValue( eUH_Stunde_1S, 0 );
    putValue( eUH_Minute_1S, 59 );  putValue( eUH_Minute_1S, 0 );
    putValue( eUH_Sekunde_1S, 59 );  putValue( eUH_Sekunde_1S, 0 );
    putValue( eKombi_02_altS, 1 );  putValue( eKombi_02_altS, 0 );
    putValue( eUhrzeit_01_altS, 1 );  putValue( eUhrzeit_01_altS, 0 );
    putValue( eEPB_Fehlerlampe_GelbS, 1 );  putValue( eEPB_Fehlerlampe_GelbS, 0 );
    putValue( eEPB_Fehlerlampe_BKLS, 1 );  putValue( eEPB_Fehlerlampe_BKLS, 0 );
    putValue( eEPB_FunktionslampeS, 1 );  putValue( eEPB_FunktionslampeS, 0 );
    putValue( eEPB_TexteS, 15 );  putValue( eEPB_TexteS, 0 );
    putValue( eEPB_AkustikS, 1 );  putValue( eEPB_AkustikS, 0 );
    putValue( eEPB_AutoholdlampeS, 1 );  putValue( eEPB_AutoholdlampeS, 0 );
    putValue( eEPB_Bremsbelag_WarnS, 1 );  putValue( eEPB_Bremsbelag_WarnS, 0 );
    putValue( eESP_02_BZS, 15 );  putValue( eESP_02_BZS, 0 );
    putValue( eESP_QBit_GierrateS, 1 );  putValue( eESP_QBit_GierrateS, 0 );
    putValue( eESP_QBit_LaengsbeschlS, 1 );  putValue( eESP_QBit_LaengsbeschlS, 0 );
    putValue( eESP_QBit_QuerbS, 1 );  putValue( eESP_QBit_QuerbS, 0 );
    putValue( eESP_QuerbeschleunigungS, 1.27 );  putValue( eESP_QuerbeschleunigungS, -1.27 );
    putValue( eESP_LaengsbeschlS, 15.90625 );  putValue( eESP_LaengsbeschlS, -16 );
    putValue( eESP_GierrateS, 163.82 );  putValue( eESP_GierrateS, 0 );
    putValue( eESP_VZ_GierrateS, 1 );  putValue( eESP_VZ_GierrateS, 0 );
    putValue( eESP_NotbremsanzeigeS, 1 );  putValue( eESP_NotbremsanzeigeS, 0 );
    putValue( eESP_SpannungsAnfS, 1 );  putValue( eESP_SpannungsAnfS, 0 );
    putValue( eESP_PLA_AbbruchS, 7 );  putValue( eESP_PLA_AbbruchS, 0 );
    putValue( eESP_Status_ESP_PLAS, 15 );  putValue( eESP_Status_ESP_PLAS, 0 );
    putValue( eBR_SystemartS, 3 );  putValue( eBR_SystemartS, 0 );
    putValue( eESP_ZaehnezahlS, 255 );  putValue( eESP_ZaehnezahlS, 0 );
    putValue( eESP_24_BZS, 15 );  putValue( eESP_24_BZS, 0 );
    putValue( eESP_LampeS, 1 );  putValue( eESP_LampeS, 0 );
    putValue( eABS_LampeS, 1 );  putValue( eABS_LampeS, 0 );
    putValue( eBK_Lampe_02S, 3 );  putValue( eBK_Lampe_02S, 0 );
    putValue( eESP_m_RaddrehzS, 65.278 );  putValue( eESP_m_RaddrehzS, 0 );
    putValue( eESP_Textanzeigen_03S, 31 );  putValue( eESP_Textanzeigen_03S, 0 );
    putValue( eESP_MeldungenS, 7 );  putValue( eESP_MeldungenS, 0 );
    putValue( eESP_Wegimp_VAS, 2047 );  putValue( eESP_Wegimp_VAS, 0 );
    putValue( eESP_Fehlerstatus_WegimpS, 1 );  putValue( eESP_Fehlerstatus_WegimpS, 0 );
    putValue( eESP_Wegimp_UeberlaufS, 1 );  putValue( eESP_Wegimp_UeberlaufS, 0 );
    putValue( eESP_QBit_Wegimp_VAS, 1 );  putValue( eESP_QBit_Wegimp_VAS, 0 );
    putValue( eESP_HDC_FktLampeS, 1 );  putValue( eESP_HDC_FktLampeS, 0 );
    putValue( eESP_Off_LampeS, 1 );  putValue( eESP_Off_LampeS, 0 );
    putValue( eESP_HDC_RegelgeschwS, 39.68 );  putValue( eESP_HDC_RegelgeschwS, 0.32 );
    putValue( eESP_BKV_WarnungS, 1 );  putValue( eESP_BKV_WarnungS, 0 );
    putValue( eMotor_12_altS, 1 );  putValue( eMotor_12_altS, 0 );
    putValue( eGW_73_va_11S, 1 );  putValue( eGW_73_va_11S, 0 );
    putValue( eGetriebe_11_altS, 1 );  putValue( eGetriebe_11_altS, 0 );
    putValue( eGetriebe_13_altS, 1 );  putValue( eGetriebe_13_altS, 0 );
    putValue( eGW_73_va_14S, 1 );  putValue( eGW_73_va_14S, 0 );
    putValue( eGW_73_va_16S, 1 );  putValue( eGW_73_va_16S, 0 );
    putValue( eGW_73_va_17S, 1 );  putValue( eGW_73_va_17S, 0 );
    putValue( eMO_QBit_Drehzahl_01S, 1 );  putValue( eMO_QBit_Drehzahl_01S, 0 );
    putValue( eMKE_TexteS, 3 );  putValue( eMKE_TexteS, 0 );
    putValue( eMO_Drehzahl_01S, 16383 );  putValue( eMO_Drehzahl_01S, 0 );
    putValue( eGE_FahrstufeS, 31 );  putValue( eGE_FahrstufeS, 0 );
    putValue( eGE_NotlaufS, 1 );  putValue( eGE_NotlaufS, 0 );
    putValue( eGE_ZielgangS, 15 );  putValue( eGE_ZielgangS, 0 );
    putValue( eWFS_GSG_RNDS, 4294967295 );  putValue( eWFS_GSG_RNDS, 0 );
    putValue( eWFS_GSG_CRCS, 4294967295 );  putValue( eWFS_GSG_CRCS, 0 );
    putValue( eISO_ALL_01_Req_DataS, 4294967295 );  putValue( eISO_ALL_01_Req_DataS, 0 );
    putValue( eISO_ALL_01_Req_Data_2S, 4294967295 );  putValue( eISO_ALL_01_Req_Data_2S, 0 );
    putValue( eISO_Kombi_Req_DataS, 4294967295 );  putValue( eISO_Kombi_Req_DataS, 0 );
    putValue( eKS_Kombi_Req_DataS, 4294967295 );  putValue( eKS_Kombi_Req_DataS, 0 );
    putValue( eLDW_GongS, 3 );  putValue( eLDW_GongS, 0 );
    putValue( eLDW_TexteS, 15 );  putValue( eLDW_TexteS, 0 );
    putValue( eLDW_Seite_DLCTLCS, 1 );  putValue( eLDW_Seite_DLCTLCS, 0 );
    putValue( eLDW_Lernmodus_seitenabhaengigS, 15 );  putValue( eLDW_Lernmodus_seitenabhaengigS, 0 );
    putValue( eLDW_DLCS, 1.25 );  putValue( eLDW_DLCS, -1.25 );
    putValue( eLDW_TLCS, 3 );  putValue( eLDW_TLCS, 0 );
    putValue( eLDW_Status_LED_gelbS, 1 );  putValue( eLDW_Status_LED_gelbS, 0 );
    putValue( eLDW_Status_LED_gruenS, 1 );  putValue( eLDW_Status_LED_gruenS, 0 );
    putValue( eEPS_01_BZS, 15 );  putValue( eEPS_01_BZS, 0 );
    putValue( eEPS_AkustiksignalS, 1 );  putValue( eEPS_AkustiksignalS, 0 );
    putValue( eEPS_FehlerlampeS, 1 );  putValue( eEPS_FehlerlampeS, 0 );
    putValue( eEPS_WarnungenS, 7 );  putValue( eEPS_WarnungenS, 0 );
    putValue( eEPS_PLA_AbbruchS, 15 );  putValue( eEPS_PLA_AbbruchS, 0 );
    putValue( eEPS_PLA_FehlerS, 15 );  putValue( eEPS_PLA_FehlerS, 0 );
    putValue( eEPS_PLA_StatusS, 15 );  putValue( eEPS_PLA_StatusS, 0 );
    putValue( eEPS_Charisma_FahrPrS, 7 );  putValue( eEPS_Charisma_FahrPrS, 0 );
    putValue( eEPS_Charisma_StatusS, 3 );  putValue( eEPS_Charisma_StatusS, 0 );
    putValue( eEPS_LenkerpositionS, 3 );  putValue( eEPS_LenkerpositionS, 0 );
    putValue( eEPS_Anf_KLS, 1 );  putValue( eEPS_Anf_KLS, 0 );
    putValue( eAFS_Abbiegelicht_li_AnfS, 1 );  putValue( eAFS_Abbiegelicht_li_AnfS, 0 );
    putValue( eAFS_Abbiegelicht_re_AnfS, 1 );  putValue( eAFS_Abbiegelicht_re_AnfS, 0 );
    putValue( eAFS_Abbiegelicht_Dimm_AnfS, 1 );  putValue( eAFS_Abbiegelicht_Dimm_AnfS, 0 );
    putValue( eAFS_Verfuegbarkeit_GLWS, 1 );  putValue( eAFS_Verfuegbarkeit_GLWS, 0 );
    putValue( eAFS_Status_adaptive_LVS, 1 );  putValue( eAFS_Status_adaptive_LVS, 0 );
    putValue( eAFS_Fernlicht_li_defektS, 1 );  putValue( eAFS_Fernlicht_li_defektS, 0 );
    putValue( eAFS_Fernlicht_re_defektS, 1 );  putValue( eAFS_Fernlicht_re_defektS, 0 );
    putValue( eAFS_Fernlicht_StatusS, 1 );  putValue( eAFS_Fernlicht_StatusS, 0 );
    putValue( eLWR_AFS_01_BZS, 15 );  putValue( eLWR_AFS_01_BZS, 0 );
    putValue( eAFS_LampeS, 1 );  putValue( eAFS_LampeS, 0 );
    putValue( eLWR_LampeS, 1 );  putValue( eLWR_LampeS, 0 );
    putValue( eAFS_FehlertextS, 1 );  putValue( eAFS_FehlertextS, 0 );
    putValue( eAFS_LED_BlinkmodeS, 1 );  putValue( eAFS_LED_BlinkmodeS, 0 );
    putValue( eLWR_Touristenmodus_aktivS, 1 );  putValue( eLWR_Touristenmodus_aktivS, 0 );
    putValue( eAFS_Charisma_FahrPrS, 7 );  putValue( eAFS_Charisma_FahrPrS, 0 );
    putValue( eAFS_Charisma_StatusS, 3 );  putValue( eAFS_Charisma_StatusS, 0 );
    putValue( eAFS_Charisma_UmschaltungS, 3 );  putValue( eAFS_Charisma_UmschaltungS, 0 );
    putValue( eAFS_AllwetterlichtS, 1 );  putValue( eAFS_AllwetterlichtS, 0 );
    putValue( eLWR_Touristenmodus_verbautS, 1 );  putValue( eLWR_Touristenmodus_verbautS, 0 );
    putValue( eAFS_adaptive_LV_verbautS, 1 );  putValue( eAFS_adaptive_LV_verbautS, 0 );
}

void start2()
{
    putValue( eBFS_MMB_tippS, 1 );  putValue( eBFS_MMB_tippS, 0 );
    putValue( eBFS_MMB_tastS, 1 );  putValue( eBFS_MMB_tastS, 0 );
    putValue( eBFS_MMB_store_LED_onS, 1 );  putValue( eBFS_MMB_store_LED_onS, 0 );
    putValue( eBFS_MMB_storage_beepS, 1 );  putValue( eBFS_MMB_storage_beepS, 0 );
    putValue( eBFS_MMB_storeS, 1 );  putValue( eBFS_MMB_storeS, 0 );
    putValue( eBFS_MMB_glob_stopS, 1 );  putValue( eBFS_MMB_glob_stopS, 0 );
    putValue( eBFS_SIH_StatusS, 3 );  putValue( eBFS_SIH_StatusS, 0 );
    putValue( eBFS_SLR_ReglerstatusS, 7 );  putValue( eBFS_SLR_ReglerstatusS, 0 );
    putValue( eFS_Fond_Bed_enableS, 1 );  putValue( eFS_Fond_Bed_enableS, 0 );
    putValue( eFS_Lehne_nicht_verriegeltS, 1 );  putValue( eFS_Lehne_nicht_verriegeltS, 0 );
    putValue( eFS_Spezialposition_anfahrenS, 1 );  putValue( eFS_Spezialposition_anfahrenS, 0 );
    putValue( eFS_BFS_Sitzsym_AnfahrtS, 1 );  putValue( eFS_BFS_Sitzsym_AnfahrtS, 0 );
    putValue( eFS_Sitzfahrt_aktivS, 1 );  putValue( eFS_Sitzfahrt_aktivS, 0 );
    putValue( eFS_SLV_aktivS, 1 );  putValue( eFS_SLV_aktivS, 0 );
    putValue( eFS_SHV_aktivS, 1 );  putValue( eFS_SHV_aktivS, 0 );
    putValue( eFS_LNV_aktivS, 1 );  putValue( eFS_LNV_aktivS, 0 );
    putValue( eFS_SNV_aktivS, 1 );  putValue( eFS_SNV_aktivS, 0 );
    putValue( eFS_KSV_aktivS, 1 );  putValue( eFS_KSV_aktivS, 0 );
    putValue( eFS_LKV_aktivS, 1 );  putValue( eFS_LKV_aktivS, 0 );
    putValue( eFS_STV_aktivS, 1 );  putValue( eFS_STV_aktivS, 0 );
    putValue( eFS_LHV_aktivS, 1 );  putValue( eFS_LHV_aktivS, 0 );
    putValue( eFS_LWV_aktivS, 1 );  putValue( eFS_LWV_aktivS, 0 );
    putValue( eFS_GHV_aktivS, 1 );  putValue( eFS_GHV_aktivS, 0 );
    putValue( eFS_BFS_KSS_AnfahrtS, 1 );  putValue( eFS_BFS_KSS_AnfahrtS, 0 );
    putValue( eFS_MMB_lokal_StopS, 1 );  putValue( eFS_MMB_lokal_StopS, 0 );
    putValue( eFS_MMB_storageS, 15 );  putValue( eFS_MMB_storageS, 0 );
    putValue( eFS_MMB_tippS, 1 );  putValue( eFS_MMB_tippS, 0 );
    putValue( eFS_MMB_tastS, 1 );  putValue( eFS_MMB_tastS, 0 );
    putValue( eFS_MMB_store_LED_onS, 1 );  putValue( eFS_MMB_store_LED_onS, 0 );
    putValue( eFS_MMB_storage_beepS, 1 );  putValue( eFS_MMB_storage_beepS, 0 );
    putValue( eFS_MMB_storeS, 1 );  putValue( eFS_MMB_storeS, 0 );
    putValue( eFS_MMB_glob_stopS, 1 );  putValue( eFS_MMB_glob_stopS, 0 );
    putValue( eFS_EE_Fond_FS_enableS, 1 );  putValue( eFS_EE_Fond_FS_enableS, 0 );
    putValue( eFS_EE_Fond_BFS_enableS, 1 );  putValue( eFS_EE_Fond_BFS_enableS, 0 );
    putValue( eFS_BFS_Fond_Verst_enableS, 1 );  putValue( eFS_BFS_Fond_Verst_enableS, 0 );
    putValue( eFS_EE_BFS_enableS, 1 );  putValue( eFS_EE_BFS_enableS, 0 );
    putValue( eFS_SIH_StatusS, 3 );  putValue( eFS_SIH_StatusS, 0 );
    putValue( eFS_SLR_ReglerstatusS, 7 );  putValue( eFS_SLR_ReglerstatusS, 0 );
    putValue( eMFG_01_BZS, 15 );  putValue( eMFG_01_BZS, 0 );
    putValue( eMF_MotorweiterlaufS, 1 );  putValue( eMF_MotorweiterlaufS, 0 );
    putValue( eMF_AbzugssperreS, 1 );  putValue( eMF_AbzugssperreS, 0 );
    putValue( eMF_AnlassersperreS, 1 );  putValue( eMF_AnlassersperreS, 0 );
    putValue( eMF_VarianteS, 7 );  putValue( eMF_VarianteS, 0 );
    putValue( eMF_Schluessel_scanS, 1 );  putValue( eMF_Schluessel_scanS, 0 );
    putValue( eMF_StartStopp_InfoS, 3 );  putValue( eMF_StartStopp_InfoS, 0 );
    putValue( eMF_Fernbed_einS, 1 );  putValue( eMF_Fernbed_einS, 0 );
    putValue( eMF_StandlichtS, 1 );  putValue( eMF_StandlichtS, 0 );
    putValue( eMF_FahrlichtS, 1 );  putValue( eMF_FahrlichtS, 0 );
    putValue( eMF_interm_FernlichtS, 1 );  putValue( eMF_interm_FernlichtS, 0 );
    putValue( eMF_WarnblinkerS, 1 );  putValue( eMF_WarnblinkerS, 0 );
    putValue( eMF_FussraumbelS, 1 );  putValue( eMF_FussraumbelS, 0 );
    putValue( eMF_InnenraumbelS, 1 );  putValue( eMF_InnenraumbelS, 0 );
    putValue( eMF_Innenraumbel_UnterdrueckS, 1 );  putValue( eMF_Innenraumbel_UnterdrueckS, 0 );
    putValue( eMF_Blk_liS, 1 );  putValue( eMF_Blk_liS, 0 );
    putValue( eMF_Blk_reS, 1 );  putValue( eMF_Blk_reS, 0 );
    putValue( eMF_LichthupeS, 1 );  putValue( eMF_LichthupeS, 0 );
    putValue( eMF_FernlichtS, 1 );  putValue( eMF_FernlichtS, 0 );
    putValue( eMF_TippwischenS, 1 );  putValue( eMF_TippwischenS, 0 );
    putValue( eMF_FrontintervallS, 1 );  putValue( eMF_FrontintervallS, 0 );
    putValue( eMF_Wischerstufe_1S, 1 );  putValue( eMF_Wischerstufe_1S, 0 );
    putValue( eMF_Wischerstufe_2S, 1 );  putValue( eMF_Wischerstufe_2S, 0 );
    putValue( eMF_FrontwaschenS, 1 );  putValue( eMF_FrontwaschenS, 0 );
    putValue( eMF_HeckintervallS, 1 );  putValue( eMF_HeckintervallS, 0 );
    putValue( eMF_HeckwaschenS, 1 );  putValue( eMF_HeckwaschenS, 0 );
    putValue( eMF_SummerS, 1 );  putValue( eMF_SummerS, 0 );
    putValue( eMF_Alarm_BlinkertaktS, 1 );  putValue( eMF_Alarm_BlinkertaktS, 0 );
    putValue( eMF_Alarm_BlinkerS, 1 );  putValue( eMF_Alarm_BlinkerS, 0 );
    putValue( eMF_TFL_AbschaltungS, 1 );  putValue( eMF_TFL_AbschaltungS, 0 );
    putValue( eMF_interm_TaktS, 1 );  putValue( eMF_interm_TaktS, 0 );
    putValue( eMF_Tuerentriegelung_hintenS, 1 );  putValue( eMF_Tuerentriegelung_hintenS, 0 );
    putValue( eMF_interm_FahrlichtS, 1 );  putValue( eMF_interm_FahrlichtS, 0 );
    putValue( eMF_SignalhornS, 1 );  putValue( eMF_SignalhornS, 0 );
    putValue( eMF_FH_FT_hochS, 1 );  putValue( eMF_FH_FT_hochS, 0 );
    putValue( eMF_FH_FT_tiefS, 1 );  putValue( eMF_FH_FT_tiefS, 0 );
    putValue( eMF_FH_BT_hochS, 1 );  putValue( eMF_FH_BT_hochS, 0 );
    putValue( eMF_FH_BT_tiefS, 1 );  putValue( eMF_FH_BT_tiefS, 0 );
    putValue( eLS_Helligkeit_IRS, 101200 );  putValue( eLS_Helligkeit_IRS, 0 );
    putValue( eLS_Helligkeit_FWS, 6126 );  putValue( eLS_Helligkeit_FWS, 0 );
    putValue( eLS_defektS, 1 );  putValue( eLS_defektS, 0 );
    putValue( eLS_VerbauS, 1 );  putValue( eLS_VerbauS, 0 );
    putValue( eRS_RegenmengeS, 100 );  putValue( eRS_RegenmengeS, 0 );
    putValue( eRS_VerbauS, 1 );  putValue( eRS_VerbauS, 0 );
    putValue( eRS_Verglasung_schliessenS, 1 );  putValue( eRS_Verglasung_schliessenS, 0 );
    putValue( eRS_defektS, 1 );  putValue( eRS_defektS, 0 );
    putValue( eRS_WischergeschwindigkeitS, 7 );  putValue( eRS_WischergeschwindigkeitS, 0 );
    putValue( eBH_Blinker_liS, 1 );  putValue( eBH_Blinker_liS, 0 );
    putValue( eBH_Blinker_reS, 1 );  putValue( eBH_Blinker_reS, 0 );
    putValue( eBH_LichthupeS, 1 );  putValue( eBH_LichthupeS, 0 );
    putValue( eBH_FernlichtS, 1 );  putValue( eBH_FernlichtS, 0 );
    putValue( eWH_TipwischenS, 1 );  putValue( eWH_TipwischenS, 0 );
    putValue( eWH_IntervallS, 1 );  putValue( eWH_IntervallS, 0 );
    putValue( eWH_WischerStufe1S, 1 );  putValue( eWH_WischerStufe1S, 0 );
    putValue( eWH_WischerStufe2S, 1 );  putValue( eWH_WischerStufe2S, 0 );
    putValue( eWH_FrontwaschenS, 1 );  putValue( eWH_FrontwaschenS, 0 );
    putValue( eWH_HeckwaschenS, 1 );  putValue( eWH_HeckwaschenS, 0 );
    putValue( eWH_IntervallstufenS, 15 );  putValue( eWH_IntervallstufenS, 0 );
    putValue( eFAS_TasterS, 1 );  putValue( eFAS_TasterS, 0 );
    putValue( eFAS_Taster_FehlerS, 1 );  putValue( eFAS_Taster_FehlerS, 0 );
    putValue( eSMLS_HupeS, 1 );  putValue( eSMLS_HupeS, 0 );
    putValue( eLRH_on_offS, 3 );  putValue( eLRH_on_offS, 0 );
    putValue( eLSS_TastencodeS, 255 );  putValue( eLSS_TastencodeS, 0 );
    putValue( eSTS_Car_not_under_theftS, 1 );  putValue( eSTS_Car_not_under_theftS, 0 );
    putValue( eSTS_Car_under_theftS, 1 );  putValue( eSTS_Car_under_theftS, 0 );
    putValue( eSTS_AnlassersperreS, 1 );  putValue( eSTS_AnlassersperreS, 0 );
    putValue( eSTS_TypencodierungS, 31 );  putValue( eSTS_TypencodierungS, 0 );
    putValue( eSTS_LIN_aktivS, 1 );  putValue( eSTS_LIN_aktivS, 0 );
    putValue( eSTS_StandlichtS, 1 );  putValue( eSTS_StandlichtS, 0 );
    putValue( eSTS_FahrlichtS, 1 );  putValue( eSTS_FahrlichtS, 0 );
    putValue( eSTS_Alarm_stillS, 1 );  putValue( eSTS_Alarm_stillS, 0 );
    putValue( eSTS_TexteS, 15 );  putValue( eSTS_TexteS, 0 );
    putValue( eSTS_LaderelaisS, 1 );  putValue( eSTS_LaderelaisS, 0 );
    putValue( eSTS_SummerS, 1 );  putValue( eSTS_SummerS, 0 );
    putValue( eSTS_Alarm_BlinkerS, 1 );  putValue( eSTS_Alarm_BlinkerS, 0 );
    putValue( eSTS_NotstartS, 1 );  putValue( eSTS_NotstartS, 0 );
    putValue( eSTS_SignalhornS, 1 );  putValue( eSTS_SignalhornS, 0 );
    putValue( eSTS_LeerlaufschaltungS, 1 );  putValue( eSTS_LeerlaufschaltungS, 0 );
    putValue( eTCO_Driver1_DSS, 7 );  putValue( eTCO_Driver1_DSS, 0 );
    putValue( eTCO_Driver2_DSS, 7 );  putValue( eTCO_Driver2_DSS, 0 );
    putValue( eTCO_FahrerkennS, 3 );  putValue( eTCO_FahrerkennS, 0 );
    putValue( eTCO_Driver1_StS, 255 );  putValue( eTCO_Driver1_StS, 0 );
    putValue( eTCO_Driver2_StS, 255 );  putValue( eTCO_Driver2_StS, 0 );
    putValue( eTCO_System_EvS, 3 );  putValue( eTCO_System_EvS, 0 );
    putValue( eTCO_Handle_InfS, 3 );  putValue( eTCO_Handle_InfS, 0 );
    putValue( eTCO_Sys_PerfS, 3 );  putValue( eTCO_Sys_PerfS, 0 );
    putValue( eTCO_Dir_IndS, 3 );  putValue( eTCO_Dir_IndS, 0 );
    putValue( eTCO_Outp_SpeedS, 8031.875 );  putValue( eTCO_Outp_SpeedS, 0 );
    putValue( eTCO_Vehicle_SpeedS, 250.9961 );  putValue( eTCO_Vehicle_SpeedS, 0 );
    putValue( eTD_SekundenS, 59.75 );  putValue( eTD_SekundenS, 0 );
    putValue( eTD_MinutenS, 59 );  putValue( eTD_MinutenS, 0 );
    putValue( eTD_StundenS, 23 );  putValue( eTD_StundenS, 0 );
    putValue( eTD_MonatS, 12 );  putValue( eTD_MonatS, 0 );
    putValue( eTD_TagS, 31.75 );  putValue( eTD_TagS, 0 );
    putValue( eTD_JahrS, 2235 );  putValue( eTD_JahrS, 1985 );
    putValue( eTD_Lok_Minute_offsS, 59 );  putValue( eTD_Lok_Minute_offsS, -59 );
    putValue( eTD_Lok_Hour_offsS, 23 );  putValue( eTD_Lok_Hour_offsS, -23 );
    putValue( eVDI_V_distS, 1.073742E+07 );  putValue( eVDI_V_distS, 0 );
    putValue( eVDI_T_distS, 1E+07 );  putValue( eVDI_T_distS, 0 );
    putValue( eWischer_vorne_aktivS, 1 );  putValue( eWischer_vorne_aktivS, 0 );
    putValue( eWaschen_vorne_aktivS, 1 );  putValue( eWaschen_vorne_aktivS, 0 );
    putValue( eWischer_vorne_NormalS, 1 );  putValue( eWischer_vorne_NormalS, 0 );
    putValue( eWischer_vorne_SchnellS, 1 );  putValue( eWischer_vorne_SchnellS, 0 );
    putValue( eWischer_vorne_ParklageS, 1 );  putValue( eWischer_vorne_ParklageS, 0 );
    putValue( eWischer_vorne_defektS, 1 );  putValue( eWischer_vorne_defektS, 0 );
    putValue( eWischer_vorne_blockiertS, 1 );  putValue( eWischer_vorne_blockiertS, 0 );
    putValue( eBCM_FH_FreigabeS, 1 );  putValue( eBCM_FH_FreigabeS, 0 );
    putValue( eBCM_Komfortfkt_FreigabeS, 1 );  putValue( eBCM_Komfortfkt_FreigabeS, 0 );
    putValue( eBCM_HSK_FreigabeS, 1 );  putValue( eBCM_HSK_FreigabeS, 0 );
    putValue( eBCM_Verdeck_FreigabeS, 1 );  putValue( eBCM_Verdeck_FreigabeS, 0 );
    putValue( eZV_verriegelt_intern_istS, 1 );  putValue( eZV_verriegelt_intern_istS, 0 );
    putValue( eZV_verriegelt_extern_istS, 1 );  putValue( eZV_verriegelt_extern_istS, 0 );
    putValue( eZV_verriegelt_intern_sollS, 1 );  putValue( eZV_verriegelt_intern_sollS, 0 );
    putValue( eZV_verriegelt_extern_sollS, 1 );  putValue( eZV_verriegelt_extern_sollS, 0 );
    putValue( eZV_gesafet_extern_istS, 1 );  putValue( eZV_gesafet_extern_istS, 0 );
    putValue( eZV_gesafet_extern_sollS, 1 );  putValue( eZV_gesafet_extern_sollS, 0 );
    putValue( eZV_EinzeltuerentriegelungS, 1 );  putValue( eZV_EinzeltuerentriegelungS, 0 );
    putValue( eZV_HeckeinzelentriegelungS, 1 );  putValue( eZV_HeckeinzelentriegelungS, 0 );
    putValue( eZV_FT_offenS, 1 );  putValue( eZV_FT_offenS, 0 );
    putValue( eZV_BT_offenS, 1 );  putValue( eZV_BT_offenS, 0 );
    putValue( eZV_HFS_offenS, 1 );  putValue( eZV_HFS_offenS, 0 );
    putValue( eZV_HBFS_offenS, 1 );  putValue( eZV_HBFS_offenS, 0 );
    putValue( eZV_HD_offenS, 1 );  putValue( eZV_HD_offenS, 0 );
    putValue( eZV_HS_offenS, 1 );  putValue( eZV_HS_offenS, 0 );
    putValue( eIRUE_aktivS, 1 );  putValue( eIRUE_aktivS, 0 );
    putValue( eDWA_aktivS, 1 );  putValue( eDWA_aktivS, 0 );
    putValue( eHD_HauptrasteS, 1 );  putValue( eHD_HauptrasteS, 0 );
    putValue( eHD_VorrasteS, 1 );  putValue( eHD_VorrasteS, 0 );
    putValue( eFFB_HDF_TasteS, 1 );  putValue( eFFB_HDF_TasteS, 0 );
    putValue( eFFB_Panik_TasteS, 1 );  putValue( eFFB_Panik_TasteS, 0 );
    putValue( eFFB_Auf_TasteS, 1 );  putValue( eFFB_Auf_TasteS, 0 );
    putValue( eFFB_Zu_TasteS, 1 );  putValue( eFFB_Zu_TasteS, 0 );
    putValue( eFFB_CarFinderS, 1 );  putValue( eFFB_CarFinderS, 0 );
    putValue( eFFB_KomfortoeffnenS, 1 );  putValue( eFFB_KomfortoeffnenS, 0 );
    putValue( eFFB_KomfortschliessenS, 1 );  putValue( eFFB_KomfortschliessenS, 0 );
    putValue( eFBS_IDG_in_ReichweiteS, 1 );  putValue( eFBS_IDG_in_ReichweiteS, 0 );
    putValue( eZV_SafeFunktion_aktivS, 1 );  putValue( eZV_SafeFunktion_aktivS, 0 );
    putValue( eFBS_Warn_Schluessel_BattS, 1 );  putValue( eFBS_Warn_Schluessel_BattS, 0 );
    putValue( eFT_Kisi_FehlerS, 1 );  putValue( eFT_Kisi_FehlerS, 0 );
    putValue( eSpeedRPMCorrelation, 1 );  putValue( eSpeedRPMCorrelation, 0 );
}

void start2G()
{
    putValue( eLWR_Reisemodus_TexteS, 3 );  putValue( eLWR_Reisemodus_TexteS, 0 );
    putValue( eLWR_Pos_SchrittmotorS, 100 );  putValue( eLWR_Pos_SchrittmotorS, 0 );
    putValue( eLWR_Hoehenwert_VLS, 126 );  putValue( eLWR_Hoehenwert_VLS, -127 );
    putValue( eLWR_Hoehenwert_HLS, 126 );  putValue( eLWR_Hoehenwert_HLS, -127 );
    putValue( eAFS_Ersatzlicht_LinksS, 1 );  putValue( eAFS_Ersatzlicht_LinksS, 0 );
    putValue( eAFS_Ersatzlicht_RechtsS, 1 );  putValue( eAFS_Ersatzlicht_RechtsS, 0 );
    putValue( eLWR_AFS_GrundeinstellungS, 1 );  putValue( eLWR_AFS_GrundeinstellungS, 0 );
    putValue( eLWR_AFS_ParametrisierungS, 1 );  putValue( eLWR_AFS_ParametrisierungS, 0 );
    putValue( eLWR_InitialisierungslaufS, 1 );  putValue( eLWR_InitialisierungslaufS, 0 );
    putValue( eLWR_SicherheitspositionS, 1 );  putValue( eLWR_SicherheitspositionS, 0 );
    putValue( eLWR_ModusS, 1 );  putValue( eLWR_ModusS, 0 );
    putValue( eLWR_KD_FehlerS, 1 );  putValue( eLWR_KD_FehlerS, 0 );
    putValue( eMFL_Tastencode_1S, 255 );  putValue( eMFL_Tastencode_1S, 0 );
    putValue( eMFL_Tastencode_2S, 255 );  putValue( eMFL_Tastencode_2S, 0 );
    putValue( eMFL_Eventcode_1S, 15 );  putValue( eMFL_Eventcode_1S, 0 );
    putValue( eMFL_Eventcode_2S, 15 );  putValue( eMFL_Eventcode_2S, 0 );
    putValue( eMFL_MarkeS, 15 );  putValue( eMFL_MarkeS, 0 );
    putValue( eMFL_VarianteS, 15 );  putValue( eMFL_VarianteS, 0 );
    putValue( eMO_IstgangS, 15 );  putValue( eMO_IstgangS, 0 );
    putValue( eMO_SollgangS, 15 );  putValue( eMO_SollgangS, 0 );
    putValue( eMO_OeldruckS, 10 );  putValue( eMO_OeldruckS, 0 );
    putValue( eMO_AnzeigedrehzS, 12282 );  putValue( eMO_AnzeigedrehzS, 0 );
    putValue( eMO_Schaltempf_verfbarS, 1 );  putValue( eMO_Schaltempf_verfbarS, 0 );
    putValue( eMO_LadedruckS, 5.1 );  putValue( eMO_LadedruckS, 0 );
    putValue( eMO_KVSS, 32767 );  putValue( eMO_KVSS, 0 );
    putValue( eMO_KVS_UeberlaufS, 1 );  putValue( eMO_KVS_UeberlaufS, 0 );
    putValue( eMO_QBit_Ansaugluft_TempS, 1 );  putValue( eMO_QBit_Ansaugluft_TempS, 0 );
    putValue( eMO_QBit_Oel_TempS, 1 );  putValue( eMO_QBit_Oel_TempS, 0 );
    putValue( eMO_QBit_Kuehlmittel_TempS, 1 );  putValue( eMO_QBit_Kuehlmittel_TempS, 0 );
    putValue( eMO_Stellgliedtest_Soundaktuator, 1 );  putValue( eMO_Stellgliedtest_Soundaktuator, 0 );
    putValue( eMO_HYB_Fehler_HV_NetzS, 1 );  putValue( eMO_HYB_Fehler_HV_NetzS, 0 );
    putValue( eMO_aktives_GetriebeheizenS, 1 );  putValue( eMO_aktives_GetriebeheizenS, 0 );
    putValue( eMO_Absperrventil_oeffnenS, 3 );  putValue( eMO_Absperrventil_oeffnenS, 0 );
    putValue( eMO_Ansaugluft_TempS, 141.75 );  putValue( eMO_Ansaugluft_TempS, -48 );
    putValue( eMO_Oel_TempS, 193 );  putValue( eMO_Oel_TempS, -60 );
    putValue( eMO_Kuehlmittel_TempS, 141.75 );  putValue( eMO_Kuehlmittel_TempS, -48 );
    putValue( eMO_HoeheninfoS, 1.98374 );  putValue( eMO_HoeheninfoS, 0 );
    putValue( eMO_KennfeldkS, 1 );  putValue( eMO_KennfeldkS, 0 );
    putValue( eMO_VersionsinfoS, 63 );  putValue( eMO_VersionsinfoS, 0 );
    putValue( eMO_Getriebe_kuehlenS, 1 );  putValue( eMO_Getriebe_kuehlenS, 0 );
    putValue( eMO_Mom_Traegheit_02S, 0.31 );  putValue( eMO_Mom_Traegheit_02S, 0 );
    putValue( eMO_HeizungspumpenansteuerungS, 100 );  putValue( eMO_HeizungspumpenansteuerungS, 0 );
    putValue( eMO_SpannungsAnfS, 1 );  putValue( eMO_SpannungsAnfS, 0 );
    putValue( eMO_Nachlaufzeit_HeizungspumpeS, 945 );  putValue( eMO_Nachlaufzeit_HeizungspumpeS, 0 );
    putValue( eMO_ITM_Kuehlmittel_TempS, 143.25 );  putValue( eMO_ITM_Kuehlmittel_TempS, -48 );
    putValue( eMO_E85_SensorS, 100 );  putValue( eMO_E85_SensorS, 0 );
    putValue( eSCR_Anz_MotorstartsS, 8 );  putValue( eSCR_Anz_MotorstartsS, 0 );
    putValue( eSCR_Warnstufe_1S, 1 );  putValue( eSCR_Warnstufe_1S, 0 );
    putValue( eSCR_Warnstufe_2S, 1 );  putValue( eSCR_Warnstufe_2S, 0 );
    putValue( eSCR_AkustikS, 3 );  putValue( eSCR_AkustikS, 0 );
    putValue( eMO_Kraftstofffilter_WasserS, 1 );  putValue( eMO_Kraftstofffilter_WasserS, 0 );
    putValue( eSCR_SystemfehlerS, 1 );  putValue( eSCR_SystemfehlerS, 0 );
    putValue( eSCR_Inducement_StrategieS, 3 );  putValue( eSCR_Inducement_StrategieS, 0 );
    putValue( eMO_CO2_FaktorS, 4094 );  putValue( eMO_CO2_FaktorS, 1 );
    putValue( eMO_MKB_MUXS, 3 );  putValue( eMO_MKB_MUXS, 0 );
    putValue( eMO_MKB_01S, 31 );  putValue( eMO_MKB_01S, 0 );
    putValue( eMO_MKB_02S, 31 );  putValue( eMO_MKB_02S, 0 );
    putValue( eMO_MKB_03S, 31 );  putValue( eMO_MKB_03S, 0 );
    putValue( eMO_MKB_04S, 31 );  putValue( eMO_MKB_04S, 0 );
    putValue( eMO_StartStopp_StatusS, 3 );  putValue( eMO_StartStopp_StatusS, 0 );
    putValue( eMO_Freig_RekuS, 3 );  putValue( eMO_Freig_RekuS, 0 );
    putValue( eMO_Kl_75S, 1 );  putValue( eMO_Kl_75S, 0 );
    putValue( eMO_Kl_50S, 1 );  putValue( eMO_Kl_50S, 0 );
    putValue( eMO_GangpositionS, 15 );  putValue( eMO_GangpositionS, 0 );
    putValue( eMO_StartStopp_FahrerwunschS, 3 );  putValue( eMO_StartStopp_FahrerwunschS, 0 );
    putValue( eMO_HYB_FahrbereitschaftS, 1 );  putValue( eMO_HYB_FahrbereitschaftS, 0 );
    putValue( eMO_Ext_E_Fahrt_aktivS, 1 );  putValue( eMO_Ext_E_Fahrt_aktivS, 0 );
    putValue( eMO_Fahrer_bremstS, 1 );  putValue( eMO_Fahrer_bremstS, 0 );
    putValue( eMO_QBit_Fahrer_bremstS, 1 );  putValue( eMO_QBit_Fahrer_bremstS, 0 );
    putValue( eMO_BLSS, 1 );  putValue( eMO_BLSS, 0 );
    putValue( eMO_Konsistenz_BremspedS, 1 );  putValue( eMO_Konsistenz_BremspedS, 0 );
    putValue( eMO_Timeout_ESPS, 1 );  putValue( eMO_Timeout_ESPS, 0 );
    putValue( eMO_Klima_EingrS, 3 );  putValue( eMO_Klima_EingrS, 0 );
    putValue( eMO_Aussp_AnlassS, 1 );  putValue( eMO_Aussp_AnlassS, 0 );
    putValue( eMO_Freig_AnlassS, 1 );  putValue( eMO_Freig_AnlassS, 0 );
    putValue( eMO_Kuppl_schalterS, 1 );  putValue( eMO_Kuppl_schalterS, 0 );
    putValue( eMO_InterlockS, 1 );  putValue( eMO_InterlockS, 0 );
    putValue( eMO_Motor_laeuftS, 1 );  putValue( eMO_Motor_laeuftS, 0 );
    putValue( eMO_KickdownS, 1 );  putValue( eMO_KickdownS, 0 );
    putValue( eMO_Status_Zylabschalt_01S, 1 );  putValue( eMO_Status_Zylabschalt_01S, 0 );
    putValue( eMO_EKlKomLeiRedS, 3 );  putValue( eMO_EKlKomLeiRedS, 0 );
    putValue( eMO_Handshake_STHS, 1 );  putValue( eMO_Handshake_STHS, 0 );
    putValue( eMO_BKV_UnterdruckwarnungS, 1 );  putValue( eMO_BKV_UnterdruckwarnungS, 0 );
    putValue( eMO_Freigabe_SegelnS, 1 );  putValue( eMO_Freigabe_SegelnS, 0 );
    putValue( eMO_Drehzahl_WarnungS, 1 );  putValue( eMO_Drehzahl_WarnungS, 0 );
    putValue( eMO_obere_DrehzahlgrenzeS, 12750 );  putValue( eMO_obere_DrehzahlgrenzeS, 50 );
    putValue( eMotor_Code_01_BZS, 15 );  putValue( eMotor_Code_01_BZS, 0 );
    putValue( eMO_Faktor_Momente_02S, 3 );  putValue( eMO_Faktor_Momente_02S, 0 );
    putValue( eMO_HybridfahrzeugS, 3 );  putValue( eMO_HybridfahrzeugS, 0 );
    putValue( eMO_CodeS, 255 );  putValue( eMO_CodeS, 0 );
    putValue( eMO_Getriebe_CodeS, 63 );  putValue( eMO_Getriebe_CodeS, 0 );
    putValue( eMO_StartStopp_CodiertS, 1 );  putValue( eMO_StartStopp_CodiertS, 0 );
    putValue( eMO_Anzahl_ZylS, 15 );  putValue( eMO_Anzahl_ZylS, 0 );
    putValue( eMO_KraftstoffartS, 15 );  putValue( eMO_KraftstoffartS, 0 );
    putValue( eMO_HubraumS, 12.7 );  putValue( eMO_HubraumS, 0 );
    putValue( eMO_AnsaugsystemS, 1 );  putValue( eMO_AnsaugsystemS, 0 );
    putValue( eMO_LeistungS, 511 );  putValue( eMO_LeistungS, 0 );
    putValue( eMO_Abgastyp_EOBDS, 1 );  putValue( eMO_Abgastyp_EOBDS, 0 );
    putValue( eMO_Abgastyp_OBDS, 1 );  putValue( eMO_Abgastyp_OBDS, 0 );
    putValue( eMO_DPF_verbautS, 1 );  putValue( eMO_DPF_verbautS, 0 );
    putValue( eTSK_CodierungS, 7 );  putValue( eTSK_CodierungS, 0 );
    putValue( eMO_EinspritzartS, 1 );  putValue( eMO_EinspritzartS, 0 );
    putValue( eWFS_MSG1_RNDS, 4294967295 );  putValue( eWFS_MSG1_RNDS, 0 );
    putValue( eWFS_MSG1_CRCS, 4294967295 );  putValue( eWFS_MSG1_CRCS, 0 );
    putValue( eWFS_MSG2_RNDS, 4294967295 );  putValue( eWFS_MSG2_RNDS, 0 );
    putValue( eWFS_MSG2_CRCS, 4294967295 );  putValue( eWFS_MSG2_CRCS, 0 );
    putValue( eWFS_MSG3_RNDS, 4294967295 );  putValue( eWFS_MSG3_RNDS, 0 );
    putValue( eWFS_MSG3_CRCS, 4294967295 );  putValue( eWFS_MSG3_CRCS, 0 );
    putValue( eWFS_MSG4_RNDS, 4294967295 );  putValue( eWFS_MSG4_RNDS, 0 );
    putValue( eWFS_MSG4_CRCS, 4294967295 );  putValue( eWFS_MSG4_CRCS, 0 );
    putValue( eNM_Gateway_SNIS, 255 );  putValue( eNM_Gateway_SNIS, 0 );
    putValue( eNM_Gateway_NM_StateS, 63 );  putValue( eNM_Gateway_NM_StateS, 0 );
    putValue( eNM_Gateway_Car_WakeupS, 1 );  putValue( eNM_Gateway_Car_WakeupS, 0 );
    putValue( eNM_Gateway_WakeupS, 255 );  putValue( eNM_Gateway_WakeupS, 0 );
    putValue( eNM_Gateway_NM_aktiv_KL15S, 1 );  putValue( eNM_Gateway_NM_aktiv_KL15S, 0 );
    putValue( eNM_Gateway_NM_aktiv_DiagnoseS, 1 );  putValue( eNM_Gateway_NM_aktiv_DiagnoseS, 0 );
    putValue( eNM_Gateway_NM_aktiv_TminS, 1 );  putValue( eNM_Gateway_NM_aktiv_TminS, 0 );
    putValue( eNM_Gateway_UDS_CCS, 1 );  putValue( eNM_Gateway_UDS_CCS, 0 );
    putValue( ePLS_Anf_AnzS, 1 );  putValue( ePLS_Anf_AnzS, 0 );
    putValue( ePLS_Kurze_LueckeS, 1 );  putValue( ePLS_Kurze_LueckeS, 0 );
    putValue( ePLS_Laengs_QuerlueckeS, 1 );  putValue( ePLS_Laengs_QuerlueckeS, 0 );
    putValue( ePLS_Anf_Anz_SchwellpfeilS, 1 );  putValue( ePLS_Anf_Anz_SchwellpfeilS, 0 );
    putValue( ePLS_Fahrtrichtg_MehrzgS, 1 );  putValue( ePLS_Fahrtrichtg_MehrzgS, 0 );
    putValue( ePLS_BremssymbolS, 1 );  putValue( ePLS_BremssymbolS, 0 );
    putValue( ePLS_PL_ExistS, 1 );  putValue( ePLS_PL_ExistS, 0 );
    putValue( ePLS_StandbyS, 1 );  putValue( ePLS_StandbyS, 0 );
    putValue( ePLS_Mehrzg_AktivS, 1 );  putValue( ePLS_Mehrzg_AktivS, 0 );
    putValue( ePLS_Pos_OKS, 1 );  putValue( ePLS_Pos_OKS, 0 );
    putValue( ePLS_PL_SeiteS, 1 );  putValue( ePLS_PL_SeiteS, 0 );
    putValue( ePLS_Lenk_Aktiv_HinweisS, 1 );  putValue( ePLS_Lenk_Aktiv_HinweisS, 0 );
    putValue( ePLS_TexteS, 127 );  putValue( ePLS_TexteS, 0 );
    putValue( ePLS_Schwellpfeil_relS, 15 );  putValue( ePLS_Schwellpfeil_relS, 0 );
    putValue( ePLS_Schwellpfeil_absS, 3 );  putValue( ePLS_Schwellpfeil_absS, 0 );
    putValue( ePLS_Ausparken_AktivS, 1 );  putValue( ePLS_Ausparken_AktivS, 0 );
    putValue( ePLS_BremsleuchteS, 1 );  putValue( ePLS_BremsleuchteS, 0 );
    putValue( eRDK_System_OffS, 1 );  putValue( eRDK_System_OffS, 0 );
    putValue( eRDK_Warnungen_02s, 15 );  putValue( eRDK_Warnungen_02s, 0 );
    putValue( eRDK_FMVSS138_LampeS, 1 );  putValue( eRDK_FMVSS138_LampeS, 0 );
    putValue( eRDK_Druckwarnung_RdWS, 1 );  putValue( eRDK_Druckwarnung_RdWS, 0 );
    putValue( eRDK_FMVSS138_MILS, 1 );  putValue( eRDK_FMVSS138_MILS, 0 );
    putValue( eRDK_LF_aktivS, 1 );  putValue( eRDK_LF_aktivS, 0 );
    putValue( eRDK_Diff_Druck_VLS, 6.3 );  putValue( eRDK_Diff_Druck_VLS, -6.3 );
    putValue( eRDK_KD_FehlerS, 1 );  putValue( eRDK_KD_FehlerS, 0 );
    putValue( eRDK_Diff_Druck_VRS, 6.3 );  putValue( eRDK_Diff_Druck_VRS, -6.3 );
    putValue( eRDK_Diff_Druck_HLS, 6.3 );  putValue( eRDK_Diff_Druck_HLS, -6.3 );
    putValue( eRDK_Diff_Druck_HRS, 6.3 );  putValue( eRDK_Diff_Druck_HRS, -6.3 );
    putValue( eRKA_WarnungenS, 15 );  putValue( eRKA_WarnungenS, 0 );
    putValue( eRKA_FMVSS138_LampeS, 1 );  putValue( eRKA_FMVSS138_LampeS, 0 );
    putValue( eRKA_Druckwarnung_RdWS, 1 );  putValue( eRKA_Druckwarnung_RdWS, 0 );
    putValue( eRKA_FMVSS138_MILS, 1 );  putValue( eRKA_FMVSS138_MILS, 0 );
    putValue( eRKA_Warnungen_02S, 31 );  putValue( eRKA_Warnungen_02S, 0 );
    putValue( eRKA_KD_FehlerS, 1 );  putValue( eRKA_KD_FehlerS, 0 );
    putValue( eSWA_Status_BZS, 15 );  putValue( eSWA_Status_BZS, 0 );
    putValue( eSWA_AnzeigenS, 15 );  putValue( eSWA_AnzeigenS, 0 );
    putValue( eSWA_Blindheit_erkanntS, 1 );  putValue( eSWA_Blindheit_erkanntS, 0 );
    putValue( eSWA_rel_NichtverfS, 1 );  putValue( eSWA_rel_NichtverfS, 0 );
    putValue( eSWA_rel_FehlerS, 1 );  putValue( eSWA_rel_FehlerS, 0 );
    putValue( eSWA_Sta_aktivS, 1 );  putValue( eSWA_Sta_aktivS, 0 );
    putValue( eSWA_Sta_passivS, 1 );  putValue( eSWA_Sta_passivS, 0 );
    putValue( eSWA_Standziele_liS, 1 );  putValue( eSWA_Standziele_liS, 0 );
    putValue( eSWA_Kolonne_liS, 1 );  putValue( eSWA_Kolonne_liS, 0 );
    putValue( eSWA_Infostufe_SWA_liS, 1 );  putValue( eSWA_Infostufe_SWA_liS, 0 );
    putValue( eSWA_Warnung_SWA_liS, 1 );  putValue( eSWA_Warnung_SWA_liS, 0 );
    putValue( eSWA_Kolonne_miS, 1 );  putValue( eSWA_Kolonne_miS, 0 );
    putValue( eSWA_Standziele_reS, 1 );  putValue( eSWA_Standziele_reS, 0 );
    putValue( eSWA_Kolonne_reS, 1 );  putValue( eSWA_Kolonne_reS, 0 );
    putValue( eSWA_Infostufe_SWA_reS, 1 );  putValue( eSWA_Infostufe_SWA_reS, 0 );
    putValue( eSWA_Warnung_SWA_reS, 1 );  putValue( eSWA_Warnung_SWA_reS, 0 );
    putValue( eSWA_GischtzaehlerS, 100 );  putValue( eSWA_GischtzaehlerS, 0 );
    putValue( eSI_Sammel_SG_FehlerS, 60 );  putValue( eSI_Sammel_SG_FehlerS, 0 );
    putValue( eSI_P_Mode_gueltigS, 3 );  putValue( eSI_P_Mode_gueltigS, 0 );
    putValue( eSI_QRS_ModeS, 1 );  putValue( eSI_QRS_ModeS, 0 );
    putValue( eSI_NWDFS, 1 );  putValue( eSI_NWDFS, 0 );
    putValue( eSI_NWDF_gueltigS, 1 );  putValue( eSI_NWDF_gueltigS, 0 );
    putValue( eGW_KD_FehlerS, 1 );  putValue( eGW_KD_FehlerS, 0 );
    putValue( eSI_CAB_01S, 1 );  putValue( eSI_CAB_01S, 0 );
    putValue( eSI_CAB_02S, 1 );  putValue( eSI_CAB_02S, 0 );
    putValue( eSI_CAB_03S, 1 );  putValue( eSI_CAB_03S, 0 );
    putValue( eSI_CAB_04S, 1 );  putValue( eSI_CAB_04S, 0 );
    putValue( eSI_CAB_05S, 1 );  putValue( eSI_CAB_05S, 0 );
    putValue( eSI_CAB_06S, 1 );  putValue( eSI_CAB_06S, 0 );
    putValue( eSI_CAB_07S, 1 );  putValue( eSI_CAB_07S, 0 );
    putValue( eSI_CAB_08S, 1 );  putValue( eSI_CAB_08S, 0 );
    putValue( eSI_CAB_09S, 1 );  putValue( eSI_CAB_09S, 0 );
    putValue( eSI_CAB_10S, 1 );  putValue( eSI_CAB_10S, 0 );
    putValue( eSI_CAB_11S, 1 );  putValue( eSI_CAB_11S, 0 );
    putValue( eSI_CAB_12S, 1 );  putValue( eSI_CAB_12S, 0 );
    putValue( eSI_CAB_13S, 1 );  putValue( eSI_CAB_13S, 0 );
    putValue( eSI_CAB_14S, 1 );  putValue( eSI_CAB_14S, 0 );
    putValue( eSI_BUS_01S, 1 );  putValue( eSI_BUS_01S, 0 );
    putValue( eSI_BUS_02S, 1 );  putValue( eSI_BUS_02S, 0 );
    putValue( eSI_BUS_03S, 1 );  putValue( eSI_BUS_03S, 0 );
    putValue( eSI_BUS_04S, 1 );  putValue( eSI_BUS_04S, 0 );
    putValue( eSI_BUS_05S, 1 );  putValue( eSI_BUS_05S, 0 );
    putValue( eSI_BUS_06S, 1 );  putValue( eSI_BUS_06S, 0 );
    putValue( eSI_BUS_07S, 1 );  putValue( eSI_BUS_07S, 0 );
    putValue( eSI_BUS_08S, 1 );  putValue( eSI_BUS_08S, 0 );
    putValue( eSI_BUS_09S, 1 );  putValue( eSI_BUS_09S, 0 );
    putValue( eSI_BUS_10S, 1 );  putValue( eSI_BUS_10S, 0 );
    putValue( eSI_BUS_11S, 1 );  putValue( eSI_BUS_11S, 0 );
    putValue( eSI_BUS_12S, 1 );  putValue( eSI_BUS_12S, 0 );
    putValue( eSI_BUS_13S, 1 );  putValue( eSI_BUS_13S, 0 );
    putValue( eSI_BUS_14S, 1 );  putValue( eSI_BUS_14S, 0 );
    putValue( eSI_BUS_15S, 1 );  putValue( eSI_BUS_15S, 0 );
    putValue( eTSK_WunschgeschwS, 326.72 );  putValue( eTSK_WunschgeschwS, 0 );
    putValue( eTSK_Texte_PrimaeranzS, 31 );  putValue( eTSK_Texte_PrimaeranzS, 0 );
    putValue( eTSK_Limiter_AnzeigeS, 1 );  putValue( eTSK_Limiter_AnzeigeS, 0 );
    putValue( eTSK_Status_AnzeigeS, 7 );  putValue( eTSK_Status_AnzeigeS, 0 );
    putValue( eWBA_Fahrstufe_02S, 15 );  putValue( eWBA_Fahrstufe_02S, 0 );
    putValue( eWBA_ZielFahrstufeS, 15 );  putValue( eWBA_ZielFahrstufeS, 0 );
    putValue( eWBA_GE_Warnung_02S, 15 );  putValue( eWBA_GE_Warnung_02S, 0 );
    putValue( eWBA_eing_Gang_02S, 15 );  putValue( eWBA_eing_Gang_02S, 0 );
    putValue( eWBA_GE_TexteS, 7 );  putValue( eWBA_GE_TexteS, 0 );
    putValue( eWBA_Segeln_aktivS, 1 );  putValue( eWBA_Segeln_aktivS, 0 );
    putValue( eWBA_SchaltschemaS, 31 );  putValue( eWBA_SchaltschemaS, 0 );
    putValue( eWIV_VerschleissindexS, 0.00131068 );  putValue( eWIV_VerschleissindexS, 0 );
    putValue( eWIV_RussindexS, 0.00131068 );  putValue( eWIV_RussindexS, 0 );
    putValue( eWIV_t_minS, 63 );  putValue( eWIV_t_minS, 0 );
    putValue( eWIV_t_maxS, 63 );  putValue( eWIV_t_maxS, 0 );
    putValue( eWIV_W_minS, 127000 );  putValue( eWIV_W_minS, 0 );
    putValue( eWIV_W_maxS, 127000 );  putValue( eWIV_W_maxS, 0 );
    putValue( eDEV_Kombi_SUP1_DummySigS, 255 );  putValue( eDEV_Kombi_SUP1_DummySigS, 0 );
    putValue( eDEV_Kombi_SUP2_DummySigS, 255 );  putValue( eDEV_Kombi_SUP2_DummySigS, 0 );
    putValue( eDEV_Kombi_SUP3_DummySigS, 255 );  putValue( eDEV_Kombi_SUP3_DummySigS, 0 );
    putValue( eDEV_Kombi_UD1_Byte1S, 255 );  putValue( eDEV_Kombi_UD1_Byte1S, 0 );
    putValue( eDEV_Kombi_UD1_Byte2S, 255 );  putValue( eDEV_Kombi_UD1_Byte2S, 0 );
    putValue( eDEV_Kombi_UD1_Byte3S, 255 );  putValue( eDEV_Kombi_UD1_Byte3S, 0 );
    putValue( eDEV_Kombi_UD1_Byte4S, 255 );  putValue( eDEV_Kombi_UD1_Byte4S, 0 );
    putValue( eDEV_Kombi_UD1_Byte5S, 255 );  putValue( eDEV_Kombi_UD1_Byte5S, 0 );
    putValue( eDEV_Kombi_UD1_Byte6S, 255 );  putValue( eDEV_Kombi_UD1_Byte6S, 0 );
    putValue( eDEV_Kombi_UD1_Byte7S, 255 );  putValue( eDEV_Kombi_UD1_Byte7S, 0 );
    putValue( eDEV_Kombi_UD1_Byte8S, 255 );  putValue( eDEV_Kombi_UD1_Byte8S, 0 );
    putValue( eDEV_Kombi_UD2_Byte1S, 255 );  putValue( eDEV_Kombi_UD2_Byte1S, 0 );
    putValue( eDEV_Kombi_UD2_Byte2S, 255 );  putValue( eDEV_Kombi_UD2_Byte2S, 0 );
    putValue( eDEV_Kombi_UD2_Byte3S, 255 );  putValue( eDEV_Kombi_UD2_Byte3S, 0 );
    putValue( eDEV_Kombi_UD2_Byte4S, 255 );  putValue( eDEV_Kombi_UD2_Byte4S, 0 );
    putValue( eDEV_Kombi_UD2_Byte5S, 255 );  putValue( eDEV_Kombi_UD2_Byte5S, 0 );
    putValue( eDEV_Kombi_UD2_Byte6S, 255 );  putValue( eDEV_Kombi_UD2_Byte6S, 0 );
    putValue( eDEV_Kombi_UD2_Byte7S, 255 );  putValue( eDEV_Kombi_UD2_Byte7S, 0 );
    putValue( eDEV_Kombi_UD2_Byte8S, 255 );  putValue( eDEV_Kombi_UD2_Byte8S, 0 );
    putValue( eEFF_Verbrauch_STH, 255); putValue( eEFF_Verbrauch_STH, 0);
  //GVJ-5567
    putValue( eTG_Geber_1, 4095); putValue( eTG_Geber_1, 0);
    putValue( eTG_Geber_2, 4095); putValue( eTG_Geber_2, 0);
    putValue( eTG_Geber_3, 4095); putValue( eTG_Geber_3, 0);
    putValue( eTG_Geber_4, 4095); putValue( eTG_Geber_4, 0);
    putValue( eTG_Guete_Geber_1, 15); putValue( eTG_Guete_Geber_1, 0);
    putValue( eTG_Guete_Geber_2, 15); putValue( eTG_Guete_Geber_2, 0);
    putValue( eTG_Guete_Geber_3, 15); putValue( eTG_Guete_Geber_3, 0);
    putValue( eTG_Guete_Geber_4, 15); putValue( eTG_Guete_Geber_4, 0);
    putValue( eEFF_Verbrauch_STH, 255); putValue( eEFF_Verbrauch_STH, 0);
    loadSettings( "RBS.ini" );
}

on stopMeasurement
{
    stopMeasurement1();
}

void stopMeasurement1()
{
    writeProfileInt( "Settings", "eSaveSettings_To_ini", getValue( eSaveSettings_To_ini ), "RBS.ini" );/*Saving the settings for the Savings Enable Widget*/

    if(getValue(eSaveSettings_To_ini))
    {
        saveSettings( "RBS.ini" );
    }
}

void saveSettings( char profileFile[] )
{
    saveSettings1( profileFile );
    saveSettings1G( profileFile );
    saveSettings2( profileFile );
    saveSettings2G( profileFile );
    saveSettings3( profileFile );
    saveSettings3G( profileFile );
    saveOthers( profileFile );
    saveOthers2( profileFile );
    saveAddtlEnVars( profileFile );
}

void saveSettings1( char profileFile[] )
{
    writeProfileInt( "Settings", "eSendEnabled", getValue( eSendEnabled ), profileFile );
    writeProfileInt( "Settings", "eLog_Kombi_Req_DataS", getValue( eLog_Kombi_Req_DataS ), profileFile );
    writeProfileInt( "Settings", "eLog_Datalogger_Req_DataKombi_MQ", getValue( eLog_Datalogger_Req_DataKombi_MQ ), profileFile );
    writeProfileInt( "Settings", "eAAG_Bremsl_durch_ECDS", getValue( eAAG_Bremsl_durch_ECDS ), profileFile );
    writeProfileInt( "Settings", "eAAG_Anhaenger_abgestecktS", getValue( eAAG_Anhaenger_abgestecktS ), profileFile );
    writeProfileInt( "Settings", "eAAG_NSL_aktivS", getValue( eAAG_NSL_aktivS ), profileFile );
    writeProfileInt( "Settings", "eAAG_Anhaenger_erkanntS", getValue( eAAG_Anhaenger_erkanntS ), profileFile );
    writeProfileInt( "Settings", "eAAG_Blinker_H_aktivS", getValue( eAAG_Blinker_H_aktivS ), profileFile );
    writeProfileInt( "Settings", "eAAG_Blinker_HL_defS", getValue( eAAG_Blinker_HL_defS ), profileFile );
    writeProfileInt( "Settings", "eAAG_Blinker_HR_defS", getValue( eAAG_Blinker_HR_defS ), profileFile );
    writeProfileInt( "Settings", "eAAG_Bremslicht_H_defS", getValue( eAAG_Bremslicht_H_defS ), profileFile );
    writeProfileInt( "Settings", "eAAG_Schlusslicht_HL_defS", getValue( eAAG_Schlusslicht_HL_defS ), profileFile );
    writeProfileInt( "Settings", "eAAG_Schlusslicht_HR_defS", getValue( eAAG_Schlusslicht_HR_defS ), profileFile );
    writeProfileInt( "Settings", "eAAG_AVS_Fehler_02S", getValue( eAAG_AVS_Fehler_02S ), profileFile );
    writeProfileInt( "Settings", "eAAG_AVS_StatiS", getValue( eAAG_AVS_StatiS ), profileFile );
    writeProfileInt( "Settings", "eBCM_Bremsbelag_SensorS", getValue( eBCM_Bremsbelag_SensorS ), profileFile );
    writeProfileInt( "Settings", "eBCM_Bremsfluessigkeit_SensorS", getValue( eBCM_Bremsfluessigkeit_SensorS ), profileFile );
    writeProfileInt( "Settings", "eBCM1_Licht_WarnS", getValue( eBCM1_Licht_WarnS ), profileFile );
    writeProfileInt( "Settings", "eBCM_Waschwasser_SensorS", getValue( eBCM_Waschwasser_SensorS ), profileFile );
    writeProfileInt( "Settings", "eBCM_Kuehlmittel_SensorS", getValue( eBCM_Kuehlmittel_SensorS ), profileFile );
    writeProfileInt( "Settings", "eBCM1_Kl_15_HW_erkanntS", getValue( eBCM1_Kl_15_HW_erkanntS ), profileFile );
    writeProfileInt( "Settings", "eZZH_Endlage_obenS", getValue( eZZH_Endlage_obenS ), profileFile );
    writeProfileInt( "Settings", "eZZH_Endlage_untenS", getValue( eZZH_Endlage_untenS ), profileFile );
    writeProfileInt( "Settings", "eZZH_Endlage_unplausibelS", getValue( eZZH_Endlage_unplausibelS ), profileFile );
    writeProfileInt( "Settings", "eBCM2_EZS_gedruecktS", getValue( eBCM2_EZS_gedruecktS ), profileFile );
    writeProfileInt( "Settings", "eBCM2_SST_gedruecktS", getValue( eBCM2_SST_gedruecktS ), profileFile );
    writeProfileInt( "Settings", "eBCM1_Warnblink_TasterS", getValue( eBCM1_Warnblink_TasterS ), profileFile );
    writeProfileInt( "Settings", "eBCM1_Valet_Parking_TasterS", getValue( eBCM1_Valet_Parking_TasterS ), profileFile );
    writeProfileInt( "Settings", "eBCM1_HSK_TasterS", getValue( eBCM1_HSK_TasterS ), profileFile );
    writeProfileInt( "Settings", "eBCM1_Heckrollo_TasterS", getValue( eBCM1_Heckrollo_TasterS ), profileFile );
    writeProfileInt( "Settings", "eBCM1_Rueckfahrlicht_SchalterS", getValue( eBCM1_Rueckfahrlicht_SchalterS ), profileFile );
    writeProfileInt( "Settings", "eBCM1_MH_SchalterS", getValue( eBCM1_MH_SchalterS ), profileFile );
    writeProfileInt( "Settings", "eBCM1_MH_WIV_SchalterS", getValue( eBCM1_MH_WIV_SchalterS ), profileFile );
    writeProfileInt( "Settings", "eBCM1_Lichtwarn_TexteS", getValue( eBCM1_Lichtwarn_TexteS ), profileFile );
    writeProfileInt( "Settings", "eKY_IDGeber_1_StatusS", getValue( eKY_IDGeber_1_StatusS ), profileFile );
    writeProfileInt( "Settings", "eKY_IDGeber_2_StatusS", getValue( eKY_IDGeber_2_StatusS ), profileFile );
    writeProfileInt( "Settings", "eKY_SofttouchS", getValue( eKY_SofttouchS ), profileFile );
    writeProfileInt( "Settings", "eKY_IDGeber_3_StatusS", getValue( eKY_IDGeber_3_StatusS ), profileFile );
    writeProfileInt( "Settings", "eKY_IDGeber_4_StatusS", getValue( eKY_IDGeber_4_StatusS ), profileFile );
    writeProfileInt( "Settings", "eKY_FFB_in_LF_ReichwS", getValue( eKY_FFB_in_LF_ReichwS ), profileFile );
    writeProfileInt( "Settings", "eKY_IDGeber_1_BatS", getValue( eKY_IDGeber_1_BatS ), profileFile );
    writeProfileInt( "Settings", "eKY_IDGeber_2_BatS", getValue( eKY_IDGeber_2_BatS ), profileFile );
    writeProfileInt( "Settings", "eKY_IDGeber_3_BatS", getValue( eKY_IDGeber_3_BatS ), profileFile );
    writeProfileInt( "Settings", "eKY_IDGeber_4_BatS", getValue( eKY_IDGeber_4_BatS ), profileFile );
    writeProfileInt( "Settings", "eKY_RSSI_WertS", getValue( eKY_RSSI_WertS ), profileFile );
    writeProfileInt( "Settings", "eKY_Nr_IDGeber_AutofktS", getValue( eKY_Nr_IDGeber_AutofktS ), profileFile );
    writeProfileInt( "Settings", "eKY_KessyEntryExit_AktS", getValue( eKY_KessyEntryExit_AktS ), profileFile );
    writeProfileInt( "Settings", "eKY_Autofunktion_AktivS", getValue( eKY_Autofunktion_AktivS ), profileFile );
    writeProfileInt( "Settings", "eKY_Anf_ReichwbegrS", getValue( eKY_Anf_ReichwbegrS ), profileFile );
    writeProfileInt( "Settings", "eKY_Anf_Reichwbegr_GesamtS", getValue( eKY_Anf_Reichwbegr_GesamtS ), profileFile );
    writeProfileInt( "Settings", "eKY_BedienstelleS", getValue( eKY_BedienstelleS ), profileFile );
    writeProfileInt( "Settings", "eKY_VerriegelnS", getValue( eKY_VerriegelnS ), profileFile );
    writeProfileInt( "Settings", "eKY_EntriegelnS", getValue( eKY_EntriegelnS ), profileFile );
    writeProfileInt( "Settings", "eKY_ZV_CMDS", getValue( eKY_ZV_CMDS ), profileFile );
    writeProfileInt( "Settings", "eKY_SchluesselnrS", getValue( eKY_SchluesselnrS ), profileFile );
    writeProfileInt( "Settings", "eKY_WFS_KeyDataS", getValue( eKY_WFS_KeyDataS ), profileFile );
    writeProfileInt( "Settings", "eKY_ID_Geber_1S", getValue( eKY_ID_Geber_1S ), profileFile );
    writeProfileInt( "Settings", "eKY_ID_Geber_2S", getValue( eKY_ID_Geber_2S ), profileFile );
    writeProfileInt( "Settings", "eKY_ID_Geber_3S", getValue( eKY_ID_Geber_3S ), profileFile );
    writeProfileInt( "Settings", "eKY_ID_Geber_4S", getValue( eKY_ID_Geber_4S ), profileFile );
    writeProfileInt( "Settings", "eKY_GoTransponder_IDS", getValue( eKY_GoTransponder_IDS ), profileFile );
    writeProfileInt( "Settings", "eKY_GoAuthent_RespS", getValue( eKY_GoAuthent_RespS ), profileFile );
    writeProfileInt( "Settings", "eBM_ZV_aufS", getValue( eBM_ZV_aufS ), profileFile );
    writeProfileInt( "Settings", "eBM_ZV_zuS", getValue( eBM_ZV_zuS ), profileFile );
    writeProfileInt( "Settings", "eBM_DWA_einS", getValue( eBM_DWA_einS ), profileFile );
    writeProfileInt( "Settings", "eBM_DWA_AlarmS", getValue( eBM_DWA_AlarmS ), profileFile );
    writeProfileInt( "Settings", "eBM_CrashS", getValue( eBM_CrashS ), profileFile );
    writeProfileInt( "Settings", "eBM_PanikS", getValue( eBM_PanikS ), profileFile );
    writeProfileInt( "Settings", "eBM_Not_BremsungS", getValue( eBM_Not_BremsungS ), profileFile );
    writeProfileInt( "Settings", "eBM_GDOS", getValue( eBM_GDOS ), profileFile );
    writeProfileInt( "Settings", "eBM_WarnblinkenS", getValue( eBM_WarnblinkenS ), profileFile );
    writeProfileInt( "Settings", "eBM_Taxi_NotalarmS", getValue( eBM_Taxi_NotalarmS ), profileFile );
    writeProfileInt( "Settings", "eBM_TelematikS", getValue( eBM_TelematikS ), profileFile );
    writeProfileInt( "Settings", "eBM_linksS", getValue( eBM_linksS ), profileFile );
    writeProfileInt( "Settings", "eBM_rechtsS", getValue( eBM_rechtsS ), profileFile );
    writeProfileInt( "Settings", "eBlinken_li_Fzg_TaktS", getValue( eBlinken_li_Fzg_TaktS ), profileFile );
    writeProfileInt( "Settings", "eBlinken_re_Fzg_TaktS", getValue( eBlinken_re_Fzg_TaktS ), profileFile );
    writeProfileInt( "Settings", "eBlinken_li_Kombi_TaktS", getValue( eBlinken_li_Kombi_TaktS ), profileFile );
    writeProfileInt( "Settings", "eBlinken_re_Kombi_TaktS", getValue( eBlinken_re_Kombi_TaktS ), profileFile );
    writeProfileInt( "Settings", "eBM_NBA_n_codiert_n_aktivS", getValue( eBM_NBA_n_codiert_n_aktivS ), profileFile );
    writeProfileInt( "Settings", "eBM_NBA_StatusS", getValue( eBM_NBA_StatusS ), profileFile );
    writeProfileInt( "Settings", "eDI_KL_58xd254", getValue( eDI_KL_58xd254 ), profileFile );
    writeProfileInt( "Settings", "eDI_KL_58xdS", getValue( eDI_KL_58xdS ), profileFile );
    writeProfileInt( "Settings", "eDI_KL_58xsS", getValue( eDI_KL_58xsS ), profileFile );
    writeProfileInt( "Settings", "eDI_Display_NachtdesignS", getValue( eDI_Display_NachtdesignS ), profileFile );
    writeProfileInt( "Settings", "eDI_KL_58xtS", getValue( eDI_KL_58xtS ), profileFile );
    writeProfileInt( "Settings", "eDI_FotosensorS", getValue( eDI_FotosensorS ), profileFile );
    writeProfileInt( "Settings", "eELV_Anf_Klemme_SS", getValue( eELV_Anf_Klemme_SS ), profileFile );
    writeProfileInt( "Settings", "eELV_Anf_Klemme_15S", getValue( eELV_Anf_Klemme_15S ), profileFile );
    writeProfileInt( "Settings", "eELV_Anf_Klemme_50S", getValue( eELV_Anf_Klemme_50S ), profileFile );
    writeProfileInt( "Settings", "eELV_VerriegeltS", getValue( eELV_VerriegeltS ), profileFile );
    writeProfileInt( "Settings", "eELV_EntriegeltS", getValue( eELV_EntriegeltS ), profileFile );
    writeProfileInt( "Settings", "eELV_LebenszustandS", getValue( eELV_LebenszustandS ), profileFile );
    writeProfileInt( "Settings", "eELV_AnlernmodusS", getValue( eELV_AnlernmodusS ), profileFile );
    writeProfileInt( "Settings", "eELV_Akustik_1S", getValue( eELV_Akustik_1S ), profileFile );
    writeProfileInt( "Settings", "eELV_Akustik_2S", getValue( eELV_Akustik_2S ), profileFile );
    writeProfileInt( "Settings", "eELV_Blink_LEDS", getValue( eELV_Blink_LEDS ), profileFile );
    writeProfileInt( "Settings", "eELV_LED_RotS", getValue( eELV_LED_RotS ), profileFile );
    writeProfileInt( "Settings", "eELV_LED_BremseS", getValue( eELV_LED_BremseS ), profileFile );
    writeProfileInt( "Settings", "eELV_Txt_Lkg_BewegenS", getValue( eELV_Txt_Lkg_BewegenS ), profileFile );
    writeProfileInt( "Settings", "eELV_Txt_WerkstattS", getValue( eELV_Txt_WerkstattS ), profileFile );
    writeProfileInt( "Settings", "eELV_Txt_DefektS", getValue( eELV_Txt_DefektS ), profileFile );
    writeProfileInt( "Settings", "eELV_P_VerriegeltS", getValue( eELV_P_VerriegeltS ), profileFile );
    writeProfileInt( "Settings", "eELV_WFS_RNDS", getValue( eELV_WFS_RNDS ), profileFile );
    writeProfileInt( "Settings", "eELV_WFS_CRCS", getValue( eELV_WFS_CRCS ), profileFile );
    writeProfileInt( "Settings", "eKY_ID_Geber1_im_FzgS", getValue( eKY_ID_Geber1_im_FzgS ), profileFile );
    writeProfileInt( "Settings", "eKY_ID_Geber2_im_FzgS", getValue( eKY_ID_Geber2_im_FzgS ), profileFile );
    writeProfileInt( "Settings", "eKY_ID_Geber3_im_FzgS", getValue( eKY_ID_Geber3_im_FzgS ), profileFile );
    writeProfileInt( "Settings", "eKY_ID_Geber4_im_FzgS", getValue( eKY_ID_Geber4_im_FzgS ), profileFile );
    writeProfileInt( "Settings", "eKY_Startknopf_BelS", getValue( eKY_Startknopf_BelS ), profileFile );
    writeProfileInt( "Settings", "eKY_ID_Geber_SucheS", getValue( eKY_ID_Geber_SucheS ), profileFile );
    writeProfileInt( "Settings", "eKY_MeldungenS", getValue( eKY_MeldungenS ), profileFile );
    writeProfileInt( "Settings", "eKY_Gong_600S", getValue( eKY_Gong_600S ), profileFile );
    writeProfileInt( "Settings", "eKY_Passiv_Autolock_MenueS", getValue( eKY_Passiv_Autolock_MenueS ), profileFile );
    writeProfileInt( "Settings", "eKY_Passiv_Autolock_AktS", getValue( eKY_Passiv_Autolock_AktS ), profileFile );
    writeProfileInt( "Settings", "eKY_Passiv_AutolockS", getValue( eKY_Passiv_AutolockS ), profileFile );
    writeProfileInt( "Settings", "eKY_Passiv_AutounlockS", getValue( eKY_Passiv_AutounlockS ), profileFile );
    writeProfileInt( "Settings", "eKY_Gestik_HDS", getValue( eKY_Gestik_HDS ), profileFile );
    writeProfileInt( "Settings", "eKY_StartStopp_InfoS", getValue( eKY_StartStopp_InfoS ), profileFile );
    writeProfileInt( "Settings", "eZAS_Kl_SS", getValue( eZAS_Kl_SS ), profileFile );
    writeProfileInt( "Settings", "eZAS_Kl_15S", getValue( eZAS_Kl_15S ), profileFile );
    writeProfileInt( "Settings", "eZAS_Kl_XS", getValue( eZAS_Kl_XS ), profileFile );
    writeProfileInt( "Settings", "ZAS_Kl_50_Startanforderung", getValue( eZAS_Kl_50_StartanforderungS ), profileFile );
    writeProfileFloat( "Settings", "eBCM1_Aussen_Temp_ungefS", getValue( eBCM1_Aussen_Temp_ungefS ), profileFile );
    writeProfileInt( "Settings", "eBCM1_FStatus_Aussentemp_ungefS", getValue( eBCM1_FStatus_Aussentemp_ungefS ), profileFile );
    writeProfileInt( "Settings", "eBCM1_OBD_FStatus_ATempS", getValue( eBCM1_OBD_FStatus_ATempS ), profileFile );
    writeProfileInt( "Settings", "eBCM1_Kurvenlicht_links_AnfS", getValue( eBCM1_Kurvenlicht_links_AnfS ), profileFile );
    writeProfileInt( "Settings", "eBCM1_Kurvenlicht_rechts_AnfS", getValue( eBCM1_Kurvenlicht_rechts_AnfS ), profileFile );
    writeProfileInt( "Settings", "eBCM1_Standlicht_AnfS", getValue( eBCM1_Standlicht_AnfS ), profileFile );
    writeProfileInt( "Settings", "eBCM1_Abblendlicht_AnfS", getValue( eBCM1_Abblendlicht_AnfS ), profileFile );
    writeProfileInt( "Settings", "eBCM1_Fernlicht_AnfS", getValue( eBCM1_Fernlicht_AnfS ), profileFile );
    writeProfileInt( "Settings", "eBCM1_Nebellicht_AnfS", getValue( eBCM1_Nebellicht_AnfS ), profileFile );
    writeProfileInt( "Settings", "eBCM1_Parklicht_li_AnfS", getValue( eBCM1_Parklicht_li_AnfS ), profileFile );
    writeProfileInt( "Settings", "eBCM1_Parklicht_re_AnfS", getValue( eBCM1_Parklicht_re_AnfS ), profileFile );
    writeProfileInt( "Settings", "eBCM1_Nebelschluss_Ahg_AnfS", getValue( eBCM1_Nebelschluss_Ahg_AnfS ), profileFile );
    writeProfileInt( "Settings", "eBCM1_Nebelschluss_Fzg_AnfS", getValue( eBCM1_Nebelschluss_Fzg_AnfS ), profileFile );
    writeProfileInt( "Settings", "eBCM1_Schlusslicht_AnfS", getValue( eBCM1_Schlusslicht_AnfS ), profileFile );
    writeProfileInt( "Settings", "eBCM1_RFahrlicht_Fzg_AnfS", getValue( eBCM1_RFahrlicht_Fzg_AnfS ), profileFile );
    writeProfileInt( "Settings", "eBCM1_Umfeldleuchten_AnfS", getValue( eBCM1_Umfeldleuchten_AnfS ), profileFile );
    writeProfileInt( "Settings", "eBCM1_Tagfahrlicht_AnfS", getValue( eBCM1_Tagfahrlicht_AnfS ), profileFile );
    writeProfileInt( "Settings", "eBCM1_Regenlicht_AnfS", getValue( eBCM1_Regenlicht_AnfS ), profileFile );
    writeProfileInt( "Settings", "eBCM1_Autobahnlicht_AnfS", getValue( eBCM1_Autobahnlicht_AnfS ), profileFile );
    writeProfileInt( "Settings", "eBCM1_Touristen_Licht_AnfS", getValue( eBCM1_Touristen_Licht_AnfS ), profileFile );
    writeProfileInt( "Settings", "eBCM1_Gleitende_Leuchtw_AnfS", getValue( eBCM1_Gleitende_Leuchtw_AnfS ), profileFile );
    writeProfileInt( "Settings", "eBCM1_GLW_Fernlicht_AnfS", getValue( eBCM1_GLW_Fernlicht_AnfS ), profileFile );
    writeProfileInt( "Settings", "eBCM1_Adaptive_Lichtvert_AnfS", getValue( eBCM1_Adaptive_Lichtvert_AnfS ), profileFile );
    writeProfileInt( "Settings", "eLicht_hinten_01_BZS", getValue( eLicht_hinten_01_BZS ), profileFile );
    writeProfileInt( "Settings", "eBCM2_Bremsl_durch_ECDS", getValue( eBCM2_Bremsl_durch_ECDS ), profileFile );
    writeProfileInt( "Settings", "eLH_Aussenlicht_defS", getValue( eLH_Aussenlicht_defS ), profileFile );
    writeProfileInt( "Settings", "eLH_Standlicht_H_aktivS", getValue( eLH_Standlicht_H_aktivS ), profileFile );
    writeProfileInt( "Settings", "eLH_Parklicht_HL_aktivS", getValue( eLH_Parklicht_HL_aktivS ), profileFile );
    writeProfileInt( "Settings", "eLH_Parklicht_HR_aktivS", getValue( eLH_Parklicht_HR_aktivS ), profileFile );
    writeProfileInt( "Settings", "eLH_Bremslicht_H_aktivS", getValue( eLH_Bremslicht_H_aktivS ), profileFile );
    writeProfileInt( "Settings", "eLH_Nebelschluss_aktivS", getValue( eLH_Nebelschluss_aktivS ), profileFile );
    writeProfileInt( "Settings", "eLH_Rueckfahrlicht_aktivS", getValue( eLH_Rueckfahrlicht_aktivS ), profileFile );
    writeProfileInt( "Settings", "eLH_Blinker_HL_aktS", getValue( eLH_Blinker_HL_aktS ), profileFile );
    writeProfileInt( "Settings", "eLH_Blinker_HR_aktS", getValue( eLH_Blinker_HR_aktS ), profileFile );
    writeProfileInt( "Settings", "eLH_Blinker_li_defS", getValue( eLH_Blinker_li_defS ), profileFile );
    writeProfileInt( "Settings", "eLH_Bremsl_li_defS", getValue( eLH_Bremsl_li_defS ), profileFile );
    writeProfileInt( "Settings", "eLH_Schlusslicht_li_defS", getValue( eLH_Schlusslicht_li_defS ), profileFile );
    writeProfileInt( "Settings", "eLH_Rueckf_li_defS", getValue( eLH_Rueckf_li_defS ), profileFile );
    writeProfileInt( "Settings", "eLH_Nebel_li_defS", getValue( eLH_Nebel_li_defS ), profileFile );
    writeProfileInt( "Settings", "eLH_Schluss_Brems_Nebel_li_defS", getValue( eLH_Schluss_Brems_Nebel_li_defS ), profileFile );
    writeProfileInt( "Settings", "eLH_Schluss_Brems_Nebel_re_defS", getValue( eLH_Schluss_Brems_Nebel_re_defS ), profileFile );
    writeProfileInt( "Settings", "eLH_Schluss_Brems_li_defS", getValue( eLH_Schluss_Brems_li_defS ), profileFile );
    writeProfileInt( "Settings", "eLH_Schluss_Nebel_li_defS", getValue( eLH_Schluss_Nebel_li_defS ), profileFile );
    writeProfileInt( "Settings", "eLH_SL_BRL_BLK_li_defS", getValue( eLH_SL_BRL_BLK_li_defS ), profileFile );
    writeProfileInt( "Settings", "eLH_Brems_Blk_li_defS", getValue( eLH_Brems_Blk_li_defS ), profileFile );
    writeProfileInt( "Settings", "eLH_Blinker_re_defS", getValue( eLH_Blinker_re_defS ), profileFile );
    writeProfileInt( "Settings", "eLH_Bremsl_re_defS", getValue( eLH_Bremsl_re_defS ), profileFile );
    writeProfileInt( "Settings", "eLH_Schlusslicht_re_defS", getValue( eLH_Schlusslicht_re_defS ), profileFile );
    writeProfileInt( "Settings", "eLH_Rueckf_re_defS", getValue( eLH_Rueckf_re_defS ), profileFile );
    writeProfileInt( "Settings", "eLH_Nebel_re_defS", getValue( eLH_Nebel_re_defS ), profileFile );
    writeProfileInt( "Settings", "eLH_Schluss_Brems_re_defS", getValue( eLH_Schluss_Brems_re_defS ), profileFile );
    writeProfileInt( "Settings", "eLH_Schluss_Nebel_re_defS", getValue( eLH_Schluss_Nebel_re_defS ), profileFile );
    writeProfileInt( "Settings", "eLH_SL_BRL_BLK_re_defS", getValue( eLH_SL_BRL_BLK_re_defS ), profileFile );
    writeProfileInt( "Settings", "eLH_Brems_Blk_re_defS", getValue( eLH_Brems_Blk_re_defS ), profileFile );
    writeProfileInt( "Settings", "eLH_Kennzl_defS", getValue( eLH_Kennzl_defS ), profileFile );
    writeProfileInt( "Settings", "eLH_3_Bremsl_defS", getValue( eLH_3_Bremsl_defS ), profileFile );
    writeProfileInt( "Settings", "eLH_Nebel_mi_defS", getValue( eLH_Nebel_mi_defS ), profileFile );
    writeProfileInt( "Settings", "eLH_Rueckf_mi_defS", getValue( eLH_Rueckf_mi_defS ), profileFile );
    writeProfileInt( "Settings", "eLH_Bremsl_li_ges_defS", getValue( eLH_Bremsl_li_ges_defS ), profileFile );
    writeProfileInt( "Settings", "eLH_Bremsl_re_ges_defS", getValue( eLH_Bremsl_re_ges_defS ), profileFile );
    writeProfileInt( "Settings", "eLV_Standlicht_AnzeigeS", getValue( eLV_Standlicht_AnzeigeS ), profileFile );
    writeProfileInt( "Settings", "eLV_Abblendlicht_AnzeigeS", getValue( eLV_Abblendlicht_AnzeigeS ), profileFile );
    writeProfileInt( "Settings", "eLV_Fernlicht_AnzeigeS", getValue( eLV_Fernlicht_AnzeigeS ), profileFile );
    writeProfileInt( "Settings", "eLV_Nebellicht_AnzeigeS", getValue( eLV_Nebellicht_AnzeigeS ), profileFile );
    writeProfileInt( "Settings", "eLV_Nebelschlusslicht_AnzeigeS", getValue( eLV_Nebelschlusslicht_AnzeigeS ), profileFile );
    writeProfileInt( "Settings", "eLV_Tagfahrlicht_AnzeigeS", getValue( eLV_Tagfahrlicht_AnzeigeS ), profileFile );
    writeProfileInt( "Settings", "eLV_AFL_aktiv_AnzeigeS", getValue( eLV_AFL_aktiv_AnzeigeS ), profileFile );
    writeProfileInt( "Settings", "eLV_AFL_defektS", getValue( eLV_AFL_defektS ), profileFile );
    writeProfileInt( "Settings", "eLV_Blinker_li_defS", getValue( eLV_Blinker_li_defS ), profileFile );
    writeProfileInt( "Settings", "eLV_Standlicht_li_defS", getValue( eLV_Standlicht_li_defS ), profileFile );
    writeProfileInt( "Settings", "eLV_Abblendlicht_li_defS", getValue( eLV_Abblendlicht_li_defS ), profileFile );
    writeProfileInt( "Settings", "eLV_Fernlicht_li_defS", getValue( eLV_Fernlicht_li_defS ), profileFile );
    writeProfileInt( "Settings", "eLV_Nebellicht_li_defS", getValue( eLV_Nebellicht_li_defS ), profileFile );
    writeProfileInt( "Settings", "eLV_Blk_li_Seite_defS", getValue( eLV_Blk_li_Seite_defS ), profileFile );
    writeProfileInt( "Settings", "eLV_Tagfahrlicht_li_defS", getValue( eLV_Tagfahrlicht_li_defS ), profileFile );
    writeProfileInt( "Settings", "eLV_FLA_aktiv_AnzeigeS", getValue( eLV_FLA_aktiv_AnzeigeS ), profileFile );
    writeProfileInt( "Settings", "eLV_FLA_defektS", getValue( eLV_FLA_defektS ), profileFile );
    writeProfileInt( "Settings", "eLV_FLA_Sensor_blockiertS", getValue( eLV_FLA_Sensor_blockiertS ), profileFile );
    writeProfileInt( "Settings", "eLV_Blinker_re_defS", getValue( eLV_Blinker_re_defS ), profileFile );
    writeProfileInt( "Settings", "eLV_Standlicht_re_defS", getValue( eLV_Standlicht_re_defS ), profileFile );
    writeProfileInt( "Settings", "eLV_Abblendlicht_re_defS", getValue( eLV_Abblendlicht_re_defS ), profileFile );
    writeProfileInt( "Settings", "eLV_Fernlicht_re_defS", getValue( eLV_Fernlicht_re_defS ), profileFile );
    writeProfileInt( "Settings", "eLV_Nebellicht_re_defS", getValue( eLV_Nebellicht_re_defS ), profileFile );
    writeProfileInt( "Settings", "eLV_Blk_re_Seite_defS", getValue( eLV_Blk_re_Seite_defS ), profileFile );
    writeProfileInt( "Settings", "eLV_Tagfahrlicht_re_defS", getValue( eLV_Tagfahrlicht_re_defS ), profileFile );
    writeProfileInt( "Settings", "eLV_Aussenlicht_defS", getValue( eLV_Aussenlicht_defS ), profileFile );
    writeProfileInt( "Settings", "eLV_Abblendlicht_TFL_li_defS", getValue( eLV_Abblendlicht_TFL_li_defS ), profileFile );
    writeProfileInt( "Settings", "eLV_Nebellicht_TFL_li_defS", getValue( eLV_Nebellicht_TFL_li_defS ), profileFile );
    writeProfileInt( "Settings", "eLV_Standlicht_TFL_li_defS", getValue( eLV_Standlicht_TFL_li_defS ), profileFile );
    writeProfileInt( "Settings", "eLV_Abblend_Fernlicht_li_defS", getValue( eLV_Abblend_Fernlicht_li_defS ), profileFile );
    writeProfileInt( "Settings", "eLV_Abblendlicht_TFL_re_defS", getValue( eLV_Abblendlicht_TFL_re_defS ), profileFile );
    writeProfileInt( "Settings", "eLV_Nebellicht_TFL_re_defS", getValue( eLV_Nebellicht_TFL_re_defS ), profileFile );
    writeProfileInt( "Settings", "eLV_Standlicht_TFL_re_defS", getValue( eLV_Standlicht_TFL_re_defS ), profileFile );
    writeProfileInt( "Settings", "eLV_Abblend_Fernlicht_re_defS", getValue( eLV_Abblend_Fernlicht_re_defS ), profileFile );
    writeProfileInt( "Settings", "eBFS_Fond_Bed_AckS", getValue( eBFS_Fond_Bed_AckS ), profileFile );
    writeProfileInt( "Settings", "eBFS_Lehne_nicht_verriegeltS", getValue( eBFS_Lehne_nicht_verriegeltS ), profileFile );
    writeProfileInt( "Settings", "eBFS_Klapptisch_offenS", getValue( eBFS_Klapptisch_offenS ), profileFile );
    writeProfileInt( "Settings", "eBFS_KD_FehlerS", getValue( eBFS_KD_FehlerS ), profileFile );
    writeProfileInt( "Settings", "eBFS_Sitzsym_Fahrt_aktivS", getValue( eBFS_Sitzsym_Fahrt_aktivS ), profileFile );
    writeProfileInt( "Settings", "eBFS_Sitzfahrt_aktivS", getValue( eBFS_Sitzfahrt_aktivS ), profileFile );
    writeProfileInt( "Settings", "eBFS_SLV_aktivS", getValue( eBFS_SLV_aktivS ), profileFile );
    writeProfileInt( "Settings", "eBFS_SHV_aktivS", getValue( eBFS_SHV_aktivS ), profileFile );
    writeProfileInt( "Settings", "eBFS_LNV_aktivS", getValue( eBFS_LNV_aktivS ), profileFile );
    writeProfileInt( "Settings", "eBFS_SNV_aktivS", getValue( eBFS_SNV_aktivS ), profileFile );
    writeProfileInt( "Settings", "eBFS_KSV_aktivS", getValue( eBFS_KSV_aktivS ), profileFile );
    writeProfileInt( "Settings", "eBFS_LKV_aktivS", getValue( eBFS_LKV_aktivS ), profileFile );
    writeProfileInt( "Settings", "eBFS_STV_aktivS", getValue( eBFS_STV_aktivS ), profileFile );
    writeProfileInt( "Settings", "eBFS_LHV_aktivS", getValue( eBFS_LHV_aktivS ), profileFile );
    writeProfileInt( "Settings", "eBFS_LWV_aktivS", getValue( eBFS_LWV_aktivS ), profileFile );
    writeProfileInt( "Settings", "eBFS_GHV_aktivS", getValue( eBFS_GHV_aktivS ), profileFile );
    writeProfileInt( "Settings", "eBFS_KSS_Fahrt_aktivS", getValue( eBFS_KSS_Fahrt_aktivS ), profileFile );
    writeProfileInt( "Settings", "eBFS_MMB_lokal_StopS", getValue( eBFS_MMB_lokal_StopS ), profileFile );
    writeProfileInt( "Settings", "eBFS_Ruhestellung_StatusS", getValue( eBFS_Ruhestellung_StatusS ), profileFile );

  //TSG_FT_02
    writeProfileInt( "Settings", "eCrcTSG_FT_02", getValue( eCrcTSG_FT_02 ), profileFile );
    writeProfileInt( "Settings", "eTSG_FT_02_BZS", getValue( eTSG_FT_02_BZS ), profileFile );
    writeProfileInt( "Settings", "eFT_Tuer_Status", getValue( eFT_Tuer_Status ), profileFile );

    writeProfileInt( "Settings", "eBCM1_Hinweis_Lichtnachlauf", getValue( eBCM1_Hinweis_Lichtnachlauf ), profileFile );

    writeProfileInt( "Settings", "eAAG_AVS_Fehler_02S", getValue( eAAG_AVS_Fehler_02S ), profileFile );
    writeProfileInt( "Settings", "eBCM_Anf_AAW_MoLaWaS", getValue( eBCM_Anf_AAW_MoLaWaS ), profileFile );
    writeProfileInt( "Settings", "eWFS_Schluessel_SollS", getValue( eWFS_Schluessel_SollS ), profileFile );
    writeProfileInt( "Settings", "eWFS_Schluessel_IstS", getValue( eWFS_Schluessel_IstS ), profileFile );
    writeProfileInt( "Settings", "eWFS_SafeS", getValue( eWFS_SafeS ), profileFile );
    writeProfileInt( "Settings", "eWFS_LZS", getValue( eWFS_LZS ), profileFile );
    writeProfileInt( "Settings", "eBCM_anf_VLWS", getValue( eBCM_anf_VLWS ), profileFile );
    writeProfileInt( "Settings", "eBCM_LTM_Nebelschluss_StatusS", getValue( eBCM_LTM_Nebelschluss_StatusS ), profileFile );
    writeProfileInt( "Settings", "eBCM_LTM_Allwetterl_StatusS", getValue( eBCM_LTM_Allwetterl_StatusS ), profileFile );
    writeProfileInt( "Settings", "eBCM_LTM_PopUp_StatusS", getValue( eBCM_LTM_PopUp_StatusS ), profileFile );
    writeProfileInt( "Settings", "eBCM_LTM_Nebell_StatusS", getValue( eBCM_LTM_Nebell_StatusS ), profileFile );
    writeProfileInt( "Settings", "eBCM_LTM_PopUp_AnfS", getValue( eBCM_LTM_PopUp_AnfS ), profileFile );
    writeProfileInt( "Settings", "eBCM_LTM_PopUp_InhaltS", getValue( eBCM_LTM_PopUp_InhaltS ), profileFile );
    writeProfileInt( "Settings", "eHUD_FAS_Anzeige_KombiS", getValue( eHUD_FAS_Anzeige_KombiS ), profileFile );
    writeProfileInt( "Settings", "eHUD_KDK_Anzeige_KombiS", getValue( eHUD_KDK_Anzeige_KombiS ), profileFile );
    writeProfileInt( "Settings", "eHUD_PEA_Anzeige_KombiS", getValue( eHUD_PEA_Anzeige_KombiS ), profileFile );
    writeProfileInt( "Settings", "eHUD_VZE_AIO_Anzeige_KombiS", getValue( eHUD_VZE_AIO_Anzeige_KombiS ), profileFile );
}

void saveSettings1G( char profileFile[] )
{
    writeProfileInt( "Settings", "eMO_Kuehlerluefter_MUXS", getValue( eMO_Kuehlerluefter_MUXS ), profileFile );
    writeProfileInt( "Settings", "eMO_Kuehlerluefter_1S", getValue( eMO_Kuehlerluefter_1S ), profileFile );
    writeProfileInt( "Settings", "eMO_Kuehlerluefter_2S", getValue( eMO_Kuehlerluefter_2S ), profileFile );
    writeProfileInt( "Settings", "eMO_HYB_Status_HV_LadungS", getValue( eMO_HYB_Status_HV_LadungS ), profileFile );
    writeProfileInt( "Settings", "eWIV_Anzeige_aktivS", getValue( eWIV_Anzeige_aktivS ), profileFile );
    writeProfileInt( "Settings", "eWIV_Oelmin_WarnS", getValue( eWIV_Oelmin_WarnS ), profileFile );
    writeProfileInt( "Settings", "eWIV_SensorfehlerS", getValue( eWIV_SensorfehlerS ), profileFile );
    writeProfileInt( "Settings", "eWIV_SchieflageS", getValue( eWIV_SchieflageS ), profileFile );
    writeProfileFloat( "Settings", "eWIV_OelstandS", getValue( eWIV_OelstandS ), profileFile );
    writeProfileInt( "Settings", "eMO_Zustand_HWPS", getValue( eMO_Zustand_HWPS ), profileFile );
    writeProfileInt( "Settings", "eWIV_Oelsystem_aktivS", getValue( eWIV_Oelsystem_aktivS ), profileFile );
    writeProfileInt( "Settings", "eWIV_nicht_betriebswarmS", getValue( eWIV_nicht_betriebswarmS ), profileFile );
    writeProfileInt( "Settings", "eWIV_Ueberfuell_WarnS", getValue( eWIV_Ueberfuell_WarnS ), profileFile );
    writeProfileInt( "Settings", "eWIV_laufender_MotorS", getValue( eWIV_laufender_MotorS ), profileFile );
    writeProfileInt( "Settings", "eMO_Text_MotorstartS", getValue( eMO_Text_MotorstartS ), profileFile );
    writeProfileInt( "Settings", "eMO_Text_Partikelfil_RegS", getValue( eMO_Text_Partikelfil_RegS ), profileFile );
    writeProfileFloat( "Settings", "eWIV_OelmengeS", getValue( eWIV_OelmengeS ), profileFile );
    writeProfileInt( "Settings", "eMO_SystemlampeS", getValue( eMO_SystemlampeS ), profileFile );
    writeProfileInt( "Settings", "eMO_OBD2_LampeS", getValue( eMO_OBD2_LampeS ), profileFile );
    writeProfileInt( "Settings", "eMO_HeissleuchteS", getValue( eMO_HeissleuchteS ), profileFile );
    writeProfileInt( "Settings", "eMO_Partikel_LampeS", getValue( eMO_Partikel_LampeS ), profileFile );
    writeProfileInt( "Settings", "eMO_WinterfahrprogS", getValue( eMO_WinterfahrprogS ), profileFile );
    writeProfileInt( "Settings", "eWIV_Oelstand_nicht_vorhandenS", getValue( eWIV_Oelstand_nicht_vorhandenS ), profileFile );
    writeProfileInt( "Settings", "eWIV_nachfuellanzeige_einS", getValue( eWIV_nachfuellanzeige_einS ), profileFile );
    writeProfileInt( "Settings", "eWIV_Ueberfuell_deaktivS", getValue( eWIV_Ueberfuell_deaktivS ), profileFile );
    writeProfileInt( "Settings", "eWIV_Unterfuell_WarnS", getValue( eWIV_Unterfuell_WarnS ), profileFile );
    writeProfileInt( "Settings", "eMO_Text_TankdeckelwarnS", getValue( eMO_Text_TankdeckelwarnS ), profileFile );
    writeProfileInt( "Settings", "eWIV_Enable_Oeldr_MotorS", getValue( eWIV_Enable_Oeldr_MotorS ), profileFile );
    writeProfileInt( "Settings", "eWIV_Oeldr_Warn_MotorS", getValue( eWIV_Oeldr_Warn_MotorS ), profileFile );
    writeProfileFloat( "Settings", "eACC_Wunschgeschw_02S", getValue( eACC_Wunschgeschw_02S ), profileFile );
    writeProfileInt( "Settings", "eACC_Status_Prim_AnzS", getValue( eACC_Status_Prim_AnzS ), profileFile );
    writeProfileInt( "Settings", "eACC_Abstandsindex_02S", getValue( eACC_Abstandsindex_02S ), profileFile );
    writeProfileInt( "Settings", "eACC_Akustik_02S", getValue( eACC_Akustik_02S ), profileFile );
    writeProfileInt( "Settings", "eACC_Gesetzte_ZeitlueckeS", getValue( eACC_Gesetzte_ZeitlueckeS ), profileFile );
    writeProfileInt( "Settings", "eACC_Optischer_FahrerhinweisS", getValue( eACC_Optischer_FahrerhinweisS ), profileFile );
    writeProfileInt( "Settings", "eACC_Typ_TachokranzS", getValue( eACC_Typ_TachokranzS ), profileFile );
    writeProfileInt( "Settings", "eACC_Anzeige_ZeitlueckeS", getValue( eACC_Anzeige_ZeitlueckeS ), profileFile );
    writeProfileInt( "Settings", "eACC_TachokranzS", getValue( eACC_TachokranzS ), profileFile );
    writeProfileInt( "Settings", "eACC_Display_PrioS", getValue( eACC_Display_PrioS ), profileFile );
    writeProfileInt( "Settings", "eACC_Relevantes_ObjektS", getValue( eACC_Relevantes_ObjektS ), profileFile );
    writeProfileInt( "Settings", "eACC_Texte_PrimaeranzS", getValue( eACC_Texte_PrimaeranzS ), profileFile );
    writeProfileInt( "Settings", "eACC_Wunschgeschw_erreichtS", getValue( eACC_Wunschgeschw_erreichtS ), profileFile );
    writeProfileInt( "Settings", "eACC_Status_AnzeigeS", getValue( eACC_Status_AnzeigeS ), profileFile );
    writeProfileInt( "Settings", "eACC_Texte_ZusatzanzS", getValue( eACC_Texte_ZusatzanzS ), profileFile );
    writeProfileInt( "Settings", "eACC_Status_ZusatzanzS", getValue( eACC_Status_ZusatzanzS ), profileFile );
    writeProfileInt( "Settings", "eACC_TexteS", getValue( eACC_TexteS ), profileFile );
    writeProfileInt( "Settings", "eACC_Texte_braking_guardS", getValue( eACC_Texte_braking_guardS ), profileFile );
    writeProfileInt( "Settings", "eACC_WarnhinweisS", getValue( eACC_WarnhinweisS ), profileFile );
    writeProfileFloat( "Settings", "eACC_Geschw_ZielfahrzeugS", getValue( eACC_Geschw_ZielfahrzeugS ), profileFile );
    writeProfileInt( "Settings", "eACC_Charisma_FahrPrS", getValue( eACC_Charisma_FahrPrS ), profileFile );
    writeProfileInt( "Settings", "eACC_Charisma_StatusS", getValue( eACC_Charisma_StatusS ), profileFile );
    writeProfileInt( "Settings", "eAB_RGS_AnstS", getValue( eAB_RGS_AnstS ), profileFile );
    writeProfileInt( "Settings", "eAB_Front_CrashS", getValue( eAB_Front_CrashS ), profileFile );
    writeProfileInt( "Settings", "eAB_Heck_CrashS", getValue( eAB_Heck_CrashS ), profileFile );
    writeProfileInt( "Settings", "eAB_SF_CrashS", getValue( eAB_SF_CrashS ), profileFile );
    writeProfileInt( "Settings", "eAB_SB_CrashS", getValue( eAB_SB_CrashS ), profileFile );
    writeProfileInt( "Settings", "eAB_Rollover_CrashS", getValue( eAB_Rollover_CrashS ), profileFile );
    writeProfileInt( "Settings", "eAB_Crash_IntS", getValue( eAB_Crash_IntS ), profileFile );
    writeProfileInt( "Settings", "eAB_LampeS", getValue( eAB_LampeS ), profileFile );
    writeProfileInt( "Settings", "eAB_DeaktiviertS", getValue( eAB_DeaktiviertS ), profileFile );
    writeProfileInt( "Settings", "eAB_VB_deaktiviertS", getValue( eAB_VB_deaktiviertS ), profileFile );
    writeProfileInt( "Settings", "eAB_SystemfehlerS", getValue( eAB_SystemfehlerS ), profileFile );
    writeProfileInt( "Settings", "eAB_DiagnoseS", getValue( eAB_DiagnoseS ), profileFile );
    writeProfileInt( "Settings", "eAB_StellgliedtestS", getValue( eAB_StellgliedtestS ), profileFile );
    writeProfileInt( "Settings", "eAB_Erh_Auf_VBS", getValue( eAB_Erh_Auf_VBS ), profileFile );
    writeProfileInt( "Settings", "eAB_Gurtwarn_VFS", getValue( eAB_Gurtwarn_VFS ), profileFile );
    writeProfileInt( "Settings", "eAB_Gurtwarn_VBS", getValue( eAB_Gurtwarn_VBS ), profileFile );
    writeProfileInt( "Settings", "eAB_Anzeige_FussgS", getValue( eAB_Anzeige_FussgS ), profileFile );
    writeProfileInt( "Settings", "eAB_Texte_AKSS", getValue( eAB_Texte_AKSS ), profileFile );
    writeProfileInt( "Settings", "eAB_PAO_Leuchte_AnfS", getValue( eAB_PAO_Leuchte_AnfS ), profileFile );
    writeProfileInt( "Settings", "eAB_MKB_gueltigS", getValue( eAB_MKB_gueltigS ), profileFile );
    writeProfileInt( "Settings", "eAB_MKB_AnforderungS", getValue( eAB_MKB_AnforderungS ), profileFile );
    writeProfileInt( "Settings", "eAB_VersorgungsspannungS", getValue( eAB_VersorgungsspannungS ), profileFile );
    writeProfileInt( "Settings", "eAB_Belegung_VBS", getValue( eAB_Belegung_VBS ), profileFile );
    writeProfileInt( "Settings", "eAB_Gurtschloss_FAS", getValue( eAB_Gurtschloss_FAS ), profileFile );
    writeProfileInt( "Settings", "eAB_Gurtschloss_BFS", getValue( eAB_Gurtschloss_BFS ), profileFile );
    writeProfileInt( "Settings", "eAB_Gurtschloss_Reihe2_FAS", getValue( eAB_Gurtschloss_Reihe2_FAS ), profileFile );
    writeProfileInt( "Settings", "eAB_Gurtschloss_Reihe2_MIS", getValue( eAB_Gurtschloss_Reihe2_MIS ), profileFile );
    writeProfileInt( "Settings", "eAB_Gurtschloss_Reihe2_BFS", getValue( eAB_Gurtschloss_Reihe2_BFS ), profileFile );
    writeProfileInt( "Settings", "eAB_Gurtschloss_Reihe3_FAS", getValue( eAB_Gurtschloss_Reihe3_FAS ), profileFile );
    writeProfileInt( "Settings", "eAB_Gurtschloss_Reihe3_MIS", getValue( eAB_Gurtschloss_Reihe3_MIS ), profileFile );
    writeProfileInt( "Settings", "eAB_Gurtschloss_Reihe3_BFS", getValue( eAB_Gurtschloss_Reihe3_BFS ), profileFile );
    writeProfileInt( "Settings", "eAB_Sitzpos_Sens_FAS", getValue( eAB_Sitzpos_Sens_FAS ), profileFile );
    writeProfileInt( "Settings", "eAB_Sitzpos_Sens_BFS", getValue( eAB_Sitzpos_Sens_BFS ), profileFile );
    writeProfileInt( "Settings", "eBEM_02_AbschaltstufenS", getValue( eBEM_02_AbschaltstufenS ), profileFile );
    writeProfileFloat( "Settings", "eBEM_STH_ZielzeitS", getValue( eBEM_STH_ZielzeitS ), profileFile );
    writeProfileInt( "Settings", "eBEM_MMI_VorwarnungS", getValue( eBEM_MMI_VorwarnungS ), profileFile );
    writeProfileFloat( "Settings", "eBEM_HL_KontingentierungS", getValue( eBEM_HL_KontingentierungS ), profileFile );
    writeProfileInt( "Settings", "eBEM_GeneratordiagnoseS", getValue( eBEM_GeneratordiagnoseS ), profileFile );
    writeProfileInt( "Settings", "eBEM_Red_InnengeblaeseS", getValue( eBEM_Red_InnengeblaeseS ), profileFile );
    writeProfileInt( "Settings", "eBEM_STH_EinschaltverbotS", getValue( eBEM_STH_EinschaltverbotS ), profileFile );
    writeProfileInt( "Settings", "eBEM_HL_Regelung_StatusS", getValue( eBEM_HL_Regelung_StatusS ), profileFile );
    writeProfileFloat( "Settings", "eBEM_LadezustandS", getValue( eBEM_LadezustandS ), profileFile );
    writeProfileInt( "Settings", "eBEM_BatteriediagnoseS", getValue( eBEM_BatteriediagnoseS ), profileFile );
    writeProfileFloat( "Settings", "eBEM_DFMS", getValue( eBEM_DFMS ), profileFile );
    writeProfileInt( "Settings", "eBEM_REK_aktivS", getValue( eBEM_REK_aktivS ), profileFile );
    writeProfileInt( "Settings", "eBEM_EMLIN_ungueltigS", getValue( eBEM_EMLIN_ungueltigS ), profileFile );
    writeProfileInt( "Settings", "eBEM_Batt_AbS", getValue( eBEM_Batt_AbS ), profileFile );
    writeProfileFloat( "Settings", "eBEM_UBDMS", getValue( eBEM_UBDMS ), profileFile );
    writeProfileFloat( "Settings", "eBEM_UGenSollS", getValue( eBEM_UGenSollS ), profileFile );
    writeProfileInt( "Settings", "eCHA_Eco_Charisma_LEDS", getValue( eCHA_Eco_Charisma_LEDS ), profileFile );
    writeProfileInt( "Settings", "eCHA_Ziel_FahrPr_AMBS", getValue( eCHA_Ziel_FahrPr_AMBS ), profileFile );
    writeProfileInt( "Settings", "eCHA_Ziel_FahrPr_IVBS", getValue( eCHA_Ziel_FahrPr_IVBS ), profileFile );
    writeProfileInt( "Settings", "eCHA_Kombi_TexteS", getValue( eCHA_Kombi_TexteS ), profileFile );
    writeProfileInt( "Settings", "eCHA_Ziel_FahrPr_KLS", getValue( eCHA_Ziel_FahrPr_KLS ), profileFile );
    writeProfileInt( "Settings", "eCHA_Ziel_FahrPr_NAV_RouteS", getValue( eCHA_Ziel_FahrPr_NAV_RouteS ), profileFile );
    writeProfileInt( "Settings", "eCHA_Ziel_FahrPr_NAV_SegelS", getValue( eCHA_Ziel_FahrPr_NAV_SegelS ), profileFile );
    writeProfileInt( "Settings", "eCHA_Ziel_FahrPr_03_01S", getValue( eCHA_Ziel_FahrPr_03_01S ), profileFile );
    writeProfileInt( "Settings", "eCHA_Ziel_FahrPr_03_02S", getValue( eCHA_Ziel_FahrPr_03_02S ), profileFile );
    writeProfileInt( "Settings", "eDR_SystemstatusS", getValue( eDR_SystemstatusS ), profileFile );
    writeProfileInt( "Settings", "eLF_TexteS", getValue( eLF_TexteS ), profileFile );
    writeProfileInt( "Settings", "eDR_TasterS", getValue( eDR_TasterS ), profileFile );
    writeProfileInt( "Settings", "eDR_Gelbe_WarnlampeS", getValue( eDR_Gelbe_WarnlampeS ), profileFile );
    writeProfileInt( "Settings", "eDR_Daempferreg_TexteS", getValue( eDR_Daempferreg_TexteS ), profileFile );
    writeProfileInt( "Settings", "eDGN_VerlernzaehlerS", getValue( eDGN_VerlernzaehlerS ), profileFile );
    writeProfileInt( "Settings", "eKBI_Kilometerstand_1S", getValue( eKBI_Kilometerstand_1S ), profileFile );
    writeProfileInt( "Settings", "eUH_Jahr_1S", getValue( eUH_Jahr_1S ), profileFile );
    writeProfileInt( "Settings", "eUH_Monat_1S", getValue( eUH_Monat_1S ), profileFile );
    writeProfileInt( "Settings", "eUH_Tag_1S", getValue( eUH_Tag_1S ), profileFile );
    writeProfileInt( "Settings", "eUH_Stunde_1S", getValue( eUH_Stunde_1S ), profileFile );
    writeProfileInt( "Settings", "eUH_Minute_1S", getValue( eUH_Minute_1S ), profileFile );
    writeProfileInt( "Settings", "eUH_Sekunde_1S", getValue( eUH_Sekunde_1S ), profileFile );
    writeProfileInt( "Settings", "eKombi_02_altS", getValue( eKombi_02_altS ), profileFile );
    writeProfileInt( "Settings", "eUhrzeit_01_altS", getValue( eUhrzeit_01_altS ), profileFile );
    writeProfileInt( "Settings", "eEPB_Fehlerlampe_GelbS", getValue( eEPB_Fehlerlampe_GelbS ), profileFile );
    writeProfileInt( "Settings", "eEPB_Fehlerlampe_BKLS", getValue( eEPB_Fehlerlampe_BKLS ), profileFile );
    writeProfileInt( "Settings", "eEPB_FunktionslampeS", getValue( eEPB_FunktionslampeS ), profileFile );
    writeProfileInt( "Settings", "eEPB_TexteS", getValue( eEPB_TexteS ), profileFile );
    writeProfileInt( "Settings", "eEPB_AkustikS", getValue( eEPB_AkustikS ), profileFile );
    writeProfileInt( "Settings", "eEPB_AutoholdlampeS", getValue( eEPB_AutoholdlampeS ), profileFile );
    writeProfileInt( "Settings", "eEPB_Bremsbelag_WarnS", getValue( eEPB_Bremsbelag_WarnS ), profileFile );
    writeProfileInt( "Settings", "eESP_QBit_GierrateS", getValue( eESP_QBit_GierrateS ), profileFile );
    writeProfileInt( "Settings", "eESP_QBit_LaengsbeschlS", getValue( eESP_QBit_LaengsbeschlS ), profileFile );
    writeProfileInt( "Settings", "eESP_QBit_QuerbS", getValue( eESP_QBit_QuerbS ), profileFile );
    writeProfileFloat( "Settings", "eESP_QuerbeschleunigungS", getValue( eESP_QuerbeschleunigungS ), profileFile );
    writeProfileFloat( "Settings", "eESP_LaengsbeschlS", getValue( eESP_LaengsbeschlS ), profileFile );
    writeProfileFloat( "Settings", "eESP_GierrateS", getValue( eESP_GierrateS ), profileFile );
    writeProfileInt( "Settings", "eESP_VZ_GierrateS", getValue( eESP_VZ_GierrateS ), profileFile );
    writeProfileInt( "Settings", "eESP_NotbremsanzeigeS", getValue( eESP_NotbremsanzeigeS ), profileFile );
    writeProfileInt( "Settings", "eESP_SpannungsAnfS", getValue( eESP_SpannungsAnfS ), profileFile );
    writeProfileInt( "Settings", "eESP_PLA_AbbruchS", getValue( eESP_PLA_AbbruchS ), profileFile );
    writeProfileInt( "Settings", "eESP_Status_ESP_PLAS", getValue( eESP_Status_ESP_PLAS ), profileFile );
    writeProfileInt( "Settings", "eBR_SystemartS", getValue( eBR_SystemartS ), profileFile );
    writeProfileInt( "Settings", "eESP_ZaehnezahlS", getValue( eESP_ZaehnezahlS ), profileFile );
    writeProfileInt( "Settings", "eESP_24_BZS", getValue( eESP_24_BZS ), profileFile );
    writeProfileInt( "Settings", "eESP_LampeS", getValue( eESP_LampeS ), profileFile );
    writeProfileInt( "Settings", "eABS_LampeS", getValue( eABS_LampeS ), profileFile );
    writeProfileInt( "Settings", "eBK_Lampe_02S", getValue( eBK_Lampe_02S ), profileFile );
    writeProfileFloat( "Settings", "eESP_m_RaddrehzS", getValue( eESP_m_RaddrehzS ), profileFile );
    writeProfileInt( "Settings", "eESP_Textanzeigen_03S", getValue( eESP_Textanzeigen_03S ), profileFile );
    writeProfileInt( "Settings", "eESP_MeldungenS", getValue( eESP_MeldungenS ), profileFile );
    writeProfileInt( "Settings", "KCAN_ESP_Wegimp_VA", getValue( KCAN_ESP_Wegimp_VA ), profileFile );
    writeProfileInt( "Settings", "eESP_Fehlerstatus_WegimpS", getValue( eESP_Fehlerstatus_WegimpS ), profileFile );
    writeProfileInt( "Settings", "eESP_Wegimp_UeberlaufS", getValue( eESP_Wegimp_UeberlaufS ), profileFile );
    writeProfileInt( "Settings", "eESP_QBit_Wegimp_VAS", getValue( eESP_QBit_Wegimp_VAS ), profileFile );
    writeProfileInt( "Settings", "eESP_HDC_FktLampeS", getValue( eESP_HDC_FktLampeS ), profileFile );
    writeProfileInt( "Settings", "eESP_Off_LampeS", getValue( eESP_Off_LampeS ), profileFile );
    writeProfileFloat( "Settings", "eESP_HDC_RegelgeschwS", getValue( eESP_HDC_RegelgeschwS ), profileFile );
    writeProfileInt( "Settings", "eESP_BKV_WarnungS", getValue( eESP_BKV_WarnungS ), profileFile );
    writeProfileInt( "Settings", "eMotor_12_altS", getValue( eMotor_12_altS ), profileFile );
    writeProfileInt( "Settings", "eGW_73_va_11S", getValue( eGW_73_va_11S ), profileFile );
    writeProfileInt( "Settings", "eGetriebe_11_altS", getValue( eGetriebe_11_altS ), profileFile );
    writeProfileInt( "Settings", "eGetriebe_13_altS", getValue( eGetriebe_13_altS ), profileFile );
    writeProfileInt( "Settings", "eGW_73_va_14S", getValue( eGW_73_va_14S ), profileFile );
    writeProfileInt( "Settings", "eGW_73_va_16S", getValue( eGW_73_va_16S ), profileFile );
    writeProfileInt( "Settings", "eGW_73_va_17S", getValue( eGW_73_va_17S ), profileFile );
    writeProfileInt( "Settings", "eMO_QBit_Drehzahl_01S", getValue( eMO_QBit_Drehzahl_01S ), profileFile );
    writeProfileInt( "Settings", "eMKE_TexteS", getValue( eMKE_TexteS ), profileFile );
    writeProfileFloat( "Settings", "eMO_Drehzahl_01S", getValue( eMO_Drehzahl_01S ), profileFile );
    writeProfileInt( "Settings", "eGE_FahrstufeS", getValue( eGE_FahrstufeS ), profileFile );
    writeProfileInt( "Settings", "eGE_NotlaufS", getValue( eGE_NotlaufS ), profileFile );
    writeProfileInt( "Settings", "eGE_ZielgangS", getValue( eGE_ZielgangS ), profileFile );
    writeProfileInt( "Settings", "eWFS_GSG_RNDS", getValue( eWFS_GSG_RNDS ), profileFile );
    writeProfileInt( "Settings", "eWFS_GSG_CRCS", getValue( eWFS_GSG_CRCS ), profileFile );
    writeProfileInt( "Settings", "eISO_ALL_01_Req_DataS", getValue( eISO_ALL_01_Req_DataS ), profileFile );
    writeProfileInt( "Settings", "eISO_ALL_01_Req_Data_2S", getValue( eISO_ALL_01_Req_Data_2S ), profileFile );
    writeProfileInt( "Settings", "eISO_Kombi_Req_DataS", getValue( eISO_Kombi_Req_DataS ), profileFile );
    writeProfileInt( "Settings", "eKS_Kombi_Req_DataS", getValue( eKS_Kombi_Req_DataS ), profileFile );
    writeProfileInt( "Settings", "eLDW_GongS", getValue( eLDW_GongS ), profileFile );
    writeProfileInt( "Settings", "eLDW_TexteS", getValue( eLDW_TexteS ), profileFile );
    writeProfileInt( "Settings", "eLDW_Seite_DLCTLCS", getValue( eLDW_Seite_DLCTLCS ), profileFile );
    writeProfileInt( "Settings", "eLDW_Lernmodus_seitenabhaengigS", getValue( eLDW_Lernmodus_seitenabhaengigS ), profileFile );
    writeProfileFloat( "Settings", "eLDW_DLCS", getValue( eLDW_DLCS ), profileFile );
    writeProfileFloat( "Settings", "eLDW_TLCS", getValue( eLDW_TLCS ), profileFile );
    writeProfileInt( "Settings", "eLDW_Status_LED_gelbS", getValue( eLDW_Status_LED_gelbS ), profileFile );
    writeProfileInt( "Settings", "eLDW_Status_LED_gruenS", getValue( eLDW_Status_LED_gruenS ), profileFile );
    writeProfileInt( "Settings", "eEPS_01_BZS", getValue( eEPS_01_BZS ), profileFile );
    writeProfileInt( "Settings", "eEPS_AkustiksignalS", getValue( eEPS_AkustiksignalS ), profileFile );
    writeProfileInt( "Settings", "eEPS_FehlerlampeS", getValue( eEPS_FehlerlampeS ), profileFile );
    writeProfileInt( "Settings", "eEPS_WarnungenS", getValue( eEPS_WarnungenS ), profileFile );
    writeProfileInt( "Settings", "eEPS_PLA_AbbruchS", getValue( eEPS_PLA_AbbruchS ), profileFile );
    writeProfileInt( "Settings", "eEPS_PLA_FehlerS", getValue( eEPS_PLA_FehlerS ), profileFile );
    writeProfileInt( "Settings", "eEPS_PLA_StatusS", getValue( eEPS_PLA_StatusS ), profileFile );
    writeProfileInt( "Settings", "eEPS_Charisma_FahrPrS", getValue( eEPS_Charisma_FahrPrS ), profileFile );
    writeProfileInt( "Settings", "eEPS_Charisma_StatusS", getValue( eEPS_Charisma_StatusS ), profileFile );
    writeProfileInt( "Settings", "eEPS_LenkerpositionS", getValue( eEPS_LenkerpositionS ), profileFile );
    writeProfileInt( "Settings", "eEPS_Anf_KLS", getValue( eEPS_Anf_KLS ), profileFile );
    writeProfileInt( "Settings", "eAFS_Abbiegelicht_li_AnfS", getValue( eAFS_Abbiegelicht_li_AnfS ), profileFile );
    writeProfileInt( "Settings", "eAFS_Abbiegelicht_re_AnfS", getValue( eAFS_Abbiegelicht_re_AnfS ), profileFile );
    writeProfileInt( "Settings", "eAFS_Abbiegelicht_Dimm_AnfS", getValue( eAFS_Abbiegelicht_Dimm_AnfS ), profileFile );
    writeProfileInt( "Settings", "eAFS_Verfuegbarkeit_GLWS", getValue( eAFS_Verfuegbarkeit_GLWS ), profileFile );
    writeProfileInt( "Settings", "eAFS_Status_adaptive_LVS", getValue( eAFS_Status_adaptive_LVS ), profileFile );
    writeProfileInt( "Settings", "eAFS_Fernlicht_li_defektS", getValue( eAFS_Fernlicht_li_defektS ), profileFile );
    writeProfileInt( "Settings", "eAFS_Fernlicht_re_defektS", getValue( eAFS_Fernlicht_re_defektS ), profileFile );
    writeProfileInt( "Settings", "eAFS_Fernlicht_StatusS", getValue( eAFS_Fernlicht_StatusS ), profileFile );
    writeProfileInt( "Settings", "eLWR_AFS_01_BZS", getValue( eLWR_AFS_01_BZS ), profileFile );
    writeProfileInt( "Settings", "eAFS_LampeS", getValue( eAFS_LampeS ), profileFile );
    writeProfileInt( "Settings", "eLWR_LampeS", getValue( eLWR_LampeS ), profileFile );
    writeProfileInt( "Settings", "eAFS_FehlertextS", getValue( eAFS_FehlertextS ), profileFile );
    writeProfileInt( "Settings", "eAFS_LED_BlinkmodeS", getValue( eAFS_LED_BlinkmodeS ), profileFile );
    writeProfileInt( "Settings", "eLWR_Touristenmodus_aktivS", getValue( eLWR_Touristenmodus_aktivS ), profileFile );
    writeProfileInt( "Settings", "eAFS_Charisma_FahrPrS", getValue( eAFS_Charisma_FahrPrS ), profileFile );
    writeProfileInt( "Settings", "eAFS_Charisma_StatusS", getValue( eAFS_Charisma_StatusS ), profileFile );
    writeProfileInt( "Settings", "eAFS_Charisma_UmschaltungS", getValue( eAFS_Charisma_UmschaltungS ), profileFile );
    writeProfileInt( "Settings", "eAFS_AllwetterlichtS", getValue( eAFS_AllwetterlichtS ), profileFile );
    writeProfileInt( "Settings", "eLWR_Touristenmodus_verbautS", getValue( eLWR_Touristenmodus_verbautS ), profileFile );
    writeProfileInt( "Settings", "eAFS_adaptive_LV_verbautS", getValue( eAFS_adaptive_LV_verbautS ), profileFile );


 //motor_gas01
    writeProfileInt( "Settings", "eMO_CNG_LPG", getValue( eMO_CNG_LPG ), profileFile );
    writeProfileInt( "Settings", "eMO_AnzeigeGasbetrieb", getValue( eMO_AnzeigeGasbetrieb ), profileFile );
    writeProfileInt( "Settings", "eMO_akt_Betrieb", getValue( eMO_akt_Betrieb ), profileFile );
    writeProfileInt( "Settings", "eMO_Erdgasqualitaet", getValue( eMO_Erdgasqualitaet ), profileFile );
    writeProfileFloat( "Settings", "eMO_Verbrauchsaequivalent", getValue( eMO_Verbrauchsaequivalent ), profileFile );
    writeProfileFloat( "Settings", "eMO_Fuellungsgrad_CNG", getValue( eMO_Fuellungsgrad_CNG ), profileFile );
    writeProfileInt( "Settings", "eMO_CNG_Ueberlauf_m0", getValue( eMO_CNG_Ueberlauf_m0 ), profileFile );
    writeProfileFloat( "Settings", "eMO_Tankmasse_CNG", getValue( eMO_Tankmasse_CNG ), profileFile );

  //motor gas consumption
    writeProfileInt( "Settings", "eMO_Verbrauch_CNG", getValue( eMO_Verbrauch_CNG ), profileFile );
    writeProfileFloat( "Settings", "eGasConsumption", getValue( eGasConsumption ), profileFile );

  //ARA_Status_01

  //ESP_21
    writeProfileInt( "Settings", "eESP_21_BZS", getValue( eESP_21_BZS ), profileFile );
    writeProfileInt( "Settings", "eCrcESP_21", getValue( eCrcESP_21 ), profileFile );
    writeProfileInt( "Settings", "eESP_v_Signal", getValue( eESP_v_Signal ), profileFile );
    writeProfileInt( "Settings", "eESP_Anhaltevorgang_ACC_aktiv", getValue( eESP_Anhaltevorgang_ACC_aktiv ), profileFile );

    writeProfileInt( "Settings", "eMO_Tankbereitschaft_Status", getValue( eMO_Tankbereitschaft_Status ), profileFile );

    writeProfileInt( "Settings", "eHRE_Anzeigetexte", getValue( eHRE_Anzeigetexte ), profileFile );

    writeProfileInt( "Settings", "eMO_RedFahrleistung_Lampe", getValue( eMO_RedFahrleistung_Lampe ), profileFile );

    writeProfileInt( "Settings", "eRW_Reichweite_Einheit_Anzeige", getValue( eRW_Reichweite_Einheit_Anzeige ), profileFile );
    writeProfileInt( "Settings", "eRW_Gesamt_Reichweite_Anzeige", getValue( eRW_Gesamt_Reichweite_Anzeige ), profileFile );
    writeProfileInt( "Settings", "eRW_Gesamt_ReichweiteS", getValue( eRW_Gesamt_ReichweiteS ), profileFile );
    writeProfileInt( "Settings", "eRW_Primaer_Reichweite_Anzeige", getValue( eRW_Primaer_Reichweite_Anzeige ), profileFile );
    writeProfileInt( "Settings", "eRW_Sekundaer_Reichweite_Anzeige", getValue( eRW_Sekundaer_Reichweite_Anzeige ), profileFile );

  //PLA_Status_02
    writeProfileInt( "Settings", "ePLA_Anf_Akustik", getValue( ePLA_Anf_Akustik ), profileFile );
    writeProfileInt( "Settings", "ePLA_Anf_Anzeige_Schwellpfeil", getValue( ePLA_Anf_Anzeige_Schwellpfeil ), profileFile );
    writeProfileInt( "Settings", "ePLA_Anf_Anzeige_Bremsfuss", getValue( ePLA_Anf_Anzeige_Bremsfuss ), profileFile );
    writeProfileInt( "Settings", "ePLA_Anf_Anzeigemodus", getValue( ePLA_Anf_Anzeigemodus ), profileFile );
    writeProfileInt( "Settings", "ePLA_Anf_Meldungen", getValue( ePLA_Anf_Meldungen ), profileFile );
    writeProfileInt( "Settings", "ePLA_Status_Aktive_Seite", getValue( ePLA_Status_Aktive_SeiteS ), profileFile );
    writeProfileInt( "Settings", "ePLA_Anf_Anzeige_Mini", getValue( ePLA_Anf_Anzeige_MiniS ), profileFile );
    writeProfileInt( "Settings", "ePLA_Anzahl_Segmente_Schwellpfeil", getValue( ePLA_Anzahl_Segmente_SchwellpfeilS ), profileFile );
    writeProfileInt( "Settings", "ePLA_Status_Funktion", getValue( ePLA_Status_Funktion ), profileFile );
    writeProfileInt( "Settings", "ePLA_Status_beenden_Mini", getValue( ePLA_Status_beenden_Mini ), profileFile );
    writeProfileInt( "Settings", "ePLA_Status_QP_Rueckw_Mini", getValue( ePLA_Status_QP_Rueckw_Mini ), profileFile );
    writeProfileInt( "Settings", "ePLA_Status_QP_Vorw_Mini", getValue( ePLA_Status_QP_Vorw_Mini ), profileFile );
    writeProfileInt( "Settings", "ePLA_Fortschritt_bis_ZugendeS", getValue( ePLA_Fortschritt_bis_ZugendeS ), profileFile );
    writeProfileInt( "Settings", "ePLA_Abstand_zur_ParklueckeS", getValue( ePLA_Abstand_zur_ParklueckeS ), profileFile );

    //GVJ-4663
    writeProfileInt( "Settings", "eSendBEM_06", getValue( eSendBEM_06 ), profileFile );
    writeProfileInt( "Settings", "eTBEM_06", getValue( eTBEM_06 ), profileFile );
    writeProfileInt( "Settings", "eTOTBEM_06", getValue( eTOTBEM_06 ), profileFile );
    writeProfileInt( "Settings", "eDlcBEM_06", getValue( eDlcBEM_06 ), profileFile );
    writeProfileInt( "Settings", "eCrcBEM_06", getValue( eCrcBEM_06 ), profileFile );
    writeProfileInt( "Settings", "eBZBEM_06", getValue( eBZBEM_06 ), profileFile );
    writeProfileInt( "Settings", "eBZStepBEM_06", getValue( eBZStepBEM_06 ), profileFile );

    writeProfileInt( "Settings", "eACC_Status_GRA_ModusS", getValue( eACC_Status_GRA_ModusS ), profileFile );
    writeProfileInt( "Settings", "eACC_FoD_StatusS", getValue( eACC_FoD_StatusS ), profileFile );
    writeProfileInt( "Settings", "eAB_Gurtwarn_Reihe4_FAS", getValue( eAB_Gurtwarn_Reihe4_FAS ), profileFile );
    writeProfileInt( "Settings", "eAB_Gurtwarn_Reihe4_BFS", getValue( eAB_Gurtwarn_Reihe4_BFS ), profileFile );
    writeProfileInt( "Settings", "eAB_Gurtwarn_Reihe4_MIS", getValue( eAB_Gurtwarn_Reihe4_MIS ), profileFile );
    writeProfileInt( "Settings", "eAWV_AW_AbstandS", getValue( eAWV_AW_AbstandS ), profileFile );
    writeProfileFloat( "Settings", "eAWV_AW_ZeitlueckeS", getValue( eAWV_AW_ZeitlueckeS ), profileFile );
    writeProfileInt( "Settings", "eAWV_AW_TexteS", getValue( eAWV_AW_TexteS ), profileFile );
    writeProfileInt( "Settings", "eAWV_AW_Texte_ZusatzanzeigeS", getValue( eAWV_AW_Texte_ZusatzanzeigeS ), profileFile );
    writeProfileInt( "Settings", "eEPB_03_CRCS", getValue( eEPB_03_CRCS ), profileFile );
    writeProfileInt( "Settings", "eEPB_03_BZS", getValue( eEPB_03_BZS ), profileFile );
    writeProfileInt( "Settings", "eHVLM_Restladezeit_HV_Bat_02S", getValue( eHVLM_Restladezeit_HV_Bat_02S ), profileFile );
    writeProfileInt( "Settings", "eHVLM_AnzeigetexteS", getValue( eHVLM_AnzeigetexteS ), profileFile );
    writeProfileInt( "Settings", "eHVLM_Bat_laden_aktivS", getValue( eHVLM_Bat_laden_aktivS ), profileFile );
    writeProfileInt( "Settings", "eTSK_Einheit_vMax_FahrerInfoS", getValue( eTSK_Einheit_vMax_FahrerInfoS ), profileFile );
    writeProfileInt( "Settings", "eTSK_Status_vMax_FahrerInfoS", getValue( eTSK_Status_vMax_FahrerInfoS ), profileFile );
    writeProfileInt( "Settings", "eTSK_vMax_FahrerInfoS", getValue( eTSK_vMax_FahrerInfoS ), profileFile );
    writeProfileInt( "Settings", "eRKA_FMVSS138_LampeS", getValue( eRKA_FMVSS138_LampeS ), profileFile );
    writeProfileInt( "Settings", "eRKA_FMVSS138_MILS", getValue( eRKA_FMVSS138_MILS ), profileFile );
    writeProfileInt( "Settings", "eSI_P_Mode_gueltigS", getValue( eSI_P_Mode_gueltigS ), profileFile );
    writeProfileInt( "Settings", "eSI_P_ModeS", getValue( eSI_P_ModeS ), profileFile );
    writeProfileInt( "Settings", "eMOD_Request_ServiceKeyS", getValue( eMOD_Request_ServiceKeyS ), profileFile );
    writeProfileInt( "Settings", "eBEM_06_CRCS", getValue( eBEM_06_CRCS ), profileFile );
    writeProfileInt( "Settings", "eBEM_06_BZS", getValue( eBEM_06_BZS ), profileFile );
    writeProfileInt( "Settings", "eNVEM_BordnetzdiagnoseS", getValue( eNVEM_BordnetzdiagnoseS ), profileFile );
    writeProfileInt( "Settings", "eFoD_Anz_FunktionsabschaltungS", getValue( eFoD_Anz_FunktionsabschaltungS ), profileFile );
    writeProfileInt( "Settings", "eGetriebe_14_altS", getValue( eGetriebe_14_altS ), profileFile );
    writeProfileInt( "Settings", "eGE_SumpftemperaturS", getValue( eGE_SumpftemperaturS ), profileFile );
    writeProfileFloat( "Settings", "eGNSS_Ortung_2D_Geschw_ue_GrundS", getValue( eGNSS_Ortung_2D_Geschw_ue_GrundS ), profileFile );
    writeProfileFloat( "Settings", "eGNSS_Ortung_Guete_GeschwindigkS", getValue( eGNSS_Ortung_Guete_GeschwindigkS ), profileFile );
    writeProfileInt( "Settings", "eHVK_Gesamtst_SpgfreiheitS", getValue( eHVK_Gesamtst_SpgfreiheitS ), profileFile );
    writeProfileInt( "Settings", "eLoGeWa_C2C_Event_EinheitS", getValue( eLoGeWa_C2C_Event_EinheitS ), profileFile );
    writeProfileInt( "Settings", "eLoGeWa_C2C_Event_RichtungS", getValue( eLoGeWa_C2C_Event_RichtungS ), profileFile );
    writeProfileInt( "Settings", "eLoGeWa_C2C_Event_StatusS", getValue( eLoGeWa_C2C_Event_StatusS ), profileFile );
    writeProfileInt( "Settings", "eLoGeWa_C2C_Event_WarnungS", getValue( eLoGeWa_C2C_Event_WarnungS ), profileFile );
    writeProfileFloat( "Settings", "eLoGeWa_C2C_Event_EntfernungS", getValue( eLoGeWa_C2C_Event_EntfernungS ), profileFile );
    writeProfileInt( "Settings", "eMVK_MV_Netz_WarnungenS", getValue( eMVK_MV_Netz_WarnungenS ), profileFile );
    writeProfileInt( "Settings", "ePH_VerschmutzungsmeldungS", getValue( ePH_VerschmutzungsmeldungS ), profileFile );
    writeProfileInt( "Settings", "ePH_WAH_MeldungS", getValue( ePH_WAH_MeldungS ), profileFile );
    writeProfileInt( "Settings", "eMMI_StartupAnimationS", getValue( eMMI_StartupAnimationS ), profileFile );
    writeProfileInt( "Settings", "eMVK_01_BZS", getValue( eMVK_01_BZS ), profileFile );
}

void saveSettings2( char profileFile[] )
{
    writeProfileInt( "Settings", "eBFS_MMB_storageS", getValue( eBFS_MMB_storageS ), profileFile );
    writeProfileInt( "Settings", "eBFS_MMB_tippS", getValue( eBFS_MMB_tippS ), profileFile );
    writeProfileInt( "Settings", "eBFS_MMB_tastS", getValue( eBFS_MMB_tastS ), profileFile );
    writeProfileInt( "Settings", "eBFS_MMB_store_LED_onS", getValue( eBFS_MMB_store_LED_onS ), profileFile );
    writeProfileInt( "Settings", "eBFS_MMB_storage_beepS", getValue( eBFS_MMB_storage_beepS ), profileFile );
    writeProfileInt( "Settings", "eBFS_MMB_storeS", getValue( eBFS_MMB_storeS ), profileFile );
    writeProfileInt( "Settings", "eBFS_MMB_glob_stopS", getValue( eBFS_MMB_glob_stopS ), profileFile );
    writeProfileInt( "Settings", "eBFS_SIH_StatusS", getValue( eBFS_SIH_StatusS ), profileFile );
    writeProfileInt( "Settings", "eBFS_SLR_ReglerstatusS", getValue( eBFS_SLR_ReglerstatusS ), profileFile );
    writeProfileInt( "Settings", "eFS_Fond_Bed_enableS", getValue( eFS_Fond_Bed_enableS ), profileFile );
    writeProfileInt( "Settings", "eFS_Lehne_nicht_verriegeltS", getValue( eFS_Lehne_nicht_verriegeltS ), profileFile );
    writeProfileInt( "Settings", "eFS_Spezialposition_anfahrenS", getValue( eFS_Spezialposition_anfahrenS ), profileFile );
    writeProfileInt( "Settings", "eFS_BFS_Sitzsym_AnfahrtS", getValue( eFS_BFS_Sitzsym_AnfahrtS ), profileFile );
    writeProfileInt( "Settings", "eFS_Sitzfahrt_aktivS", getValue( eFS_Sitzfahrt_aktivS ), profileFile );
    writeProfileInt( "Settings", "eFS_SLV_aktivS", getValue( eFS_SLV_aktivS ), profileFile );
    writeProfileInt( "Settings", "eFS_SHV_aktivS", getValue( eFS_SHV_aktivS ), profileFile );
    writeProfileInt( "Settings", "eFS_LNV_aktivS", getValue( eFS_LNV_aktivS ), profileFile );
    writeProfileInt( "Settings", "eFS_SNV_aktivS", getValue( eFS_SNV_aktivS ), profileFile );
    writeProfileInt( "Settings", "eFS_KSV_aktivS", getValue( eFS_KSV_aktivS ), profileFile );
    writeProfileInt( "Settings", "eFS_LKV_aktivS", getValue( eFS_LKV_aktivS ), profileFile );
    writeProfileInt( "Settings", "eFS_STV_aktivS", getValue( eFS_STV_aktivS ), profileFile );
    writeProfileInt( "Settings", "eFS_LHV_aktivS", getValue( eFS_LHV_aktivS ), profileFile );
    writeProfileInt( "Settings", "eFS_LWV_aktivS", getValue( eFS_LWV_aktivS ), profileFile );
    writeProfileInt( "Settings", "eFS_GHV_aktivS", getValue( eFS_GHV_aktivS ), profileFile );
    writeProfileInt( "Settings", "eFS_BFS_KSS_AnfahrtS", getValue( eFS_BFS_KSS_AnfahrtS ), profileFile );
    writeProfileInt( "Settings", "eFS_MMB_lokal_StopS", getValue( eFS_MMB_lokal_StopS ), profileFile );
    writeProfileInt( "Settings", "eFS_MMB_storageS", getValue( eFS_MMB_storageS ), profileFile );
    writeProfileInt( "Settings", "eFS_MMB_tippS", getValue( eFS_MMB_tippS ), profileFile );
    writeProfileInt( "Settings", "eFS_MMB_tastS", getValue( eFS_MMB_tastS ), profileFile );
    writeProfileInt( "Settings", "eFS_MMB_store_LED_onS", getValue( eFS_MMB_store_LED_onS ), profileFile );
    writeProfileInt( "Settings", "eFS_MMB_storage_beepS", getValue( eFS_MMB_storage_beepS ), profileFile );
    writeProfileInt( "Settings", "eFS_MMB_storeS", getValue( eFS_MMB_storeS ), profileFile );
    writeProfileInt( "Settings", "eFS_MMB_glob_stopS", getValue( eFS_MMB_glob_stopS ), profileFile );
    writeProfileInt( "Settings", "eFS_EE_Fond_FS_enableS", getValue( eFS_EE_Fond_FS_enableS ), profileFile );
    writeProfileInt( "Settings", "eFS_EE_Fond_BFS_enableS", getValue( eFS_EE_Fond_BFS_enableS ), profileFile );
    writeProfileInt( "Settings", "eFS_BFS_Fond_Verst_enableS", getValue( eFS_BFS_Fond_Verst_enableS ), profileFile );
    writeProfileInt( "Settings", "eFS_EE_BFS_enableS", getValue( eFS_EE_BFS_enableS ), profileFile );
    writeProfileInt( "Settings", "eFS_SIH_StatusS", getValue( eFS_SIH_StatusS ), profileFile );
    writeProfileInt( "Settings", "eFS_SLR_ReglerstatusS", getValue( eFS_SLR_ReglerstatusS ), profileFile );
    writeProfileInt( "Settings", "eMFG_01_BZS", getValue( eMFG_01_BZS ), profileFile );
    writeProfileInt( "Settings", "eMF_MotorweiterlaufS", getValue( eMF_MotorweiterlaufS ), profileFile );
    writeProfileInt( "Settings", "eMF_AbzugssperreS", getValue( eMF_AbzugssperreS ), profileFile );
    writeProfileInt( "Settings", "eMF_AnlassersperreS", getValue( eMF_AnlassersperreS ), profileFile );
    writeProfileInt( "Settings", "eMF_VarianteS", getValue( eMF_VarianteS ), profileFile );
    writeProfileInt( "Settings", "eMF_Schluessel_scanS", getValue( eMF_Schluessel_scanS ), profileFile );
    writeProfileInt( "Settings", "eMF_StartStopp_InfoS", getValue( eMF_StartStopp_InfoS ), profileFile );
    writeProfileInt( "Settings", "eMF_Fernbed_einS", getValue( eMF_Fernbed_einS ), profileFile );
    writeProfileInt( "Settings", "eMF_StandlichtS", getValue( eMF_StandlichtS ), profileFile );
    writeProfileInt( "Settings", "eMF_FahrlichtS", getValue( eMF_FahrlichtS ), profileFile );
    writeProfileInt( "Settings", "eMF_interm_FernlichtS", getValue( eMF_interm_FernlichtS ), profileFile );
    writeProfileInt( "Settings", "eMF_WarnblinkerS", getValue( eMF_WarnblinkerS ), profileFile );
    writeProfileInt( "Settings", "eMF_FussraumbelS", getValue( eMF_FussraumbelS ), profileFile );
    writeProfileInt( "Settings", "eMF_InnenraumbelS", getValue( eMF_InnenraumbelS ), profileFile );
    writeProfileInt( "Settings", "eMF_Innenraumbel_UnterdrueckS", getValue( eMF_Innenraumbel_UnterdrueckS ), profileFile );
    writeProfileInt( "Settings", "eMF_Blk_liS", getValue( eMF_Blk_liS ), profileFile );
    writeProfileInt( "Settings", "eMF_Blk_reS", getValue( eMF_Blk_reS ), profileFile );
    writeProfileInt( "Settings", "eMF_LichthupeS", getValue( eMF_LichthupeS ), profileFile );
    writeProfileInt( "Settings", "eMF_FernlichtS", getValue( eMF_FernlichtS ), profileFile );
    writeProfileInt( "Settings", "eMF_TippwischenS", getValue( eMF_TippwischenS ), profileFile );
    writeProfileInt( "Settings", "eMF_FrontintervallS", getValue( eMF_FrontintervallS ), profileFile );
    writeProfileInt( "Settings", "eMF_Wischerstufe_1S", getValue( eMF_Wischerstufe_1S ), profileFile );
    writeProfileInt( "Settings", "eMF_Wischerstufe_2S", getValue( eMF_Wischerstufe_2S ), profileFile );
    writeProfileInt( "Settings", "eMF_FrontwaschenS", getValue( eMF_FrontwaschenS ), profileFile );
    writeProfileInt( "Settings", "eMF_HeckintervallS", getValue( eMF_HeckintervallS ), profileFile );
    writeProfileInt( "Settings", "eMF_HeckwaschenS", getValue( eMF_HeckwaschenS ), profileFile );
    writeProfileInt( "Settings", "eMF_SummerS", getValue( eMF_SummerS ), profileFile );
    writeProfileInt( "Settings", "eMF_Alarm_BlinkertaktS", getValue( eMF_Alarm_BlinkertaktS ), profileFile );
    writeProfileInt( "Settings", "eMF_Alarm_BlinkerS", getValue( eMF_Alarm_BlinkerS ), profileFile );
    writeProfileInt( "Settings", "eMF_TFL_AbschaltungS", getValue( eMF_TFL_AbschaltungS ), profileFile );
    writeProfileInt( "Settings", "eMF_interm_TaktS", getValue( eMF_interm_TaktS ), profileFile );
    writeProfileInt( "Settings", "eMF_Tuerentriegelung_hintenS", getValue( eMF_Tuerentriegelung_hintenS ), profileFile );
    writeProfileInt( "Settings", "eMF_interm_FahrlichtS", getValue( eMF_interm_FahrlichtS ), profileFile );
    writeProfileInt( "Settings", "eMF_SignalhornS", getValue( eMF_SignalhornS ), profileFile );
    writeProfileInt( "Settings", "eMF_FH_FT_hochS", getValue( eMF_FH_FT_hochS ), profileFile );
    writeProfileInt( "Settings", "eMF_FH_FT_tiefS", getValue( eMF_FH_FT_tiefS ), profileFile );
    writeProfileInt( "Settings", "eMF_FH_BT_hochS", getValue( eMF_FH_BT_hochS ), profileFile );
    writeProfileInt( "Settings", "eMF_FH_BT_tiefS", getValue( eMF_FH_BT_tiefS ), profileFile );
    writeProfileFloat( "Settings", "eLS_Helligkeit_IRS", getValue( eLS_Helligkeit_IRS ), profileFile );
    writeProfileFloat( "Settings", "eLS_Helligkeit_FWS", getValue( eLS_Helligkeit_FWS ), profileFile );
    writeProfileInt( "Settings", "eLS_defektS", getValue( eLS_defektS ), profileFile );
    writeProfileInt( "Settings", "eLS_VerbauS", getValue( eLS_VerbauS ), profileFile );
    writeProfileFloat( "Settings", "eRS_RegenmengeS", getValue( eRS_RegenmengeS ), profileFile );
    writeProfileInt( "Settings", "eRS_VerbauS", getValue( eRS_VerbauS ), profileFile );
    writeProfileInt( "Settings", "eRS_Verglasung_schliessenS", getValue( eRS_Verglasung_schliessenS ), profileFile );
    writeProfileInt( "Settings", "eRS_defektS", getValue( eRS_defektS ), profileFile );
    writeProfileInt( "Settings", "eRS_WischergeschwindigkeitS", getValue( eRS_WischergeschwindigkeitS ), profileFile );
    writeProfileInt( "Settings", "eBH_Blinker_liS", getValue( eBH_Blinker_liS ), profileFile );
    writeProfileInt( "Settings", "eBH_Blinker_reS", getValue( eBH_Blinker_reS ), profileFile );
    writeProfileInt( "Settings", "eBH_LichthupeS", getValue( eBH_LichthupeS ), profileFile );
    writeProfileInt( "Settings", "eBH_FernlichtS", getValue( eBH_FernlichtS ), profileFile );
    writeProfileInt( "Settings", "eWH_TipwischenS", getValue( eWH_TipwischenS ), profileFile );
    writeProfileInt( "Settings", "eWH_IntervallS", getValue( eWH_IntervallS ), profileFile );
    writeProfileInt( "Settings", "eWH_WischerStufe1S", getValue( eWH_WischerStufe1S ), profileFile );
    writeProfileInt( "Settings", "eWH_WischerStufe2S", getValue( eWH_WischerStufe2S ), profileFile );
    writeProfileInt( "Settings", "eWH_FrontwaschenS", getValue( eWH_FrontwaschenS ), profileFile );
    writeProfileInt( "Settings", "eWH_HeckwaschenS", getValue( eWH_HeckwaschenS ), profileFile );
    writeProfileInt( "Settings", "eWH_IntervallstufenS", getValue( eWH_IntervallstufenS ), profileFile );
    writeProfileInt( "Settings", "eFAS_TasterS", getValue( eFAS_TasterS ), profileFile );
    writeProfileInt( "Settings", "eFAS_Taster_FehlerS", getValue( eFAS_Taster_FehlerS ), profileFile );
    writeProfileInt( "Settings", "eSMLS_HupeS", getValue( eSMLS_HupeS ), profileFile );
    writeProfileInt( "Settings", "eLRH_on_offS", getValue( eLRH_on_offS ), profileFile );
    writeProfileInt( "Settings", "eLSS_TastencodeS", getValue( eLSS_TastencodeS ), profileFile );
    writeProfileInt( "Settings", "eSTS_Car_not_under_theftS", getValue( eSTS_Car_not_under_theftS ), profileFile );
    writeProfileInt( "Settings", "eSTS_Car_under_theftS", getValue( eSTS_Car_under_theftS ), profileFile );
    writeProfileInt( "Settings", "eSTS_AnlassersperreS", getValue( eSTS_AnlassersperreS ), profileFile );
    writeProfileInt( "Settings", "eSTS_TypencodierungS", getValue( eSTS_TypencodierungS ), profileFile );
    writeProfileInt( "Settings", "eSTS_LIN_aktivS", getValue( eSTS_LIN_aktivS ), profileFile );
    writeProfileInt( "Settings", "eSTS_StandlichtS", getValue( eSTS_StandlichtS ), profileFile );
    writeProfileInt( "Settings", "eSTS_FahrlichtS", getValue( eSTS_FahrlichtS ), profileFile );
    writeProfileInt( "Settings", "eSTS_Alarm_stillS", getValue( eSTS_Alarm_stillS ), profileFile );
    writeProfileInt( "Settings", "eSTS_TexteS", getValue( eSTS_TexteS ), profileFile );
    writeProfileInt( "Settings", "eSTS_LaderelaisS", getValue( eSTS_LaderelaisS ), profileFile );
    writeProfileInt( "Settings", "eSTS_SummerS", getValue( eSTS_SummerS ), profileFile );
    writeProfileInt( "Settings", "eSTS_Alarm_BlinkerS", getValue( eSTS_Alarm_BlinkerS ), profileFile );
    writeProfileInt( "Settings", "eSTS_NotstartS", getValue( eSTS_NotstartS ), profileFile );
    writeProfileInt( "Settings", "eSTS_SignalhornS", getValue( eSTS_SignalhornS ), profileFile );
    writeProfileInt( "Settings", "eSTS_LeerlaufschaltungS", getValue( eSTS_LeerlaufschaltungS ), profileFile );
    writeProfileInt( "Settings", "eTCO_Driver1_DSS", getValue( eTCO_Driver1_DSS ), profileFile );
    writeProfileInt( "Settings", "eTCO_Driver2_DSS", getValue( eTCO_Driver2_DSS ), profileFile );
    writeProfileInt( "Settings", "eTCO_FahrerkennS", getValue( eTCO_FahrerkennS ), profileFile );
    writeProfileInt( "Settings", "eTCO_Driver1_StS", getValue( eTCO_Driver1_StS ), profileFile );
    writeProfileInt( "Settings", "eTCO_Driver2_StS", getValue( eTCO_Driver2_StS ), profileFile );
    writeProfileInt( "Settings", "eTCO_System_EvS", getValue( eTCO_System_EvS ), profileFile );
    writeProfileInt( "Settings", "eTCO_Handle_InfS", getValue( eTCO_Handle_InfS ), profileFile );
    writeProfileInt( "Settings", "eTCO_Sys_PerfS", getValue( eTCO_Sys_PerfS ), profileFile );
    writeProfileInt( "Settings", "eTCO_Dir_IndS", getValue( eTCO_Dir_IndS ), profileFile );
    writeProfileFloat( "Settings", "eTCO_Outp_SpeedS", getValue( eTCO_Outp_SpeedS ), profileFile );
    writeProfileFloat( "Settings", "eTCO_Vehicle_SpeedS", getValue( eTCO_Vehicle_SpeedS ), profileFile );
    writeProfileFloat( "Settings", "eTD_SekundenS", getValue( eTD_SekundenS ), profileFile );
    writeProfileInt( "Settings", "eTD_MinutenS", getValue( eTD_MinutenS ), profileFile );
    writeProfileInt( "Settings", "eTD_StundenS", getValue( eTD_StundenS ), profileFile );
    writeProfileInt( "Settings", "eTD_MonatS", getValue( eTD_MonatS ), profileFile );
    writeProfileFloat( "Settings", "eTD_TagS", getValue( eTD_TagS ), profileFile );
    writeProfileInt( "Settings", "eTD_JahrS", getValue( eTD_JahrS ), profileFile );
    writeProfileInt( "Settings", "eTD_Lok_Minute_offsS", getValue( eTD_Lok_Minute_offsS ), profileFile );
    writeProfileInt( "Settings", "eTD_Lok_Hour_offsS", getValue( eTD_Lok_Hour_offsS ), profileFile );
    writeProfileFloat( "Settings", "eVDI_V_distS", getValue( eVDI_V_distS ), profileFile );
    writeProfileFloat( "Settings", "eVDI_T_distS", getValue( eVDI_T_distS ), profileFile );
    writeProfileInt( "Settings", "eWischer_vorne_aktivS", getValue( eWischer_vorne_aktivS ), profileFile );
    writeProfileInt( "Settings", "eWaschen_vorne_aktivS", getValue( eWaschen_vorne_aktivS ), profileFile );
    writeProfileInt( "Settings", "eWischer_vorne_NormalS", getValue( eWischer_vorne_NormalS ), profileFile );
    writeProfileInt( "Settings", "eWischer_vorne_SchnellS", getValue( eWischer_vorne_SchnellS ), profileFile );
    writeProfileInt( "Settings", "eWischer_vorne_ParklageS", getValue( eWischer_vorne_ParklageS ), profileFile );
    writeProfileInt( "Settings", "eWischer_vorne_defektS", getValue( eWischer_vorne_defektS ), profileFile );
    writeProfileInt( "Settings", "eWischer_vorne_blockiertS", getValue( eWischer_vorne_blockiertS ), profileFile );
    writeProfileInt( "Settings", "eBCM_FH_FreigabeS", getValue( eBCM_FH_FreigabeS ), profileFile );
    writeProfileInt( "Settings", "eBCM_Komfortfkt_FreigabeS", getValue( eBCM_Komfortfkt_FreigabeS ), profileFile );
    writeProfileInt( "Settings", "eBCM_HSK_FreigabeS", getValue( eBCM_HSK_FreigabeS ), profileFile );
    writeProfileInt( "Settings", "eBCM_Verdeck_FreigabeS", getValue( eBCM_Verdeck_FreigabeS ), profileFile );
    writeProfileInt( "Settings", "eZV_verriegelt_intern_istS", getValue( eZV_verriegelt_intern_istS ), profileFile );
    writeProfileInt( "Settings", "eZV_verriegelt_extern_istS", getValue( eZV_verriegelt_extern_istS ), profileFile );
    writeProfileInt( "Settings", "eZV_verriegelt_intern_sollS", getValue( eZV_verriegelt_intern_sollS ), profileFile );
    writeProfileInt( "Settings", "eZV_verriegelt_extern_sollS", getValue( eZV_verriegelt_extern_sollS ), profileFile );
    writeProfileInt( "Settings", "eZV_gesafet_extern_istS", getValue( eZV_gesafet_extern_istS ), profileFile );
    writeProfileInt( "Settings", "eZV_gesafet_extern_sollS", getValue( eZV_gesafet_extern_sollS ), profileFile );
    writeProfileInt( "Settings", "eZV_EinzeltuerentriegelungS", getValue( eZV_EinzeltuerentriegelungS ), profileFile );
    writeProfileInt( "Settings", "eZV_HeckeinzelentriegelungS", getValue( eZV_HeckeinzelentriegelungS ), profileFile );
    writeProfileInt( "Settings", "eZV_FT_offenS", getValue( eZV_FT_offenS ), profileFile );
    writeProfileInt( "Settings", "eZV_BT_offenS", getValue( eZV_BT_offenS ), profileFile );
    writeProfileInt( "Settings", "eZV_HFS_offenS", getValue( eZV_HFS_offenS ), profileFile );
    writeProfileInt( "Settings", "eZV_HBFS_offenS", getValue( eZV_HBFS_offenS ), profileFile );
    writeProfileInt( "Settings", "eZV_HD_offenS", getValue( eZV_HD_offenS ), profileFile );
    writeProfileInt( "Settings", "eZV_HS_offenS", getValue( eZV_HS_offenS ), profileFile );
    writeProfileInt( "Settings", "eIRUE_aktivS", getValue( eIRUE_aktivS ), profileFile );
    writeProfileInt( "Settings", "eDWA_aktivS", getValue( eDWA_aktivS ), profileFile );
    writeProfileInt( "Settings", "eHD_HauptrasteS", getValue( eHD_HauptrasteS ), profileFile );
    writeProfileInt( "Settings", "eHD_VorrasteS", getValue( eHD_VorrasteS ), profileFile );
    writeProfileInt( "Settings", "eFFB_HDF_TasteS", getValue( eFFB_HDF_TasteS ), profileFile );
    writeProfileInt( "Settings", "eFFB_Panik_TasteS", getValue( eFFB_Panik_TasteS ), profileFile );
    writeProfileInt( "Settings", "eFFB_Auf_TasteS", getValue( eFFB_Auf_TasteS ), profileFile );
    writeProfileInt( "Settings", "eFFB_Zu_TasteS", getValue( eFFB_Zu_TasteS ), profileFile );
    writeProfileInt( "Settings", "eFFB_CarFinderS", getValue( eFFB_CarFinderS ), profileFile );
    writeProfileInt( "Settings", "eFFB_KomfortoeffnenS", getValue( eFFB_KomfortoeffnenS ), profileFile );
    writeProfileInt( "Settings", "eFFB_KomfortschliessenS", getValue( eFFB_KomfortschliessenS ), profileFile );
    writeProfileInt( "Settings", "eFBS_IDG_in_ReichweiteS", getValue( eFBS_IDG_in_ReichweiteS ), profileFile );
    writeProfileInt( "Settings", "eZV_SafeFunktion_aktivS", getValue( eZV_SafeFunktion_aktivS ), profileFile );
    writeProfileInt( "Settings", "eFBS_Warn_Schluessel_BattS", getValue( eFBS_Warn_Schluessel_BattS ), profileFile );
    writeProfileInt( "Settings", "eFT_Kisi_FehlerS", getValue( eFT_Kisi_FehlerS ), profileFile );
    writeProfileInt( "Settings", "eSpeedRPMCorrelation", getValue( eSpeedRPMCorrelation ), profileFile );
    writeProfileInt( "Settings", "eSendAnhaenger_01", getValue( eSendAnhaenger_01 ), profileFile );
    writeProfileInt( "Settings", "eTAnhaenger_01", getValue( eTAnhaenger_01 ), profileFile );
    writeProfileInt( "Settings", "eTOTAnhaenger_01", getValue( eTOTAnhaenger_01 ), profileFile );
    writeProfileInt( "Settings", "eDlcAnhaenger_01", getValue( eDlcAnhaenger_01 ), profileFile );
    writeProfileInt( "Settings", "eBZStepAnhaenger_01", getValue( eBZStepAnhaenger_01 ), profileFile );
    writeProfileInt( "Settings", "eSendBCM_01", getValue( eSendBCM_01 ), profileFile );
    writeProfileInt( "Settings", "eTBCM_01", getValue( eTBCM_01 ), profileFile );
    writeProfileInt( "Settings", "eTOTBCM_01", getValue( eTOTBCM_01 ), profileFile );
    writeProfileInt( "Settings", "eDlcBCM_01", getValue( eDlcBCM_01 ), profileFile );
    writeProfileInt( "Settings", "eSendBlinkmodi_02", getValue( eSendBlinkmodi_02 ), profileFile );
    writeProfileInt( "Settings", "eTBlinkmodi_02", getValue( eTBlinkmodi_02 ), profileFile );
    writeProfileInt( "Settings", "eTOTBlinkmodi_02", getValue( eTOTBlinkmodi_02 ), profileFile );
    writeProfileInt( "Settings", "eDlcBlinkmodi_02", getValue( eDlcBlinkmodi_02 ), profileFile );
    writeProfileInt( "Settings", "eSendDimmung_01", getValue( eSendDimmung_01 ), profileFile );
    writeProfileInt( "Settings", "eTDimmung_01", getValue( eTDimmung_01 ), profileFile );
    writeProfileInt( "Settings", "eTOTDimmung_01", getValue( eTOTDimmung_01 ), profileFile );
    writeProfileInt( "Settings", "eDlcDimmung_01", getValue( eDlcDimmung_01 ), profileFile );
    writeProfileInt( "Settings", "eSendELV_01", getValue( eSendELV_01 ), profileFile );
    writeProfileInt( "Settings", "eTELV_01", getValue( eTELV_01 ), profileFile );
    writeProfileInt( "Settings", "eTOTELV_01", getValue( eTOTELV_01 ), profileFile );
    writeProfileInt( "Settings", "eDlcELV_01", getValue( eDlcELV_01 ), profileFile );
    writeProfileInt( "Settings", "eSendKessy_04", getValue( eSendKessy_04 ), profileFile );
    writeProfileInt( "Settings", "eTKessy_04", getValue( eTKessy_04 ), profileFile );
    writeProfileInt( "Settings", "eTOTKessy_04", getValue( eTOTKessy_04 ), profileFile );
    writeProfileInt( "Settings", "eDlcKessy_04", getValue( eDlcKessy_04 ), profileFile );
    writeProfileInt( "Settings", "eSendKlemmen_Status_01", getValue( eSendKlemmen_Status_01 ), profileFile );
    writeProfileInt( "Settings", "eTKlemmen_Status_01", getValue( eTKlemmen_Status_01 ), profileFile );
    writeProfileInt( "Settings", "eTOTKlemmen_Status_01", getValue( eTOTKlemmen_Status_01 ), profileFile );
    writeProfileInt( "Settings", "eDlcKlemmen_Status_01", getValue( eDlcKlemmen_Status_01 ), profileFile );
    writeProfileInt( "Settings", "eCrcKlemmen_Status_01", getValue( eCrcKlemmen_Status_01 ), profileFile );
    writeProfileInt( "Settings", "eBZKlemmen_Status_01", getValue( eBZKlemmen_Status_01 ), profileFile );
    writeProfileInt( "Settings", "eBZStepKlemmen_Status_01", getValue( eBZStepKlemmen_Status_01 ), profileFile );
    writeProfileInt( "Settings", "eSendKlima_Sensor_02", getValue( eSendKlima_Sensor_02 ), profileFile );
    writeProfileInt( "Settings", "eTKlima_Sensor_02", getValue( eTKlima_Sensor_02 ), profileFile );
    writeProfileInt( "Settings", "eTOTKlima_Sensor_02", getValue( eTOTKlima_Sensor_02 ), profileFile );
    writeProfileInt( "Settings", "eDlcKlima_Sensor_02", getValue( eDlcKlima_Sensor_02 ), profileFile );
    writeProfileInt( "Settings", "eSendLicht_Anf_01", getValue( eSendLicht_Anf_01 ), profileFile );
    writeProfileInt( "Settings", "eTLicht_Anf_01", getValue( eTLicht_Anf_01 ), profileFile );
    writeProfileInt( "Settings", "eTOTLicht_Anf_01", getValue( eTOTLicht_Anf_01 ), profileFile );
    writeProfileInt( "Settings", "eDlcLicht_Anf_01", getValue( eDlcLicht_Anf_01 ), profileFile );
    writeProfileInt( "Settings", "eSendLicht_hinten_01", getValue( eSendLicht_hinten_01 ), profileFile );
    writeProfileInt( "Settings", "eTLicht_hinten_01", getValue( eTLicht_hinten_01 ), profileFile );
    writeProfileInt( "Settings", "eTOTLicht_hinten_01", getValue( eTOTLicht_hinten_01 ), profileFile );
    writeProfileInt( "Settings", "eDlcLicht_hinten_01", getValue( eDlcLicht_hinten_01 ), profileFile );
    writeProfileInt( "Settings", "eBZLicht_hinten_01", getValue( eBZLicht_hinten_01 ), profileFile );
    writeProfileInt( "Settings", "eBZStepLicht_hinten_01", getValue( eBZStepLicht_hinten_01 ), profileFile );
    writeProfileInt( "Settings", "eSendLicht_vorne_01", getValue( eSendLicht_vorne_01 ), profileFile );
    writeProfileInt( "Settings", "eTLicht_vorne_01", getValue( eTLicht_vorne_01 ), profileFile );
    writeProfileInt( "Settings", "eTOTLicht_vorne_01", getValue( eTOTLicht_vorne_01 ), profileFile );
    writeProfileInt( "Settings", "eDlcLicht_vorne_01", getValue( eDlcLicht_vorne_01 ), profileFile );
    writeProfileInt( "Settings", "eSendLog_Datenlogger_Req", getValue( eSendLog_Datenlogger_Req ), profileFile );
    writeProfileInt( "Settings", "eTLog_Datenlogger_Req", getValue( eTLog_Datenlogger_Req ), profileFile );
    writeProfileInt( "Settings", "eTOTLog_Datenlogger_Req", getValue( eTOTLog_Datenlogger_Req ), profileFile );
    writeProfileInt( "Settings", "eDlcLog_Datenlogger_Req", getValue( eDlcLog_Datenlogger_Req ), profileFile );
    writeProfileInt( "Settings", "eSendLog_Kombi_Req", getValue( eSendLog_Kombi_Req ), profileFile );
    writeProfileInt( "Settings", "eTLog_Kombi_Req", getValue( eTLog_Kombi_Req ), profileFile );
    writeProfileInt( "Settings", "eTOTLog_Kombi_Req", getValue( eTOTLog_Kombi_Req ), profileFile );
}

void saveSettings2G( char profileFile[] )
{
    writeProfileInt( "Settings", "eLWR_Reisemodus_TexteS", getValue( eLWR_Reisemodus_TexteS ), profileFile );
    writeProfileFloat( "Settings", "eLWR_Pos_SchrittmotorS", getValue( eLWR_Pos_SchrittmotorS ), profileFile );
    writeProfileInt( "Settings", "eLWR_Hoehenwert_VLS", getValue( eLWR_Hoehenwert_VLS ), profileFile );
    writeProfileInt( "Settings", "eLWR_Hoehenwert_HLS", getValue( eLWR_Hoehenwert_HLS ), profileFile );
    writeProfileInt( "Settings", "eAFS_Ersatzlicht_LinksS", getValue( eAFS_Ersatzlicht_LinksS ), profileFile );
    writeProfileInt( "Settings", "eAFS_Ersatzlicht_RechtsS", getValue( eAFS_Ersatzlicht_RechtsS ), profileFile );
    writeProfileInt( "Settings", "eLWR_AFS_GrundeinstellungS", getValue( eLWR_AFS_GrundeinstellungS ), profileFile );
    writeProfileInt( "Settings", "eLWR_AFS_ParametrisierungS", getValue( eLWR_AFS_ParametrisierungS ), profileFile );
    writeProfileInt( "Settings", "eLWR_InitialisierungslaufS", getValue( eLWR_InitialisierungslaufS ), profileFile );
    writeProfileInt( "Settings", "eLWR_SicherheitspositionS", getValue( eLWR_SicherheitspositionS ), profileFile );
    writeProfileInt( "Settings", "eLWR_ModusS", getValue( eLWR_ModusS ), profileFile );
    writeProfileInt( "Settings", "eLWR_KD_FehlerS", getValue( eLWR_KD_FehlerS ), profileFile );
    writeProfileInt( "Settings", "eMFL_Tastencode_1S", getValue( eMFL_Tastencode_1S ), profileFile );
    writeProfileInt( "Settings", "eMFL_Tastencode_2S", getValue( eMFL_Tastencode_2S ), profileFile );
    writeProfileInt( "Settings", "eMFL_Eventcode_1S", getValue( eMFL_Eventcode_1S ), profileFile );
    writeProfileInt( "Settings", "eMFL_Eventcode_2S", getValue( eMFL_Eventcode_2S ), profileFile );
    writeProfileInt( "Settings", "eMFL_MarkeS", getValue( eMFL_MarkeS ), profileFile );
    writeProfileInt( "Settings", "eMFL_VarianteS", getValue( eMFL_VarianteS ), profileFile );
    writeProfileInt( "Settings", "eMO_IstgangS", getValue( eMO_IstgangS ), profileFile );
    writeProfileInt( "Settings", "eMO_SollgangS", getValue( eMO_SollgangS ), profileFile );
    writeProfileFloat( "Settings", "eMO_OeldruckS", getValue( eMO_OeldruckS ), profileFile );
    writeProfileFloat( "Settings", "eMO_AnzeigedrehzS", getValue( eMO_AnzeigedrehzS ), profileFile );
    writeProfileInt( "Settings", "eMO_Schaltempf_verfbarS", getValue( eMO_Schaltempf_verfbarS ), profileFile );
    writeProfileFloat( "Settings", "eMO_LadedruckS", getValue( eMO_LadedruckS ), profileFile );
    writeProfileInt( "Settings", "eMO_KVSS", getValue( eMO_KVSS ), profileFile );
    writeProfileInt( "Settings", "eMO_KVS_UeberlaufS", getValue( eMO_KVS_UeberlaufS ), profileFile );
    writeProfileInt( "Settings", "eMO_QBit_Ansaugluft_TempS", getValue( eMO_QBit_Ansaugluft_TempS ), profileFile );
    writeProfileInt( "Settings", "eMO_QBit_Oel_TempS", getValue( eMO_QBit_Oel_TempS ), profileFile );
    writeProfileInt( "Settings", "eMO_QBit_Kuehlmittel_TempS", getValue( eMO_QBit_Kuehlmittel_TempS ), profileFile );
    writeProfileInt( "Settings", "eMO_Stellgliedtest_Soundaktuator", getValue( eMO_Stellgliedtest_Soundaktuator ), profileFile );
    writeProfileInt( "Settings", "eMO_HYB_Fehler_HV_NetzS", getValue( eMO_HYB_Fehler_HV_NetzS ), profileFile );
    writeProfileInt( "Settings", "eMO_aktives_GetriebeheizenS", getValue( eMO_aktives_GetriebeheizenS ), profileFile );
    writeProfileInt( "Settings", "eMO_Absperrventil_oeffnenS", getValue( eMO_Absperrventil_oeffnenS ), profileFile );
    writeProfileFloat( "Settings", "eMO_Ansaugluft_TempS", getValue( eMO_Ansaugluft_TempS ), profileFile );
    writeProfileInt( "Settings", "eMO_Oel_TempS", getValue( eMO_Oel_TempS ), profileFile );
    writeProfileFloat( "Settings", "eMO_Kuehlmittel_TempS", getValue( eMO_Kuehlmittel_TempS ), profileFile );
    writeProfileFloat( "Settings", "eMO_HoeheninfoS", getValue( eMO_HoeheninfoS ), profileFile );
    writeProfileInt( "Settings", "eMO_KennfeldkS", getValue( eMO_KennfeldkS ), profileFile );
    writeProfileInt( "Settings", "eMO_VersionsinfoS", getValue( eMO_VersionsinfoS ), profileFile );
    writeProfileInt( "Settings", "eMO_Getriebe_kuehlenS", getValue( eMO_Getriebe_kuehlenS ), profileFile );
    writeProfileFloat( "Settings", "eMO_Mom_Traegheit_02S", getValue( eMO_Mom_Traegheit_02S ), profileFile );
    writeProfileFloat( "Settings", "eMO_HeizungspumpenansteuerungS", getValue( eMO_HeizungspumpenansteuerungS ), profileFile );
    writeProfileInt( "Settings", "eMO_SpannungsAnfS", getValue( eMO_SpannungsAnfS ), profileFile );
    writeProfileFloat( "Settings", "eMO_Nachlaufzeit_HeizungspumpeS", getValue( eMO_Nachlaufzeit_HeizungspumpeS ), profileFile );
    writeProfileFloat( "Settings", "eMO_ITM_Kuehlmittel_TempS", getValue( eMO_ITM_Kuehlmittel_TempS ), profileFile );
    writeProfileFloat( "Settings", "eMO_E85_SensorS", getValue( eMO_E85_SensorS ), profileFile );
    writeProfileInt( "Settings", "eSCR_Anz_MotorstartsS", getValue( eSCR_Anz_MotorstartsS ), profileFile );
    writeProfileInt( "Settings", "eSCR_Warnstufe_1S", getValue( eSCR_Warnstufe_1S ), profileFile );
    writeProfileInt( "Settings", "eSCR_Warnstufe_2S", getValue( eSCR_Warnstufe_2S ), profileFile );
    writeProfileInt( "Settings", "eSCR_AkustikS", getValue( eSCR_AkustikS ), profileFile );
    writeProfileInt( "Settings", "eMO_Kraftstofffilter_WasserS", getValue( eMO_Kraftstofffilter_WasserS ), profileFile );
    writeProfileInt( "Settings", "eSCR_SystemfehlerS", getValue( eSCR_SystemfehlerS ), profileFile );
    writeProfileInt( "Settings", "eSCR_Inducement_StrategieS", getValue( eSCR_Inducement_StrategieS ), profileFile );
    writeProfileInt( "Settings", "eMO_CO2_FaktorS", getValue( eMO_CO2_FaktorS ), profileFile );
    writeProfileInt( "Settings", "eMO_MKB_MUXS", getValue( eMO_MKB_MUXS ), profileFile );
    writeProfileInt( "Settings", "eMO_MKB_01S", getValue( eMO_MKB_01S ), profileFile );
    writeProfileInt( "Settings", "eMO_MKB_02S", getValue( eMO_MKB_02S ), profileFile );
    writeProfileInt( "Settings", "eMO_MKB_03S", getValue( eMO_MKB_03S ), profileFile );
    writeProfileInt( "Settings", "eMO_MKB_04S", getValue( eMO_MKB_04S ), profileFile );
    writeProfileInt( "Settings", "eMO_StartStopp_StatusS", getValue( eMO_StartStopp_StatusS ), profileFile );
    writeProfileInt( "Settings", "eMO_Freig_RekuS", getValue( eMO_Freig_RekuS ), profileFile );
    writeProfileInt( "Settings", "eMO_Kl_75S", getValue( eMO_Kl_75S ), profileFile );
    writeProfileInt( "Settings", "eMO_Kl_50S", getValue( eMO_Kl_50S ), profileFile );
    writeProfileInt( "Settings", "eMO_GangpositionS", getValue( eMO_GangpositionS ), profileFile );
    writeProfileInt( "Settings", "eMO_StartStopp_FahrerwunschS", getValue( eMO_StartStopp_FahrerwunschS ), profileFile );
    writeProfileInt( "Settings", "eMO_HYB_FahrbereitschaftS", getValue( eMO_HYB_FahrbereitschaftS ), profileFile );
    writeProfileInt( "Settings", "eMO_Ext_E_Fahrt_aktivS", getValue( eMO_Ext_E_Fahrt_aktivS ), profileFile );
    writeProfileInt( "Settings", "eMO_Fahrer_bremstS", getValue( eMO_Fahrer_bremstS ), profileFile );
    writeProfileInt( "Settings", "eMO_QBit_Fahrer_bremstS", getValue( eMO_QBit_Fahrer_bremstS ), profileFile );
    writeProfileInt( "Settings", "eMO_BLSS", getValue( eMO_BLSS ), profileFile );
    writeProfileInt( "Settings", "eMO_Konsistenz_BremspedS", getValue( eMO_Konsistenz_BremspedS ), profileFile );
    writeProfileInt( "Settings", "eMO_Timeout_ESPS", getValue( eMO_Timeout_ESPS ), profileFile );
    writeProfileInt( "Settings", "eMO_Klima_EingrS", getValue( eMO_Klima_EingrS ), profileFile );
    writeProfileInt( "Settings", "eMO_Aussp_AnlassS", getValue( eMO_Aussp_AnlassS ), profileFile );
    writeProfileInt( "Settings", "eMO_Freig_AnlassS", getValue( eMO_Freig_AnlassS ), profileFile );
    writeProfileInt( "Settings", "eMO_Kuppl_schalterS", getValue( eMO_Kuppl_schalterS ), profileFile );
    writeProfileInt( "Settings", "eMO_InterlockS", getValue( eMO_InterlockS ), profileFile );
    writeProfileInt( "Settings", "eMO_Motor_laeuftS", getValue( eMO_Motor_laeuftS ), profileFile );
    writeProfileInt( "Settings", "eMO_KickdownS", getValue( eMO_KickdownS ), profileFile );
    writeProfileInt( "Settings", "eMO_Status_Zylabschalt_01S", getValue( eMO_Status_Zylabschalt_01S ), profileFile );
    writeProfileInt( "Settings", "eMO_EKlKomLeiRedS", getValue( eMO_EKlKomLeiRedS ), profileFile );
    writeProfileInt( "Settings", "eMO_Handshake_STHS", getValue( eMO_Handshake_STHS ), profileFile );
    writeProfileInt( "Settings", "eMO_BKV_UnterdruckwarnungS", getValue( eMO_BKV_UnterdruckwarnungS ), profileFile );
    writeProfileInt( "Settings", "eMO_Freigabe_SegelnS", getValue( eMO_Freigabe_SegelnS ), profileFile );
    writeProfileInt( "Settings", "eMO_Drehzahl_WarnungS", getValue( eMO_Drehzahl_WarnungS ), profileFile );
    writeProfileFloat( "Settings", "eMO_obere_DrehzahlgrenzeS", getValue( eMO_obere_DrehzahlgrenzeS ), profileFile );
    writeProfileInt( "Settings", "eMotor_Code_01_BZS", getValue( eMotor_Code_01_BZS ), profileFile );
    writeProfileInt( "Settings", "eMO_Faktor_Momente_02S", getValue( eMO_Faktor_Momente_02S ), profileFile );
    writeProfileInt( "Settings", "eMO_HybridfahrzeugS", getValue( eMO_HybridfahrzeugS ), profileFile );
    writeProfileInt( "Settings", "eMO_CodeS", getValue( eMO_CodeS ), profileFile );
    writeProfileInt( "Settings", "eMO_Getriebe_CodeS", getValue( eMO_Getriebe_CodeS ), profileFile );
    writeProfileInt( "Settings", "eMO_StartStopp_CodiertS", getValue( eMO_StartStopp_CodiertS ), profileFile );
    writeProfileInt( "Settings", "eMO_Anzahl_ZylS", getValue( eMO_Anzahl_ZylS ), profileFile );
    writeProfileInt( "Settings", "eMO_KraftstoffartS", getValue( eMO_KraftstoffartS ), profileFile );
    writeProfileFloat( "Settings", "eMO_HubraumS", getValue( eMO_HubraumS ), profileFile );
    writeProfileInt( "Settings", "eMO_AnsaugsystemS", getValue( eMO_AnsaugsystemS ), profileFile );
    writeProfileInt( "Settings", "eMO_LeistungS", getValue( eMO_LeistungS ), profileFile );
    writeProfileInt( "Settings", "eMO_Abgastyp_EOBDS", getValue( eMO_Abgastyp_EOBDS ), profileFile );
    writeProfileInt( "Settings", "eMO_Abgastyp_OBDS", getValue( eMO_Abgastyp_OBDS ), profileFile );
    writeProfileInt( "Settings", "eMO_DPF_verbautS", getValue( eMO_DPF_verbautS ), profileFile );
    writeProfileInt( "Settings", "eTSK_CodierungS", getValue( eTSK_CodierungS ), profileFile );
    writeProfileInt( "Settings", "eMO_EinspritzartS", getValue( eMO_EinspritzartS ), profileFile );
    writeProfileInt( "Settings", "eWFS_MSG1_RNDS", getValue( eWFS_MSG1_RNDS ), profileFile );
    writeProfileInt( "Settings", "eWFS_MSG1_CRCS", getValue( eWFS_MSG1_CRCS ), profileFile );
    writeProfileInt( "Settings", "eWFS_MSG2_RNDS", getValue( eWFS_MSG2_RNDS ), profileFile );
    writeProfileInt( "Settings", "eWFS_MSG2_CRCS", getValue( eWFS_MSG2_CRCS ), profileFile );
    writeProfileInt( "Settings", "eWFS_MSG3_RNDS", getValue( eWFS_MSG3_RNDS ), profileFile );
    writeProfileInt( "Settings", "eWFS_MSG3_CRCS", getValue( eWFS_MSG3_CRCS ), profileFile );
    writeProfileInt( "Settings", "eWFS_MSG4_RNDS", getValue( eWFS_MSG4_RNDS ), profileFile );
    writeProfileInt( "Settings", "eWFS_MSG4_CRCS", getValue( eWFS_MSG4_CRCS ), profileFile );
    writeProfileInt( "Settings", "eNM_Gateway_SNIS", getValue( eNM_Gateway_SNIS ), profileFile );
    writeProfileInt( "Settings", "eNM_Gateway_NM_StateS", getValue( eNM_Gateway_NM_StateS ), profileFile );
    writeProfileInt( "Settings", "eNM_Gateway_Car_WakeupS", getValue( eNM_Gateway_Car_WakeupS ), profileFile );
    writeProfileInt( "Settings", "eNM_Gateway_WakeupS", getValue( eNM_Gateway_WakeupS ), profileFile );
    writeProfileInt( "Settings", "eNM_Gateway_NM_aktiv_KL15S", getValue( eNM_Gateway_NM_aktiv_KL15S ), profileFile );
    writeProfileInt( "Settings", "eNM_Gateway_NM_aktiv_DiagnoseS", getValue( eNM_Gateway_NM_aktiv_DiagnoseS ), profileFile );
    writeProfileInt( "Settings", "eNM_Gateway_NM_aktiv_TminS", getValue( eNM_Gateway_NM_aktiv_TminS ), profileFile );
    writeProfileInt( "Settings", "eNM_Gateway_UDS_CCS", getValue( eNM_Gateway_UDS_CCS ), profileFile );
    writeProfileInt( "Settings", "ePLS_Anf_AnzS", getValue( ePLS_Anf_AnzS ), profileFile );
    writeProfileInt( "Settings", "ePLS_Kurze_LueckeS", getValue( ePLS_Kurze_LueckeS ), profileFile );
    writeProfileInt( "Settings", "ePLS_Laengs_QuerlueckeS", getValue( ePLS_Laengs_QuerlueckeS ), profileFile );
    writeProfileInt( "Settings", "ePLS_Anf_Anz_SchwellpfeilS", getValue( ePLS_Anf_Anz_SchwellpfeilS ), profileFile );
    writeProfileInt( "Settings", "ePLS_Fahrtrichtg_MehrzgS", getValue( ePLS_Fahrtrichtg_MehrzgS ), profileFile );
    writeProfileInt( "Settings", "ePLS_BremssymbolS", getValue( ePLS_BremssymbolS ), profileFile );
    writeProfileInt( "Settings", "ePLS_PL_ExistS", getValue( ePLS_PL_ExistS ), profileFile );
    writeProfileInt( "Settings", "ePLS_StandbyS", getValue( ePLS_StandbyS ), profileFile );
    writeProfileInt( "Settings", "ePLS_Mehrzg_AktivS", getValue( ePLS_Mehrzg_AktivS ), profileFile );
    writeProfileInt( "Settings", "ePLS_Pos_OKS", getValue( ePLS_Pos_OKS ), profileFile );
    writeProfileInt( "Settings", "ePLS_PL_SeiteS", getValue( ePLS_PL_SeiteS ), profileFile );
    writeProfileInt( "Settings", "ePLS_Lenk_Aktiv_HinweisS", getValue( ePLS_Lenk_Aktiv_HinweisS ), profileFile );
    writeProfileInt( "Settings", "ePLS_TexteS", getValue( ePLS_TexteS ), profileFile );
    writeProfileInt( "Settings", "ePLS_Schwellpfeil_relS", getValue( ePLS_Schwellpfeil_relS ), profileFile );
    writeProfileInt( "Settings", "ePLS_Schwellpfeil_absS", getValue( ePLS_Schwellpfeil_absS ), profileFile );
    writeProfileInt( "Settings", "ePLS_Ausparken_AktivS", getValue( ePLS_Ausparken_AktivS ), profileFile );
    writeProfileInt( "Settings", "ePLS_BremsleuchteS", getValue( ePLS_BremsleuchteS ), profileFile );
    writeProfileInt( "Settings", "eRDK_System_OffS", getValue( eRDK_System_OffS ), profileFile );
    writeProfileInt( "Settings", "eRDK_Warnungen_02S", getValue( eRDK_Warnungen_02s ), profileFile );
    writeProfileInt( "Settings", "eRDK_FMVSS138_LampeS", getValue( eRDK_FMVSS138_LampeS ), profileFile );
    writeProfileInt( "Settings", "eRDK_Druckwarnung_RdWS", getValue( eRDK_Druckwarnung_RdWS ), profileFile );
    writeProfileInt( "Settings", "eRDK_FMVSS138_MILS", getValue( eRDK_FMVSS138_MILS ), profileFile );
    writeProfileInt( "Settings", "eRDK_LF_aktivS", getValue( eRDK_LF_aktivS ), profileFile );
    writeProfileFloat( "Settings", "eRDK_Diff_Druck_VLS", getValue( eRDK_Diff_Druck_VLS ), profileFile );
    writeProfileInt( "Settings", "eRDK_KD_FehlerS", getValue( eRDK_KD_FehlerS ), profileFile );
    writeProfileFloat( "Settings", "eRDK_Diff_Druck_VRS", getValue( eRDK_Diff_Druck_VRS ), profileFile );
    writeProfileFloat( "Settings", "eRDK_Diff_Druck_HLS", getValue( eRDK_Diff_Druck_HLS ), profileFile );
    writeProfileFloat( "Settings", "eRDK_Diff_Druck_HRS", getValue( eRDK_Diff_Druck_HRS ), profileFile );
    writeProfileInt( "Settings", "eRKA_WarnungenS", getValue( eRKA_WarnungenS ), profileFile );
    writeProfileInt( "Settings", "eRKA_FMVSS138_LampeS", getValue( eRKA_FMVSS138_LampeS ), profileFile );
    writeProfileInt( "Settings", "eRKA_Druckwarnung_RdWS", getValue( eRKA_Druckwarnung_RdWS ), profileFile );
    writeProfileInt( "Settings", "eRKA_FMVSS138_MILS", getValue( eRKA_FMVSS138_MILS ), profileFile );
    writeProfileInt( "Settings", "eRKA_Warnungen_02S", getValue( eRKA_Warnungen_02S ), profileFile );
    writeProfileInt( "Settings", "eRKA_KD_FehlerS", getValue( eRKA_KD_FehlerS ), profileFile );
    writeProfileInt( "Settings", "eSWA_Status_BZS", getValue( eSWA_Status_BZS ), profileFile );
    writeProfileInt( "Settings", "eSWA_AnzeigenS", getValue( eSWA_AnzeigenS ), profileFile );
    writeProfileInt( "Settings", "eSWA_Blindheit_erkanntS", getValue( eSWA_Blindheit_erkanntS ), profileFile );
    writeProfileInt( "Settings", "eSWA_rel_NichtverfS", getValue( eSWA_rel_NichtverfS ), profileFile );
    writeProfileInt( "Settings", "eSWA_rel_FehlerS", getValue( eSWA_rel_FehlerS ), profileFile );
    writeProfileInt( "Settings", "eSWA_Sta_aktivS", getValue( eSWA_Sta_aktivS ), profileFile );
    writeProfileInt( "Settings", "eSWA_Sta_passivS", getValue( eSWA_Sta_passivS ), profileFile );
    writeProfileInt( "Settings", "eSWA_Standziele_liS", getValue( eSWA_Standziele_liS ), profileFile );
    writeProfileInt( "Settings", "eSWA_Kolonne_liS", getValue( eSWA_Kolonne_liS ), profileFile );
    writeProfileInt( "Settings", "eSWA_Infostufe_SWA_liS", getValue( eSWA_Infostufe_SWA_liS ), profileFile );
    writeProfileInt( "Settings", "eSWA_Warnung_SWA_liS", getValue( eSWA_Warnung_SWA_liS ), profileFile );
    writeProfileInt( "Settings", "eSWA_Kolonne_miS", getValue( eSWA_Kolonne_miS ), profileFile );
    writeProfileInt( "Settings", "eSWA_Standziele_reS", getValue( eSWA_Standziele_reS ), profileFile );
    writeProfileInt( "Settings", "eSWA_Kolonne_reS", getValue( eSWA_Kolonne_reS ), profileFile );
    writeProfileInt( "Settings", "eSWA_Infostufe_SWA_reS", getValue( eSWA_Infostufe_SWA_reS ), profileFile );
    writeProfileInt( "Settings", "eSWA_Warnung_SWA_reS", getValue( eSWA_Warnung_SWA_reS ), profileFile );
    writeProfileInt( "Settings", "eSWA_GischtzaehlerS", getValue( eSWA_GischtzaehlerS ), profileFile );
    writeProfileInt( "Settings", "eSI_Sammel_SG_FehlerS", getValue( eSI_Sammel_SG_FehlerS ), profileFile );
    writeProfileInt( "Settings", "eSI_P_Mode_gueltigS", getValue( eSI_P_Mode_gueltigS ), profileFile );
    writeProfileInt( "Settings", "eSI_QRS_ModeS", getValue( eSI_QRS_ModeS ), profileFile );
    writeProfileInt( "Settings", "eSI_NWDFS", getValue( eSI_NWDFS ), profileFile );
    writeProfileInt( "Settings", "eSI_NWDF_gueltigS", getValue( eSI_NWDF_gueltigS ), profileFile );
    writeProfileInt( "Settings", "eGW_KD_FehlerS", getValue( eGW_KD_FehlerS ), profileFile );
    writeProfileInt( "Settings", "eSI_CAB_01S", getValue( eSI_CAB_01S ), profileFile );
    writeProfileInt( "Settings", "eSI_CAB_02S", getValue( eSI_CAB_02S ), profileFile );
    writeProfileInt( "Settings", "eSI_CAB_03S", getValue( eSI_CAB_03S ), profileFile );
    writeProfileInt( "Settings", "eSI_CAB_04S", getValue( eSI_CAB_04S ), profileFile );
    writeProfileInt( "Settings", "eSI_CAB_05S", getValue( eSI_CAB_05S ), profileFile );
    writeProfileInt( "Settings", "eSI_CAB_06S", getValue( eSI_CAB_06S ), profileFile );
    writeProfileInt( "Settings", "eSI_CAB_07S", getValue( eSI_CAB_07S ), profileFile );
    writeProfileInt( "Settings", "eSI_CAB_08S", getValue( eSI_CAB_08S ), profileFile );
    writeProfileInt( "Settings", "eSI_CAB_09S", getValue( eSI_CAB_09S ), profileFile );
    writeProfileInt( "Settings", "eSI_CAB_10S", getValue( eSI_CAB_10S ), profileFile );
    writeProfileInt( "Settings", "eSI_CAB_11S", getValue( eSI_CAB_11S ), profileFile );
    writeProfileInt( "Settings", "eSI_CAB_12S", getValue( eSI_CAB_12S ), profileFile );
    writeProfileInt( "Settings", "eSI_CAB_13S", getValue( eSI_CAB_13S ), profileFile );
    writeProfileInt( "Settings", "eSI_CAB_14S", getValue( eSI_CAB_14S ), profileFile );
    writeProfileInt( "Settings", "eSI_BUS_01S", getValue( eSI_BUS_01S ), profileFile );
    writeProfileInt( "Settings", "eSI_BUS_02S", getValue( eSI_BUS_02S ), profileFile );
    writeProfileInt( "Settings", "eSI_BUS_03S", getValue( eSI_BUS_03S ), profileFile );
    writeProfileInt( "Settings", "eSI_BUS_04S", getValue( eSI_BUS_04S ), profileFile );
    writeProfileInt( "Settings", "eSI_BUS_05S", getValue( eSI_BUS_05S ), profileFile );
    writeProfileInt( "Settings", "eSI_BUS_06S", getValue( eSI_BUS_06S ), profileFile );
    writeProfileInt( "Settings", "eSI_BUS_07S", getValue( eSI_BUS_07S ), profileFile );
    writeProfileInt( "Settings", "eSI_BUS_08S", getValue( eSI_BUS_08S ), profileFile );
    writeProfileInt( "Settings", "eSI_BUS_09S", getValue( eSI_BUS_09S ), profileFile );
    writeProfileInt( "Settings", "eSI_BUS_10S", getValue( eSI_BUS_10S ), profileFile );
    writeProfileInt( "Settings", "eSI_BUS_11S", getValue( eSI_BUS_11S ), profileFile );
    writeProfileInt( "Settings", "eSI_BUS_12S", getValue( eSI_BUS_12S ), profileFile );
    writeProfileInt( "Settings", "eSI_BUS_13S", getValue( eSI_BUS_13S ), profileFile );
    writeProfileInt( "Settings", "eSI_BUS_14S", getValue( eSI_BUS_14S ), profileFile );
    writeProfileInt( "Settings", "eSI_BUS_15S", getValue( eSI_BUS_15S ), profileFile );
    writeProfileFloat( "Settings", "eTSK_WunschgeschwS", getValue( eTSK_WunschgeschwS ), profileFile );
    writeProfileInt( "Settings", "eTSK_Texte_PrimaeranzS", getValue( eTSK_Texte_PrimaeranzS ), profileFile );
    writeProfileInt( "Settings", "eTSK_Limiter_AnzeigeS", getValue( eTSK_Limiter_AnzeigeS ), profileFile );
    writeProfileInt( "Settings", "eTSK_Status_AnzeigeS", getValue( eTSK_Status_AnzeigeS ), profileFile );
    writeProfileInt( "Settings", "eWBA_Fahrstufe_02S", getValue( eWBA_Fahrstufe_02S ), profileFile );
    writeProfileInt( "Settings", "eWBA_ZielFahrstufeS", getValue( eWBA_ZielFahrstufeS ), profileFile );
    writeProfileInt( "Settings", "eWBA_GE_Warnung_02S", getValue( eWBA_GE_Warnung_02S ), profileFile );
    writeProfileInt( "Settings", "eWBA_eing_Gang_02S", getValue( eWBA_eing_Gang_02S ), profileFile );
    writeProfileInt( "Settings", "eWBA_GE_TexteS", getValue( eWBA_GE_TexteS ), profileFile );
    writeProfileInt( "Settings", "eWBA_Segeln_aktivS", getValue( eWBA_Segeln_aktivS ), profileFile );
    writeProfileInt( "Settings", "eWBA_SchaltschemaS", getValue( eWBA_SchaltschemaS ), profileFile );
    writeProfileFloat( "Settings", "eWIV_VerschleissindexS", getValue( eWIV_VerschleissindexS ), profileFile );
    writeProfileFloat( "Settings", "eWIV_RussindexS", getValue( eWIV_RussindexS ), profileFile );
    writeProfileInt( "Settings", "eWIV_t_minS", getValue( eWIV_t_minS ), profileFile );
    writeProfileInt( "Settings", "eWIV_t_maxS", getValue( eWIV_t_maxS ), profileFile );
    writeProfileFloat( "Settings", "eWIV_W_minS", getValue( eWIV_W_minS ), profileFile );
    writeProfileFloat( "Settings", "eWIV_W_maxS", getValue( eWIV_W_maxS ), profileFile );
    writeProfileInt( "Settings", "eDEV_Kombi_SUP1_DummySigS", getValue( eDEV_Kombi_SUP1_DummySigS ), profileFile );
    writeProfileInt( "Settings", "eDEV_Kombi_SUP2_DummySigS", getValue( eDEV_Kombi_SUP2_DummySigS ), profileFile );
    writeProfileInt( "Settings", "eDEV_Kombi_SUP3_DummySigS", getValue( eDEV_Kombi_SUP3_DummySigS ), profileFile );
    writeProfileInt( "Settings", "eDEV_Kombi_UD1_Byte1S", getValue( eDEV_Kombi_UD1_Byte1S ), profileFile );
    writeProfileInt( "Settings", "eDEV_Kombi_UD1_Byte2S", getValue( eDEV_Kombi_UD1_Byte2S ), profileFile );
    writeProfileInt( "Settings", "eDEV_Kombi_UD1_Byte3S", getValue( eDEV_Kombi_UD1_Byte3S ), profileFile );
    writeProfileInt( "Settings", "eDEV_Kombi_UD1_Byte4S", getValue( eDEV_Kombi_UD1_Byte4S ), profileFile );
    writeProfileInt( "Settings", "eDEV_Kombi_UD1_Byte5S", getValue( eDEV_Kombi_UD1_Byte5S ), profileFile );
    writeProfileInt( "Settings", "eDEV_Kombi_UD1_Byte6S", getValue( eDEV_Kombi_UD1_Byte6S ), profileFile );
    writeProfileInt( "Settings", "eDEV_Kombi_UD1_Byte7S", getValue( eDEV_Kombi_UD1_Byte7S ), profileFile );
    writeProfileInt( "Settings", "eDEV_Kombi_UD1_Byte8S", getValue( eDEV_Kombi_UD1_Byte8S ), profileFile );
    writeProfileInt( "Settings", "eDEV_Kombi_UD2_Byte1S", getValue( eDEV_Kombi_UD2_Byte1S ), profileFile );
    writeProfileInt( "Settings", "eDEV_Kombi_UD2_Byte2S", getValue( eDEV_Kombi_UD2_Byte2S ), profileFile );
    writeProfileInt( "Settings", "eDEV_Kombi_UD2_Byte3S", getValue( eDEV_Kombi_UD2_Byte3S ), profileFile );
    writeProfileInt( "Settings", "eDEV_Kombi_UD2_Byte4S", getValue( eDEV_Kombi_UD2_Byte4S ), profileFile );
    writeProfileInt( "Settings", "eDEV_Kombi_UD2_Byte5S", getValue( eDEV_Kombi_UD2_Byte5S ), profileFile );
    writeProfileInt( "Settings", "eDEV_Kombi_UD2_Byte6S", getValue( eDEV_Kombi_UD2_Byte6S ), profileFile );
    writeProfileInt( "Settings", "eDEV_Kombi_UD2_Byte7S", getValue( eDEV_Kombi_UD2_Byte7S ), profileFile );
    writeProfileInt( "Settings", "eDEV_Kombi_UD2_Byte8S", getValue( eDEV_Kombi_UD2_Byte8S ), profileFile );
  //GVJ-5567
    writeProfileInt( "Settings", "eTG_Geber_1", getValue( eTG_Geber_1 ), profileFile );
    writeProfileInt( "Settings", "eTG_Geber_2", getValue( eTG_Geber_2 ), profileFile );
    writeProfileInt( "Settings", "eTG_Geber_3", getValue( eTG_Geber_3 ), profileFile );
    writeProfileInt( "Settings", "eTG_Geber_4", getValue( eTG_Geber_4 ), profileFile );
    writeProfileInt( "Settings", "eTG_Guete_Geber_1", getValue( eTG_Guete_Geber_1 ), profileFile );
    writeProfileInt( "Settings", "eTG_Guete_Geber_2", getValue( eTG_Guete_Geber_2 ), profileFile );
    writeProfileInt( "Settings", "eTG_Guete_Geber_3", getValue( eTG_Guete_Geber_3 ), profileFile );
    writeProfileInt( "Settings", "eTG_Guete_Geber_4", getValue( eTG_Guete_Geber_4 ), profileFile );
    writeProfileInt( "Settings", "eEFF_Verbrauch_STH", getValue( eEFF_Verbrauch_STH ), profileFile );
    writeProfileInt( "Settings", "eSendAirbag_01", getValue( eSendAirbag_01 ), profileFile );
    writeProfileInt( "Settings", "eTAirbag_01", getValue( eTAirbag_01 ), profileFile );
    writeProfileInt( "Settings", "eTOTAirbag_01", getValue( eTOTAirbag_01 ), profileFile );
    writeProfileInt( "Settings", "eSendARA_Status_01", getValue( eSendARA_Status_01 ), profileFile );
    writeProfileInt( "Settings", "eTARA_Status_01", getValue( eTARA_Status_01 ), profileFile );
    writeProfileInt( "Settings", "eTOTARA_Status_01", getValue( eTOTARA_Status_01 ), profileFile );
    writeProfileInt( "Settings", "eDlcARA_Status_01", getValue( eDlcARA_Status_01 ), profileFile );
    writeProfileInt( "Settings", "eSendESP_21", getValue( eSendESP_21 ), profileFile );
    writeProfileInt( "Settings", "eTESP_21", getValue( eTESP_21 ), profileFile );
    writeProfileInt( "Settings", "eTOTESP_21", getValue( eTOTESP_21 ), profileFile );
    writeProfileInt( "Settings", "eDlcESP_21", getValue( eDlcESP_21 ), profileFile );
    writeProfileInt( "Settings", "eCrcESP_21", getValue( eCrcESP_21 ), profileFile );
    writeProfileInt( "Settings", "eBZESP_21", getValue( eBZESP_21 ), profileFile );
    writeProfileInt( "Settings", "eBZStepESP_21", getValue( eBZStepESP_21 ), profileFile );
    writeProfileInt( "Settings", "eSendTSG_FT_02", getValue( eSendTSG_FT_02 ), profileFile );
    writeProfileInt( "Settings", "eTTSG_FT_02", getValue( eTTSG_FT_02 ), profileFile );
    writeProfileInt( "Settings", "eTOTTSG_FT_02", getValue( eTOTTSG_FT_02 ), profileFile );
    writeProfileInt( "Settings", "eDlcTSG_FT_02", getValue( eDlcTSG_FT_02 ), profileFile );
    writeProfileInt( "Settings", "eCrcTSG_FT_02", getValue( eCrcTSG_FT_02 ), profileFile );
    writeProfileInt( "Settings", "eBZTSG_FT_02", getValue( eBZTSG_FT_02 ), profileFile );
    writeProfileInt( "Settings", "eBZStepTSG_FT_02", getValue( eBZStepTSG_FT_02 ), profileFile );
}

void saveSettings3( char profileFile[] )
{
    writeProfileInt( "Settings", "eDlcLog_Kombi_Req", getValue( eDlcLog_Kombi_Req ), profileFile );
    writeProfileInt( "Settings", "eSendMem_BFS_01", getValue( eSendMem_BFS_01 ), profileFile );
    writeProfileInt( "Settings", "eTMem_BFS_01", getValue( eTMem_BFS_01 ), profileFile );
    writeProfileInt( "Settings", "eTOTMem_BFS_01", getValue( eTOTMem_BFS_01 ), profileFile );
    writeProfileInt( "Settings", "eDlcMem_BFS_01", getValue( eDlcMem_BFS_01 ), profileFile );
    writeProfileInt( "Settings", "eSendMem_FS_01", getValue( eSendMem_FS_01 ), profileFile );
    writeProfileInt( "Settings", "eTMem_FS_01", getValue( eTMem_FS_01 ), profileFile );
    writeProfileInt( "Settings", "eTOTMem_FS_01", getValue( eTOTMem_FS_01 ), profileFile );
    writeProfileInt( "Settings", "eDlcMem_FS_01", getValue( eDlcMem_FS_01 ), profileFile );
    writeProfileInt( "Settings", "eSendMFG_01", getValue( eSendMFG_01 ), profileFile );
    writeProfileInt( "Settings", "eTMFG_01", getValue( eTMFG_01 ), profileFile );
    writeProfileInt( "Settings", "eTOTMFG_01", getValue( eTOTMFG_01 ), profileFile );
    writeProfileInt( "Settings", "eDlcMFG_01", getValue( eDlcMFG_01 ), profileFile );
    writeProfileInt( "Settings", "eCrcMFG_01", getValue( eCrcMFG_01 ), profileFile );
    writeProfileInt( "Settings", "eBZMFG_01", getValue( eBZMFG_01 ), profileFile );
    writeProfileInt( "Settings", "eBZStepMFG_01", getValue( eBZStepMFG_01 ), profileFile );
    writeProfileInt( "Settings", "eSendRLS_01", getValue( eSendRLS_01 ), profileFile );
    writeProfileInt( "Settings", "eTRLS_01", getValue( eTRLS_01 ), profileFile );
    writeProfileInt( "Settings", "eTOTRLS_01", getValue( eTOTRLS_01 ), profileFile );
    writeProfileInt( "Settings", "eDlcRLS_01", getValue( eDlcRLS_01 ), profileFile );
    writeProfileInt( "Settings", "eSendSMLS_01", getValue( eSendSMLS_01 ), profileFile );
    writeProfileInt( "Settings", "eTSMLS_01", getValue( eTSMLS_01 ), profileFile );
    writeProfileInt( "Settings", "eTOTSMLS_01", getValue( eTOTSMLS_01 ), profileFile );
    writeProfileInt( "Settings", "eDlcSMLS_01", getValue( eDlcSMLS_01 ), profileFile );
    writeProfileInt( "Settings", "eCrcSMLS_01", getValue( eCrcSMLS_01 ), profileFile );
    writeProfileInt( "Settings", "eBZSMLS_01", getValue( eBZSMLS_01 ), profileFile );
    writeProfileInt( "Settings", "eBZStepSMLS_01", getValue( eBZStepSMLS_01 ), profileFile );
    writeProfileInt( "Settings", "eSendTCO_01", getValue( eSendTCO_01 ), profileFile );
    writeProfileInt( "Settings", "eTTCO_01", getValue( eTTCO_01 ), profileFile );
    writeProfileInt( "Settings", "eTOTTCO_01", getValue( eTOTTCO_01 ), profileFile );
    writeProfileInt( "Settings", "eDlcTCO_01", getValue( eDlcTCO_01 ), profileFile );
    writeProfileInt( "Settings", "eSendTSG_FT_01", getValue( eSendTSG_FT_01 ), profileFile );
    writeProfileInt( "Settings", "eTTSG_FT_01", getValue( eTTSG_FT_01 ), profileFile );
    writeProfileInt( "Settings", "eTOTTSG_FT_01", getValue( eTOTTSG_FT_01 ), profileFile );
    writeProfileInt( "Settings", "eDlcTSG_FT_01", getValue( eDlcTSG_FT_01 ), profileFile );
    writeProfileInt( "Settings", "eSendTimeDate", getValue( eSendTimeDate ), profileFile );
    writeProfileInt( "Settings", "eTTimeDate", getValue( eTTimeDate ), profileFile );
    writeProfileInt( "Settings", "eTOTTimeDate", getValue( eTOTTimeDate ), profileFile );
    writeProfileInt( "Settings", "eDlcTimeDate", getValue( eDlcTimeDate ), profileFile );
    writeProfileInt( "Settings", "eSendVehiDist", getValue( eSendVehiDist ), profileFile );
    writeProfileInt( "Settings", "eTVehiDist", getValue( eTVehiDist ), profileFile );
    writeProfileInt( "Settings", "eTOTVehiDist", getValue( eTOTVehiDist ), profileFile );
    writeProfileInt( "Settings", "eDlcVehiDist", getValue( eDlcVehiDist ), profileFile );
    writeProfileInt( "Settings", "eSendWischer_01", getValue( eSendWischer_01 ), profileFile );
    writeProfileInt( "Settings", "eTWischer_01", getValue( eTWischer_01 ), profileFile );
    writeProfileInt( "Settings", "eTOTWischer_01", getValue( eTOTWischer_01 ), profileFile );
    writeProfileInt( "Settings", "eDlcWischer_01", getValue( eDlcWischer_01 ), profileFile );
    writeProfileInt( "Settings", "eSendZV_02", getValue( eSendZV_02 ), profileFile );
    writeProfileInt( "Settings", "eTZV_02", getValue( eTZV_02 ), profileFile );
    writeProfileInt( "Settings", "eTOTZV_02", getValue( eTOTZV_02 ), profileFile );
    writeProfileInt( "Settings", "eDlcZV_02", getValue( eDlcZV_02 ), profileFile );
    writeProfileInt( "Settings", "eSendSTH_01", getValue( eSendSTH_01 ), profileFile );
    writeProfileInt( "Settings", "eTSTH_01", getValue( eTSTH_01 ), profileFile );
    writeProfileInt( "Settings", "eTOTSTH_01", getValue( eTOTSTH_01 ), profileFile );
    writeProfileInt( "Settings", "eDlcSTH_01", getValue( eDlcSTH_01 ), profileFile );

    writeProfileInt( "Settings", "eSendHSP_01", getValue( eSendHSP_01 ), profileFile );
    writeProfileInt( "Settings", "eTHSP_01", getValue( eTHSP_01 ), profileFile );
    writeProfileInt( "Settings", "eTOTHSP_01", getValue( eTOTHSP_01 ), profileFile );
    writeProfileInt( "Settings", "eDlcHSP_01", getValue( eDlcHSP_01 ), profileFile );

    writeProfileInt( "Settings", "eChannel", getValue( eChannel ), profileFile );

    //IssueList #173 MR 55685
    writeProfileInt( "Settings", "eSendPersonalisierung_01", getValue( eSendPersonalisierung_01 ), profileFile );
    writeProfileInt( "Settings", "eTPersonalisierung_01", getValue( eTPersonalisierung_01 ), profileFile );
    writeProfileInt( "Settings", "eTOTPersonalisierung_01", getValue( eTOTPersonalisierung_01 ), profileFile );
    writeProfileInt( "Settings", "eDlcPersonalisierung_01", getValue( eDlcPersonalisierung_01 ), profileFile );

    writeProfileInt( "Settings", "eSendGNSS_02", getValue( eSendGNSS_02 ), profileFile );
    writeProfileInt( "Settings", "eTGNSS_02", getValue( eTGNSS_02 ), profileFile );
    writeProfileInt( "Settings", "eTOTGNSS_02", getValue( eTOTGNSS_02 ), profileFile );
    writeProfileInt( "Settings", "eDlcGNSS_02", getValue( eDlcGNSS_02 ), profileFile );
}

void saveSettings3G( char profileFile[] )
{
    //ACC_13
    writeProfileInt( "Settings", "eSendACC_13", getValue( eSendACC_13 ), profileFile );
    writeProfileInt( "Settings", "eTACC_13", getValue( eTACC_13 ), profileFile );
    writeProfileInt( "Settings", "eTOTACC_13", getValue( eTOTACC_13 ), profileFile );
    writeProfileInt( "Settings", "eDlcACC_13", getValue( eDlcACC_13 ), profileFile );

    //ACC_14
    writeProfileInt( "Settings", "eSendACC_14", getValue( eSendACC_14 ), profileFile );
    writeProfileInt( "Settings", "eTACC_14", getValue( eTACC_14 ), profileFile );
    writeProfileInt( "Settings", "eTOTACC_14", getValue( eTOTACC_14 ), profileFile );
    writeProfileInt( "Settings", "eDlcACC_14", getValue( eDlcACC_14 ), profileFile );

    //AGA_01
    writeProfileInt( "Settings", "eSendAGA_01", getValue( eSendAGA_01 ), profileFile );
    writeProfileInt( "Settings", "eTAGA_01", getValue( eTAGA_01 ), profileFile );
    writeProfileInt( "Settings", "eTOTAGA_01", getValue( eTOTAGA_01 ), profileFile );
    writeProfileInt( "Settings", "eDlcAGA_01", getValue( eDlcAGA_01 ), profileFile );
    writeProfileInt( "Settings", "eCrcAGA_01", getValue( eCrcAGA_01 ), profileFile );
    writeProfileInt( "Settings", "eBZAGA_01", getValue( eBZAGA_01), profileFile );
    writeProfileInt( "Settings", "eBZStepAGA_01", getValue( eBZStepAGA_01 ), profileFile );

    //Airbag_02
    writeProfileInt( "Settings", "eSendAirbag_02", getValue( eSendAirbag_02 ), profileFile );
    writeProfileInt( "Settings", "eTAirbag_02", getValue( eTAirbag_02 ), profileFile );
    writeProfileInt( "Settings", "eTOTAirbag_02", getValue( eTOTAirbag_02 ), profileFile );
    writeProfileInt( "Settings", "eDlcAirbag_02", getValue( eDlcAirbag_02 ), profileFile );

    //Airbag_04
    writeProfileInt( "Settings", "eSendAirbag_04", getValue( eSendAirbag_04 ), profileFile );
    writeProfileInt( "Settings", "eTAirbag_04", getValue( eTAirbag_04 ), profileFile );
    writeProfileInt( "Settings", "eTOTAirbag_04", getValue( eTOTAirbag_04 ), profileFile );
    writeProfileInt( "Settings", "eDlcAirbag_04", getValue( eDlcAirbag_04 ), profileFile );

    //AWV_02
    writeProfileInt( "Settings", "eSendAWV_02", getValue( eSendAWV_02 ), profileFile );
    writeProfileInt( "Settings", "eTAWV_02", getValue( eTAWV_02 ), profileFile );
    writeProfileInt( "Settings", "eTOTAWV_02", getValue( eTOTAWV_02 ), profileFile );
    writeProfileInt( "Settings", "eDlcAWV_02", getValue( eDlcAWV_02 ), profileFile );

    writeProfileInt( "Settings", "eSendBEM_02", getValue( eSendBEM_02 ), profileFile );
    writeProfileInt( "Settings", "eTBEM_02", getValue( eTBEM_02 ), profileFile );
    writeProfileInt( "Settings", "eTOTBEM_02", getValue( eTOTBEM_02 ), profileFile );
    writeProfileInt( "Settings", "eDlcBEM_02", getValue( eDlcBEM_02 ), profileFile );
    writeProfileInt( "Settings", "eSendCharisma_03", getValue( eSendCharisma_03 ), profileFile );
    writeProfileInt( "Settings", "eTCharisma_03", getValue( eTCharisma_03 ), profileFile );
    writeProfileInt( "Settings", "eTOTCharisma_03", getValue( eTOTCharisma_03 ), profileFile );
    writeProfileInt( "Settings", "eDlcCharisma_03", getValue( eDlcCharisma_03 ), profileFile );
    writeProfileInt( "Settings", "eSendDaempfer_01", getValue( eSendDaempfer_01 ), profileFile );
    writeProfileInt( "Settings", "eTDaempfer_01", getValue( eTDaempfer_01 ), profileFile );
    writeProfileInt( "Settings", "eTOTDaempfer_01", getValue( eTOTDaempfer_01 ), profileFile );
    writeProfileInt( "Settings", "eDlcDaempfer_01", getValue( eDlcDaempfer_01 ), profileFile );
    writeProfileInt( "Settings", "eSendDEV_Kombi_SUP1", getValue( eSendDEV_Kombi_SUP1 ), profileFile );
    writeProfileInt( "Settings", "eTDEV_Kombi_SUP1", getValue( eTDEV_Kombi_SUP1 ), profileFile );
    writeProfileInt( "Settings", "eTOTDEV_Kombi_SUP1", getValue( eTOTDEV_Kombi_SUP1 ), profileFile );
    writeProfileInt( "Settings", "eDlcDEV_Kombi_SUP1", getValue( eDlcDEV_Kombi_SUP1 ), profileFile );
    writeProfileInt( "Settings", "eSendDEV_Kombi_RX1", getValue( eSendDEV_Kombi_RX1 ), profileFile );
    writeProfileInt( "Settings", "eTDEV_Kombi_RX1", getValue( eTDEV_Kombi_RX1 ), profileFile );
    writeProfileInt( "Settings", "eTOTDEV_Kombi_RX1", getValue( eTOTDEV_Kombi_RX1 ), profileFile );
    writeProfileInt( "Settings", "eDlcDEV_Kombi_RX1", getValue( eDlcDEV_Kombi_RX1 ), profileFile );
    writeProfileInt( "Settings", "eSendDEV_Kombi_SUP2", getValue( eSendDEV_Kombi_SUP2 ), profileFile );
    writeProfileInt( "Settings", "eTDEV_Kombi_SUP2", getValue( eTDEV_Kombi_SUP2 ), profileFile );
    writeProfileInt( "Settings", "eTOTDEV_Kombi_SUP2", getValue( eTOTDEV_Kombi_SUP2 ), profileFile );
    writeProfileInt( "Settings", "eDlcDEV_Kombi_SUP2", getValue( eDlcDEV_Kombi_SUP2 ), profileFile );
    writeProfileInt( "Settings", "eSendDEV_Kombi_SUP3", getValue( eSendDEV_Kombi_SUP3 ), profileFile );
    writeProfileInt( "Settings", "eTDEV_Kombi_SUP3", getValue( eTDEV_Kombi_SUP3 ), profileFile );
    writeProfileInt( "Settings", "eTOTDEV_Kombi_SUP3", getValue( eTOTDEV_Kombi_SUP3 ), profileFile );
    writeProfileInt( "Settings", "eDlcDEV_Kombi_SUP3", getValue( eDlcDEV_Kombi_SUP3 ), profileFile );
    writeProfileInt( "Settings", "eSendDEV_Kombi_UD1_PC_KI_Control", getValue( eSendDEV_Kombi_UD1_PC_KI_Control ), profileFile );
    writeProfileInt( "Settings", "eTDEV_Kombi_UD1_PC_KI_Control", getValue( eTDEV_Kombi_UD1_PC_KI_Control ), profileFile );
    writeProfileInt( "Settings", "eTOTDEV_Kombi_UD1_PC_KI_Control", getValue( eTOTDEV_Kombi_UD1_PC_KI_Control ), profileFile );
    writeProfileInt( "Settings", "eDlcDEV_Kombi_UD1_PC_KI_Control", getValue( eDlcDEV_Kombi_UD1_PC_KI_Control ), profileFile );
    writeProfileInt( "Settings", "eSendDEV_Kombi_UD2_PC_KI_Data", getValue( eSendDEV_Kombi_UD2_PC_KI_Data ), profileFile );
    writeProfileInt( "Settings", "eTDEV_Kombi_UD2_PC_KI_Data", getValue( eTDEV_Kombi_UD2_PC_KI_Data ), profileFile );
    writeProfileInt( "Settings", "eTOTDEV_Kombi_UD2_PC_KI_Data", getValue( eTOTDEV_Kombi_UD2_PC_KI_Data ), profileFile );
    writeProfileInt( "Settings", "eDlcDEV_Kombi_UD2_PC_KI_Data", getValue( eDlcDEV_Kombi_UD2_PC_KI_Data ), profileFile );
    writeProfileInt( "Settings", "eSendDiagnose_01", getValue( eSendDiagnose_01 ), profileFile );
    writeProfileInt( "Settings", "eTDiagnose_01", getValue( eTDiagnose_01 ), profileFile );
    writeProfileInt( "Settings", "eTOTDiagnose_01", getValue( eTOTDiagnose_01 ), profileFile );
    writeProfileInt( "Settings", "eDlcDiagnose_01", getValue( eDlcDiagnose_01 ), profileFile );
    writeProfileInt( "Settings", "eSendESP_02", getValue( eSendESP_02 ), profileFile );
    writeProfileInt( "Settings", "eTESP_02", getValue( eTESP_02 ), profileFile );
    writeProfileInt( "Settings", "eTOTESP_02", getValue( eTOTESP_02 ), profileFile );
    writeProfileInt( "Settings", "eDlcESP_02", getValue( eDlcESP_02 ), profileFile );
    writeProfileInt( "Settings", "eSendESP_20", getValue( eSendESP_20 ), profileFile );
    writeProfileInt( "Settings", "eTESP_20", getValue( eTESP_20 ), profileFile );
    writeProfileInt( "Settings", "eTOTESP_20", getValue( eTOTESP_20 ), profileFile );
    writeProfileInt( "Settings", "eDlcESP_20", getValue( eDlcESP_20 ), profileFile );
    writeProfileInt( "Settings", "eSendESP_24", getValue( eSendESP_24 ), profileFile );
    writeProfileInt( "Settings", "eTESP_24", getValue( eTESP_24 ), profileFile );
    writeProfileInt( "Settings", "eTOTESP_24", getValue( eTOTESP_24 ), profileFile );
    writeProfileInt( "Settings", "eDlcESP_24", getValue( eDlcESP_24 ), profileFile );
    writeProfileInt( "Settings", "eCrcESP_24", getValue( eCrcESP_24 ), profileFile );
    writeProfileInt( "Settings", "eBZESP_24", getValue( eBZESP_24 ), profileFile );
    writeProfileInt( "Settings", "eBZStepESP_24", getValue( eBZStepESP_24 ), profileFile );
    writeProfileInt( "Settings", "eSendGateway_73", getValue( eSendGateway_73 ), profileFile );
    writeProfileInt( "Settings", "eTGateway_73", getValue( eTGateway_73 ), profileFile );
    writeProfileInt( "Settings", "eTOTGateway_73", getValue( eTOTGateway_73 ), profileFile );
    writeProfileInt( "Settings", "eDlcGateway_73", getValue( eDlcGateway_73 ), profileFile );

    writeProfileInt( "Settings", "eSendGateway_78", getValue( eSendGateway_78 ), profileFile );
    writeProfileInt( "Settings", "eTGateway_78", getValue( eTGateway_78 ), profileFile );
    writeProfileInt( "Settings", "eTOTGateway_78", getValue( eTOTGateway_78 ), profileFile );
    writeProfileInt( "Settings", "eDlcGateway_78", getValue( eDlcGateway_78 ), profileFile );

    writeProfileInt( "Settings", "eSendMotor_Gas_01", getValue( eSendMotor_Gas_01 ), profileFile );
    writeProfileInt( "Settings", "eTMotor_Gas_01", getValue( eTMotor_Gas_01 ), profileFile );
    writeProfileInt( "Settings", "eTOTMotor_Gas_01", getValue( eTOTMotor_Gas_01 ), profileFile );
    writeProfileInt( "Settings", "eDlcMotor_Gas_01", getValue( eDlcMotor_Gas_01 ), profileFile );

    writeProfileInt( "Settings", "eSendISO_Funktionaler_Req_All", getValue( eSendISO_Funktionaler_Req_All ), profileFile );
    writeProfileInt( "Settings", "eTISO_Funktionaler_Req_All", getValue( eTISO_Funktionaler_Req_All ), profileFile );
    writeProfileInt( "Settings", "eTOTISO_Funktionaler_Req_All", getValue( eTOTISO_Funktionaler_Req_All ), profileFile );
    writeProfileInt( "Settings", "eDlcISO_Funktionaler_Req_All", getValue( eDlcISO_Funktionaler_Req_All ), profileFile );
    writeProfileInt( "Settings", "eSendISO_Kombi_Req", getValue( eSendISO_Kombi_Req ), profileFile );
    writeProfileInt( "Settings", "eTISO_Kombi_Req", getValue( eTISO_Kombi_Req ), profileFile );
    writeProfileInt( "Settings", "eTOTISO_Kombi_Req", getValue( eTOTISO_Kombi_Req ), profileFile );
    writeProfileInt( "Settings", "eDlcISO_Kombi_Req", getValue( eDlcISO_Kombi_Req ), profileFile );
    writeProfileInt( "Settings", "eSendKS_Kombi_Req", getValue( eSendKS_Kombi_Req ), profileFile );
    writeProfileInt( "Settings", "eTKS_Kombi_Req", getValue( eTKS_Kombi_Req ), profileFile );
    writeProfileInt( "Settings", "eTOTKS_Kombi_Req", getValue( eTOTKS_Kombi_Req ), profileFile );
    writeProfileInt( "Settings", "eDlcKS_Kombi_Req", getValue( eDlcKS_Kombi_Req ), profileFile );
    writeProfileInt( "Settings", "eSendLDW_02", getValue( eSendLDW_02 ), profileFile );
    writeProfileInt( "Settings", "eTLDW_02", getValue( eTLDW_02 ), profileFile );
    writeProfileInt( "Settings", "eTOTLDW_02", getValue( eTOTLDW_02 ), profileFile );
    writeProfileInt( "Settings", "eDlcLDW_02", getValue( eDlcLDW_02 ), profileFile );
    writeProfileInt( "Settings", "eSendLH_EPS_01", getValue( eSendLH_EPS_01 ), profileFile );
    writeProfileInt( "Settings", "eTLH_EPS_01", getValue( eTLH_EPS_01 ), profileFile );
    writeProfileInt( "Settings", "eTOTLH_EPS_01", getValue( eTOTLH_EPS_01 ), profileFile );
    writeProfileInt( "Settings", "eDlcLH_EPS_01", getValue( eDlcLH_EPS_01 ), profileFile );
    writeProfileInt( "Settings", "eCrcLH_EPS_01", getValue( eCrcLH_EPS_01 ), profileFile );
    writeProfileInt( "Settings", "eBZLH_EPS_01", getValue( eBZLH_EPS_01 ), profileFile );
    writeProfileInt( "Settings", "eBZStepLH_EPS_01", getValue( eBZStepLH_EPS_01 ), profileFile );
    writeProfileInt( "Settings", "eSendLWR_AFS_01", getValue( eSendLWR_AFS_01 ), profileFile );
    writeProfileInt( "Settings", "eTLWR_AFS_01", getValue( eTLWR_AFS_01 ), profileFile );
    writeProfileInt( "Settings", "eTOTLWR_AFS_01", getValue( eTOTLWR_AFS_01 ), profileFile );
    writeProfileInt( "Settings", "eDlcLWR_AFS_01", getValue( eDlcLWR_AFS_01 ), profileFile );
    writeProfileInt( "Settings", "eBZLWR_AFS_01", getValue( eBZLWR_AFS_01 ), profileFile );
    writeProfileInt( "Settings", "eBZStepLWR_AFS_01", getValue( eBZStepLWR_AFS_01 ), profileFile );
    writeProfileInt( "Settings", "eSendMFL_Tasten_Kon_01", getValue( eSendMFL_Tasten_Kon_01 ), profileFile );
    writeProfileInt( "Settings", "eTMFL_Tasten_Kon_01", getValue( eTMFL_Tasten_Kon_01 ), profileFile );
    writeProfileInt( "Settings", "eTOTMFL_Tasten_Kon_01", getValue( eTOTMFL_Tasten_Kon_01 ), profileFile );
    writeProfileInt( "Settings", "eDlcMFL_Tasten_Kon_01", getValue( eDlcMFL_Tasten_Kon_01 ), profileFile );
    writeProfileInt( "Settings", "eSendMotor_04", getValue( eSendMotor_04 ), profileFile );
    writeProfileInt( "Settings", "eTMotor_04", getValue( eTMotor_04 ), profileFile );
    writeProfileInt( "Settings", "eTOTMotor_04", getValue( eTOTMotor_04 ), profileFile );
    writeProfileInt( "Settings", "eDlcMotor_04", getValue( eDlcMotor_04 ), profileFile );
    writeProfileInt( "Settings", "eSendMotor_07", getValue( eSendMotor_07 ), profileFile );
    writeProfileInt( "Settings", "eTMotor_07", getValue( eTMotor_07 ), profileFile );
    writeProfileInt( "Settings", "eTOTMotor_07", getValue( eTOTMotor_07 ), profileFile );
    writeProfileInt( "Settings", "eDlcMotor_07", getValue( eDlcMotor_07 ), profileFile );
    writeProfileInt( "Settings", "eSendMotor_09", getValue( eSendMotor_09 ), profileFile );
    writeProfileInt( "Settings", "eTMotor_09", getValue( eTMotor_09 ), profileFile );
    writeProfileInt( "Settings", "eTOTMotor_09", getValue( eTOTMotor_09 ), profileFile );
    writeProfileInt( "Settings", "eDlcMotor_09", getValue( eDlcMotor_09 ), profileFile );
    writeProfileInt( "Settings", "eSendMotor_14", getValue( eSendMotor_14 ), profileFile );
    writeProfileInt( "Settings", "eTMotor_14", getValue( eTMotor_14 ), profileFile );
    writeProfileInt( "Settings", "eTOTMotor_14", getValue( eTOTMotor_14 ), profileFile );
    writeProfileInt( "Settings", "eDlcMotor_14", getValue( eDlcMotor_14 ), profileFile );
    writeProfileInt( "Settings", "eSendMotor_18", getValue( eSendMotor_18 ), profileFile );
    writeProfileInt( "Settings", "eTMotor_18", getValue( eTMotor_18 ), profileFile );
    writeProfileInt( "Settings", "eTOTMotor_18", getValue( eTOTMotor_18 ), profileFile );
    writeProfileInt( "Settings", "eDlcMotor_18", getValue( eDlcMotor_18 ), profileFile );
    writeProfileInt( "Settings", "eSendMotor_26", getValue( eSendMotor_26 ), profileFile );
    writeProfileInt( "Settings", "eTMotor_26", getValue( eTMotor_26 ), profileFile );
    writeProfileInt( "Settings", "eTOTMotor_26", getValue( eTOTMotor_26 ), profileFile );
    writeProfileInt( "Settings", "eDlcMotor_26", getValue( eDlcMotor_26 ), profileFile );
    writeProfileInt( "Settings", "eSendMotor_Code_01", getValue( eSendMotor_Code_01 ), profileFile );
    writeProfileInt( "Settings", "eTMotor_Code_01", getValue( eTMotor_Code_01 ), profileFile );
    writeProfileInt( "Settings", "eTOTMotor_Code_01", getValue( eTOTMotor_Code_01 ), profileFile );
    writeProfileInt( "Settings", "eDlcMotor_Code_01", getValue( eDlcMotor_Code_01 ), profileFile );
    writeProfileInt( "Settings", "eCrcMotor_Code_01", getValue( eCrcMotor_Code_01 ), profileFile );
    writeProfileInt( "Settings", "eBZMotor_Code_01", getValue( eBZMotor_Code_01 ), profileFile );
    writeProfileInt( "Settings", "eBZStepMotor_Code_01", getValue( eBZStepMotor_Code_01 ), profileFile );
    writeProfileInt( "Settings", "eSendNMH_Gateway", getValue( eSendNMH_Gateway ), profileFile );
    writeProfileInt( "Settings", "eTNMH_Gateway", getValue( eTNMH_Gateway ), profileFile );
    writeProfileInt( "Settings", "eTOTNMH_Gateway", getValue( eTOTNMH_Gateway ), profileFile );
    writeProfileInt( "Settings", "eDlcNMH_Gateway", getValue( eDlcNMH_Gateway ), profileFile );
    writeProfileInt( "Settings", "eSendRDK_02", getValue( eSendRDK_02 ), profileFile );
    writeProfileInt( "Settings", "eTRDK_02", getValue( eTRDK_02 ), profileFile );
    writeProfileInt( "Settings", "eTOTRDK_02", getValue( eTOTRDK_02 ), profileFile );
    writeProfileInt( "Settings", "eDlcRDK_02", getValue( eDlcRDK_02 ), profileFile );
    writeProfileInt( "Settings", "eSendRKA_01", getValue( eSendRKA_01 ), profileFile );
    writeProfileInt( "Settings", "eTRKA_01", getValue( eTRKA_01 ), profileFile );
    writeProfileInt( "Settings", "eTOTRKA_01", getValue( eTOTRKA_01 ), profileFile );
    writeProfileInt( "Settings", "eDlcRKA_01", getValue( eDlcRKA_01 ), profileFile );
    writeProfileInt( "Settings", "eSendSWA_01", getValue( eSendSWA_01 ), profileFile );
    writeProfileInt( "Settings", "eTSWA_01", getValue( eTSWA_01 ), profileFile );
    writeProfileInt( "Settings", "eTOTSWA_01", getValue( eTOTSWA_01 ), profileFile );
    writeProfileInt( "Settings", "eDlcSWA_01", getValue( eDlcSWA_01 ), profileFile );
    writeProfileInt( "Settings", "eCrcSWA_01", getValue( eCrcSWA_01 ), profileFile );
    writeProfileInt( "Settings", "eBZSWA_01", getValue( eBZSWA_01 ), profileFile );
    writeProfileInt( "Settings", "eBZStepSWA_01", getValue( eBZStepSWA_01 ), profileFile );
    writeProfileInt( "Settings", "eSendSysteminfo_01", getValue( eSendSysteminfo_01 ), profileFile );
    writeProfileInt( "Settings", "eTSysteminfo_01", getValue( eTSysteminfo_01 ), profileFile );
    writeProfileInt( "Settings", "eTOTSysteminfo_01", getValue( eTOTSysteminfo_01 ), profileFile );
    writeProfileInt( "Settings", "eDlcSysteminfo_01", getValue( eDlcSysteminfo_01 ), profileFile );
    writeProfileInt( "Settings", "eSendTSK_07", getValue( eSendTSK_07 ), profileFile );
    writeProfileInt( "Settings", "eTTSK_07", getValue( eTTSK_07 ), profileFile );
    writeProfileInt( "Settings", "eTOTTSK_07", getValue( eTOTTSK_07 ), profileFile );
    writeProfileInt( "Settings", "eDlcTSK_07", getValue( eDlcTSK_07 ), profileFile );
    writeProfileInt( "Settings", "eCrcTSK_07", getValue( eCrcTSK_07 ), profileFile );
    writeProfileInt( "Settings", "eBZTSK_07", getValue( eBZTSK_07 ), profileFile );
    writeProfileInt( "Settings", "eBZStepTSK_07", getValue( eBZStepTSK_07 ), profileFile );
    writeProfileInt( "Settings", "eSendWBA_03", getValue( eSendWBA_03 ), profileFile );
    writeProfileInt( "Settings", "eTWBA_03", getValue( eTWBA_03 ), profileFile );
    writeProfileInt( "Settings", "eTOTWBA_03", getValue( eTOTWBA_03 ), profileFile );
    writeProfileInt( "Settings", "eSendWIV_01", getValue( eSendWIV_01 ), profileFile );
    writeProfileInt( "Settings", "eTWIV_01", getValue( eTWIV_01 ), profileFile );
    writeProfileInt( "Settings", "eTOTWIV_01", getValue( eTOTWIV_01 ), profileFile );
    writeProfileInt( "Settings", "eDlcWIV_01", getValue( eDlcWIV_01 ), profileFile );

    writeProfileInt( "Settings", "eSendHVLM_05", getValue( eSendHVLM_05 ), profileFile );
    writeProfileInt( "Settings", "eTHVLM_05", getValue( eTHVLM_05 ), profileFile );
    writeProfileInt( "Settings", "eTOTHVLM_05", getValue( eTOTHVLM_05 ), profileFile );
    writeProfileInt( "Settings", "eDlcHVLM_05", getValue( eDlcHVLM_05 ), profileFile );

    writeProfileInt( "Settings", "eSendPLA_Status_02", getValue( eSendPLA_Status_02 ), profileFile );
    writeProfileInt( "Settings", "eTPLA_Status_02", getValue( eTPLA_Status_02 ), profileFile );
    writeProfileInt( "Settings", "eTOTPLA_Status_02", getValue( eTOTPLA_Status_02 ), profileFile );
    writeProfileInt( "Settings", "eDlcPLA_Status_02", getValue( eDlcPLA_Status_02 ), profileFile );

    writeProfileInt( "Settings", "eSendReichweite_01", getValue( eSendReichweite_01 ), profileFile );
    writeProfileInt( "Settings", "eTReichweite_01", getValue( eTReichweite_01 ), profileFile );
    writeProfileInt( "Settings", "eTOTReichweite_01", getValue( eTOTReichweite_01 ), profileFile );
    writeProfileInt( "Settings", "eDlcReichweite_01", getValue( eDlcReichweite_01 ), profileFile );

    writeProfileInt( "Settings", "eSendReichweite_02", getValue( eSendReichweite_02 ), profileFile );
    writeProfileInt( "Settings", "eTReichweite_02", getValue( eTReichweite_02), profileFile );
    writeProfileInt( "Settings", "eTOTReichweite_02", getValue( eTOTReichweite_02 ), profileFile );
    writeProfileInt( "Settings", "eDlcReichweite_02", getValue( eDlcReichweite_02 ), profileFile );

    writeProfileInt( "Settings", "eSendMainUnit_01", getValue( eSendMainUnit_01 ), profileFile );
    writeProfileInt( "Settings", "eTMainUnit_01", getValue( eTMainUnit_01 ), profileFile );
    writeProfileInt( "Settings", "eTOTMainUnit_01", getValue( eTOTMainUnit_01 ), profileFile );
    writeProfileInt( "Settings", "eDlcMainUnit_01", getValue( eDlcMainUnit_01 ), profileFile );

    writeProfileInt( "Settings", "eSendBMS_07", getValue( eSendBMS_07 ), profileFile );
    writeProfileInt( "Settings", "eTBMS_07", getValue( eTBMS_07), profileFile );
    writeProfileInt( "Settings", "eTOTBMS_07", getValue( eTOTBMS_07 ), profileFile );
    writeProfileInt( "Settings", "eDlcBMS_07", getValue( eDlcBMS_07 ), profileFile );
    writeProfileInt( "Settings", "eCrcBMS_07", getValue( eCrcBMS_07 ), profileFile );
    writeProfileInt( "Settings", "eBZBMS_07", getValue( eBZBMS_07 ), profileFile );
    writeProfileInt( "Settings", "eBZStepBMS_07", getValue( eBZStepBMS_07 ), profileFile );

    writeProfileInt( "Settings", "eSendMotor_23", getValue( eSendMotor_23 ), profileFile );
    writeProfileInt( "Settings", "eTMotor_23", getValue( eTMotor_23 ), profileFile );
    writeProfileInt( "Settings", "eTOTMotor_23", getValue( eTOTMotor_23 ), profileFile );
    writeProfileInt( "Settings", "eDlcMotor_23", getValue( eDlcMotor_23 ), profileFile );

    writeProfileInt( "Settings", "eSendMotor_36", getValue( eSendMotor_36 ), profileFile );
    writeProfileInt( "Settings", "eTMotor_36", getValue( eTMotor_36 ), profileFile );
    writeProfileInt( "Settings", "eTOTMotor_36", getValue( eTOTMotor_36 ), profileFile );
    writeProfileInt( "Settings", "eDlcMotor_36", getValue( eDlcMotor_36 ), profileFile );

    writeProfileInt( "Settings", "eSendGateway_71", getValue( eSendGateway_71 ), profileFile );
    writeProfileInt( "Settings", "eTGateway_71", getValue( eTGateway_71 ), profileFile );
    writeProfileInt( "Settings", "eTOTGateway_71", getValue( eTOTGateway_71 ), profileFile );
    writeProfileInt( "Settings", "eDlcGateway_71", getValue( eDlcGateway_71 ), profileFile );

    writeProfileInt( "Settings", "eSendMotor_29", getValue( eSendMotor_29 ), profileFile );
    writeProfileInt( "Settings", "eTMotor_29", getValue( eTMotor_29 ), profileFile );
    writeProfileInt( "Settings", "eTOTMotor_29", getValue( eTOTMotor_29 ), profileFile );
    writeProfileInt( "Settings", "eDlcMotor_29", getValue( eDlcMotor_29 ), profileFile );

    writeProfileInt( "Settings", "eSendLSH_02", getValue( eSendLSH_02 ), profileFile );
    writeProfileInt( "Settings", "eTLSH_02", getValue( eTLSH_02 ), profileFile );
    writeProfileInt( "Settings", "eTOTLSH_02", getValue( eTOTLSH_02 ), profileFile );
    writeProfileInt( "Settings", "eDlcLSH_02", getValue( eDlcLSH_02 ), profileFile );

    writeProfileInt( "Settings", "eSendBMS_05", getValue( eSendBMS_05 ), profileFile );
    writeProfileInt( "Settings", "eTBMS_05", getValue( eTBMS_05 ), profileFile );
    writeProfileInt( "Settings", "eTOTBMS_05", getValue( eTOTBMS_05 ), profileFile );
    writeProfileInt( "Settings", "eDlcBMS_05", getValue( eDlcBMS_05 ), profileFile );

    writeProfileInt( "Settings", "eSendMotor_25", getValue( eSendMotor_25 ), profileFile );
    writeProfileInt( "Settings", "eTMotor_25", getValue( eTMotor_25 ), profileFile );
    writeProfileInt( "Settings", "eTOTMotor_25", getValue( eTOTMotor_25 ), profileFile );
    writeProfileInt( "Settings", "eDlcMotor_25", getValue( eDlcMotor_25 ), profileFile );

    writeProfileInt( "Settings", "eSendMotor_41", getValue( eSendMotor_41 ), profileFile );
    writeProfileInt( "Settings", "eTMotor_41", getValue( eTMotor_41 ), profileFile );
    writeProfileInt( "Settings", "eTOTMotor_41", getValue( eTOTMotor_41 ), profileFile );
    writeProfileInt( "Settings", "eDlcMotor_41", getValue( eDlcMotor_41 ), profileFile );

    writeProfileInt( "Settings", "eSendTM_01", getValue( eSendTM_01 ), profileFile );
    writeProfileInt( "Settings", "eTTM_01", getValue( eTTM_01 ), profileFile );
    writeProfileInt( "Settings", "eTOTTM_01", getValue( eTOTTM_01 ), profileFile );
    writeProfileInt( "Settings", "eDlcTM_01", getValue( eDlcTM_01 ), profileFile );

    writeProfileInt( "Settings", "eSendMotor_31", getValue( eSendMotor_31 ), profileFile );
    writeProfileInt( "Settings", "eTMotor_31", getValue( eTMotor_31 ), profileFile );
    writeProfileInt( "Settings", "eTOTMotor_31", getValue( eTOTMotor_31 ), profileFile );
    writeProfileInt( "Settings", "eDlcMotor_31", getValue( eDlcMotor_31 ), profileFile );

    writeProfileInt( "Settings", "eSendASTA_Sensor_01", getValue( eSendASTA_Sensor_01), profileFile );
    writeProfileInt( "Settings", "eTASTA_Sensor_01", getValue( eTASTA_Sensor_01), profileFile );
    writeProfileInt( "Settings", "eTOTASTA_Sensor_01", getValue( eTOTASTA_Sensor_01), profileFile );
    writeProfileInt( "Settings", "eDlcASTA_Sensor_01", getValue( eDlcASTA_Sensor_01), profileFile );


  //EPB_03
    writeProfileInt( "Settings", "eSendEPB_03", getValue( eSendEPB_03 ), profileFile );
    writeProfileInt( "Settings", "eTEPB_03", getValue( eTEPB_03 ), profileFile );
    writeProfileInt( "Settings", "eTOTEPB_03", getValue( eTOTEPB_03 ), profileFile );
    writeProfileInt( "Settings", "eDlcEPB_03", getValue( eDlcEPB_03 ), profileFile );
    writeProfileInt( "Settings", "eCrcEPB_03", getValue( eCrcEPB_03 ), profileFile );
    writeProfileInt( "Settings", "eBZEPB_03", getValue( eBZEPB_03 ), profileFile );
    writeProfileInt( "Settings", "eBZStepEPB_03", getValue( eBZStepEPB_03 ), profileFile );

  //NMH_STSG_HBFS
    writeProfileInt( "Settings", "eSendNMH_STSG_HBFS", getValue( eSendNMH_STSG_HBFS ), profileFile );
    writeProfileInt( "Settings", "eTNMH_STSG_HBFS", getValue( eTNMH_STSG_HBFS ), profileFile );
    writeProfileInt( "Settings", "eTOTNMH_STSG_HBFS", getValue( eTOTNMH_STSG_HBFS ), profileFile );
    writeProfileInt( "Settings", "eDlcNMH_STSG_HBFS", getValue( eDlcNMH_STSG_HBFS ), profileFile );

  //NMH_STSG_HFS
    writeProfileInt( "Settings", "eSendNMH_STSG_HFS", getValue( eSendNMH_STSG_HFS ), profileFile );
    writeProfileInt( "Settings", "eTNMH_STSG_HFS", getValue( eTNMH_STSG_HFS ), profileFile );
    writeProfileInt( "Settings", "eTOTNMH_STSG_HFS", getValue( eTOTNMH_STSG_HFS ), profileFile );
    writeProfileInt( "Settings", "eDlcNMH_STSG_HFS", getValue( eDlcNMH_STSG_HFS ), profileFile );

  //OBDC_Funktionaler_Req_All
    writeProfileInt( "Settings", "eSendOBDC_Funktionaler_Req_All", getValue( eSendOBDC_Funktionaler_Req_All ), profileFile );
    writeProfileInt( "Settings", "eTOBDC_Funktionaler_Req_All", getValue( eTOBDC_Funktionaler_Req_All ), profileFile );
    writeProfileInt( "Settings", "eTOTOBDC_Funktionaler_Req_All", getValue( eTOTOBDC_Funktionaler_Req_All ), profileFile );
    writeProfileInt( "Settings", "eDlcOBDC_Funktionaler_Req_All", getValue( eDlcOBDC_Funktionaler_Req_All ), profileFile );

  //WFS_Transponder_Req_02
    writeProfileInt( "Settings", "eSendWFS_Transponder_Req_02", getValue( eSendWFS_Transponder_Req_02 ), profileFile );
    writeProfileInt( "Settings", "eTWFS_Transponder_Req_02", getValue( eTWFS_Transponder_Req_02 ), profileFile );
    writeProfileInt( "Settings", "eTOTWFS_Transponder_Req_02", getValue( eTOTWFS_Transponder_Req_02 ), profileFile );
    writeProfileInt( "Settings", "eDlcWFS_Transponder_Req_02", getValue( eDlcWFS_Transponder_Req_02 ), profileFile );

    writeProfileInt( "Settings", "eSendTA_01", getValue( eSendTA_01 ), profileFile );
    writeProfileInt( "Settings", "eTTA_01", getValue( eTTA_01 ), profileFile );
    writeProfileInt( "Settings", "eTOTTA_01", getValue( eTOTTA_01 ), profileFile );
    writeProfileInt( "Settings", "eDlcTA_01", getValue( eDlcTA_01 ), profileFile );
    writeProfileInt( "Settings", "eSendWFS_01", getValue( eSendWFS_01 ), profileFile );
    writeProfileInt( "Settings", "eTWFS_01", getValue( eTWFS_01 ), profileFile );
    writeProfileInt( "Settings", "eTOTWFS_01", getValue( eTOTWFS_01 ), profileFile );
    writeProfileInt( "Settings", "eDlcWFS_01", getValue( eDlcWFS_01 ), profileFile );
    writeProfileInt( "Settings", "eSendNavPos_01", getValue( eSendNavPos_01 ), profileFile );
    writeProfileInt( "Settings", "eTNavPos_01", getValue( eTNavPos_01 ), profileFile );
    writeProfileInt( "Settings", "eTOTNavPos_01", getValue( eTOTNavPos_01 ), profileFile );
    writeProfileInt( "Settings", "eDlcNavPos_01", getValue( eDlcNavPos_01 ), profileFile );

    writeProfileInt( "Settings", "eKL_LRH_StufeS", getValue( eKL_LRH_StufeS ), profileFile );
    writeProfileInt( "Settings", "eNP_LatDirectionS", getValue( eNP_LatDirectionS ), profileFile );
    writeProfileInt( "Settings", "eNP_LongDirectionS", getValue( eNP_LongDirectionS ), profileFile );
    writeProfileInt( "Settings", "eNP_LatDegreeS", getValue( eNP_LatDegreeS ), profileFile );
    writeProfileInt( "Settings", "eNP_LongDegreeS", getValue( eNP_LongDegreeS ), profileFile );
    writeProfileInt( "Settings", "eACC_Wunschgeschw_02S", getValue( eACC_Wunschgeschw_02S ), profileFile );
    writeProfileInt( "Settings", "eACC_Abstand_AbstandswarnerS", getValue( eACC_Abstand_AbstandswarnerS ), profileFile );
    writeProfileInt( "Settings", "eACC_Zeitluecke_AbstandswarnerS", getValue( eACC_Zeitluecke_AbstandswarnerS ), profileFile );
    writeProfileInt( "Settings", "eAB_SBR_hinten_verbauS", getValue( eAB_SBR_hinten_verbauS ), profileFile );
    writeProfileInt( "Settings", "eMO_Anzeige_RekuperationS", getValue( eMO_Anzeige_RekuperationS ), profileFile );
  //GVJ-4663
    writeProfileInt( "Settings", "eSendBCM_03", getValue( eSendBCM_03 ), profileFile );
    writeProfileInt( "Settings", "eTBCM_03", getValue( eTBCM_03 ), profileFile );
    writeProfileInt( "Settings", "eTOTBCM_03", getValue( eTOTBCM_03 ), profileFile );
    writeProfileInt( "Settings", "eDlcBCM_03", getValue( eDlcBCM_03 ), profileFile );

    writeProfileInt( "Settings", "eSendGateway_77", getValue( eSendGateway_77 ), profileFile );
    writeProfileInt( "Settings", "eTGateway_77", getValue( eTGateway_77 ), profileFile );
    writeProfileInt( "Settings", "eTOTGateway_77", getValue( eTOTGateway_77 ), profileFile );
    writeProfileInt( "Settings", "eDlcGateway_77", getValue( eDlcGateway_77 ), profileFile );

    writeProfileInt( "Settings", "eSendGNSS_03", getValue( eSendGNSS_03 ), profileFile );
    writeProfileInt( "Settings", "eTGNSS_03", getValue( eTGNSS_03 ), profileFile );
    writeProfileInt( "Settings", "eTOTGNSS_03", getValue( eTOTGNSS_03 ), profileFile );
    writeProfileInt( "Settings", "eDlcGNSS_03", getValue( eDlcGNSS_03 ), profileFile );
  
    writeProfileInt( "Settings", "eSendGNSS_05", getValue( eSendGNSS_05 ), profileFile );
    writeProfileInt( "Settings", "eTGNSS_05", getValue( eTGNSS_05 ), profileFile );
    writeProfileInt( "Settings", "eTOTGNSS_05", getValue( eTOTGNSS_05 ), profileFile );
    writeProfileInt( "Settings", "eDlcGNSS_05", getValue( eDlcGNSS_05 ), profileFile );

    writeProfileInt( "Settings", "eSendHUD_01", getValue( eSendHUD_01 ), profileFile );
    writeProfileInt( "Settings", "eTHUD_01", getValue( eTHUD_01 ), profileFile );
    writeProfileInt( "Settings", "eTOTHUD_01", getValue( eTOTHUD_01 ), profileFile );
    writeProfileInt( "Settings", "eDlcHUD_01", getValue( eDlcHUD_01 ), profileFile );

    writeProfileInt( "Settings", "eSendHVK_01", getValue( eSendHVK_01 ), profileFile );
    writeProfileInt( "Settings", "eTHVK_01", getValue( eTHVK_01 ), profileFile );
    writeProfileInt( "Settings", "eTOTHVK_01", getValue( eTOTHVK_01 ), profileFile );
    writeProfileInt( "Settings", "eDlcHVK_01", getValue( eDlcHVK_01 ), profileFile );

    writeProfileInt( "Settings", "eSendZentralrechner_03", getValue( eSendZentralrechner_03 ), profileFile );
    writeProfileInt( "Settings", "eTZentralrechner_03", getValue( eTZentralrechner_03 ), profileFile );
    writeProfileInt( "Settings", "eTOTZentralrechner_03", getValue( eTOTZentralrechner_03 ), profileFile );
    writeProfileInt( "Settings", "eDlcZentralrechner_03", getValue( eDlcZentralrechner_03 ), profileFile );

    writeProfileInt( "Settings", "eSendParkhilfe_04", getValue( eSendParkhilfe_04 ), profileFile );
    writeProfileInt( "Settings", "eTParkhilfe_04", getValue( eTParkhilfe_04 ), profileFile );
    writeProfileInt( "Settings", "eTOTParkhilfe_04", getValue( eTOTParkhilfe_04 ), profileFile );
    writeProfileInt( "Settings", "eDlcParkhilfe_04", getValue( eDlcParkhilfe_04 ), profileFile );

    writeProfileInt( "Settings", "eSendMVK_01", getValue( eSendMVK_01 ), profileFile );
    writeProfileInt( "Settings", "eTMVK_01", getValue( eTMVK_01 ), profileFile );
    writeProfileInt( "Settings", "eTOTMVK_01", getValue( eTOTMVK_01 ), profileFile );
    writeProfileInt( "Settings", "eDlcMVK_01", getValue( eDlcMVK_01 ), profileFile );

    writeProfileInt( "Settings", "eSendLoGeWa_03", getValue( eSendLoGeWa_03 ), profileFile );
    writeProfileInt( "Settings", "eTLoGeWa_03", getValue( eTLoGeWa_03 ), profileFile );
    writeProfileInt( "Settings", "eTOTLoGeWa_03", getValue( eTOTLoGeWa_03 ), profileFile );
    writeProfileInt( "Settings", "eDlcLoGeWa_03", getValue( eDlcLoGeWa_03 ), profileFile );

    writeProfileInt( "Settings", "eSendACC_20", getValue( eSendACC_20 ), profileFile );
    writeProfileInt( "Settings", "eTACC_20", getValue( eTACC_20 ), profileFile );
    writeProfileInt( "Settings", "eTOTACC_20", getValue( eTOTACC_20 ), profileFile );
    writeProfileInt( "Settings", "eDlcACC_20", getValue( eDlcACC_20 ), profileFile );

  //GVJ-5409
    writeProfileInt( "Settings", "eSendACC_21", getValue( eSendACC_21 ), profileFile );
    writeProfileInt( "Settings", "eTACC_21", getValue( eTACC_21 ), profileFile );
    writeProfileInt( "Settings", "eTOTACC_21", getValue( eTOTACC_21 ), profileFile );
    writeProfileInt( "Settings", "eDlcACC_21", getValue( eDlcACC_21 ), profileFile );

  //GVJ-5409
    writeProfileInt( "Settings", "eSendAirbag_06", getValue( eSendAirbag_06 ), profileFile );
    writeProfileInt( "Settings", "eTAirbag_06", getValue( eTAirbag_06 ), profileFile );
    writeProfileInt( "Settings", "eTOTAirbag_06", getValue( eTOTAirbag_06 ), profileFile );
    writeProfileInt( "Settings", "eDlcAirbag_06", getValue( eDlcAirbag_06 ), profileFile );

  //GVJ-5409
    writeProfileInt( "Settings", "eSendDCDC_02", getValue( eSendDCDC_02 ), profileFile );
    writeProfileInt( "Settings", "eTDCDC_02", getValue( eTDCDC_02 ), profileFile );
    writeProfileInt( "Settings", "eTOTDCDC_02", getValue( eTOTDCDC_02 ), profileFile );
    writeProfileInt( "Settings", "eDlcDCDC_02", getValue( eDlcDCDC_02 ), profileFile );

  //GVJ-5409
    writeProfileInt( "Settings", "eSendEM1_HYB_13", getValue( eSendEM1_HYB_13 ), profileFile );
    writeProfileInt( "Settings", "eTEM1_HYB_13", getValue( eTEM1_HYB_13 ), profileFile );
    writeProfileInt( "Settings", "eTOTEM1_HYB_13", getValue( eTOTEM1_HYB_13 ), profileFile );
    writeProfileInt( "Settings", "eDlcEM1_HYB_13", getValue( eDlcEM1_HYB_13 ), profileFile );

  //GVJ-5409
    writeProfileInt( "Settings", "eSendHVEM_04", getValue( eSendHVEM_04 ), profileFile );
    writeProfileInt( "Settings", "eTHVEM_04", getValue( eTHVEM_04 ), profileFile );
    writeProfileInt( "Settings", "eTOTHVEM_04", getValue( eTOTHVEM_04 ), profileFile );
    writeProfileInt( "Settings", "eDlcHVEM_04", getValue( eDlcHVEM_04 ), profileFile );

  //GVJ-5409
    writeProfileInt( "Settings", "eSendMotor_EV_01", getValue( eSendMotor_EV_01 ), profileFile );
    writeProfileInt( "Settings", "eTMotor_EV_01", getValue( eTMotor_EV_01 ), profileFile );
    writeProfileInt( "Settings", "eTOTMotor_EV_01", getValue( eTOTMotor_EV_01 ), profileFile );
    writeProfileInt( "Settings", "eDlcMotor_EV_01", getValue( eDlcMotor_EV_01 ), profileFile );

  //GVJ-5409
    writeProfileInt( "Settings", "eSendMotor_EV_03", getValue( eSendMotor_EV_03 ), profileFile );
    writeProfileInt( "Settings", "eTMotor_EV_03", getValue( eTMotor_EV_03 ), profileFile );
    writeProfileInt( "Settings", "eTOTMotor_EV_03", getValue( eTOTMotor_EV_03 ), profileFile );
    writeProfileInt( "Settings", "eDlcMotor_EV_03", getValue( eDlcMotor_EV_03 ), profileFile );

  //GVJ-5409
    writeProfileInt( "Settings", "eSendMotor_Hybrid_03", getValue( eSendMotor_Hybrid_03 ), profileFile );
    writeProfileInt( "Settings", "eTMotor_Hybrid_03", getValue( eTMotor_Hybrid_03 ), profileFile );
    writeProfileInt( "Settings", "eTOTMotor_Hybrid_03", getValue( eTOTMotor_Hybrid_03 ), profileFile );
    writeProfileInt( "Settings", "eDlcMotor_Hybrid_03", getValue( eDlcMotor_Hybrid_03 ), profileFile );

  //GVJ-5409
    writeProfileInt( "Settings", "eSendMotor_Hybrid_06", getValue( eSendMotor_Hybrid_06 ), profileFile );
    writeProfileInt( "Settings", "eTMotor_Hybrid_06", getValue( eTMotor_Hybrid_06 ), profileFile );
    writeProfileInt( "Settings", "eTOTMotor_Hybrid_06", getValue( eTOTMotor_Hybrid_06 ), profileFile );
    writeProfileInt( "Settings", "eDlcMotor_Hybrid_06", getValue( eDlcMotor_Hybrid_06 ), profileFile );

  //GVJ-5409
    writeProfileInt( "Settings", "eSendPreCrash_02", getValue( eSendPreCrash_02 ), profileFile );
    writeProfileInt( "Settings", "eTPreCrash_02", getValue( eTPreCrash_02 ), profileFile );
    writeProfileInt( "Settings", "eTOTPreCrash_02", getValue( eTOTPreCrash_02 ), profileFile );
    writeProfileInt( "Settings", "eDlcPreCrash_02", getValue( eDlcPreCrash_02 ), profileFile );

  //GVJ-5409
    writeProfileInt( "Settings", "eSendSOK_NoAuthenticTime_01", getValue( eSendSOK_NoAuthenticTime_01 ), profileFile );
    writeProfileInt( "Settings", "eTSOK_NoAuthenticTime_01", getValue( eTSOK_NoAuthenticTime_01 ), profileFile );
    writeProfileInt( "Settings", "eTOTSOK_NoAuthenticTime_01", getValue( eTOTSOK_NoAuthenticTime_01 ), profileFile );
    writeProfileInt( "Settings", "eDlcSOK_NoAuthenticTime_01", getValue( eDlcSOK_NoAuthenticTime_01 ), profileFile );

  //GVJ-5409
    writeProfileInt( "Settings", "eSendWaehlhebel_05", getValue( eSendWaehlhebel_05 ), profileFile );
    writeProfileInt( "Settings", "eTWaehlhebel_05", getValue( eTWaehlhebel_05 ), profileFile );
    writeProfileInt( "Settings", "eTOTWaehlhebel_05", getValue( eTOTWaehlhebel_05 ), profileFile );
    writeProfileInt( "Settings", "eDlcWaehlhebel_05", getValue( eDlcWaehlhebel_05 ), profileFile );

  //GVJ-5409
    writeProfileInt( "Settings", "eSendAZK_01", getValue( eSendAZK_01 ), profileFile );
    writeProfileInt( "Settings", "eTAZK_01", getValue( eTAZK_01 ), profileFile );
    writeProfileInt( "Settings", "eTOTAZK_01", getValue( eTOTAZK_01 ), profileFile );
    writeProfileInt( "Settings", "eDlcAZK_01", getValue( eDlcAZK_01 ), profileFile );

    writeProfileInt( "Settings", "eMo_Powermeter_GrenzeS", getValue( eMo_Powermeter_GrenzeS ), profileFile );
    writeProfileInt( "Settings", "eMO_Powermeter_Charge_GrenzeS", getValue( eMO_Powermeter_Charge_GrenzeS ), profileFile );
    writeProfileInt( "Settings", "eMO_Powermeter_Grenze_strategischS", getValue( eMO_Powermeter_Grenze_strategischS ), profileFile );
    writeProfileInt( "Settings", "eMO_Powermeter_untere_E_GrenzeS", getValue( eMO_Powermeter_untere_E_GrenzeS ), profileFile );
    writeProfileInt( "Settings", "eMO_Powermeter_obere_E_GrenzeS", getValue( eMO_Powermeter_obere_E_GrenzeS ), profileFile );

    writeProfileInt( "Settings", "eMO_ePowermeterS", getValue( eMO_ePowermeterS ), profileFile );
    writeProfileInt( "Settings", "eMO_ePerformanceS", getValue( eMO_ePerformanceS ), profileFile );
    writeProfileInt( "Settings", "eMO_Zust_AntriebS", getValue( eMO_Zust_AntriebS ), profileFile );
    writeProfileInt( "Settings", "eLadezustand_02S", getValue( eLadezustand_02S ), profileFile );
    writeProfileInt( "Settings", "eMO_Powermeter_Elm_02S", getValue( eMO_Powermeter_Elm_02S ), profileFile );
    writeProfileInt( "Settings", "eMO_PowermeterS", getValue( eMO_PowermeterS ), profileFile );

    writeProfileInt( "Settings", "eAB_Gurtschloss_Reihe4_FAS", getValue( eAB_Gurtschloss_Reihe4_FAS ), profileFile );
    writeProfileInt( "Settings", "eAB_Gurtschloss_Reihe4_BFS", getValue( eAB_Gurtschloss_Reihe4_BFS ), profileFile );
    writeProfileInt( "Settings", "eAB_Gurtschloss_Reihe4_MIS", getValue( eAB_Gurtschloss_Reihe4_MIS ), profileFile );
    writeProfileInt( "Settings", "eESP_07_altS", getValue( eESP_07_altS ), profileFile );

 	writeProfileInt( "Settings", "eCrcMVK_01", getValue( eCrcMVK_01 ), profileFile );
	writeProfileInt( "Settings", "eBZMVK_01", getValue( eBZMVK_01 ), profileFile );
	writeProfileInt( "Settings", "eBZStepMVK_01", getValue( eBZStepMVK_01 ), profileFile );

}

saveOthers( char profileFile[] )
{
  //Saving
    writeProfileInt(   "Sweeps", "eRPMSweep",  getValue( eRPMSweep ),  profileFile );
    writeProfileInt(   "Sweeps", "eRPMRandom", getValue( eRPMRandom ), profileFile );
    writeProfileInt(   "Sweeps", "eRPMStart",  getValue( eRPMStart ),  profileFile );
    writeProfileInt(   "Sweeps", "eRPMEnd",    getValue( eRPMEnd ),    profileFile );
    writeProfileInt(   "Sweeps", "eRPMSteps",  getValue( eRPMSteps ),  profileFile );
    writeProfileInt(   "Sweeps", "eRPMTime",   getValue( eRPMTime ),   profileFile );

    writeProfileInt(   "Sweeps", "eSpeedInputIsMetric", getValue( eSpeedInputIsMetric ),  profileFile );
    writeProfileFloat( "Sweeps", "eSpeed",              getValue( eSpeed ),               profileFile );

    writeProfileInt(   "Sweeps", "eSpeedPulseCorrelation", getValue( eSpeedPulseCorrelation ), profileFile );
    writeProfileInt(   "Sweeps", "eSpeedSingleSteps",      getValue( eSpeedSingleSteps ),      profileFile );
    writeProfileInt(   "Sweeps", "eSpeedSweep",            getValue( eSpeedSweep ),            profileFile );
    writeProfileInt(   "Sweeps", "eSpeedRandom",           getValue( eSpeedRandom ),           profileFile );
    writeProfileFloat( "Sweeps", "eSpeedStart",            getValue( eSpeedStart ),            profileFile );
    writeProfileFloat( "Sweeps", "eSpeedEnd",              getValue( eSpeedEnd ),              profileFile );
    writeProfileInt(   "Sweeps", "eSpeedSteps",            getValue( eSpeedSteps ),            profileFile );
    writeProfileInt(   "Sweeps", "eSpeedTime",             getValue( eSpeedTime ),             profileFile );
    writeProfileInt(   "Sweeps", "eSpeedPulsesInput",      getValue( eSpeedPulsesInput ),      profileFile );
    writeProfileFloat( "Sweeps", "eSpeedDistanceInput",    getValue( eSpeedDistanceInput ),    profileFile );

    writeProfileInt(   "Sweeps", "eWheelCircumferenceMax",      getValue( eWheelCircumferenceMax ),      profileFile );
    writeProfileInt(   "Sweeps", "eWheelCircumferenceAvg",      getValue( eWheelCircumferenceAvg ),      profileFile );
    writeProfileInt(   "Sweeps", "ePulsesPerHalfWheelRotation", getValue( ePulsesPerHalfWheelRotation ), profileFile );

    writeProfileFloat( "Sweeps", "eConsumption",                getValue( eConsumption ),                profileFile );
    writeProfileFloat( "Sweeps", "eGasConsumption",             getValue( eGasConsumption ),             profileFile );

    writeProfileInt(   "NMHigh", "eNMHStateMachineEnabled", getValue( eNMHStateMachineEnabled ), profileFile );
    writeProfileInt(   "NMHigh", "eNMHControllerNodeAwake", getValue( eNMHControllerNodeAwake ), profileFile );

    writeProfileInt(   "Dimming", "eCalculateKl58d",        getValue( eCalculateKl58d ),         profileFile );

    writeProfileInt(   "Indicator", "eIndicatorOnTime",     getValue( eIndicatorOnTime  ),       profileFile );
    writeProfileInt(   "Indicator", "eIndicatorOffTime",    getValue( eIndicatorOffTime ),       profileFile );

    writeProfileInt(   "MFL",       "eSendMfl",             getValue( eSendMfl ),                profileFile );

    writeProfileInt(   "Sweeps", "eCase_SpeedRPM",            getValue( eCase_SpeedRPM ),            profileFile );
    writeProfileInt(   "Sweeps", "eRPMSpeedTestTimer",        getValue( eRPMSpeedTestTimer ),        profileFile );
}

saveOthers2( char profileFile[] )
{
    writeProfileInt("Settings", "eFunctionAAG", getValue(eFunctionAAG), profileFile);
    writeProfileInt("Settings", "eFunctionACC", getValue(eFunctionACC), profileFile);
    writeProfileInt("Settings", "eFunctionAirbag", getValue(eFunctionAirbag), profileFile);
    writeProfileInt("Settings", "eFunctionBCM1", getValue(eFunctionBCM1), profileFile);
    writeProfileInt("Settings", "eFunctionBFS", getValue(eFunctionBFS), profileFile);
    writeProfileInt("Settings", "eFunctionBremse", getValue(eFunctionBremse), profileFile);
    writeProfileInt("Settings", "eFunctionDaempfer", getValue(eFunctionDaempfer), profileFile);
    writeProfileInt("Settings", "eFunctionELV", getValue(eFunctionELV), profileFile);
    writeProfileInt("Settings", "eFunctionEPB", getValue(eFunctionEPB), profileFile);
    writeProfileInt("Settings", "eFunctionEPS", getValue(eFunctionEPS), profileFile);
    writeProfileInt("Settings", "eFunctionFS", getValue(eFunctionFS), profileFile);
    writeProfileInt("Settings", "eFunctionGateway", getValue(eFunctionGateway), profileFile);
    writeProfileInt("Settings", "eFunctionKessy", getValue(eFunctionKessy), profileFile);
    writeProfileInt("Settings", "eFunctionLDW", getValue(eFunctionLDW), profileFile);
    writeProfileInt("Settings", "eFunctionLWR_AFS", getValue(eFunctionLWR_AFS), profileFile);
    writeProfileInt("Settings", "eFunctionMFG", getValue(eFunctionMFG), profileFile);
    writeProfileInt("Settings", "eFunctionMotor", getValue(eFunctionMotor), profileFile);
    writeProfileInt("Settings", "eFunctionPLA", getValue(eFunctionPLA), profileFile);
    writeProfileInt("Settings", "eFunctionRDK", getValue(eFunctionRDK), profileFile);
    writeProfileInt("Settings", "eFunctionRKA", getValue(eFunctionRKA), profileFile);
    writeProfileInt("Settings", "eFunctionSMLS", getValue(eFunctionSMLS), profileFile);
    writeProfileInt("Settings", "eFunctionSTS", getValue(eFunctionSTS), profileFile);
    writeProfileInt("Settings", "eFunctionSWA", getValue(eFunctionSWA), profileFile);
    writeProfileInt("Settings", "eFunctionTCO", getValue(eFunctionTCO), profileFile);
    writeProfileInt("Settings", "eFunctionTSG_FT", getValue(eFunctionTSG_FT), profileFile);
    writeProfileInt("Settings", "eFunctionWBA", getValue(eFunctionWBA), profileFile);
    writeProfileInt("Settings", "eStartup_AAG", getValue(eStartup_AAG), profileFile);
    writeProfileInt("Settings", "eStartup_ACC", getValue(eStartup_ACC), profileFile);
    writeProfileInt("Settings", "eStartup_Airbag", getValue(eStartup_Airbag), profileFile);
    writeProfileInt("Settings", "eStartup_BCM1", getValue(eStartup_BCM1), profileFile);
    writeProfileInt("Settings", "eStartup_BFS", getValue(eStartup_BFS), profileFile);
    writeProfileInt("Settings", "eStartup_Bremse", getValue(eStartup_Bremse), profileFile);
    writeProfileInt("Settings", "eStartup_Daempfer", getValue(eStartup_Daempfer), profileFile);
    writeProfileInt("Settings", "eStartup_ELV", getValue(eStartup_ELV), profileFile);
    writeProfileInt("Settings", "eStartup_EPB", getValue(eStartup_EPB), profileFile);
    writeProfileInt("Settings", "eStartup_EPS", getValue(eStartup_EPS), profileFile);
    writeProfileInt("Settings", "eStartup_FS", getValue(eStartup_FS), profileFile);
    writeProfileInt("Settings", "eStartup_Gateway", getValue(eStartup_Gateway), profileFile);
    writeProfileInt("Settings", "eStartup_HVEM", getValue(eStartup_HVEM), profileFile);
    writeProfileInt("Settings", "eStartup_HVLM", getValue(eStartup_HVLM), profileFile);
    writeProfileInt("Settings", "eStartup_Kessy", getValue(eStartup_Kessy), profileFile);

    writeProfileInt("Settings", "eStartup_LDW", getValue(eStartup_LDW), profileFile);
    writeProfileInt("Settings", "eStartup_LWR_AFS", getValue(eStartup_LWR_AFS), profileFile);
    writeProfileInt("Settings", "eStartup_MFG", getValue(eStartup_MFG), profileFile);
    writeProfileInt("Settings", "eStartup_Motor", getValue(eStartup_Motor), profileFile);
    writeProfileInt("Settings", "eStartup_PLA", getValue(eStartup_PLA), profileFile);
    writeProfileInt("Settings", "eStartup_RDK", getValue(eStartup_RDK), profileFile);
    writeProfileInt("Settings", "eStartup_RKA", getValue(eStartup_RKA), profileFile);
    writeProfileInt("Settings", "eStartup_Reichweite", getValue(eStartup_Reichweite), profileFile);
    writeProfileInt("Settings", "eStartup_SMLS", getValue(eStartup_SMLS), profileFile);
    writeProfileInt("Settings", "eStartup_STS", getValue(eStartup_STS), profileFile);
    writeProfileInt("Settings", "eStartup_SWA", getValue(eStartup_SWA), profileFile);
    writeProfileInt("Settings", "eStartup_TCO", getValue(eStartup_TCO), profileFile);
    writeProfileInt("Settings", "eStartup_TSG_FT", getValue(eStartup_TSG_FT), profileFile);
    writeProfileInt("Settings", "eStartup_WBA", getValue(eStartup_WBA), profileFile);
}

saveAddtlEnVars( char profileFile[] )
{
    writeProfileInt("Settings" ,"eACC_Typ_Tachokranz_unten" ,getValue(eACC_Typ_Tachokranz_untenS), profileFile);
    writeProfileInt("Settings" ,"eAGA_01_BZS" ,getValue(eAGA_01_BZS), profileFile);
    writeProfileInt("Settings" ,"eAGA_Charisma_FahrPrS" ,getValue(eAGA_Charisma_FahrPrS), profileFile);
    writeProfileInt("Settings" ,"eAGA_Charisma_StatusS" ,getValue(eAGA_Charisma_StatusS), profileFile);
    writeProfileInt("Settings" ,"eAGA_ohne_FunktionS" ,getValue(eAGA_ohne_FunktionS), profileFile);
    writeProfileInt("Settings" ,"eBAP_BC_ASG_02_HeaderS" ,getValue(eBAP_BC_ASG_02_HeaderS), profileFile);
    writeProfileInt("Settings" ,"eBMS_07_BZS" ,getValue(eBMS_07_BZS), profileFile);
    writeProfileInt("Settings" ,"eBMS_07_DummyS" ,getValue(eBMS_07_DummyS), profileFile);
    writeProfileInt("Settings" ,"eBMS_07_NoMsgEnabled" ,getValue(eBMS_07_NoMsgEnabled), profileFile);
    writeProfileInt("Settings" ,"eBMS_07_NoMsgEnabledData" ,getValue(eBMS_07_NoMsgEnabledData), profileFile);
    writeProfileInt("Settings" ,"eBMS_Ausgleichsladung_AnfS" ,getValue(eBMS_Ausgleichsladung_AnfS), profileFile);
    writeProfileInt("Settings" ,"eBMS_Gesamtst_SpgfreiheitS" ,getValue(eBMS_Gesamtst_SpgfreiheitS), profileFile);
    writeProfileInt("Settings" ,"eBMS_MaxEnergieinhaltS" ,getValue(eBMS_MaxEnergieinhaltS), profileFile);
    writeProfileInt("Settings" ,"eChangeAGA_01" ,getValue(eChangeAGA_01), profileFile);
    writeProfileInt("Settings" ,"eChangeBAP_BC_ASG_02" ,getValue(eChangeBAP_BC_ASG_02), profileFile);
    writeProfileInt("Settings" ,"eChangeBMS_07" ,getValue(eChangeBMS_07), profileFile);
    writeProfileInt("Settings" ,"eChangeHSP_01" ,getValue(eChangeHSP_01), profileFile);
    writeProfileInt("Settings" ,"eChangeHVLM_05" ,getValue(eChangeHVLM_05), profileFile);
    writeProfileInt("Settings" ,"eChangeKlemmen_Steuerung_01" ,getValue(eChangeKlemmen_Steuerung_01), profileFile);
    writeProfileInt("Settings" ,"eChangeMainUnit_01" ,getValue(eChangeMainUnit_01), profileFile);
    writeProfileInt("Settings" ,"eChangeReichweite_01" ,getValue(eChangeReichweite_01), profileFile);
    writeProfileInt("Settings" ,"eChangeReichweite_02" ,getValue(eChangeReichweite_02), profileFile);
    writeProfileInt("Settings" ,"eDlcBAP_BC_ASG_02" ,getValue(eDlcBAP_BC_ASG_02), profileFile);
    writeProfileInt("Settings" ,"eDlcDEV_Kombi_UD1_PC_KI_ControlD" ,getValue(eDlcDEV_Kombi_UD1_PC_KI_ControlD), profileFile);
    writeProfileInt("Settings" ,"eDlcDEV_Kombi_UD1_PC_KI_ControlI" ,getValue(eDlcDEV_Kombi_UD1_PC_KI_ControlI), profileFile);
    writeProfileInt("Settings" ,"eDlcKlemmen_Steuerung_01" ,getValue(eDlcKlemmen_Steuerung_01), profileFile);
    writeProfileInt("Settings" ,"eDlcOnceAGA_01" ,getValue(eDlcOnceAGA_01), profileFile);
    writeProfileInt("Settings" ,"eDlcOnceAirbag_02" ,getValue(eDlcOnceAirbag_02), profileFile);
    writeProfileInt("Settings" ,"eDlcOnceAnhaenger_01" ,getValue(eDlcOnceAnhaenger_01), profileFile);
    writeProfileInt("Settings" ,"eDlcOnceARA_Status_01" ,getValue(eDlcOnceARA_Status_01), profileFile);
    writeProfileInt("Settings" ,"eDlcOnceBAP_BC_ASG_02" ,getValue(eDlcOnceBAP_BC_ASG_02), profileFile);
    writeProfileInt("Settings" ,"eDlcOnceBCM_01" ,getValue(eDlcOnceBCM_01), profileFile);
    writeProfileInt("Settings" ,"eDlcOnceBEM_02" ,getValue(eDlcOnceBEM_02), profileFile);
    writeProfileInt("Settings" ,"eDlcOnceBlinkmodi_02" ,getValue(eDlcOnceBlinkmodi_02), profileFile);
    writeProfileInt("Settings" ,"eDlcOnceBMS_07" ,getValue(eDlcOnceBMS_07), profileFile);
    writeProfileInt("Settings" ,"eDlcOnceCharisma_03" ,getValue(eDlcOnceCharisma_03), profileFile);
    writeProfileInt("Settings" ,"eDlcOnceDaempfer_01" ,getValue(eDlcOnceDaempfer_01), profileFile);
    writeProfileInt("Settings" ,"eDlcOnceDEV_Kombi_RX1" ,getValue(eDlcOnceDEV_Kombi_RX1), profileFile);
    writeProfileInt("Settings" ,"eDlcOnceDEV_Kombi_SUP1" ,getValue(eDlcOnceDEV_Kombi_SUP1), profileFile);
    writeProfileInt("Settings" ,"eDlcOnceDEV_Kombi_SUP2" ,getValue(eDlcOnceDEV_Kombi_SUP2), profileFile);
    writeProfileInt("Settings" ,"eDlcOnceDEV_Kombi_SUP3" ,getValue(eDlcOnceDEV_Kombi_SUP3), profileFile);
    writeProfileInt("Settings" ,"eDlcOnceDEV_Kombi_UD1_PC_KI_Cont" ,getValue(eDlcOnceDEV_Kombi_UD1_PC_KI_Cont), profileFile);
    writeProfileInt("Settings" ,"eDlcOnceDEV_Kombi_UD2_PC_KI_Data" ,getValue(eDlcOnceDEV_Kombi_UD2_PC_KI_Data), profileFile);
    writeProfileInt("Settings" ,"eDlcOnceDiagnose_01" ,getValue(eDlcOnceDiagnose_01), profileFile);
    writeProfileInt("Settings" ,"eDlcOnceDimmung_01" ,getValue(eDlcOnceDimmung_01), profileFile);
    writeProfileInt("Settings" ,"eDlcOnceELV_01" ,getValue(eDlcOnceELV_01), profileFile);
    writeProfileInt("Settings" ,"eDlcOnceESP_02" ,getValue(eDlcOnceESP_02), profileFile);
    writeProfileInt("Settings" ,"eDlcOnceESP_20" ,getValue(eDlcOnceESP_20), profileFile);
    writeProfileInt("Settings" ,"eDlcOnceESP_21" ,getValue(eDlcOnceESP_21), profileFile);
    writeProfileInt("Settings" ,"eDlcOnceESP_24" ,getValue(eDlcOnceESP_24), profileFile);
    writeProfileInt("Settings" ,"eDlcOnceGateway_73" ,getValue(eDlcOnceGateway_73), profileFile);
    writeProfileInt("Settings" ,"eDlcOnceGateway_78" ,getValue(eDlcOnceGateway_78), profileFile);
    writeProfileInt("Settings" ,"eDlcOnceHSP_01" ,getValue(eDlcOnceHSP_01), profileFile);
    writeProfileInt("Settings" ,"eDlcOnceHVLM_05" ,getValue(eDlcOnceHVLM_05), profileFile);
    writeProfileInt("Settings" ,"eDlcOnceISO_Funktionaler_Req_All" ,getValue(eDlcOnceISO_Funktionaler_Req_All), profileFile);
    writeProfileInt("Settings" ,"eDlcOnceISO_Kombi_Req" ,getValue(eDlcOnceISO_Kombi_Req), profileFile);
    writeProfileInt("Settings" ,"eDlcOnceKessy_04" ,getValue(eDlcOnceKessy_04), profileFile);
    writeProfileInt("Settings" ,"eDlcOnceKlemmen_Status_01" ,getValue(eDlcOnceKlemmen_Status_01), profileFile);
    writeProfileInt("Settings" ,"eDlcOnceKlemmen_Steuerung_01" ,getValue(eDlcOnceKlemmen_Steuerung_01), profileFile);
    writeProfileInt("Settings" ,"eDlcOnceKlima_Sensor_02" ,getValue(eDlcOnceKlima_Sensor_02), profileFile);
    writeProfileInt("Settings" ,"eDlcOnceKS_Kombi_Req" ,getValue(eDlcOnceKS_Kombi_Req), profileFile);
    writeProfileInt("Settings" ,"eDlcOnceLDW_02" ,getValue(eDlcOnceLDW_02), profileFile);
    writeProfileInt("Settings" ,"eDlcOnceLH_EPS_01" ,getValue(eDlcOnceLH_EPS_01), profileFile);
    writeProfileInt("Settings" ,"eDlcOnceLicht_Anf_01" ,getValue(eDlcOnceLicht_Anf_01), profileFile);
    writeProfileInt("Settings" ,"eDlcOnceLicht_hinten_01" ,getValue(eDlcOnceLicht_hinten_01), profileFile);
    writeProfileInt("Settings" ,"eDlcOnceLicht_vorne_01" ,getValue(eDlcOnceLicht_vorne_01), profileFile);
    writeProfileInt("Settings" ,"eDlcOnceLog_Datenlogger_Req" ,getValue(eDlcOnceLog_Datenlogger_Req), profileFile);
    writeProfileInt("Settings" ,"eDlcOnceLog_Kombi_Req" ,getValue(eDlcOnceLog_Kombi_Req), profileFile);
    writeProfileInt("Settings" ,"eDlcOnceLWR_AFS_01" ,getValue(eDlcOnceLWR_AFS_01), profileFile);
    writeProfileInt("Settings" ,"eDlcOnceMainUnit_01" ,getValue(eDlcOnceMainUnit_01), profileFile);
    writeProfileInt("Settings" ,"eDlcOnceMem_BFS_01" ,getValue(eDlcOnceMem_BFS_01), profileFile);
    writeProfileInt("Settings" ,"eDlcOnceMem_FS_01" ,getValue(eDlcOnceMem_FS_01), profileFile);
    writeProfileInt("Settings" ,"eDlcOnceMFG_01" ,getValue(eDlcOnceMFG_01), profileFile);
    writeProfileInt("Settings" ,"eDlcOnceMFL_Tasten_Kon_01" ,getValue(eDlcOnceMFL_Tasten_Kon_01), profileFile);
    writeProfileInt("Settings" ,"eDlcOnceMotor_04" ,getValue(eDlcOnceMotor_04), profileFile);
    writeProfileInt("Settings" ,"eDlcOnceMotor_07" ,getValue(eDlcOnceMotor_07), profileFile);
    writeProfileInt("Settings" ,"eDlcOnceMotor_09" ,getValue(eDlcOnceMotor_09), profileFile);
    writeProfileInt("Settings" ,"eDlcOnceMotor_14" ,getValue(eDlcOnceMotor_14), profileFile);
    writeProfileInt("Settings" ,"eDlcOnceMotor_18" ,getValue(eDlcOnceMotor_18), profileFile);
    writeProfileInt("Settings" ,"eDlcOnceMotor_26" ,getValue(eDlcOnceMotor_26), profileFile);
    writeProfileInt("Settings" ,"eDlcOnceMotor_Code_01" ,getValue(eDlcOnceMotor_Code_01), profileFile);
    writeProfileInt("Settings" ,"eDlcOnceMotor_Gas_01" ,getValue(eDlcOnceMotor_Gas_01), profileFile);
    writeProfileInt("Settings" ,"eDlcOnceNMH_Gateway" ,getValue(eDlcOnceNMH_Gateway), profileFile);
    writeProfileInt("Settings" ,"eDlcOncePLA_Status_02" ,getValue(eDlcOncePLA_Status_02), profileFile);
    writeProfileInt("Settings" ,"eDlcOnceRDK_01" ,getValue(eDlcOnceRDK_01), profileFile);
    writeProfileInt("Settings" ,"eDlcOnceReichweite_01" ,getValue(eDlcOnceReichweite_01), profileFile);
    writeProfileInt("Settings" ,"eDlcOnceReichweite_02" ,getValue(eDlcOnceReichweite_02), profileFile);
    writeProfileInt("Settings" ,"eDlcOnceRKA_01" ,getValue(eDlcOnceRKA_01), profileFile);
    writeProfileInt("Settings" ,"eDlcOnceRLS_01" ,getValue(eDlcOnceRLS_01), profileFile);
    writeProfileInt("Settings" ,"eDlcOnceSMLS_01" ,getValue(eDlcOnceSMLS_01), profileFile);
    writeProfileInt("Settings" ,"eDlcOnceSTH_01" ,getValue(eDlcOnceSTH_01), profileFile);
    writeProfileInt("Settings" ,"eDlcOnceSWA_01" ,getValue(eDlcOnceSWA_01), profileFile);
    writeProfileInt("Settings" ,"eDlcOnceSysteminfo_01" ,getValue(eDlcOnceSysteminfo_01), profileFile);
    writeProfileInt("Settings" ,"eDlcOnceTCO_01" ,getValue(eDlcOnceTCO_01), profileFile);
    writeProfileInt("Settings" ,"eDlcOnceTimeDate" ,getValue(eDlcOnceTimeDate), profileFile);
    writeProfileInt("Settings" ,"eDlcOnceTSG_FT_01" ,getValue(eDlcOnceTSG_FT_01), profileFile);
    writeProfileInt("Settings" ,"eDlcOnceTSG_FT_02" ,getValue(eDlcOnceTSG_FT_02), profileFile);
    writeProfileInt("Settings" ,"eDlcOnceTSK_07" ,getValue(eDlcOnceTSK_07), profileFile);
    writeProfileInt("Settings" ,"eDlcOnceVehiDist" ,getValue(eDlcOnceVehiDist), profileFile);
    writeProfileInt("Settings" ,"eDlcOnceWischer_01" ,getValue(eDlcOnceWischer_01), profileFile);
    writeProfileInt("Settings" ,"eDlcOnceWIV_01" ,getValue(eDlcOnceWIV_01), profileFile);
    writeProfileInt("Settings" ,"eDlcOnceZV_02" ,getValue(eDlcOnceZV_02), profileFile);
    writeProfileInt("Settings" ,"eDlcWrongAGA_01" ,getValue(eDlcWrongAGA_01), profileFile);
    writeProfileInt("Settings" ,"eDlcWrongAirbag_02" ,getValue(eDlcWrongAirbag_02), profileFile);
    writeProfileInt("Settings" ,"eDlcWrongAnhaenger_01" ,getValue(eDlcWrongAnhaenger_01), profileFile);
    writeProfileInt("Settings" ,"eDlcWrongARA_Status_01" ,getValue(eDlcWrongARA_Status_01), profileFile);
    writeProfileInt("Settings" ,"eDlcWrongBAP_BC_ASG_02" ,getValue(eDlcWrongBAP_BC_ASG_02), profileFile);
    writeProfileInt("Settings" ,"eDlcWrongBCM_01" ,getValue(eDlcWrongBCM_01), profileFile);
    writeProfileInt("Settings" ,"eDlcWrongBEM_02" ,getValue(eDlcWrongBEM_02), profileFile);
    writeProfileInt("Settings" ,"eDlcWrongBlinkmodi_02" ,getValue(eDlcWrongBlinkmodi_02), profileFile);
    writeProfileInt("Settings" ,"eDlcWrongBMS_07" ,getValue(eDlcWrongBMS_07), profileFile);
    writeProfileInt("Settings" ,"eDlcWrongCharisma_03" ,getValue(eDlcWrongCharisma_03), profileFile);
    writeProfileInt("Settings" ,"eDlcWrongDaempfer_01" ,getValue(eDlcWrongDaempfer_01), profileFile);
    writeProfileInt("Settings" ,"eDlcWrongDEV_Kombi_RX1" ,getValue(eDlcWrongDEV_Kombi_RX1), profileFile);
    writeProfileInt("Settings" ,"eDlcWrongDEV_Kombi_SUP1" ,getValue(eDlcWrongDEV_Kombi_SUP1), profileFile);
    writeProfileInt("Settings" ,"eDlcWrongDEV_Kombi_SUP2" ,getValue(eDlcWrongDEV_Kombi_SUP2), profileFile);
    writeProfileInt("Settings" ,"eDlcWrongDEV_Kombi_SUP3" ,getValue(eDlcWrongDEV_Kombi_SUP3), profileFile);
    writeProfileInt("Settings" ,"eDlcWrongDEV_Kombi_UD1_PC_KI_Con" ,getValue(eDlcWrongDEV_Kombi_UD1_PC_KI_Con), profileFile);
    writeProfileInt("Settings" ,"eDlcWrongDEV_Kombi_UD2_PC_KI_Dat" ,getValue(eDlcWrongDEV_Kombi_UD2_PC_KI_Dat), profileFile);
    writeProfileInt("Settings" ,"eDlcWrongDiagnose_01" ,getValue(eDlcWrongDiagnose_01), profileFile);
    writeProfileInt("Settings" ,"eDlcWrongDimmung_01" ,getValue(eDlcWrongDimmung_01), profileFile);
    writeProfileInt("Settings" ,"eDlcWrongELV_01" ,getValue(eDlcWrongELV_01), profileFile);
    writeProfileInt("Settings" ,"eDlcWrongESP_02" ,getValue(eDlcWrongESP_02), profileFile);
    writeProfileInt("Settings" ,"eDlcWrongESP_20" ,getValue(eDlcWrongESP_20), profileFile);
    writeProfileInt("Settings" ,"eDlcWrongESP_21" ,getValue(eDlcWrongESP_21), profileFile);
    writeProfileInt("Settings" ,"eDlcWrongESP_24" ,getValue(eDlcWrongESP_24), profileFile);
    writeProfileInt("Settings" ,"eDlcWrongGateway_73" ,getValue(eDlcWrongGateway_73), profileFile);
    writeProfileInt("Settings" ,"eDlcWrongGateway_78" ,getValue(eDlcWrongGateway_78), profileFile);
    writeProfileInt("Settings" ,"eDlcWrongHSP_01" ,getValue(eDlcWrongHSP_01), profileFile);
    writeProfileInt("Settings" ,"eDlcWrongHVLM_05" ,getValue(eDlcWrongHVLM_05), profileFile);
    writeProfileInt("Settings" ,"eDlcWrongISO_Funktionaler_Req_Al" ,getValue(eDlcWrongISO_Funktionaler_Req_Al), profileFile);
    writeProfileInt("Settings" ,"eDlcWrongISO_Kombi_Req" ,getValue(eDlcWrongISO_Kombi_Req), profileFile);
    writeProfileInt("Settings" ,"eDlcWrongKessy_04" ,getValue(eDlcWrongKessy_04), profileFile);
    writeProfileInt("Settings" ,"eDlcWrongKlemmen_Status_01" ,getValue(eDlcWrongKlemmen_Status_01), profileFile);
    writeProfileInt("Settings" ,"eDlcWrongKlemmen_Steuerung_01" ,getValue(eDlcWrongKlemmen_Steuerung_01), profileFile);
    writeProfileInt("Settings" ,"eDlcWrongKlima_Sensor_02" ,getValue(eDlcWrongKlima_Sensor_02), profileFile);
    writeProfileInt("Settings" ,"eDlcWrongKS_Kombi_Req" ,getValue(eDlcWrongKS_Kombi_Req), profileFile);
    writeProfileInt("Settings" ,"eDlcWrongLDW_02" ,getValue(eDlcWrongLDW_02), profileFile);
    writeProfileInt("Settings" ,"eDlcWrongLH_EPS_01" ,getValue(eDlcWrongLH_EPS_01), profileFile);
    writeProfileInt("Settings" ,"eDlcWrongLicht_Anf_01" ,getValue(eDlcWrongLicht_Anf_01), profileFile);
    writeProfileInt("Settings" ,"eDlcWrongLicht_hinten_01" ,getValue(eDlcWrongLicht_hinten_01), profileFile);
    writeProfileInt("Settings" ,"eDlcWrongLicht_vorne_01" ,getValue(eDlcWrongLicht_vorne_01), profileFile);
    writeProfileInt("Settings" ,"eDlcWrongLog_Datenlogger_Req" ,getValue(eDlcWrongLog_Datenlogger_Req), profileFile);
    writeProfileInt("Settings" ,"eDlcWrongLog_Kombi_Req" ,getValue(eDlcWrongLog_Kombi_Req), profileFile);
    writeProfileInt("Settings" ,"eDlcWrongLWR_AFS_01" ,getValue(eDlcWrongLWR_AFS_01), profileFile);
    writeProfileInt("Settings" ,"eDlcWrongMainUnit_01" ,getValue(eDlcWrongMainUnit_01), profileFile);
    writeProfileInt("Settings" ,"eDlcWrongMem_BFS_01" ,getValue(eDlcWrongMem_BFS_01), profileFile);
    writeProfileInt("Settings" ,"eDlcWrongMem_FS_01" ,getValue(eDlcWrongMem_FS_01), profileFile);
    writeProfileInt("Settings" ,"eDlcWrongMFG_01" ,getValue(eDlcWrongMFG_01), profileFile);
    writeProfileInt("Settings" ,"eDlcWrongMFL_Tasten_Kon_01" ,getValue(eDlcWrongMFL_Tasten_Kon_01), profileFile);
    writeProfileInt("Settings" ,"eDlcWrongMotor_04" ,getValue(eDlcWrongMotor_04), profileFile);
    writeProfileInt("Settings" ,"eDlcWrongMotor_07" ,getValue(eDlcWrongMotor_07), profileFile);
    writeProfileInt("Settings" ,"eDlcWrongMotor_09" ,getValue(eDlcWrongMotor_09), profileFile);
    writeProfileInt("Settings" ,"eDlcWrongMotor_14" ,getValue(eDlcWrongMotor_14), profileFile);
    writeProfileInt("Settings" ,"eDlcWrongMotor_18" ,getValue(eDlcWrongMotor_18), profileFile);
    writeProfileInt("Settings" ,"eDlcWrongMotor_26" ,getValue(eDlcWrongMotor_26), profileFile);
    writeProfileInt("Settings" ,"eDlcWrongMotor_Code_01" ,getValue(eDlcWrongMotor_Code_01), profileFile);
    writeProfileInt("Settings" ,"eDlcWrongMotor_Gas_01" ,getValue(eDlcWrongMotor_Gas_01), profileFile);
    writeProfileInt("Settings" ,"eDlcWrongNMH_Gateway" ,getValue(eDlcWrongNMH_Gateway), profileFile);
    writeProfileInt("Settings" ,"eDlcWrongPLA_Status_02" ,getValue(eDlcWrongPLA_Status_02), profileFile);
    writeProfileInt("Settings" ,"eDlcWrongRDK_01" ,getValue(eDlcWrongRDK_01), profileFile);
    writeProfileInt("Settings" ,"eDlcWrongReichweite_01" ,getValue(eDlcWrongReichweite_01), profileFile);
    writeProfileInt("Settings" ,"eDlcWrongReichweite_02" ,getValue(eDlcWrongReichweite_02), profileFile);
    writeProfileInt("Settings" ,"eDlcWrongRKA_01" ,getValue(eDlcWrongRKA_01), profileFile);
    writeProfileInt("Settings" ,"eDlcWrongRLS_01" ,getValue(eDlcWrongRLS_01), profileFile);
    writeProfileInt("Settings" ,"eDlcWrongSMLS_01" ,getValue(eDlcWrongSMLS_01), profileFile);
    writeProfileInt("Settings" ,"eDlcWrongSTH_01" ,getValue(eDlcWrongSTH_01), profileFile);
    writeProfileInt("Settings" ,"eDlcWrongSWA_01" ,getValue(eDlcWrongSWA_01), profileFile);
    writeProfileInt("Settings" ,"eDlcWrongSysteminfo_01" ,getValue(eDlcWrongSysteminfo_01), profileFile);
    writeProfileInt("Settings" ,"eDlcWrongTCO_01" ,getValue(eDlcWrongTCO_01), profileFile);
    writeProfileInt("Settings" ,"eDlcWrongTimeDate" ,getValue(eDlcWrongTimeDate), profileFile);
    writeProfileInt("Settings" ,"eDlcWrongTSG_FT_01" ,getValue(eDlcWrongTSG_FT_01), profileFile);
    writeProfileInt("Settings" ,"eDlcWrongTSG_FT_02" ,getValue(eDlcWrongTSG_FT_02), profileFile);
    writeProfileInt("Settings" ,"eDlcWrongTSK_07" ,getValue(eDlcWrongTSK_07), profileFile);
    writeProfileInt("Settings" ,"eDlcWrongVehiDist" ,getValue(eDlcWrongVehiDist), profileFile);
    writeProfileInt("Settings" ,"eDlcWrongWischer_01" ,getValue(eDlcWrongWischer_01), profileFile);
    writeProfileInt("Settings" ,"eDlcWrongWIV_01" ,getValue(eDlcWrongWIV_01), profileFile);
    writeProfileInt("Settings" ,"eDlcWrongZV_02" ,getValue(eDlcWrongZV_02), profileFile);
    writeProfileInt("Settings" ,"eDSSS_WarningS" ,getValue( KCAN_DSSS_Warning ), profileFile);
    writeProfileInt("Settings" ,"eEBKV_HinweiseS" ,getValue(eEBKV_HinweiseS), profileFile);
    writeProfileInt("Settings" ,"eEBKV_OBD_StatusS" ,getValue(eEBKV_OBD_StatusS), profileFile);
    writeProfileInt("Settings" ,"eEBKV_WarnungenS" ,getValue(eEBKV_WarnungenS), profileFile);
    writeProfileInt("Settings" ,"eELV_KST_Txt_Komfortabschaltung" ,getValue(eELV_KST_Txt_Komfortabschaltung), profileFile);
    writeProfileInt("Settings" ,"eEnrgfluss_StateS" ,getValue(eEnrgfluss_StateS), profileFile);
    writeProfileInt("Settings" ,"eGE_Sollgang" ,getValue(eGE_Sollgang), profileFile);
    writeProfileInt("Settings" ,"eGE_Tipschaltempf_verfuegbar" ,getValue(eGE_Tipschaltempf_verfuegbar), profileFile);
    writeProfileInt("Settings" ,"eGong_TFL_Umschaltung" ,getValue(eGong_TFL_Umschaltung), profileFile);
    writeProfileInt("Settings" ,"eHSP_Warnung_Text" ,getValue(eHSP_Warnung_Text), profileFile);
    writeProfileInt("Settings" ,"eHV_Bordnetz_aktivS" ,getValue(eHV_Bordnetz_aktivS), profileFile);
    writeProfileInt("Settings" ,"eHVEM_Anf_ReichweiteNVS" ,getValue(eHVEM_Anf_ReichweiteNVS), profileFile);
    writeProfileInt("Settings" ,"eHVEM_HV_AnfS" ,getValue(eHVEM_HV_AnfS), profileFile);
    writeProfileInt("Settings" ,"eHVEM_KlimaMaxHVStromS" ,getValue(eHVEM_KlimaMaxHVStromS), profileFile);
    writeProfileInt("Settings" ,"eHVEM_LeistungsAnfS" ,getValue(eHVEM_LeistungsAnfS), profileFile);
    writeProfileInt("Settings" ,"eHVEM_Nachlad_StatusS" ,getValue(eHVEM_Nachlad_StatusS), profileFile);
    writeProfileInt("Settings" ,"eHVEM_Nachladen_AnfS" ,getValue(eHVEM_Nachladen_AnfS), profileFile);
    writeProfileInt("Settings" ,"eHVEM_NVLeistungEmpfS" ,getValue(eHVEM_NVLeistungEmpfS), profileFile);
    writeProfileInt("Settings" ,"eHVEM_Text_1S" ,getValue(eHVEM_Text_1S), profileFile);
    writeProfileInt("Settings" ,"eHVLM_Klima_TempS" ,getValue(eHVLM_Klima_TempS), profileFile);
    writeProfileInt("Settings" ,"eHVLM_LadeartS" ,getValue(eHVLM_LadeartS), profileFile);
    writeProfileInt("Settings" ,"eHVLM_Lademodus_HV_BatS" ,getValue(eHVLM_Lademodus_HV_BatS), profileFile);
    writeProfileInt("Settings" ,"eHVLM_LadesystemhinweiseS" ,getValue(eHVLM_LadesystemhinweiseS), profileFile);
    writeProfileInt("Settings" ,"eHVLM_Langzeit_LadenS" ,getValue(eHVLM_Langzeit_LadenS), profileFile);
    writeProfileInt("Settings" ,"eHVLM_Restladezeit_HV_BatS" ,getValue(eHVLM_Restladezeit_HV_BatS), profileFile);
    writeProfileInt("Settings" ,"eHVLM_Stecker_StatusS" ,getValue(eHVLM_Stecker_StatusS), profileFile);
    writeProfileInt("Settings" ,"eHVLM_VK_AnfS" ,getValue(eHVLM_VK_AnfS), profileFile);
    writeProfileInt("Settings" ,"eISO_Kombi_Resp_DataD" ,getValue(eISO_Kombi_Resp_DataD), profileFile);
    writeProfileInt("Settings" ,"eKBI_ABS_LampeD" ,getValue(eKBI_ABS_LampeD), profileFile);
    writeProfileInt("Settings" ,"eKBI_Airbag_LampeD" ,getValue(eKBI_Airbag_LampeD), profileFile);
    writeProfileInt("Settings" ,"eKBI_angez_GeschwD" ,getValue(eKBI_angez_GeschwD), profileFile);
    writeProfileInt("Settings" ,"eKBI_Anzeigefehler_LDWD" ,getValue(eKBI_Anzeigefehler_LDWD), profileFile);
    writeProfileInt("Settings" ,"eKBI_Anzeigefehler_NVD" ,getValue(eKBI_Anzeigefehler_NVD), profileFile);
    writeProfileInt("Settings" ,"eKBI_Anzeigefehler_SWAD" ,getValue(eKBI_Anzeigefehler_SWAD), profileFile);
    writeProfileInt("Settings" ,"eKBI_Anzeigestatus_ACCD" ,getValue(eKBI_Anzeigestatus_ACCD), profileFile);
    writeProfileInt("Settings" ,"eKBI_Anzeigestatus_GRAD" ,getValue(eKBI_Anzeigestatus_GRAD), profileFile);
    writeProfileInt("Settings" ,"eKBI_Anzeigestatus_LIMD" ,getValue(eKBI_Anzeigestatus_LIMD), profileFile);
    writeProfileInt("Settings" ,"eKBI_Aussen_Temp_gefD" ,getValue(eKBI_Aussen_Temp_gefD), profileFile);
    writeProfileInt("Settings" ,"eKBI_BCmE_aktivD" ,getValue(eKBI_BCmE_aktivD), profileFile);
    writeProfileInt("Settings" ,"eKBI_BKL_LampeD" ,getValue(eKBI_BKL_LampeD), profileFile);
    writeProfileInt("Settings" ,"eKBI_DimmpotiD" ,getValue(eKBI_DimmpotiD), profileFile);
    writeProfileInt("Settings" ,"eKBI_Einheit_DatumD" ,getValue(eKBI_Einheit_DatumD), profileFile);
    writeProfileInt("Settings" ,"eKBI_Einheit_DruckD" ,getValue(eKBI_Einheit_DruckD), profileFile);
    writeProfileInt("Settings" ,"eKBI_Einheit_SpracheD" ,getValue(eKBI_Einheit_SpracheD), profileFile);
    writeProfileInt("Settings" ,"eKBI_Einheit_StreckenanzD" ,getValue(eKBI_Einheit_StreckenanzD), profileFile);
    writeProfileInt("Settings" ,"eKBI_Einheit_TachoD" ,getValue(eKBI_Einheit_TachoD), profileFile);
    writeProfileInt("Settings" ,"eKBI_Einheit_TempD" ,getValue(eKBI_Einheit_TempD), profileFile);
    writeProfileInt("Settings" ,"eKBI_Einheit_UhrzeitD" ,getValue(eKBI_Einheit_UhrzeitD), profileFile);
    writeProfileInt("Settings" ,"eKBI_Einheit_Verbrauch_elektrD" ,getValue(eKBI_Einheit_Verbrauch_elektrD), profileFile);
    writeProfileInt("Settings" ,"eKBI_Einheit_VerbrauchD" ,getValue(eKBI_Einheit_VerbrauchD), profileFile);
    writeProfileInt("Settings" ,"eKBI_Einheit_VolumenD" ,getValue(eKBI_Einheit_VolumenD), profileFile);
    writeProfileInt("Settings" ,"eKBI_ESP_LampeD" ,getValue(eKBI_ESP_LampeD), profileFile);
    writeProfileInt("Settings" ,"eKBI_Fehler_Anzeige_ACCD" ,getValue(eKBI_Fehler_Anzeige_ACCD), profileFile);
    writeProfileInt("Settings" ,"eKBI_FStatus_TankD" ,getValue(eKBI_FStatus_TankD), profileFile);
    writeProfileInt("Settings" ,"eKBI_HandbremseD" ,getValue(eKBI_HandbremseD), profileFile);
    writeProfileInt("Settings" ,"eKBI_im_StellgliedtestD" ,getValue(eKBI_im_StellgliedtestD), profileFile);
    writeProfileInt("Settings" ,"eKBI_Inhalt_TankD" ,getValue(eKBI_Inhalt_TankD), profileFile);
    writeProfileInt("Settings" ,"eKBI_KD_FehlerD" ,getValue(eKBI_KD_FehlerD), profileFile);
    writeProfileInt("Settings" ,"eKBI_Konsistenz_ACCD" ,getValue(eKBI_Konsistenz_ACCD), profileFile);
    writeProfileInt("Settings" ,"eKBI_Lenkung_LampeD" ,getValue(eKBI_Lenkung_LampeD), profileFile);
    writeProfileInt("Settings" ,"eKBI_MFA_v_Einheit_01D" ,getValue(eKBI_MFA_v_Einheit_01D), profileFile);
    writeProfileInt("Settings" ,"eKBI_MFA_v_Einheit_02D" ,getValue(eKBI_MFA_v_Einheit_02D), profileFile);
    writeProfileInt("Settings" ,"eKBI_Nachtanken_erkanntD" ,getValue(eKBI_Nachtanken_erkanntD), profileFile);
    writeProfileInt("Settings" ,"eKBI_NV_in_AnzeigeD" ,getValue(eKBI_NV_in_AnzeigeD), profileFile);
    writeProfileInt("Settings" ,"eKBI_Oeldruck_SchalterD" ,getValue(eKBI_Oeldruck_SchalterD), profileFile);
    writeProfileInt("Settings" ,"eKBI_OeldruckwarnungD" ,getValue(eKBI_OeldruckwarnungD), profileFile);
    writeProfileInt("Settings" ,"eKBI_Oelwechsel_durchgefuehrtD" ,getValue(eKBI_Oelwechsel_durchgefuehrtD), profileFile);
    writeProfileInt("Settings" ,"eKBI_PhototransistorD" ,getValue(eKBI_PhototransistorD), profileFile);
    writeProfileInt("Settings" ,"eKBI_PLA_in_AnzeigeD" ,getValue(eKBI_PLA_in_AnzeigeD), profileFile);
    writeProfileInt("Settings" ,"eKBI_QBit_Aussen_Temp_gefD" ,getValue(eKBI_QBit_Aussen_Temp_gefD), profileFile);
    writeProfileInt("Settings" ,"eKBI_ReifenumfangD" ,getValue(eKBI_ReifenumfangD), profileFile);
    writeProfileInt("Settings" ,"eKBI_SILA_gueltigD" ,getValue(eKBI_SILA_gueltigD), profileFile);
    writeProfileInt("Settings" ,"eKBI_Sparhinweis_quittiertD" ,getValue(eKBI_Sparhinweis_quittiertD), profileFile);
    writeProfileInt("Settings" ,"eKBI_Standzeit_02D" ,getValue(eKBI_Standzeit_02D), profileFile);
    writeProfileInt("Settings" ,"eKBI_Tankfuellstand_ProzentD" ,getValue(eKBI_Tankfuellstand_ProzentD), profileFile);
    writeProfileInt("Settings" ,"eKBI_Tankinhalt_hochauflD" ,getValue(eKBI_Tankinhalt_hochauflD), profileFile);
    writeProfileInt("Settings" ,"eKBI_TankwarnungD" ,getValue(eKBI_TankwarnungD), profileFile);
    writeProfileInt("Settings" ,"eKBI_V_DigitalD" ,getValue(eKBI_V_DigitalD), profileFile);
    writeProfileInt("Settings" ,"eKBI_Variante_USAD" ,getValue(eKBI_Variante_USAD), profileFile);
    writeProfileInt("Settings" ,"eKBI_Vorglueh_System_LampeD" ,getValue(eKBI_Vorglueh_System_LampeD), profileFile);
    writeProfileInt("Settings" ,"eKombi_01_BZD" ,getValue(eKombi_01_BZD), profileFile);
    writeProfileInt("Settings" ,"eKombi_NachlauftypD" ,getValue(eKombi_NachlauftypD), profileFile);
    writeProfileInt("Settings" ,"eKS_Kombi_Resp_DataD" ,getValue(eKS_Kombi_Resp_DataD), profileFile);
    writeProfileInt("Settings" ,"eKST_Txt_Komfortabschaltung_KST" ,getValue(eKST_Txt_Komfortabschaltung_KST), profileFile);
    writeProfileInt("Settings" ,"eKST_Txt_P_GangS" ,getValue(eKST_Txt_P_GangS), profileFile);
    writeProfileInt("Settings" ,"eKST_Txt_PanikabschaltungS" ,getValue(eKST_Txt_PanikabschaltungS), profileFile);
    writeProfileInt("Settings" ,"eKST_Txt_WerkstattS" ,getValue(eKST_Txt_WerkstattS), profileFile);
    writeProfileInt("Settings" ,"eKST_Unterdr_Dummy" ,getValue(eKST_Unterdr_Dummy), profileFile);
    writeProfileInt("Settings" ,"eKST_Unterdr_ZuendungsmeldungS" ,getValue(eKST_Unterdr_ZuendungsmeldungS), profileFile);
    writeProfileInt("Settings" ,"eKST_Warn_P2_ZST_def" ,getValue(eKST_Warn_P2_ZST_def), profileFile);
    writeProfileInt("Settings" ,"eLDW_Lernmodus_seitenabhaengigDec" ,getValue(eLDW_Lernmodus_seitenabhaengigDec), profileFile);
    writeProfileInt("Settings" ,"eLDW_Lernmodus_seitenabhaengigInc" ,getValue(eLDW_Lernmodus_seitenabhaengigInc), profileFile);
    writeProfileInt("Settings" ,"eLog_Datalogger_Req_DataKombi_MD" ,getValue(eLog_Datalogger_Req_DataKombi_MD), profileFile);
    writeProfileInt("Settings" ,"eLog_Datalogger_Req_DataKombi_MI" ,getValue(eLog_Datalogger_Req_DataKombi_MI), profileFile);
    writeProfileInt("Settings" ,"eLog_Kombi_Resp_DataD" ,getValue(eLog_Kombi_Resp_DataD), profileFile);
    writeProfileInt("Settings" ,"eLV_Abbiegelicht_li_def" ,getValue(eLV_Abbiegelicht_li_def), profileFile);
    writeProfileInt("Settings" ,"eLV_Abbiegelicht_re_def" ,getValue(eLV_Abbiegelicht_re_def), profileFile);
    writeProfileInt("Settings" ,"eLV_LED_Scheinwerfer_li_defS" ,getValue(eLV_LED_Scheinwerfer_li_defS), profileFile);
    writeProfileInt("Settings" ,"eLV_LED_Scheinwerfer_re_defS" ,getValue(eLV_LED_Scheinwerfer_re_defS), profileFile);
    writeProfileInt("Settings" ,"eMKE_Stufe" ,getValue(eMKE_Stufe), profileFile);
    writeProfileInt("Settings" ,"eMO_CNG_Tankstopp_m0" ,getValue(eMO_CNG_Tankstopp_m0), profileFile);
    writeProfileInt("Settings" ,"eMO_E_ModeS" ,getValue(eMO_E_ModeS), profileFile);
    writeProfileInt("Settings" ,"eMO_E_TexteS" ,getValue(eMO_E_TexteS), profileFile);
    writeProfileInt("Settings" ,"eMO_E_WarnungenS" ,getValue(eMO_E_WarnungenS), profileFile);
    writeProfileInt("Settings" ,"eMO_Effizienzmodus" ,getValue(eMO_Effizienzmodus), profileFile);
    writeProfileInt("Settings" ,"eMO_ePowermeterS" ,getValue(eMO_ePowermeterS), profileFile);
    writeProfileInt("Settings" ,"eMO_Ethanol_BS_Texte" ,getValue(eMO_Ethanol_BS_Texte), profileFile);
    writeProfileInt("Settings" ,"eMO_Ges_calcConsumption_button" ,getValue(eMO_Ges_calcConsumption_button), profileFile);
    writeProfileInt("Settings" ,"eMO_HVEM_EskalationS" ,getValue(eMO_HVEM_EskalationS), profileFile);
    writeProfileInt("Settings" ,"eMO_Hybrid_StartStopp_LED" ,getValue(eMO_Hybrid_StartStopp_LED), profileFile);
    writeProfileInt("Settings" ,"eMO_max_LadedruckS" ,getValue(eMO_max_LadedruckS), profileFile);
    writeProfileInt("Settings" ,"eMO_Nachlaufzeit_HeizungspumpeDe" ,getValue(eMO_Nachlaufzeit_HeizungspumpeDe), profileFile);
    writeProfileInt("Settings" ,"eMO_Nachlaufzeit_HeizungspumpeIn" ,getValue(eMO_Nachlaufzeit_HeizungspumpeIn), profileFile);
    writeProfileInt("Settings" ,"eMO_PowermeterS" ,getValue(eMO_PowermeterS), profileFile);
    writeProfileInt("Settings" ,"eMO_Recu_calcConsumption_button" ,getValue(eMO_Recu_calcConsumption_button), profileFile);
    writeProfileInt("Settings" ,"eMO_Rekuperation_EM_Ges_UeberlaufS" ,getValue(eMO_Rekuperation_EM_Ges_UeberlaufS), profileFile);
    writeProfileInt("Settings" ,"eMO_Rekuperation_Ges_EMS" ,getValue(eMO_Rekuperation_Ges_EMS), profileFile);
    writeProfileInt("Settings" ,"eMO_rel_LadedruckS" ,getValue(eMO_rel_LadedruckS), profileFile);
    writeProfileInt("Settings" ,"eMO_Verbrauch_EM_Ges_UeberlaufS" ,getValue(eMO_Verbrauch_EM_Ges_UeberlaufS), profileFile);
    writeProfileInt("Settings" ,"eMO_Verbrauch_EM_GesS" ,getValue(eMO_Verbrauch_EM_GesS), profileFile);
    writeProfileInt("Settings" ,"eMO_W_Reku_normiert_ueberlaufS" ,getValue(eMO_W_Reku_normiert_ueberlaufS), profileFile);
    writeProfileInt("Settings" ,"eMO_W_Reku_normiertS" ,getValue(eMO_W_Reku_normiertS), profileFile);
    writeProfileInt("Settings" ,"eMO_WaehlposS" ,getValue(eMO_WaehlposS), profileFile);
    writeProfileInt("Settings" ,"eMO_Zylabsch_Texte_02" ,getValue(eMO_Zylabsch_Texte_02), profileFile);
    writeProfileInt("Settings" ,"eNM_eCall_Car_WakeupS" ,getValue(eNM_eCall_Car_WakeupS), profileFile);
    writeProfileInt("Settings" ,"eNM_eCall_NL_eCall_aktivS" ,getValue(eNM_eCall_NL_eCall_aktivS), profileFile);
    writeProfileInt("Settings" ,"eNM_eCall_NL_StandbyS" ,getValue(eNM_eCall_NL_StandbyS), profileFile);
    writeProfileInt("Settings" ,"eNM_eCall_NM_aktiv_DiagnoseS" ,getValue(eNM_eCall_NM_aktiv_DiagnoseS), profileFile);
    writeProfileInt("Settings" ,"eNM_eCall_NM_aktiv_KL15S" ,getValue(eNM_eCall_NM_aktiv_KL15S), profileFile);
    writeProfileInt("Settings" ,"eNM_eCall_NM_aktiv_TminS" ,getValue(eNM_eCall_NM_aktiv_TminS), profileFile);
    writeProfileInt("Settings" ,"eNM_eCall_NM_StateS" ,getValue(eNM_eCall_NM_StateS), profileFile);
    writeProfileInt("Settings" ,"eNM_eCall_SNIS" ,getValue(eNM_eCall_SNIS), profileFile);
    writeProfileInt("Settings" ,"eNM_eCall_UDS_CCS" ,getValue(eNM_eCall_UDS_CCS), profileFile);
    writeProfileInt("Settings" ,"eNM_eCall_WakeupS" ,getValue(eNM_eCall_WakeupS), profileFile);
    writeProfileInt("Settings" ,"eNM_Kombi_Car_WakeupD" ,getValue(eNM_Kombi_Car_WakeupD), profileFile);
    writeProfileInt("Settings" ,"eNM_Kombi_NM_aktiv_BuzzerD" ,getValue(eNM_Kombi_NM_aktiv_BuzzerD), profileFile);
    writeProfileInt("Settings" ,"eNM_Kombi_NM_aktiv_SchlkomD" ,getValue(eNM_Kombi_NM_aktiv_SchlkomD), profileFile);
    writeProfileInt("Settings" ,"eNM_Kombi_NM_StateD" ,getValue(eNM_Kombi_NM_StateD), profileFile);
    writeProfileInt("Settings" ,"eNoGWMessagesButton" ,getValue(eNoGWMessagesButton), profileFile);
    writeProfileInt("Settings" ,"eNoNonGWMessagesButton" ,getValue(eNoNonGWMessagesButton), profileFile);
    writeProfileInt("Settings" ,"env_GasConsumption_Correlation" ,getValue(env_GasConsumption_Correlation), profileFile);
    writeProfileInt("Settings" ,"eOBD_TG_F_Status_1D" ,getValue(eOBD_TG_F_Status_1D), profileFile);
    writeProfileInt("Settings" ,"eOBD_TG_F_Status_2D" ,getValue(eOBD_TG_F_Status_2D), profileFile);
    writeProfileInt("Settings" ,"eOBD_TG_F_Status_3D" ,getValue(eOBD_TG_F_Status_3D), profileFile);
    writeProfileInt("Settings" ,"eOBD_TG_F_Status_4D" ,getValue(eOBD_TG_F_Status_4D), profileFile);
    writeProfileInt("Settings" ,"eOBD_TG_Sens_Rohwert_1D" ,getValue(eOBD_TG_Sens_Rohwert_1D), profileFile);
    writeProfileInt("Settings" ,"eOBD_TG_Sens_Rohwert_2D" ,getValue(eOBD_TG_Sens_Rohwert_2D), profileFile);
    writeProfileInt("Settings" ,"eOBD_TG_Sens_Rohwert_3D" ,getValue(eOBD_TG_Sens_Rohwert_3D), profileFile);
    writeProfileInt("Settings" ,"eOBD_TG_Sens_Rohwert_4D" ,getValue(eOBD_TG_Sens_Rohwert_4D), profileFile);
    writeProfileInt("Settings" ,"ePLS_Akustik" ,getValue(ePLS_Akustik), profileFile);
    writeProfileInt("Settings" ,"eRDK_FMVSS138_Lampe" ,getValue(eRDK_FMVSS138_Lampe), profileFile);
    writeProfileInt("Settings" ,"eRDK_FMVSS138_MIL" ,getValue(eRDK_FMVSS138_MIL), profileFile);
    writeProfileInt("Settings" ,"eRDK_KalibrierungS" ,getValue(eRDK_KalibrierungS), profileFile);
    writeProfileInt("Settings" ,"eRDK_Warnungen_02s" ,getValue(eRDK_Warnungen_02s), profileFile);
    writeProfileInt("Settings" ,"eRES_TripResetD" ,getValue(eRES_TripResetD), profileFile);
    writeProfileInt("Settings" ,"eRGS_VL_Texte" ,getValue(eRGS_VL_Texte), profileFile);
    writeProfileInt("Settings" ,"eRS_Regenmenge14" ,getValue(eRS_Regenmenge14), profileFile);
    writeProfileInt("Settings" ,"eRS_Regenmenge15" ,getValue(eRS_Regenmenge15), profileFile);
    writeProfileInt("Settings" ,"eRW_Prim_Reichweitenv_EinheitS" ,getValue(eRW_Prim_Reichweitenv_EinheitS), profileFile);
    writeProfileInt("Settings" ,"eRW_Prim_ReichweitenverbrauchS" ,getValue(eRW_Prim_ReichweitenverbrauchS), profileFile);
    writeProfileInt("Settings" ,"eRW_Primaer_ReichweiteS" ,getValue(eRW_Primaer_ReichweiteS), profileFile);
    writeProfileInt("Settings" ,"eRW_RWDS_LastprofilS" ,getValue(eRW_RWDS_LastprofilS), profileFile);
    writeProfileInt("Settings" ,"eRW_Sek_Reichweitenv_EinheitS" ,getValue(eRW_Sek_Reichweitenv_EinheitS), profileFile);
    writeProfileInt("Settings" ,"eRW_Sek_ReichweitenverbrauchS" ,getValue(eRW_Sek_ReichweitenverbrauchS), profileFile);
    writeProfileInt("Settings" ,"eRW_Sekundaer_Reichweite" ,getValue(eRW_Sekundaer_Reichweite), profileFile);
    writeProfileInt("Settings" ,"eRW_Sekundaer_ReichweiteS" ,getValue(eRW_Sekundaer_ReichweiteS), profileFile);
    writeProfileInt("Settings" ,"eSCR_verbaut" ,getValue(eSCR_Verbaut), profileFile);
    writeProfileInt("Settings" ,"eSendBAP_BC_ASG_02" ,getValue(eSendBAP_BC_ASG_02), profileFile);
    writeProfileInt("Settings" ,"eSendKlemmen_Steuerung_01" ,getValue(eSendKlemmen_Steuerung_01), profileFile);
    writeProfileInt("Settings" ,"eSI_T_Schutz" ,getValue(eSI_T_Schutz), profileFile);
    writeProfileInt("Settings" ,"eSK1_Key_Data_1D" ,getValue(eSK1_Key_Data_1D), profileFile);
    writeProfileInt("Settings" ,"eSK1_Key_Data_2D" ,getValue(eSK1_Key_Data_2D), profileFile);
    writeProfileInt("Settings" ,"eSK1_Key_Data_3D" ,getValue(eSK1_Key_Data_3D), profileFile);
    writeProfileInt("Settings" ,"eSK1_Key_Data_4D" ,getValue(eSK1_Key_Data_4D), profileFile);
    writeProfileInt("Settings" ,"eSK1_Key_Data_5D" ,getValue(eSK1_Key_Data_5D), profileFile);
    writeProfileInt("Settings" ,"eSK1_Key_Data_6D" ,getValue(eSK1_Key_Data_6D), profileFile);
    writeProfileInt("Settings" ,"eSK1_Key_Data_7D" ,getValue(eSK1_Key_Data_7D), profileFile);
    writeProfileInt("Settings" ,"eSK1_Key_Data_8D" ,getValue(eSK1_Key_Data_8D), profileFile);
    writeProfileInt("Settings" ,"eSK1_Key_Data_9D" ,getValue(eSK1_Key_Data_9D), profileFile);
    writeProfileInt("Settings" ,"eSK1_MUXD" ,getValue(eSK1_MUXD), profileFile);
    writeProfileInt("Settings" ,"eSMLS_01_BZS" ,getValue(eSMLS_01_BZS), profileFile);
    writeProfileInt("Settings" ,"eSMLS_01_BZS_ResetJumpData" ,getValue(eSMLS_01_BZS_ResetJumpData), profileFile);
    writeProfileInt("Settings" ,"eSMLS_01_BZS_ResetJumpEnabled" ,getValue(eSMLS_01_BZS_ResetJumpEnabled), profileFile);
    writeProfileInt("Settings" ,"eSMLS_01_BZS_SingleJumpData" ,getValue(eSMLS_01_BZS_SingleJumpData), profileFile);
    writeProfileInt("Settings" ,"eSMLS_01_BZS_SingleJumpEnabled" ,getValue(eSMLS_01_BZS_SingleJumpEnabled), profileFile);
    writeProfileInt("Settings" ,"eSMLS_01_CRC_FalseData" ,getValue(eSMLS_01_CRC_FalseData), profileFile);
    writeProfileInt("Settings" ,"eSMLS_01_CRC_FalseEnabled" ,getValue(eSMLS_01_CRC_FalseEnabled), profileFile);
    writeProfileInt("Settings" ,"eSMLS_01_CRC_ON" ,getValue(eSMLS_01_CRC_ON), profileFile);
    writeProfileInt("Settings" ,"eSMLS_01_CRCS" ,getValue(eSMLS_01_CRCS), profileFile);
    writeProfileInt("Settings" ,"eSMLS_01_NoMsgEnabled" ,getValue(eSMLS_01_NoMsgEnabled), profileFile);
    writeProfileInt("Settings" ,"eSMLS_01_NoMsgEnabledData" ,getValue(eSMLS_01_NoMsgEnabledData), profileFile);
    writeProfileInt("Settings" ,"eSMLS_P_verriegeltS" ,getValue(eSMLS_P_verriegeltS), profileFile);
    writeProfileInt("Settings" ,"eSTH_KVS" ,getValue(eSTH_KVS), profileFile);
    writeProfileInt("Settings" ,"eSTH_KVS_Ueberlauf" ,getValue(eSTH_KVS_Ueberlauf), profileFile);
    writeProfileInt("Settings" ,"eSTH_HeizleistungS" ,getValue(eSTH_HeizleistungS), profileFile);
    writeProfileInt("Settings" ,"eSTH_Texte" ,getValue(eSTH_Texte), profileFile);
    writeProfileInt("Settings" ,"eSynchronizeDiagnose_01" ,getValue(eSynchronizeDiagnose_01), profileFile);
    writeProfileInt("Settings" ,"eTBAP_BC_ASG_02" ,getValue(eTBAP_BC_ASG_02), profileFile);
    writeProfileInt("Settings" ,"eTimeoutAGA_01" ,getValue(eTimeoutAGA_01), profileFile);
    writeProfileInt("Settings" ,"eTimeoutAirbag_02" ,getValue(eTimeoutAirbag_02), profileFile);
    writeProfileInt("Settings" ,"eTimeoutAnhaenger_01" ,getValue(eTimeoutAnhaenger_01), profileFile);
    writeProfileInt("Settings" ,"eTimeoutARA_Status_01" ,getValue(eTimeoutARA_Status_01), profileFile);
    writeProfileInt("Settings" ,"eTimeoutBAP_BC_ASG_02" ,getValue(eTimeoutBAP_BC_ASG_02), profileFile);
    writeProfileInt("Settings" ,"eTimeoutBCM_01" ,getValue(eTimeoutBCM_01), profileFile);
    writeProfileInt("Settings" ,"eTimeoutBEM_02" ,getValue(eTimeoutBEM_02), profileFile);
    writeProfileInt("Settings" ,"eTimeoutBlinkmodi_02" ,getValue(eTimeoutBlinkmodi_02), profileFile);
    writeProfileInt("Settings" ,"eTimeoutBMS_07" ,getValue(eTimeoutBMS_07), profileFile);
    writeProfileInt("Settings" ,"eTimeoutCharisma_03" ,getValue(eTimeoutCharisma_03), profileFile);
    writeProfileInt("Settings" ,"eTimeoutDaempfer_01" ,getValue(eTimeoutDaempfer_01), profileFile);
    writeProfileInt("Settings" ,"eTimeoutDEV_Kombi_RX1" ,getValue(eTimeoutDEV_Kombi_RX1), profileFile);
    writeProfileInt("Settings" ,"eTimeoutDEV_Kombi_SUP1" ,getValue(eTimeoutDEV_Kombi_SUP1), profileFile);
    writeProfileInt("Settings" ,"eTimeoutDEV_Kombi_SUP2" ,getValue(eTimeoutDEV_Kombi_SUP2), profileFile);
    writeProfileInt("Settings" ,"eTimeoutDEV_Kombi_SUP3" ,getValue(eTimeoutDEV_Kombi_SUP3), profileFile);
    writeProfileInt("Settings" ,"eTimeoutDEV_Kombi_UD1_PC_KI_Cont" ,getValue(eTimeoutDEV_Kombi_UD1_PC_KI_Cont), profileFile);
    writeProfileInt("Settings" ,"eTimeoutDEV_Kombi_UD2_PC_KI_Data" ,getValue(eTimeoutDEV_Kombi_UD2_PC_KI_Data), profileFile);
    writeProfileInt("Settings" ,"eTimeoutDiagnose_01" ,getValue(eTimeoutDiagnose_01), profileFile);
    writeProfileInt("Settings" ,"eTimeoutDimmung_01" ,getValue(eTimeoutDimmung_01), profileFile);
    writeProfileInt("Settings" ,"eTimeoutELV_01" ,getValue(eTimeoutELV_01), profileFile);
    writeProfileInt("Settings" ,"eTimeoutESP_02" ,getValue(eTimeoutESP_02), profileFile);
    writeProfileInt("Settings" ,"eTimeoutESP_20" ,getValue(eTimeoutESP_20), profileFile);
    writeProfileInt("Settings" ,"eTimeoutESP_21" ,getValue(eTimeoutESP_21), profileFile);
    writeProfileInt("Settings" ,"eTimeoutESP_24" ,getValue(eTimeoutESP_24), profileFile);
    writeProfileInt("Settings" ,"eTimeoutGateway_73" ,getValue(eTimeoutGateway_73), profileFile);
    writeProfileInt("Settings" ,"eTimeoutGateway_78" ,getValue(eTimeoutGateway_78), profileFile);
    writeProfileInt("Settings" ,"eTimeoutHSP_01" ,getValue(eTimeoutHSP_01), profileFile);
    writeProfileInt("Settings" ,"eTimeoutHVLM_05" ,getValue(eTimeoutHVLM_05), profileFile);
    writeProfileInt("Settings" ,"eTimeoutISO_Funktionaler_Req_All" ,getValue(eTimeoutISO_Funktionaler_Req_All), profileFile);
    writeProfileInt("Settings" ,"eTimeoutISO_Kombi_Req" ,getValue(eTimeoutISO_Kombi_Req), profileFile);
    writeProfileInt("Settings" ,"eTimeoutKessy_04" ,getValue(eTimeoutKessy_04), profileFile);
    writeProfileInt("Settings" ,"eTimeoutKlemmen_Status_01" ,getValue(eTimeoutKlemmen_Status_01), profileFile);
    writeProfileInt("Settings" ,"eTimeoutKlemmen_Steuerung_01" ,getValue(eTimeoutKlemmen_Steuerung_01), profileFile);
    writeProfileInt("Settings" ,"eTimeoutKlima_Sensor_02" ,getValue(eTimeoutKlima_Sensor_02), profileFile);
    writeProfileInt("Settings" ,"eTimeoutKS_Kombi_Req" ,getValue(eTimeoutKS_Kombi_Req), profileFile);
    writeProfileInt("Settings" ,"eTimeoutLDW_02" ,getValue(eTimeoutLDW_02), profileFile);
    writeProfileInt("Settings" ,"eTimeoutLH_EPS_01" ,getValue(eTimeoutLH_EPS_01), profileFile);
    writeProfileInt("Settings" ,"eTimeoutLicht_Anf_01" ,getValue(eTimeoutLicht_Anf_01), profileFile);
    writeProfileInt("Settings" ,"eTimeoutLicht_hinten_01" ,getValue(eTimeoutLicht_hinten_01), profileFile);
    writeProfileInt("Settings" ,"eTimeoutLicht_vorne_01" ,getValue(eTimeoutLicht_vorne_01), profileFile);
    writeProfileInt("Settings" ,"eTimeoutLog_Datenlogger_Req" ,getValue(eTimeoutLog_Datenlogger_Req), profileFile);
    writeProfileInt("Settings" ,"eTimeoutLog_Kombi_Req" ,getValue(eTimeoutLog_Kombi_Req), profileFile);
    writeProfileInt("Settings" ,"eTimeoutLWR_AFS_01" ,getValue(eTimeoutLWR_AFS_01), profileFile);
    writeProfileInt("Settings" ,"eTimeoutMainUnit_01" ,getValue(eTimeoutMainUnit_01), profileFile);
    writeProfileInt("Settings" ,"eTimeoutMem_BFS_01" ,getValue(eTimeoutMem_BFS_01), profileFile);
    writeProfileInt("Settings" ,"eTimeoutMem_FS_01" ,getValue(eTimeoutMem_FS_01), profileFile);
    writeProfileInt("Settings" ,"eTimeoutMFG_01" ,getValue(eTimeoutMFG_01), profileFile);
    writeProfileInt("Settings" ,"eTimeoutMFL_Tasten_Kon_01" ,getValue(eTimeoutMFL_Tasten_Kon_01), profileFile);
    writeProfileInt("Settings" ,"eTimeoutMotor_04" ,getValue(eTimeoutMotor_04), profileFile);
    writeProfileInt("Settings" ,"eTimeoutMotor_07" ,getValue(eTimeoutMotor_07), profileFile);
    writeProfileInt("Settings" ,"eTimeoutMotor_09" ,getValue(eTimeoutMotor_09), profileFile);
    writeProfileInt("Settings" ,"eTimeoutMotor_14" ,getValue(eTimeoutMotor_14), profileFile);
    writeProfileInt("Settings" ,"eTimeoutMotor_18" ,getValue(eTimeoutMotor_18), profileFile);
    writeProfileInt("Settings" ,"eTimeoutMotor_26" ,getValue(eTimeoutMotor_26), profileFile);
    writeProfileInt("Settings" ,"eTimeoutMotor_Code_01" ,getValue(eTimeoutMotor_Code_01), profileFile);
    writeProfileInt("Settings" ,"eTimeoutMotor_Gas_01" ,getValue(eTimeoutMotor_Gas_01), profileFile);
    writeProfileInt("Settings" ,"eTimeoutNMH_Gateway" ,getValue(eTimeoutNMH_Gateway), profileFile);
    writeProfileInt("Settings" ,"eTimeoutPLA_Status_02" ,getValue(eTimeoutPLA_Status_02), profileFile);
    writeProfileInt("Settings" ,"eTimeoutRDK_01" ,getValue(eTimeoutRDK_01), profileFile);
    writeProfileInt("Settings" ,"eTimeoutReichweite_01" ,getValue(eTimeoutReichweite_01), profileFile);
    writeProfileInt("Settings" ,"eTimeoutReichweite_02" ,getValue(eTimeoutReichweite_02), profileFile);
    writeProfileInt("Settings" ,"eTimeoutRKA_01" ,getValue(eTimeoutRKA_01), profileFile);
    writeProfileInt("Settings" ,"eTimeoutRLS_01" ,getValue(eTimeoutRLS_01), profileFile);
    writeProfileInt("Settings" ,"eTimeoutSMLS_01" ,getValue(eTimeoutSMLS_01), profileFile);
    writeProfileInt("Settings" ,"eTimeoutSTH_01" ,getValue(eTimeoutSTH_01), profileFile);
    writeProfileInt("Settings" ,"eTimeoutSWA_01" ,getValue(eTimeoutSWA_01), profileFile);
    writeProfileInt("Settings" ,"eTimeoutSysteminfo_01" ,getValue(eTimeoutSysteminfo_01), profileFile);
    writeProfileInt("Settings" ,"eTimeoutTCO_01" ,getValue(eTimeoutTCO_01), profileFile);
    writeProfileInt("Settings" ,"eTimeoutTimeDate" ,getValue(eTimeoutTimeDate), profileFile);
    writeProfileInt("Settings" ,"eTimeoutTSG_FT_01" ,getValue(eTimeoutTSG_FT_01), profileFile);
    writeProfileInt("Settings" ,"eTimeoutTSG_FT_02" ,getValue(eTimeoutTSG_FT_02), profileFile);
    writeProfileInt("Settings" ,"eTimeoutTSK_07" ,getValue(eTimeoutTSK_07), profileFile);
    writeProfileInt("Settings" ,"eTimeoutVehiDist" ,getValue(eTimeoutVehiDist), profileFile);
    writeProfileInt("Settings" ,"eTimeoutWischer_01" ,getValue(eTimeoutWischer_01), profileFile);
    writeProfileInt("Settings" ,"eTimeoutWIV_01" ,getValue(eTimeoutWIV_01), profileFile);
    writeProfileInt("Settings" ,"eTimeoutZV_02" ,getValue(eTimeoutZV_02), profileFile);
    writeProfileInt("Settings" ,"eTKlemmen_Steuerung_01" ,getValue(eTKlemmen_Steuerung_01), profileFile);
    writeProfileInt("Settings" ,"eTOTBAP_BC_ASG_02" ,getValue(eTOTBAP_BC_ASG_02), profileFile);
    writeProfileInt("Settings" ,"eTOTDEV_Kombi_UD1_PC_KI_ControlD" ,getValue(eTOTDEV_Kombi_UD1_PC_KI_ControlD), profileFile);
    writeProfileInt("Settings" ,"eTOTDEV_Kombi_UD1_PC_KI_ControlI" ,getValue(eTOTDEV_Kombi_UD1_PC_KI_ControlI), profileFile);
    writeProfileInt("Settings" ,"eTOTKlemmen_Steuerung_01" ,getValue(eTOTKlemmen_Steuerung_01), profileFile);
    writeProfileInt("Settings" ,"eUH_Jahr_0D" ,getValue(eUH_Jahr_0D), profileFile);
    writeProfileInt("Settings" ,"eUH_Monat_114" ,getValue(eUH_Monat_114), profileFile);
    writeProfileInt("Settings" ,"eVSG_MeldungenS" ,getValue(eVSG_MeldungenS), profileFile);
    writeProfileInt("Settings" ,"eWatchDog_Exceedances_1" ,getValue(eWatchDog_Exceedances_1), profileFile);
    writeProfileInt("Settings" ,"eWatchDog_Exceedances_2" ,getValue(eWatchDog_Exceedances_2), profileFile);
    writeProfileInt("Settings" ,"eWatchDog_Exceedances_3" ,getValue(eWatchDog_Exceedances_3), profileFile);
    writeProfileInt("Settings" ,"eWatchDog_Exceedances_4" ,getValue(eWatchDog_Exceedances_4), profileFile);
    writeProfileInt("Settings" ,"eWatchDog_LowerLimit_1" ,getValue(eWatchDog_LowerLimit_1), profileFile);
    writeProfileInt("Settings" ,"eWatchDog_LowerLimit_2" ,getValue(eWatchDog_LowerLimit_2), profileFile);
    writeProfileInt("Settings" ,"eWatchDog_LowerLimit_3" ,getValue(eWatchDog_LowerLimit_3), profileFile);
    writeProfileInt("Settings" ,"eWatchDog_LowerLimit_4" ,getValue(eWatchDog_LowerLimit_4), profileFile);
    writeProfileInt("Settings" ,"eWatchDog_Reset_1" ,getValue(eWatchDog_Reset_1), profileFile);
    writeProfileInt("Settings" ,"eWatchDog_Reset_2" ,getValue(eWatchDog_Reset_2), profileFile);
    writeProfileInt("Settings" ,"eWatchDog_Reset_3" ,getValue(eWatchDog_Reset_3), profileFile);
    writeProfileInt("Settings" ,"eWatchDog_Reset_4" ,getValue(eWatchDog_Reset_4), profileFile);
    writeProfileInt("Settings" ,"eWatchDog_Switch_1" ,getValue(eWatchDog_Switch_1), profileFile);
    writeProfileInt("Settings" ,"eWatchDog_Switch_2" ,getValue(eWatchDog_Switch_2), profileFile);
    writeProfileInt("Settings" ,"eWatchDog_Switch_3" ,getValue(eWatchDog_Switch_3), profileFile);
    writeProfileInt("Settings" ,"eWatchDog_Switch_4" ,getValue(eWatchDog_Switch_4), profileFile);
    writeProfileInt("Settings" ,"eWatchDog_Undercuts_1" ,getValue(eWatchDog_Undercuts_1), profileFile);
    writeProfileInt("Settings" ,"eWatchDog_Undercuts_2" ,getValue(eWatchDog_Undercuts_2), profileFile);
    writeProfileInt("Settings" ,"eWatchDog_Undercuts_3" ,getValue(eWatchDog_Undercuts_3), profileFile);
    writeProfileInt("Settings" ,"eWatchDog_Undercuts_4" ,getValue(eWatchDog_Undercuts_4), profileFile);
    writeProfileInt("Settings" ,"eWatchDog_UpperLimit_1" ,getValue(eWatchDog_UpperLimit_1), profileFile);
    writeProfileInt("Settings" ,"eWatchDog_UpperLimit_2" ,getValue(eWatchDog_UpperLimit_2), profileFile);
    writeProfileInt("Settings" ,"eWatchDog_UpperLimit_3" ,getValue(eWatchDog_UpperLimit_3), profileFile);
    writeProfileInt("Settings" ,"eWatchDog_UpperLimit_4" ,getValue(eWatchDog_UpperLimit_4), profileFile);
    writeProfileInt("Settings" ,"eWatchDog_Value_1" ,getValue(eWatchDog_Value_1), profileFile);
    writeProfileInt("Settings" ,"eWatchDog_Value_2" ,getValue(eWatchDog_Value_2), profileFile);
    writeProfileInt("Settings" ,"eWatchDog_Value_3" ,getValue(eWatchDog_Value_3), profileFile);
    writeProfileInt("Settings" ,"eWatchDog_Value_4" ,getValue(eWatchDog_Value_4), profileFile);
    writeProfileInt("Settings" ,"eWBA_eing_Gang_02Dec" ,getValue(eWBA_eing_Gang_02Dec), profileFile);
    writeProfileInt("Settings" ,"eWBA_eing_Gang_02Def" ,getValue(eWBA_eing_Gang_02Def), profileFile);
    writeProfileInt("Settings" ,"eWBA_eing_Gang_02Inc" ,getValue(eWBA_eing_Gang_02Inc), profileFile);
    writeProfileInt("Settings" ,"eWBA_Fahrstufe_02Dec" ,getValue(eWBA_Fahrstufe_02Dec), profileFile);
    writeProfileInt("Settings" ,"eWBA_Fahrstufe_02Def" ,getValue(eWBA_Fahrstufe_02Def), profileFile);
    writeProfileInt("Settings" ,"eWBA_Fahrstufe_02Inc" ,getValue(eWBA_Fahrstufe_02Inc), profileFile);
    writeProfileInt("Settings" ,"eWBA_GE_TexteDec" ,getValue(eWBA_GE_TexteDec), profileFile);
    writeProfileInt("Settings" ,"eWBA_GE_TexteDef" ,getValue(eWBA_GE_TexteDef), profileFile);
    writeProfileInt("Settings" ,"eWBA_GE_TexteInc" ,getValue(eWBA_GE_TexteInc), profileFile);
    writeProfileInt("Settings" ,"eWBA_GE_Warnung_02Dec" ,getValue(eWBA_GE_Warnung_02Dec), profileFile);
    writeProfileInt("Settings" ,"eWBA_GE_Warnung_02Def" ,getValue(eWBA_GE_Warnung_02Def), profileFile);
    writeProfileInt("Settings" ,"eWBA_GE_Warnung_02Inc" ,getValue(eWBA_GE_Warnung_02Inc), profileFile);
    writeProfileInt("Settings" ,"eWBA_GE_Zusatzwarnungen" ,getValue(eWBA_GE_Zusatzwarnungen), profileFile);
    writeProfileInt("Settings" ,"eWBA_SchaltschemaDec" ,getValue(eWBA_SchaltschemaDec), profileFile);
    writeProfileInt("Settings" ,"eWBA_SchaltschemaDef" ,getValue(eWBA_SchaltschemaDef), profileFile);
    writeProfileInt("Settings" ,"eWBA_SchaltschemaInc" ,getValue(eWBA_SchaltschemaInc), profileFile);
    writeProfileInt("Settings" ,"eWBA_ZielFahrstufeDec" ,getValue(eWBA_ZielFahrstufeDec), profileFile);
    writeProfileInt("Settings" ,"eWBA_ZielFahrstufeDef" ,getValue(eWBA_ZielFahrstufeDef), profileFile);
    writeProfileInt("Settings" ,"eWBA_ZielFahrstufeInc" ,getValue(eWBA_ZielFahrstufeInc), profileFile);
    writeProfileInt("Settings" ,"eWFS_Betrieb_LesespuleD" ,getValue(eWFS_Betrieb_LesespuleD), profileFile);
    writeProfileInt("Settings" ,"eWFS_ELV_authorisiertD" ,getValue(eWFS_ELV_authorisiertD), profileFile);
    writeProfileInt("Settings" ,"eWFS_ID_Geb_autorisiert_in_Kl15D" ,getValue(eWFS_ID_Geb_autorisiert_in_Kl15D), profileFile);
    writeProfileInt("Settings" ,"eWFS_IMMO_ELV_CRCD" ,getValue(eWFS_IMMO_ELV_CRCD), profileFile);
    writeProfileInt("Settings" ,"eWFS_IMMO_ELV_StatusD" ,getValue(eWFS_IMMO_ELV_StatusD), profileFile);
    writeProfileInt("Settings" ,"eWFS_IMMO_GSG_CRCD" ,getValue(eWFS_IMMO_GSG_CRCD), profileFile);
    writeProfileInt("Settings" ,"eWFS_IMMO_GSG_StatusD" ,getValue(eWFS_IMMO_GSG_StatusD), profileFile);
    writeProfileInt("Settings" ,"eWFS_IMMO_MSG1_CRCD" ,getValue(eWFS_IMMO_MSG1_CRCD), profileFile);
    writeProfileInt("Settings" ,"eWFS_IMMO_MSG1_StatusD" ,getValue(eWFS_IMMO_MSG1_StatusD), profileFile);
    writeProfileInt("Settings" ,"eWFS_IMMO_MSG2_CRCD" ,getValue(eWFS_IMMO_MSG2_CRCD), profileFile);
    writeProfileInt("Settings" ,"eWFS_IMMO_MSG2_StatusD" ,getValue(eWFS_IMMO_MSG2_StatusD), profileFile);
    writeProfileInt("Settings" ,"eWFS_IMMO_MSG3_CRCD" ,getValue(eWFS_IMMO_MSG3_CRCD), profileFile);
    writeProfileInt("Settings" ,"eWFS_IMMO_MSG3_StatusD" ,getValue(eWFS_IMMO_MSG3_StatusD), profileFile);
    writeProfileInt("Settings" ,"eWFS_IMMO_MSG4_CRCD" ,getValue(eWFS_IMMO_MSG4_CRCD), profileFile);
    writeProfileInt("Settings" ,"eWFS_IMMO_MSG4_StatusD" ,getValue(eWFS_IMMO_MSG4_StatusD), profileFile);
    writeProfileInt("Settings" ,"eWFS_Klemmenfreigabe_SignaturD" ,getValue(eWFS_Klemmenfreigabe_SignaturD), profileFile);
    writeProfileInt("Settings" ,"eWFS_KlemmenfreigabeD" ,getValue(eWFS_KlemmenfreigabeD), profileFile);
    writeProfileInt("Settings" ,"eWFS_Schluessel_FahrberechtD" ,getValue(eWFS_Schluessel_FahrberechtD), profileFile);
    writeProfileInt("Settings" ,"eWFS_Verbauinfo_ELVD" ,getValue(eWFS_Verbauinfo_ELVD), profileFile);
    writeProfileInt("Settings" ,"eWH_IntervallstufenDec" ,getValue(eWH_IntervallstufenDec), profileFile);
    writeProfileInt("Settings" ,"eWH_IntervallstufenDef" ,getValue(eWH_IntervallstufenDef), profileFile);
    writeProfileInt("Settings" ,"eWH_IntervallstufenInc" ,getValue(eWH_IntervallstufenInc), profileFile);
    writeProfileInt("Settings" ,"eWIV_OelmengeDec" ,getValue(eWIV_OelmengeDec), profileFile);
    writeProfileInt("Settings" ,"eWIV_OelmengeDef" ,getValue(eWIV_OelmengeDef), profileFile);
    writeProfileInt("Settings" ,"eWIV_OelmengeInc" ,getValue(eWIV_OelmengeInc), profileFile);
    writeProfileInt("Settings" ,"eWIV_OelstandDec" ,getValue(eWIV_OelstandDec), profileFile);
    writeProfileInt("Settings" ,"eWIV_OelstandDef" ,getValue(eWIV_OelstandDef), profileFile);
    writeProfileInt("Settings" ,"eWIV_OelstandInc" ,getValue(eWIV_OelstandInc), profileFile);
    writeProfileInt("Settings" ,"eWIV_Russindex65535" ,getValue(eWIV_Russindex65535), profileFile);
    writeProfileInt("Settings" ,"eWIV_RussindexDec" ,getValue(eWIV_RussindexDec), profileFile);
    writeProfileInt("Settings" ,"eWIV_RussindexDef" ,getValue(eWIV_RussindexDef), profileFile);
    writeProfileInt("Settings" ,"eWIV_RussindexInc" ,getValue(eWIV_RussindexInc), profileFile);
    writeProfileInt("Settings" ,"eWIV_t_maxDec" ,getValue(eWIV_t_maxDec), profileFile);
    writeProfileInt("Settings" ,"eWIV_t_maxDef" ,getValue(eWIV_t_maxDef), profileFile);
    writeProfileInt("Settings" ,"eWIV_t_maxInc" ,getValue(eWIV_t_maxInc), profileFile);
    writeProfileInt("Settings" ,"eWIV_t_minDec" ,getValue(eWIV_t_minDec), profileFile);
    writeProfileInt("Settings" ,"eWIV_t_minDef" ,getValue(eWIV_t_minDef), profileFile);
    writeProfileInt("Settings" ,"eWIV_t_minInc" ,getValue(eWIV_t_minInc), profileFile);
    writeProfileInt("Settings" ,"eWIV_Verschleissindex65535" ,getValue(eWIV_Verschleissindex65535), profileFile);
    writeProfileInt("Settings" ,"eWIV_VerschleissindexDec" ,getValue(eWIV_VerschleissindexDec), profileFile);
    writeProfileInt("Settings" ,"eWIV_VerschleissindexDef" ,getValue(eWIV_VerschleissindexDef), profileFile);
    writeProfileInt("Settings" ,"eWIV_VerschleissindexInc" ,getValue(eWIV_VerschleissindexInc), profileFile);
    writeProfileInt("Settings" ,"eWIV_W_maxDec" ,getValue(eWIV_W_maxDec), profileFile);
    writeProfileInt("Settings" ,"eWIV_W_maxDef" ,getValue(eWIV_W_maxDef), profileFile);
    writeProfileInt("Settings" ,"eWIV_W_maxInc" ,getValue(eWIV_W_maxInc), profileFile);
    writeProfileInt("Settings" ,"eWIV_W_minDec" ,getValue(eWIV_W_minDec), profileFile);
    writeProfileInt("Settings" ,"eWIV_W_minDef" ,getValue(eWIV_W_minDef), profileFile);
    writeProfileInt("Settings" ,"eWIV_W_minInc" ,getValue(eWIV_W_minInc), profileFile);
    writeProfileInt("Settings" ,"eDlcOnceMVK_01" ,getValue(eDlcOnceMVK_01), profileFile);
    writeProfileInt("Settings" ,"eDlcWrongMVK_01" ,getValue(eDlcWrongMVK_01), profileFile);
    writeProfileInt("Settings" ,"eMVK_01_BZS_ResetJumpData" ,getValue(eMVK_01_BZS_ResetJumpData), profileFile);
    writeProfileInt("Settings" ,"eMVK_01_BZS_ResetJumpEnabled" ,getValue(eMVK_01_BZS_ResetJumpEnabled), profileFile);
    writeProfileInt("Settings" ,"eMVK_01_BZS_SingleJumpData" ,getValue(eMVK_01_BZS_SingleJumpData), profileFile);
    writeProfileInt("Settings" ,"eMVK_01_BZS_SingleJumpEnabled" ,getValue(eMVK_01_BZS_SingleJumpEnabled), profileFile);
    writeProfileInt("Settings" ,"eMVK_01_CRC_FalseData" ,getValue(eMVK_01_CRC_FalseData), profileFile);
    writeProfileInt("Settings" ,"eMVK_01_CRC_FalseEnabled" ,getValue(eMVK_01_CRC_FalseEnabled), profileFile);
    writeProfileInt("Settings" ,"eMVK_01_NoMsgEnabled" ,getValue(eMVK_01_NoMsgEnabled), profileFile);
    writeProfileInt("Settings" ,"eMVK_01_NoMsgEnabledData" ,getValue(eMVK_01_NoMsgEnabledData), profileFile);
    writeProfileInt("Settings" ,"eTimeoutMVK_01" ,getValue(eTimeoutMVK_01), profileFile);
}

void loadSettings( char profileFile[] )
{
    putValue( eSaveSettings_To_ini, getProfileInt( "Settings", "eSaveSettings_To_ini", 1, profileFile ) );/*Loading the value of Save settings widget from ini file*/
    loadSettings1( profileFile );
    loadSettings1G( profileFile );
    loadSettings2( profileFile );
    loadSettings2G( profileFile );
    loadSettings3( profileFile );
    loadSettings3G( profileFile );
    loadOthers( profileFile );
    loadOthers2( profileFile );
    loadAddtlEnVars( profileFile );
}

void loadSettings1( char profileFile[] )
{
    putValue( eSendEnabled, getProfileInt( "Settings", "eSendEnabled", 1, profileFile ) );
    putValue( eLog_Kombi_Req_DataS, getProfileInt( "Settings", "eLog_Kombi_Req_DataS", 0, profileFile ) );
    putValue( eLog_Datalogger_Req_DataKombi_MQ, getProfileInt( "Settings", "eLog_Datalogger_Req_DataKombi_MQ", 0, profileFile ) );
    putValue( eAAG_Bremsl_durch_ECDS, getProfileInt( "Settings", "eAAG_Bremsl_durch_ECDS", 0, profileFile ) );
    putValue( eAAG_Anhaenger_abgestecktS, getProfileInt( "Settings", "eAAG_Anhaenger_abgestecktS", 0, profileFile ) );
    putValue( eAAG_NSL_aktivS, getProfileInt( "Settings", "eAAG_NSL_aktivS", 0, profileFile ) );
    putValue( eAAG_Anhaenger_erkanntS, getProfileInt( "Settings", "eAAG_Anhaenger_erkanntS", 0, profileFile ) );
    putValue( eAAG_Blinker_H_aktivS, getProfileInt( "Settings", "eAAG_Blinker_H_aktivS", 0, profileFile ) );
    putValue( eAAG_Blinker_HL_defS, getProfileInt( "Settings", "eAAG_Blinker_HL_defS", 0, profileFile ) );
    putValue( eAAG_Blinker_HR_defS, getProfileInt( "Settings", "eAAG_Blinker_HR_defS", 0, profileFile ) );
    putValue( eAAG_Bremslicht_H_defS, getProfileInt( "Settings", "eAAG_Bremslicht_H_defS", 0, profileFile ) );
    putValue( eAAG_Schlusslicht_HL_defS, getProfileInt( "Settings", "eAAG_Schlusslicht_HL_defS", 0, profileFile ) );
    putValue( eAAG_Schlusslicht_HR_defS, getProfileInt( "Settings", "eAAG_Schlusslicht_HR_defS", 0, profileFile ) );
    putValue( eAAG_AVS_Fehler_02S, getProfileInt( "Settings", "eAAG_AVS_Fehler_02S", 0, profileFile ) );
    putValue( eAAG_AVS_StatiS, getProfileInt( "Settings", "eAAG_AVS_StatiS", 0, profileFile ) );
    putValue( eBCM_Bremsbelag_SensorS, getProfileInt( "Settings", "eBCM_Bremsbelag_SensorS", 0, profileFile ) );
    putValue( eBCM_Bremsfluessigkeit_SensorS, getProfileInt( "Settings", "eBCM_Bremsfluessigkeit_SensorS", 0, profileFile ) );
    putValue( eBCM1_Licht_WarnS, getProfileInt( "Settings", "eBCM1_Licht_WarnS", 0, profileFile ) );
    putValue( eBCM_Waschwasser_SensorS, getProfileInt( "Settings", "eBCM_Waschwasser_SensorS", 0, profileFile ) );
    putValue( eBCM_Kuehlmittel_SensorS, getProfileInt( "Settings", "eBCM_Kuehlmittel_SensorS", 0, profileFile ) );
    putValue( eBCM1_Kl_15_HW_erkanntS, getProfileInt( "Settings", "eBCM1_Kl_15_HW_erkanntS", 0, profileFile ) );
    putValue( eZZH_Endlage_obenS, getProfileInt( "Settings", "eZZH_Endlage_obenS", 0, profileFile ) );
    putValue( eZZH_Endlage_untenS, getProfileInt( "Settings", "eZZH_Endlage_untenS", 0, profileFile ) );
    putValue( eZZH_Endlage_unplausibelS, getProfileInt( "Settings", "eZZH_Endlage_unplausibelS", 0, profileFile ) );
    putValue( eBCM2_EZS_gedruecktS, getProfileInt( "Settings", "eBCM2_EZS_gedruecktS", 0, profileFile ) );
    putValue( eBCM2_SST_gedruecktS, getProfileInt( "Settings", "eBCM2_SST_gedruecktS", 0, profileFile ) );
    putValue( eBCM1_Warnblink_TasterS, getProfileInt( "Settings", "eBCM1_Warnblink_TasterS", 0, profileFile ) );
    putValue( eBCM1_Valet_Parking_TasterS, getProfileInt( "Settings", "eBCM1_Valet_Parking_TasterS", 0, profileFile ) );
    putValue( eBCM1_HSK_TasterS, getProfileInt( "Settings", "eBCM1_HSK_TasterS", 0, profileFile ) );
    putValue( eBCM1_Heckrollo_TasterS, getProfileInt( "Settings", "eBCM1_Heckrollo_TasterS", 0, profileFile ) );
    putValue( eBCM1_Rueckfahrlicht_SchalterS, getProfileInt( "Settings", "eBCM1_Rueckfahrlicht_SchalterS", 0, profileFile ) );
    putValue( eBCM1_MH_SchalterS, getProfileInt( "Settings", "eBCM1_MH_SchalterS", 0, profileFile ) );
    putValue( eBCM1_MH_WIV_SchalterS, getProfileInt( "Settings", "eBCM1_MH_WIV_SchalterS", 0, profileFile ) );
    putValue( eBCM1_Lichtwarn_TexteS, getProfileInt( "Settings", "eBCM1_Lichtwarn_TexteS", 0, profileFile ) );
    putValue( eKY_IDGeber_1_StatusS, getProfileInt( "Settings", "eKY_IDGeber_1_StatusS", 0, profileFile ) );
    putValue( eKY_IDGeber_2_StatusS, getProfileInt( "Settings", "eKY_IDGeber_2_StatusS", 0, profileFile ) );
    putValue( eKY_SofttouchS, getProfileInt( "Settings", "eKY_SofttouchS", 0, profileFile ) );
    putValue( eKY_IDGeber_3_StatusS, getProfileInt( "Settings", "eKY_IDGeber_3_StatusS", 0, profileFile ) );
    putValue( eKY_IDGeber_4_StatusS, getProfileInt( "Settings", "eKY_IDGeber_4_StatusS", 0, profileFile ) );
    putValue( eKY_FFB_in_LF_ReichwS, getProfileInt( "Settings", "eKY_FFB_in_LF_ReichwS", 0, profileFile ) );
    putValue( eKY_IDGeber_1_BatS, getProfileInt( "Settings", "eKY_IDGeber_1_BatS", 0, profileFile ) );
    putValue( eKY_IDGeber_2_BatS, getProfileInt( "Settings", "eKY_IDGeber_2_BatS", 0, profileFile ) );
    putValue( eKY_IDGeber_3_BatS, getProfileInt( "Settings", "eKY_IDGeber_3_BatS", 0, profileFile ) );
    putValue( eKY_IDGeber_4_BatS, getProfileInt( "Settings", "eKY_IDGeber_4_BatS", 0, profileFile ) );
    putValue( eKY_RSSI_WertS, getProfileInt( "Settings", "eKY_RSSI_WertS", 0, profileFile ) );
    putValue( eKY_Nr_IDGeber_AutofktS, getProfileInt( "Settings", "eKY_Nr_IDGeber_AutofktS", 0, profileFile ) );
    putValue( eKY_KessyEntryExit_AktS, getProfileInt( "Settings", "eKY_KessyEntryExit_AktS", 0, profileFile ) );
    putValue( eKY_Autofunktion_AktivS, getProfileInt( "Settings", "eKY_Autofunktion_AktivS", 0, profileFile ) );
    putValue( eKY_Anf_ReichwbegrS, getProfileInt( "Settings", "eKY_Anf_ReichwbegrS", 0, profileFile ) );
    putValue( eKY_Anf_Reichwbegr_GesamtS, getProfileInt( "Settings", "eKY_Anf_Reichwbegr_GesamtS", 0, profileFile ) );
    putValue( eKY_BedienstelleS, getProfileInt( "Settings", "eKY_BedienstelleS", 0, profileFile ) );
    putValue( eKY_VerriegelnS, getProfileInt( "Settings", "eKY_VerriegelnS", 0, profileFile ) );
    putValue( eKY_EntriegelnS, getProfileInt( "Settings", "eKY_EntriegelnS", 0, profileFile ) );
    putValue( eKY_ZV_CMDS, getProfileInt( "Settings", "eKY_ZV_CMDS", 0, profileFile ) );
    putValue( eKY_SchluesselnrS, getProfileInt( "Settings", "eKY_SchluesselnrS", 0, profileFile ) );
    putValue( eKY_WFS_KeyDataS, getProfileInt( "Settings", "eKY_WFS_KeyDataS", 0, profileFile ) );
    putValue( eKY_ID_Geber_1S, getProfileInt( "Settings", "eKY_ID_Geber_1S", 0, profileFile ) );
    putValue( eKY_ID_Geber_2S, getProfileInt( "Settings", "eKY_ID_Geber_2S", 0, profileFile ) );
    putValue( eKY_ID_Geber_3S, getProfileInt( "Settings", "eKY_ID_Geber_3S", 0, profileFile ) );
    putValue( eKY_ID_Geber_4S, getProfileInt( "Settings", "eKY_ID_Geber_4S", 0, profileFile ) );
    putValue( eKY_GoTransponder_IDS, getProfileInt( "Settings", "eKY_GoTransponder_IDS", 0, profileFile ) );
    putValue( eKY_GoAuthent_RespS, getProfileInt( "Settings", "eKY_GoAuthent_RespS", 0, profileFile ) );
    putValue( eBM_ZV_aufS, getProfileInt( "Settings", "eBM_ZV_aufS", 0, profileFile ) );
    putValue( eBM_ZV_zuS, getProfileInt( "Settings", "eBM_ZV_zuS", 0, profileFile ) );
    putValue( eBM_DWA_einS, getProfileInt( "Settings", "eBM_DWA_einS", 0, profileFile ) );
    putValue( eBM_DWA_AlarmS, getProfileInt( "Settings", "eBM_DWA_AlarmS", 0, profileFile ) );
    putValue( eBM_CrashS, getProfileInt( "Settings", "eBM_CrashS", 0, profileFile ) );
    putValue( eBM_PanikS, getProfileInt( "Settings", "eBM_PanikS", 0, profileFile ) );
    putValue( eBM_Not_BremsungS, getProfileInt( "Settings", "eBM_Not_BremsungS", 0, profileFile ) );
    putValue( eBM_GDOS, getProfileInt( "Settings", "eBM_GDOS", 0, profileFile ) );
    putValue( eBM_WarnblinkenS, getProfileInt( "Settings", "eBM_WarnblinkenS", 0, profileFile ) );
    putValue( eBM_Taxi_NotalarmS, getProfileInt( "Settings", "eBM_Taxi_NotalarmS", 0, profileFile ) );
    putValue( eBM_TelematikS, getProfileInt( "Settings", "eBM_TelematikS", 0, profileFile ) );
    putValue( eBM_linksS, getProfileInt( "Settings", "eBM_linksS", 0, profileFile ) );
    putValue( eBM_rechtsS, getProfileInt( "Settings", "eBM_rechtsS", 0, profileFile ) );
    putValue( eBlinken_li_Fzg_TaktS, getProfileInt( "Settings", "eBlinken_li_Fzg_TaktS", 0, profileFile ) );
    putValue( eBlinken_re_Fzg_TaktS, getProfileInt( "Settings", "eBlinken_re_Fzg_TaktS", 0, profileFile ) );
    putValue( eBlinken_li_Kombi_TaktS, getProfileInt( "Settings", "eBlinken_li_Kombi_TaktS", 0, profileFile ) );
    putValue( eBlinken_re_Kombi_TaktS, getProfileInt( "Settings", "eBlinken_re_Kombi_TaktS", 0, profileFile ) );
    putValue( eBM_NBA_n_codiert_n_aktivS, getProfileInt( "Settings", "eBM_NBA_n_codiert_n_aktivS", 1, profileFile ) );
    putValue( eBM_NBA_StatusS, getProfileInt( "Settings", "eBM_NBA_StatusS", 0, profileFile ) );
    putValue( eDI_KL_58xd254, getProfileInt( "Settings", "eDI_KL_58xd254", 0, profileFile ) );
    putValue( eDI_KL_58xdS, getProfileInt( "Settings", "eDI_KL_58xdS", 253, profileFile ) );
    putValue( eDI_KL_58xsS, getProfileInt( "Settings", "eDI_KL_58xsS", 126, profileFile ) );
    putValue( eDI_Display_NachtdesignS, getProfileInt( "Settings", "eDI_Display_NachtdesignS", 0, profileFile ) );
    putValue( eDI_KL_58xtS, getProfileInt( "Settings", "eDI_KL_58xtS", 126, profileFile ) );
    putValue( eDI_FotosensorS, getProfileInt( "Settings", "eDI_FotosensorS", 0, profileFile ) );
    putValue( eELV_Anf_Klemme_SS, getProfileInt( "Settings", "eELV_Anf_Klemme_SS", 0, profileFile ) );
    putValue( eELV_Anf_Klemme_15S, getProfileInt( "Settings", "eELV_Anf_Klemme_15S", 0, profileFile ) );
    putValue( eELV_Anf_Klemme_50S, getProfileInt( "Settings", "eELV_Anf_Klemme_50S", 0, profileFile ) );
    putValue( eELV_VerriegeltS, getProfileInt( "Settings", "eELV_VerriegeltS", 0, profileFile ) );
    putValue( eELV_EntriegeltS, getProfileInt( "Settings", "eELV_EntriegeltS", 0, profileFile ) );
    putValue( eELV_LebenszustandS, getProfileInt( "Settings", "eELV_LebenszustandS", 0, profileFile ) );
    putValue( eELV_AnlernmodusS, getProfileInt( "Settings", "eELV_AnlernmodusS", 0, profileFile ) );
    putValue( eELV_Akustik_1S, getProfileInt( "Settings", "eELV_Akustik_1S", 0, profileFile ) );
    putValue( eELV_Akustik_2S, getProfileInt( "Settings", "eELV_Akustik_2S", 0, profileFile ) );
    putValue( eELV_Blink_LEDS, getProfileInt( "Settings", "eELV_Blink_LEDS", 0, profileFile ) );
    putValue( eELV_LED_RotS, getProfileInt( "Settings", "eELV_LED_RotS", 0, profileFile ) );
    putValue( eELV_LED_BremseS, getProfileInt( "Settings", "eELV_LED_BremseS", 0, profileFile ) );
    putValue( eELV_Txt_Lkg_BewegenS, getProfileInt( "Settings", "eELV_Txt_Lkg_BewegenS", 0, profileFile ) );
    putValue( eELV_Txt_WerkstattS, getProfileInt( "Settings", "eELV_Txt_WerkstattS", 0, profileFile ) );
    putValue( eELV_Txt_DefektS, getProfileInt( "Settings", "eELV_Txt_DefektS", 0, profileFile ) );
    putValue( eELV_P_VerriegeltS, getProfileInt( "Settings", "eELV_P_VerriegeltS", 0, profileFile ) );
    putValue( eELV_WFS_RNDS, getProfileInt( "Settings", "eELV_WFS_RNDS", 0, profileFile ) );
    putValue( eELV_WFS_CRCS, getProfileInt( "Settings", "eELV_WFS_CRCS", 0, profileFile ) );
    putValue( eKY_ID_Geber1_im_FzgS, getProfileInt( "Settings", "eKY_ID_Geber1_im_FzgS", 0, profileFile ) );
    putValue( eKY_ID_Geber2_im_FzgS, getProfileInt( "Settings", "eKY_ID_Geber2_im_FzgS", 0, profileFile ) );
    putValue( eKY_ID_Geber3_im_FzgS, getProfileInt( "Settings", "eKY_ID_Geber3_im_FzgS", 0, profileFile ) );
    putValue( eKY_ID_Geber4_im_FzgS, getProfileInt( "Settings", "eKY_ID_Geber4_im_FzgS", 0, profileFile ) );
    putValue( eKY_Startknopf_BelS, getProfileInt( "Settings", "eKY_Startknopf_BelS", 0, profileFile ) );
    putValue( eKY_ID_Geber_SucheS, getProfileInt( "Settings", "eKY_ID_Geber_SucheS", 0, profileFile ) );
    putValue( eKY_MeldungenS, getProfileInt( "Settings", "eKY_MeldungenS", 0, profileFile ) );
    putValue( eKY_Gong_600S, getProfileInt( "Settings", "eKY_Gong_600S", 0, profileFile ) );
    putValue( eKY_Passiv_Autolock_MenueS, getProfileInt( "Settings", "eKY_Passiv_Autolock_MenueS", 0, profileFile ) );
    putValue( eKY_Passiv_Autolock_AktS, getProfileInt( "Settings", "eKY_Passiv_Autolock_AktS", 0, profileFile ) );
    putValue( eKY_Passiv_AutolockS, getProfileInt( "Settings", "eKY_Passiv_AutolockS", 0, profileFile ) );
    putValue( eKY_Passiv_AutounlockS, getProfileInt( "Settings", "eKY_Passiv_AutounlockS", 0, profileFile ) );
    putValue( eKY_Gestik_HDS, getProfileInt( "Settings", "eKY_Gestik_HDS", 0, profileFile ) );
    putValue( eKY_StartStopp_InfoS, getProfileInt( "Settings", "eKY_StartStopp_InfoS", 0, profileFile ) );
    putValue( eZAS_Kl_SS, getProfileInt( "Settings", "eZAS_Kl_SS", 0, profileFile ) );
    putValue( eZAS_Kl_15S, getProfileInt( "Settings", "eZAS_Kl_15S", 0, profileFile ) );
    putValue( eZAS_Kl_XS, getProfileInt( "Settings", "eZAS_Kl_XS", 0, profileFile ) );
    putValue( eZAS_Kl_50_StartanforderungS, getProfileInt( "Settings", "ZAS_Kl_50_Startanforderung", 0, profileFile ) );
    putValue( eBCM1_Aussen_Temp_ungefS, getProfileFloat( "Settings", "eBCM1_Aussen_Temp_ungefS", 77, profileFile ) );
    putValue( eBCM1_FStatus_Aussentemp_ungefS, getProfileInt( "Settings", "eBCM1_FStatus_Aussentemp_ungefS", 1, profileFile ) );
    putValue( eBCM1_OBD_FStatus_ATempS, getProfileInt( "Settings", "eBCM1_OBD_FStatus_ATempS", 0, profileFile ) );
    putValue( eBCM1_Kurvenlicht_links_AnfS, getProfileInt( "Settings", "eBCM1_Kurvenlicht_links_AnfS", 0, profileFile ) );
    putValue( eBCM1_Kurvenlicht_rechts_AnfS, getProfileInt( "Settings", "eBCM1_Kurvenlicht_rechts_AnfS", 0, profileFile ) );
    putValue( eBCM1_Standlicht_AnfS, getProfileInt( "Settings", "eBCM1_Standlicht_AnfS", 0, profileFile ) );
    putValue( eBCM1_Abblendlicht_AnfS, getProfileInt( "Settings", "eBCM1_Abblendlicht_AnfS", 0, profileFile ) );
    putValue( eBCM1_Fernlicht_AnfS, getProfileInt( "Settings", "eBCM1_Fernlicht_AnfS", 0, profileFile ) );
    putValue( eBCM1_Nebellicht_AnfS, getProfileInt( "Settings", "eBCM1_Nebellicht_AnfS", 0, profileFile ) );
    putValue( eBCM1_Parklicht_li_AnfS, getProfileInt( "Settings", "eBCM1_Parklicht_li_AnfS", 0, profileFile ) );
    putValue( eBCM1_Parklicht_re_AnfS, getProfileInt( "Settings", "eBCM1_Parklicht_re_AnfS", 0, profileFile ) );
    putValue( eBCM1_Nebelschluss_Ahg_AnfS, getProfileInt( "Settings", "eBCM1_Nebelschluss_Ahg_AnfS", 0, profileFile ) );
    putValue( eBCM1_Nebelschluss_Fzg_AnfS, getProfileInt( "Settings", "eBCM1_Nebelschluss_Fzg_AnfS", 0, profileFile ) );
    putValue( eBCM1_Schlusslicht_AnfS, getProfileInt( "Settings", "eBCM1_Schlusslicht_AnfS", 0, profileFile ) );
    putValue( eBCM1_RFahrlicht_Fzg_AnfS, getProfileInt( "Settings", "eBCM1_RFahrlicht_Fzg_AnfS", 0, profileFile ) );
    putValue( eBCM1_Umfeldleuchten_AnfS, getProfileInt( "Settings", "eBCM1_Umfeldleuchten_AnfS", 0, profileFile ) );
    putValue( eBCM1_Tagfahrlicht_AnfS, getProfileInt( "Settings", "eBCM1_Tagfahrlicht_AnfS", 0, profileFile ) );
    putValue( eBCM1_Regenlicht_AnfS, getProfileInt( "Settings", "eBCM1_Regenlicht_AnfS", 0, profileFile ) );
    putValue( eBCM1_Autobahnlicht_AnfS, getProfileInt( "Settings", "eBCM1_Autobahnlicht_AnfS", 0, profileFile ) );
    putValue( eBCM1_Touristen_Licht_AnfS, getProfileInt( "Settings", "eBCM1_Touristen_Licht_AnfS", 0, profileFile ) );
    putValue( eBCM1_Gleitende_Leuchtw_AnfS, getProfileInt( "Settings", "eBCM1_Gleitende_Leuchtw_AnfS", 0, profileFile ) );
    putValue( eBCM1_GLW_Fernlicht_AnfS, getProfileInt( "Settings", "eBCM1_GLW_Fernlicht_AnfS", 0, profileFile ) );
    putValue( eBCM1_Adaptive_Lichtvert_AnfS, getProfileInt( "Settings", "eBCM1_Adaptive_Lichtvert_AnfS", 0, profileFile ) );
    putValue( eLicht_hinten_01_BZS, getProfileInt( "Settings", "eLicht_hinten_01_BZS", 0, profileFile ) );
    putValue( eBCM2_Bremsl_durch_ECDS, getProfileInt( "Settings", "eBCM2_Bremsl_durch_ECDS", 0, profileFile ) );
    putValue( eLH_Aussenlicht_defS, getProfileInt( "Settings", "eLH_Aussenlicht_defS", 0, profileFile ) );
    putValue( eLH_Standlicht_H_aktivS, getProfileInt( "Settings", "eLH_Standlicht_H_aktivS", 0, profileFile ) );
    putValue( eLH_Parklicht_HL_aktivS, getProfileInt( "Settings", "eLH_Parklicht_HL_aktivS", 0, profileFile ) );
    putValue( eLH_Parklicht_HR_aktivS, getProfileInt( "Settings", "eLH_Parklicht_HR_aktivS", 0, profileFile ) );
    putValue( eLH_Bremslicht_H_aktivS, getProfileInt( "Settings", "eLH_Bremslicht_H_aktivS", 0, profileFile ) );
    putValue( eLH_Nebelschluss_aktivS, getProfileInt( "Settings", "eLH_Nebelschluss_aktivS", 0, profileFile ) );
    putValue( eLH_Rueckfahrlicht_aktivS, getProfileInt( "Settings", "eLH_Rueckfahrlicht_aktivS", 0, profileFile ) );
    putValue( eLH_Blinker_HL_aktS, getProfileInt( "Settings", "eLH_Blinker_HL_aktS", 0, profileFile ) );
    putValue( eLH_Blinker_HR_aktS, getProfileInt( "Settings", "eLH_Blinker_HR_aktS", 0, profileFile ) );
    putValue( eLH_Blinker_li_defS, getProfileInt( "Settings", "eLH_Blinker_li_defS", 0, profileFile ) );
    putValue( eLH_Bremsl_li_defS, getProfileInt( "Settings", "eLH_Bremsl_li_defS", 0, profileFile ) );
    putValue( eLH_Schlusslicht_li_defS, getProfileInt( "Settings", "eLH_Schlusslicht_li_defS", 0, profileFile ) );
    putValue( eLH_Rueckf_li_defS, getProfileInt( "Settings", "eLH_Rueckf_li_defS", 0, profileFile ) );
    putValue( eLH_Nebel_li_defS, getProfileInt( "Settings", "eLH_Nebel_li_defS", 0, profileFile ) );
    putValue( eLH_Schluss_Brems_Nebel_li_defS, getProfileInt( "Settings", "eLH_Schluss_Brems_Nebel_li_defS", 0, profileFile ) );
    putValue( eLH_Schluss_Brems_Nebel_re_defS, getProfileInt( "Settings", "eLH_Schluss_Brems_Nebel_re_defS", 0, profileFile ) );
    putValue( eLH_Schluss_Brems_li_defS, getProfileInt( "Settings", "eLH_Schluss_Brems_li_defS", 0, profileFile ) );
    putValue( eLH_Schluss_Nebel_li_defS, getProfileInt( "Settings", "eLH_Schluss_Nebel_li_defS", 0, profileFile ) );
    putValue( eLH_SL_BRL_BLK_li_defS, getProfileInt( "Settings", "eLH_SL_BRL_BLK_li_defS", 0, profileFile ) );
    putValue( eLH_Brems_Blk_li_defS, getProfileInt( "Settings", "eLH_Brems_Blk_li_defS", 0, profileFile ) );
    putValue( eLH_Blinker_re_defS, getProfileInt( "Settings", "eLH_Blinker_re_defS", 0, profileFile ) );
    putValue( eLH_Bremsl_re_defS, getProfileInt( "Settings", "eLH_Bremsl_re_defS", 0, profileFile ) );
    putValue( eLH_Schlusslicht_re_defS, getProfileInt( "Settings", "eLH_Schlusslicht_re_defS", 0, profileFile ) );
    putValue( eLH_Rueckf_re_defS, getProfileInt( "Settings", "eLH_Rueckf_re_defS", 0, profileFile ) );
    putValue( eLH_Nebel_re_defS, getProfileInt( "Settings", "eLH_Nebel_re_defS", 0, profileFile ) );
    putValue( eLH_Schluss_Brems_re_defS, getProfileInt( "Settings", "eLH_Schluss_Brems_re_defS", 0, profileFile ) );
    putValue( eLH_Schluss_Nebel_re_defS, getProfileInt( "Settings", "eLH_Schluss_Nebel_re_defS", 0, profileFile ) );
    putValue( eLH_SL_BRL_BLK_re_defS, getProfileInt( "Settings", "eLH_SL_BRL_BLK_re_defS", 0, profileFile ) );
    putValue( eLH_Brems_Blk_re_defS, getProfileInt( "Settings", "eLH_Brems_Blk_re_defS", 0, profileFile ) );
    putValue( eLH_Kennzl_defS, getProfileInt( "Settings", "eLH_Kennzl_defS", 0, profileFile ) );
    putValue( eLH_3_Bremsl_defS, getProfileInt( "Settings", "eLH_3_Bremsl_defS", 0, profileFile ) );
    putValue( eLH_Nebel_mi_defS, getProfileInt( "Settings", "eLH_Nebel_mi_defS", 0, profileFile ) );
    putValue( eLH_Rueckf_mi_defS, getProfileInt( "Settings", "eLH_Rueckf_mi_defS", 0, profileFile ) );
    putValue( eLH_Bremsl_li_ges_defS, getProfileInt( "Settings", "eLH_Bremsl_li_ges_defS", 0, profileFile ) );
    putValue( eLH_Bremsl_re_ges_defS, getProfileInt( "Settings", "eLH_Bremsl_re_ges_defS", 0, profileFile ) );
    putValue( eLV_Standlicht_AnzeigeS, getProfileInt( "Settings", "eLV_Standlicht_AnzeigeS", 0, profileFile ) );
    putValue( eLV_Abblendlicht_AnzeigeS, getProfileInt( "Settings", "eLV_Abblendlicht_AnzeigeS", 0, profileFile ) );
    putValue( eLV_Fernlicht_AnzeigeS, getProfileInt( "Settings", "eLV_Fernlicht_AnzeigeS", 0, profileFile ) );
    putValue( eLV_Nebellicht_AnzeigeS, getProfileInt( "Settings", "eLV_Nebellicht_AnzeigeS", 0, profileFile ) );
    putValue( eLV_Nebelschlusslicht_AnzeigeS, getProfileInt( "Settings", "eLV_Nebelschlusslicht_AnzeigeS", 0, profileFile ) );
    putValue( eLV_Tagfahrlicht_AnzeigeS, getProfileInt( "Settings", "eLV_Tagfahrlicht_AnzeigeS", 0, profileFile ) );
    putValue( eLV_AFL_aktiv_AnzeigeS, getProfileInt( "Settings", "eLV_AFL_aktiv_AnzeigeS", 0, profileFile ) );
    putValue( eLV_AFL_defektS, getProfileInt( "Settings", "eLV_AFL_defektS", 0, profileFile ) );
    putValue( eLV_Blinker_li_defS, getProfileInt( "Settings", "eLV_Blinker_li_defS", 0, profileFile ) );
    putValue( eLV_Standlicht_li_defS, getProfileInt( "Settings", "eLV_Standlicht_li_defS", 0, profileFile ) );
    putValue( eLV_Abblendlicht_li_defS, getProfileInt( "Settings", "eLV_Abblendlicht_li_defS", 0, profileFile ) );
    putValue( eLV_Fernlicht_li_defS, getProfileInt( "Settings", "eLV_Fernlicht_li_defS", 0, profileFile ) );
    putValue( eLV_Nebellicht_li_defS, getProfileInt( "Settings", "eLV_Nebellicht_li_defS", 0, profileFile ) );
    putValue( eLV_Blk_li_Seite_defS, getProfileInt( "Settings", "eLV_Blk_li_Seite_defS", 0, profileFile ) );
    putValue( eLV_Tagfahrlicht_li_defS, getProfileInt( "Settings", "eLV_Tagfahrlicht_li_defS", 0, profileFile ) );
    putValue( eLV_FLA_aktiv_AnzeigeS, getProfileInt( "Settings", "eLV_FLA_aktiv_AnzeigeS", 0, profileFile ) );
    putValue( eLV_FLA_defektS, getProfileInt( "Settings", "eLV_FLA_defektS", 0, profileFile ) );
    putValue( eLV_FLA_Sensor_blockiertS, getProfileInt( "Settings", "eLV_FLA_Sensor_blockiertS", 0, profileFile ) );
    putValue( eLV_Blinker_re_defS, getProfileInt( "Settings", "eLV_Blinker_re_defS", 0, profileFile ) );
    putValue( eLV_Standlicht_re_defS, getProfileInt( "Settings", "eLV_Standlicht_re_defS", 0, profileFile ) );
    putValue( eLV_Abblendlicht_re_defS, getProfileInt( "Settings", "eLV_Abblendlicht_re_defS", 0, profileFile ) );
    putValue( eLV_Fernlicht_re_defS, getProfileInt( "Settings", "eLV_Fernlicht_re_defS", 0, profileFile ) );
    putValue( eLV_Nebellicht_re_defS, getProfileInt( "Settings", "eLV_Nebellicht_re_defS", 0, profileFile ) );
    putValue( eLV_Blk_re_Seite_defS, getProfileInt( "Settings", "eLV_Blk_re_Seite_defS", 0, profileFile ) );
    putValue( eLV_Tagfahrlicht_re_defS, getProfileInt( "Settings", "eLV_Tagfahrlicht_re_defS", 0, profileFile ) );
    putValue( eLV_Aussenlicht_defS, getProfileInt( "Settings", "eLV_Aussenlicht_defS", 0, profileFile ) );
    putValue( eLV_Abblendlicht_TFL_li_defS, getProfileInt( "Settings", "eLV_Abblendlicht_TFL_li_defS", 0, profileFile ) );
    putValue( eLV_Nebellicht_TFL_li_defS, getProfileInt( "Settings", "eLV_Nebellicht_TFL_li_defS", 0, profileFile ) );
    putValue( eLV_Standlicht_TFL_li_defS, getProfileInt( "Settings", "eLV_Standlicht_TFL_li_defS", 0, profileFile ) );
    putValue( eLV_Abblend_Fernlicht_li_defS, getProfileInt( "Settings", "eLV_Abblend_Fernlicht_li_defS", 0, profileFile ) );
    putValue( eLV_Abblendlicht_TFL_re_defS, getProfileInt( "Settings", "eLV_Abblendlicht_TFL_re_defS", 0, profileFile ) );
    putValue( eLV_Nebellicht_TFL_re_defS, getProfileInt( "Settings", "eLV_Nebellicht_TFL_re_defS", 0, profileFile ) );
    putValue( eLV_Standlicht_TFL_re_defS, getProfileInt( "Settings", "eLV_Standlicht_TFL_re_defS", 0, profileFile ) );
    putValue( eLV_Abblend_Fernlicht_re_defS, getProfileInt( "Settings", "eLV_Abblend_Fernlicht_re_defS", 0, profileFile ) );
    putValue( eBFS_Fond_Bed_AckS, getProfileInt( "Settings", "eBFS_Fond_Bed_AckS", 0, profileFile ) );
    putValue( eBFS_Lehne_nicht_verriegeltS, getProfileInt( "Settings", "eBFS_Lehne_nicht_verriegeltS", 0, profileFile ) );
    putValue( eBFS_Klapptisch_offenS, getProfileInt( "Settings", "eBFS_Klapptisch_offenS", 0, profileFile ) );
    putValue( eBFS_KD_FehlerS, getProfileInt( "Settings", "eBFS_KD_FehlerS", 0, profileFile ) );
    putValue( eBFS_Sitzsym_Fahrt_aktivS, getProfileInt( "Settings", "eBFS_Sitzsym_Fahrt_aktivS", 0, profileFile ) );
    putValue( eBFS_Sitzfahrt_aktivS, getProfileInt( "Settings", "eBFS_Sitzfahrt_aktivS", 0, profileFile ) );
    putValue( eBFS_SLV_aktivS, getProfileInt( "Settings", "eBFS_SLV_aktivS", 0, profileFile ) );
    putValue( eBFS_SHV_aktivS, getProfileInt( "Settings", "eBFS_SHV_aktivS", 0, profileFile ) );
    putValue( eBFS_LNV_aktivS, getProfileInt( "Settings", "eBFS_LNV_aktivS", 0, profileFile ) );
    putValue( eBFS_SNV_aktivS, getProfileInt( "Settings", "eBFS_SNV_aktivS", 0, profileFile ) );
    putValue( eBFS_KSV_aktivS, getProfileInt( "Settings", "eBFS_KSV_aktivS", 0, profileFile ) );
    putValue( eBFS_LKV_aktivS, getProfileInt( "Settings", "eBFS_LKV_aktivS", 0, profileFile ) );
    putValue( eBFS_STV_aktivS, getProfileInt( "Settings", "eBFS_STV_aktivS", 0, profileFile ) );
    putValue( eBFS_LHV_aktivS, getProfileInt( "Settings", "eBFS_LHV_aktivS", 0, profileFile ) );
    putValue( eBFS_LWV_aktivS, getProfileInt( "Settings", "eBFS_LWV_aktivS", 0, profileFile ) );
    putValue( eBFS_GHV_aktivS, getProfileInt( "Settings", "eBFS_GHV_aktivS", 0, profileFile ) );
    putValue( eBFS_KSS_Fahrt_aktivS, getProfileInt( "Settings", "eBFS_KSS_Fahrt_aktivS", 0, profileFile ) );
    putValue( eBFS_MMB_lokal_StopS, getProfileInt( "Settings", "eBFS_MMB_lokal_StopS", 0, profileFile ) );
    putValue( eBFS_Ruhestellung_StatusS, getProfileInt( "Settings", "eBFS_Ruhestellung_StatusS", 0, profileFile ) );

  //TSG_FT_02
    putValue( eCrcTSG_FT_02, getProfileInt( "Settings", "eCrcTSG_FT_02", 0, profileFile ) );
    putValue( eTSG_FT_02_BZS, getProfileInt( "Settings", "eTSG_FT_02_BZS", 0, profileFile ) );
    putValue( eFT_Tuer_Status, getProfileInt( "Settings", "eFT_Tuer_Status", 0, profileFile ) );

    putValue( eBCM1_Hinweis_Lichtnachlauf, getProfileInt( "Settings", "eBCM1_Hinweis_Lichtnachlauf", 0, profileFile ) );

    putValue( eHSP_Warnung_Text, getProfileInt( "Settings", "eHSP_Warnung_Text", 0, profileFile ) );

    putValue( eAAG_AVS_Fehler_02S, getProfileInt( "Settings", "eAAG_AVS_Fehler_02S", 0, profileFile ) );
    putValue( eBCM_Anf_AAW_MoLaWaS, getProfileInt( "Settings", "eBCM_Anf_AAW_MoLaWaS", 0, profileFile ) );
    putValue( eWFS_Schluessel_SollS, getProfileInt( "Settings", "eWFS_Schluessel_SollS", 0, profileFile ) );
    putValue( eWFS_Schluessel_IstS, getProfileInt( "Settings", "eWFS_Schluessel_IstS", 0, profileFile ) );
    putValue( eWFS_SafeS, getProfileInt( "Settings", "eWFS_SafeS", 0, profileFile ) );
    putValue( eWFS_LZS, getProfileInt( "Settings", "eWFS_LZS", 0, profileFile ) );
    putValue( eBCM_anf_VLWS, getProfileInt( "Settings", "eBCM_anf_VLWS", 0, profileFile ) );
    putValue( eBCM_LTM_Nebelschluss_StatusS, getProfileInt( "Settings", "eBCM_LTM_Nebelschluss_StatusS", 0, profileFile ) );
    putValue( eBCM_LTM_Allwetterl_StatusS, getProfileInt( "Settings", "eBCM_LTM_Allwetterl_StatusS", 0, profileFile ) );
    putValue( eBCM_LTM_PopUp_StatusS, getProfileInt( "Settings", "eBCM_LTM_PopUp_StatusS", 0, profileFile ) );
    putValue( eBCM_LTM_Nebell_StatusS, getProfileInt( "Settings", "eBCM_LTM_Nebell_StatusS", 0, profileFile ) );
    putValue( eBCM_LTM_PopUp_AnfS, getProfileInt( "Settings", "eBCM_LTM_PopUp_AnfS", 0, profileFile ) );
    putValue( eBCM_LTM_PopUp_InhaltS, getProfileInt( "Settings", "eBCM_LTM_PopUp_InhaltS", 0, profileFile ) );
    putValue( eHUD_FAS_Anzeige_KombiS, getProfileInt( "Settings", "eHUD_FAS_Anzeige_KombiS", 0, profileFile ) );
    putValue( eHUD_KDK_Anzeige_KombiS, getProfileInt( "Settings", "eHUD_KDK_Anzeige_KombiS", 0, profileFile ) );
    putValue( eHUD_PEA_Anzeige_KombiS, getProfileInt( "Settings", "eHUD_PEA_Anzeige_KombiS", 0, profileFile ) );
    putValue( eHUD_VZE_AIO_Anzeige_KombiS, getProfileInt( "Settings", "eHUD_VZE_AIO_Anzeige_KombiS", 0, profileFile ) );
}

void loadSettings1G( char profileFile[] )
{
    putValue( eMO_Kuehlerluefter_MUXS, getProfileInt( "Settings", "eMO_Kuehlerluefter_MUXS", 0, profileFile ) );
    putValue( eMO_Kuehlerluefter_1S, getProfileInt( "Settings", "eMO_Kuehlerluefter_1S", 126, profileFile ) );
    putValue( eMO_Kuehlerluefter_2S, getProfileInt( "Settings", "eMO_Kuehlerluefter_2S", 126, profileFile ) );
    putValue( eMO_HYB_Status_HV_LadungS, getProfileInt( "Settings", "eMO_HYB_Status_HV_LadungS", 0, profileFile ) );
    putValue( eWIV_Anzeige_aktivS, getProfileInt( "Settings", "eWIV_Anzeige_aktivS", 0, profileFile ) );
    putValue( eWIV_Oelmin_WarnS, getProfileInt( "Settings", "eWIV_Oelmin_WarnS", 0, profileFile ) );
    putValue( eWIV_SensorfehlerS, getProfileInt( "Settings", "eWIV_SensorfehlerS", 0, profileFile ) );
    putValue( eWIV_SchieflageS, getProfileInt( "Settings", "eWIV_SchieflageS", 0, profileFile ) );
    putValue( eWIV_OelstandS, getProfileFloat( "Settings", "eWIV_OelstandS", 0, profileFile ) );
    putValue( eMO_Zustand_HWPS, getProfileInt( "Settings", "eMO_Zustand_HWPS", 1, profileFile ) );
    putValue( eWIV_Oelsystem_aktivS, getProfileInt( "Settings", "eWIV_Oelsystem_aktivS", 0, profileFile ) );
    putValue( eWIV_nicht_betriebswarmS, getProfileInt( "Settings", "eWIV_nicht_betriebswarmS", 0, profileFile ) );
    putValue( eWIV_Ueberfuell_WarnS, getProfileInt( "Settings", "eWIV_Ueberfuell_WarnS", 0, profileFile ) );
    putValue( eWIV_laufender_MotorS, getProfileInt( "Settings", "eWIV_laufender_MotorS", 0, profileFile ) );
    putValue( eMO_Text_MotorstartS, getProfileInt( "Settings", "eMO_Text_MotorstartS", 0, profileFile ) );
    putValue( eMO_Text_Partikelfil_RegS, getProfileInt( "Settings", "eMO_Text_Partikelfil_RegS", 0, profileFile ) );
    putValue( eWIV_OelmengeS, getProfileFloat( "Settings", "eWIV_OelmengeS", 0, profileFile ) );
    putValue( eMO_SystemlampeS, getProfileInt( "Settings", "eMO_SystemlampeS", 0, profileFile ) );
    putValue( eMO_OBD2_LampeS, getProfileInt( "Settings", "eMO_OBD2_LampeS", 0, profileFile ) );
    putValue( eMO_HeissleuchteS, getProfileInt( "Settings", "eMO_HeissleuchteS", 0, profileFile ) );
    putValue( eMO_Partikel_LampeS, getProfileInt( "Settings", "eMO_Partikel_LampeS", 0, profileFile ) );
    putValue( eMO_WinterfahrprogS, getProfileInt( "Settings", "eMO_WinterfahrprogS", 0, profileFile ) );
    putValue( eWIV_Oelstand_nicht_vorhandenS, getProfileInt( "Settings", "eWIV_Oelstand_nicht_vorhandenS", 0, profileFile ) );
    putValue( eWIV_nachfuellanzeige_einS, getProfileInt( "Settings", "eWIV_nachfuellanzeige_einS", 0, profileFile ) );
    putValue( eWIV_Ueberfuell_deaktivS, getProfileInt( "Settings", "eWIV_Ueberfuell_deaktivS", 0, profileFile ) );
    putValue( eWIV_Unterfuell_WarnS, getProfileInt( "Settings", "eWIV_Unterfuell_WarnS", 0, profileFile ) );
    putValue( eMO_Text_TankdeckelwarnS, getProfileInt( "Settings", "eMO_Text_TankdeckelwarnS", 0, profileFile ) );
    putValue( eWIV_Enable_Oeldr_MotorS, getProfileInt( "Settings", "eWIV_Enable_Oeldr_MotorS", 0, profileFile ) );
    putValue( eWIV_Oeldr_Warn_MotorS, getProfileInt( "Settings", "eWIV_Oeldr_Warn_MotorS", 0, profileFile ) );
    putValue( eACC_Wunschgeschw_02S, getProfileFloat( "Settings", "eACC_Wunschgeschw_02S", 327.36, profileFile ) );
    putValue( eACC_Status_Prim_AnzS, getProfileInt( "Settings", "eACC_Status_Prim_AnzS", 0, profileFile ) );
    putValue( eACC_Abstandsindex_02S, getProfileInt( "Settings", "eACC_Abstandsindex_02S", 0, profileFile ) );
    putValue( eACC_Akustik_02S, getProfileInt( "Settings", "eACC_Akustik_02S", 0, profileFile ) );
    putValue( eACC_Gesetzte_ZeitlueckeS, getProfileInt( "Settings", "eACC_Gesetzte_ZeitlueckeS", 0, profileFile ) );
    putValue( eACC_Optischer_FahrerhinweisS, getProfileInt( "Settings", "eACC_Optischer_FahrerhinweisS", 0, profileFile ) );
    putValue( eACC_Typ_TachokranzS, getProfileInt( "Settings", "eACC_Typ_TachokranzS", 0, profileFile ) );
    putValue( eACC_Anzeige_ZeitlueckeS, getProfileInt( "Settings", "eACC_Anzeige_ZeitlueckeS", 0, profileFile ) );
    putValue( eACC_TachokranzS, getProfileInt( "Settings", "eACC_TachokranzS", 0, profileFile ) );
    putValue( eACC_Display_PrioS, getProfileInt( "Settings", "eACC_Display_PrioS", 0, profileFile ) );
    putValue( eACC_Relevantes_ObjektS, getProfileInt( "Settings", "eACC_Relevantes_ObjektS", 0, profileFile ) );
    putValue( eACC_Texte_PrimaeranzS, getProfileInt( "Settings", "eACC_Texte_PrimaeranzS", 0, profileFile ) );
    putValue( eACC_Wunschgeschw_erreichtS, getProfileInt( "Settings", "eACC_Wunschgeschw_erreichtS", 0, profileFile ) );
    putValue( eACC_Status_AnzeigeS, getProfileInt( "Settings", "eACC_Status_AnzeigeS", 0, profileFile ) );
    putValue( eACC_Texte_ZusatzanzS, getProfileInt( "Settings", "eACC_Texte_ZusatzanzS", 0, profileFile ) );
    putValue( eACC_Status_ZusatzanzS, getProfileInt( "Settings", "eACC_Status_ZusatzanzS", 0, profileFile ) );
    putValue( eACC_TexteS, getProfileInt( "Settings", "eACC_TexteS", 0, profileFile ) );
    putValue( eACC_Texte_braking_guardS, getProfileInt( "Settings", "eACC_Texte_braking_guardS", 0, profileFile ) );
    putValue( eACC_WarnhinweisS, getProfileInt( "Settings", "eACC_WarnhinweisS", 0, profileFile ) );
    putValue( eACC_Geschw_ZielfahrzeugS, getProfileFloat( "Settings", "eACC_Geschw_ZielfahrzeugS", 0, profileFile ) );
    putValue( eACC_Charisma_FahrPrS, getProfileInt( "Settings", "eACC_Charisma_FahrPrS", 0, profileFile ) );
    putValue( eACC_Charisma_StatusS, getProfileInt( "Settings", "eACC_Charisma_StatusS", 0, profileFile ) );
    putValue( eAB_RGS_AnstS, getProfileInt( "Settings", "eAB_RGS_AnstS", 8, profileFile ) );
    putValue( eAB_Front_CrashS, getProfileInt( "Settings", "eAB_Front_CrashS", 0, profileFile ) );
    putValue( eAB_Heck_CrashS, getProfileInt( "Settings", "eAB_Heck_CrashS", 0, profileFile ) );
    putValue( eAB_SF_CrashS, getProfileInt( "Settings", "eAB_SF_CrashS", 0, profileFile ) );
    putValue( eAB_SB_CrashS, getProfileInt( "Settings", "eAB_SB_CrashS", 0, profileFile ) );
    putValue( eAB_Rollover_CrashS, getProfileInt( "Settings", "eAB_Rollover_CrashS", 0, profileFile ) );
    putValue( eAB_Crash_IntS, getProfileInt( "Settings", "eAB_Crash_IntS", 0, profileFile ) );
    putValue( eAB_LampeS, getProfileInt( "Settings", "eAB_LampeS", 1, profileFile ) );
    putValue( eAB_DeaktiviertS, getProfileInt( "Settings", "eAB_DeaktiviertS", 0, profileFile ) );
    putValue( eAB_VB_deaktiviertS, getProfileInt( "Settings", "eAB_VB_deaktiviertS", 1, profileFile ) );
    putValue( eAB_SystemfehlerS, getProfileInt( "Settings", "eAB_SystemfehlerS", 0, profileFile ) );
    putValue( eAB_DiagnoseS, getProfileInt( "Settings", "eAB_DiagnoseS", 0, profileFile ) );
    putValue( eAB_StellgliedtestS, getProfileInt( "Settings", "eAB_StellgliedtestS", 0, profileFile ) );
    putValue( eAB_Erh_Auf_VBS, getProfileInt( "Settings", "eAB_Erh_Auf_VBS", 0, profileFile ) );
    putValue( eAB_Gurtwarn_VFS, getProfileInt( "Settings", "eAB_Gurtwarn_VFS", 0, profileFile ) );
    putValue( eAB_Gurtwarn_VBS, getProfileInt( "Settings", "eAB_Gurtwarn_VBS", 0, profileFile ) );
    putValue( eAB_Anzeige_FussgS, getProfileInt( "Settings", "eAB_Anzeige_FussgS", 0, profileFile ) );
    putValue( eAB_Texte_AKSS, getProfileInt( "Settings", "eAB_Texte_AKSS", 0, profileFile ) );
    putValue( eAB_PAO_Leuchte_AnfS, getProfileInt( "Settings", "eAB_PAO_Leuchte_AnfS", 1, profileFile ) );
    putValue( eAB_MKB_gueltigS, getProfileInt( "Settings", "eAB_MKB_gueltigS", 0, profileFile ) );
    putValue( eAB_MKB_AnforderungS, getProfileInt( "Settings", "eAB_MKB_AnforderungS", 0, profileFile ) );
    putValue( eAB_VersorgungsspannungS, getProfileInt( "Settings", "eAB_VersorgungsspannungS", 0, profileFile ) );
    putValue( eAB_Belegung_VBS, getProfileInt( "Settings", "eAB_Belegung_VBS", 0, profileFile ) );
    putValue( eAB_Gurtschloss_FAS, getProfileInt( "Settings", "eAB_Gurtschloss_FAS", 1, profileFile ) );
    putValue( eAB_Gurtschloss_BFS, getProfileInt( "Settings", "eAB_Gurtschloss_BFS", 1, profileFile ) );
    putValue( eAB_Gurtschloss_Reihe2_FAS, getProfileInt( "Settings", "eAB_Gurtschloss_Reihe2_FAS", 1, profileFile ) );
    putValue( eAB_Gurtschloss_Reihe2_MIS, getProfileInt( "Settings", "eAB_Gurtschloss_Reihe2_MIS", 1, profileFile ) );
    putValue( eAB_Gurtschloss_Reihe2_BFS, getProfileInt( "Settings", "eAB_Gurtschloss_Reihe2_BFS", 1, profileFile ) );
    putValue( eAB_Gurtschloss_Reihe3_FAS, getProfileInt( "Settings", "eAB_Gurtschloss_Reihe3_FAS", 1, profileFile ) );
    putValue( eAB_Gurtschloss_Reihe3_MIS, getProfileInt( "Settings", "eAB_Gurtschloss_Reihe3_MIS", 1, profileFile ) );
    putValue( eAB_Gurtschloss_Reihe3_BFS, getProfileInt( "Settings", "eAB_Gurtschloss_Reihe3_BFS", 1, profileFile ) );
    putValue( eAB_Sitzpos_Sens_FAS, getProfileInt( "Settings", "eAB_Sitzpos_Sens_FAS", 0, profileFile ) );
    putValue( eAB_Sitzpos_Sens_BFS, getProfileInt( "Settings", "eAB_Sitzpos_Sens_BFS", 0, profileFile ) );
    putValue( eBEM_02_AbschaltstufenS, getProfileInt( "Settings", "eBEM_02_AbschaltstufenS", 0, profileFile ) );
    putValue( eBEM_STH_ZielzeitS, getProfileFloat( "Settings", "eBEM_STH_ZielzeitS", 70, profileFile ) );
    putValue( eBEM_MMI_VorwarnungS, getProfileInt( "Settings", "eBEM_MMI_VorwarnungS", 0, profileFile ) );
    putValue( eBEM_HL_KontingentierungS, getProfileFloat( "Settings", "eBEM_HL_KontingentierungS", -1000, profileFile ) );
    putValue( eBEM_GeneratordiagnoseS, getProfileInt( "Settings", "eBEM_GeneratordiagnoseS", 0, profileFile ) );
    putValue( eBEM_Red_InnengeblaeseS, getProfileInt( "Settings", "eBEM_Red_InnengeblaeseS", 0, profileFile ) );
    putValue( eBEM_STH_EinschaltverbotS, getProfileInt( "Settings", "eBEM_STH_EinschaltverbotS", 0, profileFile ) );
    putValue( eBEM_HL_Regelung_StatusS, getProfileInt( "Settings", "eBEM_HL_Regelung_StatusS", 0, profileFile ) );
    putValue( eBEM_LadezustandS, getProfileFloat( "Settings", "eBEM_LadezustandS", 140, profileFile ) );
    putValue( eBEM_BatteriediagnoseS, getProfileInt( "Settings", "eBEM_BatteriediagnoseS", 0, profileFile ) );
    putValue( eBEM_DFMS, getProfileFloat( "Settings", "eBEM_DFMS", 0.025, profileFile ) );
    putValue( eBEM_REK_aktivS, getProfileInt( "Settings", "eBEM_REK_aktivS", 0, profileFile ) );
    putValue( eBEM_EMLIN_ungueltigS, getProfileInt( "Settings", "eBEM_EMLIN_ungueltigS", 0, profileFile ) );
    putValue( eBEM_Batt_AbS, getProfileInt( "Settings", "eBEM_Batt_AbS", 0, profileFile ) );
    putValue( eBEM_UBDMS, getProfileFloat( "Settings", "eBEM_UBDMS", 5, profileFile ) );
    putValue( eBEM_UGenSollS, getProfileFloat( "Settings", "eBEM_UGenSollS", 10.6, profileFile ) );
    putValue( eCHA_Eco_Charisma_LEDS, getProfileInt( "Settings", "eCHA_Eco_Charisma_LEDS", 0, profileFile ) );
    putValue( eCHA_Ziel_FahrPr_AMBS, getProfileInt( "Settings", "eCHA_Ziel_FahrPr_AMBS", 0, profileFile ) );
    putValue( eCHA_Ziel_FahrPr_IVBS, getProfileInt( "Settings", "eCHA_Ziel_FahrPr_IVBS", 0, profileFile ) );
    putValue( eCHA_Kombi_TexteS, getProfileInt( "Settings", "eCHA_Kombi_TexteS", 0, profileFile ) );
    putValue( eCHA_Ziel_FahrPr_KLS, getProfileInt( "Settings", "eCHA_Ziel_FahrPr_KLS", 0, profileFile ) );
    putValue( eCHA_Ziel_FahrPr_NAV_RouteS, getProfileInt( "Settings", "eCHA_Ziel_FahrPr_NAV_RouteS", 0, profileFile ) );
    putValue( eCHA_Ziel_FahrPr_NAV_SegelS, getProfileInt( "Settings", "eCHA_Ziel_FahrPr_NAV_SegelS", 0, profileFile ) );
    putValue( eCHA_Ziel_FahrPr_03_01S, getProfileInt( "Settings", "eCHA_Ziel_FahrPr_03_01S", 0, profileFile ) );
    putValue( eCHA_Ziel_FahrPr_03_02S, getProfileInt( "Settings", "eCHA_Ziel_FahrPr_03_02S", 0, profileFile ) );
    putValue( eDR_SystemstatusS, getProfileInt( "Settings", "eDR_SystemstatusS", 0, profileFile ) );
    putValue( eLF_TexteS, getProfileInt( "Settings", "eLF_TexteS", 0, profileFile ) );
    putValue( eDR_TasterS, getProfileInt( "Settings", "eDR_TasterS", 0, profileFile ) );
    putValue( eDR_Gelbe_WarnlampeS, getProfileInt( "Settings", "eDR_Gelbe_WarnlampeS", 0, profileFile ) );
    putValue( eDR_Daempferreg_TexteS, getProfileInt( "Settings", "eDR_Daempferreg_TexteS", 0, profileFile ) );
    putValue( eDGN_VerlernzaehlerS, getProfileInt( "Settings", "eDGN_VerlernzaehlerS", 0, profileFile ) );
    putValue( eKBI_Kilometerstand_1S, getProfileInt( "Settings", "eKBI_Kilometerstand_1S", 1048574, profileFile ) );
    putValue( eUH_Jahr_1S, getProfileInt( "Settings", "eUH_Jahr_1S", 2000, profileFile ) );
    putValue( eUH_Monat_1S, getProfileInt( "Settings", "eUH_Monat_1S", 1, profileFile ) );
    putValue( eUH_Tag_1S, getProfileInt( "Settings", "eUH_Tag_1S", 0, profileFile ) );
    putValue( eUH_Stunde_1S, getProfileInt( "Settings", "eUH_Stunde_1S", 0, profileFile ) );
    putValue( eUH_Minute_1S, getProfileInt( "Settings", "eUH_Minute_1S", 0, profileFile ) );
    putValue( eUH_Sekunde_1S, getProfileInt( "Settings", "eUH_Sekunde_1S", 0, profileFile ) );
    putValue( eKombi_02_altS, getProfileInt( "Settings", "eKombi_02_altS", 1, profileFile ) );
    putValue( eUhrzeit_01_altS, getProfileInt( "Settings", "eUhrzeit_01_altS", 1, profileFile ) );
    putValue( eEPB_Fehlerlampe_GelbS, getProfileInt( "Settings", "eEPB_Fehlerlampe_GelbS", 0, profileFile ) );
    putValue( eEPB_Fehlerlampe_BKLS, getProfileInt( "Settings", "eEPB_Fehlerlampe_BKLS", 0, profileFile ) );
    putValue( eEPB_FunktionslampeS, getProfileInt( "Settings", "eEPB_FunktionslampeS", 0, profileFile ) );
    putValue( eEPB_TexteS, getProfileInt( "Settings", "eEPB_TexteS", 0, profileFile ) );
    putValue( eEPB_AkustikS, getProfileInt( "Settings", "eEPB_AkustikS", 0, profileFile ) );
    putValue( eEPB_AutoholdlampeS, getProfileInt( "Settings", "eEPB_AutoholdlampeS", 0, profileFile ) );
    putValue( eEPB_Bremsbelag_WarnS, getProfileInt( "Settings", "eEPB_Bremsbelag_WarnS", 0, profileFile ) );
    putValue( eESP_QBit_GierrateS, getProfileInt( "Settings", "eESP_QBit_GierrateS", 1, profileFile ) );
    putValue( eESP_QBit_LaengsbeschlS, getProfileInt( "Settings", "eESP_QBit_LaengsbeschlS", 1, profileFile ) );
    putValue( eESP_QBit_QuerbS, getProfileInt( "Settings", "eESP_QBit_QuerbS", 1, profileFile ) );
    putValue( eESP_QuerbeschleunigungS, getProfileFloat( "Settings", "eESP_QuerbeschleunigungS", 0, profileFile ) );
    putValue( eESP_LaengsbeschlS, getProfileFloat( "Settings", "eESP_LaengsbeschlS", 0, profileFile ) );
    putValue( eESP_GierrateS, getProfileFloat( "Settings", "eESP_GierrateS", 0, profileFile ) );
    putValue( eESP_VZ_GierrateS, getProfileInt( "Settings", "eESP_VZ_GierrateS", 0, profileFile ) );
    putValue( eESP_NotbremsanzeigeS, getProfileInt( "Settings", "eESP_NotbremsanzeigeS", 0, profileFile ) );
    putValue( eESP_SpannungsAnfS, getProfileInt( "Settings", "eESP_SpannungsAnfS", 0, profileFile ) );
    putValue( eESP_PLA_AbbruchS, getProfileInt( "Settings", "eESP_PLA_AbbruchS", 0, profileFile ) );
    putValue( eESP_Status_ESP_PLAS, getProfileInt( "Settings", "eESP_Status_ESP_PLAS", 0, profileFile ) );
    putValue( eBR_SystemartS, getProfileInt( "Settings", "eBR_SystemartS", 0, profileFile ) );
    putValue( eESP_ZaehnezahlS, getProfileInt( "Settings", "eESP_ZaehnezahlS", 0, profileFile ) );
    putValue( eESP_24_BZS, getProfileInt( "Settings", "eESP_24_BZS", 0, profileFile ) );
    putValue( eESP_LampeS, getProfileInt( "Settings", "eESP_LampeS", 1, profileFile ) );
    putValue( eABS_LampeS, getProfileInt( "Settings", "eABS_LampeS", 1, profileFile ) );
    putValue( eBK_Lampe_02S, getProfileInt( "Settings", "eBK_Lampe_02S", 1, profileFile ) );
    putValue( eESP_m_RaddrehzS, getProfileFloat( "Settings", "eESP_m_RaddrehzS", 65.532, profileFile ) );
    putValue( eESP_Textanzeigen_03S, getProfileInt( "Settings", "eESP_Textanzeigen_03S", 0, profileFile ) );
    putValue( eESP_MeldungenS, getProfileInt( "Settings", "eESP_MeldungenS", 0, profileFile ) );
    putValue( KCAN_ESP_Wegimp_VA, getProfileInt( "Settings", "KCAN_ESP_Wegimp_VA", 0, profileFile ) );
    putValue( eESP_Fehlerstatus_WegimpS, getProfileInt( "Settings", "eESP_Fehlerstatus_WegimpS", 0, profileFile ) );
    putValue( eESP_Wegimp_UeberlaufS, getProfileInt( "Settings", "eESP_Wegimp_UeberlaufS", 0, profileFile ) );
    putValue( eESP_QBit_Wegimp_VAS, getProfileInt( "Settings", "eESP_QBit_Wegimp_VAS", 1, profileFile ) );
    putValue( eESP_HDC_FktLampeS, getProfileInt( "Settings", "eESP_HDC_FktLampeS", 0, profileFile ) );
    putValue( eESP_Off_LampeS, getProfileInt( "Settings", "eESP_Off_LampeS", 0, profileFile ) );
    putValue( eESP_HDC_RegelgeschwS, getProfileFloat( "Settings", "eESP_HDC_RegelgeschwS", 40.32, profileFile ) );
    putValue( eESP_BKV_WarnungS, getProfileInt( "Settings", "eESP_BKV_WarnungS", 0, profileFile ) );
    putValue( eMotor_12_altS, getProfileInt( "Settings", "eMotor_12_altS", 1, profileFile ) );
    putValue( eGW_73_va_11S, getProfileInt( "Settings", "eGW_73_va_11S", 1, profileFile ) );
    putValue( eGetriebe_11_altS, getProfileInt( "Settings", "eGetriebe_11_altS", 1, profileFile ) );
    putValue( eGetriebe_13_altS, getProfileInt( "Settings", "eGetriebe_13_altS", 1, profileFile ) );
    putValue( eGW_73_va_14S, getProfileInt( "Settings", "eGW_73_va_14S", 1, profileFile ) );
    putValue( eGW_73_va_16S, getProfileInt( "Settings", "eGW_73_va_16S", 1, profileFile ) );
    putValue( eGW_73_va_17S, getProfileInt( "Settings", "eGW_73_va_17S", 1, profileFile ) );
    putValue( eMO_QBit_Drehzahl_01S, getProfileInt( "Settings", "eMO_QBit_Drehzahl_01S", 1, profileFile ) );
    putValue( eMKE_TexteS, getProfileInt( "Settings", "eMKE_TexteS", 0, profileFile ) );
    putValue( eMO_Drehzahl_01S, getProfileFloat( "Settings", "eMO_Drehzahl_01S", 0, profileFile ) );
    putValue( eGE_FahrstufeS, getProfileInt( "Settings", "eGE_FahrstufeS", 1, profileFile ) );
    putValue( eGE_NotlaufS, getProfileInt( "Settings", "eGE_NotlaufS", 0, profileFile ) );
    putValue( eGE_ZielgangS, getProfileInt( "Settings", "eGE_ZielgangS", 0, profileFile ) );
    putValue( eWFS_GSG_RNDS, getProfileInt( "Settings", "eWFS_GSG_RNDS", 0, profileFile ) );
    putValue( eWFS_GSG_CRCS, getProfileInt( "Settings", "eWFS_GSG_CRCS", 0, profileFile ) );
    putValue( eISO_ALL_01_Req_DataS, getProfileInt( "Settings", "eISO_ALL_01_Req_DataS", 0, profileFile ) );
    putValue( eISO_ALL_01_Req_Data_2S, getProfileInt( "Settings", "eISO_ALL_01_Req_Data_2S", 0, profileFile ) );
    putValue( eISO_Kombi_Req_DataS, getProfileInt( "Settings", "eISO_Kombi_Req_DataS", 0, profileFile ) );
    putValue( eKS_Kombi_Req_DataS, getProfileInt( "Settings", "eKS_Kombi_Req_DataS", 0, profileFile ) );
    putValue( eLDW_GongS, getProfileInt( "Settings", "eLDW_GongS", 0, profileFile ) );
    putValue( eLDW_TexteS, getProfileInt( "Settings", "eLDW_TexteS", 0, profileFile ) );
    putValue( eLDW_Seite_DLCTLCS, getProfileInt( "Settings", "eLDW_Seite_DLCTLCS", 0, profileFile ) );
    putValue( eLDW_Lernmodus_seitenabhaengigS, getProfileInt( "Settings", "eLDW_Lernmodus_seitenabhaengigS", 0, profileFile ) );
    putValue( eLDW_DLCS, getProfileFloat( "Settings", "eLDW_DLCS", 1.25, profileFile ) );
    putValue( eLDW_TLCS, getProfileFloat( "Settings", "eLDW_TLCS", 3.1, profileFile ) );
    putValue( eLDW_Status_LED_gelbS, getProfileInt( "Settings", "eLDW_Status_LED_gelbS", 0, profileFile ) );
    putValue( eLDW_Status_LED_gruenS, getProfileInt( "Settings", "eLDW_Status_LED_gruenS", 0, profileFile ) );
    putValue( eEPS_01_BZS, getProfileInt( "Settings", "eEPS_01_BZS", 0, profileFile ) );
    putValue( eEPS_AkustiksignalS, getProfileInt( "Settings", "eEPS_AkustiksignalS", 0, profileFile ) );
    putValue( eEPS_FehlerlampeS, getProfileInt( "Settings", "eEPS_FehlerlampeS", 0, profileFile ) );
    putValue( eEPS_WarnungenS, getProfileInt( "Settings", "eEPS_WarnungenS", 0, profileFile ) );
    putValue( eEPS_PLA_AbbruchS, getProfileInt( "Settings", "eEPS_PLA_AbbruchS", 0, profileFile ) );
    putValue( eEPS_PLA_FehlerS, getProfileInt( "Settings", "eEPS_PLA_FehlerS", 0, profileFile ) );
    putValue( eEPS_PLA_StatusS, getProfileInt( "Settings", "eEPS_PLA_StatusS", 0, profileFile ) );
    putValue( eEPS_Charisma_FahrPrS, getProfileInt( "Settings", "eEPS_Charisma_FahrPrS", 0, profileFile ) );
    putValue( eEPS_Charisma_StatusS, getProfileInt( "Settings", "eEPS_Charisma_StatusS", 0, profileFile ) );
    putValue( eEPS_LenkerpositionS, getProfileInt( "Settings", "eEPS_LenkerpositionS", 0, profileFile ) );
    putValue( eEPS_Anf_KLS, getProfileInt( "Settings", "eEPS_Anf_KLS", 0, profileFile ) );
    putValue( eAFS_Abbiegelicht_li_AnfS, getProfileInt( "Settings", "eAFS_Abbiegelicht_li_AnfS", 0, profileFile ) );
    putValue( eAFS_Abbiegelicht_re_AnfS, getProfileInt( "Settings", "eAFS_Abbiegelicht_re_AnfS", 0, profileFile ) );
    putValue( eAFS_Abbiegelicht_Dimm_AnfS, getProfileInt( "Settings", "eAFS_Abbiegelicht_Dimm_AnfS", 0, profileFile ) );
    putValue( eAFS_Verfuegbarkeit_GLWS, getProfileInt( "Settings", "eAFS_Verfuegbarkeit_GLWS", 1, profileFile ) );
    putValue( eAFS_Status_adaptive_LVS, getProfileInt( "Settings", "eAFS_Status_adaptive_LVS", 1, profileFile ) );
    putValue( eAFS_Fernlicht_li_defektS, getProfileInt( "Settings", "eAFS_Fernlicht_li_defektS", 0, profileFile ) );
    putValue( eAFS_Fernlicht_re_defektS, getProfileInt( "Settings", "eAFS_Fernlicht_re_defektS", 0, profileFile ) );
    putValue( eAFS_Fernlicht_StatusS, getProfileInt( "Settings", "eAFS_Fernlicht_StatusS", 0, profileFile ) );
    putValue( eLWR_AFS_01_BZS, getProfileInt( "Settings", "eLWR_AFS_01_BZS", 0, profileFile ) );
    putValue( eAFS_LampeS, getProfileInt( "Settings", "eAFS_LampeS", 0, profileFile ) );
    putValue( eLWR_LampeS, getProfileInt( "Settings", "eLWR_LampeS", 0, profileFile ) );
    putValue( eAFS_FehlertextS, getProfileInt( "Settings", "eAFS_FehlertextS", 0, profileFile ) );
    putValue( eAFS_LED_BlinkmodeS, getProfileInt( "Settings", "eAFS_LED_BlinkmodeS", 0, profileFile ) );
    putValue( eLWR_Touristenmodus_aktivS, getProfileInt( "Settings", "eLWR_Touristenmodus_aktivS", 0, profileFile ) );
    putValue( eAFS_Charisma_FahrPrS, getProfileInt( "Settings", "eAFS_Charisma_FahrPrS", 0, profileFile ) );
    putValue( eAFS_Charisma_StatusS, getProfileInt( "Settings", "eAFS_Charisma_StatusS", 0, profileFile ) );
    putValue( eAFS_Charisma_UmschaltungS, getProfileInt( "Settings", "eAFS_Charisma_UmschaltungS", 0, profileFile ) );
    putValue( eAFS_AllwetterlichtS, getProfileInt( "Settings", "eAFS_AllwetterlichtS", 0, profileFile ) );
    putValue( eLWR_Touristenmodus_verbautS, getProfileInt( "Settings", "eLWR_Touristenmodus_verbautS", 0, profileFile ) );
    putValue( eAFS_adaptive_LV_verbautS, getProfileInt( "Settings", "eAFS_adaptive_LV_verbautS", 0, profileFile ) );

 //motor_gas01
    putValue( eMO_CNG_LPG, getProfileInt( "Settings", "eMO_CNG_LPG", 0, profileFile ) );
    putValue( eMO_AnzeigeGasbetrieb, getProfileInt( "Settings", "eMO_AnzeigeGasbetrieb", 0, profileFile ) );
    putValue( eMO_akt_Betrieb, getProfileInt( "Settings", "eMO_akt_Betrieb", 0, profileFile ) );
    putValue( eMO_Erdgasqualitaet, getProfileInt( "Settings", "eMO_Erdgasqualitaet", 0, profileFile ) );
    putValue( eMO_Verbrauchsaequivalent, getProfileFloat( "Settings", "eMO_Verbrauchsaequivalent", 0, profileFile ) );
    putValue( eMO_Fuellungsgrad_CNG, getProfileFloat( "Settings", "eMO_Fuellungsgrad_CNG", 0, profileFile ) );
    putValue( eMO_CNG_Ueberlauf_m0, getProfileInt( "Settings", "eMO_CNG_Ueberlauf_m0", 0, profileFile ) );
    putValue( eMO_Tankmasse_CNG, getProfileFloat( "Settings", "eMO_Tankmasse_CNG", 0, profileFile ) );

  //motor gas consumption
    putValue( eMO_Verbrauch_CNG, getProfileInt( "Settings", "eMO_Verbrauch_CNG", 0, profileFile ) );
    putValue( eGasConsumption, getProfileFloat( "Settings", "eGasConsumption", 0, profileFile ) );

  //ARA_Status_01

  //ESP_21
    putValue( eESP_21_BZS, getProfileInt( "Settings", "eESP_21_BZS", 0, profileFile ) );
    putValue( eCrcESP_21, getProfileInt( "Settings", "eCrcESP_21", 0, profileFile ) );
    putValue( eESP_v_Signal, getProfileInt( "Settings", "eESP_v_Signal", 0, profileFile ) );
    putValue( eESP_Anhaltevorgang_ACC_aktiv, getProfileInt( "Settings", "eESP_Anhaltevorgang_ACC_aktiv", 0, profileFile ) );

    putValue( eMO_Tankbereitschaft_Status, getProfileInt( "Settings", "eMO_Tankbereitschaft_Status", 0, profileFile ) );

    putValue( eHRE_Anzeigetexte, getProfileInt( "Settings", "eHRE_Anzeigetexte", 0, profileFile ) );

    putValue( eMO_RedFahrleistung_Lampe, getProfileInt( "Settings", "eMO_RedFahrleistung_Lampe", 0, profileFile ) );

    putValue( eRW_Reichweite_Einheit_Anzeige, getProfileInt( "Settings", "eRW_Reichweite_Einheit_Anzeige", 0, profileFile ) );
    putValue( eRW_Gesamt_Reichweite_Anzeige, getProfileInt( "Settings", "eRW_Gesamt_Reichweite_Anzeige", 0, profileFile ) );
    putValue( eRW_Gesamt_ReichweiteS, getProfileInt( "Settings", "eRW_Gesamt_ReichweiteS", 2046, profileFile ) );
    putValue( eRW_Primaer_Reichweite_Anzeige, getProfileInt( "Settings", "eRW_Primaer_Reichweite_Anzeige", 0, profileFile ) );
    putValue( eRW_Sekundaer_Reichweite_Anzeige, getProfileInt( "Settings", "eRW_Sekundaer_Reichweite_Anzeige", 0, profileFile ) );

  //PLA_Status_02
    putValue( ePLA_Anf_Akustik, getProfileInt( "Settings", "ePLA_Anf_Akustik", 0, profileFile ) );
    putValue( ePLA_Anf_Anzeige_Schwellpfeil, getProfileInt( "Settings", "ePLA_Anf_Anzeige_Schwellpfeil", 0, profileFile ) );
    putValue( ePLA_Anf_Anzeige_Bremsfuss, getProfileInt( "Settings", "ePLA_Anf_Anzeige_Bremsfuss", 0, profileFile ) );
    putValue( ePLA_Anf_Anzeigemodus, getProfileInt( "Settings", "ePLA_Anf_Anzeigemodus", 0, profileFile ) );
    putValue( ePLA_Anf_Meldungen, getProfileInt( "Settings", "ePLA_Anf_Meldungen", 0, profileFile ) );
    putValue( ePLA_Status_Aktive_SeiteS, getProfileInt( "Settings", "ePLA_Status_Aktive_Seite", 0, profileFile ) );
    putValue( ePLA_Anf_Anzeige_MiniS, getProfileInt( "Settings", "ePLA_Anf_Anzeige_Mini", 0, profileFile ) );
    putValue( ePLA_Anzahl_Segmente_SchwellpfeilS, getProfileInt( "Settings", "ePLA_Anzahl_Segmente_SchwellpfeilS", 0, profileFile ) );
    putValue( ePLA_Status_Funktion, getProfileInt( "Settings", "ePLA_Status_Funktion", 0, profileFile ) );
    putValue( ePLA_Status_beenden_Mini, getProfileInt( "Settings", "ePLA_Status_beenden_Mini", 0, profileFile ) );
    putValue( ePLA_Status_QP_Rueckw_Mini, getProfileInt( "Settings", "ePLA_Status_QP_Rueckw_Mini", 0, profileFile ) );
    putValue( ePLA_Status_QP_Vorw_Mini, getProfileInt( "Settings", "ePLA_Status_QP_Vorw_Mini", 0, profileFile ) );
    putValue( ePLA_Fortschritt_bis_ZugendeS, getProfileInt( "Settings", "ePLA_Fortschritt_bis_ZugendeS", 126, profileFile ) );
    putValue( ePLA_Abstand_zur_ParklueckeS, getProfileInt( "Settings", "ePLA_Abstand_zur_ParklueckeS", 2540, profileFile ) );

    putValue( eACC_Status_GRA_ModusS, getProfileInt( "Settings", "eACC_Status_GRA_ModusS", 0, profileFile ) );
    putValue( eACC_FoD_StatusS, getProfileInt( "Settings", "eACC_FoD_StatusS", 0, profileFile ) );
    putValue( eAB_Gurtwarn_Reihe4_FAS, getProfileInt( "Settings", "eAB_Gurtwarn_Reihe4_FAS", 0, profileFile ) );
    putValue( eAB_Gurtwarn_Reihe4_BFS, getProfileInt( "Settings", "eAB_Gurtwarn_Reihe4_BFS", 0, profileFile ) );
    putValue( eAB_Gurtwarn_Reihe4_MIS, getProfileInt( "Settings", "eAB_Gurtwarn_Reihe4_MIS", 0, profileFile ) );
    putValue( eAWV_AW_AbstandS, getProfileInt( "Settings", "eAWV_AW_AbstandS", 511, profileFile ) );
    putValue( eAWV_AW_ZeitlueckeS, getProfileFloat( "Settings", "eAWV_AW_ZeitlueckeS", 0, profileFile ) ); // RBS_InitGateway.can
//  putValue( eAWV_AW_ZeitlueckeS, getProfileFloat( "Settings", "eAWV_AW_ZeitlueckeS", 6.3, profileFile ) ); // BAP_SaveINI.can
    putValue( eAWV_AW_TexteS, getProfileInt( "Settings", "eAWV_AW_TexteS", 0, profileFile ) );
    putValue( eAWV_AW_Texte_ZusatzanzeigeS, getProfileInt( "Settings", "eAWV_AW_Texte_ZusatzanzeigeS", 0, profileFile ) );
    putValue( eEPB_03_CRCS, getProfileInt( "Settings", "eEPB_03_CRCS", 0, profileFile ) );
    putValue( eEPB_03_BZS, getProfileInt( "Settings", "eEPB_03_BZS", 0, profileFile ) );
    putValue( eHVLM_Restladezeit_HV_Bat_02S, getProfileInt( "Settings", "eHVLM_Restladezeit_HV_Bat_02S", 2550, profileFile ) );
    putValue( eHVLM_AnzeigetexteS, getProfileInt( "Settings", "eHVLM_AnzeigetexteS", 0, profileFile ) );
    putValue( eHVLM_Bat_laden_aktivS, getProfileInt( "Settings", "eHVLM_Bat_laden_aktivS", 0, profileFile ) );
    putValue( eTSK_Einheit_vMax_FahrerInfoS, getProfileInt( "Settings", "eTSK_Einheit_vMax_FahrerInfoS", 0, profileFile ) );
    putValue( eTSK_Status_vMax_FahrerInfoS, getProfileInt( "Settings", "eTSK_Status_vMax_FahrerInfoS", 0, profileFile ) );
    putValue( eTSK_vMax_FahrerInfoS, getProfileInt( "Settings", "eTSK_vMax_FahrerInfoS", 15, profileFile ) );
    putValue( eRKA_FMVSS138_LampeS, getProfileInt( "Settings", "eRKA_FMVSS138_LampeS", 0, profileFile ) );
    putValue( eRKA_FMVSS138_MILS, getProfileInt( "Settings", "eRKA_FMVSS138_MILS", 0, profileFile ) );
    putValue( eSI_P_Mode_gueltigS, getProfileInt( "Settings", "eSI_P_Mode_gueltigS", 0, profileFile ) );
    putValue( eSI_P_ModeS, getProfileInt( "Settings", "eSI_P_ModeS", 0, profileFile ) );
    putValue( eMOD_Request_ServiceKeyS, getProfileInt( "Settings", "eMOD_Request_ServiceKeyS", 0, profileFile ) );
    putValue( eBEM_06_CRCS, getProfileInt( "Settings", "eBEM_06_CRCS", 0, profileFile ) );
    putValue( eBEM_06_BZS, getProfileInt( "Settings", "eBEM_06_BZS", 0, profileFile ) );
    putValue( eNVEM_BordnetzdiagnoseS, getProfileInt( "Settings", "eNVEM_BordnetzdiagnoseS", 0, profileFile ) );
    putValue( eFoD_Anz_FunktionsabschaltungS, getProfileInt( "Settings", "eFoD_Anz_FunktionsabschaltungS", 0, profileFile ) );
    putValue( eGetriebe_14_altS, getProfileInt( "Settings", "eGetriebe_14_altS", 1, profileFile ) );
    putValue( eGE_SumpftemperaturS, getProfileInt( "Settings", "eGE_SumpftemperaturS", -58, profileFile ) );
    putValue( eGNSS_Ortung_2D_Geschw_ue_GrundS, getProfileFloat( "Settings", "eGNSS_Ortung_2D_Geschw_ue_GrundS", 127.5, profileFile ) );
    putValue( eGNSS_Ortung_Guete_GeschwindigkS, getProfileFloat( "Settings", "eGNSS_Ortung_Guete_GeschwindigkS", 3.1, profileFile ) );
    putValue( eHVK_Gesamtst_SpgfreiheitS, getProfileInt( "Settings", "eHVK_Gesamtst_SpgfreiheitS", 0, profileFile ) );
    putValue( eLoGeWa_C2C_Event_EinheitS, getProfileInt( "Settings", "eLoGeWa_C2C_Event_EinheitS", 0, profileFile ) );
    putValue( eLoGeWa_C2C_Event_RichtungS, getProfileInt( "Settings", "eLoGeWa_C2C_Event_RichtungS", 0, profileFile ) );
    putValue( eLoGeWa_C2C_Event_StatusS, getProfileInt( "Settings", "eLoGeWa_C2C_Event_StatusS", 0, profileFile ) );
    putValue( eLoGeWa_C2C_Event_WarnungS, getProfileInt( "Settings", "eLoGeWa_C2C_Event_WarnungS", 0, profileFile ) );
    putValue( eLoGeWa_C2C_Event_EntfernungS, getProfileFloat( "Settings", "eLoGeWa_C2C_Event_EntfernungS", 6553.5, profileFile ) );
    putValue( eMVK_MV_Netz_WarnungenS, getProfileInt( "Settings", "eMVK_MV_Netz_WarnungenS", 0, profileFile ) );
    putValue( ePH_VerschmutzungsmeldungS, getProfileInt( "Settings", "ePH_VerschmutzungsmeldungS", 0, profileFile ) );
    putValue( ePH_WAH_MeldungS, getProfileInt( "Settings", "ePH_WAH_MeldungS", 0, profileFile ) );
    putValue( eMMI_StartupAnimationS, getProfileInt( "Settings", "eMMI_StartupAnimationS", 0, profileFile ) );
    putValue( eMVK_01_BZS, getProfileInt( "Settings", "eMVK_01_BZS", 1, profileFile ) );
}

void loadSettings2( char profileFile[] )
{
    putValue( eBFS_MMB_storageS, getProfileInt( "Settings", "eBFS_MMB_storageS", 0, profileFile ) );
    putValue( eBFS_MMB_tippS, getProfileInt( "Settings", "eBFS_MMB_tippS", 0, profileFile ) );
    putValue( eBFS_MMB_tastS, getProfileInt( "Settings", "eBFS_MMB_tastS", 0, profileFile ) );
    putValue( eBFS_MMB_store_LED_onS, getProfileInt( "Settings", "eBFS_MMB_store_LED_onS", 0, profileFile ) );
    putValue( eBFS_MMB_storage_beepS, getProfileInt( "Settings", "eBFS_MMB_storage_beepS", 0, profileFile ) );
    putValue( eBFS_MMB_storeS, getProfileInt( "Settings", "eBFS_MMB_storeS", 0, profileFile ) );
    putValue( eBFS_MMB_glob_stopS, getProfileInt( "Settings", "eBFS_MMB_glob_stopS", 0, profileFile ) );
    putValue( eBFS_SIH_StatusS, getProfileInt( "Settings", "eBFS_SIH_StatusS", 0, profileFile ) );
    putValue( eBFS_SLR_ReglerstatusS, getProfileInt( "Settings", "eBFS_SLR_ReglerstatusS", 0, profileFile ) );
    putValue( eFS_Fond_Bed_enableS, getProfileInt( "Settings", "eFS_Fond_Bed_enableS", 0, profileFile ) );
    putValue( eFS_Lehne_nicht_verriegeltS, getProfileInt( "Settings", "eFS_Lehne_nicht_verriegeltS", 0, profileFile ) );
    putValue( eFS_Spezialposition_anfahrenS, getProfileInt( "Settings", "eFS_Spezialposition_anfahrenS", 0, profileFile ) );
    putValue( eFS_BFS_Sitzsym_AnfahrtS, getProfileInt( "Settings", "eFS_BFS_Sitzsym_AnfahrtS", 0, profileFile ) );
    putValue( eFS_Sitzfahrt_aktivS, getProfileInt( "Settings", "eFS_Sitzfahrt_aktivS", 0, profileFile ) );
    putValue( eFS_SLV_aktivS, getProfileInt( "Settings", "eFS_SLV_aktivS", 0, profileFile ) );
    putValue( eFS_SHV_aktivS, getProfileInt( "Settings", "eFS_SHV_aktivS", 0, profileFile ) );
    putValue( eFS_LNV_aktivS, getProfileInt( "Settings", "eFS_LNV_aktivS", 0, profileFile ) );
    putValue( eFS_SNV_aktivS, getProfileInt( "Settings", "eFS_SNV_aktivS", 0, profileFile ) );
    putValue( eFS_KSV_aktivS, getProfileInt( "Settings", "eFS_KSV_aktivS", 0, profileFile ) );
    putValue( eFS_LKV_aktivS, getProfileInt( "Settings", "eFS_LKV_aktivS", 0, profileFile ) );
    putValue( eFS_STV_aktivS, getProfileInt( "Settings", "eFS_STV_aktivS", 0, profileFile ) );
    putValue( eFS_LHV_aktivS, getProfileInt( "Settings", "eFS_LHV_aktivS", 0, profileFile ) );
    putValue( eFS_LWV_aktivS, getProfileInt( "Settings", "eFS_LWV_aktivS", 0, profileFile ) );
    putValue( eFS_GHV_aktivS, getProfileInt( "Settings", "eFS_GHV_aktivS", 0, profileFile ) );
    putValue( eFS_BFS_KSS_AnfahrtS, getProfileInt( "Settings", "eFS_BFS_KSS_AnfahrtS", 0, profileFile ) );
    putValue( eFS_MMB_lokal_StopS, getProfileInt( "Settings", "eFS_MMB_lokal_StopS", 0, profileFile ) );
    putValue( eFS_MMB_storageS, getProfileInt( "Settings", "eFS_MMB_storageS", 0, profileFile ) );
    putValue( eFS_MMB_tippS, getProfileInt( "Settings", "eFS_MMB_tippS", 0, profileFile ) );
    putValue( eFS_MMB_tastS, getProfileInt( "Settings", "eFS_MMB_tastS", 0, profileFile ) );
    putValue( eFS_MMB_store_LED_onS, getProfileInt( "Settings", "eFS_MMB_store_LED_onS", 0, profileFile ) );
    putValue( eFS_MMB_storage_beepS, getProfileInt( "Settings", "eFS_MMB_storage_beepS", 0, profileFile ) );
    putValue( eFS_MMB_storeS, getProfileInt( "Settings", "eFS_MMB_storeS", 0, profileFile ) );
    putValue( eFS_MMB_glob_stopS, getProfileInt( "Settings", "eFS_MMB_glob_stopS", 0, profileFile ) );
    putValue( eFS_EE_Fond_FS_enableS, getProfileInt( "Settings", "eFS_EE_Fond_FS_enableS", 0, profileFile ) );
    putValue( eFS_EE_Fond_BFS_enableS, getProfileInt( "Settings", "eFS_EE_Fond_BFS_enableS", 0, profileFile ) );
    putValue( eFS_BFS_Fond_Verst_enableS, getProfileInt( "Settings", "eFS_BFS_Fond_Verst_enableS", 0, profileFile ) );
    putValue( eFS_EE_BFS_enableS, getProfileInt( "Settings", "eFS_EE_BFS_enableS", 0, profileFile ) );
    putValue( eFS_SIH_StatusS, getProfileInt( "Settings", "eFS_SIH_StatusS", 0, profileFile ) );
    putValue( eFS_SLR_ReglerstatusS, getProfileInt( "Settings", "eFS_SLR_ReglerstatusS", 0, profileFile ) );
    putValue( eMFG_01_BZS, getProfileInt( "Settings", "eMFG_01_BZS", 0, profileFile ) );
    putValue( eMF_MotorweiterlaufS, getProfileInt( "Settings", "eMF_MotorweiterlaufS", 0, profileFile ) );
    putValue( eMF_AbzugssperreS, getProfileInt( "Settings", "eMF_AbzugssperreS", 0, profileFile ) );
    putValue( eMF_AnlassersperreS, getProfileInt( "Settings", "eMF_AnlassersperreS", 0, profileFile ) );
    putValue( eMF_VarianteS, getProfileInt( "Settings", "eMF_VarianteS", 0, profileFile ) );
    putValue( eMF_Schluessel_scanS, getProfileInt( "Settings", "eMF_Schluessel_scanS", 0, profileFile ) );
    putValue( eMF_StartStopp_InfoS, getProfileInt( "Settings", "eMF_StartStopp_InfoS", 0, profileFile ) );
    putValue( eMF_Fernbed_einS, getProfileInt( "Settings", "eMF_Fernbed_einS", 0, profileFile ) );
    putValue( eMF_StandlichtS, getProfileInt( "Settings", "eMF_StandlichtS", 0, profileFile ) );
    putValue( eMF_FahrlichtS, getProfileInt( "Settings", "eMF_FahrlichtS", 0, profileFile ) );
    putValue( eMF_interm_FernlichtS, getProfileInt( "Settings", "eMF_interm_FernlichtS", 0, profileFile ) );
    putValue( eMF_WarnblinkerS, getProfileInt( "Settings", "eMF_WarnblinkerS", 0, profileFile ) );
    putValue( eMF_FussraumbelS, getProfileInt( "Settings", "eMF_FussraumbelS", 0, profileFile ) );
    putValue( eMF_InnenraumbelS, getProfileInt( "Settings", "eMF_InnenraumbelS", 0, profileFile ) );
    putValue( eMF_Innenraumbel_UnterdrueckS, getProfileInt( "Settings", "eMF_Innenraumbel_UnterdrueckS", 0, profileFile ) );
    putValue( eMF_Blk_liS, getProfileInt( "Settings", "eMF_Blk_liS", 0, profileFile ) );
    putValue( eMF_Blk_reS, getProfileInt( "Settings", "eMF_Blk_reS", 0, profileFile ) );
    putValue( eMF_LichthupeS, getProfileInt( "Settings", "eMF_LichthupeS", 0, profileFile ) );
    putValue( eMF_FernlichtS, getProfileInt( "Settings", "eMF_FernlichtS", 0, profileFile ) );
    putValue( eMF_TippwischenS, getProfileInt( "Settings", "eMF_TippwischenS", 0, profileFile ) );
    putValue( eMF_FrontintervallS, getProfileInt( "Settings", "eMF_FrontintervallS", 0, profileFile ) );
    putValue( eMF_Wischerstufe_1S, getProfileInt( "Settings", "eMF_Wischerstufe_1S", 0, profileFile ) );
    putValue( eMF_Wischerstufe_2S, getProfileInt( "Settings", "eMF_Wischerstufe_2S", 0, profileFile ) );
    putValue( eMF_FrontwaschenS, getProfileInt( "Settings", "eMF_FrontwaschenS", 0, profileFile ) );
    putValue( eMF_HeckintervallS, getProfileInt( "Settings", "eMF_HeckintervallS", 0, profileFile ) );
    putValue( eMF_HeckwaschenS, getProfileInt( "Settings", "eMF_HeckwaschenS", 0, profileFile ) );
    putValue( eMF_SummerS, getProfileInt( "Settings", "eMF_SummerS", 0, profileFile ) );
    putValue( eMF_Alarm_BlinkertaktS, getProfileInt( "Settings", "eMF_Alarm_BlinkertaktS", 0, profileFile ) );
    putValue( eMF_Alarm_BlinkerS, getProfileInt( "Settings", "eMF_Alarm_BlinkerS", 0, profileFile ) );
    putValue( eMF_TFL_AbschaltungS, getProfileInt( "Settings", "eMF_TFL_AbschaltungS", 0, profileFile ) );
    putValue( eMF_interm_TaktS, getProfileInt( "Settings", "eMF_interm_TaktS", 0, profileFile ) );
    putValue( eMF_Tuerentriegelung_hintenS, getProfileInt( "Settings", "eMF_Tuerentriegelung_hintenS", 0, profileFile ) );
    putValue( eMF_interm_FahrlichtS, getProfileInt( "Settings", "eMF_interm_FahrlichtS", 0, profileFile ) );
    putValue( eMF_SignalhornS, getProfileInt( "Settings", "eMF_SignalhornS", 0, profileFile ) );
    putValue( eMF_FH_FT_hochS, getProfileInt( "Settings", "eMF_FH_FT_hochS", 0, profileFile ) );
    putValue( eMF_FH_FT_tiefS, getProfileInt( "Settings", "eMF_FH_FT_tiefS", 0, profileFile ) );
    putValue( eMF_FH_BT_hochS, getProfileInt( "Settings", "eMF_FH_BT_hochS", 0, profileFile ) );
    putValue( eMF_FH_BT_tiefS, getProfileInt( "Settings", "eMF_FH_BT_tiefS", 0, profileFile ) );
    putValue( eLS_Helligkeit_IRS, getProfileFloat( "Settings", "eLS_Helligkeit_IRS", 101600, profileFile ) );
    putValue( eLS_Helligkeit_FWS, getProfileFloat( "Settings", "eLS_Helligkeit_FWS", 6132, profileFile ) );
    putValue( eLS_defektS, getProfileInt( "Settings", "eLS_defektS", 0, profileFile ) );
    putValue( eLS_VerbauS, getProfileInt( "Settings", "eLS_VerbauS", 0, profileFile ) );
    putValue( eRS_RegenmengeS, getProfileFloat( "Settings", "eRS_RegenmengeS", 140, profileFile ) );
    putValue( eRS_VerbauS, getProfileInt( "Settings", "eRS_VerbauS", 0, profileFile ) );
    putValue( eRS_Verglasung_schliessenS, getProfileInt( "Settings", "eRS_Verglasung_schliessenS", 0, profileFile ) );
    putValue( eRS_defektS, getProfileInt( "Settings", "eRS_defektS", 0, profileFile ) );
    putValue( eRS_WischergeschwindigkeitS, getProfileInt( "Settings", "eRS_WischergeschwindigkeitS", 0, profileFile ) );
    putValue( eBH_Blinker_liS, getProfileInt( "Settings", "eBH_Blinker_liS", 0, profileFile ) );
    putValue( eBH_Blinker_reS, getProfileInt( "Settings", "eBH_Blinker_reS", 0, profileFile ) );
    putValue( eBH_LichthupeS, getProfileInt( "Settings", "eBH_LichthupeS", 0, profileFile ) );
    putValue( eBH_FernlichtS, getProfileInt( "Settings", "eBH_FernlichtS", 0, profileFile ) );
    putValue( eWH_TipwischenS, getProfileInt( "Settings", "eWH_TipwischenS", 0, profileFile ) );
    putValue( eWH_IntervallS, getProfileInt( "Settings", "eWH_IntervallS", 0, profileFile ) );
    putValue( eWH_WischerStufe1S, getProfileInt( "Settings", "eWH_WischerStufe1S", 0, profileFile ) );
    putValue( eWH_WischerStufe2S, getProfileInt( "Settings", "eWH_WischerStufe2S", 0, profileFile ) );
    putValue( eWH_FrontwaschenS, getProfileInt( "Settings", "eWH_FrontwaschenS", 0, profileFile ) );
    putValue( eWH_HeckwaschenS, getProfileInt( "Settings", "eWH_HeckwaschenS", 0, profileFile ) );
    putValue( eWH_IntervallstufenS, getProfileInt( "Settings", "eWH_IntervallstufenS", 0, profileFile ) );
    putValue( eFAS_TasterS, getProfileInt( "Settings", "eFAS_TasterS", 0, profileFile ) );
    putValue( eFAS_Taster_FehlerS, getProfileInt( "Settings", "eFAS_Taster_FehlerS", 0, profileFile ) );
    putValue( eSMLS_HupeS, getProfileInt( "Settings", "eSMLS_HupeS", 0, profileFile ) );
    putValue( eLRH_on_offS, getProfileInt( "Settings", "eLRH_on_offS", 0, profileFile ) );
    putValue( eLSS_TastencodeS, getProfileInt( "Settings", "eLSS_TastencodeS", 0, profileFile ) );
    putValue( eSTS_Car_not_under_theftS, getProfileInt( "Settings", "eSTS_Car_not_under_theftS", 1, profileFile ) );
    putValue( eSTS_Car_under_theftS, getProfileInt( "Settings", "eSTS_Car_under_theftS", 0, profileFile ) );
    putValue( eSTS_AnlassersperreS, getProfileInt( "Settings", "eSTS_AnlassersperreS", 0, profileFile ) );
    putValue( eSTS_TypencodierungS, getProfileInt( "Settings", "eSTS_TypencodierungS", 0, profileFile ) );
    putValue( eSTS_LIN_aktivS, getProfileInt( "Settings", "eSTS_LIN_aktivS", 0, profileFile ) );
    putValue( eSTS_StandlichtS, getProfileInt( "Settings", "eSTS_StandlichtS", 0, profileFile ) );
    putValue( eSTS_FahrlichtS, getProfileInt( "Settings", "eSTS_FahrlichtS", 0, profileFile ) );
    putValue( eSTS_Alarm_stillS, getProfileInt( "Settings", "eSTS_Alarm_stillS", 0, profileFile ) );
    putValue( eSTS_TexteS, getProfileInt( "Settings", "eSTS_TexteS", 14, profileFile ) );
    putValue( eSTS_LaderelaisS, getProfileInt( "Settings", "eSTS_LaderelaisS", 0, profileFile ) );
    putValue( eSTS_SummerS, getProfileInt( "Settings", "eSTS_SummerS", 0, profileFile ) );
    putValue( eSTS_Alarm_BlinkerS, getProfileInt( "Settings", "eSTS_Alarm_BlinkerS", 0, profileFile ) );
    putValue( eSTS_NotstartS, getProfileInt( "Settings", "eSTS_NotstartS", 0, profileFile ) );
    putValue( eSTS_SignalhornS, getProfileInt( "Settings", "eSTS_SignalhornS", 0, profileFile ) );
    putValue( eSTS_LeerlaufschaltungS, getProfileInt( "Settings", "eSTS_LeerlaufschaltungS", 0, profileFile ) );
    putValue( eTCO_Driver1_DSS, getProfileInt( "Settings", "eTCO_Driver1_DSS", 0, profileFile ) );
    putValue( eTCO_Driver2_DSS, getProfileInt( "Settings", "eTCO_Driver2_DSS", 0, profileFile ) );
    putValue( eTCO_FahrerkennS, getProfileInt( "Settings", "eTCO_FahrerkennS", 0, profileFile ) );
    putValue( eTCO_Driver1_StS, getProfileInt( "Settings", "eTCO_Driver1_StS", 0, profileFile ) );
    putValue( eTCO_Driver2_StS, getProfileInt( "Settings", "eTCO_Driver2_StS", 0, profileFile ) );
    putValue( eTCO_System_EvS, getProfileInt( "Settings", "eTCO_System_EvS", 0, profileFile ) );
    putValue( eTCO_Handle_InfS, getProfileInt( "Settings", "eTCO_Handle_InfS", 0, profileFile ) );
    putValue( eTCO_Sys_PerfS, getProfileInt( "Settings", "eTCO_Sys_PerfS", 0, profileFile ) );
    putValue( eTCO_Dir_IndS, getProfileInt( "Settings", "eTCO_Dir_IndS", 0, profileFile ) );
    putValue( eTCO_Outp_SpeedS, getProfileFloat( "Settings", "eTCO_Outp_SpeedS", 0, profileFile ) );
    putValue( eTCO_Vehicle_SpeedS, getProfileFloat( "Settings", "eTCO_Vehicle_SpeedS", 0, profileFile ) );
    putValue( eTD_SekundenS, getProfileFloat( "Settings", "eTD_SekundenS", 0, profileFile ) );
    putValue( eTD_MinutenS, getProfileInt( "Settings", "eTD_MinutenS", 0, profileFile ) );
    putValue( eTD_StundenS, getProfileInt( "Settings", "eTD_StundenS", 0, profileFile ) );
    putValue( eTD_MonatS, getProfileInt( "Settings", "eTD_MonatS", 0, profileFile ) );
    putValue( eTD_TagS, getProfileFloat( "Settings", "eTD_TagS", 0, profileFile ) );
    putValue( eTD_JahrS, getProfileInt( "Settings", "eTD_JahrS", 1985, profileFile ) );
    putValue( eTD_Lok_Minute_offsS, getProfileInt( "Settings", "eTD_Lok_Minute_offsS", -125, profileFile ) );
    putValue( eTD_Lok_Hour_offsS, getProfileInt( "Settings", "eTD_Lok_Hour_offsS", -125, profileFile ) );
    putValue( eVDI_V_distS, getProfileFloat( "Settings", "eVDI_V_distS", 0, profileFile ) );
    putValue( eVDI_T_distS, getProfileFloat( "Settings", "eVDI_T_distS", 0, profileFile ) );
    putValue( eWischer_vorne_aktivS, getProfileInt( "Settings", "eWischer_vorne_aktivS", 0, profileFile ) );
    putValue( eWaschen_vorne_aktivS, getProfileInt( "Settings", "eWaschen_vorne_aktivS", 0, profileFile ) );
    putValue( eWischer_vorne_NormalS, getProfileInt( "Settings", "eWischer_vorne_NormalS", 0, profileFile ) );
    putValue( eWischer_vorne_SchnellS, getProfileInt( "Settings", "eWischer_vorne_SchnellS", 0, profileFile ) );
    putValue( eWischer_vorne_ParklageS, getProfileInt( "Settings", "eWischer_vorne_ParklageS", 0, profileFile ) );
    putValue( eWischer_vorne_defektS, getProfileInt( "Settings", "eWischer_vorne_defektS", 0, profileFile ) );
    putValue( eWischer_vorne_blockiertS, getProfileInt( "Settings", "eWischer_vorne_blockiertS", 0, profileFile ) );
    putValue( eBCM_FH_FreigabeS, getProfileInt( "Settings", "eBCM_FH_FreigabeS", 0, profileFile ) );
    putValue( eBCM_Komfortfkt_FreigabeS, getProfileInt( "Settings", "eBCM_Komfortfkt_FreigabeS", 0, profileFile ) );
    putValue( eBCM_HSK_FreigabeS, getProfileInt( "Settings", "eBCM_HSK_FreigabeS", 0, profileFile ) );
    putValue( eBCM_Verdeck_FreigabeS, getProfileInt( "Settings", "eBCM_Verdeck_FreigabeS", 0, profileFile ) );
    putValue( eZV_verriegelt_intern_istS, getProfileInt( "Settings", "eZV_verriegelt_intern_istS", 0, profileFile ) );
    putValue( eZV_verriegelt_extern_istS, getProfileInt( "Settings", "eZV_verriegelt_extern_istS", 0, profileFile ) );
    putValue( eZV_verriegelt_intern_sollS, getProfileInt( "Settings", "eZV_verriegelt_intern_sollS", 0, profileFile ) );
    putValue( eZV_verriegelt_extern_sollS, getProfileInt( "Settings", "eZV_verriegelt_extern_sollS", 0, profileFile ) );
    putValue( eZV_gesafet_extern_istS, getProfileInt( "Settings", "eZV_gesafet_extern_istS", 0, profileFile ) );
    putValue( eZV_gesafet_extern_sollS, getProfileInt( "Settings", "eZV_gesafet_extern_sollS", 0, profileFile ) );
    putValue( eZV_EinzeltuerentriegelungS, getProfileInt( "Settings", "eZV_EinzeltuerentriegelungS", 0, profileFile ) );
    putValue( eZV_HeckeinzelentriegelungS, getProfileInt( "Settings", "eZV_HeckeinzelentriegelungS", 0, profileFile ) );
    putValue( eZV_FT_offenS, getProfileInt( "Settings", "eZV_FT_offenS", 0, profileFile ) );
    putValue( eZV_BT_offenS, getProfileInt( "Settings", "eZV_BT_offenS", 0, profileFile ) );
    putValue( eZV_HFS_offenS, getProfileInt( "Settings", "eZV_HFS_offenS", 0, profileFile ) );
    putValue( eZV_HBFS_offenS, getProfileInt( "Settings", "eZV_HBFS_offenS", 0, profileFile ) );
    putValue( eZV_HD_offenS, getProfileInt( "Settings", "eZV_HD_offenS", 0, profileFile ) );
    putValue( eZV_HS_offenS, getProfileInt( "Settings", "eZV_HS_offenS", 0, profileFile ) );
    putValue( eIRUE_aktivS, getProfileInt( "Settings", "eIRUE_aktivS", 0, profileFile ) );
    putValue( eDWA_aktivS, getProfileInt( "Settings", "eDWA_aktivS", 0, profileFile ) );
    putValue( eHD_HauptrasteS, getProfileInt( "Settings", "eHD_HauptrasteS", 0, profileFile ) );
    putValue( eHD_VorrasteS, getProfileInt( "Settings", "eHD_VorrasteS", 0, profileFile ) );
    putValue( eFFB_HDF_TasteS, getProfileInt( "Settings", "eFFB_HDF_TasteS", 0, profileFile ) );
    putValue( eFFB_Panik_TasteS, getProfileInt( "Settings", "eFFB_Panik_TasteS", 0, profileFile ) );
    putValue( eFFB_Auf_TasteS, getProfileInt( "Settings", "eFFB_Auf_TasteS", 0, profileFile ) );
    putValue( eFFB_Zu_TasteS, getProfileInt( "Settings", "eFFB_Zu_TasteS", 0, profileFile ) );
    putValue( eFFB_CarFinderS, getProfileInt( "Settings", "eFFB_CarFinderS", 0, profileFile ) );
    putValue( eFFB_KomfortoeffnenS, getProfileInt( "Settings", "eFFB_KomfortoeffnenS", 0, profileFile ) );
    putValue( eFFB_KomfortschliessenS, getProfileInt( "Settings", "eFFB_KomfortschliessenS", 0, profileFile ) );
    putValue( eFBS_IDG_in_ReichweiteS, getProfileInt( "Settings", "eFBS_IDG_in_ReichweiteS", 0, profileFile ) );
    putValue( eZV_SafeFunktion_aktivS, getProfileInt( "Settings", "eZV_SafeFunktion_aktivS", 0, profileFile ) );
    putValue( eFBS_Warn_Schluessel_BattS, getProfileInt( "Settings", "eFBS_Warn_Schluessel_BattS", 0, profileFile ) );
    putValue( eFT_Kisi_FehlerS, getProfileInt( "Settings", "eFT_Kisi_FehlerS", 0, profileFile ) );
    putValue( eSpeedRPMCorrelation, getProfileInt( "Settings", "eSpeedRPMCorrelation", 0, profileFile ) );
    putValue( eSendAnhaenger_01, getProfileInt( "Settings", "eSendAnhaenger_01", 1, profileFile ) );
    putValue( eTAnhaenger_01, getProfileInt( "Settings", "eTAnhaenger_01", 100, profileFile ) );
    putValue( eTOTAnhaenger_01, getProfileInt( "Settings", "eTOTAnhaenger_01", 1000, profileFile ) );
    putValue( eDlcAnhaenger_01, getProfileInt( "Settings", "eDlcAnhaenger_01", 8, profileFile ) );
    putValue( eBZStepAnhaenger_01, getProfileInt( "Settings", "eBZStepAnhaenger_01", 1, profileFile ) );
    putValue( eSendBCM_01, getProfileInt( "Settings", "eSendBCM_01", 1, profileFile ) );
    putValue( eTBCM_01, getProfileInt( "Settings", "eTBCM_01", 1000, profileFile ) );
    putValue( eTOTBCM_01, getProfileInt( "Settings", "eTOTBCM_01", 5000, profileFile ) );
    putValue( eDlcBCM_01, getProfileInt( "Settings", "eDlcBCM_01", 8, profileFile ) );
    putValue( eSendBlinkmodi_02, getProfileInt( "Settings", "eSendBlinkmodi_02", 1, profileFile ) );
    putValue( eTBlinkmodi_02, getProfileInt( "Settings", "eTBlinkmodi_02", 1000, profileFile ) );
    putValue( eTOTBlinkmodi_02, getProfileInt( "Settings", "eTOTBlinkmodi_02", 5000, profileFile ) );
    putValue( eDlcBlinkmodi_02, getProfileInt( "Settings", "eDlcBlinkmodi_02", 8, profileFile ) );
    putValue( eSendDimmung_01, getProfileInt( "Settings", "eSendDimmung_01", 1, profileFile ) );
    putValue( eTDimmung_01, getProfileInt( "Settings", "eTDimmung_01", 200, profileFile ) );
    putValue( eTOTDimmung_01, getProfileInt( "Settings", "eTOTDimmung_01", 2000, profileFile ) );
    putValue( eDlcDimmung_01, getProfileInt( "Settings", "eDlcDimmung_01", 8, profileFile ) );
    putValue( eSendELV_01, getProfileInt( "Settings", "eSendELV_01", 1, profileFile ) );
    putValue( eTELV_01, getProfileInt( "Settings", "eTELV_01", 1000, profileFile ) );
    putValue( eTOTELV_01, getProfileInt( "Settings", "eTOTELV_01", 5000, profileFile ) );
    putValue( eDlcELV_01, getProfileInt( "Settings", "eDlcELV_01", 8, profileFile ) );
    putValue( eSendKessy_04, getProfileInt( "Settings", "eSendKessy_04", 1, profileFile ) );
    putValue( eTKessy_04, getProfileInt( "Settings", "eTKessy_04", 200, profileFile ) );
    putValue( eTOTKessy_04, getProfileInt( "Settings", "eTOTKessy_04", 2000, profileFile ) );
    putValue( eDlcKessy_04, getProfileInt( "Settings", "eDlcKessy_04", 8, profileFile ) );
    putValue( eSendKlemmen_Status_01, getProfileInt( "Settings", "eSendKlemmen_Status_01", 1, profileFile ) );
    putValue( eTKlemmen_Status_01, getProfileInt( "Settings", "eTKlemmen_Status_01", 100, profileFile ) );
    putValue( eTOTKlemmen_Status_01, getProfileInt( "Settings", "eTOTKlemmen_Status_01", 1000, profileFile ) );
    putValue( eDlcKlemmen_Status_01, getProfileInt( "Settings", "eDlcKlemmen_Status_01", 4, profileFile ) );
    putValue( eCrcKlemmen_Status_01, getProfileInt( "Settings", "eCrcKlemmen_Status_01", 1, profileFile ) );
    putValue( eBZKlemmen_Status_01, getProfileInt( "Settings", "eBZKlemmen_Status_01", 1, profileFile ) );
    putValue( eBZStepKlemmen_Status_01, getProfileInt( "Settings", "eBZStepKlemmen_Status_01", 1, profileFile ) );
    putValue( eSendKlima_Sensor_02, getProfileInt( "Settings", "eSendKlima_Sensor_02", 1, profileFile ) );
    putValue( eTKlima_Sensor_02, getProfileInt( "Settings", "eTKlima_Sensor_02", 200, profileFile ) );
    putValue( eTOTKlima_Sensor_02, getProfileInt( "Settings", "eTOTKlima_Sensor_02", 2000, profileFile ) );
    putValue( eDlcKlima_Sensor_02, getProfileInt( "Settings", "eDlcKlima_Sensor_02", 8, profileFile ) );
    putValue( eSendLicht_Anf_01, getProfileInt( "Settings", "eSendLicht_Anf_01", 1, profileFile ) );
    putValue( eTLicht_Anf_01, getProfileInt( "Settings", "eTLicht_Anf_01", 100, profileFile ) );
    putValue( eTOTLicht_Anf_01, getProfileInt( "Settings", "eTOTLicht_Anf_01", 1000, profileFile ) );
    putValue( eDlcLicht_Anf_01, getProfileInt( "Settings", "eDlcLicht_Anf_01", 8, profileFile ) );
    putValue( eSendLicht_hinten_01, getProfileInt( "Settings", "eSendLicht_hinten_01", 1, profileFile ) );
    putValue( eTLicht_hinten_01, getProfileInt( "Settings", "eTLicht_hinten_01", 100, profileFile ) );
    putValue( eTOTLicht_hinten_01, getProfileInt( "Settings", "eTOTLicht_hinten_01", 1000, profileFile ) );
    putValue( eDlcLicht_hinten_01, getProfileInt( "Settings", "eDlcLicht_hinten_01", 8, profileFile ) );
    putValue( eBZLicht_hinten_01, getProfileInt( "Settings", "eBZLicht_hinten_01", 1, profileFile ) );
    putValue( eBZStepLicht_hinten_01, getProfileInt( "Settings", "eBZStepLicht_hinten_01", 1, profileFile ) );

    putValue( eSendLicht_vorne_01, getProfileInt( "Settings", "eSendLicht_vorne_01", 1, profileFile ) );
    putValue( eTLicht_vorne_01, getProfileInt( "Settings", "eTLicht_vorne_01", 1000, profileFile ) );
    putValue( eTOTLicht_vorne_01, getProfileInt( "Settings", "eTOTLicht_vorne_01", 5000, profileFile ) );
    putValue( eDlcLicht_vorne_01, getProfileInt( "Settings", "eDlcLicht_vorne_01", 8, profileFile ) );

    putValue( eSendLog_Datenlogger_Req, getProfileInt( "Settings", "eSendLog_Datenlogger_Req", 0, profileFile ) );
    putValue( eTLog_Datenlogger_Req, getProfileInt( "Settings", "eTLog_Datenlogger_Req", 0, profileFile ) );
    putValue( eTOTLog_Datenlogger_Req, getProfileInt( "Settings", "eTOTLog_Datenlogger_Req", 500, profileFile ) );
    putValue( eDlcLog_Datenlogger_Req, getProfileInt( "Settings", "eDlcLog_Datenlogger_Req", 8, profileFile ) );

    putValue( eSendLog_Kombi_Req, getProfileInt( "Settings", "eSendLog_Kombi_Req", 0, profileFile ) );
    putValue( eTLog_Kombi_Req, getProfileInt( "Settings", "eTLog_Kombi_Req", 0, profileFile ) );
    putValue( eTOTLog_Kombi_Req, getProfileInt( "Settings", "eTOTLog_Kombi_Req", 500, profileFile ) );

    putValue( eSendBAP_BC_ASG_02, getProfileInt( "Settings", "eSendBAP_BC_ASG_02", 0, profileFile ) );
    putValue( eTBAP_BC_ASG_02, getProfileInt( "Settings", "eTBAP_BC_ASG_02",0, profileFile ) );
    putValue( eTOTBAP_BC_ASG_02, getProfileInt( "Settings", "eTOTBAP_BC_ASG_02", 500, profileFile ) );
    putValue( eDlcBAP_BC_ASG_02, getProfileInt( "Settings", "eDlcBAP_BC_ASG_02", 8, profileFile ) );

    putValue( eSendKlemmen_Steuerung_01, getProfileInt( "Settings", "eSendKlemmen_Steuerung_01", 1, profileFile ) );
    putValue( eTKlemmen_Steuerung_01, getProfileInt( "Settings", "eTKlemmen_Steuerung_01",1000, profileFile ) );
    putValue( eTOTKlemmen_Steuerung_01, getProfileInt( "Settings", "eTOTKlemmen_Steuerung_01", 5000, profileFile ) );
    putValue( eDlcKlemmen_Steuerung_01, getProfileInt( "Settings", "eDlcKlemmen_Steuerung_01", 8, profileFile ) );
}

void loadSettings2G( char profileFile[] )
{
    putValue( eLWR_Reisemodus_TexteS, getProfileInt( "Settings", "eLWR_Reisemodus_TexteS", 0, profileFile ) );
    putValue( eLWR_Pos_SchrittmotorS, getProfileFloat( "Settings", "eLWR_Pos_SchrittmotorS", 101.6, profileFile ) );
    putValue( eLWR_Hoehenwert_VLS, getProfileInt( "Settings", "eLWR_Hoehenwert_VLS", 127, profileFile ) );
    putValue( eLWR_Hoehenwert_HLS, getProfileInt( "Settings", "eLWR_Hoehenwert_HLS", 127, profileFile ) );
    putValue( eAFS_Ersatzlicht_LinksS, getProfileInt( "Settings", "eAFS_Ersatzlicht_LinksS", 0, profileFile ) );
    putValue( eAFS_Ersatzlicht_RechtsS, getProfileInt( "Settings", "eAFS_Ersatzlicht_RechtsS", 0, profileFile ) );
    putValue( eLWR_AFS_GrundeinstellungS, getProfileInt( "Settings", "eLWR_AFS_GrundeinstellungS", 0, profileFile ) );
    putValue( eLWR_AFS_ParametrisierungS, getProfileInt( "Settings", "eLWR_AFS_ParametrisierungS", 0, profileFile ) );
    putValue( eLWR_InitialisierungslaufS, getProfileInt( "Settings", "eLWR_InitialisierungslaufS", 0, profileFile ) );
    putValue( eLWR_SicherheitspositionS, getProfileInt( "Settings", "eLWR_SicherheitspositionS", 0, profileFile ) );
    putValue( eLWR_ModusS, getProfileInt( "Settings", "eLWR_ModusS", 0, profileFile ) );
    putValue( eLWR_KD_FehlerS, getProfileInt( "Settings", "eLWR_KD_FehlerS", 0, profileFile ) );
    putValue( eMFL_Tastencode_1S, getProfileInt( "Settings", "eMFL_Tastencode_1S", 0, profileFile ) );
    putValue( eMFL_Tastencode_2S, getProfileInt( "Settings", "eMFL_Tastencode_2S", 0, profileFile ) );
    putValue( eMFL_Eventcode_1S, getProfileInt( "Settings", "eMFL_Eventcode_1S", 0, profileFile ) );
    putValue( eMFL_Eventcode_2S, getProfileInt( "Settings", "eMFL_Eventcode_2S", 0, profileFile ) );
    putValue( eMFL_MarkeS, getProfileInt( "Settings", "eMFL_MarkeS", 0, profileFile ) );
    putValue( eMFL_VarianteS, getProfileInt( "Settings", "eMFL_VarianteS", 0, profileFile ) );
    putValue( eMO_IstgangS, getProfileInt( "Settings", "eMO_IstgangS", 0, profileFile ) );
    putValue( eMO_SollgangS, getProfileInt( "Settings", "eMO_SollgangS", 0, profileFile ) );
    putValue( eMO_OeldruckS, getProfileFloat( "Settings", "eMO_OeldruckS", 10.16, profileFile ) );
    putValue( eMO_AnzeigedrehzS, getProfileFloat( "Settings", "eMO_AnzeigedrehzS", 0, profileFile ) );
    putValue( eMO_Schaltempf_verfbarS, getProfileInt( "Settings", "eMO_Schaltempf_verfbarS", 0, profileFile ) );
    putValue( eMO_LadedruckS, getProfileFloat( "Settings", "eMO_LadedruckS", 0, profileFile ) );
    putValue( eMO_KVSS, getProfileInt( "Settings", "eMO_KVSS", 0, profileFile ) );
    putValue( eMO_KVS_UeberlaufS, getProfileInt( "Settings", "eMO_KVS_UeberlaufS", 0, profileFile ) );
    putValue( eMO_QBit_Ansaugluft_TempS, getProfileInt( "Settings", "eMO_QBit_Ansaugluft_TempS", 1, profileFile ) );
    putValue( eMO_QBit_Oel_TempS, getProfileInt( "Settings", "eMO_QBit_Oel_TempS", 1, profileFile ) );
    putValue( eMO_QBit_Kuehlmittel_TempS, getProfileInt( "Settings", "eMO_QBit_Kuehlmittel_TempS", 1, profileFile ) );
    putValue( eMO_Stellgliedtest_Soundaktuator, getProfileInt( "Settings", "eMO_Stellgliedtest_Soundaktuator", 0, profileFile ) );
    putValue( eMO_HYB_Fehler_HV_NetzS, getProfileInt( "Settings", "eMO_HYB_Fehler_HV_NetzS", 0, profileFile ) );
    putValue( eMO_aktives_GetriebeheizenS, getProfileInt( "Settings", "eMO_aktives_GetriebeheizenS", 0, profileFile ) );
    putValue( eMO_Absperrventil_oeffnenS, getProfileInt( "Settings", "eMO_Absperrventil_oeffnenS", 0, profileFile ) );
    putValue( eMO_Ansaugluft_TempS, getProfileFloat( "Settings", "eMO_Ansaugluft_TempS", 142.5, profileFile ) );
    putValue( eMO_Oel_TempS, getProfileInt( "Settings", "eMO_Oel_TempS", 194, profileFile ) );
    putValue( eMO_Kuehlmittel_TempS, getProfileFloat( "Settings", "eMO_Kuehlmittel_TempS", 142.5, profileFile ) );
    putValue( eMO_HoeheninfoS, getProfileFloat( "Settings", "eMO_HoeheninfoS", 0, profileFile ) );
    putValue( eMO_KennfeldkS, getProfileInt( "Settings", "eMO_KennfeldkS", 0, profileFile ) );
    putValue( eMO_VersionsinfoS, getProfileInt( "Settings", "eMO_VersionsinfoS", 0, profileFile ) );
    putValue( eMO_Getriebe_kuehlenS, getProfileInt( "Settings", "eMO_Getriebe_kuehlenS", 0, profileFile ) );
    putValue( eMO_Mom_Traegheit_02S, getProfileFloat( "Settings", "eMO_Mom_Traegheit_02S", 0, profileFile ) );
    putValue( eMO_HeizungspumpenansteuerungS, getProfileFloat( "Settings", "eMO_HeizungspumpenansteuerungS", 140, profileFile ) );
    putValue( eMO_SpannungsAnfS, getProfileInt( "Settings", "eMO_SpannungsAnfS", 0, profileFile ) );
    putValue( eMO_Nachlaufzeit_HeizungspumpeS, getProfileFloat( "Settings", "eMO_Nachlaufzeit_HeizungspumpeS", 0, profileFile ) );
    putValue( eMO_ITM_Kuehlmittel_TempS, getProfileFloat( "Settings", "eMO_ITM_Kuehlmittel_TempS", -47.25, profileFile ) );
    putValue( eMO_E85_SensorS, getProfileFloat( "Settings", "eMO_E85_SensorS", 140, profileFile ) );
    putValue( eSCR_Anz_MotorstartsS, getProfileInt( "Settings", "eSCR_Anz_MotorstartsS", 15, profileFile ) );
    putValue( eSCR_Warnstufe_1S, getProfileInt( "Settings", "eSCR_Warnstufe_1S", 0, profileFile ) );
    putValue( eSCR_Warnstufe_2S, getProfileInt( "Settings", "eSCR_Warnstufe_2S", 0, profileFile ) );
    putValue( eSCR_AkustikS, getProfileInt( "Settings", "eSCR_AkustikS", 0, profileFile ) );
    putValue( eMO_Kraftstofffilter_WasserS, getProfileInt( "Settings", "eMO_Kraftstofffilter_WasserS", 0, profileFile ) );
    putValue( eSCR_SystemfehlerS, getProfileInt( "Settings", "eSCR_SystemfehlerS", 0, profileFile ) );
    putValue( eSCR_Inducement_StrategieS, getProfileInt( "Settings", "eSCR_Inducement_StrategieS", 0, profileFile ) );
    putValue( eMO_CO2_FaktorS, getProfileInt( "Settings", "eMO_CO2_FaktorS", 0, profileFile ) );
    putValue( eMO_MKB_MUXS, getProfileInt( "Settings", "eMO_MKB_MUXS", 0, profileFile ) );
    putValue( eMO_MKB_01S, getProfileInt( "Settings", "eMO_MKB_01S", 0, profileFile ) );
    putValue( eMO_MKB_02S, getProfileInt( "Settings", "eMO_MKB_02S", 0, profileFile ) );
    putValue( eMO_MKB_03S, getProfileInt( "Settings", "eMO_MKB_03S", 0, profileFile ) );
    putValue( eMO_MKB_04S, getProfileInt( "Settings", "eMO_MKB_04S", 0, profileFile ) );
    putValue( eMO_StartStopp_StatusS, getProfileInt( "Settings", "eMO_StartStopp_StatusS", 0, profileFile ) );
    putValue( eMO_Freig_RekuS, getProfileInt( "Settings", "eMO_Freig_RekuS", 0, profileFile ) );
    putValue( eMO_Kl_75S, getProfileInt( "Settings", "eMO_Kl_75S", 0, profileFile ) );
    putValue( eMO_Kl_50S, getProfileInt( "Settings", "eMO_Kl_50S", 0, profileFile ) );
    putValue( eMO_GangpositionS, getProfileInt( "Settings", "eMO_GangpositionS", 14, profileFile ) );
    putValue( eMO_StartStopp_FahrerwunschS, getProfileInt( "Settings", "eMO_StartStopp_FahrerwunschS", 0, profileFile ) );
    putValue( eMO_HYB_FahrbereitschaftS, getProfileInt( "Settings", "eMO_HYB_FahrbereitschaftS", 0, profileFile ) );
    putValue( eMO_Ext_E_Fahrt_aktivS, getProfileInt( "Settings", "eMO_Ext_E_Fahrt_aktivS", 0, profileFile ) );
    putValue( eMO_Fahrer_bremstS, getProfileInt( "Settings", "eMO_Fahrer_bremstS", 0, profileFile ) );
    putValue( eMO_QBit_Fahrer_bremstS, getProfileInt( "Settings", "eMO_QBit_Fahrer_bremstS", 1, profileFile ) );
    putValue( eMO_BLSS, getProfileInt( "Settings", "eMO_BLSS", 0, profileFile ) );
    putValue( eMO_Konsistenz_BremspedS, getProfileInt( "Settings", "eMO_Konsistenz_BremspedS", 0, profileFile ) );
    putValue( eMO_Timeout_ESPS, getProfileInt( "Settings", "eMO_Timeout_ESPS", 0, profileFile ) );
    putValue( eMO_Klima_EingrS, getProfileInt( "Settings", "eMO_Klima_EingrS", 0, profileFile ) );
    putValue( eMO_Aussp_AnlassS, getProfileInt( "Settings", "eMO_Aussp_AnlassS", 0, profileFile ) );
    putValue( eMO_Freig_AnlassS, getProfileInt( "Settings", "eMO_Freig_AnlassS", 0, profileFile ) );
    putValue( eMO_Kuppl_schalterS, getProfileInt( "Settings", "eMO_Kuppl_schalterS", 0, profileFile ) );
    putValue( eMO_InterlockS, getProfileInt( "Settings", "eMO_InterlockS", 0, profileFile ) );
    putValue( eMO_Motor_laeuftS, getProfileInt( "Settings", "eMO_Motor_laeuftS", 0, profileFile ) );
    putValue( eMO_KickdownS, getProfileInt( "Settings", "eMO_KickdownS", 0, profileFile ) );
    putValue( eMO_Status_Zylabschalt_01S, getProfileInt( "Settings", "eMO_Status_Zylabschalt_01S", 0, profileFile ) );
    putValue( eMO_EKlKomLeiRedS, getProfileInt( "Settings", "eMO_EKlKomLeiRedS", 0, profileFile ) );
    putValue( eMO_Handshake_STHS, getProfileInt( "Settings", "eMO_Handshake_STHS", 0, profileFile ) );
    putValue( eMO_BKV_UnterdruckwarnungS, getProfileInt( "Settings", "eMO_BKV_UnterdruckwarnungS", 0, profileFile ) );
    putValue( eMO_Freigabe_SegelnS, getProfileInt( "Settings", "eMO_Freigabe_SegelnS", 0, profileFile ) );
    putValue( eMO_Drehzahl_WarnungS, getProfileInt( "Settings", "eMO_Drehzahl_WarnungS", 0, profileFile ) );
    putValue( eMO_obere_DrehzahlgrenzeS, getProfileFloat( "Settings", "eMO_obere_DrehzahlgrenzeS", 0, profileFile ) );
    putValue( eMotor_Code_01_BZS, getProfileInt( "Settings", "eMotor_Code_01_BZS", 0, profileFile ) );
    putValue( eMO_Faktor_Momente_02S, getProfileInt( "Settings", "eMO_Faktor_Momente_02S", 0, profileFile ) );
    putValue( eMO_HybridfahrzeugS, getProfileInt( "Settings", "eMO_HybridfahrzeugS", 0, profileFile ) );
    putValue( eMO_CodeS, getProfileInt( "Settings", "eMO_CodeS", 0, profileFile ) );
    putValue( eMO_Getriebe_CodeS, getProfileInt( "Settings", "eMO_Getriebe_CodeS", 0, profileFile ) );
    putValue( eMO_StartStopp_CodiertS, getProfileInt( "Settings", "eMO_StartStopp_CodiertS", 0, profileFile ) );
    putValue( eMO_Anzahl_ZylS, getProfileInt( "Settings", "eMO_Anzahl_ZylS", 0, profileFile ) );
    putValue( eMO_KraftstoffartS, getProfileInt( "Settings", "eMO_KraftstoffartS", 0, profileFile ) );
    putValue( eMO_HubraumS, getProfileFloat( "Settings", "eMO_HubraumS", 0, profileFile ) );
    putValue( eMO_AnsaugsystemS, getProfileInt( "Settings", "eMO_AnsaugsystemS", 0, profileFile ) );
    putValue( eMO_LeistungS, getProfileInt( "Settings", "eMO_LeistungS", 0, profileFile ) );
    putValue( eMO_Abgastyp_EOBDS, getProfileInt( "Settings", "eMO_Abgastyp_EOBDS", 0, profileFile ) );
    putValue( eMO_Abgastyp_OBDS, getProfileInt( "Settings", "eMO_Abgastyp_OBDS", 0, profileFile ) );
    putValue( eMO_DPF_verbautS, getProfileInt( "Settings", "eMO_DPF_verbautS", 0, profileFile ) );
    putValue( eTSK_CodierungS, getProfileInt( "Settings", "eTSK_CodierungS", 7, profileFile ) );
    putValue( eMO_EinspritzartS, getProfileInt( "Settings", "eMO_EinspritzartS", 0, profileFile ) );
    putValue( eWFS_MSG1_RNDS, getProfileInt( "Settings", "eWFS_MSG1_RNDS", 0, profileFile ) );
    putValue( eWFS_MSG1_CRCS, getProfileInt( "Settings", "eWFS_MSG1_CRCS", 0, profileFile ) );
    putValue( eWFS_MSG2_RNDS, getProfileInt( "Settings", "eWFS_MSG2_RNDS", 0, profileFile ) );
    putValue( eWFS_MSG2_CRCS, getProfileInt( "Settings", "eWFS_MSG2_CRCS", 0, profileFile ) );
    putValue( eWFS_MSG3_RNDS, getProfileInt( "Settings", "eWFS_MSG3_RNDS", 0, profileFile ) );
    putValue( eWFS_MSG3_CRCS, getProfileInt( "Settings", "eWFS_MSG3_CRCS", 0, profileFile ) );
    putValue( eWFS_MSG4_RNDS, getProfileInt( "Settings", "eWFS_MSG4_RNDS", 0, profileFile ) );
    putValue( eWFS_MSG4_CRCS, getProfileInt( "Settings", "eWFS_MSG4_CRCS", 0, profileFile ) );
    putValue( eNM_Gateway_SNIS, getProfileInt( "Settings", "eNM_Gateway_SNIS", 16, profileFile ) );
    putValue( eNM_Gateway_NM_StateS, getProfileInt( "Settings", "eNM_Gateway_NM_StateS", 0, profileFile ) );
    putValue( eNM_Gateway_Car_WakeupS, getProfileInt( "Settings", "eNM_Gateway_Car_WakeupS", 0, profileFile ) );
    putValue( eNM_Gateway_WakeupS, getProfileInt( "Settings", "eNM_Gateway_WakeupS", 0, profileFile ) );
    putValue( eNM_Gateway_NM_aktiv_KL15S, getProfileInt( "Settings", "eNM_Gateway_NM_aktiv_KL15S", 0, profileFile ) );
    putValue( eNM_Gateway_NM_aktiv_DiagnoseS, getProfileInt( "Settings", "eNM_Gateway_NM_aktiv_DiagnoseS", 0, profileFile ) );
    putValue( eNM_Gateway_NM_aktiv_TminS, getProfileInt( "Settings", "eNM_Gateway_NM_aktiv_TminS", 0, profileFile ) );
    putValue( eNM_Gateway_UDS_CCS, getProfileInt( "Settings", "eNM_Gateway_UDS_CCS", 0, profileFile ) );
    putValue( ePLS_Anf_AnzS, getProfileInt( "Settings", "ePLS_Anf_AnzS", 0, profileFile ) );
    putValue( ePLS_Kurze_LueckeS, getProfileInt( "Settings", "ePLS_Kurze_LueckeS", 0, profileFile ) );
    putValue( ePLS_Laengs_QuerlueckeS, getProfileInt( "Settings", "ePLS_Laengs_QuerlueckeS", 0, profileFile ) );
    putValue( ePLS_Anf_Anz_SchwellpfeilS, getProfileInt( "Settings", "ePLS_Anf_Anz_SchwellpfeilS", 0, profileFile ) );
    putValue( ePLS_Fahrtrichtg_MehrzgS, getProfileInt( "Settings", "ePLS_Fahrtrichtg_MehrzgS", 0, profileFile ) );
    putValue( ePLS_BremssymbolS, getProfileInt( "Settings", "ePLS_BremssymbolS", 0, profileFile ) );
    putValue( ePLS_PL_ExistS, getProfileInt( "Settings", "ePLS_PL_ExistS", 0, profileFile ) );
    putValue( ePLS_StandbyS, getProfileInt( "Settings", "ePLS_StandbyS", 0, profileFile ) );
    putValue( ePLS_Mehrzg_AktivS, getProfileInt( "Settings", "ePLS_Mehrzg_AktivS", 0, profileFile ) );
    putValue( ePLS_Pos_OKS, getProfileInt( "Settings", "ePLS_Pos_OKS", 0, profileFile ) );
    putValue( ePLS_PL_SeiteS, getProfileInt( "Settings", "ePLS_PL_SeiteS", 0, profileFile ) );
    putValue( ePLS_Lenk_Aktiv_HinweisS, getProfileInt( "Settings", "ePLS_Lenk_Aktiv_HinweisS", 0, profileFile ) );
    putValue( ePLS_TexteS, getProfileInt( "Settings", "ePLS_TexteS", 0, profileFile ) );
    putValue( ePLS_Schwellpfeil_relS, getProfileInt( "Settings", "ePLS_Schwellpfeil_relS", 0, profileFile ) );
    putValue( ePLS_Schwellpfeil_absS, getProfileInt( "Settings", "ePLS_Schwellpfeil_absS", 0, profileFile ) );
    putValue( ePLS_Ausparken_AktivS, getProfileInt( "Settings", "ePLS_Ausparken_AktivS", 0, profileFile ) );
    putValue( ePLS_BremsleuchteS, getProfileInt( "Settings", "ePLS_BremsleuchteS", 0, profileFile ) );
    putValue( eRDK_System_OffS, getProfileInt( "Settings", "eRDK_02_System_OffS", 0, profileFile ) );
    putValue( eRDK_Warnungen_02s, getProfileInt( "Settings", "eRDK_Warnungen_02S", 0, profileFile ) );
    putValue( eRDK_FMVSS138_LampeS, getProfileInt( "Settings", "eRDK_FMVSS138_LampeS", 0, profileFile ) );
    putValue( eRDK_Druckwarnung_RdWS, getProfileInt( "Settings", "eRDK_Druckwarnung_RdWS", 0, profileFile ) );
    putValue( eRDK_FMVSS138_MILS, getProfileInt( "Settings", "eRDK_FMVSS138_MILS", 0, profileFile ) );
    putValue( eRDK_LF_aktivS, getProfileInt( "Settings", "eRDK_LF_aktivS", 0, profileFile ) );
    putValue( eRDK_Diff_Druck_VLS, getProfileFloat( "Settings", "eRDK_02_Diff_Druck_VLS", -6.3, profileFile ) );
    putValue( eRDK_KD_FehlerS, getProfileInt( "Settings", "eRDK_02_KD_FehlerS", 0, profileFile ) );
    putValue( eRDK_Diff_Druck_VRS, getProfileFloat( "Settings", "eRDK_02_Diff_Druck_VRS", -6.3, profileFile ) );
    putValue( eRDK_Diff_Druck_HLS, getProfileFloat( "Settings", "eRDK_02_Diff_Druck_HLS", -6.3, profileFile ) );
    putValue( eRDK_Diff_Druck_HRS, getProfileFloat( "Settings", "eRDK_02_Diff_Druck_HRS", -6.3, profileFile ) );
    putValue( eRKA_WarnungenS, getProfileInt( "Settings", "eRKA_WarnungenS", 0, profileFile ) );
    putValue( eRKA_FMVSS138_LampeS, getProfileInt( "Settings", "eRKA_FMVSS138_LampeS", 0, profileFile ) );
    putValue( eRKA_Druckwarnung_RdWS, getProfileInt( "Settings", "eRKA_Druckwarnung_RdWS", 0, profileFile ) );
    putValue( eRKA_FMVSS138_MILS, getProfileInt( "Settings", "eRKA_FMVSS138_MILS", 0, profileFile ) );
    putValue( eRKA_Warnungen_02S, getProfileInt( "Settings", "eRKA_Warnungen_02S", 0, profileFile ) );
    putValue( eRKA_KD_FehlerS, getProfileInt( "Settings", "eRKA_KD_FehlerS", 0, profileFile ) );
    putValue( eSWA_Status_BZS, getProfileInt( "Settings", "eSWA_Status_BZS", 0, profileFile ) );
    putValue( eSWA_AnzeigenS, getProfileInt( "Settings", "eSWA_AnzeigenS", 0, profileFile ) );
    putValue( eSWA_Blindheit_erkanntS, getProfileInt( "Settings", "eSWA_Blindheit_erkanntS", 0, profileFile ) );
    putValue( eSWA_rel_NichtverfS, getProfileInt( "Settings", "eSWA_rel_NichtverfS", 0, profileFile ) );
    putValue( eSWA_rel_FehlerS, getProfileInt( "Settings", "eSWA_rel_FehlerS", 0, profileFile ) );
    putValue( eSWA_Sta_aktivS, getProfileInt( "Settings", "eSWA_Sta_aktivS", 0, profileFile ) );
    putValue( eSWA_Sta_passivS, getProfileInt( "Settings", "eSWA_Sta_passivS", 0, profileFile ) );
    putValue( eSWA_Standziele_liS, getProfileInt( "Settings", "eSWA_Standziele_liS", 0, profileFile ) );
    putValue( eSWA_Kolonne_liS, getProfileInt( "Settings", "eSWA_Kolonne_liS", 0, profileFile ) );
    putValue( eSWA_Infostufe_SWA_liS, getProfileInt( "Settings", "eSWA_Infostufe_SWA_liS", 0, profileFile ) );
    putValue( eSWA_Warnung_SWA_liS, getProfileInt( "Settings", "eSWA_Warnung_SWA_liS", 0, profileFile ) );
    putValue( eSWA_Kolonne_miS, getProfileInt( "Settings", "eSWA_Kolonne_miS", 0, profileFile ) );
    putValue( eSWA_Standziele_reS, getProfileInt( "Settings", "eSWA_Standziele_reS", 0, profileFile ) );
    putValue( eSWA_Kolonne_reS, getProfileInt( "Settings", "eSWA_Kolonne_reS", 0, profileFile ) );
    putValue( eSWA_Infostufe_SWA_reS, getProfileInt( "Settings", "eSWA_Infostufe_SWA_reS", 0, profileFile ) );
    putValue( eSWA_Warnung_SWA_reS, getProfileInt( "Settings", "eSWA_Warnung_SWA_reS", 0, profileFile ) );
    putValue( eSWA_GischtzaehlerS, getProfileInt( "Settings", "eSWA_GischtzaehlerS", 0, profileFile ) );
    putValue( eSI_Sammel_SG_FehlerS, getProfileInt( "Settings", "eSI_Sammel_SG_FehlerS", 63, profileFile ) );
    putValue( eSI_P_Mode_gueltigS, getProfileInt( "Settings", "eSI_P_Mode_gueltigS", 0, profileFile ) );
    putValue( eSI_QRS_ModeS, getProfileInt( "Settings", "eSI_QRS_ModeS", 0, profileFile ) );
    putValue( eSI_NWDFS, getProfileInt( "Settings", "eSI_NWDFS", 0, profileFile ) );
    putValue( eSI_NWDF_gueltigS, getProfileInt( "Settings", "eSI_NWDF_gueltigS", 0, profileFile ) );
    putValue( eGW_KD_FehlerS, getProfileInt( "Settings", "eGW_KD_FehlerS", 0, profileFile ) );
    putValue( eSI_CAB_01S, getProfileInt( "Settings", "eSI_CAB_01S", 1, profileFile ) );
    putValue( eSI_CAB_02S, getProfileInt( "Settings", "eSI_CAB_02S", 1, profileFile ) );
    putValue( eSI_CAB_03S, getProfileInt( "Settings", "eSI_CAB_03S", 1, profileFile ) );
    putValue( eSI_CAB_04S, getProfileInt( "Settings", "eSI_CAB_04S", 1, profileFile ) );
    putValue( eSI_CAB_05S, getProfileInt( "Settings", "eSI_CAB_05S", 1, profileFile ) );
    putValue( eSI_CAB_06S, getProfileInt( "Settings", "eSI_CAB_06S", 1, profileFile ) );
    putValue( eSI_CAB_07S, getProfileInt( "Settings", "eSI_CAB_07S", 1, profileFile ) );
    putValue( eSI_CAB_08S, getProfileInt( "Settings", "eSI_CAB_08S", 1, profileFile ) );
    putValue( eSI_CAB_09S, getProfileInt( "Settings", "eSI_CAB_09S", 1, profileFile ) );
    putValue( eSI_CAB_10S, getProfileInt( "Settings", "eSI_CAB_10S", 1, profileFile ) );
    putValue( eSI_CAB_11S, getProfileInt( "Settings", "eSI_CAB_11S", 1, profileFile ) );
    putValue( eSI_CAB_12S, getProfileInt( "Settings", "eSI_CAB_12S", 1, profileFile ) );
    putValue( eSI_CAB_13S, getProfileInt( "Settings", "eSI_CAB_13S", 1, profileFile ) );
    putValue( eSI_CAB_14S, getProfileInt( "Settings", "eSI_CAB_14S", 1, profileFile ) );
    putValue( eSI_BUS_01S, getProfileInt( "Settings", "eSI_BUS_01S", 1, profileFile ) );
    putValue( eSI_BUS_02S, getProfileInt( "Settings", "eSI_BUS_02S", 1, profileFile ) );
    putValue( eSI_BUS_03S, getProfileInt( "Settings", "eSI_BUS_03S", 1, profileFile ) );
    putValue( eSI_BUS_04S, getProfileInt( "Settings", "eSI_BUS_04S", 1, profileFile ) );
    putValue( eSI_BUS_05S, getProfileInt( "Settings", "eSI_BUS_05S", 1, profileFile ) );
    putValue( eSI_BUS_06S, getProfileInt( "Settings", "eSI_BUS_06S", 1, profileFile ) );
    putValue( eSI_BUS_07S, getProfileInt( "Settings", "eSI_BUS_07S", 1, profileFile ) );
    putValue( eSI_BUS_08S, getProfileInt( "Settings", "eSI_BUS_08S", 1, profileFile ) );
    putValue( eSI_BUS_09S, getProfileInt( "Settings", "eSI_BUS_09S", 1, profileFile ) );
    putValue( eSI_BUS_10S, getProfileInt( "Settings", "eSI_BUS_10S", 1, profileFile ) );
    putValue( eSI_BUS_11S, getProfileInt( "Settings", "eSI_BUS_11S", 1, profileFile ) );
    putValue( eSI_BUS_12S, getProfileInt( "Settings", "eSI_BUS_12S", 1, profileFile ) );
    putValue( eSI_BUS_13S, getProfileInt( "Settings", "eSI_BUS_13S", 1, profileFile ) );
    putValue( eSI_BUS_14S, getProfileInt( "Settings", "eSI_BUS_14S", 1, profileFile ) );
    putValue( eSI_BUS_15S, getProfileInt( "Settings", "eSI_BUS_15S", 1, profileFile ) );
    putValue( eTSK_WunschgeschwS, getProfileFloat( "Settings", "eTSK_WunschgeschwS", 0, profileFile ) );
    putValue( eTSK_Texte_PrimaeranzS, getProfileInt( "Settings", "eTSK_Texte_PrimaeranzS", 0, profileFile ) );
    putValue( eTSK_Limiter_AnzeigeS, getProfileInt( "Settings", "eTSK_Limiter_AnzeigeS", 0, profileFile ) );
    putValue( eTSK_Status_AnzeigeS, getProfileInt( "Settings", "eTSK_Status_AnzeigeS", 1, profileFile ) );
    putValue( eWBA_Fahrstufe_02S, getProfileInt( "Settings", "eWBA_Fahrstufe_02S", 0, profileFile ) );
    putValue( eWBA_ZielFahrstufeS, getProfileInt( "Settings", "eWBA_ZielFahrstufeS", 0, profileFile ) );
    putValue( eWBA_GE_Warnung_02S, getProfileInt( "Settings", "eWBA_GE_Warnung_02S", 0, profileFile ) );
    putValue( eWBA_eing_Gang_02S, getProfileInt( "Settings", "eWBA_eing_Gang_02S", 0, profileFile ) );
    putValue( eWBA_GE_TexteS, getProfileInt( "Settings", "eWBA_GE_TexteS", 0, profileFile ) );
    putValue( eWBA_Segeln_aktivS, getProfileInt( "Settings", "eWBA_Segeln_aktivS", 0, profileFile ) );
    putValue( eWBA_SchaltschemaS, getProfileInt( "Settings", "eWBA_SchaltschemaS", 0, profileFile ) );
    putValue( eWIV_VerschleissindexS, getProfileFloat( "Settings", "eWIV_VerschleissindexS", 0, profileFile ) );
    putValue( eWIV_RussindexS, getProfileFloat( "Settings", "eWIV_RussindexS", 0, profileFile ) );
    putValue( eWIV_t_minS, getProfileInt( "Settings", "eWIV_t_minS", 12, profileFile ) );
    putValue( eWIV_t_maxS, getProfileInt( "Settings", "eWIV_t_maxS", 24, profileFile ) );
    putValue( eWIV_W_minS, getProfileFloat( "Settings", "eWIV_W_minS", 17000, profileFile ) );
    putValue( eWIV_W_maxS, getProfileFloat( "Settings", "eWIV_W_maxS", 31000, profileFile ) );
    putValue( eDEV_Kombi_SUP1_DummySigS, getProfileInt( "Settings", "eDEV_Kombi_SUP1_DummySigS", 0, profileFile ) );
    putValue( eDEV_Kombi_SUP2_DummySigS, getProfileInt( "Settings", "eDEV_Kombi_SUP2_DummySigS", 0, profileFile ) );
    putValue( eDEV_Kombi_SUP3_DummySigS, getProfileInt( "Settings", "eDEV_Kombi_SUP3_DummySigS", 0, profileFile ) );
    putValue( eDEV_Kombi_UD1_Byte1S, getProfileInt( "Settings", "eDEV_Kombi_UD1_Byte1S", 0, profileFile ) );
    putValue( eDEV_Kombi_UD1_Byte2S, getProfileInt( "Settings", "eDEV_Kombi_UD1_Byte2S", 0, profileFile ) );
    putValue( eDEV_Kombi_UD1_Byte3S, getProfileInt( "Settings", "eDEV_Kombi_UD1_Byte3S", 0, profileFile ) );
    putValue( eDEV_Kombi_UD1_Byte4S, getProfileInt( "Settings", "eDEV_Kombi_UD1_Byte4S", 0, profileFile ) );
    putValue( eDEV_Kombi_UD1_Byte5S, getProfileInt( "Settings", "eDEV_Kombi_UD1_Byte5S", 0, profileFile ) );
    putValue( eDEV_Kombi_UD1_Byte6S, getProfileInt( "Settings", "eDEV_Kombi_UD1_Byte6S", 0, profileFile ) );
    putValue( eDEV_Kombi_UD1_Byte7S, getProfileInt( "Settings", "eDEV_Kombi_UD1_Byte7S", 0, profileFile ) );
    putValue( eDEV_Kombi_UD1_Byte8S, getProfileInt( "Settings", "eDEV_Kombi_UD1_Byte8S", 0, profileFile ) );
    putValue( eDEV_Kombi_UD2_Byte1S, getProfileInt( "Settings", "eDEV_Kombi_UD2_Byte1S", 0, profileFile ) );
    putValue( eDEV_Kombi_UD2_Byte2S, getProfileInt( "Settings", "eDEV_Kombi_UD2_Byte2S", 0, profileFile ) );
    putValue( eDEV_Kombi_UD2_Byte3S, getProfileInt( "Settings", "eDEV_Kombi_UD2_Byte3S", 0, profileFile ) );
    putValue( eDEV_Kombi_UD2_Byte4S, getProfileInt( "Settings", "eDEV_Kombi_UD2_Byte4S", 0, profileFile ) );
    putValue( eDEV_Kombi_UD2_Byte5S, getProfileInt( "Settings", "eDEV_Kombi_UD2_Byte5S", 0, profileFile ) );
    putValue( eDEV_Kombi_UD2_Byte6S, getProfileInt( "Settings", "eDEV_Kombi_UD2_Byte6S", 0, profileFile ) );
    putValue( eDEV_Kombi_UD2_Byte7S, getProfileInt( "Settings", "eDEV_Kombi_UD2_Byte7S", 0, profileFile ) );
    putValue( eDEV_Kombi_UD2_Byte8S, getProfileInt( "Settings", "eDEV_Kombi_UD2_Byte8S", 0, profileFile ) );
  //GVJ-5567
    putValue( eTG_Geber_1, getProfileInt( "Settings", "eTG_Geber_1", 0, profileFile ) );
    putValue( eTG_Geber_2, getProfileInt( "Settings", "eTG_Geber_2", 0, profileFile ) );
    putValue( eTG_Geber_3, getProfileInt( "Settings", "eTG_Geber_3", 0, profileFile ) );
    putValue( eTG_Geber_4, getProfileInt( "Settings", "eTG_Geber_4", 0, profileFile ) );
    putValue( eTG_Guete_Geber_1, getProfileInt( "Settings", "eTG_Guete_Geber_1", 0, profileFile ) );
    putValue( eTG_Guete_Geber_2, getProfileInt( "Settings", "eTG_Guete_Geber_2", 0, profileFile ) );
    putValue( eTG_Guete_Geber_3, getProfileInt( "Settings", "eTG_Guete_Geber_3", 0, profileFile ) );
    putValue( eTG_Guete_Geber_4, getProfileInt( "Settings", "eTG_Guete_Geber_4", 0, profileFile ) );
    putValue( eEFF_Verbrauch_STH, getProfileInt( "Settings", "eEFF_Verbrauch_STH", 0, profileFile ) );
    putValue( eSendAirbag_01, getProfileInt( "Settings", "eSendAirbag_01", 1, profileFile ) );
    putValue( eTAirbag_01, getProfileInt( "Settings", "eTAirbag_01", 40, profileFile ) );
    putValue( eTOTAirbag_01, getProfileInt( "Settings", "eTOTAirbag_01", 400, profileFile ) );
    putValue( eSendARA_Status_01, getProfileInt( "Settings", "eSendARA_Status_01", 1, profileFile ) );
    putValue( eTARA_Status_01, getProfileInt( "Settings", "eTARA_Status_01", 100, profileFile ) );
    putValue( eTOTARA_Status_01, getProfileInt( "Settings", "eTOTARA_Status_01", 1000, profileFile ) );
    putValue( eDlcARA_Status_01, getProfileInt( "Settings", "eDlcARA_Status_01", 8, profileFile ) );
    putValue( eSendFCW_01, getProfileInt( "Settings", "eSendFCW_01", 1, profileFile ) );
    putValue( eTFCW_01, getProfileInt( "Settings", "eTFCW_01", 200, profileFile ) );
    putValue( eTOTFCW_01, getProfileInt( "Settings", "eTOTFCW_01", 2000, profileFile ) );
    putValue( eDlcFCW_01, getProfileInt( "Settings", "eDlcFCW_01", 8, profileFile ) );
    putValue( eSendESP_21, getProfileInt( "Settings", "eSendESP_21", 1, profileFile ) );
    putValue( eTESP_21, getProfileInt( "Settings", "eTESP_21", 20, profileFile ) );
    putValue( eTOTESP_21, getProfileInt( "Settings", "eTOTESP_21", 500, profileFile ) );
    putValue( eDlcESP_21, getProfileInt( "Settings", "eDlcESP_21", 8, profileFile ) );
    putValue( eCrcESP_21, getProfileInt( "Settings", "eCrcESP_21", 1, profileFile ) );
    putValue( eBZESP_21, getProfileInt( "Settings", "eBZESP_21", 1, profileFile ) );
    putValue( eBZStepESP_21, getProfileInt( "Settings", "eBZStepESP_21", 1, profileFile ) );
    putValue( eSendTSG_FT_02, getProfileInt( "Settings", "eSendTSG_FT_02", 1, profileFile ) );
    putValue( eTTSG_FT_02, getProfileInt( "Settings", "eTTSG_FT_02", 100, profileFile ) );
    putValue( eTOTTSG_FT_02, getProfileInt( "Settings", "eTOTTSG_FT_02", 1000, profileFile ) );
    putValue( eDlcTSG_FT_02, getProfileInt( "Settings", "eDlcTSG_FT_02", 8, profileFile ) );
    putValue( eCrcTSG_FT_02, getProfileInt( "Settings", "eCrcTSG_FT_02", 1, profileFile ) );
    putValue( eBZTSG_FT_02, getProfileInt( "Settings", "eBZTSG_FT_02", 1, profileFile ) );
    putValue( eBZStepTSG_FT_02, getProfileInt( "Settings", "eBZStepTSG_FT_02", 1, profileFile ) );
    putValue( eTBCM_03, getProfileInt( "Settings", "eTBCM_03", 1000, profileFile ) );
    putValue( eTOTBCM_03, getProfileInt( "Settings", "eTOTBCM_03", 5000, profileFile ) );
    putValue( eDlcBCM_03, getProfileInt( "Settings", "eDlcBCM_03", 8, profileFile ) );
}

void loadSettings3( char profileFile[] )
{
    putValue( eDlcLog_Kombi_Req, getProfileInt( "Settings", "eDlcLog_Kombi_Req", 8, profileFile ) );
    putValue( eSendMem_BFS_01, getProfileInt( "Settings", "eSendMem_BFS_01", 1, profileFile ) );
    putValue( eTMem_BFS_01, getProfileInt( "Settings", "eTMem_BFS_01", 100, profileFile ) );
    putValue( eTOTMem_BFS_01, getProfileInt( "Settings", "eTOTMem_BFS_01", 1000, profileFile ) );
    putValue( eDlcMem_BFS_01, getProfileInt( "Settings", "eDlcMem_BFS_01", 8, profileFile ) );
    putValue( eSendMem_FS_01, getProfileInt( "Settings", "eSendMem_FS_01", 1, profileFile ) );
    putValue( eTMem_FS_01, getProfileInt( "Settings", "eTMem_FS_01", 100, profileFile ) );
    putValue( eTOTMem_FS_01, getProfileInt( "Settings", "eTOTMem_FS_01", 1000, profileFile ) );
    putValue( eDlcMem_FS_01, getProfileInt( "Settings", "eDlcMem_FS_01", 8, profileFile ) );
    putValue( eSendMFG_01, getProfileInt( "Settings", "eSendMFG_01", 1, profileFile ) );
    putValue( eTMFG_01, getProfileInt( "Settings", "eTMFG_01", 200, profileFile ) );
    putValue( eTOTMFG_01, getProfileInt( "Settings", "eTOTMFG_01", 2000, profileFile ) );
    putValue( eDlcMFG_01, getProfileInt( "Settings", "eDlcMFG_01", 8, profileFile ) );
    putValue( eCrcMFG_01, getProfileInt( "Settings", "eCrcMFG_01", 1, profileFile ) );
    putValue( eBZMFG_01, getProfileInt( "Settings", "eBZMFG_01", 1, profileFile ) );
    putValue( eBZStepMFG_01, getProfileInt( "Settings", "eBZStepMFG_01", 1, profileFile ) );
    putValue( eSendRLS_01, getProfileInt( "Settings", "eSendRLS_01", 1, profileFile ) );
    putValue( eTRLS_01, getProfileInt( "Settings", "eTRLS_01", 200, profileFile ) );
    putValue( eTOTRLS_01, getProfileInt( "Settings", "eTOTRLS_01", 2000, profileFile ) );
    putValue( eDlcRLS_01, getProfileInt( "Settings", "eDlcRLS_01", 5, profileFile ) );
    putValue( eSendSMLS_01, getProfileInt( "Settings", "eSendSMLS_01", 1, profileFile ) );
    putValue( eTSMLS_01, getProfileInt( "Settings", "eTSMLS_01", 1000, profileFile ) );
    putValue( eTOTSMLS_01, getProfileInt( "Settings", "eTOTSMLS_01", 5000, profileFile ) );
    putValue( eDlcSMLS_01, getProfileInt( "Settings", "eDlcSMLS_01", 8, profileFile ) );
    putValue( eCrcSMLS_01, getProfileInt( "Settings", "eCrcSMLS_01", 1, profileFile ) );
    putValue( eBZSMLS_01, getProfileInt( "Settings", "eBZSMLS_01", 1, profileFile ) );
    putValue( eBZStepSMLS_01, getProfileInt( "Settings", "eBZStepSMLS_01", 1, profileFile ) );
    putValue( eSendTCO_01, getProfileInt( "Settings", "eSendTCO_01", 0, profileFile ) );
    putValue( eTTCO_01, getProfileInt( "Settings", "eTTCO_01", 20, profileFile ) );
    putValue( eTOTTCO_01, getProfileInt( "Settings", "eTOTTCO_01", 500, profileFile ) );
    putValue( eDlcTCO_01, getProfileInt( "Settings", "eDlcTCO_01", 8, profileFile ) );
    putValue( eSendTSG_FT_01, getProfileInt( "Settings", "eSendTSG_FT_01", 1, profileFile ) );
    putValue( eTTSG_FT_01, getProfileInt( "Settings", "eTTSG_FT_01", 100, profileFile ) );
    putValue( eTOTTSG_FT_01, getProfileInt( "Settings", "eTOTTSG_FT_01", 1000, profileFile ) );
    putValue( eDlcTSG_FT_01, getProfileInt( "Settings", "eDlcTSG_FT_01", 8, profileFile ) );
    putValue( eSendTimeDate, getProfileInt( "Settings", "eSendTimeDate", 1, profileFile ) );
    putValue( eTTimeDate, getProfileInt( "Settings", "eTTimeDate", 1000, profileFile ) );
    putValue( eTOTTimeDate, getProfileInt( "Settings", "eTOTTimeDate", 5000, profileFile ) );
    putValue( eDlcTimeDate, getProfileInt( "Settings", "eDlcTimeDate", 8, profileFile ) );
    putValue( eSendVehiDist, getProfileInt( "Settings", "eSendVehiDist", 1, profileFile ) );
    putValue( eTVehiDist, getProfileInt( "Settings", "eTVehiDist", 100, profileFile ) );
    putValue( eTOTVehiDist, getProfileInt( "Settings", "eTOTVehiDist", 1000, profileFile ) );
    putValue( eDlcVehiDist, getProfileInt( "Settings", "eDlcVehiDist", 8, profileFile ) );
    putValue( eSendWischer_01, getProfileInt( "Settings", "eSendWischer_01", 1, profileFile ) );
    putValue( eTWischer_01, getProfileInt( "Settings", "eTWischer_01", 1000, profileFile ) );
    putValue( eTOTWischer_01, getProfileInt( "Settings", "eTOTWischer_01", 5000, profileFile ) );
    putValue( eDlcWischer_01, getProfileInt( "Settings", "eDlcWischer_01", 2, profileFile ) );
    putValue( eSendZV_02, getProfileInt( "Settings", "eSendZV_02", 1, profileFile ) );
    putValue( eTZV_02, getProfileInt( "Settings", "eTZV_02", 200, profileFile ) );
    putValue( eTOTZV_02, getProfileInt( "Settings", "eTOTZV_02", 2000, profileFile ) );
    putValue( eDlcZV_02, getProfileInt( "Settings", "eDlcZV_02", 8, profileFile ) );
    putValue( eSendSTH_01, getProfileInt( "Settings", "eSendSTH_01", 1, profileFile ) );
    putValue( eTSTH_01, getProfileInt( "Settings", "eTSTH_01", 200, profileFile ) );
    putValue( eTOTSTH_01, getProfileInt( "Settings", "eTOTSTH_01", 2000, profileFile ) );
    putValue( eDlcSTH_01, getProfileInt( "Settings", "eDlcSTH_01", 8, profileFile ) );

    putValue( eSendHSP_01, getProfileInt( "Settings", "eSendHSP_01", 1, profileFile ) );
    putValue( eTHSP_01, getProfileInt( "Settings", "eTHSP_01", 200, profileFile ) );
    putValue( eTOTHSP_01, getProfileInt( "Settings", "eTOTHSP_01", 2000, profileFile ) );
    putValue( eDlcHSP_01, getProfileInt( "Settings", "eDlcHSP_01", 6, profileFile ) );

    putValue( eChannel, getProfileInt( "Settings", "eChannel", 0, profileFile ) );

    //IssueList #173 MR 55685
    putValue( eSendPersonalisierung_01, getProfileInt( "Settings", "eSendPersonalisierung_01", 1, profileFile ) );
    putValue( eTPersonalisierung_01, getProfileInt( "Settings", "eTPersonalisierung_01", 100, profileFile ) );
    putValue( eTOTPersonalisierung_01, getProfileInt( "Settings", "eTOTPersonalisierung_01", 1000, profileFile ) );
    putValue( eDlcPersonalisierung_01, getProfileInt( "Settings", "eDlcPersonalisierung_01", 8, profileFile ) );
}

void loadSettings3G( char profileFile[] )
{
    //ACC_13
    putValue( eSendACC_13, getProfileInt( "Settings", "eSendACC_13", 1, profileFile ) );
    putValue( eTACC_13, getProfileInt( "Settings", "eTACC_13", 60, profileFile ) );
    putValue( eTOTACC_13, getProfileInt( "Settings", "eTOTACC_13", 600, profileFile ) );
    putValue( eDlcACC_13, getProfileInt( "Settings", "eDlcACC_13", 8, profileFile ) );

    //ACC_14
    putValue( eSendACC_14, getProfileInt( "Settings", "eSendACC_14", 1, profileFile ) );
    putValue( eTACC_14, getProfileInt( "Settings", "eTACC_14", 60, profileFile ) );
    putValue( eTOTACC_14, getProfileInt( "Settings", "eTOTACC_14", 600, profileFile ) );
    putValue( eDlcACC_14, getProfileInt( "Settings", "eDlcACC_14", 8, profileFile ) );

    //ACC_20
    putValue( eSendACC_20, getProfileInt( "Settings", "eSendACC_20", 1, profileFile ) );
    putValue( eTACC_20, getProfileInt( "Settings", "eTACC_20", 60, profileFile ) );
    putValue( eTOTACC_20, getProfileInt( "Settings", "eTOTACC_20", 600, profileFile ) );
    putValue( eDlcACC_20, getProfileInt( "Settings", "eDlcACC_20", 8, profileFile ) );

    //ACC_21
    putValue( eSendACC_21, getProfileInt( "Settings", "eSendACC_21", 1, profileFile ) );
    putValue( eTACC_21, getProfileInt( "Settings", "eTACC_21", 60, profileFile ) );
    putValue( eTOTACC_21, getProfileInt( "Settings", "eTOTACC_21", 600, profileFile ) );
    putValue( eDlcACC_21, getProfileInt( "Settings", "eDlcACC_21", 8, profileFile ) );

    //AGA_01
    putValue( eSendAGA_01, getProfileInt( "Settings", "eSendAGA_01", 1, profileFile ) );
    putValue( eTAGA_01, getProfileInt( "Settings", "eTAGA_01", 1000, profileFile ) );
    putValue( eTOTAGA_01, getProfileInt( "Settings", "eTOTAGA_01", 5000, profileFile ) );
    putValue( eDlcAGA_01, getProfileInt( "Settings", "eDlcAGA_01", 8, profileFile ) );
    putValue( eBZAGA_01, getProfileInt( "Settings", "eBZAGA_01", 1, profileFile ) );
    putValue( eBZStepAGA_01, getProfileInt( "Settings", "eBZStepAGA_01", 1, profileFile ) );
    putValue( eCrcAGA_01, getProfileInt( "Settings", "eCrcAGA_01", 1, profileFile ) );

    putValue( eSendAirbag_02, getProfileInt( "Settings", "eSendAirbag_02", 1, profileFile ) );
    putValue( eTAirbag_02, getProfileInt( "Settings", "eTAirbag_02", 200, profileFile ) );
    putValue( eTOTAirbag_02, getProfileInt( "Settings", "eTOTAirbag_02", 2000, profileFile ) );
    putValue( eDlcAirbag_02, getProfileInt( "Settings", "eDlcAirbag_02", 8, profileFile ) );

    //Airbag_04
    putValue( eSendAirbag_04, getProfileInt( "Settings", "eSendAirbag_04", 1, profileFile ) );
    putValue( eTAirbag_04, getProfileInt( "Settings", "eTAirbag_04", 200, profileFile ) );
    putValue( eTOTAirbag_04, getProfileInt( "Settings", "eTOTAirbag_04", 2000, profileFile ) );
    putValue( eDlcAirbag_04, getProfileInt( "Settings", "eDlcAirbag_04", 8, profileFile ) );

    //Airbag_06
    putValue( eSendAirbag_06, getProfileInt( "Settings", "eSendAirbag_06", 1, profileFile ) );
    putValue( eTAirbag_06, getProfileInt( "Settings", "eTAirbag_06", 200, profileFile ) );
    putValue( eTOTAirbag_06, getProfileInt( "Settings", "eTOTAirbag_06", 2000, profileFile ) );
    putValue( eDlcAirbag_06, getProfileInt( "Settings", "eDlcAirbag_06", 8, profileFile ) );

    //AWV_02
    putValue( eSendAWV_02, getProfileInt( "Settings", "eSendAWV_02", 1, profileFile ) );
    putValue( eTAWV_02, getProfileInt( "Settings", "eTAWV_02", 200, profileFile ) );
    putValue( eTOTAWV_02, getProfileInt( "Settings", "eTOTAWV_02", 2000, profileFile ) );
    putValue( eDlcAWV_02, getProfileInt( "Settings", "eDlcAWV_02", 8, profileFile ) );

    putValue( eSendBEM_02, getProfileInt( "Settings", "eSendBEM_02", 1, profileFile ) );
    putValue( eTBEM_02, getProfileInt( "Settings", "eTBEM_02", 100, profileFile ) );
    putValue( eTOTBEM_02, getProfileInt( "Settings", "eTOTBEM_02", 1000, profileFile ) );
    putValue( eDlcBEM_02, getProfileInt( "Settings", "eDlcBEM_02", 8, profileFile ) );
    putValue( eSendCharisma_03, getProfileInt( "Settings", "eSendCharisma_03", 1, profileFile ) );
    putValue( eTCharisma_03, getProfileInt( "Settings", "eTCharisma_03", 1000, profileFile ) );
    putValue( eTOTCharisma_03, getProfileInt( "Settings", "eTOTCharisma_03", 5000, profileFile ) );
    putValue( eDlcCharisma_03, getProfileInt( "Settings", "eDlcCharisma_03", 8, profileFile ) );
    putValue( eSendDaempfer_01, getProfileInt( "Settings", "eSendDaempfer_01", 1, profileFile ) );
    putValue( eTDaempfer_01, getProfileInt( "Settings", "eTDaempfer_01", 100, profileFile ) );
    putValue( eTOTDaempfer_01, getProfileInt( "Settings", "eTOTDaempfer_01", 1000, profileFile ) );
    putValue( eDlcDaempfer_01, getProfileInt( "Settings", "eDlcDaempfer_01", 8, profileFile ) );
    putValue( eSendDEV_Kombi_SUP1, getProfileInt( "Settings", "eSendDEV_Kombi_SUP1", 0, profileFile ) );
    putValue( eTDEV_Kombi_SUP1, getProfileInt( "Settings", "eTDEV_Kombi_SUP1", 0, profileFile ) );
    putValue( eTOTDEV_Kombi_SUP1, getProfileInt( "Settings", "eTOTDEV_Kombi_SUP1", 500, profileFile ) );
    putValue( eDlcDEV_Kombi_SUP1, getProfileInt( "Settings", "eDlcDEV_Kombi_SUP1", 8, profileFile ) );
    putValue( eSendDEV_Kombi_RX1, getProfileInt( "Settings", "eSendDEV_Kombi_RX1", 0, profileFile ) );
    putValue( eTDEV_Kombi_RX1, getProfileInt( "Settings", "eTDEV_Kombi_RX1", 0, profileFile ) );
    putValue( eTOTDEV_Kombi_RX1, getProfileInt( "Settings", "eTOTDEV_Kombi_RX1", 500, profileFile ) );
    putValue( eDlcDEV_Kombi_RX1, getProfileInt( "Settings", "eDlcDEV_Kombi_RX1", 8, profileFile ) );
    putValue( eSendDEV_Kombi_SUP2, getProfileInt( "Settings", "eSendDEV_Kombi_SUP2", 0, profileFile ) );
    putValue( eTDEV_Kombi_SUP2, getProfileInt( "Settings", "eTDEV_Kombi_SUP2", 0, profileFile ) );
    putValue( eTOTDEV_Kombi_SUP2, getProfileInt( "Settings", "eTOTDEV_Kombi_SUP2", 500, profileFile ) );
    putValue( eDlcDEV_Kombi_SUP2, getProfileInt( "Settings", "eDlcDEV_Kombi_SUP2", 8, profileFile ) );
    putValue( eSendDEV_Kombi_SUP3, getProfileInt( "Settings", "eSendDEV_Kombi_SUP3", 0, profileFile ) );
    putValue( eTDEV_Kombi_SUP3, getProfileInt( "Settings", "eTDEV_Kombi_SUP3", 0, profileFile ) );
    putValue( eTOTDEV_Kombi_SUP3, getProfileInt( "Settings", "eTOTDEV_Kombi_SUP3", 500, profileFile ) );
    putValue( eDlcDEV_Kombi_SUP3, getProfileInt( "Settings", "eDlcDEV_Kombi_SUP3", 8, profileFile ) );
    putValue( eSendDEV_Kombi_UD1_PC_KI_Control, getProfileInt( "Settings", "eSendDEV_Kombi_UD1_PC_KI_Control", 0, profileFile ) );
    putValue( eTDEV_Kombi_UD1_PC_KI_Control, getProfileInt( "Settings", "eTDEV_Kombi_UD1_PC_KI_Control", 0, profileFile ) );
    putValue( eTOTDEV_Kombi_UD1_PC_KI_Control, getProfileInt( "Settings", "eTOTDEV_Kombi_UD1_PC_KI_Control", 500, profileFile ) );
    putValue( eDlcDEV_Kombi_UD1_PC_KI_Control, getProfileInt( "Settings", "eDlcDEV_Kombi_UD1_PC_KI_Control", 8, profileFile ) );
    putValue( eSendDEV_Kombi_UD2_PC_KI_Data, getProfileInt( "Settings", "eSendDEV_Kombi_UD2_PC_KI_Data", 0, profileFile ) );
    putValue( eTDEV_Kombi_UD2_PC_KI_Data, getProfileInt( "Settings", "eTDEV_Kombi_UD2_PC_KI_Data", 0, profileFile ) );
    putValue( eTOTDEV_Kombi_UD2_PC_KI_Data, getProfileInt( "Settings", "eTOTDEV_Kombi_UD2_PC_KI_Data", 500, profileFile ) );
    putValue( eDlcDEV_Kombi_UD2_PC_KI_Data, getProfileInt( "Settings", "eDlcDEV_Kombi_UD2_PC_KI_Data", 8, profileFile ) );
    putValue( eSendDiagnose_01, getProfileInt( "Settings", "eSendDiagnose_01", 1, profileFile ) );
    putValue( eTDiagnose_01, getProfileInt( "Settings", "eTDiagnose_01", 1000, profileFile ) );
    putValue( eTOTDiagnose_01, getProfileInt( "Settings", "eTOTDiagnose_01", 5000, profileFile ) );
    putValue( eDlcDiagnose_01, getProfileInt( "Settings", "eDlcDiagnose_01", 8, profileFile ) );
    putValue( eSendESP_02, getProfileInt( "Settings", "eSendESP_02", 1, profileFile ) );
    putValue( eTESP_02, getProfileInt( "Settings", "eTESP_02", 20, profileFile ) );
    putValue( eTOTESP_02, getProfileInt( "Settings", "eTOTESP_02", 500, profileFile ) );
    putValue( eDlcESP_02, getProfileInt( "Settings", "eDlcESP_02", 8, profileFile ) );
    putValue( eSendESP_20, getProfileInt( "Settings", "eSendESP_20", 1, profileFile ) );
    putValue( eTESP_20, getProfileInt( "Settings", "eTESP_20", 1000, profileFile ) );
    putValue( eTOTESP_20, getProfileInt( "Settings", "eTOTESP_20", 5000, profileFile ) );
    putValue( eDlcESP_20, getProfileInt( "Settings", "eDlcESP_20", 8, profileFile ) );
    putValue( eSendESP_24, getProfileInt( "Settings", "eSendESP_24", 1, profileFile ) );
    putValue( eTESP_24, getProfileInt( "Settings", "eTESP_24", 50, profileFile ) );
    putValue( eTOTESP_24, getProfileInt( "Settings", "eTOTESP_24", 500, profileFile ) );
    putValue( eDlcESP_24, getProfileInt( "Settings", "eDlcESP_24", 8, profileFile ) );
    putValue( eCrcESP_24, getProfileInt( "Settings", "eCrcESP_24", 1, profileFile ) );
    putValue( eBZESP_24, getProfileInt( "Settings", "eBZESP_24", 1, profileFile ) );
    putValue( eBZStepESP_24, getProfileInt( "Settings", "eBZStepESP_24", 1, profileFile ) );
    putValue( eSendGateway_73, getProfileInt( "Settings", "eSendGateway_73", 1, profileFile ) );
    putValue( eTGateway_73, getProfileInt( "Settings", "eTGateway_73", 50, profileFile ) );
    putValue( eTOTGateway_73, getProfileInt( "Settings", "eTOTGateway_73", 500, profileFile ) );
    putValue( eDlcGateway_73, getProfileInt( "Settings", "eDlcGateway_73", 8, profileFile ) );

    putValue( eSendGateway_78, getProfileInt( "Settings", "eSendGateway_78", 1, profileFile ) );
    putValue( eTGateway_78, getProfileInt( "Settings", "eTGateway_78", 100, profileFile ) );
    putValue( eTOTGateway_78, getProfileInt( "Settings", "eTOTGateway_78", 1000, profileFile ) );
    putValue( eDlcGateway_78, getProfileInt( "Settings", "eDlcGateway_78", 8, profileFile ) );

    putValue( eSendMotor_Gas_01, getProfileInt( "Settings", "eSendMotor_Gas_01", 1, profileFile ) );
    putValue( eTMotor_Gas_01, getProfileInt( "Settings", "eTMotor_Gas_01", 50, profileFile ) );
    putValue( eTOTMotor_Gas_01, getProfileInt( "Settings", "eTOTMotor_Gas_01", 500, profileFile ) );
    putValue( eDlcMotor_Gas_01, getProfileInt( "Settings", "eDlcMotor_Gas_01", 8, profileFile ) );

    putValue( eSendISO_Funktionaler_Req_All, getProfileInt( "Settings", "eSendISO_Funktionaler_Req_All", 0, profileFile ) );
    putValue( eTISO_Funktionaler_Req_All, getProfileInt( "Settings", "eTISO_Funktionaler_Req_All", 0, profileFile ) );
    putValue( eTOTISO_Funktionaler_Req_All, getProfileInt( "Settings", "eTOTISO_Funktionaler_Req_All", 500, profileFile ) );
    putValue( eDlcISO_Funktionaler_Req_All, getProfileInt( "Settings", "eDlcISO_Funktionaler_Req_All", 8, profileFile ) );
    putValue( eSendISO_Kombi_Req, getProfileInt( "Settings", "eSendISO_Kombi_Req", 0, profileFile ) );
    putValue( eTISO_Kombi_Req, getProfileInt( "Settings", "eTISO_Kombi_Req", 0, profileFile ) );
    putValue( eTOTISO_Kombi_Req, getProfileInt( "Settings", "eTOTISO_Kombi_Req", 500, profileFile ) );
    putValue( eDlcISO_Kombi_Req, getProfileInt( "Settings", "eDlcISO_Kombi_Req", 8, profileFile ) );
    putValue( eSendKS_Kombi_Req, getProfileInt( "Settings", "eSendKS_Kombi_Req", 0, profileFile ) );
    putValue( eTKS_Kombi_Req, getProfileInt( "Settings", "eTKS_Kombi_Req", 0, profileFile ) );
    putValue( eTOTKS_Kombi_Req, getProfileInt( "Settings", "eTOTKS_Kombi_Req", 500, profileFile ) );
    putValue( eDlcKS_Kombi_Req, getProfileInt( "Settings", "eDlcKS_Kombi_Req", 8, profileFile ) );
    putValue( eSendLDW_02, getProfileInt( "Settings", "eSendLDW_02", 1, profileFile ) );
    putValue( eTLDW_02, getProfileInt( "Settings", "eTLDW_02", 100, profileFile ) );
    putValue( eTOTLDW_02, getProfileInt( "Settings", "eTOTLDW_02", 1000, profileFile ) );
    putValue( eDlcLDW_02, getProfileInt( "Settings", "eDlcLDW_02", 8, profileFile ) );
    putValue( eSendLH_EPS_01, getProfileInt( "Settings", "eSendLH_EPS_01", 1, profileFile ) );
    putValue( eTLH_EPS_01, getProfileInt( "Settings", "eTLH_EPS_01", 50, profileFile ) );
    putValue( eTOTLH_EPS_01, getProfileInt( "Settings", "eTOTLH_EPS_01", 500, profileFile ) );
    putValue( eDlcLH_EPS_01, getProfileInt( "Settings", "eDlcLH_EPS_01", 8, profileFile ) );
    putValue( eCrcLH_EPS_01, getProfileInt( "Settings", "eCrcLH_EPS_01", 1, profileFile ) );
    putValue( eBZLH_EPS_01, getProfileInt( "Settings", "eBZLH_EPS_01", 1, profileFile ) );
    putValue( eBZStepLH_EPS_01, getProfileInt( "Settings", "eBZStepLH_EPS_01", 1, profileFile ) );
    putValue( eSendLWR_AFS_01, getProfileInt( "Settings", "eSendLWR_AFS_01", 1, profileFile ) );
    putValue( eTLWR_AFS_01, getProfileInt( "Settings", "eTLWR_AFS_01", 100, profileFile ) );
    putValue( eTOTLWR_AFS_01, getProfileInt( "Settings", "eTOTLWR_AFS_01", 1000, profileFile ) );
    putValue( eDlcLWR_AFS_01, getProfileInt( "Settings", "eDlcLWR_AFS_01", 8, profileFile ) );
    putValue( eBZLWR_AFS_01, getProfileInt( "Settings", "eBZLWR_AFS_01", 1, profileFile ) );
    putValue( eBZStepLWR_AFS_01, getProfileInt( "Settings", "eBZStepLWR_AFS_01", 1, profileFile ) );
    putValue( eSendMFL_Tasten_Kon_01, getProfileInt( "Settings", "eSendMFL_Tasten_Kon_01", 0, profileFile ) );
    putValue( eTMFL_Tasten_Kon_01, getProfileInt( "Settings", "eTMFL_Tasten_Kon_01", 1000, profileFile ) );
    putValue( eTOTMFL_Tasten_Kon_01, getProfileInt( "Settings", "eTOTMFL_Tasten_Kon_01", 5000, profileFile ) );
    putValue( eDlcMFL_Tasten_Kon_01, getProfileInt( "Settings", "eDlcMFL_Tasten_Kon_01", 4, profileFile ) );
    putValue( eSendMotor_04, getProfileInt( "Settings", "eSendMotor_04", 1, profileFile ) );
    putValue( eTMotor_04, getProfileInt( "Settings", "eTMotor_04", 20, profileFile ) );
    putValue( eTOTMotor_04, getProfileInt( "Settings", "eTOTMotor_04", 500, profileFile ) );
    putValue( eDlcMotor_04, getProfileInt( "Settings", "eDlcMotor_04", 8, profileFile ) );
    putValue( eSendMotor_07, getProfileInt( "Settings", "eSendMotor_07", 1, profileFile ) );
    putValue( eTMotor_07, getProfileInt( "Settings", "eTMotor_07", 500, profileFile ) );
    putValue( eTOTMotor_07, getProfileInt( "Settings", "eTOTMotor_07", 5000, profileFile ) );
    putValue( eDlcMotor_07, getProfileInt( "Settings", "eDlcMotor_07", 8, profileFile ) );
    putValue( eSendMotor_09, getProfileInt( "Settings", "eSendMotor_09", 1, profileFile ) );
    putValue( eTMotor_09, getProfileInt( "Settings", "eTMotor_09", 500, profileFile ) );
    putValue( eTOTMotor_09, getProfileInt( "Settings", "eTOTMotor_09", 5000, profileFile ) );
    putValue( eDlcMotor_09, getProfileInt( "Settings", "eDlcMotor_09", 8, profileFile ) );
    putValue( eSendMotor_14, getProfileInt( "Settings", "eSendMotor_14", 1, profileFile ) );
    putValue( eTMotor_14, getProfileInt( "Settings", "eTMotor_14", 100, profileFile ) );
    putValue( eTOTMotor_14, getProfileInt( "Settings", "eTOTMotor_14", 1000, profileFile ) );
    putValue( eDlcMotor_14, getProfileInt( "Settings", "eDlcMotor_14", 8, profileFile ) );
    putValue( eSendMotor_18, getProfileInt( "Settings", "eSendMotor_18", 1, profileFile ) );
    putValue( eTMotor_18, getProfileInt( "Settings", "eTMotor_18", 500, profileFile ) );
    putValue( eTOTMotor_18, getProfileInt( "Settings", "eTOTMotor_18", 5000, profileFile ) );
    putValue( eDlcMotor_18, getProfileInt( "Settings", "eDlcMotor_18", 8, profileFile ) );
    putValue( eSendMotor_26, getProfileInt( "Settings", "eSendMotor_26", 1, profileFile ) );
    putValue( eTMotor_26, getProfileInt( "Settings", "eTMotor_26", 100, profileFile ) );
    putValue( eTOTMotor_26, getProfileInt( "Settings", "eTOTMotor_26", 1000, profileFile ) );
    putValue( eDlcMotor_26, getProfileInt( "Settings", "eDlcMotor_26", 8, profileFile ) );
    putValue( eSendMotor_Code_01, getProfileInt( "Settings", "eSendMotor_Code_01", 1, profileFile ) );
    putValue( eTMotor_Code_01, getProfileInt( "Settings", "eTMotor_Code_01", 1000, profileFile ) );
    putValue( eTOTMotor_Code_01, getProfileInt( "Settings", "eTOTMotor_Code_01", 5000, profileFile ) );
    putValue( eDlcMotor_Code_01, getProfileInt( "Settings", "eDlcMotor_Code_01", 8, profileFile ) );
    putValue( eCrcMotor_Code_01, getProfileInt( "Settings", "eCrcMotor_Code_01", 1, profileFile ) );
    putValue( eBZMotor_Code_01, getProfileInt( "Settings", "eBZMotor_Code_01", 1, profileFile ) );
    putValue( eBZStepMotor_Code_01, getProfileInt( "Settings", "eBZStepMotor_Code_01", 1, profileFile ) );
    putValue( eSendNMH_Gateway, getProfileInt( "Settings", "eSendNMH_Gateway", 0, profileFile ) );
    putValue( eTNMH_Gateway, getProfileInt( "Settings", "eTNMH_Gateway", 200, profileFile ) );
    putValue( eTOTNMH_Gateway, getProfileInt( "Settings", "eTOTNMH_Gateway", 2000, profileFile ) );
    putValue( eDlcNMH_Gateway, getProfileInt( "Settings", "eDlcNMH_Gateway", 8, profileFile ) );
    putValue( eSendRDK_02, getProfileInt( "Settings", "eSendRDK_02", 1, profileFile ) );
    putValue( eTRDK_02, getProfileInt( "Settings", "eTRDK_02", 500, profileFile ) );
    putValue( eTOTRDK_02, getProfileInt( "Settings", "eTOTRDK_02", 5000, profileFile ) );
    putValue( eDlcRDK_02, getProfileInt( "Settings", "eDlcRDK_02", 8, profileFile ) );
    putValue( eSendRKA_01, getProfileInt( "Settings", "eSendRKA_01", 1, profileFile ) );
    putValue( eTRKA_01, getProfileInt( "Settings", "eTRKA_01", 500, profileFile ) );
    putValue( eTOTRKA_01, getProfileInt( "Settings", "eTOTRKA_01", 5000, profileFile ) );
    putValue( eDlcRKA_01, getProfileInt( "Settings", "eDlcRKA_01", 4, profileFile ) );
    putValue( eSendSWA_01, getProfileInt( "Settings", "eSendSWA_01", 1, profileFile ) );
    putValue( eTSWA_01, getProfileInt( "Settings", "eTSWA_01", 50, profileFile ) );
    putValue( eTOTSWA_01, getProfileInt( "Settings", "eTOTSWA_01", 500, profileFile ) );
    putValue( eDlcSWA_01, getProfileInt( "Settings", "eDlcSWA_01", 8, profileFile ) );
    putValue( eCrcSWA_01, getProfileInt( "Settings", "eCrcSWA_01", 1, profileFile ) );
    putValue( eBZSWA_01, getProfileInt( "Settings", "eBZSWA_01", 1, profileFile ) );
    putValue( eBZStepSWA_01, getProfileInt( "Settings", "eBZStepSWA_01", 1, profileFile ) );
    putValue( eSendSysteminfo_01, getProfileInt( "Settings", "eSendSysteminfo_01", 1, profileFile ) );
    putValue( eTSysteminfo_01, getProfileInt( "Settings", "eTSysteminfo_01", 1000, profileFile ) );
    putValue( eTOTSysteminfo_01, getProfileInt( "Settings", "eTOTSysteminfo_01", 5000, profileFile ) );
    putValue( eDlcSysteminfo_01, getProfileInt( "Settings", "eDlcSysteminfo_01", 8, profileFile ) );
    putValue( eSendTSK_07, getProfileInt( "Settings", "eSendTSK_07", 1, profileFile ) );
    putValue( eTTSK_07, getProfileInt( "Settings", "eTTSK_07", 50, profileFile ) );
    putValue( eTOTTSK_07, getProfileInt( "Settings", "eTOTTSK_07", 500, profileFile ) );
    putValue( eDlcTSK_07, getProfileInt( "Settings", "eDlcTSK_07", 8, profileFile ) );
    putValue( eCrcTSK_07, getProfileInt( "Settings", "eCrcTSK_07", 1, profileFile ) );
    putValue( eBZTSK_07, getProfileInt( "Settings", "eBZTSK_07", 1, profileFile ) );
    putValue( eBZStepTSK_07, getProfileInt( "Settings", "eBZStepTSK_07", 1, profileFile ) );
    putValue( eSendWBA_03, getProfileInt( "Settings", "eSendWBA_03", 1, profileFile ) );
    putValue( eTWBA_03, getProfileInt( "Settings", "eTWBA_03", 160, profileFile ) );
    putValue( eTOTWBA_03, getProfileInt( "Settings", "eTOTWBA_03", 1600, profileFile ) );
    putValue( eSendWIV_01, getProfileInt( "Settings", "eSendWIV_01", 1, profileFile ) );
    putValue( eTWIV_01, getProfileInt( "Settings", "eTWIV_01", 2000, profileFile ) );
    putValue( eTOTWIV_01, getProfileInt( "Settings", "eTOTWIV_01", 5000, profileFile ) );
    putValue( eDlcWIV_01, getProfileInt( "Settings", "eDlcWIV_01", 8, profileFile ) );

    putValue( eSendHVLM_05, getProfileInt( "Settings", "eSendHVLM_05", 1, profileFile ) );
    putValue( eTHVLM_05, getProfileInt( "Settings", "eTHVLM_05", 500, profileFile ) );
    putValue( eTOTHVLM_05, getProfileInt( "Settings", "eTOTHVLM_05", 5000, profileFile ) );
    putValue( eDlcHVLM_05, getProfileInt( "Settings", "eDlcHVLM_05", 8, profileFile ) );

    putValue( eSendReichweite_01, getProfileInt( "Settings", "eSendReichweite_01", 1, profileFile ) );
    putValue( eTReichweite_01, getProfileInt( "Settings", "eTReichweite_01",1000, profileFile ) );
    putValue( eTOTReichweite_01, getProfileInt( "Settings", "eTOTReichweite_01", 5000, profileFile ) );
    putValue( eDlcReichweite_01, getProfileInt( "Settings", "eDlcReichweite_01", 8, profileFile ) );

    putValue( eSendReichweite_02, getProfileInt( "Settings", "eSendReichweite_02", 1, profileFile ) );
    putValue( eTReichweite_02, getProfileInt( "Settings", "eTReichweite_02",1000, profileFile ) );
    putValue( eTOTReichweite_02, getProfileInt( "Settings", "eTOTReichweite_02", 5000, profileFile ) );
    putValue( eDlcReichweite_02, getProfileInt( "Settings", "eDlcReichweite_02", 8, profileFile ) );

    putValue( eSendMainUnit_01, getProfileInt( "Settings", "eSendMainUnit_01", 1, profileFile ) );
    putValue( eTMainUnit_01, getProfileInt( "Settings", "eTMainUnit_01",500, profileFile ) );
    putValue( eTOTMainUnit_01, getProfileInt( "Settings", "eTOTMainUnit_01", 5000, profileFile ) );
    putValue( eDlcMainUnit_01, getProfileInt( "Settings", "eDlcMainUnit_01", 8, profileFile ) );

    putValue( eSendBMS_07, getProfileInt( "Settings", "eSendBMS_07", 1, profileFile ) );
    putValue( eTBMS_07, getProfileInt( "Settings", "eTBMS_07", 500, profileFile ) );
    putValue( eTOTBMS_07, getProfileInt( "Settings", "eTOTBMS_07", 5000, profileFile ) );
    putValue( eDlcBMS_07, getProfileInt( "Settings", "eDlcBMS_07", 8, profileFile ) );
    putValue( eBZBMS_07, getProfileInt( "Settings", "eBZBMS_07", 1, profileFile ) );
    putValue( eBZStepBMS_07, getProfileInt( "Settings", "eBZStepBMS_07", 1, profileFile ) );
    putValue( eCrcBMS_07, getProfileInt( "Settings", "eCrcBMS_07", 1, profileFile ) );

    putValue( eSendPLA_Status_02, getProfileInt( "Settings", "eSendPLA_Status_02", 1, profileFile ) );
    putValue( eTPLA_Status_02, getProfileInt( "Settings", "eTPLA_Status_02",100, profileFile ) );
    putValue( eTOTPLA_Status_02, getProfileInt( "Settings", "eTOTPLA_Status_02", 1000, profileFile ) );
    putValue( eDlcPLA_Status_02, getProfileInt( "Settings", "eDlcPLA_Status_02", 8, profileFile ) );

    putValue( eSendMotor_23, getProfileInt( "Settings", "eSendMotor_23", 1, profileFile ) );
    putValue( eTMotor_23, getProfileInt( "Settings", "eTMotor_23", 100, profileFile ) );
    putValue( eTOTMotor_23, getProfileInt( "Settings", "eTOTMotor_23", 1000, profileFile ) );
    putValue( eDlcMotor_23, getProfileInt( "Settings", "eDlcMotor_23", 8, profileFile ) );

  //MR57568
    putValue( eSendMotor_36, getProfileInt( "Settings", "eSendMotor_36", 1, profileFile ) );
    putValue( eTMotor_36, getProfileInt( "Settings", "eTMotor_36", 1000, profileFile ) );
    putValue( eTOTMotor_36, getProfileInt( "Settings", "eTOTMotor_36", 5000, profileFile ) );
    putValue( eDlcMotor_36, getProfileInt( "Settings", "eDlcMotor_36", 8, profileFile ) );

  //MR 63119
    putValue( eSendGateway_71, getProfileInt( "Settings", "eSendGateway_71", 1, profileFile ) );
    putValue( eTGateway_71, getProfileInt( "Settings", "eTGateway_71", 500, profileFile ) );
    putValue( eTOTGateway_71, getProfileInt( "Settings", "eTOTGateway_71", 5000, profileFile ) );
    putValue( eDlcGateway_71, getProfileInt( "Settings", "eDlcGateway_71", 8, profileFile ) );

    putValue( eSendMotor_29, getProfileInt( "Settings", "eSendMotor_29", 1, profileFile ) );
    putValue( eTMotor_29, getProfileInt( "Settings", "eTMotor_29", 500, profileFile ) );
    putValue( eTOTMotor_29, getProfileInt( "Settings", "eTOTMotor_29", 5000, profileFile ) );
    putValue( eDlcMotor_29, getProfileInt( "Settings", "eDlcMotor_29", 8, profileFile ) );

   //MR 70392
    putValue( eSendLSH_02, getProfileInt( "Settings", "eSendLSH_02", 1, profileFile ) );
    putValue( eTLSH_02, getProfileInt( "Settings", "eTLSH_02", 200, profileFile ) );
    putValue( eTOTLSH_02, getProfileInt( "Settings", "eTOTLSH_02", 2000, profileFile ) );
    putValue( eDlcLSH_02, getProfileInt( "Settings", "eDlcLSH_02", 8, profileFile ) );

  //MR 73103
    putValue( eSendBMS_05, getProfileInt( "Settings", "eSendBMS_05", 1, profileFile ) );
    putValue( eTBMS_05, getProfileInt( "Settings", "eTBMS_05", 50, profileFile ) );
    putValue( eTOTBMS_05, getProfileInt( "Settings", "eTOTBMS_05", 500, profileFile ) );
    putValue( eDlcBMS_05, getProfileInt( "Settings", "eDlcBMS_05", 8, profileFile ) );

  //MR 73103
    putValue( eSendMotor_25, getProfileInt( "Settings", "eSendMotor_25", 1, profileFile ) );
    putValue( eTMotor_25, getProfileInt( "Settings", "eTMotor_25", 500, profileFile ) );
    putValue( eTOTMotor_25, getProfileInt( "Settings", "eTOTMotor_25", 5000, profileFile ) );
    putValue( eDlcMotor_25, getProfileInt( "Settings", "eDlcMotor_25", 8, profileFile ) );

  //MR 73103
    putValue( eSendMotor_41, getProfileInt( "Settings", "eSendMotor_41", 1, profileFile ) );
    putValue( eTMotor_41, getProfileInt( "Settings", "eTMotor_41", 500, profileFile ) );
    putValue( eTOTMotor_41, getProfileInt( "Settings", "eTOTMotor_41", 5000, profileFile ) );
    putValue( eDlcMotor_41, getProfileInt( "Settings", "eDlcMotor_41", 8, profileFile ) );

  //MR 73649
    putValue( eSendTM_01, getProfileInt( "Settings", "eSendTM_01", 1, profileFile ) );
    putValue( eTTM_01, getProfileInt( "Settings", "eTTM_01", 1000, profileFile ) );
    putValue( eTOTTM_01, getProfileInt( "Settings", "eTOTTM_01", 5000, profileFile ) );
    putValue( eDlcTM_01, getProfileInt( "Settings", "eDlcTM_01", 8, profileFile ) );

  //MR 75590
    putValue( eSendBCM_04, getProfileInt( "Settings", "eSendBCM_04", 1, profileFile ) );
    putValue( eTBCM_04, getProfileInt( "Settings", "eTBCM_04", 200, profileFile ) );
    putValue( eTOTBCM_04, getProfileInt( "Settings", "eTOTBCM_04", 2000, profileFile ) );
    putValue( eDlcBCM_04, getProfileInt( "Settings", "eDlcBCM_04", 8, profileFile ) );

  //MR 77431
    putValue( eSendMotor_31, getProfileInt( "Settings", "eSendMotor_31", 1, profileFile ) );
    putValue( eTMotor_31, getProfileInt( "Settings", "eTMotor_31", 1000, profileFile ) );
    putValue( eTOTMotor_31, getProfileInt( "Settings", "eTOTMotor_31", 5000, profileFile ) );
    putValue( eDlcMotor_31, getProfileInt( "Settings", "eDlcMotor_31", 8, profileFile ) );

  //MR 77431
    putValue( eSendASTA_Sensor_01, getProfileInt( "Settings", "eSendASTA_Sensor_01", 1, profileFile ) );
    putValue( eTASTA_Sensor_01, getProfileInt( "Settings", "eTASTA_Sensor_01", 500, profileFile ) );
    putValue( eTOTASTA_Sensor_01, getProfileInt( "Settings", "eTOTASTA_Sensor_01", 5000, profileFile ) );
    putValue( eDlcASTA_Sensor_01, getProfileInt( "Settings", "eDlcASTA_Sensor_01", 8, profileFile ) );

  //EPB_03
    putValue( eSendEPB_03, getProfileInt( "Settings", "eSendEPB_03", 1, profileFile ) );
    putValue( eTEPB_03, getProfileInt( "Settings", "eTEPB_03", 200, profileFile ) );
    putValue( eTOTEPB_03, getProfileInt( "Settings", "eTOTEPB_03", 2000, profileFile ) );
    putValue( eDlcEPB_03, getProfileInt( "Settings", "eDlcEPB_03", 8, profileFile ) );
    putValue( eCrcEPB_03, getProfileInt( "Settings", "eCrcEPB_03", 1, profileFile ) );
    putValue( eBZEPB_03, getProfileInt( "Settings", "eBZEPB_03", 1, profileFile ) );
    putValue( eBZStepEPB_03, getProfileInt( "Settings", "eBZStepEPB_03", 1, profileFile ) );

  //NMH_STSG_HBFS
    putValue( eSendNMH_STSG_HBFS, getProfileInt( "Settings", "eSendNMH_STSG_HBFS", 0, profileFile ) );
    putValue( eTNMH_STSG_HBFS, getProfileInt( "Settings", "eTNMH_STSG_HBFS", 200, profileFile ) );
    putValue( eTOTNMH_STSG_HBFS, getProfileInt( "Settings", "eTOTNMH_STSG_HBFS", 2000, profileFile ) );
    putValue( eDlcNMH_STSG_HBFS, getProfileInt( "Settings", "eDlcNMH_STSG_HBFS", 8, profileFile ) );

  //NMH_STSG_HFS
    putValue( eSendNMH_STSG_HFS, getProfileInt( "Settings", "eSendNMH_STSG_HFS", 0, profileFile ) );
    putValue( eTNMH_STSG_HFS, getProfileInt( "Settings", "eTNMH_STSG_HFS", 200, profileFile ) );
    putValue( eTOTNMH_STSG_HFS, getProfileInt( "Settings", "eTOTNMH_STSG_HFS", 2000, profileFile ) );
    putValue( eDlcNMH_STSG_HFS, getProfileInt( "Settings", "eDlcNMH_STSG_HFS", 8, profileFile ) );

  //OBDC_Funktionaler_Req_All
    putValue( eSendOBDC_Funktionaler_Req_All, getProfileInt( "Settings", "eSendOBDC_Funktionaler_Req_All", 0, profileFile ) );
    putValue( eTOBDC_Funktionaler_Req_All, getProfileInt( "Settings", "eTOBDC_Funktionaler_Req_All", 200, profileFile ) );
    putValue( eTOTOBDC_Funktionaler_Req_All, getProfileInt( "Settings", "eTOTOBDC_Funktionaler_Req_All", 2000, profileFile ) );
    putValue( eDlcOBDC_Funktionaler_Req_All, getProfileInt( "Settings", "eDlcOBDC_Funktionaler_Req_All", 8, profileFile ) );

  //WFS_Transponder_Req_02
    putValue( eSendWFS_Transponder_Req_02, getProfileInt( "Settings", "eSendWFS_Transponder_Req_02", 0, profileFile ) );
    putValue( eTWFS_Transponder_Req_02, getProfileInt( "Settings", "eTWFS_Transponder_Req_02", 200, profileFile ) );
    putValue( eTOTWFS_Transponder_Req_02, getProfileInt( "Settings", "eTOTWFS_Transponder_Req_02", 2000, profileFile ) );
    putValue( eDlcWFS_Transponder_Req_02, getProfileInt( "Settings", "eDlcWFS_Transponder_Req_02", 8, profileFile ) );

    putValue( eSendNavPos_01, getProfileInt( "Settings", "eSendNavPos_01", 1, profileFile ) );
    putValue( eTNavPos_01, getProfileInt( "Settings", "eTNavPos_01", 200, profileFile ) );
    putValue( eTOTNavPos_01, getProfileInt( "Settings", "eTOTNavPos_01", 2000, profileFile ) );
    putValue( eDlcNavPos_01, getProfileInt( "Settings", "eDlcNavPos_01", 8, profileFile ) );
    putValue( eSendWFS_01, getProfileInt( "Settings", "eSendWFS_01", 1, profileFile ) );
    putValue( eTWFS_01, getProfileInt( "Settings", "eTWFS_01", 200, profileFile ) );
    putValue( eTOTWFS_01, getProfileInt( "Settings", "eTOTWFS_01", 2000, profileFile ) );
    putValue( eDlcWFS_01, getProfileInt( "Settings", "eDlcWFS_01", 8, profileFile ) );
    putValue( eSendTA_01, getProfileInt( "Settings", "eSendTA_01", 1, profileFile ) );
    putValue( eTTA_01, getProfileInt( "Settings", "eTTA_01", 100, profileFile ) );
    putValue( eTOTTA_01, getProfileInt( "Settings", "eTOTTA_01", 1000, profileFile ) );
    putValue( eDlcTA_01, getProfileInt( "Settings", "eDlcTA_01", 8, profileFile ) );

    putValue( eKL_LRH_StufeS, getProfileInt( "Settings", "eKL_LRH_StufeS", 1, profileFile ) );
    putValue( eNP_LatDirectionS, getProfileInt( "Settings", "eNP_LatDirectionS", 1, profileFile ) );
    putValue( eNP_LongDirectionS, getProfileInt( "Settings", "eNP_LongDirectionS", 1, profileFile ) );
    putValue( eNP_LatDegreeS, getProfileInt( "Settings", "eNP_LatDegreeS", 134.217726, profileFile ) );
    putValue( eNP_LongDegreeS, getProfileInt( "Settings", "eNP_LongDegreeS", 268.435454, profileFile ) );
    putValue( eACC_Wunschgeschw_02S, getProfileInt( "Settings", "eACC_Wunschgeschw_02S", 327.36, profileFile ) );
    putValue( eACC_Abstand_AbstandswarnerS, getProfileInt( "Settings", "eACC_Abstand_AbstandswarnerS", 511, profileFile ) );
    putValue( eACC_Zeitluecke_AbstandswarnerS, getProfileInt( "Settings", "eACC_Zeitluecke_AbstandswarnerS", 6.3, profileFile ) );
    putValue( eAB_SBR_hinten_verbauS, getProfileInt( "Settings", "eAB_SBR_hinten_verbauS", 3, profileFile ) );
    putValue( eMO_Anzeige_RekuperationS, getProfileInt( "Settings", "eMO_Anzeige_RekuperationS", -0.5, profileFile ) );

    putValue( eSendBCM_03, getProfileInt( "Settings", "eSendBCM_03", 1, profileFile ) );

    putValue( eSendBEM_06, getProfileInt( "Settings", "eSendBEM_06", 1, profileFile ) );
    putValue( eTBEM_06, getProfileInt( "Settings", "eTBEM_06", 100, profileFile ) );
    putValue( eTOTBEM_06, getProfileInt( "Settings", "eTOTBEM_06", 1000, profileFile ) );
    putValue( eDlcBEM_06, getProfileInt( "Settings", "eDlcBEM_06", 8, profileFile ) );
    putValue( eCrcBEM_06, getProfileInt( "Settings", "eCrcBEM_06", 1, profileFile ) );
    putValue( eBZBEM_06, getProfileInt( "Settings", "eBZBEM_06", 1, profileFile ) );
    putValue( eBZStepBEM_06, getProfileInt( "Settings", "eBZStepBEM_06", 1, profileFile ) );

    putValue( eSendGateway_77, getProfileInt( "Settings", "eSendGateway_77", 1, profileFile ) );
    putValue( eTGateway_77, getProfileInt( "Settings", "eTGateway_77", 200, profileFile ) );
    putValue( eTOTGateway_77, getProfileInt( "Settings", "eTOTGateway_77", 2000, profileFile ) );
    putValue( eDlcGateway_77, getProfileInt( "Settings", "eDlcGateway_77", 8, profileFile ) );

    putValue( eSendGNSS_02, getProfileInt( "Settings", "eSendGNSS_02", 1, profileFile ) );
    putValue( eTGNSS_02, getProfileInt( "Settings", "eTGNSS_02", 1000, profileFile ) );
    putValue( eTOTGNSS_02, getProfileInt( "Settings", "eTOTGNSS_02", 5000, profileFile ) );
    putValue( eDlcGNSS_02, getProfileInt( "Settings", "eDlcGNSS_02", 8, profileFile ) );

    putValue( eSendGNSS_03, getProfileInt( "Settings", "eSendGNSS_03", 1, profileFile ) );
    putValue( eTGNSS_03, getProfileInt( "Settings", "eTGNSS_03", 1000, profileFile ) );
    putValue( eTOTGNSS_03, getProfileInt( "Settings", "eTOTGNSS_03", 5000, profileFile ) );
    putValue( eDlcGNSS_03, getProfileInt( "Settings", "eDlcGNSS_03", 8, profileFile ) );

    putValue( eSendGNSS_05, getProfileInt( "Settings", "eSendGNSS_05", 1, profileFile ) );
    putValue( eTGNSS_05, getProfileInt( "Settings", "eTGNSS_05", 1000, profileFile ) );
    putValue( eTOTGNSS_05, getProfileInt( "Settings", "eTOTGNSS_05", 5000, profileFile ) );
    putValue( eDlcGNSS_05, getProfileInt( "Settings", "eDlcGNSS_05", 8, profileFile ) );
  
    putValue( eSendHUD_01, getProfileInt( "Settings", "eSendHUD_01", 1, profileFile ) );
    putValue( eTHUD_01, getProfileInt( "Settings", "eTHUD_01", 1000, profileFile ) );
    putValue( eTOTHUD_01, getProfileInt( "Settings", "eTOTHUD_01", 5000, profileFile ) );
    putValue( eDlcHUD_01, getProfileInt( "Settings", "eDlcHUD_01", 8, profileFile ) );

    putValue( eSendMVK_01, getProfileInt( "Settings", "eSendMVK_01", 1, profileFile ) );
    putValue( eTMVK_01, getProfileInt( "Settings", "eTMVK_01", 100, profileFile ) );
    putValue( eTOTMVK_01, getProfileInt( "Settings", "eTOTMVK_01", 1000, profileFile ) );
    putValue( eDlcMVK_01, getProfileInt( "Settings", "eDlcMVK_01", 8, profileFile ) );

    putValue( eSendHVK_01, getProfileInt( "Settings", "eSendHVK_01", 1, profileFile ) );
    putValue( eTHVK_01, getProfileInt( "Settings", "eTHVK_01", 100, profileFile ) );
    putValue( eTOTHVK_01, getProfileInt( "Settings", "eTOTHVK_01", 1000, profileFile ) );
    putValue( eDlcHVK_01, getProfileInt( "Settings", "eDlcHVK_01", 8, profileFile ) );

    putValue( eSendZentralrechner_03, getProfileInt( "Settings", "eSendZentralrechner_03", 1, profileFile ) );
    putValue( eTZentralrechner_03, getProfileInt( "Settings", "eTZentralrechner_03", 1000, profileFile ) );
    putValue( eTOTZentralrechner_03, getProfileInt( "Settings", "eTOTZentralrechner_03", 5000, profileFile ) );
    putValue( eDlcZentralrechner_03, getProfileInt( "Settings", "eDlcZentralrechner_03", 8, profileFile ) );

    putValue( eSendParkhilfe_04, getProfileInt( "Settings", "eSendParkhilfe_04", 1, profileFile ) );
    putValue( eTParkhilfe_04, getProfileInt( "Settings", "eTParkhilfe_04", 500, profileFile ) );
    putValue( eTOTParkhilfe_04, getProfileInt( "Settings", "eTOTParkhilfe_04", 5000, profileFile ) );
    putValue( eDlcParkhilfe_04, getProfileInt( "Settings", "eDlcParkhilfe_04", 8, profileFile ) );

    putValue( eSendLoGeWa_03, getProfileInt( "Settings", "eSendLoGeWa_03", 1, profileFile ) );
    putValue( eTLoGeWa_03, getProfileInt( "Settings", "eTLoGeWa_03", 200, profileFile ) );
    putValue( eTOTLoGeWa_03, getProfileInt( "Settings", "eTOTLoGeWa_03", 2000, profileFile ) );
    putValue( eDlcLoGeWa_03, getProfileInt( "Settings", "eDlcLoGeWa_03", 8, profileFile ) );

    putValue( eSendMVK_01, getProfileInt( "Settings", "eSendMVK_01", 1, profileFile ) );
	putValue( eTMVK_01, getProfileInt( "Settings", "eTMVK_01", 50, profileFile ) );
	putValue( eTOTMVK_01, getProfileInt( "Settings", "eTOTMVK_01", 500, profileFile ) );
	putValue( eDlcMVK_01, getProfileInt( "Settings", "eDlcMVK_01", 8, profileFile ) );
	putValue( eCrcMVK_01, 1 ); //getProfileInt( "Settings", "eCrcMVK_01", 1, profileFile ) );
	putValue( eBZMVK_01, getProfileInt( "Settings", "eBZMVK_01", 1, profileFile ) );
	putValue( eBZStepMVK_01, getProfileInt( "Settings", "eBZStepMVK_01", 1, profileFile ) );
  
    putValue( eSendWBA_03, getProfileInt( "Settings", "eSendWBA_03", 1, profileFile ) );
	putValue( eTWBA_03, getProfileInt( "Settings", "eTWBA_03", 50, profileFile ) );
	putValue( eTOTWBA_03, getProfileInt( "Settings", "eTOTWBA_03", 500, profileFile ) );

    putValue( eKL_LRH_StufeS, 1);
    putValue( eNP_LatDirectionS, 1);
    putValue( eNP_LongDirectionS, 1);
    putValue( eNP_LatDegreeS, 134.217726);
    putValue( eNP_LongDegreeS, 268.435454);
    putValue( eACC_Wunschgeschw_02S, 327.36);
    putValue( eACC_Abstand_AbstandswarnerS, 511);
    putValue( eACC_Zeitluecke_AbstandswarnerS, 6.3);
    putValue( eAB_SBR_hinten_verbauS, 3);
    putValue( eMO_Anzeige_RekuperationS, -0.5);

    //GVJ-5409
    putValue( eSendDCDC_02, getProfileInt( "Settings", "eSendDCDC_02", 1, profileFile ) );
    putValue( eTDCDC_02, getProfileInt( "Settings", "eTDCDC_02", 50, profileFile ) );
    putValue( eTOTDCDC_02, getProfileInt( "Settings", "eTOTDCDC_02", 500, profileFile ) );
    putValue( eDlcDCDC_02, getProfileInt( "Settings", "eDlcDCDC_02", 8, profileFile ) );

    //GVJ-5409
    putValue( eSendEM1_HYB_13, getProfileInt( "Settings", "eSendEM1_HYB_13", 1, profileFile ) );
    putValue( eTEM1_HYB_13, getProfileInt( "Settings", "eTEM1_HYB_13", 500, profileFile ) );
    putValue( eTOTEM1_HYB_13, getProfileInt( "Settings", "eTOTEM1_HYB_13", 5000, profileFile ) );
    putValue( eDlcEM1_HYB_13, getProfileInt( "Settings", "eDlcEM1_HYB_13", 8, profileFile ) );

    //GVJ-5409
    putValue( eSendHVEM_04, getProfileInt( "Settings", "eSendHVEM_04", 1, profileFile ) );
    putValue( eTHVEM_04, getProfileInt( "Settings", "eTHVEM_04", 500, profileFile ) );
    putValue( eTOTHVEM_04, getProfileInt( "Settings", "eTOTHVEM_04", 5000, profileFile ) );
    putValue( eDlcHVEM_04, getProfileInt( "Settings", "eDlcHVEM_04", 8, profileFile ) );

    //GVJ-5409
    putValue( eSendMotor_EV_01, getProfileInt( "Settings", "eSendMotor_EV_01", 1, profileFile ) );
    putValue( eTMotor_EV_01, getProfileInt( "Settings", "eTMotor_EV_01", 100, profileFile ) );
    putValue( eTOTMotor_EV_01, getProfileInt( "Settings", "eTOTMotor_EV_01", 1000, profileFile ) );
    putValue( eDlcMotor_EV_01, getProfileInt( "Settings", "eDlcMotor_EV_01", 8, profileFile ) );

    //GVJ-5409
    putValue( eSendMotor_EV_03, getProfileInt( "Settings", "eSendMotor_EV_03", 1, profileFile ) );
    putValue( eTMotor_EV_03, getProfileInt( "Settings", "eTMotor_EV_03", 50, profileFile ) );
    putValue( eTOTMotor_EV_03, getProfileInt( "Settings", "eTOTMotor_EV_03", 500, profileFile ) );
    putValue( eDlcMotor_EV_03, getProfileInt( "Settings", "eDlcMotor_EV_03", 8, profileFile ) );

    //GVJ-5409
    putValue( eSendMotor_Hybrid_03, getProfileInt( "Settings", "eSendMotor_Hybrid_03", 1, profileFile ) );
    putValue( eTMotor_Hybrid_03, getProfileInt( "Settings", "eTMotor_Hybrid_03", 20, profileFile ) );
    putValue( eTOTMotor_Hybrid_03, getProfileInt( "Settings", "eTOTMotor_Hybrid_03", 200, profileFile ) );
    putValue( eDlcMotor_Hybrid_03, getProfileInt( "Settings", "eDlcMotor_Hybrid_03", 8, profileFile ) );

    //GVJ-5409
    putValue( eSendMotor_Hybrid_06, getProfileInt( "Settings", "eSendMotor_Hybrid_06", 1, profileFile ) );
    putValue( eTMotor_Hybrid_06, getProfileInt( "Settings", "eTMotor_Hybrid_06", 500, profileFile ) );
    putValue( eTOTMotor_Hybrid_06, getProfileInt( "Settings", "eTOTMotor_Hybrid_06", 5000, profileFile ) );
    putValue( eDlcMotor_Hybrid_06, getProfileInt( "Settings", "eDlcMotor_Hybrid_06", 8, profileFile ) );

    //GVJ-5409
    putValue( eSendPreCrash_02, getProfileInt( "Settings", "eSendPreCrash_02", 1, profileFile ) );
    putValue( eTPreCrash_02, getProfileInt( "Settings", "eTPreCrash_02", 200, profileFile ) );
    putValue( eTOTPreCrash_02, getProfileInt( "Settings", "eTOTPreCrash_02", 2000, profileFile ) );
    putValue( eDlcPreCrash_02, getProfileInt( "Settings", "eDlcPreCrash_02", 8, profileFile ) );

    //GVJ-5409
    putValue( eSendSOK_NoAuthenticTime_01, getProfileInt( "Settings", "eSendSOK_NoAuthenticTime_01", 1, profileFile ) );
    putValue( eTSOK_NoAuthenticTime_01, getProfileInt( "Settings", "eTSOK_NoAuthenticTime_01", 1000, profileFile ) );
    putValue( eTOTSOK_NoAuthenticTime_01, getProfileInt( "Settings", "eTOTSOK_NoAuthenticTime_01", 5000, profileFile ) );
    putValue( eDlcSOK_NoAuthenticTime_01, getProfileInt( "Settings", "eDlcSOK_NoAuthenticTime_01", 8, profileFile ) );

    //GVJ-5409
    putValue( eSendWaehlhebel_05, getProfileInt( "Settings", "eSendWaehlhebel_05", 1, profileFile ) );
    putValue( eTWaehlhebel_05, getProfileInt( "Settings", "eTWaehlhebel_05", 1000, profileFile ) );
    putValue( eTOTWaehlhebel_05, getProfileInt( "Settings", "eTOTWaehlhebel_05", 5000, profileFile ) );
    putValue( eDlcWaehlhebel_05, getProfileInt( "Settings", "eDlcWaehlhebel_05", 8, profileFile ) );

    //GVJ-5409
    putValue( eSendAZK_01, getProfileInt( "Settings", "eSendAZK_01", 1, profileFile ) );
    putValue( eTAZK_01, getProfileInt( "Settings", "eTAZK_01", 1000, profileFile ) );
    putValue( eTOTAZK_01, getProfileInt( "Settings", "eTOTAZK_01", 5000, profileFile ) );
    putValue( eDlcAZK_01, getProfileInt( "Settings", "eDlcAZK_01", 8, profileFile ) );

    putValue( eMo_Powermeter_GrenzeS, getProfileInt( "Settings", "eMo_Powermeter_GrenzeS", 4093, profileFile ) );
    putValue( eMO_Powermeter_Charge_GrenzeS, getProfileInt( "Settings", "eMO_Powermeter_Charge_GrenzeS", 1022, profileFile ) );
    putValue( eMO_Powermeter_Grenze_strategischS, getProfileInt( "Settings", "eMO_Powermeter_Grenze_strategischS", 4094, profileFile ) );
    putValue( eMO_Powermeter_untere_E_GrenzeS, getProfileInt( "Settings", "eMO_Powermeter_untere_E_GrenzeS", 4094, profileFile ) );
    putValue( eMO_Powermeter_obere_E_GrenzeS, getProfileInt( "Settings", "eMO_Powermeter_obere_E_GrenzeS", 4094, profileFile ) );

    putValue( eMO_ePowermeterS, getProfileInt( "Settings", "eMO_ePowermeterS", -0.4, profileFile ) );
    putValue( eMO_ePerformanceS, getProfileInt( "Settings", "eMO_ePerformanceS", -0.4, profileFile ) );
    putValue( eMO_Zust_AntriebS, getProfileInt( "Settings", "eMO_Zust_AntriebS", 0, profileFile ) );
    putValue( eLadezustand_02S, getProfileInt( "Settings", "eLadezustand_02S", 127, profileFile ) );
    putValue( eMO_Powermeter_Elm_02S, getProfileInt( "Settings", "eMO_Powermeter_Elm_02S", 102.3, profileFile ) );
    putValue( eMO_PowermeterS, getProfileInt( "Settings", "eMO_PowermeterS", 4093, profileFile ) );

    putValue( eAB_Gurtschloss_Reihe4_FAS, getProfileInt( "Settings", "eAB_Gurtschloss_Reihe4_FAS", 1, profileFile ) );
    putValue( eAB_Gurtschloss_Reihe4_BFS, getProfileInt( "Settings", "eAB_Gurtschloss_Reihe4_BFS", 1, profileFile ) );
    putValue( eAB_Gurtschloss_Reihe4_MIS, getProfileInt( "Settings", "eAB_Gurtschloss_Reihe4_MIS", 1, profileFile ) );
    putValue( eESP_07_altS, getProfileInt( "Settings", "eESP_07_altS", 1, profileFile ) );
}

loadOthers( char profileFile[] )
{
 //Loading
    putValue( eRPMSweep,  getProfileInt( "Sweeps", "eRPMSweep",      0, profileFile ) );
    putValue( eRPMRandom, getProfileInt( "Sweeps", "eRPMRandom",     0, profileFile ) );
    putValue( eRPMStart,  getProfileInt( "Sweeps", "eRPMStart",      0, profileFile ) );
    putValue( eRPMEnd,    getProfileInt( "Sweeps", "eRPMEnd",    320, profileFile ) );
    putValue( eRPMSteps,  getProfileInt( "Sweeps", "eRPMSteps",     10, profileFile ) );
    putValue( eRPMTime,   getProfileInt( "Sweeps", "eRPMTime",     250, profileFile ) );

    putValue( eSpeedInputIsMetric, 1 );
    putValue( eSpeedInputIsMetric, getProfileInt(   "Sweeps", "eSpeedInputIsMetric",     1, profileFile ) );
    putValue( eSpeed,              getProfileFloat( "Sweeps", "eSpeed",                100, profileFile ) );

    putValue( eSpeedPulseCorrelation, getProfileInt(   "Sweeps", "eSpeedPulseCorrelation",  1, profileFile ) );
    putValue( eSpeedSingleSteps,      getProfileInt(   "Sweeps", "eSpeedSingleSteps",       0, profileFile ) );
    putValue( eSpeedSweep,            getProfileInt(   "Sweeps", "eSpeedSweep",             0, profileFile ) );
    putValue( eSpeedRandom,           getProfileInt(   "Sweeps", "eSpeedRandom",            0, profileFile ) );
    putValue( eSpeedStart,            getProfileFloat( "Sweeps", "eSpeedStart",             0, profileFile ) );
    putValue( eSpeedEnd,              getProfileFloat( "Sweeps", "eSpeedEnd",             320, profileFile ) );
    putValue( eSpeedSteps,            getProfileInt(   "Sweeps", "eSpeedSteps",            20, profileFile ) );
    putValue( eSpeedTime,             getProfileInt(   "Sweeps", "eSpeedTime",            250, profileFile ) );
    putValue( eSpeedPulsesInput,      getProfileInt(   "Sweeps", "eSpeedPulsesInput",      10, profileFile ) );
    putValue( eSpeedDistanceInput,    getProfileFloat( "Sweeps", "eSpeedDistanceInput",     1, profileFile ) );

    putValue( eWheelCircumferenceMax,      getProfileInt(   "Sweeps", "eWheelCircumferenceMax",      2036, profileFile ) );
    putValue( eWheelCircumferenceAvg,      getProfileInt(   "Sweeps", "eWheelCircumferenceAvg",      1950, profileFile ) );
    putValue( ePulsesPerHalfWheelRotation, getProfileInt(   "Sweeps", "ePulsesPerHalfWheelRotation",   20, profileFile ) );

    putValue( eSpeedPulses,       0 );
    putValue( eDistancePulseAccu, 0 );

    putValue( eConsumption,                getProfileFloat( "Sweeps", "eConsumption",                   1, profileFile ) );
    putValue( eGasConsumption,             getProfileFloat( "Sweeps", "eGasConsumption",                1, profileFile ) );

    putValue( eNMHStateMachineEnabled, getProfileInt( "NMHigh", "eNMHStateMachineEnabled", 1, profileFile ) );
    putValue( eNMHControllerNodeAwake, getProfileInt( "NMHigh", "eNMHControllerNodeAwake", 1, profileFile ) );

    putValue( eCalculateKl58d,         getProfileInt( "Dimming", "eCalculateKl58d",        1, profileFile ) );

    putValue( eIndicatorOnTime,        getProfileInt( "Indicator", "eIndicatorOnTime",   400, profileFile ) );
    putValue( eIndicatorOffTime,       getProfileInt( "Indicator", "eIndicatorOffTime",  300, profileFile ) );

    putValue( eSendMfl,                getProfileInt( "MFL",       "eSendMfl",             1, profileFile ) );

    putValue( eCase_SpeedRPM,             getProfileInt(  "Sweeps", "eCase_SpeedRPM",       1,  profileFile ) );
    putValue( eRPMSpeedTestTimer,         getProfileInt(  "Sweeps", "eRPMSpeedTestTimer",   10,  profileFile ) );

}

loadOthers2( char profileFile[] )
{
     putValue( eStartup_AAG, getProfileInt( "Settings", "eStartup_AAG", 1, profileFile ));
     putValue( eStartup_ACC, getProfileInt( "Settings", "eStartup_ACC", 1, profileFile ));
     putValue( eStartup_Airbag, getProfileInt( "Settings", "eStartup_Airbag", 1, profileFile ));
     putValue( eStartup_BCM1, getProfileInt( "Settings", "eStartup_BCM1", 1, profileFile ));
     putValue( eStartup_BFS, getProfileInt( "Settings", "eStartup_BFS", 1, profileFile ));
     putValue( eStartup_Bremse, getProfileInt( "Settings", "eStartup_Bremse", 1, profileFile ));
     putValue( eStartup_Daempfer, getProfileInt( "Settings", "eStartup_Daempfer", 1, profileFile ));
     putValue( eStartup_ELV, getProfileInt( "Settings", "eStartup_ELV", 1, profileFile ));
     putValue( eStartup_EPB, getProfileInt( "Settings", "eStartup_EPB", 1, profileFile ));
     putValue( eStartup_EPS, getProfileInt( "Settings", "eStartup_EPS", 1, profileFile ));
     putValue( eStartup_FS, getProfileInt( "Settings", "eStartup_FS", 1, profileFile ));
     putValue( eStartup_Gateway, getProfileInt( "Settings", "eStartup_Gateway", 1, profileFile ));
     putValue( eStartup_Kessy, getProfileInt( "Settings", "eStartup_Kessy", 1, profileFile ));
     putValue( eStartup_LDW, getProfileInt( "Settings", "eStartup_LDW", 1, profileFile ));
     putValue( eStartup_LWR_AFS, getProfileInt( "Settings", "eStartup_LWR_AFS", 1, profileFile ));
     putValue( eStartup_MFG, getProfileInt( "Settings", "eStartup_MFG", 1, profileFile ));
     putValue( eStartup_Motor, getProfileInt( "Settings", "eStartup_Motor", 1, profileFile ));
     putValue( eStartup_PLA, getProfileInt( "Settings", "eStartup_PLA", 1, profileFile ));
     putValue( eStartup_RDK, getProfileInt( "Settings", "eStartup_RDK", 1, profileFile ));
     putValue( eStartup_RKA, getProfileInt( "Settings", "eStartup_RKA", 1, profileFile ));
     putValue( eStartup_SMLS, getProfileInt( "Settings", "eStartup_SMLS", 1, profileFile ));
     putValue( eStartup_STS, getProfileInt( "Settings", "eStartup_STS", 1, profileFile ));
     putValue( eStartup_SWA, getProfileInt( "Settings", "eStartup_SWA", 1, profileFile ));
     putValue( eStartup_TCO, getProfileInt( "Settings", "eStartup_TCO", 1, profileFile ));
     putValue( eStartup_TSG_FT, getProfileInt( "Settings", "eStartup_TSG_FT", 1, profileFile ));
     putValue( eStartup_WBA, getProfileInt( "Settings", "eStartup_WBA", 1, profileFile ));
     putValue( eStartup_HVEM, getProfileInt( "Settings", "eStartup_HVEM", 1, profileFile ));
     putValue( eStartup_HVLM, getProfileInt( "Settings", "eStartup_HVLM", 1, profileFile ));
     putValue( eStartup_Kombi, getProfileInt( "Settings", "eStartup_Kombi", 1, profileFile ));
     putValue( eStartup_Reichweite, getProfileInt( "Settings", "eStartup_Reichweite", 1, profileFile ));


     putValue( eFunctionAAG, getProfileInt( "Settings", "eFunctionAAG", 1, profileFile ));
     putValue( eFunctionACC, getProfileInt( "Settings", "eFunctionACC", 1, profileFile ));
     putValue( eFunctionAirbag, getProfileInt( "Settings", "eFunctionAirbag", 1, profileFile ));
     putValue( eFunctionBCM1, getProfileInt( "Settings", "eFunctionBCM1", 1, profileFile ));
     putValue( eFunctionBFS, getProfileInt( "Settings", "eFunctionBFS", 1, profileFile ));
     putValue( eFunctionBremse, getProfileInt( "Settings", "eFunctionBremse", 1, profileFile ));
     putValue( eFunctionDaempfer, getProfileInt( "Settings", "eFunctionDaempfer", 1, profileFile ));
     putValue( eFunctionELV, getProfileInt( "Settings", "eFunctionELV", 1, profileFile ));
     putValue( eFunctionEPB, getProfileInt( "Settings", "eFunctionEPB", 1, profileFile ));
     putValue( eFunctionEPS, getProfileInt( "Settings", "eFunctionEPS", 1, profileFile ));
     putValue( eFunctionFS, getProfileInt( "Settings", "eFunctionFS", 1, profileFile ));
     putValue( eFunctionGateway, getProfileInt( "Settings", "eFunctionGateway", 1, profileFile ));
     putValue( eFunctionKessy, getProfileInt( "Settings", "eFunctionKessy", 1, profileFile ));
     putValue( eFunctionLDW, getProfileInt( "Settings", "eFunctionLDW", 1, profileFile ));
     putValue( eFunctionLWR_AFS, getProfileInt( "Settings", "eFunctionLWR_AFS", 1, profileFile ));
     putValue( eFunctionMFG, getProfileInt( "Settings", "eFunctionMFG", 1, profileFile ));
     putValue( eFunctionMotor, getProfileInt( "Settings", "eFunctionMotor", 1, profileFile ));
     putValue( eFunctionPLA, getProfileInt( "Settings", "eFunctionPLA", 1, profileFile ));
     putValue( eFunctionRDK, getProfileInt( "Settings", "eFunctionRDK", 1, profileFile ));
     putValue( eFunctionRKA, getProfileInt( "Settings", "eFunctionRKA", 1, profileFile ));
     putValue( eFunctionSMLS, getProfileInt( "Settings", "eFunctionSMLS", 1, profileFile ));
     putValue( eFunctionSTS, getProfileInt( "Settings", "eFunctionSTS", 1, profileFile ));
     putValue( eFunctionSWA, getProfileInt( "Settings", "eFunctionSWA", 1, profileFile ));
     putValue( eFunctionTCO, getProfileInt( "Settings", "eFunctionTCO", 1, profileFile ));
     putValue( eFunctionTSG_FT, getProfileInt( "Settings", "eFunctionTSG_FT", 1, profileFile ));
     putValue( eFunctionWBA, getProfileInt( "Settings", "eFunctionWBA", 1, profileFile ));
}

loadAddtlEnVars ( char profileFile[] )
{
    putValue( eACC_Typ_Tachokranz_untenS ,getProfileInt( "Settings","eACC_Typ_Tachokranz_unten" , 0,  profileFile));
    putValue( eAGA_01_BZS ,getProfileInt( "Settings","eAGA_01_BZS" , 0,  profileFile));
    putValue( eAGA_01_BZS_ResetJumpData ,getProfileInt( "Settings","eAGA_01_BZS_ResetJumpData" , 0,  profileFile));
    putValue( eAGA_01_BZS_ResetJumpEnabled ,getProfileInt( "Settings","eAGA_01_BZS_ResetJumpEnabled" , 0,  profileFile));
    putValue( eAGA_01_BZS_SingleJumpData ,getProfileInt( "Settings","eAGA_01_BZS_SingleJumpData" , 0,  profileFile));
    putValue( eAGA_01_BZS_SingleJumpEnabled ,getProfileInt( "Settings","eAGA_01_BZS_SingleJumpEnabled" , 0,  profileFile));
    putValue( eAGA_01_CRC_FalseData ,getProfileInt( "Settings","eAGA_01_CRC_FalseData" , 0,  profileFile));
    putValue( eAGA_01_CRC_FalseEnabled ,getProfileInt( "Settings","eAGA_01_CRC_FalseEnabled" , 0,  profileFile));
    putValue( eAGA_01_NoMsgEnabled ,getProfileInt( "Settings","eAGA_01_NoMsgEnabled" , 0,  profileFile));
    putValue( eAGA_01_NoMsgEnabledData ,getProfileInt( "Settings","eAGA_01_NoMsgEnabledData" , 0,  profileFile));
    putValue( eAGA_Charisma_FahrPrS ,getProfileInt( "Settings","eAGA_Charisma_FahrPrS" , 0,  profileFile));
    putValue( eAGA_Charisma_StatusS ,getProfileInt( "Settings","eAGA_Charisma_StatusS" , 0,  profileFile));
    putValue( eAGA_ohne_FunktionS ,getProfileInt( "Settings","eAGA_ohne_FunktionS" , 0,  profileFile));
    putValue( eAllGWMessagesButton ,getProfileInt( "Settings","eAllGWMessagesButton" , 0,  profileFile));
    putValue( eAllNonGWMessagesButton ,getProfileInt( "Settings","eAllNonGWMessagesButton" , 0,  profileFile));
    putValue( eBAP_BC_ASG_02_HeaderS ,getProfileInt( "Settings","eBAP_BC_ASG_02_HeaderS" , 0,  profileFile));
    putValue( eBMS_07_BZS ,getProfileInt( "Settings","eBMS_07_BZS" , 0,  profileFile));
    putValue( eBMS_07_BZS_ResetJumpData ,getProfileInt( "Settings","eBMS_07_BZS_ResetJumpData" , 0,  profileFile));
    putValue( eBMS_07_BZS_ResetJumpEnabled ,getProfileInt( "Settings","eBMS_07_BZS_ResetJumpEnabled" , 0,  profileFile));
    putValue( eBMS_07_BZS_SingleJumpData ,getProfileInt( "Settings","eBMS_07_BZS_SingleJumpData" , 0,  profileFile));
    putValue( eBMS_07_BZS_SingleJumpEnabled ,getProfileInt( "Settings","eBMS_07_BZS_SingleJumpEnabled" , 0,  profileFile));
    putValue( eBMS_07_CRC_FalseData ,getProfileInt( "Settings","eBMS_07_CRC_FalseData" , 0,  profileFile));
    putValue( eBMS_07_CRC_FalseEnabled ,getProfileInt( "Settings","eBMS_07_CRC_FalseEnabled" , 0,  profileFile));
    putValue( eBMS_07_DummyS ,getProfileInt( "Settings","eBMS_07_DummyS" , 0,  profileFile));
    putValue( eBMS_07_NoMsgEnabled ,getProfileInt( "Settings","eBMS_07_NoMsgEnabled" , 0,  profileFile));
    putValue( eBMS_07_NoMsgEnabledData ,getProfileInt( "Settings","eBMS_07_NoMsgEnabledData" , 0,  profileFile));
    putValue( eBMS_Ausgleichsladung_AnfS ,getProfileInt( "Settings","eBMS_Ausgleichsladung_AnfS" , 0,  profileFile));
    putValue( eBMS_Gesamtst_SpgfreiheitS ,getProfileInt( "Settings","eBMS_Gesamtst_SpgfreiheitS" , 0,  profileFile));
    putValue( eBMS_MaxEnergieinhaltS ,getProfileInt( "Settings","eBMS_MaxEnergieinhaltS" , 0,  profileFile));
    putValue( eChangeAGA_01 ,getProfileInt( "Settings","eChangeAGA_01" , 0,  profileFile));
    putValue( eChangeBAP_BC_ASG_02 ,getProfileInt( "Settings","eChangeBAP_BC_ASG_02" , 0,  profileFile));
    putValue( eChangeBMS_07 ,getProfileInt( "Settings","eChangeBMS_07" , 0,  profileFile));
    putValue( eChangeHSP_01 ,getProfileInt( "Settings","eChangeHSP_01" , 0,  profileFile));
    putValue( eChangeHVLM_05 ,getProfileInt( "Settings","eChangeHVLM_05" , 0,  profileFile));
    putValue( eChangeKlemmen_Steuerung_01 ,getProfileInt( "Settings","eChangeKlemmen_Steuerung_01" , 0,  profileFile));
    putValue( eChangeMainUnit_01 ,getProfileInt( "Settings","eChangeMainUnit_01" , 0,  profileFile));
    putValue( eChangeReichweite_01 ,getProfileInt( "Settings","eChangeReichweite_01" , 0,  profileFile));
    putValue( eChangeReichweite_02 ,getProfileInt( "Settings","eChangeReichweite_02" , 0,  profileFile));
    putValue( eDlcBAP_BC_ASG_02 ,getProfileInt( "Settings","eDlcBAP_BC_ASG_02" , 0,  profileFile));
    putValue( eDlcDEV_Kombi_UD1_PC_KI_ControlD ,getProfileInt( "Settings","eDlcDEV_Kombi_UD1_PC_KI_ControlD" , 0,  profileFile));
    putValue( eDlcDEV_Kombi_UD1_PC_KI_ControlI ,getProfileInt( "Settings","eDlcDEV_Kombi_UD1_PC_KI_ControlI" , 0,  profileFile));
    putValue( eDlcKlemmen_Steuerung_01 ,getProfileInt( "Settings","eDlcKlemmen_Steuerung_01" , 0,  profileFile));
    putValue( eDlcOnceAGA_01 ,getProfileInt( "Settings","eDlcOnceAGA_01" , 0,  profileFile));
    putValue( eDlcOnceAirbag_02 ,getProfileInt( "Settings","eDlcOnceAirbag_02" , 0,  profileFile));
    putValue( eDlcOnceAnhaenger_01 ,getProfileInt( "Settings","eDlcOnceAnhaenger_01" , 0,  profileFile));
    putValue( eDlcOnceARA_Status_01 ,getProfileInt( "Settings","eDlcOnceARA_Status_01" , 0,  profileFile));
    putValue( eDlcOnceBAP_BC_ASG_02 ,getProfileInt( "Settings","eDlcOnceBAP_BC_ASG_02" , 0,  profileFile));
    putValue( eDlcOnceBCM_01 ,getProfileInt( "Settings","eDlcOnceBCM_01" , 0,  profileFile));
    putValue( eDlcOnceBEM_02 ,getProfileInt( "Settings","eDlcOnceBEM_02" , 0,  profileFile));
    putValue( eDlcOnceBlinkmodi_02 ,getProfileInt( "Settings","eDlcOnceBlinkmodi_02" , 0,  profileFile));
    putValue( eDlcOnceBMS_07 ,getProfileInt( "Settings","eDlcOnceBMS_07" , 0,  profileFile));
    putValue( eDlcOnceCharisma_03 ,getProfileInt( "Settings","eDlcOnceCharisma_03" , 0,  profileFile));
    putValue( eDlcOnceDaempfer_01 ,getProfileInt( "Settings","eDlcOnceDaempfer_01" , 0,  profileFile));
    putValue( eDlcOnceDEV_Kombi_RX1 ,getProfileInt( "Settings","eDlcOnceDEV_Kombi_RX1" , 0,  profileFile));
    putValue( eDlcOnceDEV_Kombi_SUP1 ,getProfileInt( "Settings","eDlcOnceDEV_Kombi_SUP1" , 0,  profileFile));
    putValue( eDlcOnceDEV_Kombi_SUP2 ,getProfileInt( "Settings","eDlcOnceDEV_Kombi_SUP2" , 0,  profileFile));
    putValue( eDlcOnceDEV_Kombi_SUP3 ,getProfileInt( "Settings","eDlcOnceDEV_Kombi_SUP3" , 0,  profileFile));
    putValue( eDlcOnceDEV_Kombi_UD1_PC_KI_Cont ,getProfileInt( "Settings","eDlcOnceDEV_Kombi_UD1_PC_KI_Cont" , 0,  profileFile));
    putValue( eDlcOnceDEV_Kombi_UD2_PC_KI_Data ,getProfileInt( "Settings","eDlcOnceDEV_Kombi_UD2_PC_KI_Data" , 0,  profileFile));
    putValue( eDlcOnceDiagnose_01 ,getProfileInt( "Settings","eDlcOnceDiagnose_01" , 0,  profileFile));
    putValue( eDlcOnceDimmung_01 ,getProfileInt( "Settings","eDlcOnceDimmung_01" , 0,  profileFile));
    putValue( eDlcOnceELV_01 ,getProfileInt( "Settings","eDlcOnceELV_01" , 0,  profileFile));
    putValue( eDlcOnceESP_02 ,getProfileInt( "Settings","eDlcOnceESP_02" , 0,  profileFile));
    putValue( eDlcOnceESP_20 ,getProfileInt( "Settings","eDlcOnceESP_20" , 0,  profileFile));
    putValue( eDlcOnceESP_21 ,getProfileInt( "Settings","eDlcOnceESP_21" , 0,  profileFile));
    putValue( eDlcOnceESP_24 ,getProfileInt( "Settings","eDlcOnceESP_24" , 0,  profileFile));
    putValue( eDlcOnceGateway_73 ,getProfileInt( "Settings","eDlcOnceGateway_73" , 0,  profileFile));
    putValue( eDlcOnceGateway_78 ,getProfileInt( "Settings","eDlcOnceGateway_78" , 0,  profileFile));
    putValue( eDlcOnceHSP_01 ,getProfileInt( "Settings","eDlcOnceHSP_01" , 0,  profileFile));
    putValue( eDlcOnceHVLM_05 ,getProfileInt( "Settings","eDlcOnceHVLM_05" , 0,  profileFile));
    putValue( eDlcOnceISO_Funktionaler_Req_All ,getProfileInt( "Settings","eDlcOnceISO_Funktionaler_Req_All" , 0,  profileFile));
    putValue( eDlcOnceISO_Kombi_Req ,getProfileInt( "Settings","eDlcOnceISO_Kombi_Req" , 0,  profileFile));
    putValue( eDlcOnceKessy_04 ,getProfileInt( "Settings","eDlcOnceKessy_04" , 0,  profileFile));
    putValue( eDlcOnceKlemmen_Status_01 ,getProfileInt( "Settings","eDlcOnceKlemmen_Status_01" , 0,  profileFile));
    putValue( eDlcOnceKlemmen_Steuerung_01 ,getProfileInt( "Settings","eDlcOnceKlemmen_Steuerung_01" , 0,  profileFile));
    putValue( eDlcOnceKlima_Sensor_02 ,getProfileInt( "Settings","eDlcOnceKlima_Sensor_02" , 0,  profileFile));
    putValue( eDlcOnceKS_Kombi_Req ,getProfileInt( "Settings","eDlcOnceKS_Kombi_Req" , 0,  profileFile));
    putValue( eDlcOnceLDW_02 ,getProfileInt( "Settings","eDlcOnceLDW_02" , 0,  profileFile));
    putValue( eDlcOnceLH_EPS_01 ,getProfileInt( "Settings","eDlcOnceLH_EPS_01" , 0,  profileFile));
    putValue( eDlcOnceLicht_Anf_01 ,getProfileInt( "Settings","eDlcOnceLicht_Anf_01" , 0,  profileFile));
    putValue( eDlcOnceLicht_hinten_01 ,getProfileInt( "Settings","eDlcOnceLicht_hinten_01" , 0,  profileFile));
    putValue( eDlcOnceLicht_vorne_01 ,getProfileInt( "Settings","eDlcOnceLicht_vorne_01" , 0,  profileFile));
    putValue( eDlcOnceLog_Datenlogger_Req ,getProfileInt( "Settings","eDlcOnceLog_Datenlogger_Req" , 0,  profileFile));
    putValue( eDlcOnceLog_Kombi_Req ,getProfileInt( "Settings","eDlcOnceLog_Kombi_Req" , 0,  profileFile));
    putValue( eDlcOnceLWR_AFS_01 ,getProfileInt( "Settings","eDlcOnceLWR_AFS_01" , 0,  profileFile));
    putValue( eDlcOnceMainUnit_01 ,getProfileInt( "Settings","eDlcOnceMainUnit_01" , 0,  profileFile));
    putValue( eDlcOnceMem_BFS_01 ,getProfileInt( "Settings","eDlcOnceMem_BFS_01" , 0,  profileFile));
    putValue( eDlcOnceMem_FS_01 ,getProfileInt( "Settings","eDlcOnceMem_FS_01" , 0,  profileFile));
    putValue( eDlcOnceMFG_01 ,getProfileInt( "Settings","eDlcOnceMFG_01" , 0,  profileFile));
    putValue( eDlcOnceMFL_Tasten_Kon_01 ,getProfileInt( "Settings","eDlcOnceMFL_Tasten_Kon_01" , 0,  profileFile));
    putValue( eDlcOnceMotor_04 ,getProfileInt( "Settings","eDlcOnceMotor_04" , 0,  profileFile));
    putValue( eDlcOnceMotor_07 ,getProfileInt( "Settings","eDlcOnceMotor_07" , 0,  profileFile));
    putValue( eDlcOnceMotor_09 ,getProfileInt( "Settings","eDlcOnceMotor_09" , 0,  profileFile));
    putValue( eDlcOnceMotor_14 ,getProfileInt( "Settings","eDlcOnceMotor_14" , 0,  profileFile));
    putValue( eDlcOnceMotor_18 ,getProfileInt( "Settings","eDlcOnceMotor_18" , 0,  profileFile));
    putValue( eDlcOnceMotor_26 ,getProfileInt( "Settings","eDlcOnceMotor_26" , 0,  profileFile));
    putValue( eDlcOnceMotor_Code_01 ,getProfileInt( "Settings","eDlcOnceMotor_Code_01" , 0,  profileFile));
    putValue( eDlcOnceMotor_Gas_01 ,getProfileInt( "Settings","eDlcOnceMotor_Gas_01" , 0,  profileFile));
    putValue( eDlcOnceNMH_Gateway ,getProfileInt( "Settings","eDlcOnceNMH_Gateway" , 0,  profileFile));
    putValue( eDlcOncePLA_Status_02 ,getProfileInt( "Settings","eDlcOncePLA_Status_02" , 0,  profileFile));
    putValue( eDlcOnceRDK_01 ,getProfileInt( "Settings","eDlcOnceRDK_01" , 0,  profileFile));
    putValue( eDlcOnceReichweite_01 ,getProfileInt( "Settings","eDlcOnceReichweite_01" , 0,  profileFile));
    putValue( eDlcOnceReichweite_02 ,getProfileInt( "Settings","eDlcOnceReichweite_02" , 0,  profileFile));
    putValue( eDlcOnceRKA_01 ,getProfileInt( "Settings","eDlcOnceRKA_01" , 0,  profileFile));
    putValue( eDlcOnceRLS_01 ,getProfileInt( "Settings","eDlcOnceRLS_01" , 0,  profileFile));
    putValue( eDlcOnceSMLS_01 ,getProfileInt( "Settings","eDlcOnceSMLS_01" , 0,  profileFile));
    putValue( eDlcOnceSTH_01 ,getProfileInt( "Settings","eDlcOnceSTH_01" , 0,  profileFile));
    putValue( eDlcOnceSWA_01 ,getProfileInt( "Settings","eDlcOnceSWA_01" , 0,  profileFile));
    putValue( eDlcOnceSysteminfo_01 ,getProfileInt( "Settings","eDlcOnceSysteminfo_01" , 0,  profileFile));
    putValue( eDlcOnceTCO_01 ,getProfileInt( "Settings","eDlcOnceTCO_01" , 0,  profileFile));
    putValue( eDlcOnceTimeDate ,getProfileInt( "Settings","eDlcOnceTimeDate" , 0,  profileFile));
    putValue( eDlcOnceTSG_FT_01 ,getProfileInt( "Settings","eDlcOnceTSG_FT_01" , 0,  profileFile));
    putValue( eDlcOnceTSG_FT_02 ,getProfileInt( "Settings","eDlcOnceTSG_FT_02" , 0,  profileFile));
    putValue( eDlcOnceTSK_07 ,getProfileInt( "Settings","eDlcOnceTSK_07" , 0,  profileFile));
    putValue( eDlcOnceVehiDist ,getProfileInt( "Settings","eDlcOnceVehiDist" , 0,  profileFile));
    putValue( eDlcOnceWischer_01 ,getProfileInt( "Settings","eDlcOnceWischer_01" , 0,  profileFile));
    putValue( eDlcOnceWIV_01 ,getProfileInt( "Settings","eDlcOnceWIV_01" , 0,  profileFile));
    putValue( eDlcOnceZV_02 ,getProfileInt( "Settings","eDlcOnceZV_02" , 0,  profileFile));
    putValue( eDlcWrongAGA_01 ,getProfileInt( "Settings","eDlcWrongAGA_01" , 0,  profileFile));
    putValue( eDlcWrongAirbag_02 ,getProfileInt( "Settings","eDlcWrongAirbag_02" , 0,  profileFile));
    putValue( eDlcWrongAnhaenger_01 ,getProfileInt( "Settings","eDlcWrongAnhaenger_01" , 0,  profileFile));
    putValue( eDlcWrongARA_Status_01 ,getProfileInt( "Settings","eDlcWrongARA_Status_01" , 0,  profileFile));
    putValue( eDlcWrongBAP_BC_ASG_02 ,getProfileInt( "Settings","eDlcWrongBAP_BC_ASG_02" , 0,  profileFile));
    putValue( eDlcWrongBCM_01 ,getProfileInt( "Settings","eDlcWrongBCM_01" , 0,  profileFile));
    putValue( eDlcWrongBEM_02 ,getProfileInt( "Settings","eDlcWrongBEM_02" , 0,  profileFile));
    putValue( eDlcWrongBlinkmodi_02 ,getProfileInt( "Settings","eDlcWrongBlinkmodi_02" , 0,  profileFile));
    putValue( eDlcWrongBMS_07 ,getProfileInt( "Settings","eDlcWrongBMS_07" , 0,  profileFile));
    putValue( eDlcWrongCharisma_03 ,getProfileInt( "Settings","eDlcWrongCharisma_03" , 0,  profileFile));
    putValue( eDlcWrongDaempfer_01 ,getProfileInt( "Settings","eDlcWrongDaempfer_01" , 0,  profileFile));
    putValue( eDlcWrongDEV_Kombi_RX1 ,getProfileInt( "Settings","eDlcWrongDEV_Kombi_RX1" , 0,  profileFile));
    putValue( eDlcWrongDEV_Kombi_SUP1 ,getProfileInt( "Settings","eDlcWrongDEV_Kombi_SUP1" , 0,  profileFile));
    putValue( eDlcWrongDEV_Kombi_SUP2 ,getProfileInt( "Settings","eDlcWrongDEV_Kombi_SUP2" , 0,  profileFile));
    putValue( eDlcWrongDEV_Kombi_SUP3 ,getProfileInt( "Settings","eDlcWrongDEV_Kombi_SUP3" , 0,  profileFile));
    putValue( eDlcWrongDEV_Kombi_UD1_PC_KI_Con ,getProfileInt( "Settings","eDlcWrongDEV_Kombi_UD1_PC_KI_Con" , 0,  profileFile));
    putValue( eDlcWrongDEV_Kombi_UD2_PC_KI_Dat ,getProfileInt( "Settings","eDlcWrongDEV_Kombi_UD2_PC_KI_Dat" , 0,  profileFile));
    putValue( eDlcWrongDiagnose_01 ,getProfileInt( "Settings","eDlcWrongDiagnose_01" , 0,  profileFile));
    putValue( eDlcWrongDimmung_01 ,getProfileInt( "Settings","eDlcWrongDimmung_01" , 0,  profileFile));
    putValue( eDlcWrongELV_01 ,getProfileInt( "Settings","eDlcWrongELV_01" , 0,  profileFile));
    putValue( eDlcWrongESP_02 ,getProfileInt( "Settings","eDlcWrongESP_02" , 0,  profileFile));
    putValue( eDlcWrongESP_20 ,getProfileInt( "Settings","eDlcWrongESP_20" , 0,  profileFile));
    putValue( eDlcWrongESP_21 ,getProfileInt( "Settings","eDlcWrongESP_21" , 0,  profileFile));
    putValue( eDlcWrongESP_24 ,getProfileInt( "Settings","eDlcWrongESP_24" , 0,  profileFile));
    putValue( eDlcWrongGateway_73 ,getProfileInt( "Settings","eDlcWrongGateway_73" , 0,  profileFile));
    putValue( eDlcWrongGateway_78 ,getProfileInt( "Settings","eDlcWrongGateway_78" , 0,  profileFile));
    putValue( eDlcWrongHSP_01 ,getProfileInt( "Settings","eDlcWrongHSP_01" , 0,  profileFile));
    putValue( eDlcWrongHVLM_05 ,getProfileInt( "Settings","eDlcWrongHVLM_05" , 0,  profileFile));
    putValue( eDlcWrongISO_Funktionaler_Req_Al ,getProfileInt( "Settings","eDlcWrongISO_Funktionaler_Req_Al" , 0,  profileFile));
    putValue( eDlcWrongISO_Kombi_Req ,getProfileInt( "Settings","eDlcWrongISO_Kombi_Req" , 0,  profileFile));
    putValue( eDlcWrongKessy_04 ,getProfileInt( "Settings","eDlcWrongKessy_04" , 0,  profileFile));
    putValue( eDlcWrongKlemmen_Status_01 ,getProfileInt( "Settings","eDlcWrongKlemmen_Status_01" , 0,  profileFile));
    putValue( eDlcWrongKlemmen_Steuerung_01 ,getProfileInt( "Settings","eDlcWrongKlemmen_Steuerung_01" , 0,  profileFile));
    putValue( eDlcWrongKlima_Sensor_02 ,getProfileInt( "Settings","eDlcWrongKlima_Sensor_02" , 0,  profileFile));
    putValue( eDlcWrongKS_Kombi_Req ,getProfileInt( "Settings","eDlcWrongKS_Kombi_Req" , 0,  profileFile));
    putValue( eDlcWrongLDW_02 ,getProfileInt( "Settings","eDlcWrongLDW_02" , 0,  profileFile));
    putValue( eDlcWrongLH_EPS_01 ,getProfileInt( "Settings","eDlcWrongLH_EPS_01" , 0,  profileFile));
    putValue( eDlcWrongLicht_Anf_01 ,getProfileInt( "Settings","eDlcWrongLicht_Anf_01" , 0,  profileFile));
    putValue( eDlcWrongLicht_hinten_01 ,getProfileInt( "Settings","eDlcWrongLicht_hinten_01" , 0,  profileFile));
    putValue( eDlcWrongLicht_vorne_01 ,getProfileInt( "Settings","eDlcWrongLicht_vorne_01" , 0,  profileFile));
    putValue( eDlcWrongLog_Datenlogger_Req ,getProfileInt( "Settings","eDlcWrongLog_Datenlogger_Req" , 0,  profileFile));
    putValue( eDlcWrongLog_Kombi_Req ,getProfileInt( "Settings","eDlcWrongLog_Kombi_Req" , 0,  profileFile));
    putValue( eDlcWrongLWR_AFS_01 ,getProfileInt( "Settings","eDlcWrongLWR_AFS_01" , 0,  profileFile));
    putValue( eDlcWrongMainUnit_01 ,getProfileInt( "Settings","eDlcWrongMainUnit_01" , 0,  profileFile));
    putValue( eDlcWrongMem_BFS_01 ,getProfileInt( "Settings","eDlcWrongMem_BFS_01" , 0,  profileFile));
    putValue( eDlcWrongMem_FS_01 ,getProfileInt( "Settings","eDlcWrongMem_FS_01" , 0,  profileFile));
    putValue( eDlcWrongMFG_01 ,getProfileInt( "Settings","eDlcWrongMFG_01" , 0,  profileFile));
    putValue( eDlcWrongMFL_Tasten_Kon_01 ,getProfileInt( "Settings","eDlcWrongMFL_Tasten_Kon_01" , 0,  profileFile));
    putValue( eDlcWrongMotor_04 ,getProfileInt( "Settings","eDlcWrongMotor_04" , 0,  profileFile));
    putValue( eDlcWrongMotor_07 ,getProfileInt( "Settings","eDlcWrongMotor_07" , 0,  profileFile));
    putValue( eDlcWrongMotor_09 ,getProfileInt( "Settings","eDlcWrongMotor_09" , 0,  profileFile));
    putValue( eDlcWrongMotor_14 ,getProfileInt( "Settings","eDlcWrongMotor_14" , 0,  profileFile));
    putValue( eDlcWrongMotor_18 ,getProfileInt( "Settings","eDlcWrongMotor_18" , 0,  profileFile));
    putValue( eDlcWrongMotor_26 ,getProfileInt( "Settings","eDlcWrongMotor_26" , 0,  profileFile));
    putValue( eDlcWrongMotor_Code_01 ,getProfileInt( "Settings","eDlcWrongMotor_Code_01" , 0,  profileFile));
    putValue( eDlcWrongMotor_Gas_01 ,getProfileInt( "Settings","eDlcWrongMotor_Gas_01" , 0,  profileFile));
    putValue( eDlcWrongNMH_Gateway ,getProfileInt( "Settings","eDlcWrongNMH_Gateway" , 0,  profileFile));
    putValue( eDlcWrongPLA_Status_02 ,getProfileInt( "Settings","eDlcWrongPLA_Status_02" , 0,  profileFile));
    putValue( eDlcWrongRDK_01 ,getProfileInt( "Settings","eDlcWrongRDK_01" , 0,  profileFile));
    putValue( eDlcWrongReichweite_01 ,getProfileInt( "Settings","eDlcWrongReichweite_01" , 0,  profileFile));
    putValue( eDlcWrongReichweite_02 ,getProfileInt( "Settings","eDlcWrongReichweite_02" , 0,  profileFile));
    putValue( eDlcWrongRKA_01 ,getProfileInt( "Settings","eDlcWrongRKA_01" , 0,  profileFile));
    putValue( eDlcWrongRLS_01 ,getProfileInt( "Settings","eDlcWrongRLS_01" , 0,  profileFile));
    putValue( eDlcWrongSMLS_01 ,getProfileInt( "Settings","eDlcWrongSMLS_01" , 0,  profileFile));
    putValue( eDlcWrongSTH_01 ,getProfileInt( "Settings","eDlcWrongSTH_01" , 0,  profileFile));
    putValue( eDlcWrongSWA_01 ,getProfileInt( "Settings","eDlcWrongSWA_01" , 0,  profileFile));
    putValue( eDlcWrongSysteminfo_01 ,getProfileInt( "Settings","eDlcWrongSysteminfo_01" , 0,  profileFile));
    putValue( eDlcWrongTCO_01 ,getProfileInt( "Settings","eDlcWrongTCO_01" , 0,  profileFile));
    putValue( eDlcWrongTimeDate ,getProfileInt( "Settings","eDlcWrongTimeDate" , 0,  profileFile));
    putValue( eDlcWrongTSG_FT_01 ,getProfileInt( "Settings","eDlcWrongTSG_FT_01" , 0,  profileFile));
    putValue( eDlcWrongTSG_FT_02 ,getProfileInt( "Settings","eDlcWrongTSG_FT_02" , 0,  profileFile));
    putValue( eDlcWrongTSK_07 ,getProfileInt( "Settings","eDlcWrongTSK_07" , 0,  profileFile));
    putValue( eDlcWrongVehiDist ,getProfileInt( "Settings","eDlcWrongVehiDist" , 0,  profileFile));
    putValue( eDlcWrongWischer_01 ,getProfileInt( "Settings","eDlcWrongWischer_01" , 0,  profileFile));
    putValue( eDlcWrongWIV_01 ,getProfileInt( "Settings","eDlcWrongWIV_01" , 0,  profileFile));
    putValue( eDlcWrongZV_02 ,getProfileInt( "Settings","eDlcWrongZV_02" , 0,  profileFile));
    putValue( KCAN_DSSS_Warning ,getProfileInt( "Settings","eDSSS_WarningS" , 0,  profileFile));
    putValue( eEBKV_HinweiseS ,getProfileInt( "Settings","eEBKV_HinweiseS" , 0,  profileFile));
    putValue( eEBKV_OBD_StatusS ,getProfileInt( "Settings","eEBKV_OBD_StatusS" , 0,  profileFile));
    putValue( eEBKV_WarnungenS ,getProfileInt( "Settings","eEBKV_WarnungenS" , 0,  profileFile));
    putValue( eELV_KST_Txt_Komfortabschaltung ,getProfileInt( "Settings","eELV_KST_Txt_Komfortabschaltung" , 0,  profileFile));
    putValue( eEnrgfluss_StateS ,getProfileInt( "Settings","eEnrgfluss_StateS" , 0,  profileFile));
    putValue( eESP_HDC_Regelgeschw0 ,getProfileInt( "Settings","eESP_HDC_Regelgeschw0" , 0,  profileFile));
    putValue( eGE_Sollgang ,getProfileInt( "Settings","eGE_Sollgang" , 0,  profileFile));
    putValue( eGE_Tipschaltempf_verfuegbar ,getProfileInt( "Settings","eGE_Tipschaltempf_verfuegbar" , 0,  profileFile));
    putValue( eGong_TFL_Umschaltung ,getProfileInt( "Settings","eGong_TFL_Umschaltung" , 0,  profileFile));
    putValue( eHSP_Warnung_Text ,getProfileInt( "Settings","eHSP_Warnung_Text" , 0,  profileFile));
    putValue( eHV_Bordnetz_aktivS ,getProfileInt( "Settings","eHV_Bordnetz_aktivS" , 0,  profileFile));
    putValue( eHVEM_Anf_ReichweiteNVS ,getProfileInt( "Settings","eHVEM_Anf_ReichweiteNVS" , 0,  profileFile));
    putValue( eHVEM_HV_AnfS ,getProfileInt( "Settings","eHVEM_HV_AnfS" , 0,  profileFile));
    putValue( eHVEM_KlimaMaxHVStromS ,getProfileInt( "Settings","eHVEM_KlimaMaxHVStromS" , 0,  profileFile));
    putValue( eHVEM_LeistungsAnfS ,getProfileInt( "Settings","eHVEM_LeistungsAnfS" , 0,  profileFile));
    putValue( eHVEM_Nachlad_StatusS ,getProfileInt( "Settings","eHVEM_Nachlad_StatusS" , 0,  profileFile));
    putValue( eHVEM_Nachladen_AnfS ,getProfileInt( "Settings","eHVEM_Nachladen_AnfS" , 0,  profileFile));
    putValue( eHVEM_NVLeistungEmpfS ,getProfileInt( "Settings","eHVEM_NVLeistungEmpfS" , 0,  profileFile));
    putValue( eHVEM_Text_1S ,getProfileInt( "Settings","eHVEM_Text_1S" , 0,  profileFile));
    putValue( eHVLM_Klima_TempS ,getProfileInt( "Settings","eHVLM_Klima_TempS" , 0,  profileFile));
    putValue( eHVLM_LadeartS ,getProfileInt( "Settings","eHVLM_LadeartS" , 0,  profileFile));
    putValue( eHVLM_Lademodus_HV_BatS ,getProfileInt( "Settings","eHVLM_Lademodus_HV_BatS" , 0,  profileFile));
    putValue( eHVLM_LadesystemhinweiseS ,getProfileInt( "Settings","eHVLM_LadesystemhinweiseS" , 0,  profileFile));
    putValue( eHVLM_Langzeit_LadenS ,getProfileInt( "Settings","eHVLM_Langzeit_LadenS" , 0,  profileFile));
    putValue( eHVLM_Restladezeit_HV_BatS ,getProfileInt( "Settings","eHVLM_Restladezeit_HV_BatS" , 0,  profileFile));
    putValue( eHVLM_Stecker_StatusS ,getProfileInt( "Settings","eHVLM_Stecker_StatusS" , 0,  profileFile));
    putValue( eHVLM_VK_AnfS ,getProfileInt( "Settings","eHVLM_VK_AnfS" , 0,  profileFile));
    putValue( eISO_Kombi_Resp_DataD ,getProfileInt( "Settings","eISO_Kombi_Resp_DataD" , 0,  profileFile));
    putValue( eKBI_ABS_LampeD ,getProfileInt( "Settings","eKBI_ABS_LampeD" , 0,  profileFile));
    putValue( eKBI_Airbag_LampeD ,getProfileInt( "Settings","eKBI_Airbag_LampeD" , 0,  profileFile));
    putValue( eKBI_angez_GeschwD ,getProfileInt( "Settings","eKBI_angez_GeschwD" , 0,  profileFile));
    putValue( eKBI_Anzeigefehler_LDWD ,getProfileInt( "Settings","eKBI_Anzeigefehler_LDWD" , 0,  profileFile));
    putValue( eKBI_Anzeigefehler_NVD ,getProfileInt( "Settings","eKBI_Anzeigefehler_NVD" , 0,  profileFile));
    putValue( eKBI_Anzeigefehler_SWAD ,getProfileInt( "Settings","eKBI_Anzeigefehler_SWAD" , 0,  profileFile));
    putValue( eKBI_Anzeigestatus_ACCD ,getProfileInt( "Settings","eKBI_Anzeigestatus_ACCD" , 0,  profileFile));
    putValue( eKBI_Anzeigestatus_GRAD ,getProfileInt( "Settings","eKBI_Anzeigestatus_GRAD" , 0,  profileFile));
    putValue( eKBI_Anzeigestatus_LIMD ,getProfileInt( "Settings","eKBI_Anzeigestatus_LIMD" , 0,  profileFile));
    putValue( eKBI_Aussen_Temp_gefD ,getProfileInt( "Settings","eKBI_Aussen_Temp_gefD" , 0,  profileFile));
    putValue( eKBI_BCmE_aktivD ,getProfileInt( "Settings","eKBI_BCmE_aktivD" , 0,  profileFile));
    putValue( eKBI_BKL_LampeD ,getProfileInt( "Settings","eKBI_BKL_LampeD" , 0,  profileFile));
    putValue( eKBI_DimmpotiD ,getProfileInt( "Settings","eKBI_DimmpotiD" , 0,  profileFile));
    putValue( eKBI_Einheit_DatumD ,getProfileInt( "Settings","eKBI_Einheit_DatumD" , 0,  profileFile));
    putValue( eKBI_Einheit_DruckD ,getProfileInt( "Settings","eKBI_Einheit_DruckD" , 0,  profileFile));
    putValue( eKBI_Einheit_SpracheD ,getProfileInt( "Settings","eKBI_Einheit_SpracheD" , 0,  profileFile));
    putValue( eKBI_Einheit_StreckenanzD ,getProfileInt( "Settings","eKBI_Einheit_StreckenanzD" , 0,  profileFile));
    putValue( eKBI_Einheit_TachoD ,getProfileInt( "Settings","eKBI_Einheit_TachoD" , 0,  profileFile));
    putValue( eKBI_Einheit_TempD ,getProfileInt( "Settings","eKBI_Einheit_TempD" , 0,  profileFile));
    putValue( eKBI_Einheit_UhrzeitD ,getProfileInt( "Settings","eKBI_Einheit_UhrzeitD" , 0,  profileFile));
    putValue( eKBI_Einheit_Verbrauch_elektrD ,getProfileInt( "Settings","eKBI_Einheit_Verbrauch_elektrD" , 0,  profileFile));
    putValue( eKBI_Einheit_VerbrauchD ,getProfileInt( "Settings","eKBI_Einheit_VerbrauchD" , 0,  profileFile));
    putValue( eKBI_Einheit_VolumenD ,getProfileInt( "Settings","eKBI_Einheit_VolumenD" , 0,  profileFile));
    putValue( eKBI_ESP_LampeD ,getProfileInt( "Settings","eKBI_ESP_LampeD" , 0,  profileFile));
    putValue( eKBI_Fehler_Anzeige_ACCD ,getProfileInt( "Settings","eKBI_Fehler_Anzeige_ACCD" , 0,  profileFile));
    putValue( eKBI_FStatus_TankD ,getProfileInt( "Settings","eKBI_FStatus_TankD" , 0,  profileFile));
    putValue( eKBI_HandbremseD ,getProfileInt( "Settings","eKBI_HandbremseD" , 0,  profileFile));
    putValue( eKBI_im_StellgliedtestD ,getProfileInt( "Settings","eKBI_im_StellgliedtestD" , 0,  profileFile));
    putValue( eKBI_Inhalt_TankD ,getProfileInt( "Settings","eKBI_Inhalt_TankD" , 0,  profileFile));
    putValue( eKBI_KD_FehlerD ,getProfileInt( "Settings","eKBI_KD_FehlerD" , 0,  profileFile));
    putValue( eKBI_Kilometerstand_0D ,getProfileInt( "Settings","eKBI_Kilometerstand_0D" , 0,  profileFile));
    putValue( eKBI_Konsistenz_ACCD ,getProfileInt( "Settings","eKBI_Konsistenz_ACCD" , 0,  profileFile));
    putValue( eKBI_Lenkung_LampeD ,getProfileInt( "Settings","eKBI_Lenkung_LampeD" , 0,  profileFile));
    putValue( eKBI_MFA_v_Einheit_01D ,getProfileInt( "Settings","eKBI_MFA_v_Einheit_01D" , 0,  profileFile));
    putValue( eKBI_MFA_v_Einheit_02D ,getProfileInt( "Settings","eKBI_MFA_v_Einheit_02D" , 0,  profileFile));
    putValue( eKBI_Nachtanken_erkanntD ,getProfileInt( "Settings","eKBI_Nachtanken_erkanntD" , 0,  profileFile));
    putValue( eKBI_NV_in_AnzeigeD ,getProfileInt( "Settings","eKBI_NV_in_AnzeigeD" , 0,  profileFile));
    putValue( eKBI_Oeldruck_SchalterD ,getProfileInt( "Settings","eKBI_Oeldruck_SchalterD" , 0,  profileFile));
    putValue( eKBI_OeldruckwarnungD ,getProfileInt( "Settings","eKBI_OeldruckwarnungD" , 0,  profileFile));
    putValue( eKBI_Oelwechsel_durchgefuehrtD ,getProfileInt( "Settings","eKBI_Oelwechsel_durchgefuehrtD" , 0,  profileFile));
    putValue( eKBI_PhototransistorD ,getProfileInt( "Settings","eKBI_PhototransistorD" , 0,  profileFile));
    putValue( eKBI_PLA_in_AnzeigeD ,getProfileInt( "Settings","eKBI_PLA_in_AnzeigeD" , 0,  profileFile));
    putValue( eKBI_QBit_Aussen_Temp_gefD ,getProfileInt( "Settings","eKBI_QBit_Aussen_Temp_gefD" , 0,  profileFile));
    putValue( eKBI_ReifenumfangD ,getProfileInt( "Settings","eKBI_ReifenumfangD" , 0,  profileFile));
    putValue( eKBI_SILA_gueltigD ,getProfileInt( "Settings","eKBI_SILA_gueltigD" , 0,  profileFile));
    putValue( eKBI_Sparhinweis_quittiertD ,getProfileInt( "Settings","eKBI_Sparhinweis_quittiertD" , 0,  profileFile));
    putValue( eKBI_Standzeit_02D ,getProfileInt( "Settings","eKBI_Standzeit_02D" , 0,  profileFile));
    putValue( eKBI_Tankfuellstand_ProzentD ,getProfileInt( "Settings","eKBI_Tankfuellstand_ProzentD" , 0,  profileFile));
    putValue( eKBI_Tankinhalt_hochauflD ,getProfileInt( "Settings","eKBI_Tankinhalt_hochauflD" , 0,  profileFile));
    putValue( eKBI_TankwarnungD ,getProfileInt( "Settings","eKBI_TankwarnungD" , 0,  profileFile));
    putValue( eKBI_V_DigitalD ,getProfileInt( "Settings","eKBI_V_DigitalD" , 0,  profileFile));
    putValue( eKBI_Variante_USAD ,getProfileInt( "Settings","eKBI_Variante_USAD" , 0,  profileFile));
    putValue( eKBI_Vorglueh_System_LampeD ,getProfileInt( "Settings","eKBI_Vorglueh_System_LampeD" , 0,  profileFile));
    putValue( eKombi_01_BZD ,getProfileInt( "Settings","eKombi_01_BZD" , 0,  profileFile));
    putValue( eKombi_NachlauftypD ,getProfileInt( "Settings","eKombi_NachlauftypD" , 0,  profileFile));
    putValue( eKS_Kombi_Resp_DataD ,getProfileInt( "Settings","eKS_Kombi_Resp_DataD" , 0,  profileFile));
    putValue( eKST_Txt_Komfortabschaltung_KST ,getProfileInt( "Settings","eKST_Txt_Komfortabschaltung_KST" , 0,  profileFile));
    putValue( eKST_Txt_P_GangS ,getProfileInt( "Settings","eKST_Txt_P_GangS" , 0,  profileFile));
    putValue( eKST_Txt_PanikabschaltungS ,getProfileInt( "Settings","eKST_Txt_PanikabschaltungS" , 0,  profileFile));
    putValue( eKST_Txt_WerkstattS ,getProfileInt( "Settings","eKST_Txt_WerkstattS" , 0,  profileFile));
    putValue( eKST_Unterdr_Dummy ,getProfileInt( "Settings","eKST_Unterdr_Dummy" , 0,  profileFile));
    putValue( eKST_Unterdr_ZuendungsmeldungS ,getProfileInt( "Settings","eKST_Unterdr_ZuendungsmeldungS" , 0,  profileFile));
    putValue( eKST_Warn_P2_ZST_def ,getProfileInt( "Settings","eKST_Warn_P2_ZST_def" , 0,  profileFile));
    putValue( eLadezustand_02S ,getProfileInt( "Settings","eLadezustand_02S" , 0,  profileFile));
    putValue( eLDW_Lernmodus_seitenabhaengigDec ,getProfileInt( "Settings","eLDW_Lernmodus_seitenabhaengigDec" , 0,  profileFile));
    putValue( eLDW_Lernmodus_seitenabhaengigInc ,getProfileInt( "Settings","eLDW_Lernmodus_seitenabhaengigInc" , 0,  profileFile));
    putValue( eLog_Datalogger_Req_DataKombi_MD ,getProfileInt( "Settings","eLog_Datalogger_Req_DataKombi_MD" , 0,  profileFile));
    putValue( eLog_Datalogger_Req_DataKombi_MI ,getProfileInt( "Settings","eLog_Datalogger_Req_DataKombi_MI" , 0,  profileFile));
    putValue( eLog_Kombi_Resp_DataD ,getProfileInt( "Settings","eLog_Kombi_Resp_DataD" , 0,  profileFile));
    putValue( eLV_Abbiegelicht_li_def ,getProfileInt( "Settings","eLV_Abbiegelicht_li_def" , 0,  profileFile));
    putValue( eLV_Abbiegelicht_re_def ,getProfileInt( "Settings","eLV_Abbiegelicht_re_def" , 0,  profileFile));
    putValue( eLV_LED_Scheinwerfer_li_defS ,getProfileInt( "Settings","eLV_LED_Scheinwerfer_li_defS" , 0,  profileFile));
    putValue( eLV_LED_Scheinwerfer_re_defS ,getProfileInt( "Settings","eLV_LED_Scheinwerfer_re_defS" , 0,  profileFile));
    putValue( eMKE_Stufe ,getProfileInt( "Settings","eMKE_Stufe" , 0,  profileFile));
    putValue( eMO_CNG_Tankstopp_m0 ,getProfileInt( "Settings","eMO_CNG_Tankstopp_m0" , 0,  profileFile));
    putValue( eMO_E_ModeS ,getProfileInt( "Settings","eMO_E_ModeS" , 0,  profileFile));
    putValue( eMO_E_TexteS ,getProfileInt( "Settings","eMO_E_TexteS" , 0,  profileFile));
    putValue( eMO_E_WarnungenS ,getProfileInt( "Settings","eMO_E_WarnungenS" , 0,  profileFile));
    putValue( eMO_Effizienzmodus ,getProfileInt( "Settings","eMO_Effizienzmodus" , 0,  profileFile));
    putValue( eMO_ePowermeterS ,getProfileInt( "Settings","eMO_ePowermeterS" , 0,  profileFile));
    putValue( eMO_Ethanol_BS_Texte ,getProfileInt( "Settings","eMO_Ethanol_BS_Texte" , 0,  profileFile));
    putValue( eMO_Ges_calcConsumption_button ,getProfileInt( "Settings","eMO_Ges_calcConsumption_button" , 0,  profileFile));
    putValue( eMO_Heizungspumpenansteuerung15 ,getProfileInt( "Settings","eMO_Heizungspumpenansteuerung15" , 0,  profileFile));
    putValue( eMO_Hoeheninfo255 ,getProfileInt( "Settings","eMO_Hoeheninfo255" , 0,  profileFile));
    putValue( eMO_HVEM_EskalationS ,getProfileInt( "Settings","eMO_HVEM_EskalationS" , 0,  profileFile));
    putValue( eMO_Hybrid_StartStopp_LED ,getProfileInt( "Settings","eMO_Hybrid_StartStopp_LED" , 0,  profileFile));
    putValue( eMO_max_LadedruckS ,getProfileInt( "Settings","eMO_max_LadedruckS" , 0,  profileFile));
    putValue( eMO_Nachlaufzeit_HeizungspumpeDe ,getProfileInt( "Settings","eMO_Nachlaufzeit_HeizungspumpeDe" , 0,  profileFile));
    putValue( eMO_Nachlaufzeit_HeizungspumpeIn ,getProfileInt( "Settings","eMO_Nachlaufzeit_HeizungspumpeIn" , 0,  profileFile));
    putValue( eMO_PowermeterS ,getProfileInt( "Settings","eMO_PowermeterS" , 0,  profileFile));
    putValue( eMO_Recu_calcConsumption_button ,getProfileInt( "Settings","eMO_Recu_calcConsumption_button" , 0,  profileFile));
    putValue( eMO_Rekuperation_EM_Ges_UeberlaufS ,getProfileInt( "Settings","eMO_Rekuperation_EM_Ges_UeberlaufS" , 0,  profileFile));
    putValue( eMO_Rekuperation_Ges_EMS ,getProfileInt( "Settings","eMO_Rekuperation_Ges_EMS" , 0,  profileFile));
    putValue( eMO_rel_LadedruckS ,getProfileInt( "Settings","eMO_rel_LadedruckS" , 0,  profileFile));
    putValue( eMO_Verbrauch_EM_Ges_UeberlaufS ,getProfileInt( "Settings","eMO_Verbrauch_EM_Ges_UeberlaufS" , 0,  profileFile));
    putValue( eMO_Verbrauch_EM_GesS ,getProfileInt( "Settings","eMO_Verbrauch_EM_GesS" , 0,  profileFile));
    putValue( eMO_W_Reku_normiert_ueberlaufS ,getProfileInt( "Settings","eMO_W_Reku_normiert_ueberlaufS" , 0,  profileFile));
    putValue( eMO_W_Reku_normiertS ,getProfileInt( "Settings","eMO_W_Reku_normiertS" , 0,  profileFile));
    putValue( eMO_WaehlposS ,getProfileInt( "Settings","eMO_WaehlposS" , 0,  profileFile));
    putValue( eMO_Zylabsch_Texte_02 ,getProfileInt( "Settings","eMO_Zylabsch_Texte_02" , 0,  profileFile));
    putValue( eNM_eCall_Car_WakeupS ,getProfileInt( "Settings","eNM_eCall_Car_WakeupS" , 0,  profileFile));
    putValue( eNM_eCall_NL_eCall_aktivS ,getProfileInt( "Settings","eNM_eCall_NL_eCall_aktivS" , 0,  profileFile));
    putValue( eNM_eCall_NL_StandbyS ,getProfileInt( "Settings","eNM_eCall_NL_StandbyS" , 0,  profileFile));
    putValue( eNM_eCall_NM_aktiv_DiagnoseS ,getProfileInt( "Settings","eNM_eCall_NM_aktiv_DiagnoseS" , 0,  profileFile));
    putValue( eNM_eCall_NM_aktiv_KL15S ,getProfileInt( "Settings","eNM_eCall_NM_aktiv_KL15S" , 0,  profileFile));
    putValue( eNM_eCall_NM_aktiv_TminS ,getProfileInt( "Settings","eNM_eCall_NM_aktiv_TminS" , 0,  profileFile));
    putValue( eNM_eCall_NM_StateS ,getProfileInt( "Settings","eNM_eCall_NM_StateS" , 0,  profileFile));
    putValue( eNM_eCall_SNIS ,getProfileInt( "Settings","eNM_eCall_SNIS" , 0,  profileFile));
    putValue( eNM_eCall_UDS_CCS ,getProfileInt( "Settings","eNM_eCall_UDS_CCS" , 0,  profileFile));
    putValue( eNM_eCall_WakeupS ,getProfileInt( "Settings","eNM_eCall_WakeupS" , 0,  profileFile));
    putValue( eNM_Kombi_Car_WakeupD ,getProfileInt( "Settings","eNM_Kombi_Car_WakeupD" , 0,  profileFile));
    putValue( eNM_Kombi_NM_aktiv_BuzzerD ,getProfileInt( "Settings","eNM_Kombi_NM_aktiv_BuzzerD" , 0,  profileFile));
    putValue( eNM_Kombi_NM_aktiv_SchlkomD ,getProfileInt( "Settings","eNM_Kombi_NM_aktiv_SchlkomD" , 0,  profileFile));
    putValue( eNM_Kombi_NM_StateD ,getProfileInt( "Settings","eNM_Kombi_NM_StateD" , 0,  profileFile));
    putValue( eNoGWMessagesButton ,getProfileInt( "Settings","eNoGWMessagesButton" , 0,  profileFile));
    putValue( eNoNonGWMessagesButton ,getProfileInt( "Settings","eNoNonGWMessagesButton" , 0,  profileFile));
    putValue( env_GasConsumption_Correlation ,getProfileInt( "Settings","env_GasConsumption_Correlation" , 0,  profileFile));
    putValue( eOBD_TG_F_Status_1D ,getProfileInt( "Settings","eOBD_TG_F_Status_1D" , 0,  profileFile));
    putValue( eOBD_TG_F_Status_2D ,getProfileInt( "Settings","eOBD_TG_F_Status_2D" , 0,  profileFile));
    putValue( eOBD_TG_F_Status_3D ,getProfileInt( "Settings","eOBD_TG_F_Status_3D" , 0,  profileFile));
    putValue( eOBD_TG_F_Status_4D ,getProfileInt( "Settings","eOBD_TG_F_Status_4D" , 0,  profileFile));
    putValue( eOBD_TG_Sens_Rohwert_1D ,getProfileInt( "Settings","eOBD_TG_Sens_Rohwert_1D" , 0,  profileFile));
    putValue( eOBD_TG_Sens_Rohwert_2D ,getProfileInt( "Settings","eOBD_TG_Sens_Rohwert_2D" , 0,  profileFile));
    putValue( eOBD_TG_Sens_Rohwert_3D ,getProfileInt( "Settings","eOBD_TG_Sens_Rohwert_3D" , 0,  profileFile));
    putValue( eOBD_TG_Sens_Rohwert_4D ,getProfileInt( "Settings","eOBD_TG_Sens_Rohwert_4D" , 0,  profileFile));
    putValue( ePLS_Akustik ,getProfileInt( "Settings","ePLS_Akustik" , 0,  profileFile));
    putValue( eRDK_FMVSS138_Lampe ,getProfileInt( "Settings","eRDK_FMVSS138_Lampe" , 0,  profileFile));
    putValue( eRDK_FMVSS138_MIL ,getProfileInt( "Settings","eRDK_FMVSS138_MIL" , 0,  profileFile));
    putValue( eRDK_KalibrierungS ,getProfileInt( "Settings","eRDK_KalibrierungS" , 0,  profileFile));
    putValue( eRDK_Warnungen_02s ,getProfileInt( "Settings","eRDK_Warnungen_02s" , 0,  profileFile));
    putValue( eRES_TripResetD ,getProfileInt( "Settings","eRES_TripResetD" , 0,  profileFile));
    putValue( eRGS_VL_Texte ,getProfileInt( "Settings","eRGS_VL_Texte" , 0,  profileFile));
    putValue( eRDK_FMVSS138_Lampe ,getProfileInt( "Settings","eRDK_02_FMVSS138_Lampe" , 0,  profileFile));
    putValue( eRDK_FMVSS138_MIL ,getProfileInt( "Settings","eRDK_02_FMVSS138_MIL" , 0,  profileFile));
    putValue( eRDK_Warnungen_02s ,getProfileInt( "Settings","eRDK_Warnungen_02s" , 0,  profileFile));
    putValue( eRW_Prim_Reichweitenv_EinheitS ,getProfileInt( "Settings","eRW_Prim_Reichweitenv_EinheitS" , 0,  profileFile));
    putValue( eRW_Prim_ReichweitenverbrauchS ,getProfileInt( "Settings","eRW_Prim_ReichweitenverbrauchS" , 0,  profileFile));
    putValue( eRW_Primaer_ReichweiteS ,getProfileInt( "Settings","eRW_Primaer_ReichweiteS" , 0,  profileFile));
    putValue( eRW_RWDS_LastprofilS ,getProfileInt( "Settings","eRW_RWDS_LastprofilS" , 0,  profileFile));
    putValue( eRW_Sek_Reichweitenv_EinheitS ,getProfileInt( "Settings","eRW_Sek_Reichweitenv_EinheitS" , 0,  profileFile));
    putValue( eRW_Sek_ReichweitenverbrauchS ,getProfileInt( "Settings","eRW_Sek_ReichweitenverbrauchS" , 0,  profileFile));
    putValue( eRW_Sekundaer_Reichweite ,getProfileInt( "Settings","eRW_Sekundaer_Reichweite" , 0,  profileFile));
    putValue( eRW_Sekundaer_ReichweiteS ,getProfileInt( "Settings","eRW_Sekundaer_ReichweiteS" , 0,  profileFile));
    putValue( eSCR_Anz_Motorstarts15 ,getProfileInt( "Settings","eSCR_Anz_Motorstarts15" , 0,  profileFile));
    putValue( eSCR_Verbaut ,getProfileInt( "Settings","eSCR_verbaut" , 0,  profileFile));
    putValue( eSendBAP_BC_ASG_02 ,getProfileInt( "Settings","eSendBAP_BC_ASG_02" , 0,  profileFile));
    putValue( eSendKlemmen_Steuerung_01 ,getProfileInt( "Settings","eSendKlemmen_Steuerung_01" , 0,  profileFile));
    putValue( eSI_T_Schutz ,getProfileInt( "Settings","eSI_T_Schutz" , 0,  profileFile));
    putValue( eSK1_Key_Data_1D ,getProfileInt( "Settings","eSK1_Key_Data_1D" , 0,  profileFile));
    putValue( eSK1_Key_Data_2D ,getProfileInt( "Settings","eSK1_Key_Data_2D" , 0,  profileFile));
    putValue( eSK1_Key_Data_3D ,getProfileInt( "Settings","eSK1_Key_Data_3D" , 0,  profileFile));
    putValue( eSK1_Key_Data_4D ,getProfileInt( "Settings","eSK1_Key_Data_4D" , 0,  profileFile));
    putValue( eSK1_Key_Data_5D ,getProfileInt( "Settings","eSK1_Key_Data_5D" , 0,  profileFile));
    putValue( eSK1_Key_Data_6D ,getProfileInt( "Settings","eSK1_Key_Data_6D" , 0,  profileFile));
    putValue( eSK1_Key_Data_7D ,getProfileInt( "Settings","eSK1_Key_Data_7D" , 0,  profileFile));
    putValue( eSK1_Key_Data_8D ,getProfileInt( "Settings","eSK1_Key_Data_8D" , 0,  profileFile));
    putValue( eSK1_Key_Data_9D ,getProfileInt( "Settings","eSK1_Key_Data_9D" , 0,  profileFile));
    putValue( eSK1_MUXD ,getProfileInt( "Settings","eSK1_MUXD" , 0,  profileFile));
    putValue( eSMLS_P_verriegeltS ,getProfileInt( "Settings","eSMLS_P_verriegeltS" , 0,  profileFile));
    putValue( eSTH_KVS ,getProfileInt( "Settings","eSTH_KVS" , 0,  profileFile));
    putValue( eSTH_KVS_Ueberlauf ,getProfileInt( "Settings","eSTH_KVS_Ueberlauf" , 0,  profileFile));
    putValue( eSTH_HeizleistungS ,getProfileInt( "Settings","eSTH_HeizleistungS" , 0,  profileFile));
    putValue( eSTH_Texte ,getProfileInt( "Settings","eSTH_Texte" , 0,  profileFile));
    putValue( eSynchronizeDiagnose_01 ,getProfileInt( "Settings","eSynchronizeDiagnose_01" , 0,  profileFile));
    putValue( eTBAP_BC_ASG_02 ,getProfileInt( "Settings","eTBAP_BC_ASG_02" , 0,  profileFile));
    putValue( eTimeoutAGA_01 ,getProfileInt( "Settings","eTimeoutAGA_01" , 0,  profileFile));
    putValue( eTimeoutAirbag_02 ,getProfileInt( "Settings","eTimeoutAirbag_02" , 0,  profileFile));
    putValue( eTimeoutAnhaenger_01 ,getProfileInt( "Settings","eTimeoutAnhaenger_01" , 0,  profileFile));
    putValue( eTimeoutARA_Status_01 ,getProfileInt( "Settings","eTimeoutARA_Status_01" , 0,  profileFile));
    putValue( eTimeoutBAP_BC_ASG_02 ,getProfileInt( "Settings","eTimeoutBAP_BC_ASG_02" , 0,  profileFile));
    putValue( eTimeoutBCM_01 ,getProfileInt( "Settings","eTimeoutBCM_01" , 0,  profileFile));
    putValue( eTimeoutBEM_02 ,getProfileInt( "Settings","eTimeoutBEM_02" , 0,  profileFile));
    putValue( eTimeoutBlinkmodi_02 ,getProfileInt( "Settings","eTimeoutBlinkmodi_02" , 0,  profileFile));
    putValue( eTimeoutBMS_07 ,getProfileInt( "Settings","eTimeoutBMS_07" , 0,  profileFile));
    putValue( eTimeoutCharisma_03 ,getProfileInt( "Settings","eTimeoutCharisma_03" , 0,  profileFile));
    putValue( eTimeoutDaempfer_01 ,getProfileInt( "Settings","eTimeoutDaempfer_01" , 0,  profileFile));
    putValue( eTimeoutDEV_Kombi_RX1 ,getProfileInt( "Settings","eTimeoutDEV_Kombi_RX1" , 0,  profileFile));
    putValue( eTimeoutDEV_Kombi_SUP1 ,getProfileInt( "Settings","eTimeoutDEV_Kombi_SUP1" , 0,  profileFile));
    putValue( eTimeoutDEV_Kombi_SUP2 ,getProfileInt( "Settings","eTimeoutDEV_Kombi_SUP2" , 0,  profileFile));
    putValue( eTimeoutDEV_Kombi_SUP3 ,getProfileInt( "Settings","eTimeoutDEV_Kombi_SUP3" , 0,  profileFile));
    putValue( eTimeoutDEV_Kombi_UD1_PC_KI_Cont ,getProfileInt( "Settings","eTimeoutDEV_Kombi_UD1_PC_KI_Cont" , 0,  profileFile));
    putValue( eTimeoutDEV_Kombi_UD2_PC_KI_Data ,getProfileInt( "Settings","eTimeoutDEV_Kombi_UD2_PC_KI_Data" , 0,  profileFile));
    putValue( eTimeoutDiagnose_01 ,getProfileInt( "Settings","eTimeoutDiagnose_01" , 0,  profileFile));
    putValue( eTimeoutDimmung_01 ,getProfileInt( "Settings","eTimeoutDimmung_01" , 0,  profileFile));
    putValue( eTimeoutELV_01 ,getProfileInt( "Settings","eTimeoutELV_01" , 0,  profileFile));
    putValue( eTimeoutESP_02 ,getProfileInt( "Settings","eTimeoutESP_02" , 0,  profileFile));
    putValue( eTimeoutESP_20 ,getProfileInt( "Settings","eTimeoutESP_20" , 0,  profileFile));
    putValue( eTimeoutESP_21 ,getProfileInt( "Settings","eTimeoutESP_21" , 0,  profileFile));
    putValue( eTimeoutESP_24 ,getProfileInt( "Settings","eTimeoutESP_24" , 0,  profileFile));
    putValue( eTimeoutGateway_73 ,getProfileInt( "Settings","eTimeoutGateway_73" , 0,  profileFile));
    putValue( eTimeoutGateway_78 ,getProfileInt( "Settings","eTimeoutGateway_78" , 0,  profileFile));
    putValue( eTimeoutHSP_01 ,getProfileInt( "Settings","eTimeoutHSP_01" , 0,  profileFile));
    putValue( eTimeoutHVLM_05 ,getProfileInt( "Settings","eTimeoutHVLM_05" , 0,  profileFile));
    putValue( eTimeoutISO_Funktionaler_Req_All ,getProfileInt( "Settings","eTimeoutISO_Funktionaler_Req_All" , 0,  profileFile));
    putValue( eTimeoutISO_Kombi_Req ,getProfileInt( "Settings","eTimeoutISO_Kombi_Req" , 0,  profileFile));
    putValue( eTimeoutKessy_04 ,getProfileInt( "Settings","eTimeoutKessy_04" , 0,  profileFile));
    putValue( eTimeoutKlemmen_Status_01 ,getProfileInt( "Settings","eTimeoutKlemmen_Status_01" , 0,  profileFile));
    putValue( eTimeoutKlemmen_Steuerung_01 ,getProfileInt( "Settings","eTimeoutKlemmen_Steuerung_01" , 0,  profileFile));
    putValue( eTimeoutKlima_Sensor_02 ,getProfileInt( "Settings","eTimeoutKlima_Sensor_02" , 0,  profileFile));
    putValue( eTimeoutKS_Kombi_Req ,getProfileInt( "Settings","eTimeoutKS_Kombi_Req" , 0,  profileFile));
    putValue( eTimeoutLDW_02 ,getProfileInt( "Settings","eTimeoutLDW_02" , 0,  profileFile));
    putValue( eTimeoutLH_EPS_01 ,getProfileInt( "Settings","eTimeoutLH_EPS_01" , 0,  profileFile));
    putValue( eTimeoutLicht_Anf_01 ,getProfileInt( "Settings","eTimeoutLicht_Anf_01" , 0,  profileFile));
    putValue( eTimeoutLicht_hinten_01 ,getProfileInt( "Settings","eTimeoutLicht_hinten_01" , 0,  profileFile));
    putValue( eTimeoutLicht_vorne_01 ,getProfileInt( "Settings","eTimeoutLicht_vorne_01" , 0,  profileFile));
    putValue( eTimeoutLog_Datenlogger_Req ,getProfileInt( "Settings","eTimeoutLog_Datenlogger_Req" , 0,  profileFile));
    putValue( eTimeoutLog_Kombi_Req ,getProfileInt( "Settings","eTimeoutLog_Kombi_Req" , 0,  profileFile));
    putValue( eTimeoutLWR_AFS_01 ,getProfileInt( "Settings","eTimeoutLWR_AFS_01" , 0,  profileFile));
    putValue( eTimeoutMainUnit_01 ,getProfileInt( "Settings","eTimeoutMainUnit_01" , 0,  profileFile));
    putValue( eTimeoutMem_BFS_01 ,getProfileInt( "Settings","eTimeoutMem_BFS_01" , 0,  profileFile));
    putValue( eTimeoutMem_FS_01 ,getProfileInt( "Settings","eTimeoutMem_FS_01" , 0,  profileFile));
    putValue( eTimeoutMFG_01 ,getProfileInt( "Settings","eTimeoutMFG_01" , 0,  profileFile));
    putValue( eTimeoutMFL_Tasten_Kon_01 ,getProfileInt( "Settings","eTimeoutMFL_Tasten_Kon_01" , 0,  profileFile));
    putValue( eTimeoutMotor_04 ,getProfileInt( "Settings","eTimeoutMotor_04" , 0,  profileFile));
    putValue( eTimeoutMotor_07 ,getProfileInt( "Settings","eTimeoutMotor_07" , 0,  profileFile));
    putValue( eTimeoutMotor_09 ,getProfileInt( "Settings","eTimeoutMotor_09" , 0,  profileFile));
    putValue( eTimeoutMotor_14 ,getProfileInt( "Settings","eTimeoutMotor_14" , 0,  profileFile));
    putValue( eTimeoutMotor_18 ,getProfileInt( "Settings","eTimeoutMotor_18" , 0,  profileFile));
    putValue( eTimeoutMotor_26 ,getProfileInt( "Settings","eTimeoutMotor_26" , 0,  profileFile));
    putValue( eTimeoutMotor_Code_01 ,getProfileInt( "Settings","eTimeoutMotor_Code_01" , 0,  profileFile));
    putValue( eTimeoutMotor_Gas_01 ,getProfileInt( "Settings","eTimeoutMotor_Gas_01" , 0,  profileFile));
    putValue( eTimeoutNMH_Gateway ,getProfileInt( "Settings","eTimeoutNMH_Gateway" , 0,  profileFile));
    putValue( eTimeoutPLA_Status_02 ,getProfileInt( "Settings","eTimeoutPLA_Status_02" , 0,  profileFile));
    putValue( eTimeoutRDK_01 ,getProfileInt( "Settings","eTimeoutRDK_01" , 0,  profileFile));
    putValue( eTimeoutReichweite_01 ,getProfileInt( "Settings","eTimeoutReichweite_01" , 0,  profileFile));
    putValue( eTimeoutReichweite_02 ,getProfileInt( "Settings","eTimeoutReichweite_02" , 0,  profileFile));
    putValue( eTimeoutRKA_01 ,getProfileInt( "Settings","eTimeoutRKA_01" , 0,  profileFile));
    putValue( eTimeoutRLS_01 ,getProfileInt( "Settings","eTimeoutRLS_01" , 0,  profileFile));
    putValue( eTimeoutSMLS_01 ,getProfileInt( "Settings","eTimeoutSMLS_01" , 0,  profileFile));
    putValue( eTimeoutSTH_01 ,getProfileInt( "Settings","eTimeoutSTH_01" , 0,  profileFile));
    putValue( eTimeoutSWA_01 ,getProfileInt( "Settings","eTimeoutSWA_01" , 0,  profileFile));
    putValue( eTimeoutSysteminfo_01 ,getProfileInt( "Settings","eTimeoutSysteminfo_01" , 0,  profileFile));
    putValue( eTimeoutTCO_01 ,getProfileInt( "Settings","eTimeoutTCO_01" , 0,  profileFile));
    putValue( eTimeoutTimeDate ,getProfileInt( "Settings","eTimeoutTimeDate" , 0,  profileFile));
    putValue( eTimeoutTSG_FT_01 ,getProfileInt( "Settings","eTimeoutTSG_FT_01" , 0,  profileFile));
    putValue( eTimeoutTSG_FT_02 ,getProfileInt( "Settings","eTimeoutTSG_FT_02" , 0,  profileFile));
    putValue( eTimeoutTSK_07 ,getProfileInt( "Settings","eTimeoutTSK_07" , 0,  profileFile));
    putValue( eTimeoutVehiDist ,getProfileInt( "Settings","eTimeoutVehiDist" , 0,  profileFile));
    putValue( eTimeoutWischer_01 ,getProfileInt( "Settings","eTimeoutWischer_01" , 0,  profileFile));
    putValue( eTimeoutWIV_01 ,getProfileInt( "Settings","eTimeoutWIV_01" , 0,  profileFile));
    putValue( eTimeoutZV_02 ,getProfileInt( "Settings","eTimeoutZV_02" , 0,  profileFile));
    putValue( eTKlemmen_Steuerung_01 ,getProfileInt( "Settings","eTKlemmen_Steuerung_01" , 0,  profileFile));
    putValue( eTOTBAP_BC_ASG_02 ,getProfileInt( "Settings","eTOTBAP_BC_ASG_02" , 0,  profileFile));
    putValue( eTOTDEV_Kombi_UD1_PC_KI_ControlD ,getProfileInt( "Settings","eTOTDEV_Kombi_UD1_PC_KI_ControlD" , 0,  profileFile));
    putValue( eTOTDEV_Kombi_UD1_PC_KI_ControlI ,getProfileInt( "Settings","eTOTDEV_Kombi_UD1_PC_KI_ControlI" , 0,  profileFile));
    putValue( eTOTKlemmen_Steuerung_01 ,getProfileInt( "Settings","eTOTKlemmen_Steuerung_01" , 0,  profileFile));
    putValue( eVSG_MeldungenS ,getProfileInt( "Settings","eVSG_MeldungenS" , 0,  profileFile));
    putValue( eWatchDog_Exceedances_1 ,getProfileInt( "Settings","eWatchDog_Exceedances_1" , 0,  profileFile));
    putValue( eWatchDog_Exceedances_2 ,getProfileInt( "Settings","eWatchDog_Exceedances_2" , 0,  profileFile));
    putValue( eWatchDog_Exceedances_3 ,getProfileInt( "Settings","eWatchDog_Exceedances_3" , 0,  profileFile));
    putValue( eWatchDog_Exceedances_4 ,getProfileInt( "Settings","eWatchDog_Exceedances_4" , 0,  profileFile));
    putValue( eWatchDog_LowerLimit_1 ,getProfileInt( "Settings","eWatchDog_LowerLimit_1" , 0,  profileFile));
    putValue( eWatchDog_LowerLimit_2 ,getProfileInt( "Settings","eWatchDog_LowerLimit_2" , 0,  profileFile));
    putValue( eWatchDog_LowerLimit_3 ,getProfileInt( "Settings","eWatchDog_LowerLimit_3" , 0,  profileFile));
    putValue( eWatchDog_LowerLimit_4 ,getProfileInt( "Settings","eWatchDog_LowerLimit_4" , 0,  profileFile));
    putValue( eWatchDog_Reset_1 ,getProfileInt( "Settings","eWatchDog_Reset_1" , 0,  profileFile));
    putValue( eWatchDog_Reset_2 ,getProfileInt( "Settings","eWatchDog_Reset_2" , 0,  profileFile));
    putValue( eWatchDog_Reset_3 ,getProfileInt( "Settings","eWatchDog_Reset_3" , 0,  profileFile));
    putValue( eWatchDog_Reset_4 ,getProfileInt( "Settings","eWatchDog_Reset_4" , 0,  profileFile));
    putValue( eWatchDog_Switch_1 ,getProfileInt( "Settings","eWatchDog_Switch_1" , 0,  profileFile));
    putValue( eWatchDog_Switch_2 ,getProfileInt( "Settings","eWatchDog_Switch_2" , 0,  profileFile));
    putValue( eWatchDog_Switch_3 ,getProfileInt( "Settings","eWatchDog_Switch_3" , 0,  profileFile));
    putValue( eWatchDog_Switch_4 ,getProfileInt( "Settings","eWatchDog_Switch_4" , 0,  profileFile));
    putValue( eWatchDog_Undercuts_1 ,getProfileInt( "Settings","eWatchDog_Undercuts_1" , 0,  profileFile));
    putValue( eWatchDog_Undercuts_2 ,getProfileInt( "Settings","eWatchDog_Undercuts_2" , 0,  profileFile));
    putValue( eWatchDog_Undercuts_3 ,getProfileInt( "Settings","eWatchDog_Undercuts_3" , 0,  profileFile));
    putValue( eWatchDog_Undercuts_4 ,getProfileInt( "Settings","eWatchDog_Undercuts_4" , 0,  profileFile));
    putValue( eWatchDog_UpperLimit_1 ,getProfileInt( "Settings","eWatchDog_UpperLimit_1" , 0,  profileFile));
    putValue( eWatchDog_UpperLimit_2 ,getProfileInt( "Settings","eWatchDog_UpperLimit_2" , 0,  profileFile));
    putValue( eWatchDog_UpperLimit_3 ,getProfileInt( "Settings","eWatchDog_UpperLimit_3" , 0,  profileFile));
    putValue( eWatchDog_UpperLimit_4 ,getProfileInt( "Settings","eWatchDog_UpperLimit_4" , 0,  profileFile));
    putValue( eWatchDog_Value_1 ,getProfileInt( "Settings","eWatchDog_Value_1" , 0,  profileFile));
    putValue( eWatchDog_Value_2 ,getProfileInt( "Settings","eWatchDog_Value_2" , 0,  profileFile));
    putValue( eWatchDog_Value_3 ,getProfileInt( "Settings","eWatchDog_Value_3" , 0,  profileFile));
    putValue( eWatchDog_Value_4 ,getProfileInt( "Settings","eWatchDog_Value_4" , 0,  profileFile));
    putValue( eWBA_GE_Zusatzwarnungen ,getProfileInt( "Settings","eWBA_GE_Zusatzwarnungen" , 0,  profileFile));
    putValue( eWFS_Betrieb_LesespuleD ,getProfileInt( "Settings","eWFS_Betrieb_LesespuleD" , 0,  profileFile));
    putValue( eWFS_ELV_authorisiertD ,getProfileInt( "Settings","eWFS_ELV_authorisiertD" , 0,  profileFile));
    putValue( eWFS_ID_Geb_autorisiert_in_Kl15D ,getProfileInt( "Settings","eWFS_ID_Geb_autorisiert_in_Kl15D" , 0,  profileFile));
    putValue( eWFS_IMMO_ELV_CRCD ,getProfileInt( "Settings","eWFS_IMMO_ELV_CRCD" , 0,  profileFile));
    putValue( eWFS_IMMO_ELV_StatusD ,getProfileInt( "Settings","eWFS_IMMO_ELV_StatusD" , 0,  profileFile));
    putValue( eWFS_IMMO_GSG_CRCD ,getProfileInt( "Settings","eWFS_IMMO_GSG_CRCD" , 0,  profileFile));
    putValue( eWFS_IMMO_GSG_StatusD ,getProfileInt( "Settings","eWFS_IMMO_GSG_StatusD" , 0,  profileFile));
    putValue( eWFS_IMMO_MSG1_CRCD ,getProfileInt( "Settings","eWFS_IMMO_MSG1_CRCD" , 0,  profileFile));
    putValue( eWFS_IMMO_MSG1_StatusD ,getProfileInt( "Settings","eWFS_IMMO_MSG1_StatusD" , 0,  profileFile));
    putValue( eWFS_IMMO_MSG2_CRCD ,getProfileInt( "Settings","eWFS_IMMO_MSG2_CRCD" , 0,  profileFile));
    putValue( eWFS_IMMO_MSG2_StatusD ,getProfileInt( "Settings","eWFS_IMMO_MSG2_StatusD" , 0,  profileFile));
    putValue( eWFS_IMMO_MSG3_CRCD ,getProfileInt( "Settings","eWFS_IMMO_MSG3_CRCD" , 0,  profileFile));
    putValue( eWFS_IMMO_MSG3_StatusD ,getProfileInt( "Settings","eWFS_IMMO_MSG3_StatusD" , 0,  profileFile));
    putValue( eWFS_IMMO_MSG4_CRCD ,getProfileInt( "Settings","eWFS_IMMO_MSG4_CRCD" , 0,  profileFile));
    putValue( eWFS_IMMO_MSG4_StatusD ,getProfileInt( "Settings","eWFS_IMMO_MSG4_StatusD" , 0,  profileFile));
    putValue( eWFS_Klemmenfreigabe_SignaturD ,getProfileInt( "Settings","eWFS_Klemmenfreigabe_SignaturD" , 0,  profileFile));
    putValue( eWFS_KlemmenfreigabeD ,getProfileInt( "Settings","eWFS_KlemmenfreigabeD" , 0,  profileFile));
    putValue( eWFS_Schluessel_FahrberechtD ,getProfileInt( "Settings","eWFS_Schluessel_FahrberechtD" , 0,  profileFile));
    putValue( eWFS_Verbauinfo_ELVD ,getProfileInt( "Settings","eWFS_Verbauinfo_ELVD" , 0,  profileFile));
    putValue( eDlcOnceMVK_01 ,getProfileInt( "Settings","eDlcOnceMVK_01" , 0,  profileFile));
    putValue( eDlcWrongMVK_01 ,getProfileInt( "Settings","eDlcWrongMVK_01" , 0,  profileFile));
    putValue( eMVK_01_BZS_ResetJumpData ,getProfileInt( "Settings","eMVK_01_BZS_ResetJumpData" , 0,  profileFile));
    putValue( eMVK_01_BZS_ResetJumpEnabled ,getProfileInt( "Settings","eMVK_01_BZS_ResetJumpEnabled" , 0,  profileFile));
    putValue( eMVK_01_BZS_SingleJumpData ,getProfileInt( "Settings","eMVK_01_BZS_SingleJumpData" , 0,  profileFile));
    putValue( eMVK_01_BZS_SingleJumpEnabled ,getProfileInt( "Settings","eMVK_01_BZS_SingleJumpEnabled" , 0,  profileFile));
    putValue( eMVK_01_CRC_FalseData ,getProfileInt( "Settings","eMVK_01_CRC_FalseData" , 0,  profileFile));
    putValue( eMVK_01_CRC_FalseEnabled ,getProfileInt( "Settings","eMVK_01_CRC_FalseEnabled" , 0,  profileFile));
    putValue( eMVK_01_NoMsgEnabled ,getProfileInt( "Settings","eMVK_01_NoMsgEnabled" , 0,  profileFile));
    putValue( eMVK_01_NoMsgEnabledData ,getProfileInt( "Settings","eMVK_01_NoMsgEnabledData" , 0,  profileFile));
    putValue( eTimeoutMVK_01 ,getProfileInt( "Settings","eTimeoutMVK_01" , 0,  profileFile));
}

on EnvVar eAllNonGWMessagesButton
{
  enableAllNonGWMessages( 1 );
}

on EnvVar eNoNonGWMessagesButton
{
  enableAllNonGWMessages( 0 );
}

on EnvVar eAllGWMessagesButton
{
  enableAllGWMessages( 1 );
}

on EnvVar eNoGWMessagesButton
{
  enableAllGWMessages( 0 );
}

void enableAllNonGWMessages( int enable )
{
    putValue( eSendAnhaenger_01, enable );
    putValue( eSendBCM_01, enable );
    putValue( eSendBlinkmodi_02, enable );
    putValue( eSendDimmung_01, enable );
    putValue( eSendELV_01, enable );
    putValue( eSendKessy_04, enable );
    putValue( eSendKlemmen_Status_01, enable );
    putValue( eSendKlima_Sensor_02, enable );
    putValue( eSendLicht_Anf_01, enable );
    putValue( eSendLicht_hinten_01, enable );
    putValue( eSendLicht_vorne_01, enable );
    putValue( eSendMem_BFS_01, enable );
    putValue( eSendMem_FS_01, enable );
    putValue( eSendMFG_01, enable );
    putValue( eSendRLS_01, enable );
    putValue( eSendSMLS_01, enable );
    putValue( eSendTCO_01, 0 ); // Default is OFF !!!
    putValue( eSendTSG_FT_01, enable );
    putValue( eSendTimeDate, enable );
    putValue( eSendVehiDist, enable );
    putValue( eSendWischer_01, enable );
    putValue( eSendZV_02, enable );
    putValue( eSendSTH_01, enable );
    putValue( eSendBAP_BC_ASG_02, enable );
    putValue( eSendKlemmen_Steuerung_01, enable );

    putValue( eSendTSG_FT_02, enable );
    putValue( eSendHSP_01, enable );

  //IssueList #173 MR 55685
    putValue( eSendPersonalisierung_01, enable );

  //MR 73649
    putValue( eSendTM_01, enable );

  //MR 75590
    putValue( eSendBCM_04, enable );

  //MR 77431
    putValue( eSendASTA_Sensor_01, enable );

    putValue( eSendWFS_01, enable );

  //GVJ-4663
    putValue( eSendBCM_03, enable );

}

void enableAllGWMessages( int enable )
{
    putValue( eSendACC_12, enable );
    putValue( eSendACC_13, enable );
    putValue( eSendACC_14, enable );
    putValue( eSendAGA_01, enable );
    putValue( eSendAirbag_01, enable );
    putValue( eSendAirbag_02, enable );
    putValue( eSendAirbag_04, enable );
    putValue( eSendARA_Status_01, enable );
    putValue( eSendAWV_02, enable );
    putValue( eSendBEM_02, enable );
    putValue( eSendBEM_06, enable );
    putValue( eSendBMS_05, enable );
    putValue( eSendBMS_07, enable );
    putValue( eSendCharisma_03, enable );
    putValue( eSendDaempfer_01, enable );
    putValue( eSendDiagnose_01, enable );
    putValue( eSendEPB_03, enable );
    putValue( eSendESP_02, enable );
    putValue( eSendESP_20, enable );
    putValue( eSendESP_21, enable );
    putValue( eSendESP_24, enable );
    putValue( eSendGateway_71, enable );
    putValue( eSendGateway_73, enable );
    putValue( eSendGateway_78, enable );
    putValue( eSendHVLM_05, enable);
    putValue( eSendLDW_02, enable );
    putValue( eSendLH_EPS_01, enable );
    putValue( eSendLSH_02, enable );
    putValue( eSendLWR_AFS_01, enable );
    putValue( eSendMainUnit_01, enable );
    putValue( eSendMotor_04, enable );
    putValue( eSendMotor_07, enable );
    putValue( eSendMotor_09, enable );
    putValue( eSendMotor_14, enable );
    putValue( eSendMotor_18, enable );
    putValue( eSendMotor_23, enable );
    putValue( eSendMotor_25, enable );
    putValue( eSendMotor_26, enable );
    putValue( eSendMotor_29, enable );
    putValue( eSendMotor_31, enable );
    putValue( eSendMotor_36, enable );
    putValue( eSendMotor_41, enable );
    putValue( eSendMotor_Code_01, enable );
    putValue( eSendMotor_Gas_01, enable);
    putValue( eSendNavPos_01, enable );
    putValue( eSendPLA_Status_02, enable );
    putValue( eSendRDK_02, enable );
    putValue( eSendReichweite_01, enable );
    putValue( eSendReichweite_02, enable );
    putValue( eSendRKA_01, enable );
    putValue( eSendSWA_01, enable );
    putValue( eSendSysteminfo_01, enable );
    putValue( eSendTA_01, enable );
    putValue( eSendTSK_07, enable );
    putValue( eSendWBA_03, enable );
    putValue( eSendWIV_01, enable );
}

