/*@!Encoding:1252*/
includes
{
    #include "DoIP.cin"
}
variables
{
    dword udpHandle;
    dword transmitterIPdw, transmitterPortdw;
    dword receiverIPdw, receiverPortdw;
    char  rxBuffer[1460], txBuffer[1460];
    char  transmitterIPstr[16], transmitterNAMEstr[16];
    char  receiverIPstr[16], receiverNAMEstr[16];      
    char  kPanelName[32] = "DoIP_Test";   // Name of the panel
  
    const dword IPV6_STR_SIZE = 40; // IPv6 string size
  
    char  ipv6SourceAddrStr[IPV6_STR_SIZE] = "fd53:7cb8:383:5::73";
    char  ipv6GatewayStr[IPV6_STR_SIZE] = "fd53:7cb8:383:5::11";
    char  ipv6KombiStr[IPV6_STR_SIZE] = "fd53:7cb8:383:5::14";
    char  ipv6MulticastGrpStr[IPV6_STR_SIZE] = "ff02:0000:0000:0000:0000:0000:0000:0001";  //ff02::1
    char  ipv6DestAddrStr[IPV6_STR_SIZE]   = "ff14::5";

    byte  ipv6SourceAddr[16];              // IPv6 address bytes.  
    byte  ipv6DestAddr[16]; 
    byte  ipv6Gateway[16];
    byte  ipv6Kombi[16];
    byte  ipv6MulticastGrp[16]; 
  
    dword dwSrcPort = 13400;
    dword dwDstPort = 13400;
    dword gResult = 0;
  
    dword gUdpSocketHandleGW = 0;
    dword gTcpSocketHandleGW = 0;
  
    char  gErrorText[200];
    char  gRxBuffer[1472]; // Max. UDP payload without fragmentation
    char  gTxBuffer[1472]; // Max. UDP payload without fragmentation
    char  gReceiveBuffer[1452];
  
    char  textData[20] = "Hello UDP Server";
    byte  abData[20];
  
    timer TestTimer;  
    timer PollTimer;
  
    struct DoIP_tstHead
    {
        byte ProtocolVer;
        byte InvProtocolVer;
        word wPayloadType;
        dword dwpayloadLen;
    }stDoIPHead;
  
    const word gcRequestHeadLen = 8; //8 bytes
  
    byte  gDoIPPayload[1452];
    byte  gabEmptyArray[1452];     
  
    //DOIP Specific data
    byte  Eid[6] = {0,0,0,0,0,0x0B};
    byte  Vin[17] = {0,0,0,0,0,0,0,0,0,0,0,0,0,0,0,0,0};
      
    struct
    {
        word SrcAddr;
        byte ActType;
        dword Reservedoc;
        dword ReserveOEM;        
    } stRoutingActivation;
      
    struct
    {
        word SrcAddr;
        word DstAddr;
    } stDiagMsgHead;
      
    byte  DiagUserData[8] = {1,2,3,4,5,6,7,8};
    byte  TestDiagUserData[8] = {1,2,3,4,5,6,7,8};
      
    const byte gMAXIDNO = 7;
    byte  DoIPID = 0;
      
    char sPrintbuf[255];
}

/// <DoIP_Cmd>
void DoIP_SenCmd( word wID )
{
    DoIP_ProInit();
  
    switch( wID )
    {
        case DoIP_ID:             DoIP_VinRequest();             break;
        case DoIP_EID:            DoIP_VinRequest_EID();         break;
        case DoIP_VIN:            DoIP_VinRequest_VIN();         break;
        case DoIP_EntityStatReq:  DoIP_Entity_Status_Request();  break;
        case DoIP_PowerModeReq:   DoIP_Pwr_mode_Request();       break;
        case DoIP_RoutingActReq:  DoIP_Route_Act_Request();      break;      
        case DoIP_DiagMsg:        DoIP_DiagMsg_Request();        break;     
    }
}

on start
{
    vOpenIPv6UdpPort(gUdpSocketHandleGW, ipv6Gateway,dwSrcPort );
    TcPClientStart();
  
    DoIP_ProInit();
  
    memcpy(abData,textData,elcount(textData));
  
 //   InitIPV6data();
  
    //SendUdpMsg(gUdpSocketHandleGW,ipv6Kombi,dwDstPort,abData);  
    // DoIP_VinRequest();
  
    ReceiveUdpMsg(gUdpSocketHandleGW); 
    //  setTimer( TestTimer, 1 ); //disabled for test
}

/// <DoIP_Cmd>
void DoIP_VinRequest()
{
    DoIP_MessageHeadBuilder(0x0001,0);
    DoIP_MessageUdpSend(gcRequestHeadLen);

    putValueToControl( kPanelName, "DoIPOutput", " Sent Vehicle Indetification  request. \r\n");
}

/// <DoIP_Cmd>
void DoIP_VinRequest_EID()
{
    DoIP_MessageHeadBuilder(0x0002,6); //6 bytes of eid

    memcpy(gDoIPPayload,gabEmptyArray,elcount(gabEmptyArray));

    memcpy_off(gDoIPPayload,8,Eid,0,6);

    DoIP_MessageUdpSend(gcRequestHeadLen+6);

    putValueToControl( kPanelName, "DoIPOutput", " Sent Vehicle Indetification  request with EID. \r\n");
}

/// <TCP>
/*
  Start Chat Client and connect to server
*/
int TcPClientStart()
{
  byte  remoteAddressIPv6[16];
  byte  localAddressIPv6[16];
  char  errorText[200];
  char  buf[32];
  long  result;
  byte ServerPortIndex;
  long TcpServerPorts;
  long TcpClientPort = 13400 ;
 
  TcpServerPorts = 13400;

// Setup server address
  //

  if( ipGetAddressAsArray(ipv6KombiStr, remoteAddressIPv6) == 0 )
  {
    //
    // Create IPv6 TCP socket and connect
    //

      write( "$$  <%BASE_FILE_NAME%> Connecting to %s ...", ipv6KombiStr );


    
          ipGetAddressAsArray("::", localAddressIPv6);
    
          gTcpSocketHandleGW = TcpOpen( localAddressIPv6, TcpClientPort );
    

    
          if (IpGetLastSocketError(gTcpSocketHandleGW) != 0)
          {
            IpGetLastSocketErrorAsString( gTcpSocketHandleGW, errorText, elcount(errorText) );
            write( "$$  <%BASE_FILE_NAME%> TcpSocket::open IPv6 failed, %s (Result %d)", errorText, IpGetLastSocketError(gTcpSocketHandleGW) );
            return -1;
          }

          IpSetSocketOption(gTcpSocketHandleGW, "IPPROTO_IPV6", "IPV6_TCLASS",0);
          IpSetSocketOption(gTcpSocketHandleGW, "IPPROTO_IPV6", "IPV6_AUTOFLOWLABEL",0);
          
          result = TcpConnect( gTcpSocketHandleGW, remoteAddressIPv6, TcpServerPorts );
          if (result != 0 && ipGetLastSocketError(gTcpSocketHandleGW) != 10035 ) // WSAEWOULDBLOCK
          {
            IpGetLastSocketErrorAsString(gTcpSocketHandleGW, errorText, elcount(errorText) );
            write( "$$  <%BASE_FILE_NAME%> TcpSocket::connect IPv6 failed, %s (Result %d)", errorText,IpGetLastSocketError(gTcpSocketHandleGW) );
            return -1;
          }
          
          write( "$$  <%BASE_FILE_NAME%> TCP Client connecting to port: %d, from Socket: 0x%x", TcpServerPorts,gTcpSocketHandleGW  );

      
  
  }
        return 0;
}

on sysvar_update DoIP::PollDiag
{
  if(@this)
  {
    setTimer( PollTimer, 1 ); //disabled for test
   }
  else
   {
    cancelTimer(PollTimer);    
   }
}

on timer PollTimer
{
  DoIP_SenCmd(0x8001);
  
  setTimer(PollTimer, 3);
}

/// <DoIP_Cmd>
//tcp cmd
void DoIP_Route_Act_Request()
{
   // memcpy(gDoIPPayload,gabEmptyArray,elcount(gabEmptyArray));
  
    DoIP_MessageHeadBuilder(0x005,11); //6 bytes of eid
  
    memcpy_h2n(gDoIPPayload,8,stRoutingActivation);
   
    DoIP_MessageTcpSend(gcRequestHeadLen+11);
  
    putValueToControl( kPanelName, "DoIPOutput", " Sent Routing activation request. \r\n");
}


word DoIP_wBuildDiagMsg(byte abData[])
{
  word wLen;
  
  wLen = elcount(abData);
  
  return wLen;
}

/// <DoIP_Cmd>
void DoIP_DiagMsg_Request()
{
  word wDiagMsgLen;
  
  byte abDiagUserData[100];
  long CmdLen;
  
  CmdLen = elcount(sysvar::DoIP::DiagCmd); 
  
   sysGetVariableData( sysvar::DoIP::DiagCmd, abDiagUserData, CmdLen);
  
  //   wDiagMsgLen = DoIP_wBuildDiagMsg(abDiagUserData);
    wDiagMsgLen =   CmdLen;
  
     DoIP_MessageHeadBuilder(0x8001,4+wDiagMsgLen); //4 bytes of addr + diag length
  

     memcpy(gDoIPPayload,gabEmptyArray,elcount(gabEmptyArray));
  
     memcpy_h2n(gDoIPPayload,8,stDiagMsgHead);
  
     memcpy_off(gDoIPPayload,8+4,abDiagUserData,0,wDiagMsgLen); //8 = head, 4= Diag head
    
   
    DoIP_MessageTcpSend(gcRequestHeadLen+wDiagMsgLen+4);
  
    putValueToControl( kPanelName, "DoIPOutput", " Sent Diagnosis request. \r\n");
}

/// <TCP>
/*
  Stop Chat Client and close connection to server
*/
int TcpClientStop()
{
    char errorText[200];
    byte ServerPortIndex;

  //
  // Close socket
  //
        TcpClose(gTcpSocketHandleGW);
        gTcpSocketHandleGW = 0;
  
  return 0;
}

/// <TCP>
/*
 * Send text of SysVar ChatClient1::Text to server.
 */
int TcpSendtoServer(byte abData[], word wLen)
{
    byte text[1048510];
    char chartext[1048510]; 
    long copiedBytes;
    byte newData[1];
    long result;
  
 // sysGetVariableData( sysvar::TCPClt::SendBuffer, text,copiedBytes );
  
  //sysSetVariableData( sysvar::TCPSrv::RecvBuffer, newData, 0 ); //clear buffer
  
  //sysSetVariableInt( sysvar::TCPSrv::RecvLen, 0 );
  
  result =  TcpSend( gTcpSocketHandleGW, abData, wLen );
  
 // sysGetVariableInt( sysvar::TCPClt::SendLen, copiedBytes );


    memcpy(chartext,text,copiedBytes);
  
   if (result == 0)
  {
    // sending took place immediately.
      
    write( "$$  <%BASE_FILE_NAME%> TCP Sent out %d bytes",wLen );
   // writeLineEx(1, 1, " [ $ <%BASE_FILE_NAME%>: Synchronous sending: on socket %d ]", gTcpSocketHandleGW);
    OnTcpSend(gTcpSocketHandleGW, result, chartext, copiedBytes); // trigger callback manually
  }
  else
  {
    if (result == -1)
    {
      result = IpGetLastSocketError(gTcpSocketHandleGW);
      if (result == 997)
      {
        // sending is done asynchronously.
        writeLineEx(1, 1, " [ $$ <%BASE_FILE_NAME%>: Asynchronous sending: on socket %d ]", gTcpSocketHandleGW);
        // => OnTcpSend is called when done sending.
      }
      else
      {
        writeLineEx( 1, 3, " [ $$ <%BASE_FILE_NAME%>: sendTcpData: Error sending data. (%d) ]", result);
      }
    }
    else
    {
      writeLineEx( 1, 3, " [ $$ <%BASE_FILE_NAME%>: sendTcpData: Error sending data. (%d) ]", result);
    }
  } 
  
  return 0;
}

OnTcpSend(dword socket, long result, char buffer[], dword size)
{
  TcpReceivefromServer();
}

/// <TCP>
int TcpReceivefromServer()
{
    char errorText[200];
    long result;
  
   write( "$$  <%BASE_FILE_NAME%> Started receiving.." );
  
   //sysSetVariableInt( sysvar::TCPClt::RecvLen, 0 );
  
   result = TcpReceive( gTcpSocketHandleGW, gReceiveBuffer, elcount(gReceiveBuffer) );

  /*
    if (ipGetLastSocketError(gClientSocket) != 997)
    {
      IpGetLastSocketErrorAsString( gClientSocket, errorText, elcount(errorText) );
      write( "$$  <%BASE_FILE_NAME%> TcpSocket::Receive failed, %s (Result %d)", errorText, IpGetLastSocketError(gClientSocket) );
      return -1;
    }
    */
  
  if (result == -1)
  {
    result = IpGetLastSocketError(gTcpSocketHandleGW);
    if (result != 997) // not asynchronous
    {
      // failure
      IPGetLastSocketErrorAsString(gTcpSocketHandleGW, errorText, elcount(errorText) );
      write( "$$ <%BASE_FILE_NAME%> TcpReceive failed, %s (Result %d)", errorText, IpGetLastSocketError(gTcpSocketHandleGW) );
      
    }
  }
  else if (result != 0) // synchronous sending failed
  {
    // failure
    writeLineEx( 1, 3, "$$ <%BASE_FILE_NAME%>: TcpReceive error %d", result);
    }
    return 0;
}

/// <TCP>
/*
 * Data is received from Chat Server. Put it to text buffer.
 *
 * socket  - Socket handle of the client
 * result  - Result of the operation, 0 on success
 * buffer  - Buffer which contains the received data
 * size    - Size in bytes of the received data
 */
void TcpReceiveInternal( dword socket, long result, char buffer[], dword size)
{
    char errorText[200];
    long retVal;
    char SendText[200];
    byte newData[1];
    byte TempByte[50];  
    long copypostion;  
    long copiedBytes; 

  memcpy(TempByte,buffer,size);
  //
  // Put text to the panel
  //
  write( "$$  <%BASE_FILE_NAME%> TCP received %d bytes, socket 0x%x", size, socket );    

  //  if (result == 0)
  if(socket == gTcpSocketHandleGW )
    {     
      //there is still unread bytes?
      //sysGetVariableInt( sysvar::TCPClt::RecvLen, copypostion );

      sysSetVariableData( sysvar::DoIP::OutputHex, TempByte, size );    
      RecvMsghandler(buffer, size);
      putValueToControl( kPanelName, "DoIPOutput", "Received Tcp response from Kombi. \r\n");           
    }    

    //
    // Receive next message
    //
    //Disable by ZJ
 //   if(size>= 65812)
 //      ReceivefromServer();

}

OnTcpConnect(dword socket, long result)
{
    write( "$$  <%BASE_FILE_NAME%> OnTcpConnect with result %d, socket 0x%x", result, socket );

    if (result == 0)
    {
        if( socket == gTcpSocketHandleGW  )
        {
             write( "Tcp client connected from socket 0x%x ", gTcpSocketHandleGW );   
        }            
    }
}

OnTcpClose( dword socket, long result)
{
    write( "$$  <%BASE_FILE_NAME%> TCP connection closed, result %d", result );

    TcpClose(socket);
    socket = 0;
}

OnTcpReceive(dword socket, long result, byte ipv6Address[], dword port, char buffer[], dword size)
{
    TcpReceiveInternal( socket, result, buffer, size);
}

/// <DoIP_Cmd>
void DoIP_VinRequest_VIN()
{
    DoIP_MessageHeadBuilder( 0x0003,17 ); //6 bytes of eid
    memcpy( gDoIPPayload, gabEmptyArray, elcount( gabEmptyArray ));
    memcpy_off( gDoIPPayload, 8, Vin, 0, 17 );
    DoIP_MessageUdpSend( gcRequestHeadLen + 17 );
    putValueToControl( kPanelName, "DoIPOutput", " Sent Vehicle Indetification  request with VIN. \r\n");
}

/// <DoIP_Cmd>
void DoIP_Entity_Status_Request()
{
    DoIP_MessageHeadBuilder( 0x4001,0 ); //6 bytes of eid
    DoIP_MessageUdpSend( gcRequestHeadLen );
    putValueToControl( kPanelName, "DoIPOutput", " Sent Entity status request. \r\n" );
}

/// <DoIP_Cmd>
void DoIP_Pwr_mode_Request()
{
    DoIP_MessageHeadBuilder( 0x4003,0 ); //6 bytes of eid
    DoIP_MessageUdpSend( gcRequestHeadLen );
    putValueToControl( kPanelName, "DoIPOutput", " Sent Power mode status request. \r\n");  
}
/// <DoIP>
void DoIP_ProInit()
{
    long EidLen =6;
    long VinLen =17;
    long lSrcAddr;
    long lDstAddr;
    long lProtoVer;
    long lActType;
    dword ifnIdx = 2; //2 is adapter vlan 1.5

    stRoutingActivation.Reservedoc = 0;
    stRoutingActivation.ReserveOEM = 0;

    ipSetStackParameter(ifnIdx, "canoe.ipv6.flow", 0);

    sysGetVariableInt( sysvar::DoIP::SrcAddr,lSrcAddr ); 
    sysGetVariableInt( sysvar::DoIP::DstAddr, lDstAddr); 
    sysGetVariableInt( sysvar::DoIP::ProtocolVer, lProtoVer); 
    sysGetVariableInt( sysvar::DoIP::ActType, lActType); 

    stDoIPHead.ProtocolVer = lProtoVer;
    stDoIPHead.InvProtocolVer = ~stDoIPHead.ProtocolVer;

    stRoutingActivation.ActType = lActType;
    stRoutingActivation.SrcAddr = lSrcAddr;

    stDiagMsgHead.SrcAddr = lSrcAddr;
    stDiagMsgHead.DstAddr = lDstAddr;

    sysGetVariableData( sysvar::DoIP::EID, Eid, EidLen );
    sysGetVariableData( sysvar::DoIP::VIN, Vin, VinLen );
}

on timer TestTimer
{
    //SendUdpMsg(gUdpSocketHandleGW,ipv6Kombi,dwDstPort,abData);

    switch (DoIPID)
    {
        case 0:  DoIP_VinRequest();            break;
        case 1:  DoIP_VinRequest_EID();        break;
        case 2:  DoIP_VinRequest_VIN();        break;
        case 3:  DoIP_Entity_Status_Request(); break;
        case 4:  DoIP_Pwr_mode_Request();      break;
        case 5:  DoIP_Route_Act_Request();     break;
        case 6:  DoIP_DiagMsg_Request();       break;
    }
    DoIPID++;

    if(DoIPID >= gMAXIDNO)
        DoIPID = 0;

    setTimer( TestTimer, 3 );
}



/// <Udp>
OnUdpReceiveFrom(dword socket, long result, byte ipv6Address[], dword port, char buffer[], dword size)
{
    byte boMulticast;

    boMulticast  = @sysvar::DoIP::multicast;
    if(boMulticast)
    {
    if ((BufferCompare(ipv6MulticastGrp, ipv6Address, IPv6_ADDR_LEN)) && (port == dwDstPort))
    {
      RecvMsghandler(buffer, size);
    }
    else{
      snprintf(sPrintbuf, elcount(sPrintbuf),"Invalid DoIP Data received port=%d \n",port);
      putValueToControl( kPanelName, "DoIPOutput", sPrintbuf); 
    }
  }
  else
  {
    if(port == dwDstPort)
    {
      RecvMsghandler(buffer, size);
    }
    else{
      snprintf(sPrintbuf, elcount(sPrintbuf),"Invalid DoIP Data received port=%d \n",port);
      putValueToControl( kPanelName, "DoIPOutput", sPrintbuf);  
    }
  }
  
  // Get next received data
  ReceiveUdpMsg( gUdpSocketHandleGW);
}

/*
on key 'b'
{
    strncpy(txBuffer, "Hello UDP from CANoe", elcount (txBuffer));
    udpSendTo(udpHandle, receiverIPdw, receiverPortdw, txBuffer, strlen(txBuffer)); 
  
   // OutputToPanel(3, receiverPortdw);
}
*/

/// <Udp>
byte u8IPv6Compare(byte ipv6Address1[],byte ipv6Address2[])
{
    byte Cnt;
  
    for( Cnt = 0; Cnt < 16; Cnt++ )
    {
        if( ipv6Address1[Cnt] != ipv6Address2[Cnt] )
        {
            return 1; //different IP
        }
    }
    return 0;//same IP
}

/// <Udp>
void vOpenIPv6UdpPort( dword &UdpSocketHandler, byte ipv6SrcAddr[],dword ipv6SrcPort)
{
    int i;                          // loop variable  
    dword result;  
    byte ipv6WildcardAddrArray[16]; /* ipv6  address  Wildcard */
    char textData[20] = "Hello UDP Server";
  
  //wildcard IP binding
    result = IpGetAddressAsArray("::", ipv6WildcardAddrArray);

    if (result == 0)
    {
      // success...
      write("<%BASE_FILE_NAME%>IpGetAddressAsArray: returned wildcard array with IPv6 bytes:");
      for ( i=0; i<16; i++)
      {
        write("<%BASE_FILE_NAME%>Byte %.2d = 0x%.2x", i, ipv6WildcardAddrArray[i]);
      }
    }
    else
    {
      writeLineEx(1, 3, "IpGetAddressAsArray: The wildcard address string was invalid.");
    }
 

    // Open UDP socket
    UdpSocketHandler = UdpOpen(ipv6SrcAddr, ipv6SrcPort); // if The port parameter is set to zero. => A free local port is selected by the stack.

    // Check for valid socket handle
    if (UdpSocketHandler == ~0)
    {
      write("<%BASE_FILE_NAME%> UdpOpen failed: Result %d", IpGetLastError());
    }
    else // Socket handle valid
    {

        write("<%BASE_FILE_NAME%> Udp Open is successful..  ");

    }
 }


on sysvar_update DoIP::ConnectSrv2
{
    byte  remoteAddressIPv6[16];
    byte  localAddressIPv6[16];
    char  errorText[200];
    long  result;

    long TcpServerPorts;
    long TcpClientPort = 13450 ;

    TcpServerPorts = 13400;
  
    if(@this)
    {    
        TcpClose(gTcpSocketHandleGW);
        gTcpSocketHandleGW = 0;

        gTcpSocketHandleGW = TcpOpen( localAddressIPv6, TcpClientPort );

        IpSetSocketOption(gTcpSocketHandleGW, "IPPROTO_IPV6", "IPV6_TCLASS",0);
        IpSetSocketOption(gTcpSocketHandleGW, "IPPROTO_IPV6", "IPV6_AUTOFLOWLABEL",0);

        if (IpGetLastSocketError(gTcpSocketHandleGW) != 0)
        {
            IpGetLastSocketErrorAsString( gTcpSocketHandleGW, errorText, elcount(errorText) );
            write( "$$  <%BASE_FILE_NAME%> TcpSocket::open IPv6 failed, %s (Result %d)", errorText, IpGetLastSocketError(gTcpSocketHandleGW) );
        }
        ipGetAddressAsArray(ipv6KombiStr, remoteAddressIPv6);

        result = TcpConnect( gTcpSocketHandleGW, remoteAddressIPv6, TcpServerPorts );
        if (result != 0 && ipGetLastSocketError(gTcpSocketHandleGW) != 10035 ) // WSAEWOULDBLOCK
        {
            IpGetLastSocketErrorAsString(gTcpSocketHandleGW, errorText, elcount(errorText) );
            write( "$$  <%BASE_FILE_NAME%> TcpSocket::connect IPv6 failed, %s (Result %d)", errorText,IpGetLastSocketError(gTcpSocketHandleGW) );
        }
        write( "$$  <%BASE_FILE_NAME%> TCP Client connecting to port: %d, from Socket: 0x%x", TcpServerPorts,gTcpSocketHandleGW  );
    }
}

/// <DoIP>
void DoIP_MessageHeadBuilder(word wMsgID,dword dwLen)
{
    stDoIPHead.wPayloadType = wMsgID;
    stDoIPHead.dwpayloadLen = dwLen; 
}


/// <DoIP>
dword DoIP_MessageUdpSend(word wLen)
{

    byte TempByte[1] ='\0';  
    byte boMulticast;
  
    memcpy_h2n(gDoIPPayload,stDoIPHead);
    boMulticast  = @sysvar::DoIP::multicast;
  
    if( boMulticast == 1 )
        gResult = SendUdpMsg( gUdpSocketHandleGW, ipv6MulticastGrp, dwDstPort, gDoIPPayload, wLen);
    else
        gResult = SendUdpMsg( gUdpSocketHandleGW, ipv6Kombi, dwDstPort, gDoIPPayload, wLen);
    
    sysSetVariableData( sysvar::DoIP::InputHext, gDoIPPayload, wLen ); //output sent hex 
  
    sysSetVariableData( sysvar::DoIP::OutputHex, TempByte, 0 ); //clear hex output
  
    return gResult;
}

/// <DoIP>
dword DoIP_MessageTcpSend(word wLen)
{
    byte TempByte[1] = '\0';
  
    memcpy_h2n(gDoIPPayload,stDoIPHead);
  
    gResult = TcpSendtoServer(gDoIPPayload,wLen);
  
    sysSetVariableData( sysvar::DoIP::InputHext, gDoIPPayload, wLen ); //output sent hex 
  
    sysSetVariableData( sysvar::DoIP::OutputHex, TempByte, 0 ); //clear hex output

    return gResult;
}

/// <Udp>
dword SendUdpMsg(dword &UdpSocketHandler,byte ipv6DstAddr[],dword ipv6DstPort,byte textData[], word wLen)
{
    if( wLen == 0 )
        wLen = elcount( textData );
  
    gResult = UdpSendTo(UdpSocketHandler, ipv6DstAddr, ipv6DstPort, textData,wLen );
  
      // Check for error
    if ( (gResult != 0) && (IpGetLastSocketError(UdpSocketHandler) != 997) )
    {
      IpGetLastSocketErrorAsString(UdpSocketHandler, gErrorText, elcount(gErrorText) );
      write( "<%BASE_FILE_NAME%> UdpSendTo failed, %s (Result %d)", gErrorText, IpGetLastSocketError(UdpSocketHandler) );
    }

    return gResult; 
 }


/// <Udp>
dword ReceiveUdpMsg(dword &UdpSocketHandler)
{
    // Optionally receive answer from UDP server
    UdpReceiveFrom(UdpSocketHandler, gRxBuffer, elcount(gRxBuffer)); 
  
    // Check for error
    if( IpGetLastSocketError(UdpSocketHandler) != 997 )
    {
        IpGetLastSocketErrorAsString(UdpSocketHandler, gErrorText, elcount(gErrorText));
        write("<%BASE_FILE_NAME%> UdpReceiveFrom failed, %s (Result %d)", gErrorText, IpGetLastSocketError(UdpSocketHandler));
    }
  
 return  gResult;
}


/// <Udp>
void RecvMsghandler(char buffer[], dword size)
{
    byte TempByte[50];
  
    memcpy(TempByte,buffer,size);  
    putValueToControl( kPanelName, "DoIPOutput", "Received DoIP response from Kombi. \r\n");     
    sysSetVariableData( sysvar::DoIP::OutputHex, TempByte, size );
  
}

/// <Udp>
void vConvertIPv6toArray(char acAddrStr[], byte abAddr[])
{
    int i; // loop variable 
    long gResult;
    
    //1nd IPv6 interface 
    write("Converting IPv6 Address %s to bytes...", acAddrStr);

    gResult = IpGetAddressAsArray( acAddrStr, abAddr );
    if (gResult == 0)
    {
      // success...
      write("IpGetAddressAsArray: returned array with IPv6 bytes:");
      for ( i=0; i<16; i++)
      {        
        write("Byte %.2d = 0x%.2x", i, abAddr[i]);
      }
    }
    else
    {
      write("Error converting");
    }       
}


on preStart
{
    vConvertIPv6toArray(ipv6SourceAddrStr, ipv6SourceAddr);
    vConvertIPv6toArray(ipv6DestAddrStr, ipv6DestAddr);  
    vConvertIPv6toArray(ipv6GatewayStr, ipv6Gateway);
    vConvertIPv6toArray(ipv6KombiStr, ipv6Kombi); 
    vConvertIPv6toArray(ipv6MulticastGrpStr, ipv6MulticastGrp);  
}

