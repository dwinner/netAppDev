/*@!Encoding:1252*/
variables
{
    word TP_TGW_IC_Aud = 0x2DB;
    word TP_IC_TGW_Aud = 0x2D9;

    word TP_TGW_IC_Nav = 0x2BF;
    word TP_IC_TGW_Nav = 0x2BD;

    word TP_TGW_IC_Tel = 0x2C3;
    word TP_IC_TGW_Tel = 0x2C1;

    word TP_TGW_IC_HUD = 0x2A0;
    word TP_IC_TGW_HUD = 0x2C8;

    word TP_TGW_IC_SCA = 0x2EF;
    word TP_IC_TGW_SCA = 0x2ED;

    const byte Node_AUD = 0xC0;//0x03;
    const byte Node_NAV = 0xBD;//0x04;
    const byte Node_TEL = 0xC1;//0x05;
    const byte Node_NES = 0x06;

    const byte Channel_AUD = 0x00;
    const byte Channel_NAV = 0x01;
    const byte Channel_TEL = 0x02;
    const byte Channel_HUD = 0x03;
    const byte Channel_SCA = 0x04;

    byte ADC_ERROR = 0xA8;//0xA3;
    byte ADC_DATA  = 0xA9;//0xA4;
    byte ADC_EVENT = 0xAA;//0xA5;
    byte ADC_REPLY = 0xAB;//0xA6;
    byte ADC_ACOUSTICS = 0xAC;//0xA7;

    byte AllDFOn = 0;
    byte AllEvMaskOn = 0;

    byte TxBuffer_AUD[32];
    byte TxBuffer_NAV[32];
    byte TxBuffer_TEL[32];
    byte TxBuffer_HUD[32];
    byte TxBuffer_SCA[32];

    byte TxBuffer[2048];

    long lAudHandle;
    long lNavHandle;
    long lTelHandle;
    long lHUDHandle;
    long lSCAHandle;
    

    mstimer msTimer_Reply_AUD;
    mstimer msTimer_Reply_NAV;
    mstimer msTimer_Reply_TEL;
    mstimer msTimer_Reply_HUD;
    mstimer msTimer_Reply_SCA;

    mstimer msTimer_StressTest_AUD;
    mstimer msTimer_StressTest_NAV;
    mstimer msTimer_StressTest_TEL;
    mstimer msTimer_SendData_AUD;
    mstimer msTimer_SendData_NAV;
    mstimer msTimer_SendData_TEL;
    msTimer msTimer_UpDown;
    msTimer msTimer_LeftRight;

    char acDFContent[16][62];
    byte abDFSpecial[16];
    byte abDFSpecialType[16];
    byte abDFDataType[16];
    byte abDFUpdateCfg[16];
    byte abDFSelectable[16];
    byte abDFSelected[16];
    byte abDFHighL[16];
    byte abDFTruncation[16];
    byte abDFProgression[16];
    byte abDFAlignment[16];
    byte abDFMove[16];
    byte abDFIconPos[16];
    byte abDFIconLength[16];	 
    byte abDFInactive[16];
    byte abDFSeparator[16];
    word awDFIconNr[16];
    byte abActiveDF[16];

    byte abFirstDFInLine[7];
    byte abLineSelectable[7];
    byte abLineSelected[7];
    byte abLineHighL[7];
    byte abLineProgression[7];
    byte abLineAlignment[7];
    byte abLineInactive[7];
    byte abLineSeparator[7];

    byte abFirstDFInChain[7];
    byte abChainSelectable[7];
    byte abChainSelected[7];
    byte abChainHighL[7];
    byte abChainProgression[7];
    byte abChainAlignment[7];
    byte abChainInactive[7];
    byte abChainSeparator[7];

    byte  abLaneShape[9];
    byte  abLaneDirection[8];
     byte  abLaneColor[8];
    byte  abLaneArt[8];

    byte LaneG = 0x01;
    byte Bargraph = 0x11;
    byte Turns = 0x21;
    byte Places_225 = 0x22;
    byte Roundabouts_225 = 0x23;
    byte Roundabouts_300 = 0x24;
    byte Compass = 0x25;
    byte Flags = 0x26;
    byte Highways = 0x27;
    byte HOVHighways = 0x28;

    byte StressTestNoAud = 0;
    byte StressTestNoNav = 0;
    byte StressTestNoTel = 0;
    byte bGridIdAud;
    byte bGridIdNav;
    byte bGridIdTel;
    byte UpPress;
    byte LeftPress;
    byte SendDelay = 200;

    dword dwWriteTab;
    char cAud[10] = "Audio";
    char cNav[10] = "Navi";
    char cTel[10] = "Tel";
    char cHUD[10] = "HUD";
    char cSCA[10] = "SCA";

    char cHdlName[10];

    byte bTelegramCounter;
}

on start
{
    byte i;    
    putValue(ADC_A_NodeAddress, Node_AUD);
    putValue(ADC_C_GridId, 0x12);
    putValue(ADC_A_Project, 0x00);
    
    putValue(ADC_D_TAEventQuantity, 0x00);
    putValue(ADC_D_TAEventType, 0x00);
    
    lAudHandle = CanTpCreateConnection( 0); // Normal mode
    CanTpSetTxIdentifier(lAudHandle, TP_TGW_IC_Aud);
    CanTpSetRxIdentifier(lAudHandle, TP_IC_TGW_Aud);
    
    lNavHandle = CanTpCreateConnection( 0); // Normal mode
    CanTpSetTxIdentifier(lNavHandle, TP_TGW_IC_Nav);
    CanTpSetRxIdentifier(lNavHandle, TP_IC_TGW_Nav);

    lTelHandle = CanTpCreateConnection( 0); // Normal mode
    CanTpSetTxIdentifier(lTelHandle, TP_TGW_IC_Tel);
    CanTpSetRxIdentifier(lTelHandle, TP_IC_TGW_Tel);

    lHUDHandle = CanTpCreateConnection( 0); // Normal mode
    CanTpSetTxIdentifier(lHUDHandle, TP_TGW_IC_HUD);
    CanTpSetRxIdentifier(lHUDHandle, TP_IC_TGW_HUD);

    lSCAHandle = CanTpCreateConnection( 0); // Normal mode
    CanTpSetTxIdentifier(lSCAHandle, TP_TGW_IC_SCA);
    CanTpSetRxIdentifier(lSCAHandle, TP_IC_TGW_SCA);


    bTelegramCounter = 1;

    for(i=0;i<32;i++)
    {
        TxBuffer_AUD[i] = 0x00;
        TxBuffer_NAV[i] = 0x00;
        TxBuffer_TEL[i] = 0x00;
        TxBuffer_HUD[i] = 0x00;
        TxBuffer_SCA[i] = 0x00;
    }
    for(i=0;i<10;i++)
    {
        cHdlName[i] = 0;
    }

    vInitDataFields();
    vInitLaneGuidance();
    vInitGraphics();
    vInitLinesChains();
    vInitConfiguration();

    putValue(HMI__STMSG_TP_TGW_IC_Aud, 0);
    putValue(HMI__STMSG_TP_TGW_IC_Nav, 0);
    putValue(HMI__STMSG_TP_TGW_IC_Tel, 0);
    putValue(HMI__STMSG_TP_TGW_IC_HUD, 0);
    putValue(HMI__STMSG_TP_TGW_IC_SCA, 0);

    putValue(HMI_TGW_TP_Alive, 1);
 //   putValue(HMI_TX_Actv, 1);

    putValue(ADC_Z_TimerReply, 10);
    putValue(ADC_Z_StressTest, 0);
    putValue(ADC_Z_StressTest_Aud, 0);
    putValue(ADC_Z_StressTest_Nav, 0);
    putValue(ADC_Z_StressTest_Tel, 0);
    putValue(ADC_Z_LeftRight, 0);
    putValue(ADC_Z_UpDown, 0);
    StressTestNoAud = 0;
    StressTestNoNav = 0;
    StressTestNoTel = 0;

    callAllOnEnvVar();

    dwWriteTab = writeCreate("ADC");
    writeclear(dwWriteTab);
}

on envVar ADC_A_NodeAddress
{
byte bNode;
bNode = getValue(this);
    switch(bNode)
    {
    case Node_AUD:
        putValue(ADC_B_Application, 0x01);
        putValue(ADC_A_CANChannel, 0x00);
        break;
    case Node_NAV:
        putValue(ADC_B_Application, 0x04);
        putValue(ADC_A_CANChannel, 0x01);
        break;
    case Node_TEL:
        putValue(ADC_B_Application, 0x03);
        putValue(ADC_A_CANChannel, 0x02);
        break;
    case Node_NES:
        putValue(ADC_B_Application, 0x06);
        putValue(ADC_A_CANChannel, 0x04);
        break;
    default:
        break;
    }    
}

on envVar ADC_G_SetDF
{
if (getValue(this) == 1)
    {
    if (AllDFOn == 1)
        {
        AllDFOn = 0;
        putValue(ADC_G_ActiveDF_01, 0);
        putValue(ADC_G_ActiveDF_02, 0);
        putValue(ADC_G_ActiveDF_03, 0);
        putValue(ADC_G_ActiveDF_04, 0);
        putValue(ADC_G_ActiveDF_05, 0);
        putValue(ADC_G_ActiveDF_06, 0);
        putValue(ADC_G_ActiveDF_07, 0);
        putValue(ADC_G_ActiveDF_08, 0);
        putValue(ADC_G_ActiveDF_09, 0);
        putValue(ADC_G_ActiveDF_10, 0);
        putValue(ADC_G_ActiveDF_11, 0);
        putValue(ADC_G_ActiveDF_12, 0);
        putValue(ADC_G_ActiveDF_13, 0);
        putValue(ADC_G_ActiveDF_14, 0);
        putValue(ADC_G_ActiveDF_15, 0);
        putValue(ADC_G_ActiveDF_16, 0);
        }
    else
        {
        AllDFOn = 1;
        putValue(ADC_G_ActiveDF_01, 1);
        putValue(ADC_G_ActiveDF_02, 1);
        putValue(ADC_G_ActiveDF_03, 1);
        putValue(ADC_G_ActiveDF_04, 1);
        putValue(ADC_G_ActiveDF_05, 1);
        putValue(ADC_G_ActiveDF_06, 1);
        putValue(ADC_G_ActiveDF_07, 1);
        putValue(ADC_G_ActiveDF_08, 1);
        putValue(ADC_G_ActiveDF_09, 1);
        putValue(ADC_G_ActiveDF_10, 1);
        putValue(ADC_G_ActiveDF_11, 1);
        putValue(ADC_G_ActiveDF_12, 1);
        putValue(ADC_G_ActiveDF_13, 1);
        putValue(ADC_G_ActiveDF_14, 1);
        putValue(ADC_G_ActiveDF_15, 1);
        putValue(ADC_G_ActiveDF_16, 1);
        }        
    }
}

on timer msTimer_Reply_AUD
{
    if( !getValue( HMI__STMSG_TP_TGW_IC_Aud ) )
        CanTpSendData( lAudHandle, TxBuffer_AUD, 5 );
}

on timer msTimer_Reply_NAV
{
    if( !getValue( HMI__STMSG_TP_TGW_IC_Nav ) )
        CanTpSendData(lNavHandle, TxBuffer_NAV, 5);
}

on timer msTimer_Reply_TEL
{
    if( !getValue( HMI__STMSG_TP_TGW_IC_Tel ) )
        CanTpSendData(lTelHandle, TxBuffer_TEL, 5);
}

on timer msTimer_Reply_HUD
{
    if( !getValue( HMI__STMSG_TP_TGW_IC_HUD ) )
        CanTpSendData(lHUDHandle, TxBuffer_HUD, 5);
}

on timer msTimer_Reply_SCA
{
    if( !getValue( HMI__STMSG_TP_TGW_IC_SCA ) )
        CanTpSendData(lSCAHandle, TxBuffer_SCA, 5);
}

on envVar ADC_E_SetEvMask
{
if (getValue(this) == 1)
    {
    if (AllEvMaskOn == 1)
        {
        AllEvMaskOn = 0;
        putValue(ADC_E_EvReturn, 0);
        putValue(ADC_E_EvLongBack, 0);
        putValue(ADC_E_EvLongOK, 0);
        putValue(ADC_E_EvRelLongBack, 0);
        putValue(ADC_E_EvRelLongOK, 0);
        putValue(ADC_E_EvRelShortBack, 0);
        putValue(ADC_E_EvRelShortOK, 0);
        putValue(ADC_E_EvShortBack, 0);
        putValue(ADC_E_EvShortOK, 0);
        putValue(ADC_E_EvOFNUp, 0);
        putValue(ADC_E_EvOFNDown, 0);	
        putValue(ADC_E_EvOFNLeft, 0);
        putValue(ADC_E_EvOFNRight, 0);
        }
    else
        {
        AllEvMaskOn = 1;
        putValue(ADC_E_EvReturn, 1);
        putValue(ADC_E_EvLongBack, 1);
        putValue(ADC_E_EvLongOK, 1);
        putValue(ADC_E_EvRelLongBack, 1);
        putValue(ADC_E_EvRelLongOK, 1);
        putValue(ADC_E_EvRelShortBack, 1);
        putValue(ADC_E_EvRelShortOK, 1);
        putValue(ADC_E_EvShortBack, 1);
        putValue(ADC_E_EvShortOK, 1);
        putValue(ADC_E_EvOFNUp, 1);
        putValue(ADC_E_EvOFNDown, 1);	
        putValue(ADC_E_EvOFNLeft, 1);
        putValue(ADC_E_EvOFNRight, 1);
        }        
    }
}

on envVar ADC_Z_SendData
{
    byte bGridId;
    
    if (getValue(this) == 1)
    {
        bGridId = getValue(ADC_C_GridId);
        vSendADCData(bGridId);
    }
}

on envVar ADC_Z_SendAcoustics
{
    if (getValue(this) == 1)
    {
        vSendAcoustics();
    }
}

byte bGetConfigurationLB()
{
    byte bTemp;
    bTemp = 0;
    bTemp |= (getValue(ADC_D_FontVariant) << 7) & 0x80;
    bTemp |= (getValue(ADC_D_LayoutSettings) << 5) & 0x20;
    bTemp |= (getValue(ADC_D_Animation) << 4) & 0x10;
    bTemp |= (getValue(ADC_D_MultiLine) << 3) & 0x08;
    bTemp |= (getValue(ADC_D_ActiveDataFields) << 2) & 0x04;
    bTemp |= (getValue(ADC_D_IconSet) << 1) & 0x02;
    bTemp |= getValue(ADC_D_EvMaskSet) & 0x01;
    return bTemp;
}

byte bGetEvMaskLB ()
{
    byte bTemp;
    bTemp = 0;
    bTemp |= (getValue(ADC_E_EvOFNDown) << 4) & 0x10;
    bTemp |= getValue(ADC_E_EvOFNUp) & 0x01;
    return bTemp;
}

byte bGetEvMaskMB ()
{
    byte bTemp;
    bTemp = 0;
    bTemp |= (getValue(ADC_E_EvRelLongBack) << 7) & 0x80;
    bTemp |= (getValue(ADC_E_EvRelShortBack) << 6) & 0x40;
    bTemp |= (getValue(ADC_E_EvLongBack) << 5) & 0x20;
    bTemp |= (getValue(ADC_E_EvShortBack) << 4) & 0x10;
    bTemp |= (getValue(ADC_E_EvRelLongOK) << 3) & 0x08;
    bTemp |= (getValue(ADC_E_EvRelShortOK) << 2) & 0x04;
    bTemp |= (getValue(ADC_E_EvLongOK) << 1) & 0x02;
    bTemp |= getValue(ADC_E_EvShortOK) & 0x01;
    return bTemp;
}

byte bGetEvMaskHB ()
{
    byte bTemp;
    bTemp = 0;
    bTemp |= (getValue(ADC_E_EvReturn) << 7) & 0x80;
    bTemp |= (getValue(ADC_E_EvOFNLeft) << 3) & 0x08;
    bTemp |= (getValue(ADC_E_EvOFNRight) << 2) & 0x04;
    return bTemp;
}

byte bGetIconsTable ()
{
    byte bTemp;
    bTemp = 0;
    bTemp |= (getValue(ADC_F_IconDownKombiVisible) << 3) & 0x08;
    bTemp |= (getValue(ADC_F_IconUpKombiVisible) << 2) & 0x04;
    bTemp |= (getValue(ADC_F_IconDownListVisible) << 1) & 0x02;
    bTemp |= getValue(ADC_F_IconUpListVisible) & 0x01;
    return bTemp;
}

byte bGetActiveDF_LB ()
{
    byte bTemp;
    bTemp = 0;
    bTemp |= (getValue(ADC_G_ActiveDF_08) << 7) & 0x80;
    bTemp |= (getValue(ADC_G_ActiveDF_07) << 6) & 0x40;
    bTemp |= (getValue(ADC_G_ActiveDF_06) << 5) & 0x20;
    bTemp |= (getValue(ADC_G_ActiveDF_05) << 4) & 0x10;
    bTemp |= (getValue(ADC_G_ActiveDF_04) << 3) & 0x08;
    bTemp |= (getValue(ADC_G_ActiveDF_03) << 2) & 0x04;
    bTemp |= (getValue(ADC_G_ActiveDF_02) << 1) & 0x02;
    bTemp |= getValue(ADC_G_ActiveDF_01) & 0x01;
    return bTemp;
}

byte bGetActiveDF_HB ()
{
    byte bTemp;
    bTemp = 0;
    bTemp |= (getValue(ADC_G_ActiveDF_16) << 7) & 0x80;
    bTemp |= (getValue(ADC_G_ActiveDF_15) << 6) & 0x40;
    bTemp |= (getValue(ADC_G_ActiveDF_14) << 5) & 0x20;
    bTemp |= (getValue(ADC_G_ActiveDF_13) << 4) & 0x10;
    bTemp |= (getValue(ADC_G_ActiveDF_12) << 3) & 0x08;
    bTemp |= (getValue(ADC_G_ActiveDF_11) << 2) & 0x04;
    bTemp |= (getValue(ADC_G_ActiveDF_10) << 1) & 0x02;
    bTemp |= getValue(ADC_G_ActiveDF_09) & 0x01;
    return bTemp;
}

void vInitDataFields ()
{
    putValue(ADC_H_DF_01, "D01");
    putValue(ADC_H_DF_02, "D02");
    putValue(ADC_H_DF_03, "D03");
    putValue(ADC_H_DF_04, "D04");
    putValue(ADC_H_DF_05, "D05");
    putValue(ADC_H_DF_06, "D06");
    putValue(ADC_H_DF_07, "D07");
    putValue(ADC_H_DF_08, "D08");
    putValue(ADC_H_DF_09, "D09");
    putValue(ADC_H_DF_10, "D10");
    putValue(ADC_H_DF_11, "D11");
    putValue(ADC_H_DF_12, "D12");
    putValue(ADC_H_DF_13, "D13");
    putValue(ADC_H_DF_14, "D14");
    putValue(ADC_H_DF_15, "D15");
    putValue(ADC_H_DF_16, "D16");
    // Initialization to default
    // Data Field 1
    putValue(ADC_H_Selectable_01, 0); // Default
    putValue(ADC_H_Selected_01, 0); // Default
    putValue(ADC_H_HighL_01, 0); // Default
    putValue(ADC_H_Truncation_01, 0); // Default
    putValue(ADC_H_DFDataType_01, 0); // Default
    putValue(ADC_H_Progression_01, 0); // Default
    putValue(ADC_H_Alignment_01, 0); // Default
    putValue(ADC_H_IconPos_01, 0); // Default
    putValue(ADC_H_Inactive_01, 0); // Default
    putValue(ADC_H_Separator_01, 0); // Default
    // Data Field 2
    putValue(ADC_H_Selectable_02, 0); // Default
    putValue(ADC_H_Selected_02, 0); // Default
    putValue(ADC_H_HighL_02, 0); // Default
    putValue(ADC_H_Truncation_02, 0); // Default
    putValue(ADC_H_DFDataType_02, 0); // Default
    putValue(ADC_H_Progression_02, 0); // Default
    putValue(ADC_H_Alignment_02, 0); // Default
    putValue(ADC_H_IconPos_02, 0); // Default
    putValue(ADC_H_Inactive_02, 0); // Default
    putValue(ADC_H_Separator_02, 0); // Default
    // Data Field 3
    putValue(ADC_H_Selectable_03, 0); // Default
    putValue(ADC_H_Selected_03, 0); // Default
    putValue(ADC_H_HighL_03, 0); // Default
    putValue(ADC_H_Truncation_03, 0); // Default
    putValue(ADC_H_DFDataType_03, 0); // Default
    putValue(ADC_H_Progression_03, 0); // Default
    putValue(ADC_H_Alignment_03, 0); // Default
    putValue(ADC_H_IconPos_03, 0); // Default
    putValue(ADC_H_Inactive_03, 0); // Default
    putValue(ADC_H_Separator_03, 0); // Default
    // Data Field 4
    putValue(ADC_H_Selectable_04, 0); // Default
    putValue(ADC_H_Selected_04, 0); // Default
    putValue(ADC_H_HighL_04, 0); // Default
    putValue(ADC_H_Truncation_04, 0); // Default
    putValue(ADC_H_DFDataType_04, 0); // Default
    putValue(ADC_H_Progression_04, 0); // Default
    putValue(ADC_H_Alignment_04, 0); // Default
    putValue(ADC_H_IconPos_04, 0); // Default
    putValue(ADC_H_Inactive_04, 0); // Default
    putValue(ADC_H_Separator_04, 0); // Default
    // Data Field 5
    putValue(ADC_H_Selectable_05, 0); // Default
    putValue(ADC_H_Selected_05, 0); // Default
    putValue(ADC_H_HighL_05, 0); // Default
    putValue(ADC_H_Truncation_05, 0); // Default
    putValue(ADC_H_DFDataType_05, 0); // Default
    putValue(ADC_H_Progression_05, 0); // Default
    putValue(ADC_H_Alignment_05, 0); // Default
    putValue(ADC_H_IconPos_05, 0); // Default
    putValue(ADC_H_Inactive_05, 0); // Default
    putValue(ADC_H_Separator_05, 0); // Default
    // Data Field 6
    putValue(ADC_H_Selectable_06, 0); // Default
    putValue(ADC_H_Selected_06, 0); // Default
    putValue(ADC_H_HighL_06, 0); // Default
    putValue(ADC_H_Truncation_06, 0); // Default
    putValue(ADC_H_DFDataType_06, 0); // Default
    putValue(ADC_H_Progression_06, 0); // Default
    putValue(ADC_H_Alignment_06, 0); // Default
    putValue(ADC_H_IconPos_06, 0); // Default
    putValue(ADC_H_Inactive_06, 0); // Default
    putValue(ADC_H_Separator_06, 0); // Default
    // Data Field 7
    putValue(ADC_H_Selectable_07, 0); // Default
    putValue(ADC_H_Selected_07, 0); // Default
    putValue(ADC_H_HighL_07, 0); // Default
    putValue(ADC_H_Truncation_07, 0); // Default
    putValue(ADC_H_DFDataType_07, 0); // Default
    putValue(ADC_H_Progression_07, 0); // Default
    putValue(ADC_H_Alignment_07, 0); // Default
    putValue(ADC_H_IconPos_07, 0); // Default
    putValue(ADC_H_Inactive_07, 0); // Default
    putValue(ADC_H_Separator_07, 0); // Default
    // Data Field 8
    putValue(ADC_H_Selectable_08, 0); // Default
    putValue(ADC_H_Selected_08, 0); // Default
    putValue(ADC_H_HighL_08, 0); // Default
    putValue(ADC_H_Truncation_08, 0); // Default
    putValue(ADC_H_DFDataType_08, 0); // Default
    putValue(ADC_H_Progression_08, 0); // Default
    putValue(ADC_H_Alignment_08, 0); // Default
    putValue(ADC_H_IconPos_08, 0); // Default
    putValue(ADC_H_Inactive_08, 0); // Default
    putValue(ADC_H_Separator_08, 0); // Default
    // Data Field 9
    putValue(ADC_H_Selectable_09, 0); // Default
    putValue(ADC_H_Selected_09, 0); // Default
    putValue(ADC_H_HighL_09, 0); // Default
    putValue(ADC_H_Truncation_09, 0); // Default
    putValue(ADC_H_DFDataType_09, 0); // Default
    putValue(ADC_H_Progression_09, 0); // Default
    putValue(ADC_H_Alignment_09, 0); // Default
    putValue(ADC_H_IconPos_09, 0); // Default
    putValue(ADC_H_Inactive_09, 0); // Default
    putValue(ADC_H_Separator_09, 0); // Default
    // Data Field 10
    putValue(ADC_H_Selectable_10, 0); // Default
    putValue(ADC_H_Selected_10, 0); // Default
    putValue(ADC_H_HighL_10, 0); // Default
    putValue(ADC_H_Truncation_10, 0); // Default
    putValue(ADC_H_DFDataType_10, 0); // Default
    putValue(ADC_H_Progression_10, 0); // Default
    putValue(ADC_H_Alignment_10, 0); // Default
    putValue(ADC_H_IconPos_10, 0); // Default
    putValue(ADC_H_Inactive_10, 0); // Default
    putValue(ADC_H_Separator_10, 0); // Default
    // Data Field 11
    putValue(ADC_H_Selectable_11, 0); // Default
    putValue(ADC_H_Selected_11, 0); // Default
    putValue(ADC_H_HighL_11, 0); // Default
    putValue(ADC_H_Truncation_11, 0); // Default
    putValue(ADC_H_DFDataType_11, 0); // Default
    putValue(ADC_H_Progression_11, 0); // Default
    putValue(ADC_H_Alignment_11, 0); // Default
    putValue(ADC_H_IconPos_11, 0); // Default
    putValue(ADC_H_Inactive_11, 0); // Default
    putValue(ADC_H_Separator_11, 0); // Default
    // Data Field 12
    putValue(ADC_H_Selectable_12, 0); // Default
    putValue(ADC_H_Selected_12, 0); // Default
    putValue(ADC_H_HighL_12, 0); // Default
    putValue(ADC_H_Truncation_12, 0); // Default
    putValue(ADC_H_DFDataType_12, 0); // Default
    putValue(ADC_H_Progression_12, 0); // Default
    putValue(ADC_H_Alignment_12, 0); // Default
    putValue(ADC_H_IconPos_12, 0); // Default
    putValue(ADC_H_Inactive_12, 0); // Default
    putValue(ADC_H_Separator_12, 0); // Default
    // Data Field 13
    putValue(ADC_H_Selectable_13, 0); // Default
    putValue(ADC_H_Selected_13, 0); // Default
    putValue(ADC_H_HighL_13, 0); // Default
    putValue(ADC_H_Truncation_13, 0); // Default
    putValue(ADC_H_DFDataType_13, 0); // Default
    putValue(ADC_H_Progression_13, 0); // Default
    putValue(ADC_H_Alignment_13, 0); // Default
    putValue(ADC_H_IconPos_13, 0); // Default
    putValue(ADC_H_Inactive_13, 0); // Default
    putValue(ADC_H_Separator_13, 0); // Default
    // Data Field 14
    putValue(ADC_H_Selectable_14, 0); // Default
    putValue(ADC_H_Selected_14, 0); // Default
    putValue(ADC_H_HighL_14, 0); // Default
    putValue(ADC_H_Truncation_14, 0); // Default
    putValue(ADC_H_DFDataType_14, 0); // Default
    putValue(ADC_H_Progression_14, 0); // Default
    putValue(ADC_H_Alignment_14, 0); // Default
    putValue(ADC_H_IconPos_14, 0); // Default
    putValue(ADC_H_Inactive_14, 0); // Default
    putValue(ADC_H_Separator_14, 0); // Default
    // Data Field 15
    putValue(ADC_H_Selectable_15, 0); // Default
    putValue(ADC_H_Selected_15, 0); // Default
    putValue(ADC_H_HighL_15, 0); // Default
    putValue(ADC_H_Truncation_15, 0); // Default
    putValue(ADC_H_DFDataType_15, 0); // Default
    putValue(ADC_H_Progression_15, 0); // Default
    putValue(ADC_H_Alignment_15, 0); // Default
    putValue(ADC_H_IconPos_15, 0); // Default
    putValue(ADC_H_Inactive_15, 0); // Default
    putValue(ADC_H_Separator_15, 0); // Default
    // Data Field 16
    putValue(ADC_H_Selectable_16, 0); // Default
    putValue(ADC_H_Selected_16, 0); // Default
    putValue(ADC_H_HighL_16, 0); // Default
    putValue(ADC_H_Truncation_16, 0); // Default
    putValue(ADC_H_DFDataType_16, 0); // Default
    putValue(ADC_H_Progression_16, 0); // Default
    putValue(ADC_H_Alignment_16, 0); // Default
    putValue(ADC_H_IconPos_16, 0); // Default
    putValue(ADC_H_Inactive_16, 0); // Default
    putValue(ADC_H_Separator_16, 0); // Default
    // End of initialization to default
}

on envVar ADC_J_Lane1_Art
{
    abLaneArt[0] = getValue(ADC_J_Lane1_Art);
}

on envVar ADC_J_Lane2_Art
{
    abLaneArt[1] = getValue(ADC_J_Lane2_Art);
}

on envVar ADC_J_Lane3_Art
{
    abLaneArt[2] = getValue(ADC_J_Lane3_Art);
}

on envVar ADC_J_Lane4_Art
{
    abLaneArt[3] = getValue(ADC_J_Lane4_Art);
}

on envVar ADC_J_Lane5_Art
{
    abLaneArt[4] = getValue(ADC_J_Lane5_Art);
}

on envVar ADC_J_Lane6_Art
{
    abLaneArt[5] = getValue(ADC_J_Lane6_Art);
}

on envVar ADC_J_Lane7_Art
{
    abLaneArt[6] = getValue(ADC_J_Lane7_Art);
}

on envVar ADC_J_Lane8_Art
{
    abLaneArt[7] = getValue(ADC_J_Lane8_Art);
}

on envVar ADC_J_Lane1_Shape
{
    abLaneShape[0] = getValue(ADC_J_Lane1_Shape);
}

on envVar ADC_J_Lane2_Shape
{
    abLaneShape[1] = getValue(ADC_J_Lane2_Shape);
}

on envVar ADC_J_Lane3_Shape
{
    abLaneShape[2] = getValue(ADC_J_Lane3_Shape);
}

on envVar ADC_J_Lane4_Shape
{
    abLaneShape[3] = getValue(ADC_J_Lane4_Shape);
}

on envVar ADC_J_Lane5_Shape
{
    abLaneShape[4] = getValue(ADC_J_Lane5_Shape);
}

on envVar ADC_J_Lane6_Shape
{
    abLaneShape[5] = getValue(ADC_J_Lane6_Shape);
}

on envVar ADC_J_Lane7_Shape
{
    abLaneShape[6] = getValue(ADC_J_Lane7_Shape);
}

on envVar ADC_J_Lane8_Shape
{
    abLaneShape[7] = getValue(ADC_J_Lane8_Shape);
}

on envVar ADC_J_Lane1_Direction
{
    abLaneDirection[0] = getValue(ADC_J_Lane1_Direction);
}

on envVar ADC_J_Lane2_Direction
{
    abLaneDirection[1] = getValue(ADC_J_Lane2_Direction);
}

on envVar ADC_J_Lane3_Direction
{
    abLaneDirection[2] = getValue(ADC_J_Lane3_Direction);
}

on envVar ADC_J_Lane4_Direction
{
    abLaneDirection[3] = getValue(ADC_J_Lane4_Direction);
}

on envVar ADC_J_Lane5_Direction
{
    abLaneDirection[4] = getValue(ADC_J_Lane5_Direction);
}

on envVar ADC_J_Lane6_Direction
{
    abLaneDirection[5] = getValue(ADC_J_Lane6_Direction);
}

on envVar ADC_J_Lane7_Direction
{
    abLaneDirection[6] = getValue(ADC_J_Lane7_Direction);
}

on envVar ADC_J_Lane8_Direction
{
    abLaneDirection[7] = getValue(ADC_J_Lane8_Direction);
}

on envVar ADC_J_Lane1_Color
{
    abLaneColor[0] =  ((getValue(ADC_J_Lane1_Color) & 0x03) | (abLaneColor[0] & 0xFC)); //set 0. bit and 1.bit used for color and keep all next bits
}

on envVar ADC_J_Lane2_Color
{
    abLaneColor[1] =  ((getValue(ADC_J_Lane2_Color) & 0x03) | (abLaneColor[1] & 0xFC)); //set 0. bit and 1.bit used for color and keep all next bits
}

on envVar ADC_J_Lane3_Color
{
    abLaneColor[2] =  ((getValue(ADC_J_Lane3_Color) & 0x03) | (abLaneColor[2] & 0xFC)); //set 0. bit and 1.bit used for color and keep all next bits
}

on envVar ADC_J_Lane4_Color
{
    abLaneColor[3] =  ((getValue(ADC_J_Lane4_Color) & 0x03) | (abLaneColor[3] & 0xFC)); //set 0. bit and 1.bit used for color and keep all next bits
}

on envVar ADC_J_Lane5_Color
{
    abLaneColor[4] =  ((getValue(ADC_J_Lane5_Color) & 0x03) | (abLaneColor[4] & 0xFC)); //set 0. bit and 1.bit used for color and keep all next bits
}

on envVar ADC_J_Lane6_Color
{
    abLaneColor[5] =  ((getValue(ADC_J_Lane6_Color) & 0x03) | (abLaneColor[5] & 0xFC)); //set 0. bit and 1.bit used for color and keep all next bits
}

on envVar ADC_J_Lane7_Color
{
    abLaneColor[6] =  ((getValue(ADC_J_Lane7_Color) & 0x03) | (abLaneColor[6] & 0xFC)); //set 0. bit and 1.bit used for color and keep all next bits
}

on envVar ADC_J_Lane8_Color
{
    abLaneColor[7] =  ((getValue(ADC_J_Lane8_Color) & 0x03) | (abLaneColor[7] & 0xFC)); //set 0. bit and 1.bit used for color and keep all next bits
}

word wSpecialData (word wIndex, byte bType)
{
    word wTemp, wBuf;
    byte k, bSegments;
    byte bData[32];
    long lGraphic;

    wTemp = wBuf = wIndex;
    switch (bType)
        {
            case 0x01:  //Lane Guidance
                bSegments = getValue(ADC_J_NrOfLanes);
                if (bSegments > 0)
                {    
                    TxBuffer[wBuf++] = LaneG; //Group Lane Guidance
                    TxBuffer[wBuf++] = (bSegments*4) + 1;
                    for(k=0;k < bSegments;k++)
                    {
                        TxBuffer[wBuf++]=abLaneShape[k];
                        TxBuffer[wBuf++]=abLaneDirection[k];
                        TxBuffer[wBuf++]=abLaneColor[k];
                        TxBuffer[wBuf++]=abLaneArt[k];                      
                    }
                    TxBuffer[wBuf++]=abLaneShape[k];
                    
                }
            break;
            case 0x11:   //Bargraph
                TxBuffer[wBuf++] = Bargraph;
                TxBuffer[wBuf++] = getValue(ADC_K_Bargraph);
            break;
            case 0x21:
                TxBuffer[wBuf++] = Turns;
                lGraphic = getValue(ADC_K_Turn, bData);
                for(k=0;k < lGraphic;k++)
                    {
                        TxBuffer[wBuf++]=bData[k];                   
                    }
            break;
            case 0x22:
                TxBuffer[wBuf++] = Places_225;
                lGraphic = getValue(ADC_K_Place, bData);
                for(k=0;k < lGraphic;k++)
                    {
                        TxBuffer[wBuf++]=bData[k];                   
                    }
            break;
            case 0x23:
                TxBuffer[wBuf++] = Roundabouts_225;
                lGraphic = getValue(ADC_K_Round_225, bData);
                for(k=0;k < lGraphic;k++)
                    {
                        TxBuffer[wBuf++]=bData[k];                   
                    }
            break;
            case 0x24:
                TxBuffer[wBuf++] = Roundabouts_300;
                lGraphic = getValue(ADC_K_Round_300, bData);
                for(k=0;k < lGraphic;k++)
                    {
                        TxBuffer[wBuf++]=bData[k];                   
                    }
            break;
            case 0x25:
                TxBuffer[wBuf++] = Compass;
                TxBuffer[wBuf++] = getValue(ADC_K_Compass);
            break;
            case 0x26:
                TxBuffer[wBuf++] = Flags;
                TxBuffer[wBuf++] = getValue(ADC_K_Flag);
            break;
            case 0x27:
                TxBuffer[wBuf++] = Highways;
                lGraphic = getValue(ADC_K_Highways, bData);
                for(k=0;k < lGraphic;k++)
                    {
                        TxBuffer[wBuf++]=bData[k];                   
                    }
            break;
            case 0x28:
                TxBuffer[wBuf++] = HOVHighways;
                lGraphic = getValue(ADC_K_HOV_Highways, bData);
                for(k=0;k < lGraphic;k++)
                    {
                        TxBuffer[wBuf++]=bData[k];                   
                    }
            break;
            default:
            break;
        }
    return (wBuf - wTemp);
}

void vInitLaneGuidance ()
{
   putValue(ADC_J_NrOfLanes,2);

   putValue(ADC_J_Lane1_Shape,1);
   putValue(ADC_J_Lane1_Direction,1);
   putValue(ADC_J_Lane1_Color,0);
   putValue(ADC_J_Lane1_Art,0);
   
   putValue(ADC_J_Lane2_Shape,3);
   putValue(ADC_J_Lane2_Direction,9);
   putValue(ADC_J_Lane2_Color,1);
   putValue(ADC_J_Lane2_Art,0);

   putValue(ADC_J_Lane3_Shape,0);
   putValue(ADC_J_Lane3_Direction,0);
   putValue(ADC_J_Lane3_Color,0);
   putValue(ADC_J_Lane3_Art,0);

   putValue(ADC_J_Lane4_Shape,0);
   putValue(ADC_J_Lane4_Direction,0);
   putValue(ADC_J_Lane4_Color,0);
   putValue(ADC_J_Lane4_Art,0);

   putValue(ADC_J_Lane5_Shape,0);
   putValue(ADC_J_Lane5_Direction,0);
   putValue(ADC_J_Lane5_Color,0);
   putValue(ADC_J_Lane5_Art,0);

   putValue(ADC_J_Lane6_Shape,0);
   putValue(ADC_J_Lane6_Direction,0);
   putValue(ADC_J_Lane6_Color,0);
   putValue(ADC_J_Lane6_Art,0);

   putValue(ADC_J_Lane7_Shape,0);
   putValue(ADC_J_Lane7_Direction,0);
   putValue(ADC_J_Lane7_Color,0);
   putValue(ADC_J_Lane7_Art,0);

   putValue(ADC_J_Lane8_Shape,0);
   putValue(ADC_J_Lane8_Direction,0);
   putValue(ADC_J_Lane8_Color,0);
   putValue(ADC_J_Lane8_Art,0);

}

on envVar ADC_K_Special_DF01
{
    abDFSpecialType[0] = getValue(this);
    if (getValue(this) != 0x00)
        putValue(ADC_H_Special_01, 1);
    else
        putValue(ADC_H_Special_01, 0);
}

on envVar ADC_K_Special_DF02
{
    abDFSpecialType[1] = getValue(this);
    if (getValue(this) != 0x00)
        putValue(ADC_H_Special_02, 1);
    else
        putValue(ADC_H_Special_02, 0);
}

on envVar ADC_K_Special_DF03
{
    abDFSpecialType[2] = getValue(this);
    if (getValue(this) != 0x00)
        putValue(ADC_H_Special_03, 1);
    else
        putValue(ADC_H_Special_03, 0);
}

on envVar ADC_K_Special_DF04
{
    abDFSpecialType[3] = getValue(this);
    if (getValue(this) != 0x00)
        putValue(ADC_H_Special_04, 1);
    else
        putValue(ADC_H_Special_04, 0);
}

on envVar ADC_K_Special_DF05
{
    abDFSpecialType[4] = getValue(this);
    if (getValue(this) != 0x00)
        putValue(ADC_H_Special_05, 1);
    else
        putValue(ADC_H_Special_05, 0);
}

on envVar ADC_K_Special_DF06
{
    abDFSpecialType[5] = getValue(this);
    if (getValue(this) != 0x00)
        putValue(ADC_H_Special_06, 1);
    else
        putValue(ADC_H_Special_06, 0);
}

on envVar ADC_K_Special_DF07
{
    abDFSpecialType[6] = getValue(this);
    if (getValue(this) != 0x00)
        putValue(ADC_H_Special_07, 1);
    else
        putValue(ADC_H_Special_07, 0);
}

on envVar ADC_K_Special_DF08
{
    abDFSpecialType[7] = getValue(this);
    if (getValue(this) != 0x00)
        putValue(ADC_H_Special_08, 1);
    else
        putValue(ADC_H_Special_08, 0);
}

on envVar ADC_K_Special_DF09
{
    abDFSpecialType[8] = getValue(this);
    if (getValue(this) != 0x00)
        putValue(ADC_H_Special_09, 1);
    else
        putValue(ADC_H_Special_09, 0);
}

on envVar ADC_K_Special_DF10
{
    abDFSpecialType[9] = getValue(this);
    if (getValue(this) != 0x00)
        putValue(ADC_H_Special_10, 1);
    else
        putValue(ADC_H_Special_10, 0);
}

on envVar ADC_K_Special_DF11
{
    abDFSpecialType[10] = getValue(this);
    if (getValue(this) != 0x00)
        putValue(ADC_H_Special_11, 1);
    else
        putValue(ADC_H_Special_11, 0);
}

on envVar ADC_K_Special_DF12
{
    abDFSpecialType[11] = getValue(this);
    if (getValue(this) != 0x00)
        putValue(ADC_H_Special_12, 1);
    else
        putValue(ADC_H_Special_12, 0);
}

on envVar ADC_K_Special_DF13
{
    abDFSpecialType[12] = getValue(this);
    if (getValue(this) != 0x00)
        putValue(ADC_H_Special_13, 1);
    else
        putValue(ADC_H_Special_13, 0);
}

on envVar ADC_K_Special_DF14
{
    abDFSpecialType[13] = getValue(this);
    if (getValue(this) != 0x00)
        putValue(ADC_H_Special_14, 1);
    else
        putValue(ADC_H_Special_14, 0);
}

on envVar ADC_K_Special_DF15
{
    abDFSpecialType[14] = getValue(this);
    if (getValue(this) != 0x00)
        putValue(ADC_H_Special_15, 1);
    else
        putValue(ADC_H_Special_15, 0);
}

on envVar ADC_K_Special_DF16
{
    abDFSpecialType[15] = getValue(this);
    if (getValue(this) != 0x00)
        putValue(ADC_H_Special_16, 1);
    else
        putValue(ADC_H_Special_16, 0);
}

byte bGetGraphicLength (byte bVal)
{
byte bRet, bSegments;
byte bData[32];

    switch (bVal)
        {
            case 0x01:  //Lane Guidance
                bSegments = getValue(ADC_J_NrOfLanes);
                bRet = (bSegments*4) + 3;
            break;
            case 0x21:
                bRet = getValue(ADC_K_Turn, bData);
                bRet = bRet+1;
            break;
            case 0x22:
                bRet = getValue(ADC_K_Place, bData);
                bRet = bRet+1;
            break;
            case 0x23:
                bRet = getValue(ADC_K_Round_225, bData);
                bRet = bRet+1;
            break;
            case 0x24:
                bRet = getValue(ADC_K_Round_300, bData);
                bRet = bRet+1;
            break;
            case 0x27:
                bRet = getValue(ADC_K_Highways, bData);
                bRet = bRet+1;
            break;
            case 0x28:
                bRet = getValue(ADC_K_HOV_Highways, bData);
                bRet = bRet+1;
            break;
            case 0x11:
            case 0x25:
            case 0x26:
                bRet = 2;
            break;
            default:
            break;
        }
return bRet;
}

on envVar ADC_C_GridId
{
    byte bGrid;
    vInitAll();

    bGrid = getValue(this);

    switch(bGrid)
    {
        case 2:             vSetupGrid02();        break;
        case 4:             vSetupGrid04();        break;
        case 5:             vSetupGrid05();        break;
        case 6:             vSetupGrid06();        break;
        case 7:             vSetupGrid07();        break;
        case 8:             vSetupGrid08();        break;
        case 9:             vSetupGrid09();        break;
        case 10:            vSetupGrid10();        break;
        case 18:            vSetupGrid18();        break;
        case 21:            vSetupGrid21();        break;
        case 22:            vSetupGrid22();        break;
        case 23:            vSetupGrid23();        break;
        case 24:            vSetupGrid24();        break;
        case 25:            vSetupGrid25();        break;
        case 26:            vSetupGrid26();        break;
        case 27:            vSetupGrid27();        break;
        case 28:            vSetupGrid28();        break;
        case 29:            vSetupGrid29();        break;
        case 30:            vSetupGrid30();        break;
        case 31:            vSetupGrid31();        break;
        case 32:            vSetupGrid32();        break;
        case 33:            vSetupGrid33();        break;
        case 34:            vSetupGrid34();        break;
        case 35:            vSetupGrid35();        break;
        case 36:            vSetupGrid36();        break;
        case 40:            vSetupGrid40();        break;
        case 41:            vSetupGrid41();        break;
        case 42:            vSetupGrid42();        break;
        case 43:            vSetupGrid43();        break;
        case 45:            vSetupGrid45();        break;
        case 56:            vSetupGrid56();        break;
        case 57:            vSetupGrid57();        break;
        case 63:            vSetupGrid63();        break;
        case 64:            vSetupGrid64();        break;
        case 65:            vSetupGrid65();        break;
        case 66:            vSetupGrid66();        break;
        case 67:            vSetupGrid67();        break;
        case 74:            vSetupGrid74();        break;
        case 75:            vSetupGrid75();        break;
        case 79:            vSetupGrid79();        break;
        case 80:            vSetupGrid80();        break;
        case 81:            vSetupGrid81();        break;
        case 84:            vSetupGrid84();        break;
        case 87:            vSetupGrid87();        break;		  
        case 208:           vSetupGrid208();       break;
        case 3:             vSetupGrid03();        break;
        case 255:           vSetupGridInvalid();   break;
    }
}

void vInitUCBMove()
{
    putValue(ADC_G_UpdateCfg_01, 0);
    putValue(ADC_G_UpdateCfg_02, 0);
    putValue(ADC_G_UpdateCfg_03, 0);
    putValue(ADC_G_UpdateCfg_04, 0);
    putValue(ADC_G_UpdateCfg_05, 0);
    putValue(ADC_G_UpdateCfg_06, 0);
    putValue(ADC_G_UpdateCfg_07, 0);
    putValue(ADC_G_UpdateCfg_08, 0);
    putValue(ADC_G_UpdateCfg_09, 0);
    putValue(ADC_G_UpdateCfg_10, 0);
    putValue(ADC_G_UpdateCfg_11, 0);
    putValue(ADC_G_UpdateCfg_12, 0);
    putValue(ADC_G_UpdateCfg_13, 0);
    putValue(ADC_G_UpdateCfg_14, 0);
    putValue(ADC_G_UpdateCfg_15, 0);
    putValue(ADC_G_UpdateCfg_16, 0);

    putValue(ADC_H_Move_01, 0);
    putValue(ADC_H_Move_02, 0);
    putValue(ADC_H_Move_03, 0);
    putValue(ADC_H_Move_04, 0);
    putValue(ADC_H_Move_05, 0);
    putValue(ADC_H_Move_06, 0);
    putValue(ADC_H_Move_07, 0);
    putValue(ADC_H_Move_08, 0);
    putValue(ADC_H_Move_09, 0);
    putValue(ADC_H_Move_10, 0);
    putValue(ADC_H_Move_11, 0);
    putValue(ADC_H_Move_12, 0);
    putValue(ADC_H_Move_13, 0);
    putValue(ADC_H_Move_14, 0);
    putValue(ADC_H_Move_15, 0);
    putValue(ADC_H_Move_16, 0);
}

void vInitActiveDF ()
{
    putValue(ADC_G_ActiveDF_01, 0);
    putValue(ADC_G_ActiveDF_02, 0);
    putValue(ADC_G_ActiveDF_03, 0);
    putValue(ADC_G_ActiveDF_04, 0);
    putValue(ADC_G_ActiveDF_05, 0);
    putValue(ADC_G_ActiveDF_06, 0);
    putValue(ADC_G_ActiveDF_07, 0);
    putValue(ADC_G_ActiveDF_08, 0);
    putValue(ADC_G_ActiveDF_09, 0);
    putValue(ADC_G_ActiveDF_10, 0);
    putValue(ADC_G_ActiveDF_11, 0);
    putValue(ADC_G_ActiveDF_12, 0);
    putValue(ADC_G_ActiveDF_13, 0);
    putValue(ADC_G_ActiveDF_14, 0);
    putValue(ADC_G_ActiveDF_15, 0);
    putValue(ADC_G_ActiveDF_16, 0);
}

void vInitSpecialDF()
{
    putValue(ADC_K_Special_DF01, 0);
    putValue(ADC_K_Special_DF02, 0);
    putValue(ADC_K_Special_DF03, 0);
    putValue(ADC_K_Special_DF04, 0);
    putValue(ADC_K_Special_DF05, 0);
    putValue(ADC_K_Special_DF06, 0);
    putValue(ADC_K_Special_DF07, 0);
    putValue(ADC_K_Special_DF08, 0);
    putValue(ADC_K_Special_DF09, 0);
    putValue(ADC_K_Special_DF10, 0);
    putValue(ADC_K_Special_DF11, 0);
    putValue(ADC_K_Special_DF12, 0);
    putValue(ADC_K_Special_DF13, 0);
    putValue(ADC_K_Special_DF14, 0);
    putValue(ADC_K_Special_DF15, 0);
    putValue(ADC_K_Special_DF16, 0);
}

void vInitGraphics ()
{
    byte bData1[3];
    byte bData2[2];
    
    bData1[0] = 0x01;
    bData1[1] = 0x01;
    bData1[2] = 0x00;
    bData2[0] = 0x01;
    bData2[1] = 0x00;

    putValue(ADC_K_Turn, bData2);
    putValue(ADC_K_Place, bData1);
    putValue(ADC_K_Round_300, bData1);
    putValue(ADC_K_Round_225, bData1);
    putValue(ADC_K_Highways, bData1);
    putValue(ADC_K_HOV_Highways, bData1);

    putValue(ADC_K_Bargraph, 50);
    putValue(ADC_K_Flag, 1);
    putValue(ADC_K_Compass, 1);
}

on envVar ADC_J_LastLane_Shape
{
    abLaneShape[8] = getValue(ADC_J_LastLane_Shape);
}

void CanTp_ErrorInd (long lHandle, long lError)
{
    vGetHandleName(lHandle);
    writeLineEx (dwWriteTab, 1, "Error for connection %s", cHdlName);
    switch (lError)
    {
        case 1:            writeLineEx (dwWriteTab, 1,"ADC: Timeout waiting for consecutive frame");        break;
        case 2:            writeLineEx (dwWriteTab, 1,"ADC: Timeout waiting for flow control");        break;
        case 4:            writeLineEx (dwWriteTab, 1,"ADC: TxBusy, only one transmission possible at the same time");        break;
        case 5:            writeLineEx (dwWriteTab, 1,"ADC: Received unexpected PDU");        break;
        case 6:            writeLineEx (dwWriteTab, 1,"ADC: Timeout while trying to send a CAN frame");        break;
        case 7:            writeLineEx (dwWriteTab, 1,"ADC: Too many FC.WFT sent");        break;
        case 8:            writeLineEx (dwWriteTab, 1,"ADC: Receiver buffer overflow");        break;
        case 9:            writeLineEx (dwWriteTab, 1,"ADC: Wrong parameter");        break;
        case 10:           writeLineEx (dwWriteTab, 1,"ADC: An invalid flow status was received in an expected FlowControl frame");        break;
        case 11:           writeLineEx (dwWriteTab, 1,"ADC: The data transfer has been aborted explicitly from the CAPL program");        break;
        case 12:           writeLineEx (dwWriteTab, 1,"ADC: No data has been provided for transmission in time");        break;
        default:           writeLineEx (dwWriteTab, 1,"ADC: Unknown error");        break;
    }

}

vSendADCData(byte bGridId)
{
word wSize;
byte bIndex;
byte bCnt;
byte bHMIModeWidgetID;
byte bGridFactor;
byte bDataGridFactorLB;
byte bDataGridFactorHB;
byte bApplication;
long lHandle;
    wSize = 0;
    bDataGridFactorLB = 0;
    bDataGridFactorHB = 0;
    bGridFactor = 0;
    bHMIModeWidgetID = 0;

    bHMIModeWidgetID |= (bGridFactor << 7)  & 0x80;
    bHMIModeWidgetID |= (getValue(ADC_C_HMIMode) << 3) & 0x78;
    bHMIModeWidgetID |= getValue(ADC_C_WidgetID) & 0x07;

    TxBuffer[wSize++] = getValue(ADC_A_NodeAddress);
    TxBuffer[wSize++] = getValue(ADC_B_Application);
    TxBuffer[wSize++] = ADC_DATA;
    TxBuffer[wSize++] = bTelegramCounter;
    TxBuffer[wSize++] = bHMIModeWidgetID;
    TxBuffer[wSize++] = bGridId;
    TxBuffer[wSize++] = bGetConfigurationLB();
    TxBuffer[wSize++] = bGetConfigurationHB();
    if (bGridFactor == 1)
    {
        TxBuffer[wSize++] = bDataGridFactorLB;
        TxBuffer[wSize++] = bDataGridFactorHB;    
    }
    if (getValue(ADC_D_EvMaskSet) == 1)
    {
        TxBuffer[wSize++] = bGetEvMaskLB();
        TxBuffer[wSize++] = bGetEvMaskMB();
        TxBuffer[wSize++] = bGetEvMaskHB();
    }
    if (getValue(ADC_D_IconSet) == 1)
    {
        TxBuffer[wSize++] = bGetIconsTable();
    }
    if (getValue(ADC_D_MultiLine) == 1)
    {
        TxBuffer[wSize++] = bGetMultiLineCfg();
    }
    if (getValue(ADC_D_Animation) == 1)
    {
        TxBuffer[wSize++] = getValue(ADC_F_AnimType);
    }
    if (getValue(ADC_D_NrLineConfig) > 0)
    {
        bCnt = getValue(ADC_D_NrLineConfig);
        for (bIndex = 0; bIndex < bCnt; bIndex++)
        {
            wSize += wUpdateLineCfg(wSize, bIndex);
        }
    }
    if (getValue(ADC_D_NrChainConfig) > 0)
    {
        bCnt = getValue(ADC_D_NrChainConfig);
        for (bIndex = 0; bIndex < bCnt; bIndex++)
        {
            wSize += wUpdateChainCfg(wSize, bIndex);
        }
    }
    if (getValue(ADC_D_ActiveDataFields) == 1)
    {
        TxBuffer[wSize++] = bGetActiveDF_LB();
        TxBuffer[wSize++] = bGetActiveDF_HB();
        for (bIndex = 0; bIndex < 16; bIndex++)
        {
            if (abActiveDF[bIndex] == 1)
                {wSize += wUpdateDF(wSize, bIndex);}
        }
    }
    TxBuffer[wSize++] = 0x00;

    if (bTelegramCounter < 0xff)
    {
        bTelegramCounter = bTelegramCounter + 1;
    }
    else
    {
        bTelegramCounter = 1;
    }
    switch(getValue(ADC_A_CANChannel))
    {
        case Channel_AUD:
            if( !getValue( HMI__STMSG_TP_TGW_IC_Aud ) )
                CanTpSendData(lAudHandle, TxBuffer, wSize);
            break;
        case Channel_NAV:
            if( !getValue( HMI__STMSG_TP_TGW_IC_Nav ) )
                CanTpSendData(lNavHandle, TxBuffer, wSize);
            break;
        case Channel_TEL:
            if( !getValue( HMI__STMSG_TP_TGW_IC_Tel ) )
                CanTpSendData(lTelHandle, TxBuffer, wSize);
            break;
        case Channel_HUD:
            if( !getValue( HMI__STMSG_TP_TGW_IC_HUD ) )
            CanTpSendData(lHUDHandle, TxBuffer, wSize);
            break;
        case Channel_SCA:
            if( !getValue( HMI__STMSG_TP_TGW_IC_SCA ) )
            CanTpSendData(lSCAHandle, TxBuffer, wSize);
            break;
    }

}

vSendAcoustics()
{
word wSize;
long lHandle;
    wSize = 0;
    TxBuffer[wSize++] = getValue(ADC_A_NodeAddress);
    TxBuffer[wSize++] = getValue(ADC_B_Application);
    TxBuffer[wSize++] = ADC_ACOUSTICS;
    TxBuffer[wSize++] = getValue(ADC_D_TAEventType);
    TxBuffer[wSize++] = getValue(ADC_D_TAEventQuantity);
    TxBuffer[wSize++] = 0x00;

    switch(getValue(ADC_A_CANChannel))
    {
        case Channel_AUD:
            if( !getValue( HMI__STMSG_TP_TGW_IC_Aud ) )
                CanTpSendData(lAudHandle, TxBuffer, wSize);
            break;
        case Channel_NAV:
            if( !getValue( HMI__STMSG_TP_TGW_IC_Nav ) )
                CanTpSendData(lNavHandle, TxBuffer, wSize);
            break;
        case Channel_TEL:
            if( !getValue( HMI__STMSG_TP_TGW_IC_Tel ) )
                CanTpSendData(lTelHandle, TxBuffer, wSize);
            break;
        case Channel_HUD:
            if( !getValue( HMI__STMSG_TP_TGW_IC_HUD ) )
            CanTpSendData(lHUDHandle, TxBuffer, wSize);
            break;
        case Channel_SCA:
            if( !getValue( HMI__STMSG_TP_TGW_IC_SCA ) )
            CanTpSendData(lSCAHandle, TxBuffer, wSize);
            break;
    }

}

byte bGetConfigurationHB()
{
    byte bTemp;
    bTemp = 0;
    bTemp |= (getValue(ADC_D_NrLineConfig) << 4) & 0xF0;
    bTemp |= getValue(ADC_D_NrChainConfig) & 0x0F;
    return bTemp;
}

on envVar ADC_H_DF_01
{
    getValue(this, acDFContent[0]);
}

on envVar ADC_H_DF_02
{
    getValue(this, acDFContent[1]);
}

on envVar ADC_H_DF_03
{
    getValue(this, acDFContent[2]);
}

on envVar ADC_H_DF_04
{
    getValue(this, acDFContent[3]);
}

on envVar ADC_H_DF_05
{
    getValue(this, acDFContent[4]);
}

on envVar ADC_H_DF_06
{
    getValue(this, acDFContent[5]);
}

on envVar ADC_H_DF_07
{
    getValue(this, acDFContent[6]);
}

on envVar ADC_H_DF_08
{
    getValue(this, acDFContent[7]);
}

on envVar ADC_H_DF_09
{
    getValue(this, acDFContent[8]);
}

on envVar ADC_H_DF_10
{
    getValue(this, acDFContent[9]);
}

on envVar ADC_H_DF_11
{
    getValue(this, acDFContent[10]);
}

on envVar ADC_H_DF_12
{
    getValue(this, acDFContent[11]);
}

on envVar ADC_H_DF_13
{
    getValue(this, acDFContent[12]);
}

on envVar ADC_H_DF_14
{
    getValue(this, acDFContent[13]);
}

on envVar ADC_H_DF_15
{
    getValue(this, acDFContent[14]);
}

on envVar ADC_H_DF_16
{
    getValue(this, acDFContent[15]);
}

on envVar ADC_H_Special_01
{
    abDFSpecial[0] = getValue(this);
}

on envVar ADC_H_Special_02
{
    abDFSpecial[1] = getValue(this);
}

on envVar ADC_H_Special_03
{
    abDFSpecial[2] = getValue(this);
}

on envVar ADC_H_Special_04
{
    abDFSpecial[3] = getValue(this);
}

on envVar ADC_H_Special_05
{
    abDFSpecial[4] = getValue(this);
}

on envVar ADC_H_Special_06
{
    abDFSpecial[5] = getValue(this);
}

on envVar ADC_H_Special_07
{
    abDFSpecial[6] = getValue(this);
}

on envVar ADC_H_Special_08
{
    abDFSpecial[7] = getValue(this);
}

on envVar ADC_H_Special_09
{
    abDFSpecial[8] = getValue(this);
}

on envVar ADC_H_Special_10
{
    abDFSpecial[9] = getValue(this);
}

on envVar ADC_H_Special_11
{
    abDFSpecial[10] = getValue(this);
}

on envVar ADC_H_Special_12
{
    abDFSpecial[11] = getValue(this);
}

on envVar ADC_H_Special_13
{
    abDFSpecial[12] = getValue(this);
}

on envVar ADC_H_Special_14
{
    abDFSpecial[13] = getValue(this);
}

on envVar ADC_H_Special_15
{
    abDFSpecial[14] = getValue(this);
}

on envVar ADC_H_Special_16
{
    abDFSpecial[15] = getValue(this);
}

on envVar ADC_H_DFDataType_01
{
    abDFDataType[0] = getValue(this);
}

on envVar ADC_H_DFDataType_02
{
    abDFDataType[1] = getValue(this);
}

on envVar ADC_H_DFDataType_03
{
    abDFDataType[2] = getValue(this);
}

on envVar ADC_H_DFDataType_04
{
    abDFDataType[3] = getValue(this);
}

on envVar ADC_H_DFDataType_05
{
    abDFDataType[4] = getValue(this);
}

on envVar ADC_H_DFDataType_06
{
    abDFDataType[5] = getValue(this);
}

on envVar ADC_H_DFDataType_07
{
    abDFDataType[6] = getValue(this);
}

on envVar ADC_H_DFDataType_08
{
    abDFDataType[7] = getValue(this);
}

on envVar ADC_H_DFDataType_09
{
    abDFDataType[8] = getValue(this);
}

on envVar ADC_H_DFDataType_10
{
    abDFDataType[9] = getValue(this);
}

on envVar ADC_H_DFDataType_11
{
    abDFDataType[10] = getValue(this);
}

on envVar ADC_H_DFDataType_12
{
    abDFDataType[11] = getValue(this);
}

on envVar ADC_H_DFDataType_13
{
    abDFDataType[12] = getValue(this);
}

on envVar ADC_H_DFDataType_14
{
    abDFDataType[13] = getValue(this);
}

on envVar ADC_H_DFDataType_15
{
    abDFDataType[14] = getValue(this);
}

on envVar ADC_H_DFDataType_16
{
    abDFDataType[15] = getValue(this);
}

on envVar ADC_G_UpdateCfg_01
{
    abDFUpdateCfg[0] = getValue(this);
}

on envVar ADC_G_UpdateCfg_02
{
    abDFUpdateCfg[1] = getValue(this);
}

on envVar ADC_G_UpdateCfg_03
{
    abDFUpdateCfg[2] = getValue(this);
}

on envVar ADC_G_UpdateCfg_04
{
    abDFUpdateCfg[3] = getValue(this);
}

on envVar ADC_G_UpdateCfg_05
{
    abDFUpdateCfg[4] = getValue(this);
}

on envVar ADC_G_UpdateCfg_06
{
    abDFUpdateCfg[5] = getValue(this);
}

on envVar ADC_G_UpdateCfg_07
{
    abDFUpdateCfg[6] = getValue(this);
}

on envVar ADC_G_UpdateCfg_08
{
    abDFUpdateCfg[7] = getValue(this);
}

on envVar ADC_G_UpdateCfg_09
{
    abDFUpdateCfg[8] = getValue(this);
}

on envVar ADC_G_UpdateCfg_10
{
    abDFUpdateCfg[9] = getValue(this);
}

on envVar ADC_G_UpdateCfg_11
{
    abDFUpdateCfg[10] = getValue(this);
}

on envVar ADC_G_UpdateCfg_12
{
    abDFUpdateCfg[11] = getValue(this);
}

on envVar ADC_G_UpdateCfg_13
{
    abDFUpdateCfg[12] = getValue(this);
}

on envVar ADC_G_UpdateCfg_14
{
    abDFUpdateCfg[13] = getValue(this);
}

on envVar ADC_G_UpdateCfg_15
{
    abDFUpdateCfg[14] = getValue(this);
}

on envVar ADC_G_UpdateCfg_16
{
    abDFUpdateCfg[15] = getValue(this);
}

on envVar ADC_H_Selectable_01
{
    abDFSelectable[0] = getValue(this);
}

on envVar ADC_H_Selectable_02
{
    abDFSelectable[1] = getValue(this);
}

on envVar ADC_H_Selectable_03
{
    abDFSelectable[2] = getValue(this);
}

on envVar ADC_H_Selectable_04
{
    abDFSelectable[3] = getValue(this);
}

on envVar ADC_H_Selectable_05
{
    abDFSelectable[4] = getValue(this);
}

on envVar ADC_H_Selectable_06
{
    abDFSelectable[5] = getValue(this);
}

on envVar ADC_H_Selectable_07
{
    abDFSelectable[6] = getValue(this);
}

on envVar ADC_H_Selectable_08
{
    abDFSelectable[7] = getValue(this);
}

on envVar ADC_H_Selectable_09
{
    abDFSelectable[8] = getValue(this);
}

on envVar ADC_H_Selectable_10
{
    abDFSelectable[9] = getValue(this);
}

on envVar ADC_H_Selectable_11
{
    abDFSelectable[10] = getValue(this);
}

on envVar ADC_H_Selectable_12
{
    abDFSelectable[11] = getValue(this);
}

on envVar ADC_H_Selectable_13
{
    abDFSelectable[12] = getValue(this);
}

on envVar ADC_H_Selectable_14
{
    abDFSelectable[13] = getValue(this);
}

on envVar ADC_H_Selectable_15
{
    abDFSelectable[14] = getValue(this);
}

on envVar ADC_H_Selectable_16
{
    abDFSelectable[15] = getValue(this);
}

on envVar ADC_H_Selected_01
{
    abDFSelected[0] = getValue(this);
}

on envVar ADC_H_Selected_02
{
    abDFSelected[1] = getValue(this);
}

on envVar ADC_H_Selected_03
{
    abDFSelected[2] = getValue(this);
}

on envVar ADC_H_Selected_04
{
    abDFSelected[3] = getValue(this);
}

on envVar ADC_H_Selected_05
{
    abDFSelected[4] = getValue(this);
}

on envVar ADC_H_Selected_06
{
    abDFSelected[5] = getValue(this);
}

on envVar ADC_H_Selected_07
{
    abDFSelected[6] = getValue(this);
}

on envVar ADC_H_Selected_08
{
    abDFSelected[7] = getValue(this);
}

on envVar ADC_H_Selected_09
{
    abDFSelected[8] = getValue(this);
}

on envVar ADC_H_Selected_10
{
    abDFSelected[9] = getValue(this);
}

on envVar ADC_H_Selected_11
{
    abDFSelected[10] = getValue(this);
}

on envVar ADC_H_Selected_12
{
    abDFSelected[11] = getValue(this);
}

on envVar ADC_H_Selected_13
{
    abDFSelected[12] = getValue(this);
}

on envVar ADC_H_Selected_14
{
    abDFSelected[13] = getValue(this);
}

on envVar ADC_H_Selected_15
{
    abDFSelected[14] = getValue(this);
}

on envVar ADC_H_Selected_16
{
    abDFSelected[15] = getValue(this);
}

on envVar ADC_H_HighL_01
{
    abDFHighL[0] = getValue(this);
}

on envVar ADC_H_HighL_02
{
    abDFHighL[1] = getValue(this);
}

on envVar ADC_H_HighL_03
{
    abDFHighL[2] = getValue(this);
}

on envVar ADC_H_HighL_04
{
    abDFHighL[3] = getValue(this);
}

on envVar ADC_H_HighL_05
{
    abDFHighL[4] = getValue(this);
}

on envVar ADC_H_HighL_06
{
    abDFHighL[5] = getValue(this);
}

on envVar ADC_H_HighL_07
{
    abDFHighL[6] = getValue(this);
}

on envVar ADC_H_HighL_08
{
    abDFHighL[7] = getValue(this);
}

on envVar ADC_H_HighL_09
{
    abDFHighL[8] = getValue(this);
}

on envVar ADC_H_HighL_10
{
    abDFHighL[9] = getValue(this);
}

on envVar ADC_H_HighL_11
{
    abDFHighL[10] = getValue(this);
}

on envVar ADC_H_HighL_12
{
    abDFHighL[11] = getValue(this);
}

on envVar ADC_H_HighL_13
{
    abDFHighL[12] = getValue(this);
}

on envVar ADC_H_HighL_14
{
    abDFHighL[13] = getValue(this);
}

on envVar ADC_H_HighL_15
{
    abDFHighL[14] = getValue(this);
}

on envVar ADC_H_HighL_16
{
    abDFHighL[15] = getValue(this);
}

on envVar ADC_H_Truncation_01
{
    abDFTruncation[0] = getValue(this);
}

on envVar ADC_H_Truncation_02
{
    abDFTruncation[1] = getValue(this);
}

on envVar ADC_H_Truncation_03
{
    abDFTruncation[2] = getValue(this);
}

on envVar ADC_H_Truncation_04
{
    abDFTruncation[3] = getValue(this);
}

on envVar ADC_H_Truncation_05
{
    abDFTruncation[4] = getValue(this);
}

on envVar ADC_H_Truncation_06
{
    abDFTruncation[5] = getValue(this);
}

on envVar ADC_H_Truncation_07
{
    abDFTruncation[6] = getValue(this);
}

on envVar ADC_H_Truncation_08
{
    abDFTruncation[7] = getValue(this);
}

on envVar ADC_H_Truncation_09
{
    abDFTruncation[8] = getValue(this);
}

on envVar ADC_H_Truncation_10
{
    abDFTruncation[9] = getValue(this);
}

on envVar ADC_H_Truncation_11
{
    abDFTruncation[10] = getValue(this);
}

on envVar ADC_H_Truncation_12
{
    abDFTruncation[11] = getValue(this);
}

on envVar ADC_H_Truncation_13
{
    abDFTruncation[12] = getValue(this);
}

on envVar ADC_H_Truncation_14
{
    abDFTruncation[13] = getValue(this);
}

on envVar ADC_H_Truncation_15
{
    abDFTruncation[14] = getValue(this);
}

on envVar ADC_H_Truncation_16
{
    abDFTruncation[15] = getValue(this);
}

on envVar ADC_H_Progression_01
{
    abDFProgression[0] = getValue(this);
}

on envVar ADC_H_Progression_02
{
    abDFProgression[1] = getValue(this);
}

on envVar ADC_H_Progression_03
{
    abDFProgression[2] = getValue(this);
}

on envVar ADC_H_Progression_04
{
    abDFProgression[3] = getValue(this);
}

on envVar ADC_H_Progression_05
{
    abDFProgression[4] = getValue(this);
}

on envVar ADC_H_Progression_06
{
    abDFProgression[5] = getValue(this);
}

on envVar ADC_H_Progression_07
{
    abDFProgression[6] = getValue(this);
}

on envVar ADC_H_Progression_08
{
    abDFProgression[7] = getValue(this);
}

on envVar ADC_H_Progression_09
{
    abDFProgression[8] = getValue(this);
}

on envVar ADC_H_Progression_10
{
    abDFProgression[9] = getValue(this);
}

on envVar ADC_H_Progression_11
{
    abDFProgression[10] = getValue(this);
}

on envVar ADC_H_Progression_12
{
    abDFProgression[11] = getValue(this);
}

on envVar ADC_H_Progression_13
{
    abDFProgression[12] = getValue(this);
}

on envVar ADC_H_Progression_14
{
    abDFProgression[13] = getValue(this);
}

on envVar ADC_H_Progression_15
{
    abDFProgression[14] = getValue(this);
}

on envVar ADC_H_Progression_16
{
    abDFProgression[15] = getValue(this);
}

on envVar ADC_H_Alignment_01
{
    abDFAlignment[0] = getValue(this);
}

on envVar ADC_H_Alignment_02
{
    abDFAlignment[1] = getValue(this);
}

on envVar ADC_H_Alignment_03
{
    abDFAlignment[2] = getValue(this);
}

on envVar ADC_H_Alignment_04
{
    abDFAlignment[3] = getValue(this);
}

on envVar ADC_H_Alignment_05
{
    abDFAlignment[4] = getValue(this);
}

on envVar ADC_H_Alignment_06
{
    abDFAlignment[5] = getValue(this);
}

on envVar ADC_H_Alignment_07
{
    abDFAlignment[6] = getValue(this);
}

on envVar ADC_H_Alignment_08
{
    abDFAlignment[7] = getValue(this);
}

on envVar ADC_H_Alignment_09
{
    abDFAlignment[8] = getValue(this);
}

on envVar ADC_H_Alignment_10
{
    abDFAlignment[9] = getValue(this);
}

on envVar ADC_H_Alignment_11
{
    abDFAlignment[10] = getValue(this);
}

on envVar ADC_H_Alignment_12
{
    abDFAlignment[11] = getValue(this);
}

on envVar ADC_H_Alignment_13
{
    abDFAlignment[12] = getValue(this);
}

on envVar ADC_H_Alignment_14
{
    abDFAlignment[13] = getValue(this);
}

on envVar ADC_H_Alignment_15
{
    abDFAlignment[14] = getValue(this);
}

on envVar ADC_H_Alignment_16
{
    abDFAlignment[15] = getValue(this);
}

on envVar ADC_H_Move_01
{
    abDFMove[0] = getValue(this);
}

on envVar ADC_H_Move_02
{
    abDFMove[1] = getValue(this);
}

on envVar ADC_H_Move_03
{
    abDFMove[2] = getValue(this);
}

on envVar ADC_H_Move_04
{
    abDFMove[3] = getValue(this);
}

on envVar ADC_H_Move_05
{
    abDFMove[4] = getValue(this);
}

on envVar ADC_H_Move_06
{
    abDFMove[5] = getValue(this);
}

on envVar ADC_H_Move_07
{
    abDFMove[6] = getValue(this);
}

on envVar ADC_H_Move_08
{
    abDFMove[7] = getValue(this);
}

on envVar ADC_H_Move_09
{
    abDFMove[8] = getValue(this);
}

on envVar ADC_H_Move_10
{
    abDFMove[9] = getValue(this);
}

on envVar ADC_H_Move_11
{
    abDFMove[10] = getValue(this);
}

on envVar ADC_H_Move_12
{
    abDFMove[11] = getValue(this);
}

on envVar ADC_H_Move_13
{
    abDFMove[12] = getValue(this);
}

on envVar ADC_H_Move_14
{
    abDFMove[13] = getValue(this);
}

on envVar ADC_H_Move_15
{
    abDFMove[14] = getValue(this);
}

on envVar ADC_H_Move_16
{
    abDFMove[15] = getValue(this);
}

on envVar ADC_H_IconPos_01
{
    abDFIconPos[0] = getValue(this);
}

on envVar ADC_H_IconPos_02
{
    abDFIconPos[1] = getValue(this);
}

on envVar ADC_H_IconPos_03
{
    abDFIconPos[2] = getValue(this);
}

on envVar ADC_H_IconPos_04
{
    abDFIconPos[3] = getValue(this);
}

on envVar ADC_H_IconPos_05
{
    abDFIconPos[4] = getValue(this);
}

on envVar ADC_H_IconPos_06
{
    abDFIconPos[5] = getValue(this);
}

on envVar ADC_H_IconPos_07
{
    abDFIconPos[6] = getValue(this);
}

on envVar ADC_H_IconPos_08
{
    abDFIconPos[7] = getValue(this);
}

on envVar ADC_H_IconPos_09
{
    abDFIconPos[8] = getValue(this);
}

on envVar ADC_H_IconPos_10
{
    abDFIconPos[9] = getValue(this);
}

on envVar ADC_H_IconPos_11
{
    abDFIconPos[10] = getValue(this);
}

on envVar ADC_H_IconPos_12
{
    abDFIconPos[11] = getValue(this);
}

on envVar ADC_H_IconPos_13
{
    abDFIconPos[12] = getValue(this);
}

on envVar ADC_H_IconPos_14
{
    abDFIconPos[13] = getValue(this);
}

on envVar ADC_H_IconPos_15
{
    abDFIconPos[14] = getValue(this);
}

on envVar ADC_H_IconPos_16
{
    abDFIconPos[15] = getValue(this);
}

on envVar ADC_H_IconLength_01
{
    abDFIconLength[0] = getValue(this);
}

on envVar ADC_H_IconLength_02
{
    abDFIconLength[1] = getValue(this);
}

on envVar ADC_H_IconLength_03
{
    abDFIconLength[2] = getValue(this);
}

on envVar ADC_H_IconLength_04
{
    abDFIconLength[3] = getValue(this);
}

on envVar ADC_H_IconLength_05
{
    abDFIconLength[4] = getValue(this);
}

on envVar ADC_H_IconLength_06
{
    abDFIconLength[5] = getValue(this);
}

on envVar ADC_H_IconLength_07
{
    abDFIconLength[6] = getValue(this);
}

on envVar ADC_H_IconLength_08
{
    abDFIconLength[7] = getValue(this);
}

on envVar ADC_H_IconLength_09
{
    abDFIconLength[8] = getValue(this);
}

on envVar ADC_H_IconLength_10
{
    abDFIconLength[9] = getValue(this);
}

on envVar ADC_H_IconLength_11
{
    abDFIconLength[10] = getValue(this);
}

on envVar ADC_H_IconLength_12
{
    abDFIconLength[11] = getValue(this);
}

on envVar ADC_H_IconLength_13
{
    abDFIconLength[12] = getValue(this);
}

on envVar ADC_H_IconLength_14
{
    abDFIconLength[13] = getValue(this);
}

on envVar ADC_H_IconLength_15
{
    abDFIconLength[14] = getValue(this);
}

on envVar ADC_H_IconLength_16
{
    abDFIconLength[15] = getValue(this);
}

on envVar ADC_H_Inactive_01
{
    abDFInactive[0] = getValue(this);
}

on envVar ADC_H_Inactive_02
{
    abDFInactive[1] = getValue(this);
}

on envVar ADC_H_Inactive_03
{
    abDFInactive[2] = getValue(this);
}

on envVar ADC_H_Inactive_04
{
    abDFInactive[3] = getValue(this);
}

on envVar ADC_H_Inactive_05
{
    abDFInactive[4] = getValue(this);
}

on envVar ADC_H_Inactive_06
{
    abDFInactive[5] = getValue(this);
}

on envVar ADC_H_Inactive_07
{
    abDFInactive[6] = getValue(this);
}

on envVar ADC_H_Inactive_08
{
    abDFInactive[7] = getValue(this);
}

on envVar ADC_H_Inactive_09
{
    abDFInactive[8] = getValue(this);
}

on envVar ADC_H_Inactive_10
{
    abDFInactive[9] = getValue(this);
}

on envVar ADC_H_Inactive_11
{
    abDFInactive[10] = getValue(this);
}

on envVar ADC_H_Inactive_12
{
    abDFInactive[11] = getValue(this);
}

on envVar ADC_H_Inactive_13
{
    abDFInactive[12] = getValue(this);
}

on envVar ADC_H_Inactive_14
{
    abDFInactive[13] = getValue(this);
}

on envVar ADC_H_Inactive_15
{
    abDFInactive[14] = getValue(this);
}

on envVar ADC_H_Inactive_16
{
    abDFInactive[15] = getValue(this);
}

on envVar ADC_H_Separator_01
{
    abDFSeparator[0] = getValue(this);
}

on envVar ADC_H_Separator_02
{
    abDFSeparator[1] = getValue(this);
}

on envVar ADC_H_Separator_03
{
    abDFSeparator[2] = getValue(this);
}

on envVar ADC_H_Separator_04
{
    abDFSeparator[3] = getValue(this);
}

on envVar ADC_H_Separator_05
{
    abDFSeparator[4] = getValue(this);
}

on envVar ADC_H_Separator_06
{
    abDFSeparator[5] = getValue(this);
}

on envVar ADC_H_Separator_07
{
    abDFSeparator[6] = getValue(this);
}

on envVar ADC_H_Separator_08
{
    abDFSeparator[7] = getValue(this);
}

on envVar ADC_H_Separator_09
{
    abDFSeparator[8] = getValue(this);
}

on envVar ADC_H_Separator_10
{
    abDFSeparator[9] = getValue(this);
}

on envVar ADC_H_Separator_11
{
    abDFSeparator[10] = getValue(this);
}

on envVar ADC_H_Separator_12
{
    abDFSeparator[11] = getValue(this);
}

on envVar ADC_H_Separator_13
{
    abDFSeparator[12] = getValue(this);
}

on envVar ADC_H_Separator_14
{
    abDFSeparator[13] = getValue(this);
}

on envVar ADC_H_Separator_15
{
    abDFSeparator[14] = getValue(this);
}

on envVar ADC_H_Separator_16
{
    abDFSeparator[15] = getValue(this);
}

on envVar ADC_I_IconNr_01
{
    awDFIconNr[0] = getValue(this);
	 if (awDFIconNr[0] > 255) putValue(ADC_H_IconLength_01, 1); else putValue(ADC_H_IconLength_01, 0);
}

on envVar ADC_I_IconNr_02
{
    awDFIconNr[1] = getValue(this);
	 if (awDFIconNr[1] > 255) putValue(ADC_H_IconLength_02, 1); else putValue(ADC_H_IconLength_02, 0);
}

on envVar ADC_I_IconNr_03
{
    awDFIconNr[2] = getValue(this);
	 if (awDFIconNr[2] > 255) putValue(ADC_H_IconLength_03, 1); else putValue(ADC_H_IconLength_03, 0);
}

on envVar ADC_I_IconNr_04
{
    awDFIconNr[3] = getValue(this);
	 if (awDFIconNr[3] > 255) putValue(ADC_H_IconLength_04, 1); else putValue(ADC_H_IconLength_04, 0);
}

on envVar ADC_I_IconNr_05
{
    awDFIconNr[4] = getValue(this);
	 if (awDFIconNr[4] > 255) putValue(ADC_H_IconLength_05, 1); else putValue(ADC_H_IconLength_05, 0);
}

on envVar ADC_I_IconNr_06
{
    awDFIconNr[5] = getValue(this);
	 if (awDFIconNr[5] > 255) putValue(ADC_H_IconLength_06, 1); else putValue(ADC_H_IconLength_06, 0);
}

on envVar ADC_I_IconNr_07
{
    awDFIconNr[6] = getValue(this);
	 if (awDFIconNr[6] > 255) putValue(ADC_H_IconLength_07, 1); else putValue(ADC_H_IconLength_07, 0);
}

on envVar ADC_I_IconNr_08
{
    awDFIconNr[7] = getValue(this);
	 if (awDFIconNr[7] > 255) putValue(ADC_H_IconLength_08, 1); else putValue(ADC_H_IconLength_08, 0);
}

on envVar ADC_I_IconNr_09
{
    awDFIconNr[8] = getValue(this);
	 if (awDFIconNr[8] > 255) putValue(ADC_H_IconLength_09, 1); else putValue(ADC_H_IconLength_09, 0);
}

on envVar ADC_I_IconNr_10
{
    awDFIconNr[9] = getValue(this);
	 if (awDFIconNr[9] > 255) putValue(ADC_H_IconLength_10, 1); else putValue(ADC_H_IconLength_10, 0);
}

on envVar ADC_I_IconNr_11
{
    awDFIconNr[10] = getValue(this);
	 if (awDFIconNr[10] > 255) putValue(ADC_H_IconLength_11, 1); else putValue(ADC_H_IconLength_11, 0);
}

on envVar ADC_I_IconNr_12
{
    awDFIconNr[11] = getValue(this);
	 if (awDFIconNr[11] > 255) putValue(ADC_H_IconLength_12, 1); else putValue(ADC_H_IconLength_12, 0);
}

on envVar ADC_I_IconNr_13
{
    awDFIconNr[12] = getValue(this);
	 if (awDFIconNr[12] > 255) putValue(ADC_H_IconLength_13, 1); else putValue(ADC_H_IconLength_13, 0);
}

on envVar ADC_I_IconNr_14
{
    awDFIconNr[13] = getValue(this);
	 if (awDFIconNr[13] > 255) putValue(ADC_H_IconLength_14, 1); else putValue(ADC_H_IconLength_14, 0);
}

on envVar ADC_I_IconNr_15
{
    awDFIconNr[14] = getValue(this);
	 if (awDFIconNr[14] > 255) putValue(ADC_H_IconLength_15, 1); else putValue(ADC_H_IconLength_15, 0);
}

on envVar ADC_I_IconNr_16
{
    awDFIconNr[15] = getValue(this);
	 if (awDFIconNr[15] > 255) putValue(ADC_H_IconLength_16, 1); else putValue(ADC_H_IconLength_16, 0);
}

on envVar ADC_G_ActiveDF_01
{
    abActiveDF[0] = getValue(this);
}

on envVar ADC_G_ActiveDF_02
{
    abActiveDF[1] = getValue(this);
}

on envVar ADC_G_ActiveDF_03
{
    abActiveDF[2] = getValue(this);
}

on envVar ADC_G_ActiveDF_04
{
    abActiveDF[3] = getValue(this);
}

on envVar ADC_G_ActiveDF_05
{
    abActiveDF[4] = getValue(this);
}

on envVar ADC_G_ActiveDF_06
{
    abActiveDF[5] = getValue(this);
}

on envVar ADC_G_ActiveDF_07
{
    abActiveDF[6] = getValue(this);
}

on envVar ADC_G_ActiveDF_08
{
    abActiveDF[7] = getValue(this);
}

on envVar ADC_G_ActiveDF_09
{
    abActiveDF[8] = getValue(this);
}

on envVar ADC_G_ActiveDF_10
{
    abActiveDF[9] = getValue(this);
}

on envVar ADC_G_ActiveDF_11
{
    abActiveDF[10] = getValue(this);
}

on envVar ADC_G_ActiveDF_12
{
    abActiveDF[11] = getValue(this);
}

on envVar ADC_G_ActiveDF_13
{
    abActiveDF[12] = getValue(this);
}

on envVar ADC_G_ActiveDF_14
{
    abActiveDF[13] = getValue(this);
}

on envVar ADC_G_ActiveDF_15
{
    abActiveDF[14] = getValue(this);
}

on envVar ADC_G_ActiveDF_16
{
    abActiveDF[15] = getValue(this);
}

word wUpdateDF (word wIndex, byte bDFNr)
{
    word wTemp, wBuf;
    byte bCfg;
    char cArray[62];
    long lLength;
    byte bIndex, bDataType, bSpecial;

    wTemp = wBuf = wIndex;
    for (bIndex = 0; bIndex < 62; bIndex++)
        {
        cArray[bIndex] = acDFContent[bDFNr][bIndex];
        }

    if (abDFSpecial[bDFNr] != 0)
    {
        bSpecial = abDFSpecialType[bDFNr];
        lLength = bGetGraphicLength(bSpecial);
    }
    else
    {
        bDataType = abDFDataType[bDFNr];
        switch(bDataType)
        {
            case 3:  //ICON
				if (abDFIconLength[bDFNr] == 1)
				{
               lLength = 2;
				}
				else
				{
					lLength = 1;
				}
					 
            break;
            case 4:  //MIXED
				if (abDFIconLength[bDFNr] == 1)
				{
               lLength = strlen(cArray) + 2;
					if (lLength == 63) 
					{
					lLength = 62;
					}
				}
				else
				{
					lLength = strlen(cArray) + 1;
				}				

            break;
            default:
                lLength = strlen(cArray);
            break;
        }
    }

    if (lLength == 0)
    {
        TxBuffer[wBuf++] = 0x01;
    }
    else
    {
        if (abDFUpdateCfg[bDFNr] == 1)
        {
            if (abDFSpecial[bDFNr] == 0)
            {
               TxBuffer[wBuf++] = 0x04;
            }
            else
            {
               TxBuffer[wBuf++] = 0x05;
            }
            //Config byte LB
            bCfg = 0;
            bCfg |= (abDFSelectable[bDFNr] << 6) & 0xC0;
            bCfg |= (abDFSelected[bDFNr] << 4) & 0x30;
            bCfg |= (abDFHighL[bDFNr] << 2) & 0x0C;
            bCfg |= abDFTruncation[bDFNr] & 0x03;
            TxBuffer[wBuf++] = bCfg;
            //Config byte MB
            bCfg = 0;
            bCfg |= (abDFSpecial[bDFNr] << 7) & 0x80;
            bCfg |= (abDFDataType[bDFNr] << 4) & 0x70;
            bCfg |= (abDFProgression[bDFNr] << 2) & 0x0C;
            bCfg |= abDFAlignment[bDFNr] & 0x03;
            TxBuffer[wBuf++] = bCfg;
            //Config byte HB
            bCfg = 0;
            bCfg |= (abDFMove[bDFNr] << 7) & 0x80;				
            bCfg |= (abDFIconPos[bDFNr] << 5) & 0x60;
				bCfg |= (abDFIconLength[bDFNr] << 4) & 0x10;				
            bCfg |= (abDFInactive[bDFNr] << 2) & 0x0C;
            bCfg |= abDFSeparator[bDFNr] & 0x03;
            TxBuffer[wBuf++] = bCfg;
            //set fourth byte for special data
            if (abDFSpecial[bDFNr] != 0)
            {
               TxBuffer[wBuf++] = bSpecial;
            }
        }
        else
        {
            TxBuffer[wBuf++] = 0x04 + lLength;
            //Config byte LB
            bCfg = 0;
            bCfg |= (abDFSelectable[bDFNr] << 6) & 0xC0;
            bCfg |= (abDFSelected[bDFNr] << 4) & 0x30;
            bCfg |= (abDFHighL[bDFNr] << 2) & 0x0C;
            bCfg |= abDFTruncation[bDFNr] & 0x03;
            TxBuffer[wBuf++] = bCfg;
            //Config byte MB
            bCfg = 0;
            bCfg |= (abDFSpecial[bDFNr] << 7) & 0x80;
            bCfg |= (abDFDataType[bDFNr] << 4) & 0x70;
            bCfg |= (abDFProgression[bDFNr] << 2) & 0x0C;
            bCfg |= abDFAlignment[bDFNr] & 0x03;
            TxBuffer[wBuf++] = bCfg;
            //Config byte HB
            bCfg = 0;
            bCfg |= (abDFMove[bDFNr] << 7) & 0x80;
            bCfg |= (abDFIconPos[bDFNr] << 5) & 0x60;
				bCfg |= (abDFIconLength[bDFNr] << 4) & 0x10;					
            bCfg |= (abDFInactive[bDFNr] << 2) & 0x0C;
            bCfg |= abDFSeparator[bDFNr] & 0x03;
            TxBuffer[wBuf++] = bCfg;
            
            if (abDFSpecial[bDFNr] == 0)
            {
                switch (bDataType)
                {
                case 0: //DEFAULT
                case 1: //TEXT
                for (bIndex = 0; bIndex < lLength; bIndex++)
                    {
                        if (abDFMove[bDFNr] == 1)
                        {
                            cArray[bIndex] = cArray[bIndex] - 48;
                        }
                        TxBuffer[wBuf++] = cArray[bIndex];
                    }
                break;
                case 3: //ICON
					 if (abDFIconLength[bDFNr] == 1)
					 {
            //MarMiz: Modification requested from MR62784
            TxBuffer[wBuf++] = (awDFIconNr[bDFNr] & 0x00FF);
            TxBuffer[wBuf++] = (awDFIconNr[bDFNr] & 0xFF00) >> 8;
					 }
					 else
					 {
						TxBuffer[wBuf++] = awDFIconNr[bDFNr];
					 }
                break;
                case 4: //MIXED
                if (abDFIconPos[bDFNr] == 1) //END
                    {
							 if (abDFIconLength[bDFNr] == 1)
							 {
								for (bIndex = 0; bIndex < (lLength - 2); bIndex++)
                        {
                        TxBuffer[wBuf++] = cArray[bIndex];
                        }
								//MarMiz: Modification requested from MR62784
                TxBuffer[wBuf++] = (awDFIconNr[bDFNr] & 0x00FF);
                TxBuffer[wBuf++] = (awDFIconNr[bDFNr] & 0xFF00) >> 8;
							 }
							 else
							 {
							   for (bIndex = 0; bIndex < (lLength - 1); bIndex++)
                        {
                        TxBuffer[wBuf++] = cArray[bIndex];
                        }
								TxBuffer[wBuf++] = awDFIconNr[bDFNr];
							 }
                    }
                if ((abDFIconPos[bDFNr] == 2) || (abDFIconPos[bDFNr] == 0)) //START or DEFAULT
                    {
							 if (abDFIconLength[bDFNr] == 1)
							 {
                //MarMiz: Modification requested from MR62784
                TxBuffer[wBuf++] = (awDFIconNr[bDFNr] & 0x00FF);
                TxBuffer[wBuf++] = (awDFIconNr[bDFNr] & 0xFF00) >> 8;
								for (bIndex = 0; bIndex < (lLength - 2); bIndex++)
                        {
                        TxBuffer[wBuf++] = cArray[bIndex];
                        }
							 }
							 else
							 {
								TxBuffer[wBuf++] = awDFIconNr[bDFNr];
								for (bIndex = 0; bIndex < (lLength - 1); bIndex++)
                        {
                        TxBuffer[wBuf++] = cArray[bIndex];
                        }
							 }
                    }
                break;
                case 5: //HSVL
                for (bIndex = 0; bIndex < lLength; bIndex++)
                    {
                        if (abDFMove[bDFNr] == 1)
                        {
                            cArray[bIndex] = cArray[bIndex] - 48;
                        }
                        TxBuffer[wBuf++] = cArray[bIndex];
                    }
                break;
                default:
                break;
                }
            }
            else
            {
                wBuf += wSpecialData(wBuf, bSpecial);
            }
        }
    }
    return (wBuf - wTemp);
}

byte bGetMultiLineCfg()
{
    byte bTemp;
    bTemp = 0;
    bTemp |= (getValue(ADC_F_LineConnector) << 3) & 0x18;
    bTemp |= getValue(ADC_F_NrOfMultiLines) & 0x07;
    return bTemp;
}

on envVar ADC_Z_SetLineCfg
{
byte bLine;
    if (getValue(this) == 1)
    {
        bLine = getValue(ADC_F_NrOfLine) - 1;
        abFirstDFInLine[bLine] = getValue(ADC_F_FirstDFInLine);
        abLineSelectable[bLine] = getValue(ADC_F_LineCfgSelectable);
        abLineSelected[bLine] = getValue(ADC_F_LineCfgSelected);
        abLineHighL[bLine] = getValue(ADC_F_LineCfgHighlighted);
        abLineProgression[bLine] = getValue(ADC_F_LineCfgProgression);
        abLineAlignment[bLine] = getValue(ADC_F_LineCfgAlignment);
        abLineInactive[bLine] = getValue(ADC_F_LineCfgInactive);
        abLineSeparator[bLine] = getValue(ADC_F_LineCfgSeparator);
    }
}

on envVar ADC_Z_SetChainCfg
{
byte bChain;
    if (getValue(this) == 1)
    {
        bChain = getValue(ADC_F_NrOfChain) - 1;
        abFirstDFInChain[bChain] = getValue(ADC_F_FirstDFInChain);
        abChainSelectable[bChain] = getValue(ADC_F_ChainCfgSelectable);
        abChainSelected[bChain] = getValue(ADC_F_ChainCfgSelected);
        abChainHighL[bChain] = getValue(ADC_F_ChainCfgHighlighted);
        abChainProgression[bChain] = getValue(ADC_F_ChainCfgProgression);
        abChainAlignment[bChain] = getValue(ADC_F_ChainCfgAlignment);
        abChainInactive[bChain] = getValue(ADC_F_ChainCfgInactive);
        abChainSeparator[bChain] = getValue(ADC_F_ChainCfgSeparator);
    }
}

word wUpdateLineCfg (word wIndex, byte bLineNr)
{
    word wTemp, wBuf;
    byte bCfg;

    wTemp = wBuf = wIndex;

    TxBuffer[wBuf++] = abFirstDFInLine[bLineNr];
    bCfg = 0;
    bCfg |= (abLineSelectable[bLineNr] << 6) & 0xC0;
    bCfg |= (abLineSelected[bLineNr] << 4) & 0x30;
    bCfg |= (abLineHighL[bLineNr] << 2) & 0x0C;
    TxBuffer[wBuf++] = bCfg;
    //Config byte MB
    bCfg = 0;
    bCfg |= (abLineProgression[bLineNr] << 2) & 0x0C;
    bCfg |= abLineAlignment[bLineNr] & 0x03;
    TxBuffer[wBuf++] = bCfg;
    //Config byte HB
    bCfg = 0;
    bCfg |= (abLineInactive[bLineNr] << 2) & 0x0C;
    bCfg |= abLineSeparator[bLineNr] & 0x03;
    TxBuffer[wBuf++] = bCfg;

    return (wBuf - wTemp);
}

word wUpdateChainCfg (word wIndex, byte bChainNr)
{
    word wTemp, wBuf;
    byte bCfg;

    wTemp = wBuf = wIndex;

    TxBuffer[wBuf++] = abFirstDFInChain[bChainNr];
    bCfg = 0;
    bCfg |= (abChainSelectable[bChainNr] << 6) & 0xC0;
    bCfg |= (abChainSelected[bChainNr] << 4) & 0x30;
    bCfg |= (abChainHighL[bChainNr] << 2) & 0x0C;
    TxBuffer[wBuf++] = bCfg;
    //Config byte MB
    bCfg = 0;
    bCfg |= (abChainProgression[bChainNr] << 2) & 0x0C;
    bCfg |= abChainAlignment[bChainNr] & 0x03;
    TxBuffer[wBuf++] = bCfg;
    //Config byte HB
    bCfg = 0;
    bCfg |= (abChainInactive[bChainNr] << 2) & 0x0C;
    bCfg |= abChainSeparator[bChainNr] & 0x03;
    TxBuffer[wBuf++] = bCfg;

    return (wBuf - wTemp);
}

void vInitLinesChains()
{
    byte bIndex;
    for (bIndex = 0; bIndex < 7; bIndex++)
    {
        abLineSelectable[bIndex] = 1;
        abLineSelected[bIndex] = 1;
        abLineHighL[bIndex] = 1;
        abLineProgression[bIndex] = 1;
        abLineAlignment[bIndex] = 2;
        abLineInactive[bIndex] = 1;
        abLineSeparator[bIndex] = 0;

        abChainSelectable[bIndex] = 1;
        abChainSelected[bIndex] = 1;
        abChainHighL[bIndex] = 1;
        abChainProgression[bIndex] = 1;
        abChainAlignment[bIndex] = 2;
        abChainInactive[bIndex] = 1;
        abChainSeparator[bIndex] = 0;
    }    
}

void vInitConfiguration ()
{
    putValue(ADC_D_FontVariant, 1);
    putValue(ADC_D_LayoutSettings, 0);
    putValue(ADC_D_Animation, 0);
    putValue(ADC_D_MultiLine, 0);
    putValue(ADC_D_ActiveDataFields, 1);
    putValue(ADC_D_IconSet, 0);
    putValue(ADC_D_EvMaskSet, 0);
    putValue(ADC_D_NrLineConfig, 0);
    putValue(ADC_D_NrChainConfig, 0);

    putValue(ADC_F_NrOfMultiLines, 0);
}

void vSetupGrid02()
{
    putValue(ADC_G_ActiveDF_01, 1);
    putValue(ADC_G_ActiveDF_02, 1);
    putValue(ADC_G_ActiveDF_03, 1);
    putValue(ADC_G_ActiveDF_04, 1);
    
    if(getValue(ADC_A_Project) == 0x01 ) //VS30 HL/HLP
      putValue(ADC_G_ActiveDF_05, 1);

    putValue(ADC_D_MultiLine, 1);
    putValue(ADC_F_LineConnector, 1);
    putValue(ADC_F_NrOfMultiLines, 2);
}

void vSetupGrid03()
{
    putValue(ADC_G_ActiveDF_01, 1);
    putValue(ADC_G_ActiveDF_02, 1);
    putValue(ADC_G_ActiveDF_03, 1);
	
    if(getValue(ADC_A_Project) == 0x01 ) //VS30 HL/HLP
    {
      putValue(ADC_D_MultiLine, 1);
      putValue(ADC_F_LineConnector, 1);
      putValue(ADC_F_NrOfMultiLines, 3);
      
      putValue(ADC_G_ActiveDF_04, 1);
	    putValue(ADC_G_ActiveDF_05, 1);
      putValue(ADC_H_DFDataType_05, 3); //Icon
    }
    else
    {
      putValue(ADC_D_MultiLine, 1);
      putValue(ADC_F_LineConnector, 1);
      putValue(ADC_F_NrOfMultiLines, 2);
    }
}

void vSetupGrid04()
{
    putValue(ADC_G_ActiveDF_01, 1);
    putValue(ADC_G_ActiveDF_02, 1);
    putValue(ADC_G_ActiveDF_03, 1);

    putValue(ADC_H_DFDataType_01, 3);  //Icon
    putValue(ADC_H_Special_01, 1);  //Special data
    putValue(ADC_K_Special_DF01, Turns); //Turns

    putValue(ADC_H_DFDataType_03, 3);  //Icon
    putValue(ADC_H_Special_03, 1);  //Special data
    putValue(ADC_K_Special_DF03, LaneG); //Lane Guidance

    putValue(ADC_D_NrChainConfig, 1); //One chain
    abFirstDFInChain[0] = 1; //First chain starts with DF 1

}

void vSetupGrid05()
{
    putValue(ADC_G_ActiveDF_01, 1);
    putValue(ADC_G_ActiveDF_02, 1);
    putValue(ADC_G_ActiveDF_03, 1);
    putValue(ADC_G_ActiveDF_04, 1);
    putValue(ADC_G_ActiveDF_05, 1);

    putValue(ADC_H_DFDataType_02, 3);  //Icon
    putValue(ADC_H_Special_02, 1);  //Special data
    putValue(ADC_K_Special_DF02, Bargraph); //Bargraph

    putValue(ADC_H_DFDataType_03, 3);  //Icon
    putValue(ADC_H_Special_03, 1);  //Special data
    putValue(ADC_K_Special_DF03, Turns); //Turns

    putValue(ADC_H_DFDataType_05, 3);  //Icon
    putValue(ADC_H_Special_05, 1);  //Special data
    putValue(ADC_K_Special_DF05, LaneG); //Lane Guidance

    putValue(ADC_D_NrChainConfig, 1); //One chain
    abFirstDFInChain[0] = 2; //First chain starts with DF 2

}

void vSetupGrid06()
{
    putValue(ADC_G_ActiveDF_01, 1);
    putValue(ADC_G_ActiveDF_02, 1);
    putValue(ADC_G_ActiveDF_03, 1);

    putValue(ADC_H_DFDataType_02, 3);  //Icon
    putValue(ADC_H_Special_02, 1);  //Special data
    putValue(ADC_K_Special_DF02, Compass); //Compass

}

void vSetupGrid07()
{
    putValue(ADC_G_ActiveDF_01, 1);
    putValue(ADC_G_ActiveDF_02, 1);
    putValue(ADC_G_ActiveDF_03, 1);
    putValue(ADC_G_ActiveDF_04, 1);
}

void vSetupGrid08()
{
    putValue(ADC_G_ActiveDF_01, 1);
    putValue(ADC_G_ActiveDF_02, 1);
    putValue(ADC_G_ActiveDF_03, 1);
    putValue(ADC_G_ActiveDF_04, 1);

    putValue(ADC_D_MultiLine, 1);
    putValue(ADC_F_LineConnector, 1);
    putValue(ADC_F_NrOfMultiLines, 4);
}

void vSetupGrid09()
{
    putValue(ADC_G_ActiveDF_01, 1);

    putValue(ADC_H_DFDataType_01, 3);  //Icon
    putValue(ADC_H_Special_01, 1);  //Special data
    putValue(ADC_K_Special_DF01, Flags); //Flags
}

void vSetupGrid10()
{
    putValue(ADC_G_ActiveDF_01, 1);
    putValue(ADC_G_ActiveDF_02, 1);
    putValue(ADC_G_ActiveDF_03, 1);
}

void vSetupGrid18()
{
    putValue(ADC_G_ActiveDF_01, 1);
    putValue(ADC_G_ActiveDF_02, 1);
    putValue(ADC_G_ActiveDF_03, 1);
    putValue(ADC_G_ActiveDF_04, 1);
    putValue(ADC_G_ActiveDF_05, 1);
    putValue(ADC_G_ActiveDF_06, 1);
    putValue(ADC_G_ActiveDF_07, 1);
    
    putValue(ADC_H_DFDataType_02, 3);  //Icon
    putValue(ADC_I_IconNr_02, 3);

    putValue(ADC_H_DFDataType_04, 3);  //Icon
    putValue(ADC_I_IconNr_04, 2);

    putValue(ADC_H_DFDataType_06, 3);  //Icon
    putValue(ADC_I_IconNr_06, 7);
  
    if(getValue(ADC_A_Project) == 0x01 ) //VS30 HL/HLP
    {
      putValue(ADC_G_ActiveDF_08, 1);
      putValue(ADC_G_ActiveDF_09, 1);
      putValue(ADC_G_ActiveDF_10, 1);

      putValue(ADC_H_DFDataType_08, 3);  //Icon
      putValue(ADC_I_IconNr_08, 13);
      
      putValue(ADC_D_NrChainConfig, 4); //4 chains
      abFirstDFInChain[0] = 2; //First chain starts with DF 2
      abFirstDFInChain[1] = 4; //Second chain starts with DF 4
      abFirstDFInChain[2] = 6; //Third chain starts with DF 6
      abFirstDFInChain[3] = 8; //Fourth chain starts with DF 8
    }
    else//VS30 LL/ML
    {
      putValue(ADC_D_NrChainConfig, 3); //4 chains
      abFirstDFInChain[0] = 2; //First chain starts with DF 2
      abFirstDFInChain[1] = 4; //Second chain starts with DF 4
      abFirstDFInChain[2] = 6; //Third chain starts with DF 6
    }
}

void vSetupGrid21()
{
    byte bData2[3] = {0x01, 0x00, 0x01};  
  
    putValue(ADC_G_ActiveDF_01, 1);
    putValue(ADC_G_ActiveDF_02, 1);
    putValue(ADC_G_ActiveDF_03, 1);
    putValue(ADC_G_ActiveDF_04, 1);
	  putValue(ADC_G_ActiveDF_05, 1);

    putValue(ADC_H_DFDataType_01, 4); //Mixed = Icon+Text
    putValue(ADC_I_IconNr_01, 0x18);

    putValue(ADC_H_Special_02, 1); //Special Data
	  putValue(ADC_K_Special_DF02, Turns); //Turns
    putValue(ADC_K_Turn, bData2);
    
	  putValue(ADC_H_DFDataType_05, 4); //Mixed = Icon+Text  
    putValue(ADC_I_IconNr_05, 0x18);
  
    putValue(ADC_D_NrChainConfig, 1); //One chain
    abFirstDFInChain[0] = 2; //First chain starts with DF 2
}

void vSetupGrid22()
{
    byte bData2[3] = {0x01, 0x00, 0x01};  
    
    putValue(ADC_G_ActiveDF_01, 1);
    putValue(ADC_G_ActiveDF_02, 1);
    putValue(ADC_G_ActiveDF_03, 1);
    putValue(ADC_G_ActiveDF_04, 1);
	  putValue(ADC_G_ActiveDF_05, 1);
	  putValue(ADC_G_ActiveDF_06, 1);
    
    putValue(ADC_H_DFDataType_01, 4); //Mixed = Icon+Text
    putValue(ADC_I_IconNr_01, 0x18);
    
    putValue(ADC_H_DFDataType_02, 3); //Icon
	  putValue(ADC_H_Special_02, 1); //Special Data
	  putValue(ADC_K_Special_DF02, Turns); //Turns
    putValue(ADC_K_Turn, bData2);
  
    putValue(ADC_H_DFDataType_05, 3); //Icon
	  putValue(ADC_H_Special_05, 1); //Special Data
	  putValue(ADC_K_Special_DF05, Bargraph); //Bargraph
	
	  putValue(ADC_H_DFDataType_06, 3); //Icon
	  putValue(ADC_H_Special_06, 1); //Special Data
	  putValue(ADC_K_Special_DF06, LaneG); //Laneguidance

    putValue(ADC_D_NrChainConfig, 1); //One chain
    abFirstDFInChain[0] = 2; //First chain starts with DF 2
}

void vSetupGrid23()
{
    putValue(ADC_G_ActiveDF_01, 1);
    putValue(ADC_G_ActiveDF_02, 1);
    putValue(ADC_G_ActiveDF_03, 1);
    putValue(ADC_G_ActiveDF_04, 1);
	  putValue(ADC_G_ActiveDF_05, 1);
}

void vSetupGrid24()
{
    byte bData2[3] = {0x01, 0x00, 0x01};  
  
    putValue(ADC_G_ActiveDF_01, 1);
    putValue(ADC_G_ActiveDF_02, 1);
    putValue(ADC_G_ActiveDF_03, 1);
    putValue(ADC_G_ActiveDF_04, 1);
	  putValue(ADC_G_ActiveDF_05, 1);
	  putValue(ADC_G_ActiveDF_06, 1);
	  putValue(ADC_G_ActiveDF_07, 1);
    putValue(ADC_G_ActiveDF_08, 1);
	  putValue(ADC_G_ActiveDF_09, 1);
	  putValue(ADC_G_ActiveDF_10, 1);

    putValue(ADC_H_DFDataType_01, 3); //Icon
	  putValue(ADC_I_IconNr_01, 0x2B);
	
	  putValue(ADC_H_DFDataType_04, 3); //Icon
	  putValue(ADC_I_IconNr_04, 0x2C);
	
    putValue(ADC_H_DFDataType_07, 3); //Icon
	  putValue(ADC_H_Special_07, 1); //Special Data
	  putValue(ADC_K_Special_DF07, Turns); // Turns
    putValue(ADC_K_Turn, bData2); 

    putValue(ADC_H_DFDataType_10, 4); //Mixed
    putValue(ADC_I_IconNr_10, 0x18);
  
    putValue(ADC_D_NrChainConfig, 2); //Two chains
    abFirstDFInChain[0] = 1; //First chain starts with DF 1
    abFirstDFInChain[1] = 5; //Second chain starts with DF 5
}

void vSetupGrid25()
{
    byte bData2[3] = {0x01, 0x00, 0x01};  
    
    putValue(ADC_G_ActiveDF_01, 1);
    putValue(ADC_G_ActiveDF_02, 1);
    putValue(ADC_G_ActiveDF_03, 1);
    putValue(ADC_G_ActiveDF_04, 1);
	  putValue(ADC_G_ActiveDF_05, 1);
	  putValue(ADC_G_ActiveDF_06, 1);
	  putValue(ADC_G_ActiveDF_07, 1);
    putValue(ADC_G_ActiveDF_08, 1);
	  putValue(ADC_G_ActiveDF_09, 1);
	  putValue(ADC_G_ActiveDF_10, 1);

    putValue(ADC_H_DFDataType_01, 3); //Icon
	  putValue(ADC_I_IconNr_01, 0x2B);
	
	  putValue(ADC_H_DFDataType_04, 3); //Icon
	  putValue(ADC_I_IconNr_04, 0x2C);
	
	  putValue(ADC_H_DFDataType_07, 3); //Icon
	  putValue(ADC_H_Special_07, 1); //Special Data
	  putValue(ADC_K_Special_DF07, Turns); // Turns
    putValue(ADC_K_Turn, bData2); 
  
    putValue(ADC_H_DFDataType_10, 3); //Icon
	  putValue(ADC_H_Special_10, 1); //Special Data
	  putValue(ADC_K_Special_DF10, LaneG); // Laneguidance

    putValue(ADC_D_NrChainConfig, 2); //Two chains
    abFirstDFInChain[0] = 1; //First chain starts with DF 1
    abFirstDFInChain[1] = 5; //Second chain starts with DF 5
}

void vSetupGrid26()
{
    putValue(ADC_G_ActiveDF_01, 1);
    putValue(ADC_G_ActiveDF_02, 1);
    putValue(ADC_G_ActiveDF_03, 1);
    putValue(ADC_G_ActiveDF_04, 1);
  
    if(getValue(ADC_A_Project) == 0x01 ) //VS30 HL/HLP
    {
      putValue(ADC_G_ActiveDF_05, 1);
      putValue(ADC_G_ActiveDF_06, 1);    
    }
}

void vSetupGrid27()
{
    putValue(ADC_G_ActiveDF_01, 1);
    putValue(ADC_G_ActiveDF_02, 1);
    putValue(ADC_G_ActiveDF_03, 1);
    putValue(ADC_G_ActiveDF_04, 1);
	  putValue(ADC_G_ActiveDF_05, 1);
	  putValue(ADC_G_ActiveDF_06, 1);
	  putValue(ADC_G_ActiveDF_07, 1);
    putValue(ADC_G_ActiveDF_08, 1);
	  putValue(ADC_G_ActiveDF_09, 1);
  
    putValue(ADC_H_DFDataType_04, 3); //Icon
	  putValue(ADC_I_IconNr_04, 0x24);
	
	  putValue(ADC_H_DFDataType_06, 3); //Icon
	  putValue(ADC_I_IconNr_06, 0x23);
	
	  putValue(ADC_H_DFDataType_08, 3); //Icon
	  putValue(ADC_I_IconNr_08, 0x22);
  
    if(getValue(ADC_A_Project) == 0x01 ) //VS30 HL/HLP
    {
      putValue(ADC_G_ActiveDF_10, 1);
	    putValue(ADC_G_ActiveDF_11, 1);
      
      putValue(ADC_H_DFDataType_10, 3); //Icon
	    putValue(ADC_I_IconNr_10, 0x22);
      
      putValue(ADC_D_NrChainConfig, 4); //3 chains
      abFirstDFInChain[0] = 4; //First chain starts with DF 4
      abFirstDFInChain[1] = 6; //Second chain starts with DF 6
      abFirstDFInChain[2] = 8; //Third chain starts with DF 8
      abFirstDFInChain[3] = 10; //Fourth chain starts with DF 8
    }
    else//VS30 LL/ML
    {
      putValue(ADC_D_NrChainConfig, 3); //3 chains
      abFirstDFInChain[0] = 4; //First chain starts with DF 4
      abFirstDFInChain[1] = 6; //Second chain starts with DF 6
      abFirstDFInChain[2] = 8; //Third chain starts with DF 8
    }
}

void vSetupGrid28()
{
    putValue(ADC_G_ActiveDF_01, 1);
    putValue(ADC_G_ActiveDF_02, 1);
    putValue(ADC_G_ActiveDF_03, 1);
    putValue(ADC_G_ActiveDF_04, 1);
    putValue(ADC_G_ActiveDF_05, 1);
    putValue(ADC_G_ActiveDF_06, 1);    

    putValue(ADC_H_DFDataType_02, 5);  //HSVL
}

void vSetupGrid29()
{
    byte bProject; 
    bProject = getValue(ADC_A_Project);

    putValue(ADC_G_ActiveDF_01, 1);
    putValue(ADC_G_ActiveDF_02, 1);
    putValue(ADC_G_ActiveDF_03, 1);
    putValue(ADC_G_ActiveDF_04, 1);
    putValue(ADC_G_ActiveDF_05, 1);
    putValue(ADC_G_ActiveDF_06, 1);
    putValue(ADC_G_ActiveDF_07, 1);
    putValue(ADC_G_ActiveDF_08, 1);
    putValue(ADC_G_ActiveDF_09, 1);
    putValue(ADC_G_ActiveDF_10, 1);
    putValue(ADC_G_ActiveDF_11, 1);

    switch(bProject)
    {    
        case 0:
           putValue(ADC_H_DFDataType_01, 5);       //HSVL
           break;
        case 1:
           putValue(ADC_H_DFDataType_01, 3);       //Icon
           putValue(ADC_I_IconNr_01, 0x00);
           break;
    }

    putValue(ADC_H_DFDataType_03, 3);  //Icon
    putValue(ADC_I_IconNr_03, 3);

    putValue(ADC_H_DFDataType_05, 3);  //Icon
    putValue(ADC_I_IconNr_05, 4);

    putValue(ADC_H_DFDataType_07, 3);  //Icon
    putValue(ADC_I_IconNr_07, 5);

    putValue(ADC_H_DFDataType_09, 3);  //Icon
    putValue(ADC_I_IconNr_09, 13);

    putValue(ADC_D_NrChainConfig, 5); //5 chains
    abFirstDFInChain[0] = 1; //First chain starts with DF 1
    abFirstDFInChain[1] = 3; //Second chain starts with DF 3
    abFirstDFInChain[2] = 5; //Third chain starts with DF 5
    abFirstDFInChain[3] = 7; //Fourth chain starts with DF 7
    abFirstDFInChain[4] = 9; //Fifth chain starts with DF 9

}

void vSetupGrid30()
{
    putValue(ADC_G_ActiveDF_01, 1);
    putValue(ADC_G_ActiveDF_02, 1);
    putValue(ADC_G_ActiveDF_03, 1);
    putValue(ADC_G_ActiveDF_04, 1);
    putValue(ADC_G_ActiveDF_05, 1);
    putValue(ADC_G_ActiveDF_06, 1);    
}

void vSetupGrid31()
{
    putValue(ADC_G_ActiveDF_01, 1);
    putValue(ADC_G_ActiveDF_02, 1);
    putValue(ADC_G_ActiveDF_03, 1);

    putValue(ADC_D_MultiLine, 1);
    putValue(ADC_F_LineConnector, 1);
    putValue(ADC_F_NrOfMultiLines, 2);
}

void vSetupGrid32()
{
    putValue(ADC_G_ActiveDF_01, 1);
    putValue(ADC_G_ActiveDF_02, 1);
    putValue(ADC_G_ActiveDF_03, 1);
    putValue(ADC_G_ActiveDF_04, 1);
    putValue(ADC_G_ActiveDF_05, 1);
    putValue(ADC_G_ActiveDF_06, 1);
    putValue(ADC_G_ActiveDF_07, 1);
  
    putValue(ADC_H_DFDataType_02, 3);  //Icon
    putValue(ADC_I_IconNr_02, 28);

    putValue(ADC_H_DFDataType_04, 3);  //Icon
    putValue(ADC_I_IconNr_04, 31);

    putValue(ADC_H_DFDataType_06, 3);  //Icon
    putValue(ADC_I_IconNr_06, 90);
  
    if(getValue(ADC_A_Project) == 0x01 ) //VS30 HL/HLP
    {
      putValue(ADC_G_ActiveDF_08, 1);
      putValue(ADC_G_ActiveDF_09, 1);

      putValue(ADC_H_DFDataType_08, 3);  //Icon
      putValue(ADC_I_IconNr_08, 27);
      
      putValue(ADC_D_NrChainConfig, 4); //4 chains
      abFirstDFInChain[0] = 2; //First chain starts with DF 2
      abFirstDFInChain[1] = 4; //Second chain starts with DF 4
      abFirstDFInChain[2] = 6; //Third chain starts with DF 6
      abFirstDFInChain[3] = 8; //Fourth chain starts with DF 8  
    }
    else//VS30 LL/ML
    {
      putValue(ADC_D_NrChainConfig, 3); //3 chains
      abFirstDFInChain[0] = 2; //First chain starts with DF 2
      abFirstDFInChain[1] = 4; //Second chain starts with DF 4
      abFirstDFInChain[2] = 6; //Third chain starts with DF 6
    }
}

void vSetupGrid33()
{
    putValue(ADC_G_ActiveDF_01, 1);
    putValue(ADC_G_ActiveDF_02, 1);
    putValue(ADC_G_ActiveDF_03, 1);
    putValue(ADC_G_ActiveDF_04, 1);
	  putValue(ADC_G_ActiveDF_05, 1);
	  putValue(ADC_G_ActiveDF_06, 1);
	  putValue(ADC_G_ActiveDF_07, 1);
    putValue(ADC_G_ActiveDF_08, 1);

    putValue(ADC_H_DFDataType_01, 3); //Icon
	  putValue(ADC_I_IconNr_01, 0x1B);
	
	  putValue(ADC_H_DFDataType_07, 3); //Icon
	  putValue(ADC_I_IconNr_07, 0x46);
    
    if(getValue(ADC_A_Project) == 0x01 ) //VS30 HL/HLP
    {
      putValue(ADC_D_NrChainConfig, 2); //2 chain
      abFirstDFInChain[0] = 1; //First chain starts with DF 1
      abFirstDFInChain[1] = 3; //Second chain starts with DF 3
    }
    else
    {
      putValue(ADC_D_NrChainConfig, 1); //1 chain
      abFirstDFInChain[0] = 1; //First chain starts with DF 1
    }
}

void vSetupGrid34()
{
    byte bProject; 
    bProject = getValue(ADC_A_Project);
 
    putValue(ADC_G_ActiveDF_01, 1);
    putValue(ADC_G_ActiveDF_02, 1);
    putValue(ADC_G_ActiveDF_03, 1);
    putValue(ADC_G_ActiveDF_04, 1);
    putValue(ADC_G_ActiveDF_05, 1);
    putValue(ADC_G_ActiveDF_06, 1);
    putValue(ADC_G_ActiveDF_07, 1);
    putValue(ADC_G_ActiveDF_08, 1);

    putValue(ADC_H_DFDataType_01, 3);  //Icon
    putValue(ADC_I_IconNr_01, 27);

    switch(bProject)
    {
        case 0:
           putValue(ADC_H_DFDataType_03, 5);  //HSVL
           break;
        case 1:
           putValue(ADC_H_DFDataType_03, 3);  //Icon
           putValue(ADC_I_IconNr_03, 0xA9);
           break;
    }

    putValue(ADC_D_NrChainConfig, 2); //Two chains
    abFirstDFInChain[0] = 1; //First chain starts with DF 1
    abFirstDFInChain[1] = 4; //Second chain starts with DF 4
}

void vSetupGrid35()
{
    putValue(ADC_G_ActiveDF_01, 1);

    putValue(ADC_H_DFDataType_01, 3);  //Icon
    putValue(ADC_H_Special_01, 1);  //Special data
    putValue(ADC_K_Special_DF01, Flags); //Flags
}

void vSetupGrid36()
{
    putValue(ADC_G_ActiveDF_01, 1);
    putValue(ADC_G_ActiveDF_02, 1);
    putValue(ADC_G_ActiveDF_03, 1);
    putValue(ADC_G_ActiveDF_04, 1);
    putValue(ADC_G_ActiveDF_05, 1);
    putValue(ADC_G_ActiveDF_06, 1);
    putValue(ADC_G_ActiveDF_07, 1);
    putValue(ADC_G_ActiveDF_08, 1);
    putValue(ADC_G_ActiveDF_09, 1);
    putValue(ADC_G_ActiveDF_10, 1);
    putValue(ADC_G_ActiveDF_11, 1);
    putValue(ADC_G_ActiveDF_12, 1);

    putValue(ADC_H_DFDataType_05, 3);  //Icon
    putValue(ADC_I_IconNr_05, 36);

    putValue(ADC_H_DFDataType_07, 3);  //Icon
    putValue(ADC_I_IconNr_07, 35);

    putValue(ADC_H_DFDataType_09, 3);  //Icon
    putValue(ADC_I_IconNr_09, 34);

    putValue(ADC_H_DFDataType_11, 3);  //Icon
    putValue(ADC_I_IconNr_11, 35);

    putValue(ADC_D_NrChainConfig, 4); //4 chains
    abFirstDFInChain[0] = 5; //First chain starts with DF 5
    abFirstDFInChain[1] = 7; //Second chain starts with DF 7
    abFirstDFInChain[2] = 9; //Third chain starts with DF 9
    abFirstDFInChain[3] = 11; //Fourth chain starts with DF 11
}

void vSetupGrid40()
{
    putValue(ADC_G_ActiveDF_01, 1);
    putValue(ADC_G_ActiveDF_02, 1);
    putValue(ADC_G_ActiveDF_03, 1);
    putValue(ADC_G_ActiveDF_04, 1);
    putValue(ADC_G_ActiveDF_05, 1);
    putValue(ADC_G_ActiveDF_06, 1);
    putValue(ADC_G_ActiveDF_07, 1);
    putValue(ADC_G_ActiveDF_08, 1);
    putValue(ADC_G_ActiveDF_09, 1);
    putValue(ADC_G_ActiveDF_10, 1);
    putValue(ADC_G_ActiveDF_11, 1);
    putValue(ADC_G_ActiveDF_12, 1);
    
    putValue(ADC_H_DFDataType_05, 3);  //Icon
    putValue(ADC_I_IconNr_05, 36);

    putValue(ADC_H_DFDataType_07, 3);  //Icon
    putValue(ADC_I_IconNr_07, 35);

    putValue(ADC_H_DFDataType_09, 3);  //Icon
    putValue(ADC_I_IconNr_09, 34);

    putValue(ADC_H_DFDataType_11, 3);  //Icon
    putValue(ADC_I_IconNr_11, 35);

    putValue(ADC_D_NrChainConfig, 4); //4 chains
    abFirstDFInChain[0] = 5; //First chain starts with DF 5
    abFirstDFInChain[1] = 7; //Second chain starts with DF 7
    abFirstDFInChain[2] = 9; //Third chain starts with DF 9
    abFirstDFInChain[3] = 11; //Fourth chain starts with DF 11
}

void vSetupGrid41()
{
    putValue(ADC_G_ActiveDF_01, 1);
    putValue(ADC_H_DFDataType_01, 5);  //HSVL
}

void vSetupGrid42()
{
    putValue(ADC_G_ActiveDF_01, 1);
    putValue(ADC_G_ActiveDF_02, 1);
    putValue(ADC_G_ActiveDF_03, 1);
    putValue(ADC_G_ActiveDF_04, 1);
    putValue(ADC_G_ActiveDF_05, 1);

    putValue(ADC_D_MultiLine, 1);
    putValue(ADC_F_LineConnector, 1);
    putValue(ADC_F_NrOfMultiLines, 4);
}

void vSetupGrid43()
{
    putValue(ADC_G_ActiveDF_01, 1);
    putValue(ADC_G_ActiveDF_02, 1);
    putValue(ADC_G_ActiveDF_03, 1);
    putValue(ADC_G_ActiveDF_04, 1);
    putValue(ADC_G_ActiveDF_05, 1);

    putValue(ADC_H_DFDataType_03, 3);  //Icon
    putValue(ADC_H_Special_03, 1);  //Special data
    putValue(ADC_K_Special_DF03, Turns); //Turns

    putValue(ADC_H_DFDataType_05, 3);  //Icon
    putValue(ADC_H_Special_05, 1);  //Special data
    putValue(ADC_K_Special_DF05, Bargraph); //Bargraph

    putValue(ADC_D_NrChainConfig, 1);
    abFirstDFInChain[0] = 3;
}

void vSetupGrid45()
{
    putValue(ADC_G_ActiveDF_01, 1);
    putValue(ADC_G_ActiveDF_02, 1);
    putValue(ADC_G_ActiveDF_03, 1);
    putValue(ADC_G_ActiveDF_04, 1);
	  putValue(ADC_G_ActiveDF_05, 1);
  
    putValue(ADC_H_DFDataType_03, 3); //Icon
	  putValue(ADC_I_IconNr_03, 0x39);
	
	  putValue(ADC_H_DFDataType_05, 3); //Icon
	  putValue(ADC_I_IconNr_05, 0xE1);
  
    if(getValue(ADC_A_Project) == 0x01 ) //VS30 HL/HLP
    {
	    putValue(ADC_G_ActiveDF_06, 1);
    }
}

void vSetupGrid56()
{
    putValue(ADC_G_ActiveDF_01, 1);
    putValue(ADC_G_ActiveDF_02, 1);
    putValue(ADC_G_ActiveDF_03, 1);
    putValue(ADC_G_ActiveDF_04, 1);
	  putValue(ADC_G_ActiveDF_05, 1);

    putValue(ADC_H_DFDataType_01, 3); //Icon
	  putValue(ADC_I_IconNr_01, 0x39);
  
    if(getValue(ADC_A_Project) == 0x01 ) //VS30 HL/HLP
    {
	    putValue(ADC_G_ActiveDF_06, 1);
      
      putValue(ADC_D_MultiLine, 1);
      putValue(ADC_F_LineConnector, 1);
      putValue(ADC_F_NrOfMultiLines, 4);
    }
    else//VS30 LL/ML
    {	  
      putValue(ADC_D_MultiLine, 1);
      putValue(ADC_F_LineConnector, 1);
      putValue(ADC_F_NrOfMultiLines, 3);
    }
}

void vSetupGrid57()
{
    byte bProject; 
    bProject = getValue(ADC_A_Project);

    putValue(ADC_G_ActiveDF_01, 1);
    putValue(ADC_G_ActiveDF_02, 1);
    putValue(ADC_G_ActiveDF_03, 1);
    putValue(ADC_G_ActiveDF_04, 1);
    putValue(ADC_G_ActiveDF_05, 1);
    putValue(ADC_G_ActiveDF_06, 1);
    putValue(ADC_G_ActiveDF_07, 1);

    switch(bProject)
    {
        case 0:
           putValue(ADC_H_DFDataType_02, 5);  //HSVL
           break;
        case 1:
           putValue(ADC_H_DFDataType_02, 3);  //Icon
           putValue(ADC_I_IconNr_02, 0xA9);
           break;
    }

    putValue(ADC_D_NrChainConfig, 1);
    abFirstDFInChain[0] = 3; //First chain starts with DF 3
}

void vSetupGrid63()
{
    putValue(ADC_G_ActiveDF_01, 1);
    putValue(ADC_G_ActiveDF_02, 1);
    putValue(ADC_G_ActiveDF_03, 1);
    putValue(ADC_G_ActiveDF_04, 1);
	  putValue(ADC_G_ActiveDF_05, 1);
	  putValue(ADC_G_ActiveDF_06, 1);
	
	  putValue(ADC_H_DFDataType_05, 3); //Icon
	  putValue(ADC_I_IconNr_05, 0xE1);
}

void vSetupGrid64()
{
    putValue(ADC_G_ActiveDF_01, 1);
    putValue(ADC_G_ActiveDF_02, 1);
    putValue(ADC_G_ActiveDF_03, 1);
    putValue(ADC_G_ActiveDF_04, 1);
    putValue(ADC_G_ActiveDF_05, 1);
  
    if(getValue(ADC_A_Project) == 0x01 ) //VS30 HL/HLP
    {
      putValue(ADC_H_DFDataType_03, 3);  //Icon
      putValue(ADC_I_IconNr_03, 0xE1);
    }
    else//VS30 LL/ML
    {	  
      putValue(ADC_H_DFDataType_05, 3);  //Icon
      putValue(ADC_I_IconNr_05, 0xE1);
    }
}

void vSetupGrid65()
{
    putValue(ADC_G_ActiveDF_01, 1);
    putValue(ADC_G_ActiveDF_02, 1);
    putValue(ADC_G_ActiveDF_03, 1);
    putValue(ADC_G_ActiveDF_04, 1);
	  putValue(ADC_G_ActiveDF_05, 1);
    
    if(getValue(ADC_A_Project) == 0x01 ) //VS30 HL/HLP
    {
	    putValue(ADC_H_DFDataType_02, 3); //Icon
	    putValue(ADC_I_IconNr_02, 0xB4);
	
	    putValue(ADC_H_DFDataType_03, 3); //Icon
	    putValue(ADC_I_IconNr_03, 0xE1);
    }
    else//VS30 LL/ML
    {	  
	    putValue(ADC_H_DFDataType_04, 3); //Icon
	    putValue(ADC_I_IconNr_04, 0xB4);
	
	    putValue(ADC_H_DFDataType_05, 3); //Icon
	    putValue(ADC_I_IconNr_05, 0xE1);
    }
    

}

void vSetupGrid66()
{
    putValue(ADC_G_ActiveDF_01, 1);
    putValue(ADC_G_ActiveDF_02, 1);
    putValue(ADC_G_ActiveDF_03, 1);
    putValue(ADC_G_ActiveDF_04, 1);
    putValue(ADC_G_ActiveDF_05, 1);
    putValue(ADC_G_ActiveDF_06, 1);
    putValue(ADC_G_ActiveDF_07, 1);

    putValue(ADC_H_DFDataType_01, 3);  //Icon
    putValue(ADC_I_IconNr_01, 27);

    putValue(ADC_D_NrChainConfig, 2); //Two chains
    abFirstDFInChain[0] = 1; //First chain starts with DF 1
    abFirstDFInChain[1] = 3; //Second chain starts with DF 3
}

void vSetupGrid67()
{
    putValue(ADC_G_ActiveDF_01, 1);
    putValue(ADC_G_ActiveDF_02, 1);
    putValue(ADC_G_ActiveDF_03, 1);
    putValue(ADC_G_ActiveDF_04, 1);
    putValue(ADC_G_ActiveDF_05, 1);
    putValue(ADC_G_ActiveDF_06, 1);

    putValue(ADC_D_NrChainConfig, 1);
    abFirstDFInChain[0] = 2; //First chain starts with DF 2
}

void vSetupGrid74()
{
    putValue(ADC_G_ActiveDF_01, 1);
    putValue(ADC_G_ActiveDF_02, 1);
    putValue(ADC_G_ActiveDF_03, 1);
    putValue(ADC_G_ActiveDF_04, 1);
    putValue(ADC_G_ActiveDF_05, 1);
    putValue(ADC_G_ActiveDF_06, 1);
    putValue(ADC_G_ActiveDF_07, 1);

    putValue(ADC_H_DFDataType_01, 3);  //Icon
    putValue(ADC_I_IconNr_01, 27);

    putValue(ADC_H_DFDataType_03, 5);  //HSVL

    putValue(ADC_D_NrChainConfig, 2); //Two chains
    abFirstDFInChain[0] = 1; //First chain starts with DF 1
    abFirstDFInChain[1] = 4; //Second chain starts with DF 4
}

void vSetupGrid75()
{
    putValue(ADC_G_ActiveDF_01, 1);
    putValue(ADC_G_ActiveDF_02, 1);
    putValue(ADC_G_ActiveDF_03, 1);
    putValue(ADC_G_ActiveDF_04, 1);
    putValue(ADC_G_ActiveDF_05, 1);
	 
    putValue(ADC_H_DFDataType_01, 3);  //Icon
    putValue(ADC_I_IconNr_01, 0x34);
  
    putValue(ADC_H_DFDataType_05, 3);  //Icon
    putValue(ADC_I_IconNr_05, 0xE1);
}
 
void vSetupGrid79()
{
    putValue(ADC_G_ActiveDF_01, 1);
    putValue(ADC_G_ActiveDF_02, 1);
    putValue(ADC_G_ActiveDF_03, 1);
    putValue(ADC_G_ActiveDF_04, 1);
	  
	  putValue(ADC_D_MultiLine, 1);
    putValue(ADC_F_LineConnector, 1);
    putValue(ADC_F_NrOfMultiLines, 3);
  
    if(getValue(ADC_A_Project) == 0x01 ) //VS30 HL/HLP
    {
      putValue(ADC_G_ActiveDF_05, 1);
    }
}

void vSetupGrid80()
{
    putValue(ADC_G_ActiveDF_01, 1);
    putValue(ADC_G_ActiveDF_02, 1);
    putValue(ADC_G_ActiveDF_03, 1);
    putValue(ADC_G_ActiveDF_04, 1);
	  
    if(getValue(ADC_A_Project) == 0x01 ) //VS30 HL/HLP
    {
      putValue(ADC_G_ActiveDF_05, 1);
 
	    putValue(ADC_D_MultiLine, 1);
      putValue(ADC_F_LineConnector, 1);
      putValue(ADC_F_NrOfMultiLines, 4);
    }
    else//VS30 LL/ML
    {
	    putValue(ADC_D_MultiLine, 1);
      putValue(ADC_F_LineConnector, 1);
      putValue(ADC_F_NrOfMultiLines, 3);      
    }

}

void vSetupGrid81()
{
    putValue(ADC_G_ActiveDF_01, 1);
    putValue(ADC_G_ActiveDF_02, 1);
    putValue(ADC_G_ActiveDF_03, 1);
    putValue(ADC_G_ActiveDF_04, 1);
	  putValue(ADC_G_ActiveDF_05, 1);
	  putValue(ADC_G_ActiveDF_06, 1);
    
    if(getValue(ADC_A_Project) == 0x01 ) //VS30 HL/HLP
    {

      putValue(ADC_G_ActiveDF_07, 1);
	
	    putValue(ADC_D_MultiLine, 1);
      putValue(ADC_F_LineConnector, 1);
      putValue(ADC_F_NrOfMultiLines, 4);
	
	    putValue(ADC_H_DFDataType_03, 3); //Icon
	    putValue(ADC_I_IconNr_03, 0x39);
    }
    else
    {
	    putValue(ADC_D_MultiLine, 1);
      putValue(ADC_F_LineConnector, 1);
      putValue(ADC_F_NrOfMultiLines, 3);      
    }
}

void vSetupGrid84()
{
    putValue(ADC_G_ActiveDF_01, 1);
    putValue(ADC_G_ActiveDF_02, 1);
    putValue(ADC_G_ActiveDF_03, 1);
    putValue(ADC_G_ActiveDF_04, 1);
	  putValue(ADC_G_ActiveDF_05, 1);
	  putValue(ADC_G_ActiveDF_06, 1);
	
	  putValue(ADC_H_DFDataType_04, 3); //Icon
	  putValue(ADC_H_Special_04, 1); //Special Data
	  putValue(ADC_K_Special_DF04, Turns); // Turns
	
	  putValue(ADC_H_DFDataType_05, 3); //Icon
	  putValue(ADC_H_Special_05, 1); //Special Data
	  putValue(ADC_K_Special_DF05, Bargraph); // Bargraph
	
	  putValue(ADC_H_DFDataType_06, 3); //Icon
	  putValue(ADC_H_Special_06, 1); //Special Data
	  putValue(ADC_K_Special_DF06, LaneG); // Laneguidance
	
}

void vSetupGrid87()
{
    byte bProject; 
    bProject = getValue(ADC_A_Project);

    putValue(ADC_G_ActiveDF_01, 1);
    putValue(ADC_G_ActiveDF_02, 1);
    putValue(ADC_G_ActiveDF_03, 1);
    putValue(ADC_G_ActiveDF_04, 1);
    putValue(ADC_G_ActiveDF_05, 1);
    putValue(ADC_G_ActiveDF_06, 1);
    putValue(ADC_G_ActiveDF_07, 1);
    putValue(ADC_G_ActiveDF_08, 1);
    putValue(ADC_G_ActiveDF_09, 1);
    putValue(ADC_G_ActiveDF_10, 1);
    putValue(ADC_G_ActiveDF_11, 1);

    switch(bProject)
    {    
        case 0:
           putValue(ADC_H_DFDataType_01, 5);       //HSVL
           break;
        case 1:
           putValue(ADC_H_DFDataType_01, 3);       //Icon
           putValue(ADC_I_IconNr_01, 0x00);
           break;
    }

    putValue(ADC_H_DFDataType_03, 3);  //Icon
    putValue(ADC_I_IconNr_03, 3);

    putValue(ADC_H_DFDataType_05, 3);  //Icon
    putValue(ADC_I_IconNr_05, 4);

    putValue(ADC_H_DFDataType_07, 3);  //Icon
    putValue(ADC_I_IconNr_07, 5);

    putValue(ADC_H_DFDataType_09, 3);  //Icon
    putValue(ADC_I_IconNr_09, 13);

    putValue(ADC_D_NrChainConfig, 5); //5 chains
    abFirstDFInChain[0] = 1; //First chain starts with DF 1
    abFirstDFInChain[1] = 3; //Second chain starts with DF 3
    abFirstDFInChain[2] = 5; //Third chain starts with DF 5
    abFirstDFInChain[3] = 7; //Fourth chain starts with DF 7
    abFirstDFInChain[4] = 9; //Fifth chain starts with DF 9

}

void vSetupGrid208()
{
    putValue(ADC_G_ActiveDF_01, 1);
    putValue(ADC_G_ActiveDF_02, 1);
    putValue(ADC_G_ActiveDF_03, 1);
    putValue(ADC_G_ActiveDF_04, 1);
    putValue(ADC_G_ActiveDF_05, 1);
    putValue(ADC_G_ActiveDF_06, 1);

    putValue(ADC_D_MultiLine, 1);
    putValue(ADC_F_LineConnector, 1);
    putValue(ADC_F_NrOfMultiLines, 4);
}

void vSetupGridInvalid()
{
    putValue(ADC_G_ActiveDF_01, 1);
    putValue(ADC_G_ActiveDF_02, 1);
    putValue(ADC_G_ActiveDF_03, 1);
    putValue(ADC_G_ActiveDF_04, 1);
    putValue(ADC_G_ActiveDF_05, 1);
    putValue(ADC_G_ActiveDF_06, 1);
    putValue(ADC_G_ActiveDF_07, 1);    
    putValue(ADC_G_ActiveDF_08, 1);
    putValue(ADC_G_ActiveDF_09, 1);
    putValue(ADC_G_ActiveDF_10, 1);
    putValue(ADC_G_ActiveDF_11, 1);
    putValue(ADC_G_ActiveDF_12, 1);
    putValue(ADC_G_ActiveDF_13, 1);
    putValue(ADC_G_ActiveDF_14, 1);
    putValue(ADC_G_ActiveDF_15, 1);
    putValue(ADC_G_ActiveDF_16, 1);
}

on envVar ADC_Z_LaneGInv1
{
byte Data[103]={0x04,0x04,0xA4,0x02,0x01,0x19,0x84,0x02,0x01,0x54,0x06,0x04,0x05,0x54,0x06,0x04,0x7F,0x00,0x05,0x00,0x30,0x00,0x2B,0x07,0x00,0x10,0x00,0x44,0x30,0x32,0x05,0x00,0x30,0x00,0x2C,0x07,0x00,0x10,0x00,0x44,0x30,0x34,0x07,0x00,0xB0,0x00,0x21,0x01,0x00,0x07,0x00,0x10,0x00,0x44,0x30,0x36,0x2F,0x00,0xB0,0x00,0x01,0x29,0x01,0x01,0x00,0x00,0x03,0x09,0x00,0x00,0x01,0x01,0x00,0x00,0x01,0x01,0x00,0x00,0x01,0x01,0x00,0x00,0x01,0x01,0x00,0x00,0x01,0x01,0x00,0x00,0x01,0x01,0x00,0x00,0x03,0x09,0x00,0x00,0x03,0x09,0x01,0x00,0x01};
byte k;
if (getValue(this) == 1)
    {
    for (k=0; k<103; k++)
        {
        TxBuffer[k] = Data[k];
        }
    if( !getValue( HMI__STMSG_TP_TGW_IC_Nav ) )
        CanTpSendData(lNavHandle, TxBuffer, 103);
    }
}

on envVar ADC_Z_LaneGInv2
{
byte Data[103]={0x04,0x04,0xA4,0x02,0x01,0x19,0x84,0x02,0x01,0x54,0x06,0x04,0x05,0x54,0x06,0x04,0x7F,0x00,0x05,0x00,0x30,0x00,0x2B,0x07,0x00,0x10,0x00,0x44,0x30,0x32,0x05,0x00,0x30,0x00,0x2C,0x07,0x00,0x10,0x00,0x44,0x30,0x34,0x07,0x00,0xB0,0x00,0x21,0x01,0x00,0x07,0x00,0x10,0x00,0x44,0x30,0x36,0x2F,0x00,0xB0,0x00,0x01,0x29,0x03,0x09,0x01,0x00,0x03,0x09,0x00,0x00,0x01,0x01,0x00,0x00,0x01,0x01,0x00,0x00,0x01,0x01,0x00,0x00,0x01,0x01,0x00,0x00,0x01,0x01,0x00,0x00,0x01,0x01,0x00,0x00,0x03,0x09,0x01,0x00,0x01,0x01,0x00,0x00,0x00};
byte k;
if (getValue(this) == 1)
    {
    for (k=0; k<103; k++)
        {
        TxBuffer[k] = Data[k];
        }
    if( !getValue( HMI__STMSG_TP_TGW_IC_Nav ) )
        CanTpSendData(lNavHandle, TxBuffer, 103);
    }
}

on envVar ADC_Z_StressTest
{
    if (getValue(this) == 1)
    {
    putValue(ADC_D_EvMaskSet, 1);
    putValue(ADC_E_EvOFNLeft, 1);
    putValue(ADC_E_EvOFNRight, 1);
    putValue(ADC_E_EvReturn, 1);
    putValue(ADC_E_EvOFNUp, 1);
    putValue(ADC_E_EvOFNDown, 1);
    if (getValue(ADC_Z_StressTest_Aud) == 1)
        setTimer(msTimer_StressTest_AUD, getValue(ADC_Z_TimerStress));
    if (getValue(ADC_Z_StressTest_Nav) == 1)
        setTimer(msTimer_StressTest_NAV, getValue(ADC_Z_TimerStress));
    if (getValue(ADC_Z_StressTest_Tel) == 1)
        setTimer(msTimer_StressTest_TEL, getValue(ADC_Z_TimerStress));
    }
    else
    {
    putValue(ADC_Z_StressTest_Aud, 0);
    putValue(ADC_Z_StressTest_Nav, 0);
    putValue(ADC_Z_StressTest_Tel, 0);
    vInitAll();
    vInitDataFields();
    vInitLinesChains();
    vSetupGrid18();
    }
}

on timer msTimer_StressTest_AUD
{
int i;
//vInitAll ();
    putValue(ADC_A_NodeAddress, Node_AUD);
    putValue(ADC_A_CANChannel, 0x00);
    switch (StressTestNoAud)
        {
        case 0:
            {
            putValue(ADC_B_Application, 0x01);    
            putValue(ADC_G_ActiveDF_01, 1);
            putValue(ADC_G_ActiveDF_02, 1);
            putValue(ADC_G_ActiveDF_03, 1);
            putValue(ADC_G_ActiveDF_04, 1);
            putValue(ADC_G_ActiveDF_05, 1);
            putValue(ADC_G_ActiveDF_06, 1);
            putValue(ADC_G_ActiveDF_07, 0);
            putValue(ADC_G_ActiveDF_08, 0);
            putValue(ADC_G_ActiveDF_09, 0);
            putValue(ADC_G_ActiveDF_10, 0);
            putValue(ADC_G_ActiveDF_11, 0);
            putValue(ADC_G_ActiveDF_12, 0);
            putValue(ADC_G_ActiveDF_13, 0);
            abDFDataType[0] = 1;
            strncpy(acDFContent[0], "Headline", 62);
            abDFAlignment[0] = random(4);
            abDFSpecial[0] = 0;

            abDFDataType[1] = 1;
            strncpy(acDFContent[1], "Very Last Item", 62);
            abDFAlignment[1] = random(4);
            abDFSpecial[1] = 0;

            abDFDataType[2] = 1;
            strncpy(acDFContent[2], "First Item", 62);
            abDFAlignment[2] = random(4);
            abDFSpecial[2] = 0;

            abDFDataType[3] = 1;
            strncpy(acDFContent[3], "Second Item", 62);
            abDFAlignment[3] = random(4);
            abDFSpecial[3] = 0;

            abDFDataType[4] = 1;
            strncpy(acDFContent[4], "Third Item", 62);
            abDFAlignment[4] = random(4);
            abDFSpecial[4] = 0;

            abDFDataType[5] = 1;
            strncpy(acDFContent[5], "Subtitle", 62);
            abDFAlignment[5] = random(4);
            abDFSpecial[5] = 0;

            setTimer(msTimer_SendData_AUD,SendDelay);
            bGridIdAud = 26;
            }
            break;
        case 1:
            {
            putValue(ADC_B_Application, 0x02);    
            putValue(ADC_G_ActiveDF_01, 1);
            putValue(ADC_G_ActiveDF_02, 1);
            putValue(ADC_G_ActiveDF_03, 1);
            putValue(ADC_G_ActiveDF_04, 1);
            putValue(ADC_G_ActiveDF_05, 1);
            putValue(ADC_G_ActiveDF_06, 1);
            putValue(ADC_G_ActiveDF_07, 1);
            putValue(ADC_G_ActiveDF_08, 1);
            putValue(ADC_G_ActiveDF_09, 1);
            putValue(ADC_G_ActiveDF_10, 0);
            putValue(ADC_G_ActiveDF_11, 0);
            putValue(ADC_G_ActiveDF_12, 0);
            putValue(ADC_G_ActiveDF_13, 0);

            abDFDataType[0] = 1;
            strncpy(acDFContent[0], "Media", 62);
            abDFAlignment[0] = random(4);
            abDFSpecial[0] = 0;

            abDFDataType[1] = 3;
            awDFIconNr[1] = 0x1c;
            abDFAlignment[1] = 2;
            abDFSpecial[1] = 0;

            abDFDataType[2] = 1;
            strncpy(acDFContent[2], "Memory Card", 62);
            abDFAlignment[2] = random(4);
            abDFSpecial[2] = 0;

            abDFDataType[3] = 3;
            awDFIconNr[3] = 0x1f;
            abDFAlignment[3] = 2;
            abDFSpecial[3] = 0;

            abDFDataType[4] = 1;
            strncpy(acDFContent[4], "DISC", 62);
            abDFAlignment[4] = random(4);
            abDFSpecial[4] = 0;

            abDFDataType[5] = 3;
            awDFIconNr[5] = 0x5a;
            abDFAlignment[5] = 2;
            abDFSpecial[5] = 0;
            
            abDFDataType[6] = 1;
            strncpy(acDFContent[6], "HDD", 62);
            abDFAlignment[6] = random(4);
            abDFSpecial[6] = 0;

            abDFDataType[7] = 3;
            awDFIconNr[7] = 0x1b;
            abDFAlignment[7] = 2;
            abDFSpecial[7] = 0;
            
            abDFDataType[8] = 1;
            strncpy(acDFContent[8], "USB", 62);
            abDFAlignment[8] = random(4);
            abDFSpecial[8] = 0;

                
            putValue(ADC_D_NrChainConfig, 4); //4 chains
            abFirstDFInChain[0] = 2; //First chain starts with DF 2
            abFirstDFInChain[1] = 4; //Second chain starts with DF 4
            abFirstDFInChain[2] = 6; //Third chain starts with DF 6
            abFirstDFInChain[3] = 8; //Fourth chain starts with DF 8

            setTimer(msTimer_SendData_AUD,SendDelay);
            bGridIdAud = 32;
            }
            break;
        case 2:
            {
            putValue(ADC_B_Application, 0x02);    
            putValue(ADC_G_ActiveDF_01, 1);
            putValue(ADC_G_ActiveDF_02, 1);
            putValue(ADC_G_ActiveDF_03, 1);
            putValue(ADC_G_ActiveDF_04, 1);
            putValue(ADC_G_ActiveDF_05, 1);
            putValue(ADC_G_ActiveDF_06, 1);
            putValue(ADC_G_ActiveDF_07, 1);
            putValue(ADC_G_ActiveDF_08, 1);
            putValue(ADC_G_ActiveDF_09, 1);
            putValue(ADC_G_ActiveDF_10, 1);
            putValue(ADC_G_ActiveDF_11, 1);
            putValue(ADC_G_ActiveDF_12, 0);
            putValue(ADC_G_ActiveDF_13, 0);

            abDFDataType[0] = 3;
            awDFIconNr[0] = 0x1b;
            abDFAlignment[0] = 2;
            abDFSpecial[0] = 0;

            abDFDataType[1] = 1;
            strncpy(acDFContent[1], "Pauls iPod", 62);
            abDFAlignment[1] = random(4);
            abDFSpecial[1] = 0;

            abDFDataType[2] = 1;
            strncpy(acDFContent[2], "1:", 62);
            abDFAlignment[2] = random(4);
            abDFSpecial[2] = 0;

            abDFDataType[3] = 1;
            strncpy(acDFContent[3], "Runaway Love", 62);
            abDFAlignment[3] = random(4);
            abDFSpecial[3] = 0;

            abDFDataType[4] = 1;
            strncpy(acDFContent[4], "2:", 62);
            abDFAlignment[4] = random(4);
            abDFSpecial[4] = 0;

            abDFDataType[5] = 1;
            strncpy(acDFContent[5], "Wicked Game", 62);
            abDFAlignment[5] = random(4);
            abDFSpecial[5] = 0;

            abDFDataType[6] = 1;
            strncpy(acDFContent[6], "3:", 62);
            abDFAlignment[6] = random(4);
            abDFSpecial[6] = 0;

            abDFDataType[7] = 1;
            strncpy(acDFContent[7], "Not Myself Tonight", 62);
            abDFAlignment[7] = random(4);
            abDFSpecial[7] = 0;

            abDFDataType[8] = 1;
            strncpy(acDFContent[8], "4:", 62);
            abDFAlignment[8] = random(4);
            abDFSpecial[8] = 0;

            abDFDataType[9] = 1;
            strncpy(acDFContent[9], "Glam", 62);
            abDFAlignment[9] = random(4);
            abDFSpecial[9] = 0;

            abDFDataType[10] = 1;
            strncpy(acDFContent[10], "Pauls Car Mix", 62);
            abDFAlignment[10] = random(4);
            abDFSpecial[10] = 0;

            setTimer(msTimer_SendData_AUD,SendDelay);
            bGridIdAud = 33;
            }
            break;
        case 3:
            {
            putValue(ADC_B_Application, 0x02);    
            putValue(ADC_G_ActiveDF_01, 1);
            putValue(ADC_G_ActiveDF_02, 1);
            putValue(ADC_G_ActiveDF_03, 1);
            putValue(ADC_G_ActiveDF_04, 1);
            putValue(ADC_G_ActiveDF_05, 1);
            putValue(ADC_G_ActiveDF_06, 1);
            putValue(ADC_G_ActiveDF_07, 1);
            putValue(ADC_G_ActiveDF_08, 1);
            putValue(ADC_G_ActiveDF_09, 0);
            putValue(ADC_G_ActiveDF_10, 0);
            putValue(ADC_G_ActiveDF_11, 0);
            putValue(ADC_G_ActiveDF_12, 0);
            putValue(ADC_G_ActiveDF_13, 0);

            abDFDataType[0] = 3;
            awDFIconNr[0] = 0x1b;
            abDFAlignment[0] = 2;
            abDFSpecial[0] = 0;

            abDFDataType[1] = 1;
            strncpy(acDFContent[1], "Pauls iPod", 62);
            abDFAlignment[1] = random(4);
            abDFSpecial[1] = 0;

            abDFDataType[2] = 5;
            strncpy(acDFContent[2], "0,0;0,0", 62);
            abDFSpecial[2] = 0;

            abDFDataType[3] = 1;
            strncpy(acDFContent[3], "7:", 62);
            abDFAlignment[3] = random(4);
            abDFSpecial[3] = 0;

            abDFDataType[4] = 1;
            strncpy(acDFContent[4], "Black Crow", 62);
            abDFAlignment[4] = random(4);
            abDFSpecial[4] = 0;

            abDFDataType[5] = 1;
            strncpy(acDFContent[5], "Jamiroquai", 62);
            abDFAlignment[5] = random(4);
            abDFSpecial[5] = 0;

            abDFDataType[6] = 1;
            strncpy(acDFContent[6], "A Funk Odyssey", 62);
            abDFAlignment[6] = random(4);
            abDFSpecial[6] = 0;

            abDFDataType[7] = 1;
            strncpy(acDFContent[7], "Pauls Car Mix", 62);
            abDFAlignment[7] = random(4);
            abDFSpecial[7] = 0;
                
            putValue(ADC_D_NrChainConfig, 2);
            abFirstDFInChain[0] = 1; 
            abFirstDFInChain[1] = 4;

            setTimer(msTimer_SendData_AUD,SendDelay);
            bGridIdAud = 34;
            }
            break;
        case 4:
            {
            putValue(ADC_B_Application, 0x01);    
            putValue(ADC_G_ActiveDF_01, 1);
            putValue(ADC_G_ActiveDF_02, 1);
            putValue(ADC_G_ActiveDF_03, 1);
            putValue(ADC_G_ActiveDF_04, 1);
            putValue(ADC_G_ActiveDF_05, 1);
            putValue(ADC_G_ActiveDF_06, 1);
            putValue(ADC_G_ActiveDF_07, 1);
            putValue(ADC_G_ActiveDF_08, 0);
            putValue(ADC_G_ActiveDF_09, 0);
            putValue(ADC_G_ActiveDF_10, 0);
            putValue(ADC_G_ActiveDF_11, 0);
            putValue(ADC_G_ActiveDF_12, 0);
            putValue(ADC_G_ActiveDF_13, 0);

            abDFDataType[0] = 1;
            strncpy(acDFContent[0], "Presets", 62);
            abDFAlignment[0] = random(4);
            abDFSpecial[0] = 0;

            abDFDataType[1] = 5;
            strncpy(acDFContent[1], "0,0;0,0", 62);
            abDFSpecial[1] = 0;

            abDFDataType[2] = 1;
            strncpy(acDFContent[2], "8:", 62);
            abDFAlignment[2] = random(4);
            abDFSpecial[2] = 0;

            abDFDataType[3] = 1;
            strncpy(acDFContent[3], "CNN", 62);
            abDFAlignment[3] = random(4);
            abDFSpecial[3] = 0;

            abDFDataType[4] = 1;
            strncpy(acDFContent[4], "Black Crow", 62);
            abDFAlignment[4] = random(4);
            abDFSpecial[4] = 0;

            abDFDataType[5] = 1;
            strncpy(acDFContent[5], "Jamiroquai", 62);
            abDFAlignment[5] = random(4);
            abDFSpecial[5] = 0;

            abDFDataType[6] = 1;
            strncpy(acDFContent[6], "Rock", 62);
            abDFAlignment[6] = random(4);
            abDFSpecial[6] = 0;

            putValue(ADC_D_NrChainConfig, 1); //1 chain
            abFirstDFInChain[0] = 3; //First chain starts with DF 3

            setTimer(msTimer_SendData_AUD,SendDelay);
            bGridIdAud = 57;
            }
            break;
        default:
            break;
        }
    StressTestNoAud++;
    if (StressTestNoAud > 4)
    {
    StressTestNoAud = 0;
    }
}

vInitAll()
{
    vInitActiveDF();
    vInitSpecialDF();
    vInitUCBMove();
    vInitConfiguration();

    putValue(ADC_H_DFDataType_01, 1);  //Text
    putValue(ADC_H_DFDataType_02, 1);  //Text
    putValue(ADC_H_DFDataType_03, 1);  //Text
    putValue(ADC_H_DFDataType_04, 1);  //Text
    putValue(ADC_H_DFDataType_05, 1);  //Text
    putValue(ADC_H_DFDataType_06, 1);  //Text
    putValue(ADC_H_DFDataType_07, 1);  //Text
    putValue(ADC_H_DFDataType_08, 1);  //Text
    putValue(ADC_H_DFDataType_09, 1);  //Text
    putValue(ADC_H_DFDataType_10, 1);  //Text
    putValue(ADC_H_DFDataType_11, 1);  //Text
    putValue(ADC_H_DFDataType_12, 1);  //Text
    putValue(ADC_H_DFDataType_13, 1);  //Text
    putValue(ADC_H_DFDataType_14, 1);  //Text
    putValue(ADC_H_DFDataType_15, 1);  //Text
    putValue(ADC_H_DFDataType_16, 1);  //Text
}

on timer msTimer_SendData_AUD
{
    vSendADCData(bGridIdAud);
    cancelTimer(msTimer_SendData_AUD);
}

on envVar ADC_Z_UpDown
{
    if(getValue(this) == 1)
    {
    UpPress = 0;
    setTimer(msTimer_UpDown, getValue(ADC_Z_TimerUpDown));
    }
    else
    {
    cancelTimer(msTimer_UpDown);
      putValue(Env_OFN_Up_1_Play, 0);
      putValue(Env_OFN_Down_1_Play, 0);
    }
}

on timer msTimer_UpDown
{
    if (UpPress == 0)
    {
      putValue(Env_OFN_Up_1_Play, 1); //Up
      putValue(Env_OFN_Down_1_Play, 0); //Down
    UpPress = 1;
    }
    else
    {
      putValue(Env_OFN_Up_1_Play, 0); //Up
      putValue(Env_OFN_Down_1_Play, 1); //Down
    UpPress = 0;
    }
setTimer(msTimer_UpDown, getValue(ADC_Z_TimerUpDown));
}

on envVar ADC_Z_LeftRight
{
    if(getValue(this) == 1)
    {
    LeftPress = 0;
    setTimer( msTimer_LeftRight, getValue( ADC_Z_TimerLeftRight ) );
    }
    else
    {
    cancelTimer( msTimer_LeftRight );
    putValue( Env_OFN_Left_1_Play, 0 ); //Left
    putValue( Env_OFN_Right_1_Play, 0 ); //End
    }
}

on timer msTimer_LeftRight
{
    if (LeftPress == 0)
    {
    putValue( Env_OFN_Left_1_Play, 1 ); //Left
    putValue( Env_OFN_Right_1_Play, 0 ); //End
    LeftPress = 1;
    }
    else
    {
    putValue( Env_OFN_Left_1_Play, 0 ); //Left
    putValue( Env_OFN_Right_1_Play, 1 ); //End
    LeftPress = 0;
    }
setTimer( msTimer_LeftRight, getValue( ADC_Z_TimerLeftRight ) );
}

void CanTp_ReceptionInd (long lHandle, byte bRxData[])
{
    byte NA;
    
    vGetHandleName(lHandle);
    writeLineEx (dwWriteTab, 1,"Received %d bytes on connection %s", elcount(bRxData), cHdlName);

    if (bRxData[2] != 0xA1)
      {
        NA = bRxData[0];
        switch (NA)
        {
            case Node_AUD:
            TxBuffer_AUD[0] = NA;
            TxBuffer_AUD[1] = bRxData[1];
            TxBuffer_AUD[2] = ADC_REPLY;
            TxBuffer_AUD[3] = bRxData[2];
            TxBuffer_AUD[4] = 0x00;
            setTimer(msTimer_Reply_AUD, getValue(ADC_Z_TimerReply));
            break;
            case Node_NAV:
            if (lHandle == lNavHandle)
            {
                TxBuffer_NAV[0] = NA;
                TxBuffer_NAV[1] = bRxData[1];
                TxBuffer_NAV[2] = ADC_REPLY;
                TxBuffer_NAV[3] = bRxData[2];
                TxBuffer_NAV[4] = 0x00;
                setTimer(msTimer_Reply_NAV, getValue(ADC_Z_TimerReply));
            }
            else if (lHandle == lSCAHandle)
            {
                TxBuffer_SCA[0] = NA;
                TxBuffer_SCA[1] = bRxData[1];
                TxBuffer_SCA[2] = ADC_REPLY;
                TxBuffer_SCA[3] = bRxData[2];
                TxBuffer_SCA[4] = 0x00;
                setTimer(msTimer_Reply_SCA, getValue(ADC_Z_TimerReply));
            }
            else if (lHandle == lHUDHandle)
            {
                TxBuffer_HUD[0] = NA;
                TxBuffer_HUD[1] = bRxData[1];
                TxBuffer_HUD[2] = ADC_REPLY;
                TxBuffer_HUD[3] = bRxData[2];
                TxBuffer_HUD[4] = 0x00;
                setTimer(msTimer_Reply_HUD, getValue(ADC_Z_TimerReply));
            }
            break;
            case Node_TEL:
            TxBuffer_TEL[0] = NA;
            TxBuffer_TEL[1] = bRxData[1];
            TxBuffer_TEL[2] = ADC_REPLY;
            TxBuffer_TEL[3] = bRxData[2];
            TxBuffer_TEL[4] = 0x00;
            setTimer(msTimer_Reply_TEL, getValue(ADC_Z_TimerReply));
            break;
            case Node_NES:
            TxBuffer_SCA[0] = NA;
            TxBuffer_SCA[1] = bRxData[1];
            TxBuffer_SCA[2] = ADC_REPLY;
            TxBuffer_SCA[3] = bRxData[2];
            TxBuffer_SCA[4] = 0x00;
            setTimer(msTimer_Reply_SCA, getValue(ADC_Z_TimerReply));
            break;
            default:
            break;
        }
    }

}

void CanTp_SendCon (long lHandle, DWORD dwCount)
{
    vGetHandleName(lHandle);
    writeLineEx (dwWriteTab, 1, "Transmission of %d bytes on connection %s successful", dwCount, cHdlName);

    if ((lHandle == lAudHandle) && (getValue(ADC_Z_StressTest_Aud) == 1))
        setTimer(msTimer_StressTest_AUD, getValue(ADC_Z_TimerStress));
    if ((lHandle == lNavHandle) && (getValue(ADC_Z_StressTest_Nav) == 1))
        setTimer(msTimer_StressTest_NAV, getValue(ADC_Z_TimerStress));
    if ((lHandle == lTelHandle) && (getValue(ADC_Z_StressTest_Tel) == 1))
        setTimer(msTimer_StressTest_TEL, getValue(ADC_Z_TimerStress));
}

void vGetHandleName(long lHandle)
{
    
    if (lHandle == lAudHandle)
        memcpy(cHdlName, cAud, elcount(cAud));
    if (lHandle == lNavHandle)
        memcpy(cHdlName, cNav, elcount(cNav));
    if (lHandle == lTelHandle)
        memcpy(cHdlName, cTel, elcount(cTel));
    if (lHandle == lHUDHandle)
        memcpy(cHdlName, cHUD, elcount(cHUD));
    if (lHandle == lSCAHandle)
        memcpy(cHdlName, cSCA, elcount(cSCA));
}

on timer msTimer_StressTest_NAV
{
int i;
//vInitAll ();
    putValue(ADC_A_NodeAddress, Node_NAV);
    putValue(ADC_A_CANChannel,  0x01);
    putValue(ADC_B_Application, 0x04);
    switch (StressTestNoNav)
        {
        case 0:
            {
            putValue(ADC_G_ActiveDF_01, 1);
            putValue(ADC_G_ActiveDF_02, 1);
            putValue(ADC_G_ActiveDF_03, 1);
            putValue(ADC_G_ActiveDF_04, 1);
            putValue(ADC_G_ActiveDF_05, 1);
            putValue(ADC_G_ActiveDF_06, 0);
            putValue(ADC_G_ActiveDF_07, 0);
            putValue(ADC_G_ActiveDF_08, 0);
            putValue(ADC_G_ActiveDF_09, 0);
            putValue(ADC_G_ActiveDF_10, 0);
            putValue(ADC_G_ActiveDF_11, 0);
            putValue(ADC_G_ActiveDF_12, 0);
            putValue(ADC_G_ActiveDF_13, 0);

            abDFDataType[0] = 1;
            strncpy(acDFContent[0], "Mozartstrasse", 62);
            abDFAlignment[0] = random(4);
            abDFSpecial[0] = 0;


            abDFDataType[1] = 3;
            abDFSpecial[1] = 1;
            abDFSpecialType[1] = 0x23;


            abDFDataType[2] = 1;
            strncpy(acDFContent[2], "600m", 62);
            abDFAlignment[2] = random(4);
            abDFSpecial[2] = 0;


            abDFDataType[3] = 3;
            abDFSpecial[3] = 1;
            abDFSpecialType[3] = 0x11;


            abDFDataType[4] = 1;
            strncpy(acDFContent[4], "B33", 62);
            abDFAlignment[4] = random(4);
            abDFSpecial[4] = 0;

           
            putValue(ADC_D_NrChainConfig, 1);
            abFirstDFInChain[0] = 2;

            setTimer(msTimer_SendData_NAV,SendDelay);
            bGridIdNav = 21;
            }
            break;
        case 1:
            {
            putValue(ADC_G_ActiveDF_01, 1);
            putValue(ADC_G_ActiveDF_02, 1);
            putValue(ADC_G_ActiveDF_03, 1);
            putValue(ADC_G_ActiveDF_04, 1);
            putValue(ADC_G_ActiveDF_05, 1);
            putValue(ADC_G_ActiveDF_06, 0);
            putValue(ADC_G_ActiveDF_07, 0);
            putValue(ADC_G_ActiveDF_08, 0);
            putValue(ADC_G_ActiveDF_09, 0);
            putValue(ADC_G_ActiveDF_10, 0);
            putValue(ADC_G_ActiveDF_11, 0);
            putValue(ADC_G_ActiveDF_12, 0);
            putValue(ADC_G_ActiveDF_13, 0);

            abDFDataType[0] = 1;
            strncpy(acDFContent[0], "Mozartstrasse", 62);
            abDFAlignment[0] = random(4);
            abDFSpecial[0] = 0;


            abDFDataType[1] = 3;
            abDFSpecial[1] = 1;
            abDFSpecialType[1] = 0x23;


            abDFDataType[2] = 1;
            strncpy(acDFContent[2], "600m", 62);
            abDFAlignment[2] = random(4);
            abDFSpecial[2] = 0;


            abDFDataType[3] = 3;
            abDFSpecial[3] = 1;
            abDFSpecialType[3] = 0x11;


            abDFDataType[4] = 3;
            abDFSpecial[4] = 1;
            abDFSpecialType[4] = 0x01;

           
            putValue(ADC_D_NrChainConfig, 1);
            abFirstDFInChain[0] = 2;

            setTimer(msTimer_SendData_NAV,SendDelay);
            bGridIdNav = 22;
            }
            break;
        case 2:
            {
            putValue(ADC_G_ActiveDF_01, 1);
            putValue(ADC_G_ActiveDF_02, 1);
            putValue(ADC_G_ActiveDF_03, 1);
            putValue(ADC_G_ActiveDF_04, 1);
            putValue(ADC_G_ActiveDF_05, 0);
            putValue(ADC_G_ActiveDF_06, 0);
            putValue(ADC_G_ActiveDF_07, 0);
            putValue(ADC_G_ActiveDF_08, 0);
            putValue(ADC_G_ActiveDF_09, 0);
            putValue(ADC_G_ActiveDF_10, 0);
            putValue(ADC_G_ActiveDF_11, 0);
            putValue(ADC_G_ActiveDF_12, 0);
            putValue(ADC_G_ActiveDF_13, 0);

            abDFDataType[0] = 1;
            strncpy(acDFContent[0], "Driving Direction", 62);
            abDFAlignment[0] = random(4);
            abDFSpecial[0] = 0;

            abDFDataType[1] = 1;
            strncpy(acDFContent[1], "N-W", 62);
            abDFAlignment[1] = random(4);
            abDFSpecial[1] = 0;

            abDFDataType[2] = 1;
            strncpy(acDFContent[2], "Letzte Ziele", 62);
            abDFAlignment[2] = random(4);
            abDFSpecial[2] = 0;

            abDFDataType[3] = 1;
            strncpy(acDFContent[3], "Sonnenbergstrasse", 62);
            abDFAlignment[3] = random(4);
            abDFSpecial[3] = 0;

            setTimer(msTimer_SendData_NAV,SendDelay);
            bGridIdNav = 23;          
            }
            break;
        case 3:
            {
            putValue(ADC_G_ActiveDF_01, 1);
            putValue(ADC_G_ActiveDF_02, 1);
            putValue(ADC_G_ActiveDF_03, 1);
            putValue(ADC_G_ActiveDF_04, 1);
            putValue(ADC_G_ActiveDF_05, 1);
            putValue(ADC_G_ActiveDF_06, 1);
            putValue(ADC_G_ActiveDF_07, 1);
            putValue(ADC_G_ActiveDF_08, 0);
            putValue(ADC_G_ActiveDF_09, 0);
            putValue(ADC_G_ActiveDF_10, 0);
            putValue(ADC_G_ActiveDF_11, 0);
            putValue(ADC_G_ActiveDF_12, 0);
            putValue(ADC_G_ActiveDF_13, 0);

            abDFDataType[0] = 3;
            awDFIconNr[0] = 0x2b;
            abDFAlignment[0] = 2;
            abDFSpecial[0] = 0;

            abDFDataType[1] = 1;
            strncpy(acDFContent[1], "99.999km", 62);
            abDFAlignment[1] = random(4);
            abDFSpecial[1] = 0;

            abDFDataType[2] = 3;
            awDFIconNr[2] = 0x2c;
            abDFAlignment[2] = 2;
            abDFSpecial[2] = 0;

            abDFDataType[3] = 1;
            strncpy(acDFContent[3], "23:59pm", 62);
            abDFAlignment[3] = random(4);
            abDFSpecial[3] = 0;


            abDFDataType[4] = 3;
            abDFSpecial[4] = 1;
            abDFSpecialType[4] = 0x21;


            abDFDataType[5] = 1;
            strncpy(acDFContent[5], "600m", 62);
            abDFAlignment[5] = random(4);
            abDFSpecial[5] = 0;


            abDFDataType[6] = 1;
            strncpy(acDFContent[6], "Sonnenbergstrasse", 62);
            abDFAlignment[6] = random(4);
            abDFSpecial[6] = 0;

           
            putValue(ADC_D_NrChainConfig, 2);
            abFirstDFInChain[0] = 1;
            abFirstDFInChain[1] = 5;

            setTimer(msTimer_SendData_NAV,SendDelay);
            bGridIdNav = 24;
            }
            break;
        case 4:
            {
            putValue(ADC_G_ActiveDF_01, 1);
            putValue(ADC_G_ActiveDF_02, 1);
            putValue(ADC_G_ActiveDF_03, 1);
            putValue(ADC_G_ActiveDF_04, 1);
            putValue(ADC_G_ActiveDF_05, 1);
            putValue(ADC_G_ActiveDF_06, 1);
            putValue(ADC_G_ActiveDF_07, 1);
            putValue(ADC_G_ActiveDF_08, 0);
            putValue(ADC_G_ActiveDF_09, 0);
            putValue(ADC_G_ActiveDF_10, 0);
            putValue(ADC_G_ActiveDF_11, 0);
            putValue(ADC_G_ActiveDF_12, 0);
            putValue(ADC_G_ActiveDF_13, 0);

            abDFDataType[0] = 3;
            awDFIconNr[0] = 0x2b;
            abDFAlignment[0] = 2;
            abDFSpecial[0] = 0;

            abDFDataType[1] = 1;
            strncpy(acDFContent[1], "99.999km", 62);
            abDFAlignment[1] = random(4);
            abDFSpecial[1] = 0;

            abDFDataType[2] = 3;
            awDFIconNr[2] = 0x2c;
            abDFAlignment[2] = 2;
            abDFSpecial[2] = 0;

            abDFDataType[3] = 1;
            strncpy(acDFContent[3], "23:59pm", 62);
            abDFAlignment[3] = random(4);
            abDFSpecial[3] = 0;


            abDFDataType[4] = 3;
            abDFSpecial[4] = 1;
            abDFSpecialType[4] = 0x21;


            abDFDataType[5] = 1;
            strncpy(acDFContent[5], "600m", 62);
            abDFAlignment[5] = random(4);
            abDFSpecial[5] = 0;


            abDFDataType[6] = 3;
            abDFSpecial[6] = 1;
            abDFSpecialType[6] = 0x01;

           
            putValue(ADC_D_NrChainConfig, 2);
            abFirstDFInChain[0] = 1;
            abFirstDFInChain[1] = 5;

            setTimer(msTimer_SendData_NAV,SendDelay);
            bGridIdNav = 25;
            }
            break;
        case 5:
            {
            putValue(ADC_G_ActiveDF_01, 1);
            putValue(ADC_G_ActiveDF_02, 0);
            putValue(ADC_G_ActiveDF_03, 0);
            putValue(ADC_G_ActiveDF_04, 0);
            putValue(ADC_G_ActiveDF_05, 0);
            putValue(ADC_G_ActiveDF_06, 0);
            putValue(ADC_G_ActiveDF_07, 0);
            putValue(ADC_G_ActiveDF_08, 0);
            putValue(ADC_G_ActiveDF_09, 0);
            putValue(ADC_G_ActiveDF_10, 0);
            putValue(ADC_G_ActiveDF_11, 0);
            putValue(ADC_G_ActiveDF_12, 0);
            putValue(ADC_G_ActiveDF_13, 0);

            abDFDataType[0] = 3;
            abDFSpecial[0] = 1;
            abDFSpecialType[0] = 0x26;
            
            setTimer(msTimer_SendData_NAV,SendDelay);
            bGridIdNav = 35;          
            }
            break;
        default:
            break;
        }
    StressTestNoNav++;
    if (StressTestNoNav > 5)
    {
    StressTestNoNav = 0;
    }
}

on timer msTimer_StressTest_TEL
{
int i;
//vInitAll ();
    putValue(ADC_A_NodeAddress, Node_TEL);
    putValue(ADC_A_CANChannel,  0x02);
    putValue(ADC_B_Application, 0x03);
    switch (StressTestNoTel)
        {
        case 0:
            {    
            putValue(ADC_G_ActiveDF_01, 1);
            putValue(ADC_G_ActiveDF_02, 1);
            putValue(ADC_G_ActiveDF_03, 1);
            putValue(ADC_G_ActiveDF_04, 1);
            putValue(ADC_G_ActiveDF_05, 1);
            putValue(ADC_G_ActiveDF_06, 1);
            putValue(ADC_G_ActiveDF_07, 1);
            putValue(ADC_G_ActiveDF_08, 1);
            putValue(ADC_G_ActiveDF_09, 1);
            putValue(ADC_G_ActiveDF_10, 1);
            putValue(ADC_G_ActiveDF_11, 0);
            putValue(ADC_G_ActiveDF_12, 0);
            putValue(ADC_G_ActiveDF_13, 0);

            abDFDataType[0] = 1;
            strncpy(acDFContent[0], "Altmann, Gunther", 62);
            abDFAlignment[0] = random(4);
            abDFSpecial[0] = 0;

            abDFDataType[1] = 3;
            awDFIconNr[1] = 3;
            abDFAlignment[1] = 2;
            abDFSpecial[1] = 0;

            abDFDataType[2] = 1;
            strncpy(acDFContent[2], "+4970319089790", 62);
            abDFAlignment[2] = random(4);
            abDFSpecial[2] = 0;

            abDFDataType[3] = 3;
            awDFIconNr[3] = 4;
            abDFAlignment[3] = 2;
            abDFSpecial[3] = 0;

            abDFDataType[4] = 1;
            strncpy(acDFContent[4], "+491728813391", 62);
            abDFAlignment[4] = random(4);
            abDFSpecial[4] = 0;

            abDFDataType[5] = 3;
            awDFIconNr[5] = 5;
            abDFAlignment[5] = 2;
            abDFSpecial[5] = 0;
            
            abDFDataType[6] = 1;
            strncpy(acDFContent[6], "+49170312398", 62);
            abDFAlignment[6] = random(4);
            abDFSpecial[6] = 0;

            abDFDataType[7] = 3;
            awDFIconNr[7] = 13;
            abDFAlignment[7] = 2;
            abDFSpecial[7] = 0;
            
            abDFDataType[8] = 1;
            strncpy(acDFContent[8], "+4917037562398", 62);
            abDFAlignment[8] = random(4);
            abDFSpecial[8] = 0;

            abDFDataType[9] = 1;
            strncpy(acDFContent[9], "Lese Daten", 62);
            abDFAlignment[9] = random(4);
            abDFSpecial[9] = 0;
                
            putValue(ADC_D_NrChainConfig, 4); //4 chains
            abFirstDFInChain[0] = 2; //First chain starts with DF 2
            abFirstDFInChain[1] = 4; //Second chain starts with DF 4
            abFirstDFInChain[2] = 6; //Third chain starts with DF 6
            abFirstDFInChain[3] = 8; //Fourth chain starts with DF 8

            putValue(ADC_F_LineConnector, 0);

            setTimer(msTimer_SendData_TEL,SendDelay);
            bGridIdTel = 18;
            }
            break;
        case 1:
            {    
            putValue(ADC_G_ActiveDF_01, 1);
            putValue(ADC_G_ActiveDF_02, 1);
            putValue(ADC_G_ActiveDF_03, 1);
            putValue(ADC_G_ActiveDF_04, 1);
            putValue(ADC_G_ActiveDF_05, 1);
            putValue(ADC_G_ActiveDF_06, 1);
            putValue(ADC_G_ActiveDF_07, 1);
            putValue(ADC_G_ActiveDF_08, 1);
            putValue(ADC_G_ActiveDF_09, 1);
            putValue(ADC_G_ActiveDF_10, 1);
            putValue(ADC_G_ActiveDF_11, 0);
            putValue(ADC_G_ActiveDF_12, 0);
            putValue(ADC_G_ActiveDF_13, 0);

            abDFDataType[0] = 1;
            strncpy(acDFContent[0], "Telefonliste", 62);
            abDFAlignment[0] = random(4);
            abDFSpecial[0] = 0;

            abDFDataType[1] = 3;
            awDFIconNr[1] = 36;
            abDFAlignment[1] = 2;
            abDFSpecial[1] = 0;

            abDFDataType[2] = 1;
            strncpy(acDFContent[2], "Acker, Charlotte", 62);
            abDFAlignment[2] = random(4);
            abDFSpecial[2] = 0;

            abDFDataType[3] = 3;
            awDFIconNr[3] = 35;
            abDFAlignment[3] = 2;
            abDFSpecial[3] = 0;

            abDFDataType[4] = 1;
            strncpy(acDFContent[4], "Adams, John Quincy", 62);
            abDFAlignment[4] = random(4);
            abDFSpecial[4] = 0;

            abDFDataType[5] = 3;
            awDFIconNr[5] = 34;
            abDFAlignment[5] = 2;
            abDFSpecial[5] = 0;
            
            abDFDataType[6] = 1;
            strncpy(acDFContent[6], "Altmann Gunther", 62);
            abDFAlignment[6] = random(4);
            abDFSpecial[6] = 0;

            abDFDataType[7] = 3;
            awDFIconNr[7] = 35;
            abDFAlignment[7] = 2;
            abDFSpecial[7] = 0;
            
            abDFDataType[8] = 1;
            strncpy(acDFContent[8], "Arthur, Edouard", 62);
            abDFAlignment[8] = random(4);
            abDFSpecial[8] = 0;

            abDFDataType[9] = 1;
            strncpy(acDFContent[9], "Lese Daten", 62);
            abDFAlignment[9] = random(4);
            abDFSpecial[9] = 0;
                
            putValue(ADC_D_NrChainConfig, 4); //4 chains
            abFirstDFInChain[0] = 2; //First chain starts with DF 2
            abFirstDFInChain[1] = 4; //Second chain starts with DF 4
            abFirstDFInChain[2] = 6; //Third chain starts with DF 6
            abFirstDFInChain[3] = 8; //Fourth chain starts with DF 8

            putValue(ADC_F_LineConnector, 0);

            setTimer(msTimer_SendData_TEL,SendDelay);
            bGridIdTel = 27;
            }
            break;
        case 2:
            {    
            putValue(ADC_G_ActiveDF_01, 1);
            putValue(ADC_G_ActiveDF_02, 1);
            putValue(ADC_G_ActiveDF_03, 1);
            putValue(ADC_G_ActiveDF_04, 1);
            putValue(ADC_G_ActiveDF_05, 1);
            putValue(ADC_G_ActiveDF_06, 1);
            putValue(ADC_G_ActiveDF_07, 1);
            putValue(ADC_G_ActiveDF_08, 1);
            putValue(ADC_G_ActiveDF_09, 1);
            putValue(ADC_G_ActiveDF_10, 1);
            putValue(ADC_G_ActiveDF_11, 1);
            putValue(ADC_G_ActiveDF_12, 0);
            putValue(ADC_G_ActiveDF_13, 0);

            abDFDataType[0] = 1;
            strncpy(acDFContent[0], "0,0;0,0", 62);
            abDFSpecial[0] = 0;

            abDFDataType[1] = 1;
            strncpy(acDFContent[1], "Altmann, Gunther", 62);
            abDFAlignment[1] = random(4);
            abDFSpecial[1] = 0;

            abDFDataType[2] = 3;
            awDFIconNr[2] = 3;
            abDFAlignment[2] = 2;
            abDFSpecial[2] = 0;

            abDFDataType[3] = 1;
            strncpy(acDFContent[3], "+4970319089790", 62);
            abDFAlignment[3] = random(4);
            abDFSpecial[3] = 0;

            abDFDataType[4] = 3;
            awDFIconNr[4] = 4;
            abDFAlignment[4] = 2;
            abDFSpecial[4] = 0;

            abDFDataType[5] = 1;
            strncpy(acDFContent[5], "+491728813391", 62);
            abDFAlignment[5] = random(4);
            abDFSpecial[5] = 0;

            abDFDataType[6] = 3;
            awDFIconNr[6] = 5;
            abDFAlignment[6] = 2;
            abDFSpecial[6] = 0;
            
            abDFDataType[7] = 1;
            strncpy(acDFContent[7], "+49170312398", 62);
            abDFAlignment[7] = random(4);
            abDFSpecial[7] = 0;

            abDFDataType[8] = 3;
            awDFIconNr[8] = 13;
            abDFAlignment[8] = 2;
            abDFSpecial[8] = 0;
            
            abDFDataType[9] = 1;
            strncpy(acDFContent[9], "+4917037562398", 62);
            abDFAlignment[9] = random(4);
            abDFSpecial[9] = 0;

            abDFDataType[10] = 1;
            strncpy(acDFContent[10], "Lese Daten", 62);
            abDFAlignment[10] = random(4);
            abDFSpecial[10] = 0;
                
            putValue(ADC_D_NrChainConfig, 5); //5 chains
            abFirstDFInChain[0] = 1; //First chain starts with DF 1
            abFirstDFInChain[1] = 3; //Second chain starts with DF 3
            abFirstDFInChain[2] = 5; //Third chain starts with DF 5
            abFirstDFInChain[3] = 7; //Fourth chain starts with DF 7
            abFirstDFInChain[4] = 9; //Fourth chain starts with DF 9

            setTimer(msTimer_SendData_TEL,SendDelay);
            bGridIdTel = 29;
            }
            break;
        case 3:
            {
            putValue(ADC_G_ActiveDF_01, 1);
            putValue(ADC_G_ActiveDF_02, 1);
            putValue(ADC_G_ActiveDF_03, 1);
            putValue(ADC_G_ActiveDF_04, 0);
            putValue(ADC_G_ActiveDF_05, 0);
            putValue(ADC_G_ActiveDF_06, 0);
            putValue(ADC_G_ActiveDF_07, 0);
            putValue(ADC_G_ActiveDF_08, 0);
            putValue(ADC_G_ActiveDF_09, 0);
            putValue(ADC_G_ActiveDF_10, 0);
            putValue(ADC_G_ActiveDF_11, 0);
            putValue(ADC_G_ActiveDF_12, 0);
            putValue(ADC_G_ActiveDF_13, 0);

            abDFDataType[0] = 1;
            strncpy(acDFContent[0], "Phone number", 62);
            abDFAlignment[0] = random(4);
            abDFSpecial[0] = 0;

            abDFDataType[1] = 1;
            strncpy(acDFContent[1], "18630687342178640", 62);
            abDFAlignment[1] = random(4);;
            abDFSpecial[1] = 0;

            abDFDataType[2] = 1;
            strncpy(acDFContent[2], "093456285674012459", 62);
            abDFAlignment[2] = random(4);;
            abDFSpecial[2] = 0;

            putValue(ADC_D_MultiLine, 1);
            putValue(ADC_F_LineConnector, 1);
            putValue(ADC_F_NrOfMultiLines, 2);
                
            setTimer(msTimer_SendData_TEL,SendDelay);
            bGridIdTel = 31;
            }
            break;
        case 4:
            {    
            putValue(ADC_G_ActiveDF_01, 1);
            putValue(ADC_G_ActiveDF_02, 1);
            putValue(ADC_G_ActiveDF_03, 1);
            putValue(ADC_G_ActiveDF_04, 1);
            putValue(ADC_G_ActiveDF_05, 1);
            putValue(ADC_G_ActiveDF_06, 1);
            putValue(ADC_G_ActiveDF_07, 1);
            putValue(ADC_G_ActiveDF_08, 1);
            putValue(ADC_G_ActiveDF_09, 1);
            putValue(ADC_G_ActiveDF_10, 1);
            putValue(ADC_G_ActiveDF_11, 1);
            putValue(ADC_G_ActiveDF_12, 1);
            putValue(ADC_G_ActiveDF_13, 1);

            abDFDataType[0] = 1;
            strncpy(acDFContent[0], "Telefonliste", 62);
            abDFAlignment[0] = random(4);
            abDFSpecial[0] = 0;

            abDFDataType[1] = 1;
            strncpy(acDFContent[1], "A", 62);
            abDFAlignment[1] = random(4);
            abDFSpecial[1] = 0;

            abDFDataType[2] = 1;
            strncpy(acDFContent[2], "B", 62);
            abDFAlignment[2] = random(4);
            abDFSpecial[2] = 0;

            abDFDataType[3] = 1;
            strncpy(acDFContent[3], "C", 62);
            abDFAlignment[3] = random(4);
            abDFSpecial[3] = 0;

            abDFDataType[4] = 3;
            awDFIconNr[4] = 36;
            abDFAlignment[4] = 2;
            abDFSpecial[4] = 0;

            abDFDataType[5] = 1;
            strncpy(acDFContent[5], "Acker, Charlotte", 62);
            abDFAlignment[5] = random(4);
            abDFSpecial[5] = 0;

            abDFDataType[6] = 3;
            awDFIconNr[6] = 35;
            abDFAlignment[6] = 2;
            abDFSpecial[6] = 0;

            abDFDataType[7] = 1;
            strncpy(acDFContent[7], "Adams, John Quincy", 62);
            abDFAlignment[7] = random(4);
            abDFSpecial[7] = 0;

            abDFDataType[8] = 3;
            awDFIconNr[8] = 36;
            abDFAlignment[8] = 2;
            abDFSpecial[8] = 0;
            
            abDFDataType[9] = 1;
            strncpy(acDFContent[9], "Altmann Gunther", 62);
            abDFAlignment[9] = random(4);
            abDFSpecial[9] = 0;

            abDFDataType[10] = 3;
            awDFIconNr[10] = 35;
            abDFAlignment[10] = 2;
            abDFSpecial[10] = 0;
            
            abDFDataType[11] = 1;
            strncpy(acDFContent[11], "Arthur, Edouard", 62);
            abDFAlignment[11] = random(4);
            abDFSpecial[11] = 0;

            abDFDataType[12] = 1;
            strncpy(acDFContent[12], "Lese Daten", 62);
            abDFAlignment[12] = random(4);
            abDFSpecial[12] = 0;
                
            putValue(ADC_D_NrChainConfig, 4); //5 chains
            abFirstDFInChain[0] = 5; //Third chain starts with DF 5
            abFirstDFInChain[1] = 7; //Fourth chain starts with DF 7
            abFirstDFInChain[2] = 9; //Fourth chain starts with DF 9
            abFirstDFInChain[3] = 11; //Fourth chain starts with DF 11

            setTimer(msTimer_SendData_TEL,SendDelay);
            bGridIdTel = 36;
            }
            break;
        case 5:
            {
            putValue(ADC_G_ActiveDF_01, 1);
            putValue(ADC_G_ActiveDF_02, 1);
            putValue(ADC_G_ActiveDF_03, 1);
            putValue(ADC_G_ActiveDF_04, 1);
            putValue(ADC_G_ActiveDF_05, 1);
            putValue(ADC_G_ActiveDF_06, 1);
            putValue(ADC_G_ActiveDF_07, 0);
            putValue(ADC_G_ActiveDF_08, 0);
            putValue(ADC_G_ActiveDF_09, 0);
            putValue(ADC_G_ActiveDF_10, 0);
            putValue(ADC_G_ActiveDF_11, 0);
            putValue(ADC_G_ActiveDF_12, 0);
            putValue(ADC_G_ActiveDF_13, 0);

            abDFDataType[0] = 5;
            strncpy(acDFContent[0], "0,0;0,0", 62);
            abDFSpecial[0] = 0;


            abDFDataType[1] = 1;
            strncpy(acDFContent[1], "Eingehender Anruf", 62);
            abDFAlignment[1] = random(4);
            abDFSpecial[1] = 0;

            abDFDataType[2] = 1;
            strncpy(acDFContent[2], "Hamilton, Louis", 62);
            abDFAlignment[2] = random(4);
            abDFSpecial[2] = 0;

            abDFDataType[3] = 1;
            strncpy(acDFContent[3], "Hamilton, Louis", 62);
            abDFAlignment[3] = random(4);
            abDFSpecial[3] = 0;

            abDFDataType[4] = 3;
            awDFIconNr[4] = 0xB4;
            abDFAlignment[4] = 2;
            abDFSpecial[4] = 0;

            abDFDataType[5] = 3;
            awDFIconNr[5] = 0xE1;
            abDFAlignment[5] = 2;
            abDFSpecial[5] = 0;
                
            setTimer(msTimer_SendData_TEL,SendDelay);
            bGridIdTel = 45;
            }
            break;
        default:
            break;
        }
    StressTestNoTel++;
    if (StressTestNoTel > 5)
    {
    StressTestNoTel = 0;
    }
}

on timer msTimer_SendData_NAV
{
    vSendADCData(bGridIdNav);
    cancelTimer(msTimer_SendData_NAV);
}

on timer msTimer_SendData_TEL
{
    vSendADCData(bGridIdTel);
    cancelTimer(msTimer_SendData_TEL);
}

on envVar ADC_Z_StressTest_Aud
{
    if(getValue(this) == 1)
        setTimer(msTimer_StressTest_AUD, getValue(ADC_Z_TimerStress));
    else
        cancelTimer(msTimer_StressTest_AUD);
}

on envVar ADC_Z_StressTest_Nav
{
    if(getValue(this) == 1)
        setTimer(msTimer_StressTest_NAV, getValue(ADC_Z_TimerStress));
    else
        cancelTimer(msTimer_StressTest_NAV);
}

on envVar ADC_Z_StressTest_Tel
{
    if(getValue(this) == 1)
        setTimer(msTimer_StressTest_TEL, getValue(ADC_Z_TimerStress));
    else
        cancelTimer(msTimer_StressTest_TEL);
}

vUpdateSelectedContent ()
{
    /* Update selected content */

    /* Content to be updated */
    byte bSelectedContent;
    /* String text from Hex Edit component */
    char acHexContent[128]; /* TODO : check the size which has to be used !! */
    /* Bytes copied from Hex Edit */
    long lHexContentCopiedBytes;

    /* obtaining selected DATA Field content */
    bSelectedContent = getValue(ADC_H_HexContentSelected);
    /* obtaining of Hex Edit data */
    lHexContentCopiedBytes = getValue(ADC_H_HexContent, acHexContent);
    /* Update only selected content */
    switch (bSelectedContent) {
        /* Data field 1: Content */
        case 0x01 :
            putValue(ADC_H_DF_01, acHexContent);
            break;
        /* Data field 2: Content */
        case 0x02 :
            putValue(ADC_H_DF_02, acHexContent);
            break;
        /* Data field 3: Content */
        case 0x03 :
            putValue(ADC_H_DF_03, acHexContent);
            break;
        /* Data field 4: Content */
        case 0x04 :
            putValue(ADC_H_DF_04, acHexContent);
            break;
        /* Data field 5: Content */
        case 0x05 :
            putValue(ADC_H_DF_05, acHexContent);
            break;
        /* Data field 6: Content */
        case 0x06 :
            putValue(ADC_H_DF_06, acHexContent);
            break;
        /* Data field 7: Content */
        case 0x07 :
            putValue(ADC_H_DF_07, acHexContent);
            break;
        /* Data field 8: Content */
        case 0x08 :
            putValue(ADC_H_DF_08, acHexContent);
            break;
        /* Data field 9: Content */
        case 0x09 :
            putValue(ADC_H_DF_09, acHexContent);
            break;
        /* Data field 10: Content */
        case 0x0A :
            putValue(ADC_H_DF_10, acHexContent);
            break;
        /* Data field 11: Content */
        case 0x0B :
            putValue(ADC_H_DF_11, acHexContent);
            break;
        /* Data field 12: Content */
        case 0x0C :
            putValue(ADC_H_DF_12, acHexContent);
            break;
        /* Data field 13: Content */
        case 0x0D :
            putValue(ADC_H_DF_13, acHexContent);
            break;
        /* Data field 14: Content */
        case 0x0E :
            putValue(ADC_H_DF_14, acHexContent);
            break;
        /* Data field 15: Content */
        case 0x0F :
            putValue(ADC_H_DF_15, acHexContent);
            break;
        /* Data field 16: Content */
        case 0x10 :
            putValue(ADC_H_DF_16, acHexContent);
            break;
        default :
            /* Nothing to do, unknown/none content selected */
            break;
    }
}

on envVar ADC_H_HexContentSet
{
    if (getValue(this) == 1) 
    {
        /* Update data field content */
        vUpdateSelectedContent();
    }
}

