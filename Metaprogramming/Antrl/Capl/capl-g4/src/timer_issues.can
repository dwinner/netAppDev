on timer delayTimer
{
    message DomeLight dlMsg;
    dlMsg.Status = 0; // turns off dome light
    output(dlMsg);
}