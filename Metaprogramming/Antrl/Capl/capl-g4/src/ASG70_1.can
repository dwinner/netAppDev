/*@!Encoding:1252*/
variables
{

	//@BAPSIMGEN_VAR_SECTION_BEGIN

	/***************************************************/
	/*            BapSimGen ASG template               */
	/***************************************************/

	/************** Ausgabe Konsolen (Traces) ***********/
	dword gBAP_Trace;
	dword gError_Trace;

	/************** Node Verwaltung ***************/
	//Power on/off
	byte gSG_PowerOnOff=0x01;     // wird mit Power_off/on gesetzt
	byte gBAP_Init=0;             // schon mal initialisiert?

	const Power_off = 0x00;
	const Power_on	= 0x01;

	mstimer TaskTimer;				//real communication timer

	/************** Request **************/
	const Requestbuffer_lines = 100;
	const BAP_buffer_size = 4096;

	/************ Speichern von Requests im "Ringbuffer" ***********/
	int   gBAP_Requestbuffer_status     [Requestbuffer_lines];		            // 0: kein Eintrag, 1:pending
	dword gBAP_Request_header			[Requestbuffer_lines] [6];				// beinhaltet auch skalare Daten
	dword gBAP_Request_data             [Requestbuffer_lines] [BAP_buffer_size];// ringbuffer Eintrag fuer BAP-Request


	/************** Indication **************/
	// enthaelt die derzeitige Indication
	dword gBAP_Indication_header[6];	
	byte  gBAP_Indication_data[BAP_buffer_size];		

	/************** Konstanten ****************/

	//BAP Data Type 
	const Bap_void				=0;
	const Bap_uint8				=1;
	const Bap_uint16			=2;
	const Bap_uint32			=3;
	const Bap_byteSequence		=4;
	const Bap_error				=5;
	const Bap_acknowledge		=6;

	char Datatype_Text[7][20] =
	{
		"void", "uint8", "uint16", "uint32", "byteSequence", "error", "acknowledge"
	};

	//BAP request types
	const DataSetGet_REQ  = 0x00;
	const DataSet_REQ	  = 0x01;
	const DataGet_REQ	  = 0x02;
	const Data_REQ		  = 0x03;
	const Changed_REQ	  = 0x04;
	const Start_REQ		  = 0x05;
	const StartResult_REQ = 0x06;
	const AbortResult_REQ = 0x07;
	const Processing_REQ  = 0x08;
	const Result_REQ      = 0x09;
	const DataAck_REQ     = 0x0A;
	const Ack_REQ         = 0x0B;
	const Invalid_REQ     = 0x1F;      // Interne Kennzeichnung fuer einen ungueltigen Request

	//eigene Error-Definition
	const Error_REQ=0x20;

	char Requesttype_Text[33][30] =
	{
		"DataSetGet_REQ", "DataSet_REQ", "DataGet_REQ", "Data_REQ",			/* 00 .. 03 */
		"Changed_REQ", "Start_REQ", "StartResult_REQ", "AbortResult_REQ",   /* 04 .. 07 */
		"Processing_REQ", "Result_REQ", "DataAck_REQ", "Ack_REQ", 			/* 08 .. 0b */
		"Invalid_REQ", "Invalid_REQ", "Invalid_REQ", "Invalid_REQ",  		/* 0c .. 0f */
		"Invalid_REQ", "Invalid_REQ", "Invalid_REQ", "Invalid_REQ",  		/* 10 .. 13 */
		"Invalid_REQ", "Invalid_REQ", "Invalid_REQ", "Invalid_REQ",  		/* 14 .. 17 */
		"Invalid_REQ", "Invalid_REQ", "Invalid_REQ", "Invalid_REQ", 		/* 18 .. 1b */
		"Invalid_REQ", "Invalid_REQ", "Invalid_REQ", "Invalid_REQ",  		/* 1c .. 1f */
		"Error_REQ"	  														/* 20 */
	};

	//BAP indication types
	const Data_IND			 = 0x00;
	const Reset_IND			 = 0x01;
	const DataAck_IND        = 0x02;
	const Result_IND		 = 0x03;
	const Processing_IND	 = 0x04;
  	const Changed_IND		 = 0x05;
  	const DataSetGet_IND	 = 0x06;
	const DataSet_IND		 = 0x07;
	const DataGet_IND		 = 0x08;
	const Ack_IND            = 0x09;
	const Processing_CNF_IND = 0x0A;
	const Start_IND			 = 0x0B;
	const StartResult_IND	 = 0x0C;
	const AbortResult_IND	 = 0x0D;
	const Invalid_IND		 = 0x1F; // Kennzeichnung fuer eine ungueltige Indication
	const Error_IND			 = 0x20;
	
	char Indicationtype_Text[33][30] =
	{
		"Data_IND", "Reset_IND", "DataAck_IND", "Result_IND",			 	/* 00 .. 03 */
		"Processing_IND", "Changed_IND", "DataSetGet_IND", "DataSet_IND", 	/* 04 .. 07 */
		"DataGet_IND", "Ack_IND", "Processing_CNF_IND", "Start_REQ",	 	/* 08 .. 0b */
		"StartResult_REQ", "AbortResult_REQ", "Invalid_REQ", "Invalid_REQ", /* 0c .. 0f */
		"Invalid_REQ", "Invalid_REQ", "Invalid_REQ", "Invalid_REQ",  		/* 10 .. 13 */
		"Invalid_REQ", "Invalid_REQ", "Invalid_REQ", "Invalid_REQ",  		/* 14 .. 17 */
		"Invalid_REQ", "Invalid_REQ", "Invalid_REQ", "Invalid_REQ", 		/* 18 .. 1b */
		"Invalid_REQ", "Invalid_REQ", "Invalid_REQ", "Invalid_REQ",  		/* 1c .. 1f */
		"Error_REQ"	  														/* 20 */
	};	
	
	char Acknowledgetype_Text[24][30] =
	{
		"Property_SetGet_ACK", "Array_SetGet_ACK", "Property_Set_ACK", "Array_Set_ACK",  			/* 00 .. 03 */
		"Method_Start_ACK", "Method_StartResult_ACK", "Method_AbortResult_ACK", "Property_Get_ACK",	/* 04 .. 07 */
		"Array_Get_ACK", "Cache_GetAll_ACK", "Property_Ack_ACK", "Property_Status_ACK",	   			/* 08 .. 0b */
		"Property_StatusAck_ACK", "Property_Error_ACK", "Array_Status_ACK", "Array_Changed_ACK",	/* 0c .. 0f */
		"Array_Error_ACK", "Method_Processing_ACK", "Method_Result_ACK", "Method_Error_ACK",  		/* 10 .. 13 */
		"Unknown_ACK", "Unknown_ACK", "Unknown_ACK", "Unknown_ACK"									/* 14 .. 17 */
	};

	/**************************** Global Function-ID's ******************************/
	/** TODO: already_pressed kann zwischen den Funktionen geshared werden          */

	byte already_pressed = 0;

	const FctID_GetAll									= 0x01;
	const FctID_BAP_Config								= 0x02;
	const FctID_FunctionList							= 0x03;
	const FctID_HeartBeat								= 0x04;
    
    char SGtype[4]="ASG";

	char  dbc_path[255]             = "asg70_1\\bapdb\\BAP_only_MQB_MLBevo_v1.19.dbc";
	char  xml_path[255]             = "asg70_1\\bapxml\\BAP_SW17_SDS_ASG_SDS_MQB_MLBevo_v1.0.xml";
	dword NODE_INDEX                =  0;
	char  NODE_NAME[100]            = "SDS_SD";
	const LSGID                     = 70;
	char  panel_name[100]           = "ASG70_1";
	char  bapconfig_panel_name[100]    = "panel1";
	char  common_panel_name[100]    = "panel2";
	const TaskTime                  = 10;
	const heartBeatFactor                               = 5;
	 const C_ASG_70_1_0_1_ID = 1;
	 byte C_ASG_70_1_0_1GetAll_BTN_already_pressed = 0;
	 char gCheckbox1[100] = "checkbox_C_ASG_70_1_0_1";
	 char gErrField1[100] = "errfield_C_ASG_70_1_0_1";
	 byte gC_ASG_70_1_0_1_ErrCode = 1;
	 const P_ASG_70_1_0_2_ID = 2;
	 byte P_ASG_70_1_0_2Get_BTN_already_pressed = 0;
	 char gCheckbox2[100] = "checkbox_P_ASG_70_1_0_2";
	 char gErrField2[100] = "errfield_P_ASG_70_1_0_2";
	 byte gP_ASG_70_1_0_2_ErrCode = 1;
	 const P_ASG_70_1_0_3_ID = 3;
	 byte P_ASG_70_1_0_3Get_BTN_already_pressed = 0;
	 char gCheckbox3[100] = "checkbox_P_ASG_70_1_0_3";
	 char gErrField3[100] = "errfield_P_ASG_70_1_0_3";
	 byte gP_ASG_70_1_0_3_ErrCode = 1;
	 const P_ASG_70_1_0_4_ID = 4;
	 byte P_ASG_70_1_0_4Get_BTN_already_pressed = 0;
	 char gCheckbox4[100] = "checkbox_P_ASG_70_1_0_4";
	 char gErrField4[100] = "errfield_P_ASG_70_1_0_4";
	 byte gP_ASG_70_1_0_4_ErrCode = 1;
	 const P_ASG_70_1_0_14_ID = 14;
	 byte P_ASG_70_1_0_14Get_BTN_already_pressed = 0;
	 char gCheckbox14[100] = "checkbox_P_ASG_70_1_0_14";
	 char gErrField14[100] = "errfield_P_ASG_70_1_0_14";
	 byte gP_ASG_70_1_0_14_ErrCode = 1;
	 char gPanel14[100] = "panel_P_ASG_70_1_0_14";
	 const P_ASG_70_1_0_15_ID = 15;
	 byte P_ASG_70_1_0_15Get_BTN_already_pressed = 0;
	 char gCheckbox15[100] = "checkbox_P_ASG_70_1_0_15";
	 char gErrField15[100] = "errfield_P_ASG_70_1_0_15";
	 byte gP_ASG_70_1_0_15_ErrCode = 1;
	 char gPanel15[100] = "panel_P_ASG_70_1_0_15";
	 const P_ASG_70_1_0_16_ID = 16;
	 byte P_ASG_70_1_0_16Get_BTN_already_pressed = 0;
	 byte P_ASG_70_1_0_16SetGet_BTN_already_pressed = 0;
	 char gCheckbox16[100] = "checkbox_P_ASG_70_1_0_16";
	 char gErrField16[100] = "errfield_P_ASG_70_1_0_16";
	 byte gP_ASG_70_1_0_16_ErrCode = 1;
	 char gPanel16[100] = "panel_P_ASG_70_1_0_16";
	 const P_ASG_70_1_0_17_ID = 17;
	 byte P_ASG_70_1_0_17Get_BTN_already_pressed = 0;
	 char gCheckbox17[100] = "checkbox_P_ASG_70_1_0_17";
	 char gErrField17[100] = "errfield_P_ASG_70_1_0_17";
	 byte gP_ASG_70_1_0_17_ErrCode = 1;
	 char gPanel17[100] = "panel_P_ASG_70_1_0_17";
	 const A_ASG_70_1_0_18_ID = 18;
	 byte A_ASG_70_1_0_18Get_BTN_already_pressed = 0;
	 char gCheckbox18[100] = "checkbox_A_ASG_70_1_0_18";
	 char gErrField18[100] = "errfield_A_ASG_70_1_0_18";
	 byte gA_ASG_70_1_0_18_ErrCode = 1;
	 char gPanel18[100] = "panel_A_ASG_70_1_0_18";
	 byte A_ASG_70_1_0_18_DataIndex_Decr_already_pressed = 0;
	 byte A_ASG_70_1_0_18_DataIndex_Incr_already_pressed = 0;
	 byte A_ASG_70_1_0_18_DataIndex_SetGet_Decr_already_pressed = 0;
	 byte A_ASG_70_1_0_18_DataIndex_SetGet_Incr_already_pressed = 0;
	 byte A_ASG_70_1_0_18_generateData_Btn_already_pressed = 0;
	 byte A_ASG_70_1_0_18_loadArray_Btn_already_pressed = 0;
	 _align(1) struct A_ASG_70_1_0_18_ArrayDataStruct {
		 byte Param1;
		 word Param2;
		 byte Param3[61];
		 word Param3_Length;
		 byte Param4[2];
		 word Param4_Length;
	 };
	 struct A_ASG_70_1_0_18_ArrayDataStruct A_ASG_70_1_0_18_ArrayDataList[254];
	 const A_ASG_70_1_0_18_ArrayDataList_Length = 254;
	 long A_ASG_70_1_0_18_Data_3_LenList[254];
	 byte A_ASG_70_1_0_18_Data_3_CntList[254];
	 long A_ASG_70_1_0_18_Data_3_SetGet_LenList[254];
	 byte A_ASG_70_1_0_18_Data_3_SetGet_CntList[254];
	 long A_ASG_70_1_0_18_Data_4_LenList[254];
	 byte A_ASG_70_1_0_18_Data_4_CntList[254];
	 long A_ASG_70_1_0_18_Data_4_SetGet_LenList[254];
	 byte A_ASG_70_1_0_18_Data_4_SetGet_CntList[254];
	 const A_ASG_70_1_0_19_ID = 19;
	 byte A_ASG_70_1_0_19Get_BTN_already_pressed = 0;
	 char gCheckbox19[100] = "checkbox_A_ASG_70_1_0_19";
	 char gErrField19[100] = "errfield_A_ASG_70_1_0_19";
	 byte gA_ASG_70_1_0_19_ErrCode = 1;
	 char gPanel19[100] = "panel_A_ASG_70_1_0_19";
	 byte A_ASG_70_1_0_19_DataIndex_Decr_already_pressed = 0;
	 byte A_ASG_70_1_0_19_DataIndex_Incr_already_pressed = 0;
	 byte A_ASG_70_1_0_19_DataIndex_SetGet_Decr_already_pressed = 0;
	 byte A_ASG_70_1_0_19_DataIndex_SetGet_Incr_already_pressed = 0;
	 byte A_ASG_70_1_0_19_generateData_Btn_already_pressed = 0;
	 byte A_ASG_70_1_0_19_loadArray_Btn_already_pressed = 0;
	 _align(1) struct A_ASG_70_1_0_19_ArrayDataStruct {
		 byte Param1;
		 byte Param2;
		 byte Param3[171];
		 word Param3_Length;
		 byte Param4[2];
		 word Param4_Length;
	 };
	 struct A_ASG_70_1_0_19_ArrayDataStruct A_ASG_70_1_0_19_ArrayDataList[254];
	 const A_ASG_70_1_0_19_ArrayDataList_Length = 254;
	 long A_ASG_70_1_0_19_Data_3_LenList[254];
	 byte A_ASG_70_1_0_19_Data_3_CntList[254];
	 long A_ASG_70_1_0_19_Data_3_SetGet_LenList[254];
	 byte A_ASG_70_1_0_19_Data_3_SetGet_CntList[254];
	 long A_ASG_70_1_0_19_Data_4_LenList[254];
	 byte A_ASG_70_1_0_19_Data_4_CntList[254];
	 long A_ASG_70_1_0_19_Data_4_SetGet_LenList[254];
	 byte A_ASG_70_1_0_19_Data_4_SetGet_CntList[254];
	 const P_ASG_70_1_0_20_ID = 20;
	 byte P_ASG_70_1_0_20Get_BTN_already_pressed = 0;
	 char gCheckbox20[100] = "checkbox_P_ASG_70_1_0_20";
	 char gErrField20[100] = "errfield_P_ASG_70_1_0_20";
	 byte gP_ASG_70_1_0_20_ErrCode = 1;
	 char gPanel20[100] = "panel_P_ASG_70_1_0_20";


	/// Begin: Definition der BUS-Schnittstellen
	
	// FLEXRAY NOT ENABLED!
	
	// ETHERNET NOT ENABLED! 
	
	//// End Bus Schnittstellen
}

on preStart
{
	char Version[200];
	char Path[255];

	/***** Erzeugen der Ausgabeconsolen *****/	
	gBAP_Trace=writecreate("BAP-Trace");		//write-window for BAP-cummunication
	writeclear(gBAP_Trace);						//clear BAP-window in write-window
	
	gError_Trace=writecreate("Error");			//error-window for BAP-cummunication
	writeclear(gError_Trace);					//clear error-window in write-window
	
	writeclear(1);								//clear CAPL-window in write-window
	
	/**** Versionsstring von DLL holen und auf Bildschirm ausgeben ***/	
	BAP150_GetVersions(Version, 200);
	writelineEx(gBAP_Trace, 0, "Versionx:%s", Version);
											
    NODE_INDEX = BAP150_CreateNode();
    writelineEx(gBAP_Trace, 0, "ASG %d Nodeindex:%d", LSGID, Version);
    
	/**** Laden der CANoe Datenbank *****/
	getAbsFilePath(dbc_path, Path, 255);
	writelineEx(gBAP_Trace, 0, "Load BAP_DBC-File: %s", Path);
	if(BAP150_LoadDBC(NODE_INDEX, 1, Path)  != 0) {		writelineEx(gError_Trace, 0, "Fehler beim Laden: %s !", Path);
	}

	/**** Laden des BAP XML Files ****/
	getAbsFilePath(xml_path, Path, 255);
	writelineEx(gBAP_Trace, 0, "Load BAP-XML-File: %s", Path);
	if (BAP150_LoadConfig(NODE_INDEX, Path) != 0) {
	    writelineEx(gError_Trace, 0, "Fehler beim Laden: %s !", Path);
	}

	if (BAP150_AddCanMap(NODE_INDEX, 1, 1) != 0) {
		writelineEx(gError_Trace, 0, "Fehler beim Mappen!");
	}
	
	// FLEXRAY NOT ENABLED!
	
}

DisableFctCtrl ()
{
  	EnableControl(panel_name, common_panel_name, 0);
	EnableControl(panel_name,gErrField1,0);
	EnableControl(panel_name,gErrField2,0);
	EnableControl(panel_name,gErrField3,0);
	EnableControl(panel_name,gErrField4,0);
	EnableControl(panel_name,gErrField14,0);
	EnableControl(panel_name,gPanel14,0);
	EnableControl(panel_name,"panel_P_ASG_70_1_0_14",0);
	EnableControl(panel_name,gErrField15,0);
	EnableControl(panel_name,gPanel15,0);
	EnableControl(panel_name,"panel_P_ASG_70_1_0_15",0);
	EnableControl(panel_name,gErrField16,0);
	EnableControl(panel_name,gPanel16,0);
	EnableControl(panel_name,"panel_P_ASG_70_1_0_16",0);
	EnableControl(panel_name,gErrField17,0);
	EnableControl(panel_name,gPanel17,0);
	EnableControl(panel_name,"panel_P_ASG_70_1_0_17",0);
	EnableControl(panel_name,gErrField18,0);
	EnableControl(panel_name,gPanel18,0);
	EnableControl(panel_name,"panel_A_ASG_70_1_0_18",0);
	EnableControl(panel_name,"panel_A_ASG_70_1_0_18_Changed",0);
	EnableControl(panel_name,"panel_A_ASG_70_1_0_18_SetGet",0);
	EnableControl(panel_name,gErrField19,0);
	EnableControl(panel_name,gPanel19,0);
	EnableControl(panel_name,"panel_A_ASG_70_1_0_19",0);
	EnableControl(panel_name,"panel_A_ASG_70_1_0_19_Changed",0);
	EnableControl(panel_name,"panel_A_ASG_70_1_0_19_SetGet",0);
	EnableControl(panel_name,gErrField20,0);
	EnableControl(panel_name,gPanel20,0);
	EnableControl(panel_name,"panel_P_ASG_70_1_0_20",0);

}

EnableFctCtrl ()
{
  	EnableControl(panel_name, common_panel_name, 1);
		 EnableControl(panel_name,gPanel14,1);
		 EnableControl(panel_name,gErrField14,1);
		 EnableControl(panel_name,gPanel15,1);
		 EnableControl(panel_name,gErrField15,1);
		 EnableControl(panel_name,gPanel16,1);
		 EnableControl(panel_name,gErrField16,1);
		 EnableControl(panel_name,gPanel17,1);
		 EnableControl(panel_name,gErrField17,1);
		 EnableControl(panel_name,gPanel18,1);
		 EnableControl(panel_name,gErrField18,1);
		 EnableControl(panel_name,gPanel19,1);
		 EnableControl(panel_name,gErrField19,1);
		 EnableControl(panel_name,gPanel20,1);
		 EnableControl(panel_name,gErrField20,1);

}

EnableConfigCtrl ()
{
  	if(getValue(C_ASG_70_1_0_1_FctLstItemEn))
	{
		setControlForeColor(panel_name, gCheckbox1, MakeRGB(0,240,0));
	}
	else
	{
		setControlForeColor(panel_name, gCheckbox1, MakeRGB(250,0,0));
	}
	if(getValue(P_ASG_70_1_0_2_FctLstItemEn))
	{
		setControlForeColor(panel_name, gCheckbox2, MakeRGB(0,240,0));
	}
	else
	{
		setControlForeColor(panel_name, gCheckbox2, MakeRGB(250,0,0));
	}
	if(getValue(P_ASG_70_1_0_3_FctLstItemEn))
	{
		setControlForeColor(panel_name, gCheckbox3, MakeRGB(0,240,0));
	}
	else
	{
		setControlForeColor(panel_name, gCheckbox3, MakeRGB(250,0,0));
	}
	EnableControl(panel_name, "panel_P_ASG_70_1_0_4", 1);
	if(getValue(P_ASG_70_1_0_4_FctLstItemEn))
	{
		setControlForeColor(panel_name, gCheckbox4, MakeRGB(0,240,0));
	}
	else
	{
		setControlForeColor(panel_name, gCheckbox4, MakeRGB(250,0,0));
	}
	if(getValue(P_ASG_70_1_0_14_FctLstItemEn))
	{
		EnableControl(panel_name, "panel_P_ASG_70_1_0_14",1);
		EnableControl(panel_name,"errfield_P_ASG_70_1_0_14",1);
		setControlForeColor(panel_name, gCheckbox14, MakeRGB(0,240,0));
	}
	else
	{
		EnableControl(panel_name, "panel_P_ASG_70_1_0_14",0);
		EnableControl(panel_name,"errfield_P_ASG_70_1_0_14",0);
		setControlForeColor(panel_name, gCheckbox14, MakeRGB(250,0,0));
	}
	if(getValue(P_ASG_70_1_0_15_FctLstItemEn))
	{
		EnableControl(panel_name, "panel_P_ASG_70_1_0_15",1);
		EnableControl(panel_name,"errfield_P_ASG_70_1_0_15",1);
		setControlForeColor(panel_name, gCheckbox15, MakeRGB(0,240,0));
	}
	else
	{
		EnableControl(panel_name, "panel_P_ASG_70_1_0_15",0);
		EnableControl(panel_name,"errfield_P_ASG_70_1_0_15",0);
		setControlForeColor(panel_name, gCheckbox15, MakeRGB(250,0,0));
	}
	if(getValue(P_ASG_70_1_0_16_FctLstItemEn))
	{
		EnableControl(panel_name, "panel_P_ASG_70_1_0_16",1);
		EnableControl(panel_name,"errfield_P_ASG_70_1_0_16",1);
		setControlForeColor(panel_name, gCheckbox16, MakeRGB(0,240,0));
	}
	else
	{
		EnableControl(panel_name, "panel_P_ASG_70_1_0_16",0);
		EnableControl(panel_name,"errfield_P_ASG_70_1_0_16",0);
		setControlForeColor(panel_name, gCheckbox16, MakeRGB(250,0,0));
	}
	if(getValue(P_ASG_70_1_0_17_FctLstItemEn))
	{
		EnableControl(panel_name, "panel_P_ASG_70_1_0_17",1);
		EnableControl(panel_name,"errfield_P_ASG_70_1_0_17",1);
		setControlForeColor(panel_name, gCheckbox17, MakeRGB(0,240,0));
	}
	else
	{
		EnableControl(panel_name, "panel_P_ASG_70_1_0_17",0);
		EnableControl(panel_name,"errfield_P_ASG_70_1_0_17",0);
		setControlForeColor(panel_name, gCheckbox17, MakeRGB(250,0,0));
	}
	if(getValue(A_ASG_70_1_0_18_FctLstItemEn))
	{
		EnableControl(panel_name, "panel_A_ASG_70_1_0_18",1);
		EnableControl(panel_name,"errfield_A_ASG_70_1_0_18",1);
		EnableControl(panel_name,"panel_A_ASG_70_1_0_18_Changed",1);
		EnableControl(panel_name,"panel_A_ASG_70_1_0_18_SetGet",1);
		setControlForeColor(panel_name, gCheckbox18, MakeRGB(0,240,0));
	}
	else
	{
		EnableControl(panel_name, "panel_A_ASG_70_1_0_18",0);
		EnableControl(panel_name,"errfield_A_ASG_70_1_0_18",0);
		EnableControl(panel_name,"panel_A_ASG_70_1_0_18_Changed",0);
		EnableControl(panel_name,"panel_A_ASG_70_1_0_18_SetGet",0);
		setControlForeColor(panel_name, gCheckbox18, MakeRGB(250,0,0));
	}
	if(getValue(A_ASG_70_1_0_19_FctLstItemEn))
	{
		EnableControl(panel_name, "panel_A_ASG_70_1_0_19",1);
		EnableControl(panel_name,"errfield_A_ASG_70_1_0_19",1);
		EnableControl(panel_name,"panel_A_ASG_70_1_0_19_Changed",1);
		EnableControl(panel_name,"panel_A_ASG_70_1_0_19_SetGet",1);
		setControlForeColor(panel_name, gCheckbox19, MakeRGB(0,240,0));
	}
	else
	{
		EnableControl(panel_name, "panel_A_ASG_70_1_0_19",0);
		EnableControl(panel_name,"errfield_A_ASG_70_1_0_19",0);
		EnableControl(panel_name,"panel_A_ASG_70_1_0_19_Changed",0);
		EnableControl(panel_name,"panel_A_ASG_70_1_0_19_SetGet",0);
		setControlForeColor(panel_name, gCheckbox19, MakeRGB(250,0,0));
	}
	if(getValue(P_ASG_70_1_0_20_FctLstItemEn))
	{
		EnableControl(panel_name, "panel_P_ASG_70_1_0_20",1);
		EnableControl(panel_name,"errfield_P_ASG_70_1_0_20",1);
		setControlForeColor(panel_name, gCheckbox20, MakeRGB(0,240,0));
	}
	else
	{
		EnableControl(panel_name, "panel_P_ASG_70_1_0_20",0);
		EnableControl(panel_name,"errfield_P_ASG_70_1_0_20",0);
		setControlForeColor(panel_name, gCheckbox20, MakeRGB(250,0,0));
	}

}

DisableReservedFld ()
{
  
}

resetErrfieldColor()
{
  	setControlBackColor(panel_name, "errfield_C_ASG_70_1_0_1", MakeRGB(255,255,255));
	setControlBackColor(panel_name, "errfield_P_ASG_70_1_0_2", MakeRGB(255,255,255));
	setControlBackColor(panel_name, "errfield_P_ASG_70_1_0_3", MakeRGB(255,255,255));
	setControlBackColor(panel_name, "errfield_P_ASG_70_1_0_4", MakeRGB(255,255,255));
	setControlBackColor(panel_name, "errfield_P_ASG_70_1_0_14", MakeRGB(255,255,255));
	setControlBackColor(panel_name, "errfield_P_ASG_70_1_0_15", MakeRGB(255,255,255));
	setControlBackColor(panel_name, "errfield_P_ASG_70_1_0_16", MakeRGB(255,255,255));
	setControlBackColor(panel_name, "errfield_P_ASG_70_1_0_17", MakeRGB(255,255,255));
	setControlBackColor(panel_name, "errfield_A_ASG_70_1_0_18", MakeRGB(255,255,255));
	setControlBackColor(panel_name, "errfield_A_ASG_70_1_0_19", MakeRGB(255,255,255));
	setControlBackColor(panel_name, "errfield_P_ASG_70_1_0_20", MakeRGB(255,255,255));

}

CANoe_Shutdown ()
{
	// Timer 
	canceltimer(TaskTimer);		//cancel real CAN-communication timer

	// Ruecksetzen der Hintergrundfarbe der Error-Felder
	resetErrfieldColor();
	// Deaktivierung aller Panel Elemente 
	DisableFctCtrl();
	EnableControl(panel_name, bapconfig_panel_name, 0); 
	EnableConfigCtrl();

}

on timer TaskTimer
{

	/*** Aufruf des BAP Task in DLL fuer NODE_INDEX ***/
	BAP150_Task(NODE_INDEX);	

	/*** Pollen ueber die anstehenden Indications (Lesen aus DLL, Auslesen eines Puffers der DLL) ***/
	BAP_DLL_Indication();	
	
	/*** Pollen ueber die anstehenden Requests (Schreiben in DLL, dort werden evt. Sendeauftraege gesetzt) ***/
	BAP_DLL_Request();
	
	/*** Abarbeiten der ausstehenden Sendeauftraege innerhalb der BAP DLL und Versenden ueber CANoe ***/
    BAP_CAN_TX_Request();

	/*** Der Empfang von CAN Daten geschieht ueber on message CAN message Mechanismen ***/
	// keine Funktion hier

	/*** Retriggern des Timers mit 10 ms ***/
	setTimer(TaskTimer, TaskTime); // @TODO bei anderer Taskzeit muss hier modifiziert werden
}

BAP_DLL_Indication()	//function to get received BAP-data from DLL (at BAL-interface)
{
	int i, length, datalength, temp;
	byte Indication_data[BAP_buffer_size];		// indication data from DLL
	dword Indication_header[6];					// indication header from DLL
	byte BAP_data_type;

	//init local variables
	length=0;
	datalength=0;
	temp=0;
	BAP_data_type=0;

	for(i=0;i<6;i++)
		Indication_header[i]=0;

	for(i=0;i<BAP_buffer_size;i++)
		Indication_data[i]=0;

	// BAP-Stack needs this information for successful BAP150_GetIndication 
	Indication_header[4]=BAP_buffer_size;

	while (BAP150_GetInd(NODE_INDEX, Indication_header, Indication_data) == 0)
	{		
		//read header and write in global variable
		for (i = 0; i < 6; i++) {
			gBAP_Indication_header[i]=Indication_header[i];	
		}

		// nur Bytesequneces haben Datenanteil
		if (gBAP_Indication_header[3] == Bap_byteSequence)
		{
			for (i = 0; i < BAP_buffer_size; i++) {
				gBAP_Indication_data[i]=Indication_data[i];	
			}
		}	
		// Verarbeiten der Indication
		Process_Current_Indication();

		// Vorbereiten fuer naechsten Durchlauf 
		Indication_header[4]=BAP_buffer_size;
	} 
}

ChangeConfig(long paramIndex,long config[])
{

        byte temp ;
        temp = BAP150_ChangeConfig(NODE_INDEX, paramIndex, config);
        if(temp == 0)
            writelineEx(gBAP_Trace, 0, "BAP150_ChangeConfig for %s succesful (LSG %d, NODE_INDEX %d)", NODE_NAME, LSGID, NODE_INDEX);
        else
            writelineEx(gError_Trace, 0, "BAP150_ChangeConfig error 0x%X for %s (LSG %d, NODE_INDEX %d)", temp, NODE_NAME, LSGID, NODE_INDEX);        
}

PrintIndicationError(char reason[])
{
	writelineEx(gError_Trace, 0, "%s - %s lsgId:%d fctid:%d indType:%s dataType:%s",
		reason, SGtype, gBAP_Indication_header[0], gBAP_Indication_header[1], Indicationtype_Text[gBAP_Indication_header[2]], Datatype_Text[gBAP_Indication_header[3]]);
}

BapOnOff(byte _on)
{
    int length, temp;

    /***** Einschalten ******/
    if(_on==1){
        // soll der BAP Stack wieder initlialisiert werden?                                 
        if(gBAP_Init==0){
            gBAP_Init=1;
            temp=BAP150_Init(NODE_INDEX, LSGID);
            if(temp==0)
                writelineEx(gBAP_Trace, 0, "BAP_Init for %s succesful (LSG %d, NODE_INDEX %d)", NODE_NAME, LSGID, NODE_INDEX);
            else
                writelineEx(gError_Trace, 0, "BAP_Init error 0x%X for %s (LSG %d, NODE_INDEX %d)", temp, NODE_NAME, LSGID, NODE_INDEX);         
        }

        // Initialisierung aller Variablen
        Initialize_Variables();                     

        // Aktivierung aller Panelelemente
		//EnableFctCtrl();
		initInvalidFields();
		EnableControl(panel_name, common_panel_name, 1);
		EnableControl(panel_name, bapconfig_panel_name, 1); 
		DisableReservedFld();

        //BAP-Shutdown
        temp = BAP150_Shutdown(NODE_INDEX, LSGID);
        if(temp==0)
            writelineEx(gBAP_Trace, 0, "BAP_Shutdown for %s succesful (LSG %d, NODE_INDEX %d)", NODE_NAME, LSGID, NODE_INDEX);
        else
            writelineEx(gError_Trace, 0, "BAP_Shutdown error 0x%X for %s (LSG %d, NODE_INDEX %d)", temp, NODE_NAME, LSGID, NODE_INDEX); 

        //BAP-Start
        temp = BAP150_Start(NODE_INDEX, LSGID);             
        if(temp == 0)
            writelineEx(gBAP_Trace, 0, "BAP_Start for %s succesful (LSG %d, NODE_INDEX %d)", NODE_NAME, LSGID, NODE_INDEX);
        else
            writelineEx(gError_Trace, 0, "BAP_Start error 0x%X for %s (LSG %d, NODE_INDEX %d)", temp, NODE_NAME, LSGID, NODE_INDEX);        
    
        // setze den Timer fuer den zyklischen Aufruf des CANoe-"Tasks"
        setTimer(TaskTimer, 10);                
    
        //  BAPFsg_ProcessDebug(NODE_INDEX,DEBUG_CAN_CHANNEL, DEBUG_ID, LSGID, DEBUG_SWITCH_ON);    
    }
    else{ /***** Ausschalten ****/
        
        BAP150_Shutdown(NODE_INDEX,LSGID);
        
        CANoe_Shutdown();
        
        // ETHERNET NOT ENABLED! (CALL_FCT_CLOSE_UPD_SOCKET_TOKEN)
    }

}

Initialize_Variables()	//initialize/reset all global variables
{
	int i;
	byte  Init_data[BAP_buffer_size];	// InitSend data for DLL

	/**** Request Buffer Geschichten initialisieren ****/
	for (i = 0; i < Requestbuffer_lines; i++)
	{
		gBAP_Requestbuffer_status[i] = 0;
	}
	for (i = 0; i < BAP_buffer_size; i++)
	{
		Init_data[i] = 0;
	}
	
	/* Wert im Eingabefeld initialisieren*/
	getValue(P_ASG_70_1_0_16,Init_data);
	putValue(P_ASG_70_1_0_16,Init_data, 6);
	/* Farbe setzen*/
	putValue(C_ASG_70_1_0_1_State,"");
	setControlBackColor(panel_name, "errfield_C_ASG_70_1_0_1_State", MakeRGB(255,255,255));

}

initInvalidFields()	//initialize/reset all global variables
{
	    setControlBackColor(panel_name, "panel1_edit", MakeRGB(220,220,220));
    setControlBackColor(panel_name, "panel_P_ASG_70_1_0_4", MakeRGB(220,220,220));
    setControlBackColor(panel_name, "panel_P_ASG_70_1_0_14", MakeRGB(220,220,220));
    setControlBackColor(panel_name, "panel_P_ASG_70_1_0_15", MakeRGB(220,220,220));
    setControlBackColor(panel_name, "panel_P_ASG_70_1_0_16", MakeRGB(220,220,220));
    setControlBackColor(panel_name, "panel_P_ASG_70_1_0_17", MakeRGB(220,220,220));
    setControlBackColor(panel_name, "panel_A_ASG_70_1_0_18", MakeRGB(220,220,220));
    setControlBackColor(panel_name, "panel_A_ASG_70_1_0_18_Changed",MakeRGB(220,220,220));
    setControlBackColor(panel_name, "panel_A_ASG_70_1_0_19", MakeRGB(220,220,220));
    setControlBackColor(panel_name, "panel_A_ASG_70_1_0_19_Changed",MakeRGB(220,220,220));
    setControlBackColor(panel_name, "panel_P_ASG_70_1_0_20", MakeRGB(220,220,220));

}

on start
{
	// noch nicht eingeschaltet
	gSG_PowerOnOff=0;
	// noch nicht initialisiert
	gBAP_Init=0;
	// open the panel, nur fuer CANoe-Version >= 5.1 erlaubt
	//openPanel(panel_name);
	// deaktiviere alle aktiven Panel Elemente, ausser AN/AUSS
    CANoe_Shutdown();
    // ungueltige Felder initialisieren
    initInvalidFields();    
    
// ETHERNET AND FLEXRAY NOT ENABLED!
}

BAP_CAN_TX_Request()	//Function to send BAP-data over CAN
{
   int i;
   byte TX_Data[8];				// CAN-data
   byte TX_Data_FR[10];    		// FlexRay-Data
   dword TX_Header[3];			// CAN-header
   message 0x100 TX_Message;	// dummy-message, Adresse wird noch modifiziert
   
   byte send_result;
   
   // ONLY CAN IS ENABLED! 
   		TX_Header[2] = 8; // max-Length of TX_Data

		// Pollen ueber die Queue, die von der DLL zur Verfuegung gestellt wird
		// Diese Daten muessen ueber den CAN Bus gesendet werden
	   	while (BAP150_CAN_GetTxDat(NODE_INDEX,TX_Header,TX_Data) == 0) {	
			TX_Message.CAN = TX_Header[0]; 		//CAN channel
			TX_Message.ID =TX_Header[1]; 			//Can ID
			TX_Message.DLC = TX_Header[2]; 		// received length
			
			for (i=0; i<TX_Message.DLC; i++) {	//CAN data-bytes
		  		TX_Message.byte(i) = TX_Data[i];
		  	}
		  	
		  	output(TX_Message);					//send CAN message
		  	
		  	//Versions Output
		  	if(TX_Data[0] == 0x40 && TX_Data[1] == 0x00 && TX_Header[2] == 4)
		  	{
		    	writelineEx(gBAP_Trace, 0,"Major Version: %i, Minor Version: %i", TX_Data[2], TX_Data[3]);
		  	}       
		  	TX_Header[2] = 8; // max-Length of TX_Data
	   	} 
   // ONLY CAN IS ENABLED!
   // FLEXRAY NOT ENABLED! (TX_FR_TOKEN)
   // ETHERNET NOT ENABLED! (TX_IP_TOKEN)
}

ringbuffer_write (byte lsgID, byte fctID, byte request, byte dataType, word length, dword singleData, byte data[])
{
	int bufferline, i;

	bufferline = getNextWriteIndex();	//get next free position in ring-buffer

	if (bufferline == -1) 
	{
		writelineEx(gError_Trace, 0, "Crititcal Error: No free buffer found!");
		return;
	}
		
	gBAP_Request_header[bufferline][0] = lsgID;	// LSG
	gBAP_Request_header[bufferline][1] = fctID;	// FCT
	gBAP_Request_header[bufferline][3] = dataType; // dataType

    //writelineEx(gBAP_Trace, 0, "Write request in buffer ASG NODEINDEX:%d lsgid:%d fctid:%d requesttype:%d datatype:%d length:%d", 
    //        NODE_INDEX,lsgID,fctID,request,dataType,length);
	switch (dataType)
	{
		case Bap_void:
			gBAP_Request_header[bufferline][2] = request;	// request
			gBAP_Request_header[bufferline][4] = 0;	// length
				// Void
			// @TODO?		
			break;
		case Bap_uint8:
			gBAP_Request_header[bufferline][2] = request;		// request
			gBAP_Request_header[bufferline][5] = singleData;	// Daten		
			break;
		case Bap_uint16:
			gBAP_Request_header[bufferline][2] = request;		// request
			gBAP_Request_header[bufferline][5] = singleData;	// Daten
			break;			
		case Bap_uint32:
			gBAP_Request_header[bufferline][2] = request;		// request
			gBAP_Request_header[bufferline][5] = singleData;	// Daten		
			break;	
		case Bap_byteSequence:
			gBAP_Request_header[bufferline][2] = request;	// request
			gBAP_Request_header[bufferline][4] = length;	// length
			// Daten der ByteSequence kopieren
			for(i = 0; i < BAP_buffer_size; i++)									
				gBAP_Request_data[bufferline][i] = data[i];
		case Bap_error:
			gBAP_Request_header[bufferline][5] = singleData;	// Errorcode						
			break;
		default:
			break;
	}

			

}

float round (float value, float step)
{
	return _floor(value / step + 0.5) * step;
}

Request_Void (byte lsgID, byte fctID, byte request)
{
	int i;
	byte dataArray [BAP_buffer_size];

	// Initialisieren eines Arrays
	for(i=0;i<BAP_buffer_size;i++) dataArray [i]=0;

	ringbuffer_write (lsgID, fctID, request, Bap_void, 0, 0, dataArray);	
}

Request_Int8 (byte lsgID, byte fctID, byte request, dword data)
{
	int i;
	byte dataArray [BAP_buffer_size];

	// Initialisieren eines Arrays
	for(i=0;i<BAP_buffer_size;i++) dataArray [i]=0;

	ringbuffer_write (lsgID, fctID, request, Bap_uint8, 0, data, dataArray);

}

Request_Int16 (byte lsgID, byte fctID, byte request, dword data)
{
	int i;
	byte dataArray [BAP_buffer_size];

	// Initialisieren eines Arrays
	for(i=0;i<BAP_buffer_size;i++) dataArray [i]=0;

	ringbuffer_write (lsgID, fctID, request, Bap_uint16, 0, data, dataArray);

}

Request_Int32 (byte lsgID, byte fctID, byte request, dword data)
{
	int i;
	byte dataArray [BAP_buffer_size];

	// Initialisieren eines Arrays
	for(i=0;i<BAP_buffer_size;i++) dataArray [i]=0;

	ringbuffer_write (lsgID, fctID, request, Bap_uint32, 0, data, dataArray);
}

Request_ByteSequence (byte lsgID, byte fctID, byte request, byte data[], word length)
{
	int i;
	byte dataArray [BAP_buffer_size];

	// Initialisieren eines Arrays
	for(i=0;i<BAP_buffer_size;i++) dataArray [i]=0;

	// Fuellen des Arrays
	for(i=0;i<length;i++) dataArray [i]=data[i];

	ringbuffer_write (lsgID, fctID, request, Bap_byteSequence, length, 0, dataArray);
}

Request_Error (byte lsgID, byte fctID, byte errorCode)
{
	int i;
	byte dataArray [BAP_buffer_size];

	// Initialisieren eines Arrays
	for(i=0;i<BAP_buffer_size;i++) dataArray [i]=0;

	ringbuffer_write (lsgID, fctID, 0, Bap_error, 0, errorCode, dataArray);
}

DisplayRequestErrorCode(dword fctID, dword errCode)
{
       switch(fctID)
   {
       case C_ASG_70_1_0_1_ID:
           gC_ASG_70_1_0_1_ErrCode = 0;
           putValue(C_ASG_70_1_0_1_ErrCode,  errCode);
           setControlBackColor(panel_name,"errfield_C_ASG_70_1_0_1", MakeRGB(255,79,79));
       break;
       case P_ASG_70_1_0_2_ID:
           gP_ASG_70_1_0_2_ErrCode = 0;
           putValue(P_ASG_70_1_0_2_ErrCode,  errCode);
           setControlBackColor(panel_name,"errfield_P_ASG_70_1_0_2", MakeRGB(255,79,79));
       break;
       case P_ASG_70_1_0_3_ID:
           gP_ASG_70_1_0_3_ErrCode = 0;
           putValue(P_ASG_70_1_0_3_ErrCode,  errCode);
           setControlBackColor(panel_name,"errfield_P_ASG_70_1_0_3", MakeRGB(255,79,79));
       break;
       case P_ASG_70_1_0_4_ID:
           gP_ASG_70_1_0_4_ErrCode = 0;
           putValue(P_ASG_70_1_0_4_ErrCode,  errCode);
           setControlBackColor(panel_name,"errfield_P_ASG_70_1_0_4", MakeRGB(255,79,79));
       break;
       case P_ASG_70_1_0_14_ID:
           gP_ASG_70_1_0_14_ErrCode = 0;
           putValue(P_ASG_70_1_0_14_ErrCode,  errCode);
           setControlBackColor(panel_name,"errfield_P_ASG_70_1_0_14", MakeRGB(255,79,79));
       break;
       case P_ASG_70_1_0_15_ID:
           gP_ASG_70_1_0_15_ErrCode = 0;
           putValue(P_ASG_70_1_0_15_ErrCode,  errCode);
           setControlBackColor(panel_name,"errfield_P_ASG_70_1_0_15", MakeRGB(255,79,79));
       break;
       case P_ASG_70_1_0_16_ID:
           gP_ASG_70_1_0_16_ErrCode = 0;
           putValue(P_ASG_70_1_0_16_ErrCode,  errCode);
           setControlBackColor(panel_name,"errfield_P_ASG_70_1_0_16", MakeRGB(255,79,79));
       break;
       case P_ASG_70_1_0_17_ID:
           gP_ASG_70_1_0_17_ErrCode = 0;
           putValue(P_ASG_70_1_0_17_ErrCode,  errCode);
           setControlBackColor(panel_name,"errfield_P_ASG_70_1_0_17", MakeRGB(255,79,79));
       break;
       case A_ASG_70_1_0_18_ID:
           gA_ASG_70_1_0_18_ErrCode = 0;
           putValue(A_ASG_70_1_0_18_ErrCode,  errCode);
           setControlBackColor(panel_name,"errfield_A_ASG_70_1_0_18", MakeRGB(255,79,79));
       break;
       case A_ASG_70_1_0_19_ID:
           gA_ASG_70_1_0_19_ErrCode = 0;
           putValue(A_ASG_70_1_0_19_ErrCode,  errCode);
           setControlBackColor(panel_name,"errfield_A_ASG_70_1_0_19", MakeRGB(255,79,79));
       break;
       case P_ASG_70_1_0_20_ID:
           gP_ASG_70_1_0_20_ErrCode = 0;
           putValue(P_ASG_70_1_0_20_ErrCode,  errCode);
           setControlBackColor(panel_name,"errfield_P_ASG_70_1_0_20", MakeRGB(255,79,79));
       break;
       default:
           writelineEx(gError_Trace, 0, "%s%d/%d Unknown Functionid in  displayErrorCode", SGtype, LSGID,fctID);
   }

}

BAP_DLL_Request ()
{
	int i;
    int l=0;
	byte temp;
	byte Request_data[4096];	//Request data for DLL
	dword Request_header[6];	//Request header for DLL
	byte dataValid;
	int nextElementToRead;
	
	// defaultmaessig ist senden OK
	dataValid = 1;

	// loeschen der Daten "Container"
	for(i=0;i<6;i++)
		Request_header[i]=0;
	for(i=0;i<BAP_buffer_size;i++)
		Request_data[i]=0;

    
	// Verarbeiten aller noch offenen Requests	
	while ((nextElementToRead = getNextReadIndex()) != -1) 
	{
		// Fuer alle Datentypen gleich
		Request_header[0]=gBAP_Request_header [nextElementToRead][0];		//LSG-ID
		Request_header[1]=gBAP_Request_header [nextElementToRead][1];		//Function-ID
		Request_header[2]=gBAP_Request_header [nextElementToRead][2];		//request type
		Request_header[3]=gBAP_Request_header [nextElementToRead][3];		//BAP data type

		switch(gBAP_Request_header[nextElementToRead][3]){
			case Bap_uint32:
                l=2;
            case Bap_uint16:
                l++;
            case Bap_uint8:
			case Bap_error: // Request (2) wird dabei ignoriert
                l++;
			case Bap_void:  // Datenfeld (5) wird dabei ignoriert
				Request_header[4]=l;												//	not used
				Request_header[5]=gBAP_Request_header [nextElementToRead][5];		// Daten
			break;
			case Bap_byteSequence:									
				Request_header[4]=gBAP_Request_header [nextElementToRead][4];		// length
				Request_header[5]=0;												// not used

				// data-array for BAP-DLL funcion 'BAP_Request'
				for(i=0;i<BAP_buffer_size;i++)
					Request_data[i]=gBAP_Request_data [nextElementToRead][i];
				break;			
			default:
				writelineEx(gError_Trace, 0, "BAP_DLL_Request: invalid BAP-Data-Type: %d", gBAP_Request_header[nextElementToRead][3]);
				dataValid = 0;
			break;			
		}
		
		if(dataValid){
            // wie heisst der Request?
            writelineEx(gBAP_Trace, 0, "%s%d/%d BAP_Request %s datatype:%s length:%d", SGtype, Request_header[0],Request_header[1],Requesttype_Text[Request_header[2]],Datatype_Text[Request_header[3]],Request_header[4]);
			temp = BAP150_Request(NODE_INDEX, Request_header, Request_data);	//send data to BAP-DLL	
			// BAP-Request failed
            if(temp != 0){
                // Fehlercode: Request failed
                writelineEx(gError_Trace, 0, "%s%d/%d Error during BAP_Request errorcode: 0x%X", SGtype, Request_header[0],Request_header[1],temp);
                DisplayRequestErrorCode(Request_header[1],temp);
            } 
		}

	}
} 

int getNextReadIndex ()
{
	int i, ret;
	// der Puffer wird nach dem naechsten zu lesenden Eintrag durchsucht
	// Existiert keiner wird -1 zurueckgegeben
	ret = -1;

	for (i = 0; i < Requestbuffer_lines; i++)
	{
		if (gBAP_Requestbuffer_status[i] == 1)
		{
			// zum verschicken
			ret = i;
			// und wieder freigeben
			gBAP_Requestbuffer_status[i] = 0;
			break;
		}
	}

	return (ret);
}

int getNextWriteIndex ()
{
	int i, ret;
	// der Puffer wird nach dem naechsten freien Eintrag durchsucht
	// Existiert keiner wird -1 zurueckgegeben
	ret = -1;

	for (i = 0; i < Requestbuffer_lines; i++)
	{
		if (gBAP_Requestbuffer_status[i] == 0)
		{
			// zum schreiben
			ret = i;
			// belegen
			gBAP_Requestbuffer_status[i] = 1;
			break;
		}
	}

	return (ret);
}

byte  isBitForFctSetted(word fctid, byte fctList[])
{
    byte byteNo ;
    byte bitno ;
    byte fctValue ;

    byteNo = fctid / 8;
    bitno = fctid % 8;

    fctValue = 0x80 >> bitno;

    return (fctList[byteNo] & fctValue)?1:0;
}

UpdateAllProperties()
{
	Request_Void(LSGID,P_ASG_70_1_0_2_ID,DataGet_REQ);
	Request_Void(LSGID,P_ASG_70_1_0_3_ID,DataGet_REQ);
	Request_Void(LSGID,P_ASG_70_1_0_4_ID,DataGet_REQ);
	Request_Void(LSGID,P_ASG_70_1_0_14_ID,DataGet_REQ);
	Request_Void(LSGID,P_ASG_70_1_0_15_ID,DataGet_REQ);
	Request_Void(LSGID,P_ASG_70_1_0_16_ID,DataGet_REQ);
	Request_Void(LSGID,P_ASG_70_1_0_17_ID,DataGet_REQ);
	Request_Void(LSGID,P_ASG_70_1_0_20_ID,DataGet_REQ);

}

Process_Current_Indication ()
{
   int rxsize;
   int txsize;
   byte temp[BAP_buffer_size];
   char buffer[BAP_buffer_size];
   if(strncmp(Datatype_Text[gBAP_Indication_header[3]], "acknowledge", 4)!=0) 
       writelineEx(gBAP_Trace, 0, "NodeIndex: %d: CurrentIndication %s lsgid:%d fctid:%d indType:%s dataType=%s length=%d",
               NODE_INDEX, SGtype, gBAP_Indication_header[0], gBAP_Indication_header[1], Indicationtype_Text[gBAP_Indication_header[2]], Datatype_Text[gBAP_Indication_header[3]], gBAP_Indication_header[4]);
   else 
       writelineEx(gBAP_Trace, 0, "Internal acknowledge %s-%d fctid:%d indType:%s dataType=%s length=%d",
               SGtype, gBAP_Indication_header[0], gBAP_Indication_header[1], Acknowledgetype_Text[gBAP_Indication_header[5]], Datatype_Text[gBAP_Indication_header[3]], gBAP_Indication_header[4]);
   switch(gBAP_Indication_header[0])  // LSGID
   {
   case LSGID:
       switch(gBAP_Indication_header[1]) // FCTID
       {
    case C_ASG_70_1_0_1_ID: 
        switch(gBAP_Indication_header[3]) // Datentyp 
        {
        case Bap_void:
            switch (gBAP_Indication_header[2]) // IndType
            {
                case Data_IND: // Indicationtyp pruefen
                    //Now every Property with Cache is updated
                    UpdateAllProperties();
                    putValue(C_ASG_70_1_0_1_State, "StatusAll");
                    setControlBackColor(panel_name, "errfield_C_ASG_70_1_0_1_State", MakeRGB(255,255,255));
                    break;
                default:
                    PrintIndicationError("Illegal IndType");
                    break;
            }
            break;
            case Bap_error:
               snprintf(buffer,BAP_buffer_size-1,"Error %02x", gBAP_Indication_header[5]);
               putValue(C_ASG_70_1_0_1_State, buffer);
               setControlBackColor(panel_name, "errfield_C_ASG_70_1_0_1_State", MakeRGB(255,79,79));
               break;
            case Bap_acknowledge:
                break;
            default:
                PrintIndicationError("Illegal DataType");
                break;
        }
    break;
    case P_ASG_70_1_0_2_ID: 
        switch(gBAP_Indication_header[3]) // Datentyp 
        {
        case Bap_byteSequence:
            switch (gBAP_Indication_header[2]) // IndType
            {
                case Reset_IND: // Nur fuer FctId 2 (BAPConfig) relevant
                   putValue(C_ASG_70_1_0_1_State, "");
                   setControlBackColor(panel_name, "errfield_C_ASG_70_1_0_1_State", MakeRGB(255,255,255));
                   initInvalidFields();
                   // Fall through
                case Data_IND: // Indicationtyp pruefen
                    // Daten setzen
                    putValue(BAPCFG_ASG_70_1_0_ProtocolMajor, gBAP_Indication_data[0]);
                    putValue(BAPCFG_ASG_70_1_0_ProtocolMinor, gBAP_Indication_data[1]);
                    putValue(BAPCFG_ASG_70_1_0_LsgClassMajor, gBAP_Indication_data[2]);
                    putValue(BAPCFG_ASG_70_1_0_LsgClassMinor, gBAP_Indication_data[3]);
                    putValue(BAPCFG_ASG_70_1_0_DFMajor, gBAP_Indication_data[4]);
                    putValue(BAPCFG_ASG_70_1_0_DFMinor, gBAP_Indication_data[5]);
                    setControlBackColor(panel_name, "errfield_P_ASG_70_1_0_2", MakeRGB(255,255,255));  
                    setControlBackColor(panel_name, "panel1_edit", MakeRGB(255,255,255));  
                    break;
                default:
                    PrintIndicationError("Illegal IndType");
                    break;
            }
            break;
            case Bap_error:
                putValue(P_ASG_70_1_0_2_ErrCode,  gBAP_Indication_header[5]);
                setControlBackColor(panel_name, "errfield_P_ASG_70_1_0_2", MakeRGB(255,79,79));  
                setControlBackColor(panel_name, "panel1_edit", MakeRGB(220,220,220));  
                break;
            case Bap_acknowledge:
                break;
            default:
                PrintIndicationError("Illegal DataType");
                break;
        }
    break;
    case P_ASG_70_1_0_3_ID: 
       switch(gBAP_Indication_header[3]) // Datentyp
       {
            case Bap_byteSequence:
                switch (gBAP_Indication_header[2]) // IndType
                {
                    case Data_IND: // Indicationtyp pruefen
                    case Reset_IND: // Nur fuer FctId 2 (BAPConfig) relevant
                    {
                        setControlBackColor(panel_name, "errfield_P_ASG_70_1_0_3", MakeRGB(255,255,255));
                        if(isBitForFctSetted(A_ASG_70_1_0_19_ID,gBAP_Indication_data))
                        {
                            putValue(A_ASG_70_1_0_19_FctLstItemEn, 1);
                            setControlForeColor(panel_name, gCheckbox19,MakeRGB(0,240,0));
                            EnableControl(panel_name, gPanel19, 1);
                            EnableControl(panel_name, "panel_A_ASG_70_1_0_19",1);
                            EnableControl(panel_name, "panel_A_ASG_70_1_0_19_Changed",1);
                            EnableControl(panel_name, "panel_A_ASG_70_1_0_19_SetGet",1);
                        }
                        else
                        {
                            putValue(A_ASG_70_1_0_19_FctLstItemEn, 0);
                            setControlForeColor(panel_name, gCheckbox19,MakeRGB(250,0,0));
                            EnableControl(panel_name, gPanel19, 0);
                            EnableControl(panel_name, "panel_A_ASG_70_1_0_19",0);
                            EnableControl(panel_name, "panel_A_ASG_70_1_0_19_Changed",0);
                            EnableControl(panel_name, "panel_A_ASG_70_1_0_19_SetGet",0);
                        }

                        if(isBitForFctSetted(P_ASG_70_1_0_20_ID,gBAP_Indication_data))
                        {
                            putValue(P_ASG_70_1_0_20_FctLstItemEn, 1);
                            setControlForeColor(panel_name, gCheckbox20,MakeRGB(0,240,0));
                            EnableControl(panel_name, gPanel20, 1);
                            EnableControl(panel_name, "panel_P_ASG_70_1_0_20",1);
                        }
                        else
                        {
                            putValue(P_ASG_70_1_0_20_FctLstItemEn, 0);
                            setControlForeColor(panel_name, gCheckbox20,MakeRGB(250,0,0));
                            EnableControl(panel_name, gPanel20, 0);
                            EnableControl(panel_name, "panel_P_ASG_70_1_0_20",0);
                        }

                        if(isBitForFctSetted(A_ASG_70_1_0_18_ID,gBAP_Indication_data))
                        {
                            putValue(A_ASG_70_1_0_18_FctLstItemEn, 1);
                            setControlForeColor(panel_name, gCheckbox18,MakeRGB(0,240,0));
                            EnableControl(panel_name, gPanel18, 1);
                            EnableControl(panel_name, "panel_A_ASG_70_1_0_18",1);
                            EnableControl(panel_name, "panel_A_ASG_70_1_0_18_Changed",1);
                            EnableControl(panel_name, "panel_A_ASG_70_1_0_18_SetGet",1);
                        }
                        else
                        {
                            putValue(A_ASG_70_1_0_18_FctLstItemEn, 0);
                            setControlForeColor(panel_name, gCheckbox18,MakeRGB(250,0,0));
                            EnableControl(panel_name, gPanel18, 0);
                            EnableControl(panel_name, "panel_A_ASG_70_1_0_18",0);
                            EnableControl(panel_name, "panel_A_ASG_70_1_0_18_Changed",0);
                            EnableControl(panel_name, "panel_A_ASG_70_1_0_18_SetGet",0);
                        }

                        if(isBitForFctSetted(P_ASG_70_1_0_17_ID,gBAP_Indication_data))
                        {
                            putValue(P_ASG_70_1_0_17_FctLstItemEn, 1);
                            setControlForeColor(panel_name, gCheckbox17,MakeRGB(0,240,0));
                            EnableControl(panel_name, gPanel17, 1);
                            EnableControl(panel_name, "panel_P_ASG_70_1_0_17",1);
                        }
                        else
                        {
                            putValue(P_ASG_70_1_0_17_FctLstItemEn, 0);
                            setControlForeColor(panel_name, gCheckbox17,MakeRGB(250,0,0));
                            EnableControl(panel_name, gPanel17, 0);
                            EnableControl(panel_name, "panel_P_ASG_70_1_0_17",0);
                        }

                        if(isBitForFctSetted(P_ASG_70_1_0_16_ID,gBAP_Indication_data))
                        {
                            putValue(P_ASG_70_1_0_16_FctLstItemEn, 1);
                            setControlForeColor(panel_name, gCheckbox16,MakeRGB(0,240,0));
                            EnableControl(panel_name, gPanel16, 1);
                            EnableControl(panel_name, "panel_P_ASG_70_1_0_16",1);
                        }
                        else
                        {
                            putValue(P_ASG_70_1_0_16_FctLstItemEn, 0);
                            setControlForeColor(panel_name, gCheckbox16,MakeRGB(250,0,0));
                            EnableControl(panel_name, gPanel16, 0);
                            EnableControl(panel_name, "panel_P_ASG_70_1_0_16",0);
                        }

                        if(isBitForFctSetted(P_ASG_70_1_0_15_ID,gBAP_Indication_data))
                        {
                            putValue(P_ASG_70_1_0_15_FctLstItemEn, 1);
                            setControlForeColor(panel_name, gCheckbox15,MakeRGB(0,240,0));
                            EnableControl(panel_name, gPanel15, 1);
                            EnableControl(panel_name, "panel_P_ASG_70_1_0_15",1);
                        }
                        else
                        {
                            putValue(P_ASG_70_1_0_15_FctLstItemEn, 0);
                            setControlForeColor(panel_name, gCheckbox15,MakeRGB(250,0,0));
                            EnableControl(panel_name, gPanel15, 0);
                            EnableControl(panel_name, "panel_P_ASG_70_1_0_15",0);
                        }

                        if(isBitForFctSetted(P_ASG_70_1_0_14_ID,gBAP_Indication_data))
                        {
                            putValue(P_ASG_70_1_0_14_FctLstItemEn, 1);
                            setControlForeColor(panel_name, gCheckbox14,MakeRGB(0,240,0));
                            EnableControl(panel_name, gPanel14, 1);
                            EnableControl(panel_name, "panel_P_ASG_70_1_0_14",1);
                        }
                        else
                        {
                            putValue(P_ASG_70_1_0_14_FctLstItemEn, 0);
                            setControlForeColor(panel_name, gCheckbox14,MakeRGB(250,0,0));
                            EnableControl(panel_name, gPanel14, 0);
                            EnableControl(panel_name, "panel_P_ASG_70_1_0_14",0);
                        }

                        if(isBitForFctSetted(P_ASG_70_1_0_4_ID,gBAP_Indication_data))
                        {
                            putValue(P_ASG_70_1_0_4_FctLstItemEn, 1);
                            setControlForeColor(panel_name, gCheckbox4,MakeRGB(0,240,0));
                        }
                        else
                        {
                            putValue(P_ASG_70_1_0_4_FctLstItemEn, 0);
                            setControlForeColor(panel_name, gCheckbox4,MakeRGB(250,0,0));
                        }

                        if(isBitForFctSetted(P_ASG_70_1_0_3_ID,gBAP_Indication_data))
                        {
                            putValue(P_ASG_70_1_0_3_FctLstItemEn, 1);
                            setControlForeColor(panel_name, gCheckbox3,MakeRGB(0,240,0));
                        }
                        else
                        {
                            putValue(P_ASG_70_1_0_3_FctLstItemEn, 0);
                            setControlForeColor(panel_name, gCheckbox3,MakeRGB(250,0,0));
                        }

                        if(isBitForFctSetted(P_ASG_70_1_0_2_ID,gBAP_Indication_data))
                        {
                            putValue(P_ASG_70_1_0_2_FctLstItemEn, 1);
                            setControlForeColor(panel_name, gCheckbox2,MakeRGB(0,240,0));
                        }
                        else
                        {
                            putValue(P_ASG_70_1_0_2_FctLstItemEn, 0);
                            setControlForeColor(panel_name, gCheckbox2,MakeRGB(250,0,0));
                        }

                        if(isBitForFctSetted(C_ASG_70_1_0_1_ID,gBAP_Indication_data))
                        {
                            putValue(C_ASG_70_1_0_1_FctLstItemEn, 1);
                            setControlForeColor(panel_name, gCheckbox1,MakeRGB(0,240,0));
                        }
                        else
                        {
                            putValue(C_ASG_70_1_0_1_FctLstItemEn, 0);
                            setControlForeColor(panel_name, gCheckbox1,MakeRGB(250,0,0));
                        }

                     }
                        break;
                    default:
                      writelineEx(gError_Trace, 0, "NodeIndex: %d: Illegal IndType : lsgid:%d fctid:%d indType:%d",
                           NODE_INDEX, gBAP_Indication_header[0], gBAP_Indication_header[1], gBAP_Indication_header[2]);
                       break;
                  }
                  break;
            case Bap_error:
                putValue(P_ASG_70_1_0_3_ErrCode,  gBAP_Indication_header[5]);
                setControlBackColor(panel_name, "errfield_P_ASG_70_1_0_3", MakeRGB(255,79,79));
                break;
            case Bap_acknowledge:
            	 break;
            default:
                PrintIndicationError("Illegal DataType");
                break;
       }
       break;
    case P_ASG_70_1_0_4_ID: 
        switch(gBAP_Indication_header[3]) // Datentyp 
        {
           case Bap_uint8:
                   switch(gBAP_Indication_header[2]) // IndType
                   {
                       case Data_IND: // Indicationtyp pruefen
                           // Daten setzen
                           putValue(P_ASG_70_1_0_4, gBAP_Indication_header[5]);
                           setControlBackColor(panel_name, "errfield_P_ASG_70_1_0_4", MakeRGB(255,255,255));  
                           setControlBackColor(panel_name, "panel_P_ASG_70_1_0_4", MakeRGB(255,255,255));  
                           break;                              
                       default:
                           PrintIndicationError("Illegal IndType");
                           break;
                   }
                   break;
            case Bap_error:
                putValue(P_ASG_70_1_0_4_ErrCode,  gBAP_Indication_header[5]);
                setControlBackColor(panel_name, "errfield_P_ASG_70_1_0_4", MakeRGB(255,79,79));  
                setControlBackColor(panel_name, "panel_P_ASG_70_1_0_4", MakeRGB(220,220,220));  
                if(gBAP_Indication_header[5]==0x21)
                {
                   putValue(C_ASG_70_1_0_1_State, "");
                   setControlBackColor(panel_name, "errfield_C_ASG_70_1_0_1_State", MakeRGB(255,255,255));
                }
                break;
            case Bap_acknowledge:
                break;
            default:
                PrintIndicationError("Illegal DataType");
                break;
        }
    break;
    case P_ASG_70_1_0_14_ID: 
        switch(gBAP_Indication_header[3]) // Datentyp 
        {
            case Bap_byteSequence:
                switch (gBAP_Indication_header[2]) // IndType
                {
                    case Data_IND: // Indicationtyp pruefen
                        // Daten setzen
                        putValue(P_ASG_70_1_0_14, gBAP_Indication_data, gBAP_Indication_header[4]);
                        setControlBackColor(panel_name, "errfield_P_ASG_70_1_0_14", MakeRGB(255,255,255));  
                        setControlBackColor(panel_name, "panel_P_ASG_70_1_0_14", MakeRGB(255,255,255));  
                        break;
                    default:
                        PrintIndicationError("Illegal IndType");
                        break;
                }
                break;
            case Bap_error:
                gP_ASG_70_1_0_14_ErrCode = 0;
                putValue(P_ASG_70_1_0_14_ErrCode,  gBAP_Indication_header[5]);
                setControlBackColor(panel_name, "errfield_P_ASG_70_1_0_14", MakeRGB(255,79,79));  
                setControlBackColor(panel_name, "panel_P_ASG_70_1_0_14", MakeRGB(220,220,220));  
                break;
            case Bap_acknowledge:
                break;
            default:
                PrintIndicationError("Illegal DataType");
                break;
        }
    break;
    case P_ASG_70_1_0_15_ID: 
        switch(gBAP_Indication_header[3]) // Datentyp 
        {
            case Bap_uint8:
                    switch(gBAP_Indication_header[2]) // IndType
                    {
                        case Data_IND: // Indicationtyp pruefen
                            // Daten setzen
                            putValue(P_ASG_70_1_0_15, gBAP_Indication_header[5]);
                            setControlBackColor(panel_name, "errfield_P_ASG_70_1_0_15", MakeRGB(255,255,255));  
                            setControlBackColor(panel_name, "panel_P_ASG_70_1_0_15", MakeRGB(255,255,255));  
                            break;                              
                        default:
                            PrintIndicationError("Illegal IndType");
                            break;
                    }
                    break;
            case Bap_error:
                gP_ASG_70_1_0_15_ErrCode = 0;
                putValue(P_ASG_70_1_0_15_ErrCode,  gBAP_Indication_header[5]);
                setControlBackColor(panel_name, "errfield_P_ASG_70_1_0_15", MakeRGB(255,79,79));  
                setControlBackColor(panel_name, "panel_P_ASG_70_1_0_15", MakeRGB(220,220,220));  
                break;
            case Bap_acknowledge:
                break;
            default:
                    PrintIndicationError("Illegal DataType");
                    break;
        }
    break;
    case P_ASG_70_1_0_16_ID: 
        switch(gBAP_Indication_header[3]) // Datentyp 
        {
            case Bap_byteSequence:
                switch (gBAP_Indication_header[2]) // IndType
                {
                    case Data_IND: // Indicationtyp pruefen
                        // Daten setzen
                        putValue(P_ASG_70_1_0_16, gBAP_Indication_data, gBAP_Indication_header[4]);
                        setControlBackColor(panel_name, "errfield_P_ASG_70_1_0_16", MakeRGB(255,255,255));  
                        setControlBackColor(panel_name, "panel_P_ASG_70_1_0_16", MakeRGB(255,255,255));  
                        break;
                    default:
                        PrintIndicationError("Illegal IndType");
                        break;
                }
                break;
            case Bap_error:
                gP_ASG_70_1_0_16_ErrCode = 0;
                putValue(P_ASG_70_1_0_16_ErrCode,  gBAP_Indication_header[5]);
                setControlBackColor(panel_name, "errfield_P_ASG_70_1_0_16", MakeRGB(255,79,79));  
                setControlBackColor(panel_name, "panel_P_ASG_70_1_0_16", MakeRGB(220,220,220));  
                break;
            case Bap_acknowledge:
                break;
            default:
                PrintIndicationError("Illegal DataType");
                break;
        }
    break;
    case P_ASG_70_1_0_17_ID: 
        switch(gBAP_Indication_header[3]) // Datentyp 
        {
            case Bap_byteSequence:
                switch (gBAP_Indication_header[2]) // IndType
                {
                    case Data_IND: // Indicationtyp pruefen
                        // Daten setzen
                        putValue(P_ASG_70_1_0_17, gBAP_Indication_data, gBAP_Indication_header[4]);
                        setControlBackColor(panel_name, "errfield_P_ASG_70_1_0_17", MakeRGB(255,255,255));  
                        setControlBackColor(panel_name, "panel_P_ASG_70_1_0_17", MakeRGB(255,255,255));  
                        break;
                    default:
                        PrintIndicationError("Illegal IndType");
                        break;
                }
                break;
            case Bap_error:
                gP_ASG_70_1_0_17_ErrCode = 0;
                putValue(P_ASG_70_1_0_17_ErrCode,  gBAP_Indication_header[5]);
                setControlBackColor(panel_name, "errfield_P_ASG_70_1_0_17", MakeRGB(255,79,79));  
                setControlBackColor(panel_name, "panel_P_ASG_70_1_0_17", MakeRGB(220,220,220));  
                break;
            case Bap_acknowledge:
                break;
            default:
                PrintIndicationError("Illegal DataType");
                break;
        }
    break;
    case A_ASG_70_1_0_18_ID: 
        switch(gBAP_Indication_header[3]) // Datentyp 
        {
            case Bap_byteSequence:
                switch (gBAP_Indication_header[2]) // IndType
                {
                    case Data_IND: // Indicationtyp pruefen
                        // Daten setzen
                        //putValue(A_ASG_70_1_0_18, gBAP_Indication_data, gBAP_Indication_header[4]);
                        A_ASG_70_1_0_18_DataInd();
                        setControlBackColor(panel_name, "errfield_A_ASG_70_1_0_18", MakeRGB(255,255,255));  
                        setControlBackColor(panel_name, "panel_A_ASG_70_1_0_18", MakeRGB(255,255,255));  
                        break;
                    case Changed_IND: // Indicationtyp pruefen
                        // Daten setzen
                        //putValue(A_ASG_70_1_0_18_Changed, gBAP_Indication_data, gBAP_Indication_header[4]);
                        A_ASG_70_1_0_18_ChangedInd();
                        setControlBackColor(panel_name, "errfield_A_ASG_70_1_0_18", MakeRGB(255,255,255));  
                        setControlBackColor(panel_name, "panel_A_ASG_70_1_0_18_Changed", MakeRGB(255,255,255));  
                        break;
                    default:
                        PrintIndicationError("Illegal IndType");
                        break;
                }
                break;
            case Bap_error:
                gA_ASG_70_1_0_18_ErrCode = 0;
                putValue(A_ASG_70_1_0_18_ErrCode,  gBAP_Indication_header[5]);
                setControlBackColor(panel_name, "errfield_A_ASG_70_1_0_18", MakeRGB(255,79,79));  
                setControlBackColor(panel_name, "panel_A_ASG_70_1_0_18", MakeRGB(220,220,220));  
                setControlBackColor(panel_name, "panel_A_ASG_70_1_0_18_Changed", MakeRGB(220,220,220));  
                break;
            case Bap_acknowledge:
                break;
            default:
                    PrintIndicationError("Illegal DataType");
                    break;
        }
    break;
    case A_ASG_70_1_0_19_ID: 
        switch(gBAP_Indication_header[3]) // Datentyp 
        {
            case Bap_byteSequence:
                switch (gBAP_Indication_header[2]) // IndType
                {
                    case Data_IND: // Indicationtyp pruefen
                        // Daten setzen
                        //putValue(A_ASG_70_1_0_19, gBAP_Indication_data, gBAP_Indication_header[4]);
                        A_ASG_70_1_0_19_DataInd();
                        setControlBackColor(panel_name, "errfield_A_ASG_70_1_0_19", MakeRGB(255,255,255));  
                        setControlBackColor(panel_name, "panel_A_ASG_70_1_0_19", MakeRGB(255,255,255));  
                        break;
                    case Changed_IND: // Indicationtyp pruefen
                        // Daten setzen
                        //putValue(A_ASG_70_1_0_19_Changed, gBAP_Indication_data, gBAP_Indication_header[4]);
                        A_ASG_70_1_0_19_ChangedInd();
                        setControlBackColor(panel_name, "errfield_A_ASG_70_1_0_19", MakeRGB(255,255,255));  
                        setControlBackColor(panel_name, "panel_A_ASG_70_1_0_19_Changed", MakeRGB(255,255,255));  
                        break;
                    default:
                        PrintIndicationError("Illegal IndType");
                        break;
                }
                break;
            case Bap_error:
                gA_ASG_70_1_0_19_ErrCode = 0;
                putValue(A_ASG_70_1_0_19_ErrCode,  gBAP_Indication_header[5]);
                setControlBackColor(panel_name, "errfield_A_ASG_70_1_0_19", MakeRGB(255,79,79));  
                setControlBackColor(panel_name, "panel_A_ASG_70_1_0_19", MakeRGB(220,220,220));  
                setControlBackColor(panel_name, "panel_A_ASG_70_1_0_19_Changed", MakeRGB(220,220,220));  
                break;
            case Bap_acknowledge:
                break;
            default:
                    PrintIndicationError("Illegal DataType");
                    break;
        }
    break;
    case P_ASG_70_1_0_20_ID: 
        switch(gBAP_Indication_header[3]) // Datentyp 
        {
            case Bap_byteSequence:
                switch (gBAP_Indication_header[2]) // IndType
                {
                    case Data_IND: // Indicationtyp pruefen
                        // Daten setzen
                        putValue(P_ASG_70_1_0_20, gBAP_Indication_data, gBAP_Indication_header[4]);
                        setControlBackColor(panel_name, "errfield_P_ASG_70_1_0_20", MakeRGB(255,255,255));  
                        setControlBackColor(panel_name, "panel_P_ASG_70_1_0_20", MakeRGB(255,255,255));  
                        break;
                    default:
                        PrintIndicationError("Illegal IndType");
                        break;
                }
                break;
            case Bap_error:
                gP_ASG_70_1_0_20_ErrCode = 0;
                putValue(P_ASG_70_1_0_20_ErrCode,  gBAP_Indication_header[5]);
                setControlBackColor(panel_name, "errfield_P_ASG_70_1_0_20", MakeRGB(255,79,79));  
                setControlBackColor(panel_name, "panel_P_ASG_70_1_0_20", MakeRGB(220,220,220));  
                break;
            case Bap_acknowledge:
                break;
            default:
                PrintIndicationError("Illegal DataType");
                break;
        }
    break;
       default:
           writelineEx(gError_Trace, 0, "NodeIndex: %d: Illegal Fct: lsgid:%d fctid:%d indType:%d",
           NODE_INDEX, gBAP_Indication_header[0], gBAP_Indication_header[1], gBAP_Indication_header[2]);
           break;
       }
       break;
   default:
       writelineEx(gError_Trace, 0, "NodeIndex: %d: Illegal LSGID: lsgid:%d fctid:%d indType:%s", NODE_INDEX, gBAP_Indication_header[0], gBAP_Indication_header[1], Indicationtype_Text[gBAP_Indication_header[2]]);
       break;
   }
}


on message BAP_SDS_FSG_01
{
   int i, temp;
   byte RX_Data[8];            // received CAN-DATA
   dword RX_Header[3];         // received CAN-Header
   if(gSG_PowerOnOff==Power_on){
       RX_Header[0]=this.CAN;
       RX_Header[1]=this.ID;
       RX_Header[2]=this.DLC; // received length
       for (i=0; i<this.DLC; i++) {
           RX_Data[i]=this.byte(i);
       }
       temp=BAP150_CAN_SetRxDat(NODE_INDEX, RX_Header, RX_Data);
   }
}



intertelegram_err(long fctId)
{
    long data[4];
    data[0]=LSGID;
    data[1]=fctId;
    data[2]=1;
    data[3]=940;
    ChangeConfig(0x0020,data);
}

sequence_err(long fctId, long size)
{
    long data[5];
    long lastSeg;

    lastSeg = size-5;

    data[0]=LSGID;
    data[1]=fctId;
    data[2]=lastSeg/7+1;
    data[3]=1;
    data[4]=(lastSeg/7+4) & 15;
    ChangeConfig(0x0021,data);
}

intertelegram_err_off(long fctId)
{
    long data[4];
    data[0]=LSGID;
    data[1]=fctId;
    data[2]=5000;
    data[3]=0;
    ChangeConfig(0x0020,data);
}

sequence_err_off(long fctId)
{
    long data[5];

    data[0]=LSGID;
    data[1]=fctId;
    data[2]=5000;
    data[3]=0;
    data[4]=0;
    ChangeConfig(0x0021,data);
}

// START OF BUS CONFIG PANEL CAPL

// ETHERNET AND FLEXRAY NOT ENABLED! (ENABLE_BUS_SELECTOR_PANEL_TOKEN)

// ETHERNET AND FLEXRAY NOT ENABLED! (ENABLE_CAN_FRAME_TOKEN)

// ETHERNET AND FLEXRAY NOT ENABLED! (ENABLE_FR_FRAME_TOKEN)

// ETHERNET AND FLEXRAY NOT ENABLED! (ENABLE_ETHERNET_FRAME_TOKEN)

// ETHERNET AND FLEXRAY NOT ENABLED! (ENABLE_IP_FORMAT_TOKEN)

// ETHERNET AND FLEXRAY NOT ENABLED! (ON_ENVVAR_BUSTYPE_TOKEN)

// ETHERNET NOT ENABLED! (ON_ENVVAR_ETHERNET_APPLY_BTN_TOKEN)

// ETHERNET NOT ENABLED! (ON_ENVVAR_ETHERNET_RESET_BTN_TOKEN)

// ETHERNET NOT ENABLED! (ON_ENVVAR_IP_INTERFACE_LIST_TOKEN)

// ETHERNET NOT ENABLED! (ON_ENVVAR_IP_FORMAT_TOKEN)

// ETHERNET NOT ENABLED! (ON_UDP_RECEIVE_FROM_TOKEN)

// ETHERNET NOT ENABLED!

on envVar ON_OFF_ASG70_1
{
   BapOnOff(getvalue(this));
   gSG_PowerOnOff=getvalue(ON_OFF_ASG70_1);
}
on envVar C_ASG_70_1_0_1GetAll_BTN
{
 if (C_ASG_70_1_0_1GetAll_BTN_already_pressed == 0)
  {
     C_ASG_70_1_0_1GetAll_BTN_already_pressed = 1;
     Request_Void(LSGID, C_ASG_70_1_0_1_ID, DataGet_REQ); 
     putValue(C_ASG_70_1_0_1_State, "GetAll");
     setControlBackColor(panel_name, "errfield_C_ASG_70_1_0_1_State", MakeRGB(255,255,255));
 }
 else
 {
     C_ASG_70_1_0_1GetAll_BTN_already_pressed = 0;
 }
}
on envVar P_ASG_70_1_0_2Get_BTN
{
 if (P_ASG_70_1_0_2Get_BTN_already_pressed == 0)
  {
       putValue(P_ASG_70_1_0_2_ErrCode,0);
       SetControlBackColor(panel_name,"errField_P_ASG_70_1_0_2",MakeRGB(255,255,255));
       P_ASG_70_1_0_2Get_BTN_already_pressed = 1;
 }
 else
 {
       Request_Void(LSGID, P_ASG_70_1_0_2_ID, DataGet_REQ); 
       P_ASG_70_1_0_2Get_BTN_already_pressed = 0;
 }
}
on envVar P_ASG_70_1_0_3Get_BTN
{
 if (P_ASG_70_1_0_3Get_BTN_already_pressed == 0)
  {
       putValue(P_ASG_70_1_0_3_ErrCode,0);
       SetControlBackColor(panel_name,"errField_P_ASG_70_1_0_3",MakeRGB(255,255,255));
       P_ASG_70_1_0_3Get_BTN_already_pressed = 1;
 }
 else
 {
       Request_Void(LSGID, P_ASG_70_1_0_3_ID, DataGet_REQ); 
       P_ASG_70_1_0_3Get_BTN_already_pressed = 0;
 }
}
on envVar P_ASG_70_1_0_4Get_BTN
{
 if (P_ASG_70_1_0_4Get_BTN_already_pressed == 0)
  {
       putValue(P_ASG_70_1_0_4_ErrCode,0);
       SetControlBackColor(panel_name,"errField_P_ASG_70_1_0_4",MakeRGB(255,255,255));
       P_ASG_70_1_0_4Get_BTN_already_pressed = 1;
 }
 else
 {
       Request_Void(LSGID, P_ASG_70_1_0_4_ID, DataGet_REQ); 
       P_ASG_70_1_0_4Get_BTN_already_pressed = 0;
 }
}
on envVar P_ASG_70_1_0_14Get_BTN
{
 if (P_ASG_70_1_0_14Get_BTN_already_pressed == 0)
  {
       putValue(P_ASG_70_1_0_14_ErrCode,0);
       SetControlBackColor(panel_name,"errField_P_ASG_70_1_0_14",MakeRGB(255,255,255));
       P_ASG_70_1_0_14Get_BTN_already_pressed = 1;
 }
 else
 {
       Request_Void(LSGID, P_ASG_70_1_0_14_ID, DataGet_REQ); 
       P_ASG_70_1_0_14Get_BTN_already_pressed = 0;
 }
}
on envVar P_ASG_70_1_0_14 // bus value of FSG_Setup (14).
{
	// opcodes: Error-Status
	byte param1; // SetupValue
	byte param2; // Extension1
	byte param3; // Extension2
	byte param4; // Extension3
	byte param5; // Extension4
	byte param6; // Extension5
	// DATATYPE_BYTESEQUENCE / DATATYPE_FIXEDBYTESEQUENCE
	int i;
	byte superval[6];
	int currentPos;
	currentPos = 0;
	for( i = 0; i < 6; i++ ) {
		superval[i] = 0;
	}
	getValue(P_ASG_70_1_0_14, superval);
	///////// Start param1 - UINT8 /////////
	param1 = superval[currentPos++];
	putValue(P_ASG_70_1_0_14_1, param1);
	///////// Start param2 - UINT8 /////////
	param2 = superval[currentPos++];
	putValue(P_ASG_70_1_0_14_2, round((param2 * 1.0) - (0) + (0), 1.0));
	///////// Start param3 - UINT8 /////////
	param3 = superval[currentPos++];
	putValue(P_ASG_70_1_0_14_3, round((param3 * 1.0) - (0) + (0), 1.0));
	///////// Start param4 - UINT8 /////////
	param4 = superval[currentPos++];
	putValue(P_ASG_70_1_0_14_4, round((param4 * 1.0) - (0) + (0), 1.0));
	///////// Start param5 - UINT8 /////////
	param5 = superval[currentPos++];
	putValue(P_ASG_70_1_0_14_5, round((param5 * 1.0) - (0) + (0), 1.0));
	///////// Start param6 - UINT8 /////////
	param6 = superval[currentPos++];
	putValue(P_ASG_70_1_0_14_6, round((param6 * 1.0) - (0) + (0), 1.0));
}

on envVar P_ASG_70_1_0_14_1_0
{
	byte bitval;
	//thisval steht hier fuer den bitfield-wert, 
	//aus Generierungsgruenden hier keine einheitliche Bezeichnung moeglich.
	byte thisval; // SetupValue
	bitval= getValue(this);
	thisval = getValue(P_ASG_70_1_0_14_1);
	thisval = thisval&~(1<<0)|(bitval<<0);
	putValue(P_ASG_70_1_0_14_1,thisval);
}

on envVar P_ASG_70_1_0_14_1 // FSG_Setup.SetupValue
{
	byte superval[6];

	//Update Childvalue (BitField)
	byte mask=0x01;
	int i = 0;
	byte thisval; // SetupValue
	thisval = getValue(this);
	if(thisval&(mask<<0))
		putValue(P_ASG_70_1_0_14_1_0, 1);
	else
		putValue(P_ASG_70_1_0_14_1_0, 0);

    // Update superval
	getValue(P_ASG_70_1_0_14, superval);
	superval[0]=thisval;
	putValue(P_ASG_70_1_0_14,superval);
}

// Ueberwachung der Darstellungsvariable der Range.
on envVar P_ASG_70_1_0_14_2_range // FSG_Setup.Extension1 
{
	@P_ASG_70_1_0_14_2 = @P_ASG_70_1_0_14_2_range - (0); // slider = range - min
}

on envVar P_ASG_70_1_0_14_2 // FSG_Setup.Extension1
{
	byte superval[6];

	//Update Childvalue (Number)
	byte thisval; // Extension1
	float slider_value;

	slider_value = 0; // Konstanter Parameter.
	@P_ASG_70_1_0_14_2_range = slider_value + (0); // real value := slider value + range min.
	thisval = (byte)round((slider_value + (0) - (0)) / (1.0), 1); // bus value := (slider value + min - offset) / step.

    // Update superval
	getValue(P_ASG_70_1_0_14, superval);
	superval[1]=thisval;
	putValue(P_ASG_70_1_0_14,superval);
}

// Ueberwachung der Darstellungsvariable der Range.
on envVar P_ASG_70_1_0_14_3_range // FSG_Setup.Extension2 
{
	@P_ASG_70_1_0_14_3 = @P_ASG_70_1_0_14_3_range - (0); // slider = range - min
}

on envVar P_ASG_70_1_0_14_3 // FSG_Setup.Extension2
{
	byte superval[6];

	//Update Childvalue (Number)
	byte thisval; // Extension2
	float slider_value;

	slider_value = 0; // Konstanter Parameter.
	@P_ASG_70_1_0_14_3_range = slider_value + (0); // real value := slider value + range min.
	thisval = (byte)round((slider_value + (0) - (0)) / (1.0), 1); // bus value := (slider value + min - offset) / step.

    // Update superval
	getValue(P_ASG_70_1_0_14, superval);
	superval[2]=thisval;
	putValue(P_ASG_70_1_0_14,superval);
}

// Ueberwachung der Darstellungsvariable der Range.
on envVar P_ASG_70_1_0_14_4_range // FSG_Setup.Extension3 
{
	@P_ASG_70_1_0_14_4 = @P_ASG_70_1_0_14_4_range - (0); // slider = range - min
}

on envVar P_ASG_70_1_0_14_4 // FSG_Setup.Extension3
{
	byte superval[6];

	//Update Childvalue (Number)
	byte thisval; // Extension3
	float slider_value;

	slider_value = 0; // Konstanter Parameter.
	@P_ASG_70_1_0_14_4_range = slider_value + (0); // real value := slider value + range min.
	thisval = (byte)round((slider_value + (0) - (0)) / (1.0), 1); // bus value := (slider value + min - offset) / step.

    // Update superval
	getValue(P_ASG_70_1_0_14, superval);
	superval[3]=thisval;
	putValue(P_ASG_70_1_0_14,superval);
}

// Ueberwachung der Darstellungsvariable der Range.
on envVar P_ASG_70_1_0_14_5_range // FSG_Setup.Extension4 
{
	@P_ASG_70_1_0_14_5 = @P_ASG_70_1_0_14_5_range - (0); // slider = range - min
}

on envVar P_ASG_70_1_0_14_5 // FSG_Setup.Extension4
{
	byte superval[6];

	//Update Childvalue (Number)
	byte thisval; // Extension4
	float slider_value;

	slider_value = 0; // Konstanter Parameter.
	@P_ASG_70_1_0_14_5_range = slider_value + (0); // real value := slider value + range min.
	thisval = (byte)round((slider_value + (0) - (0)) / (1.0), 1); // bus value := (slider value + min - offset) / step.

    // Update superval
	getValue(P_ASG_70_1_0_14, superval);
	superval[4]=thisval;
	putValue(P_ASG_70_1_0_14,superval);
}

// Ueberwachung der Darstellungsvariable der Range.
on envVar P_ASG_70_1_0_14_6_range // FSG_Setup.Extension5 
{
	@P_ASG_70_1_0_14_6 = @P_ASG_70_1_0_14_6_range - (0); // slider = range - min
}

on envVar P_ASG_70_1_0_14_6 // FSG_Setup.Extension5
{
	byte superval[6];

	//Update Childvalue (Number)
	byte thisval; // Extension5
	float slider_value;

	slider_value = 0; // Konstanter Parameter.
	@P_ASG_70_1_0_14_6_range = slider_value + (0); // real value := slider value + range min.
	thisval = (byte)round((slider_value + (0) - (0)) / (1.0), 1); // bus value := (slider value + min - offset) / step.

    // Update superval
	getValue(P_ASG_70_1_0_14, superval);
	superval[5]=thisval;
	putValue(P_ASG_70_1_0_14,superval);
}

on envVar P_ASG_70_1_0_15Get_BTN
{
 if (P_ASG_70_1_0_15Get_BTN_already_pressed == 0)
  {
       putValue(P_ASG_70_1_0_15_ErrCode,0);
       SetControlBackColor(panel_name,"errField_P_ASG_70_1_0_15",MakeRGB(255,255,255));
       P_ASG_70_1_0_15Get_BTN_already_pressed = 1;
 }
 else
 {
       Request_Void(LSGID, P_ASG_70_1_0_15_ID, DataGet_REQ); 
       P_ASG_70_1_0_15Get_BTN_already_pressed = 0;
 }
}
on envVar P_ASG_70_1_0_15 // bus value of FSG_OperationState (15).
{
	// opcodes: Error-Status
	byte param1; // OP_State
	// DATATYPE_UINTXX
	param1 = getValue(P_ASG_70_1_0_15);
	putValue(P_ASG_70_1_0_15_1, param1);
}

on envVar P_ASG_70_1_0_15_1 // FSG_OperationState.OP_State
{
	byte superval;

	//Update Childvalue (Enum)
	byte thisval; // OP_State
	thisval = getValue(this);

    // Update superval
	superval = getValue(P_ASG_70_1_0_15);
	superval = thisval;
	putValue(P_ASG_70_1_0_15,superval);
}

on envVar P_ASG_70_1_0_16Get_BTN
{
 if (P_ASG_70_1_0_16Get_BTN_already_pressed == 0)
  {
       putValue(P_ASG_70_1_0_16_ErrCode,0);
       SetControlBackColor(panel_name,"errField_P_ASG_70_1_0_16",MakeRGB(255,255,255));
       P_ASG_70_1_0_16Get_BTN_already_pressed = 1;
 }
 else
 {
       Request_Void(LSGID, P_ASG_70_1_0_16_ID, DataGet_REQ); 
       P_ASG_70_1_0_16Get_BTN_already_pressed = 0;
 }
}
on envVar P_ASG_70_1_0_16SetGet_BTN
{
	byte BAPTemp[6];
    if (P_ASG_70_1_0_16SetGet_BTN_already_pressed == 0)
    {
       putValue(P_ASG_70_1_0_16_ErrCode,0);
       SetControlBackColor(panel_name,"errField_P_ASG_70_1_0_16",MakeRGB(255,255,255));
       P_ASG_70_1_0_16SetGet_BTN_already_pressed = 1;
    }
    else
    {
       getValue(P_ASG_70_1_0_16, BAPTemp);
       Request_ByteSequence(LSGID, P_ASG_70_1_0_16_ID, DataSetGet_REQ, BAPTemp, getValueSize(P_ASG_70_1_0_16));
       P_ASG_70_1_0_16SetGet_BTN_already_pressed = 0;
    }
}
on envVar P_ASG_70_1_0_16 // bus value of ASG_Capabilities (16).
{
	// opcodes: Error-Status
	byte param1; // DisplaySizeClass
	byte param2; // Extension1
	byte param3; // Extension2
	byte param4; // Extension3
	byte param5; // Extension4
	byte param6; // Extension5
	// DATATYPE_BYTESEQUENCE / DATATYPE_FIXEDBYTESEQUENCE
	int i;
	byte superval[6];
	int currentPos;
	currentPos = 0;
	for( i = 0; i < 6; i++ ) {
		superval[i] = 0;
	}
	getValue(P_ASG_70_1_0_16, superval);
	///////// Start param1 - UINT8 /////////
	param1 = superval[currentPos++];
	putValue(P_ASG_70_1_0_16_1, param1);
	///////// Start param2 - UINT8 /////////
	param2 = superval[currentPos++];
	putValue(P_ASG_70_1_0_16_2, round((param2 * 1.0) - (0) + (0), 1.0));
	///////// Start param3 - UINT8 /////////
	param3 = superval[currentPos++];
	putValue(P_ASG_70_1_0_16_3, round((param3 * 1.0) - (0) + (0), 1.0));
	///////// Start param4 - UINT8 /////////
	param4 = superval[currentPos++];
	putValue(P_ASG_70_1_0_16_4, round((param4 * 1.0) - (0) + (0), 1.0));
	///////// Start param5 - UINT8 /////////
	param5 = superval[currentPos++];
	putValue(P_ASG_70_1_0_16_5, round((param5 * 1.0) - (0) + (0), 1.0));
	///////// Start param6 - UINT8 /////////
	param6 = superval[currentPos++];
	putValue(P_ASG_70_1_0_16_6, round((param6 * 1.0) - (0) + (0), 1.0));
}

on envVar P_ASG_70_1_0_16_1 // ASG_Capabilities.DisplaySizeClass
{
	byte superval[6];

	//Update Childvalue (Enum)
	byte thisval; // DisplaySizeClass
	thisval = getValue(this);

    // Update superval
	getValue(P_ASG_70_1_0_16, superval);
	superval[0]=thisval;
	putValue(P_ASG_70_1_0_16,superval);
}

// Ueberwachung der Darstellungsvariable der Range.
on envVar P_ASG_70_1_0_16_2_range // ASG_Capabilities.Extension1 
{
	@P_ASG_70_1_0_16_2 = @P_ASG_70_1_0_16_2_range - (0); // slider = range - min
}

on envVar P_ASG_70_1_0_16_2 // ASG_Capabilities.Extension1
{
	byte superval[6];

	//Update Childvalue (Number)
	byte thisval; // Extension1
	float slider_value;

	slider_value = 0; // Konstanter Parameter.
	@P_ASG_70_1_0_16_2_range = slider_value + (0); // real value := slider value + range min.
	thisval = (byte)round((slider_value + (0) - (0)) / (1.0), 1); // bus value := (slider value + min - offset) / step.

    // Update superval
	getValue(P_ASG_70_1_0_16, superval);
	superval[1]=thisval;
	putValue(P_ASG_70_1_0_16,superval);
}

// Ueberwachung der Darstellungsvariable der Range.
on envVar P_ASG_70_1_0_16_3_range // ASG_Capabilities.Extension2 
{
	@P_ASG_70_1_0_16_3 = @P_ASG_70_1_0_16_3_range - (0); // slider = range - min
}

on envVar P_ASG_70_1_0_16_3 // ASG_Capabilities.Extension2
{
	byte superval[6];

	//Update Childvalue (Number)
	byte thisval; // Extension2
	float slider_value;

	slider_value = 0; // Konstanter Parameter.
	@P_ASG_70_1_0_16_3_range = slider_value + (0); // real value := slider value + range min.
	thisval = (byte)round((slider_value + (0) - (0)) / (1.0), 1); // bus value := (slider value + min - offset) / step.

    // Update superval
	getValue(P_ASG_70_1_0_16, superval);
	superval[2]=thisval;
	putValue(P_ASG_70_1_0_16,superval);
}

// Ueberwachung der Darstellungsvariable der Range.
on envVar P_ASG_70_1_0_16_4_range // ASG_Capabilities.Extension3 
{
	@P_ASG_70_1_0_16_4 = @P_ASG_70_1_0_16_4_range - (0); // slider = range - min
}

on envVar P_ASG_70_1_0_16_4 // ASG_Capabilities.Extension3
{
	byte superval[6];

	//Update Childvalue (Number)
	byte thisval; // Extension3
	float slider_value;

	slider_value = 0; // Konstanter Parameter.
	@P_ASG_70_1_0_16_4_range = slider_value + (0); // real value := slider value + range min.
	thisval = (byte)round((slider_value + (0) - (0)) / (1.0), 1); // bus value := (slider value + min - offset) / step.

    // Update superval
	getValue(P_ASG_70_1_0_16, superval);
	superval[3]=thisval;
	putValue(P_ASG_70_1_0_16,superval);
}

// Ueberwachung der Darstellungsvariable der Range.
on envVar P_ASG_70_1_0_16_5_range // ASG_Capabilities.Extension4 
{
	@P_ASG_70_1_0_16_5 = @P_ASG_70_1_0_16_5_range - (0); // slider = range - min
}

on envVar P_ASG_70_1_0_16_5 // ASG_Capabilities.Extension4
{
	byte superval[6];

	//Update Childvalue (Number)
	byte thisval; // Extension4
	float slider_value;

	slider_value = 0; // Konstanter Parameter.
	@P_ASG_70_1_0_16_5_range = slider_value + (0); // real value := slider value + range min.
	thisval = (byte)round((slider_value + (0) - (0)) / (1.0), 1); // bus value := (slider value + min - offset) / step.

    // Update superval
	getValue(P_ASG_70_1_0_16, superval);
	superval[4]=thisval;
	putValue(P_ASG_70_1_0_16,superval);
}

// Ueberwachung der Darstellungsvariable der Range.
on envVar P_ASG_70_1_0_16_6_range // ASG_Capabilities.Extension5 
{
	@P_ASG_70_1_0_16_6 = @P_ASG_70_1_0_16_6_range - (0); // slider = range - min
}

on envVar P_ASG_70_1_0_16_6 // ASG_Capabilities.Extension5
{
	byte superval[6];

	//Update Childvalue (Number)
	byte thisval; // Extension5
	float slider_value;

	slider_value = 0; // Konstanter Parameter.
	@P_ASG_70_1_0_16_6_range = slider_value + (0); // real value := slider value + range min.
	thisval = (byte)round((slider_value + (0) - (0)) / (1.0), 1); // bus value := (slider value + min - offset) / step.

    // Update superval
	getValue(P_ASG_70_1_0_16, superval);
	superval[5]=thisval;
	putValue(P_ASG_70_1_0_16,superval);
}

on envVar P_ASG_70_1_0_17Get_BTN
{
 if (P_ASG_70_1_0_17Get_BTN_already_pressed == 0)
  {
       putValue(P_ASG_70_1_0_17_ErrCode,0);
       SetControlBackColor(panel_name,"errField_P_ASG_70_1_0_17",MakeRGB(255,255,255));
       P_ASG_70_1_0_17Get_BTN_already_pressed = 1;
 }
 else
 {
       Request_Void(LSGID, P_ASG_70_1_0_17_ID, DataGet_REQ); 
       P_ASG_70_1_0_17Get_BTN_already_pressed = 0;
 }
}
on envVar P_ASG_70_1_0_17 // bus value of SDS_ContextState (17).
{
	// opcodes: Error-Status
	byte param1; // SDS_ContextState
	byte param2; // SDS_ContextType
	word param3; // Attributes
	byte param4[93]; //Record: AdditionalInfo
	byte param5; // Extension
	// DATATYPE_BYTESEQUENCE / DATATYPE_FIXEDBYTESEQUENCE
	int i;
	byte superval[98];
	int currentPos;
	currentPos = 0;
	for( i = 0; i < 98; i++ ) {
		superval[i] = 0;
	}
	getValue(P_ASG_70_1_0_17, superval);
	///////// Start param1 - UINT8 /////////
	param1 = superval[currentPos++];
	putValue(P_ASG_70_1_0_17_1, param1);
	///////// Start param2 - UINT8 /////////
	param2 = superval[currentPos++];
	putValue(P_ASG_70_1_0_17_2, param2);
	///////// Start param3 - UINT16 /////////
	param3 = superval[currentPos++]|(superval[currentPos++]<<8);
	putValue(P_ASG_70_1_0_17_3, param3);
	///////// Start param4 - Record /////////
	for( i = 0; i < 93; i++ )
	{
		param4[i] = superval[currentPos++];
	}
	putValue(P_ASG_70_1_0_17_4, param4);
	///////// Start param5 - UINT8 /////////
	param5 = superval[currentPos++];
	putValue(P_ASG_70_1_0_17_5, round((param5 * 1.0) - (0) + (0), 1.0));
}

// Updates the bus value field and other dependencies.
P_ASG_70_1_0_17_BuildFct()
{
	byte param1; // SDS_ContextState
	byte param2; // SDS_ContextType
	word param3; // Attributes
	byte param4[93]; //Record: AdditionalInfo
	byte param5; // Extension

	int i;
	byte superval[98];
	int currentPos;
	currentPos = 0;
// gen_BuildFunc_SetSuperVals 
	param1 = getValue(P_ASG_70_1_0_17_1);
	superval[currentPos++]=param1;
// gen_BuildFunc_SetSuperVals 
	param2 = getValue(P_ASG_70_1_0_17_2);
	superval[currentPos++]=param2;
// gen_BuildFunc_SetSuperVals 
	param3 = getValue(P_ASG_70_1_0_17_3);
	@P_ASG_70_1_0_17_3_0 = (param3 & 1) > 0;
	superval[currentPos++]=param3&0x00ff;
	superval[currentPos++]=(param3&0xff00)>>8;
// gen_BuildFunc_SetSuperVals 
	//Record:AdditionalInfo
	getValue(P_ASG_70_1_0_17_4, param4);
	for( i = 0; i < 93; i++)
	{
	 superval[currentPos++] = param4[i];
	}
// gen_BuildFunc_SetSuperVals 
	@P_ASG_70_1_0_17_5_range = round(@P_ASG_70_1_0_17_5 + (0), 1.0); // slider value + min = real value
	param5 = 0; // underlying parameter has constant value 0.
	superval[currentPos++]=param5;
	putValue(P_ASG_70_1_0_17, superval, currentPos);
}


on envVar P_ASG_70_1_0_17_1 // SDS_ContextState.SDS_ContextState
{
	P_ASG_70_1_0_17_BuildFct();
}

on envVar P_ASG_70_1_0_17_2 // SDS_ContextState.SDS_ContextType
{
	P_ASG_70_1_0_17_BuildFct();
}

on envVar P_ASG_70_1_0_17_3_0
{
	byte bitval;
	//thisval steht hier fuer den bitfield-wert, 
	//aus Generierungsgruenden hier keine einheitliche Bezeichnung moeglich.
	word thisval; // Attributes
	bitval= getValue(this);
	thisval = getValue(P_ASG_70_1_0_17_3);
	thisval = thisval&~(1<<0)|(bitval<<0);
	putValue(P_ASG_70_1_0_17_3,thisval);
}

on envVar P_ASG_70_1_0_17_3 // SDS_ContextState.Attributes
{
	P_ASG_70_1_0_17_BuildFct();
}

//Record: AdditionalInfo, Element: AdditionalInfoType
on envVar P_ASG_70_1_0_17_4_AdditionalInfoType // AdditionalInfo.AdditionalInfoType
{
	byte superval[93];

	//Update Childvalue (Enum)
	word thisval; // AdditionalInfoType
	thisval = getValue(this);

    // Update superval
	getValue(P_ASG_70_1_0_17_4, superval);
	superval[0]=thisval&0x00ff;
	superval[1]=(thisval&0xff00)>>8;
	putValue(P_ASG_70_1_0_17_4,superval);
}

//Record: AdditionalInfo, Element: AdditionalText

// Ueberwachung der CheckBox fuer String
on envVar  P_ASG_70_1_0_17_4_AdditionalText_cnt
{
	word len;
	byte cnt;
	len = getValue(P_ASG_70_1_0_17_4_AdditionalText_len);
	cnt = getValue(P_ASG_70_1_0_17_4_AdditionalText_cnt);

	/* wird nur gerufen, wenn check box deaktiviert mit Length>127*/ 
	if( cnt == 0) 
	{
		if(len > 127 )
		{
			putValue(P_ASG_70_1_0_17_4_AdditionalText_len, 127);
		}
	}

	P_ASG_70_1_0_17_BuildFct();
}



// Ueberwachung der Eingabefeld fuer String Data
on envVar P_ASG_70_1_0_17_4_AdditionalText_len
{
	word len;
	len = getValue(this);
	/* Validierung der Eingabe*/
	if(len > 90)
	{
		writelineEx(gBAP_Trace, 0, "Eingegebene Laenge: %d von P_ASG_70_1_0_17_4_AdditionalText ist ungueltig. Die max. erlaubte Laenge ist %d. ", len, 90);
		putValue(this, 90);
	}
	P_ASG_70_1_0_17_BuildFct();
}


on envVar P_ASG_70_1_0_17_4_AdditionalText // AdditionalInfo.AdditionalText
{
	byte superval[93];

	//Update Childvalue (String)
	word i;
	byte thisval[91];
	getValue(this, thisval);

    // Update superval
	getValue(P_ASG_70_1_0_17_4, superval);
	for( i = 0; i < 91; i++ )
	{
		superval[i+2] = thisval[i];
	}
	putValue(P_ASG_70_1_0_17_4,superval);
}

on envVar P_ASG_70_1_0_17_4 // SDS_ContextState.AdditionalInfo
{
	byte recordVal[93]; //Record: AdditionalInfo
	int currentPos;
	int i;
//UpdateChildValue for Record.
	word param1; // AdditionalInfoType
	byte param2[91]; // AdditionalText
	word len2;
	byte cnt2;

	currentPos = 0;
	getValue(P_ASG_70_1_0_17_4, recordVal);
	// DATATYPE_BYTESEQUENCE / DATATYPE_FIXEDBYTESEQUENCE
	///////// Start param1 - UINT16 /////////
	param1 = recordVal[currentPos++]|(recordVal[currentPos++]<<8);
	putValue(P_ASG_70_1_0_17_4_AdditionalInfoType, param1);
	///////// Start param2 - STRING /////////
	getValue(P_ASG_70_1_0_17_4_AdditionalText, param2);
	if((recordVal[currentPos] & 0x80) > 0)
	{
		if(90>127) /* Max Fct-Katalog Laenge: 90*/
		{
			len2 = ( (recordVal[currentPos]&0x7F) <<8) + recordVal[currentPos+1];
			currentPos = currentPos + 2;
			cnt2 = 1;
		}
		else
		{
			len2 = 90;
			writelineEx(gBAP_Trace, 0, "Anzahl der Laengeninformation-Bytes in P_ASG_70_1_0_17_4 ueberschreitet die erlaubte 1 Byte vom Fct-Kalatog.");
		}
	}
	else
	{
		len2 = recordVal[currentPos]&0x7F;
		currentPos = currentPos + 1;
		cnt2 = 0;
	}
	
	if(len2 > 90)
	{
		writelineEx(gBAP_Trace, 0, "Laenge:%d bei der Byte Position:%d ueberschreitet die Maximale erlaubte Laenge von Fct-Kalatog", len2, currentPos);
		len2 = 90;
	
		if(len2 < 128) cnt2 = 0;
		else cnt2 = 1;
	}
	
	for(i = 0; i < len2; i++)
	{
		param2[i] = recordVal[currentPos++];
	}
	
	putValue(P_ASG_70_1_0_17_4_AdditionalText_len, len2);
	putValue(P_ASG_70_1_0_17_4_AdditionalText_cnt, cnt2);
	
	if(len2 > getValueSize(P_ASG_70_1_0_17_4_AdditionalText))
		putValue(P_ASG_70_1_0_17_4_AdditionalText, param2, len2);
	else
		putValue(P_ASG_70_1_0_17_4_AdditionalText, param2, getValueSize(P_ASG_70_1_0_17_4_AdditionalText));

	P_ASG_70_1_0_17_BuildFct();
}

// Ueberwachung der Darstellungsvariable der Range.
on envVar P_ASG_70_1_0_17_5_range // SDS_ContextState.Extension 
{
	@P_ASG_70_1_0_17_5 = @P_ASG_70_1_0_17_5_range - (0); // slider = range - min
}

on envVar P_ASG_70_1_0_17_5 // SDS_ContextState.Extension
{
	P_ASG_70_1_0_17_BuildFct();
}

on envVar A_ASG_70_1_0_18Get_BTN
{
  byte data[5]; 
  byte stringValue[5];
  byte head[5];
  int i;
  int headLength;
  long tempValue;
  word currentPos;
  word startVal;
  word elementsVal;
  byte nibbleSetted;
  if (A_ASG_70_1_0_18Get_BTN_already_pressed == 0)
  {
     putValue(A_ASG_70_1_0_18_ErrCode,0);
     SetControlBackColor(panel_name,"errField_A_ASG_70_1_0_18",MakeRGB(255,255,255));
     A_ASG_70_1_0_18Get_BTN_already_pressed = 1;
  }
  else
  {
        currentPos = 0;
        //Einzelparameter: ASG_ID
        tempValue = getValue(A_ASG_70_1_0_18_1_SetGet);
    if(nibbleSetted == 1)
    {
        //voriger Parameter war ein Nibble, => second nibble, Pos incr und Flag zuruecksetzen
        data[currentPos] = (tempValue &0x0F) | (data[currentPos] &0xF0);
        currentPos++;
        nibbleSetted = 0;
    }
    else
    {
        //first nibble, kein increment, Flag setzen
        data[currentPos] = (tempValue<<4) &0xF0;
        nibbleSetted = 1;
    }
        //Einzelparameter: TAID
        tempValue = getValue(A_ASG_70_1_0_18_2_SetGet);
    if(nibbleSetted == 1)
    {
        //voriger Parameter war ein Nibble, => second nibble, Pos incr und Flag zuruecksetzen
        data[currentPos] = (tempValue &0x0F) | (data[currentPos] &0xF0);
        currentPos++;
        nibbleSetted = 0;
    }
    else
    {
        //first nibble, kein increment, Flag setzen
        data[currentPos] = (tempValue<<4) &0xF0;
        nibbleSetted = 1;
    }
        //head Parameter
        headLength = getValueSize(A_ASG_70_1_0_18_SetGet);
        getValue(A_ASG_70_1_0_18_SetGet,head);
        for(i=0; i< headLength; i++)
        {
            data[currentPos++] = head[i];
        }

     Request_ByteSequence(LSGID, A_ASG_70_1_0_18_ID, DataGet_REQ, data, currentPos);
     if(getValue(A_ASG_70_1_0_18_IntTlgEn)) //getValue(IT))
     {
       intertelegram_err(A_ASG_70_1_0_18_ID);
     }
     if(getValue(A_ASG_70_1_0_18_SegmEn))   //getvalue(SG)
     {
         sequence_err(A_ASG_70_1_0_18_ID,getValueSize(A_ASG_70_1_0_18_SetGet));
     }
     A_ASG_70_1_0_18Get_BTN_already_pressed = 0;
  }
}
A_ASG_70_1_0_18_SetGet_GenerateSetGet()
{
    byte head[5];
    //Record Address in Byte 0 Bit 0-3 kopieren - MAX Wert = 0x0F
    if(getValue(A_ASG_70_1_0_18_SetGet_RecAdr) > 0x0F)
        putValue(A_ASG_70_1_0_18_SetGet_RecAdr , 0x0F);
    head[0] = (head[0] & 0xF0) | getValue(A_ASG_70_1_0_18_SetGet_RecAdr);
    //Shift Bit in Byte 0 Bit 4 kopieren
    if( getValue(A_ASG_70_1_0_18_SetGet_Shift) > 0) head[0] = head[0] | 0x10;
    else head[0] = head[0] & 0xEF;
    // Direction Bit in Byte 0 Bit 5 kopieren
    if( getValue(A_ASG_70_1_0_18_SetGet_Direction) > 0) head[0] = head[0] | 0x20;
    else head[0] = head[0] & 0xDF;
    // reserverd:  Byte 0 Bit 6
    if( getValue(A_ASG_70_1_0_18_SetGet_IndexSize) > 0)
    {
        // 5 Byte Header
        head[0] = head[0] | 0x80;
        head[1] =  getValue(A_ASG_70_1_0_18_SetGet_Start) & 0xFF;
        head[2] = (getValue(A_ASG_70_1_0_18_SetGet_Start) >> 8 ) & 0xFF;
        head[3] =  getValue(A_ASG_70_1_0_18_SetGet_Elements) & 0xFF;
        head[4] = (getValue(A_ASG_70_1_0_18_SetGet_Elements)  >> 8 ) & 0xFF;
        //ToDo: DATA - derzeit einfach laenge = 5
        putValue(A_ASG_70_1_0_18_SetGet, head, 5); 
    }
    else 
    {
        // 3 Byte Header
        head[0] = head[0] & 0x7F;
        head[1] = getValue(A_ASG_70_1_0_18_SetGet_Start) & 0xFF;
        head[2] = getValue(A_ASG_70_1_0_18_SetGet_Elements) & 0xFF;
        //ToDo: DATA - derzeit einfach laenge = 3
        putValue(A_ASG_70_1_0_18_SetGet, head, 3); 
    }
}

on envVar A_ASG_70_1_0_18_SetGet_RecAdr
{
    A_ASG_70_1_0_18_SetGet_GenerateSetGet();
}

on envVar A_ASG_70_1_0_18_SetGet_Shift
{
    A_ASG_70_1_0_18_SetGet_GenerateSetGet();
}

on envVar A_ASG_70_1_0_18_SetGet_Direction
{
    A_ASG_70_1_0_18_SetGet_GenerateSetGet();
}

on envVar A_ASG_70_1_0_18_SetGet_Start
{
    A_ASG_70_1_0_18_SetGet_GenerateSetGet();
}

on envVar A_ASG_70_1_0_18_SetGet_Elements
{
    A_ASG_70_1_0_18_SetGet_GenerateSetGet();
}

on envVar A_ASG_70_1_0_18_SetGet_IndexSize
{
    A_ASG_70_1_0_18_SetGet_GenerateSetGet();
}
on envVar A_ASG_70_1_0_18
{
    byte temp[5];
    byte head[5];
    getValue(A_ASG_70_1_0_18, head);
    putValue(A_ASG_70_1_0_18_RecAdr, 0x0F & head[0]); //Record Address = Bit 0-3 von Byte 0
    if ( (0x10 & head[0]) >0)
        putValue(A_ASG_70_1_0_18_Shift, 1); //Shift = Bit 4 von Byte 0
    else
        putValue(A_ASG_70_1_0_18_Shift, 0); //Shift = Bit 4 von Byte 0
    if ( (0x20 & head[0]) >0)
        putValue(A_ASG_70_1_0_18_Direction, 1); //Direction = Bit 5 von Byte 0
    else
        putValue(A_ASG_70_1_0_18_Direction, 0); //Direction = Bit 5 von Byte 0
    if ( (0x40 & head[0]) >0)
        putValue(A_ASG_70_1_0_18_TransPos, 1); //Transmission Pos = Bit 6 von Byte 0
    else
        putValue(A_ASG_70_1_0_18_TransPos, 0); //Transmission Pos = Bit 6 von Byte 0
    if ( (0x80 & head[0]) >0)
        putValue(A_ASG_70_1_0_18_IndexSize, 1); //IndexSize = Bit 7 von Byte 0
    else
        putValue(A_ASG_70_1_0_18_IndexSize, 0); //IndexSize = Bit 7 von Byte 0
    if(getValue(A_ASG_70_1_0_18_IndexSize))
    {
        putValue(A_ASG_70_1_0_18_Start, ((head[2]<<8)| head[1]) ); //Start Wert, 2 Byte lang
        putValue(A_ASG_70_1_0_18_Elements, ((head[4]<<8)| head[3]) ); //Elements Wert, 2 Byte lang
    }
    else
    {
        putValue(A_ASG_70_1_0_18_Start, head[1]); //Start Wert, 1 Byte lang
        putValue(A_ASG_70_1_0_18_Elements, head[2]); //Start Wert, 1 Byte lang
    }
}
on envVar A_ASG_70_1_0_18_Changed
{
    byte temp[269];
    getValue(A_ASG_70_1_0_18_Changed, temp);
    putValue(A_ASG_70_1_0_18_Changed_RecAdr, 0x0F & temp[0]); //Record Address = Bit 0-3 von Byte 0
    if ( (0x10 & temp[0]) >0)
        putValue(A_ASG_70_1_0_18_Changed_Shift, 1); //Shift = Bit 4 von Byte 0
    else
        putValue(A_ASG_70_1_0_18_Changed_Shift, 0); //Shift = Bit 4 von Byte 0
    if ( (0x20 & temp[0]) >0)
        putValue(A_ASG_70_1_0_18_Changed_Direction, 1); //Direction = Bit 5 von Byte 0
    else
        putValue(A_ASG_70_1_0_18_Changed_Direction, 0); //Direction = Bit 5 von Byte 0
    if ( (0x40 & temp[0]) >0)
        putValue(A_ASG_70_1_0_18_Changed_TransPos, 1); //Transmission Pos = Bit 6 von Byte 0
    else
        putValue(A_ASG_70_1_0_18_Changed_TransPos, 0); //Transmission Pos = Bit 6 von Byte 0
    if ( (0x80 & temp[0]) >0)
        putValue(A_ASG_70_1_0_18_Changed_IndexSize, 1); //IndexSize = Bit 7 von Byte 0
    else
        putValue(A_ASG_70_1_0_18_Changed_IndexSize, 0); //IndexSize = Bit 7 von Byte 0
    if(getValue(A_ASG_70_1_0_18_Changed_IndexSize))
    {
        putValue(A_ASG_70_1_0_18_Changed_Start, ((temp[2]<<8)| temp[1]) ); //Start Wert, 2 Byte lang
        putValue(A_ASG_70_1_0_18_Changed_Elements, ((temp[4]<<8)| temp[3]) ); //Elements Wert, 2 Byte lang
    }
    else
    {
        putValue(A_ASG_70_1_0_18_Changed_Start, temp[1]); //Start Wert, 1 Byte lang
        putValue(A_ASG_70_1_0_18_Changed_Elements, temp[2]); //Start Wert, 1 Byte lang
    }
}
on envVar A_ASG_70_1_0_18_SetGet
{
    byte temp[5];
    getValue(A_ASG_70_1_0_18_SetGet, temp);
    putValue(A_ASG_70_1_0_18_SetGet_RecAdr, 0x0F & temp[0]); //Record Address = Bit 0-3 von Byte 0
    if ( (0x10 & temp[0]) >0)
        putValue(A_ASG_70_1_0_18_SetGet_Shift, 1); //Shift = Bit 4 von Byte 0
    else
        putValue(A_ASG_70_1_0_18_SetGet_Shift, 0); //Shift = Bit 4 von Byte 0
    if ( (0x20 & temp[0]) >0)
        putValue(A_ASG_70_1_0_18_SetGet_Direction, 1); //Direction = Bit 5 von Byte 0
    else
        putValue(A_ASG_70_1_0_18_SetGet_Direction, 0); //Direction = Bit 5 von Byte 0
    // Bit 6 von Byte 0 = reserved
    if ( (0x80 & temp[0]) >0)
        putValue(A_ASG_70_1_0_18_SetGet_IndexSize, 1); //IndexSize = Bit 7 von Byte 0
    else
        putValue(A_ASG_70_1_0_18_SetGet_IndexSize, 0); //IndexSize = Bit 7 von Byte 0
    if(getValue(A_ASG_70_1_0_18_SetGet_IndexSize))
    {
        putValue(A_ASG_70_1_0_18_SetGet_Start, ((temp[2]<<8)| temp[1]) ); //Start Wert, 2 Byte lang
        putValue(A_ASG_70_1_0_18_SetGet_Elements, ((temp[4]<<8)| temp[3]) ); //Elements Wert, 2 Byte lang
    }
    else
    {
        putValue(A_ASG_70_1_0_18_SetGet_Start, temp[1]); //Start Wert, 1 Byte lang
        putValue(A_ASG_70_1_0_18_SetGet_Elements, temp[2]); //Start Wert, 1 Byte lang
    }
}
A_ASG_70_1_0_18_LoadArray()
{
	/********* Statische Deklarationen ***********/
	dword CSVfileHandle;
	dword filePos;
	dword paramPos;
	dword Num_of_csv_byte;
	dword element;
	dword current_CSV_line;
	byte buffer_byte[0xFFFF];
	dword i;
	dword j;
	char CSV_filename[255];

	/********* Param Puffer Deklarationen ***********/
	char temp1[25];
	char temp2[25];

	/********* Initialisierungen ***********/
	CSVfileHandle = 0;
	filePos = 0;
	paramPos = 0;
	Num_of_csv_byte = 0;
	element = 1;
	current_CSV_line = 0;
	for(i = 0; i < A_ASG_70_1_0_18_ArrayDataList_Length; i++)
	{ /* Initialisierung von den Ziel-Strukturen */
		A_ASG_70_1_0_18_ArrayDataList[i].Param1 = 0;
		A_ASG_70_1_0_18_ArrayDataList[i].Param2 = 0;
		for(j=0; j<61; j++)
			A_ASG_70_1_0_18_ArrayDataList[i].Param3[j] = 0;
		A_ASG_70_1_0_18_ArrayDataList[i].Param3_Length = 0;
		A_ASG_70_1_0_18_Data_3_LenList[i] = 0;
		for(j=0; j<2; j++)
			A_ASG_70_1_0_18_ArrayDataList[i].Param4[j] = 0;
		A_ASG_70_1_0_18_ArrayDataList[i].Param4_Length = 0;
		A_ASG_70_1_0_18_Data_4_LenList[i] = 0;
	}

	/********* Laden der CSV-Datei ***********/
	getValue(A_ASG_70_1_0_18_fileSelector, CSV_filename);
	CSVfileHandle = openFileRead(CSV_filename, 1); //open *.csv (binary-mode ->get the ASCII/UTF-8 code)

	if (CSVfileHandle!=0) //*.csv file access successful
	{
		writelineEx(gBAP_Trace, 0,"Dateizugriff auf '%s' erfolgreich", CSV_filename);    //output result
		//get data from *.csv and store the total number of byte in *.csv-file
		Num_of_csv_byte = fileGetBinaryBlock (buffer_byte, elcount(buffer_byte), CSVfileHandle);

		for (filePos = 0; filePos < Num_of_csv_byte; filePos++) //copy data into "LastDestList"
		{
			if (buffer_byte[filePos] != 0x3B) //read data if no ";" is detected
			{
				//nextline in *.csv (next "record element" in LastDestList) -> "LF" and "CR" detected -> copy (transform string -> long) data from help values in global values
				if(buffer_byte[filePos] == 0x0D && buffer_byte[filePos+1] == 0x0A)
				{
					if(current_CSV_line > 0 && current_CSV_line < 255) //ignore first line in *.csv file
					{
						A_ASG_70_1_0_18_ArrayDataList[current_CSV_line-1].Param1 = atol(temp1); //Pos
						A_ASG_70_1_0_18_ArrayDataList[current_CSV_line-1].Param2 = atol(temp2); //CommandID
						for(i = 0; i < 25; i++)
						{ /* Temp-Puffer Initialisierung zur Vermeidung von Nebeneffekte */
							temp1[i]=0;
							temp2[i]=0;
						}
					}
					current_CSV_line++; //next line in *.csv file
					element = 1; //start at 'POS' (first record element of "array data")
					paramPos = 0; //reset value
				}
 				//copy data from "buffer_byte" (data from *.csv file) in help values and "name" until end of line is not detected
				else if(current_CSV_line > 0 && current_CSV_line < 255)
				{
					//writelineEx(gBAP_Trace, 0, "Element %x  Index %x", element, j);
					switch (element)
					{
						case 1: //Pos
								if( paramPos >= elCount(temp1) ){
									writelineEx(gBAP_Trace, 0, "Param%x in Zeile %d in der Input CSV Datei, enthaelt mehr Zeichen als erlaubt. Bearbeitung abgebrochen!", element, current_CSV_line);
									return; //False
								}else{
									temp1[paramPos] = buffer_byte[filePos];
									paramPos++;
								}
							break;
						case 2: //CommandID
								if( paramPos >= elCount(temp2) ){
									writelineEx(gBAP_Trace, 0, "Param%x in Zeile %d in der Input CSV Datei, enthaelt mehr Zeichen als erlaubt. Bearbeitung abgebrochen!", element, current_CSV_line);
									return; //False
								}else{
									temp2[paramPos] = buffer_byte[filePos];
									paramPos++;
								}
							break;
						case 3: //CommandText
								if(paramPos < 60)
								{
									A_ASG_70_1_0_18_ArrayDataList[current_CSV_line-1].Param3[paramPos] = buffer_byte[filePos];
									A_ASG_70_1_0_18_ArrayDataList[current_CSV_line-1].Param3_Length = paramPos +1;
								}
								paramPos++;
						break;
						case 4: //Extension
								if(paramPos < 1)
								{
									A_ASG_70_1_0_18_ArrayDataList[current_CSV_line-1].Param4[paramPos] = buffer_byte[filePos];
									A_ASG_70_1_0_18_ArrayDataList[current_CSV_line-1].Param4_Length = paramPos +1;
								}
								paramPos++;
						break;
						default:
						break;
					}
				}
			}
			else  // ";" is detected ->next record element of "array data"
			{
				//writelineEx(gBAP_Trace, 0, "naechstes Element %d Bytes",element);
				element++;
				paramPos=0; //reset value
			}
		}

		if(fileClose (CSVfileHandle) !=0) //close *.csv file
			writelineEx(gBAP_Trace, 0,"Datei '%s' geschlossen", CSV_filename); //output result
		else
			writelineEx(gBAP_Trace, 0,"Fehler beim Schliessen der Datei '%s'", CSV_filename);//output result
	}
	else //*.csv file access not successful
	{
		writelineEx(gBAP_Trace, 0,"Fehler beim Dateizugriff auf '%s'",CSV_filename); //output result
	}
}

on envVar A_ASG_70_1_0_18_loadArray_Btn
{
	char filePath[255];
	if (A_ASG_70_1_0_18_generateData_Btn_already_pressed == 0)
	{
		A_ASG_70_1_0_18_generateData_Btn_already_pressed = 1;
	}
	else
	{
		A_ASG_70_1_0_18_generateData_Btn_already_pressed = 0;
		getValue(A_ASG_70_1_0_18_fileSelector, filePath);
		if(0 == strlen(filePath))
		{
			writelineEx(gBAP_Trace, 0, "Invalid file path!");
		}
		else
		{
			A_ASG_70_1_0_18_LoadArray();
			writelineEx(gBAP_Trace, 0, "Load array from CSV file: %s", filePath);
		}
	}
	putValue(A_ASG_70_1_0_18_Data_1, A_ASG_70_1_0_18_ArrayDataList[ getValue( A_ASG_70_1_0_18_DataIndex) ].Param1);
	putValue(A_ASG_70_1_0_18_Data_2, A_ASG_70_1_0_18_ArrayDataList[ getValue( A_ASG_70_1_0_18_DataIndex) ].Param2);
	putValue(A_ASG_70_1_0_18_Data_3, A_ASG_70_1_0_18_ArrayDataList[ getValue( A_ASG_70_1_0_18_DataIndex) ].Param3, A_ASG_70_1_0_18_ArrayDataList[getValue(A_ASG_70_1_0_18_DataIndex)].Param3_Length);
	putValue(A_ASG_70_1_0_18_Data_4, A_ASG_70_1_0_18_ArrayDataList[ getValue( A_ASG_70_1_0_18_DataIndex) ].Param4, A_ASG_70_1_0_18_ArrayDataList[getValue(A_ASG_70_1_0_18_DataIndex)].Param4_Length);
}


on envVar A_ASG_70_1_0_18_generateData_Btn
{
	word i;
	dword elementsArray[6] = {1, 2, 61, 2, 2, 2};
	byte elementsTypeArray[6] = {0, 0, 0xE, 0xF, 0xE, 0xF};
	dword elementsMaxSizeArray[6] = {255, 65535, 0, 0, 0, 0};
	byte tempArray[17780];
	if (A_ASG_70_1_0_18_generateData_Btn_already_pressed == 0)
	{
		A_ASG_70_1_0_18_generateData_Btn_already_pressed = 1;
	}
	else
	{
		initStruct(tempArray, elementsArray, elementsTypeArray, elementsMaxSizeArray, 18, 254 );
		for(i = 0; i < 254; i++)
		{
			memcpy(A_ASG_70_1_0_18_ArrayDataList[i], tempArray, (i * 70) );
			if(A_ASG_70_1_0_18_ArrayDataList[i].Param3_Length > 127 )
				A_ASG_70_1_0_18_Data_3_CntList[i] = 1;
			if(A_ASG_70_1_0_18_ArrayDataList[i].Param4_Length > 127 )
				A_ASG_70_1_0_18_Data_4_CntList[i] = 1;
		}
		A_ASG_70_1_0_18_generateData_Btn_already_pressed = 0;
	}
	putValue(A_ASG_70_1_0_18_Data_1, A_ASG_70_1_0_18_ArrayDataList[ getValue( A_ASG_70_1_0_18_DataIndex) ].Param1);
	putValue(A_ASG_70_1_0_18_Data_2, A_ASG_70_1_0_18_ArrayDataList[ getValue( A_ASG_70_1_0_18_DataIndex) ].Param2);
	putValue(A_ASG_70_1_0_18_Data_3, A_ASG_70_1_0_18_ArrayDataList[ getValue( A_ASG_70_1_0_18_DataIndex) ].Param3, A_ASG_70_1_0_18_ArrayDataList[getValue(A_ASG_70_1_0_18_DataIndex)].Param3_Length);
	putValue(A_ASG_70_1_0_18_Data_4, A_ASG_70_1_0_18_ArrayDataList[ getValue( A_ASG_70_1_0_18_DataIndex) ].Param4, A_ASG_70_1_0_18_ArrayDataList[getValue(A_ASG_70_1_0_18_DataIndex)].Param4_Length);
}
// HME generateCaplOnEnv (3131)
on envVar A_ASG_70_1_0_18_DataIndex
{
    long index;
    long maxIndex = 254-1;
    index = getValue(this);
    if(index >= maxIndex) index = maxIndex;
    else if(index < 0) index = 0;
    putValue(this, index);
    putValue(A_ASG_70_1_0_18_Data_1, A_ASG_70_1_0_18_ArrayDataList[index].Param1);
    putValue(A_ASG_70_1_0_18_Data_2, A_ASG_70_1_0_18_ArrayDataList[index].Param2);
    putValue(A_ASG_70_1_0_18_Data_3_len, A_ASG_70_1_0_18_Data_3_LenList[index]);
    putValue(A_ASG_70_1_0_18_Data_3_cnt, A_ASG_70_1_0_18_Data_3_CntList[index]);
    putValue(A_ASG_70_1_0_18_Data_3, A_ASG_70_1_0_18_ArrayDataList[index].Param3, A_ASG_70_1_0_18_ArrayDataList[index].Param3_Length);
    putValue(A_ASG_70_1_0_18_Data_4_len, A_ASG_70_1_0_18_Data_4_LenList[index]);
    putValue(A_ASG_70_1_0_18_Data_4_cnt, A_ASG_70_1_0_18_Data_4_CntList[index]);
    putValue(A_ASG_70_1_0_18_Data_4, A_ASG_70_1_0_18_ArrayDataList[index].Param4, A_ASG_70_1_0_18_ArrayDataList[index].Param4_Length);

}
on envVar A_ASG_70_1_0_18_DataIndex_Incr
{
    long index;
    if(A_ASG_70_1_0_18_DataIndex_Incr_already_pressed == 0)
    {
        A_ASG_70_1_0_18_DataIndex_Incr_already_pressed = 1;
    }
    else
    {
        index = getValue(A_ASG_70_1_0_18_DataIndex);
        index++;
        putValue(A_ASG_70_1_0_18_DataIndex, index);
        A_ASG_70_1_0_18_DataIndex_Incr_already_pressed = 0;
    }
}
on envVar A_ASG_70_1_0_18_DataIndex_Decr
{
    long index;
    if(A_ASG_70_1_0_18_DataIndex_Decr_already_pressed == 0)
    {
        A_ASG_70_1_0_18_DataIndex_Decr_already_pressed = 1;
    }
    else
    {
        index = getValue(A_ASG_70_1_0_18_DataIndex);
        index--;
        putValue(A_ASG_70_1_0_18_DataIndex, index);
        A_ASG_70_1_0_18_DataIndex_Decr_already_pressed = 0;
    }
}
// Man darf gleichzeitig nur Checkbox fuer SegmError oder IntertelegramError aktiviert werden
on envVar A_ASG_70_1_0_18_IntTlgEn
{
       if(getValue(this)) 
       {
           putValue(A_ASG_70_1_0_18_SegmEn,0);
           intertelegram_err(A_ASG_70_1_0_18_ID);
       }
       else
       {
           intertelegram_err_off(A_ASG_70_1_0_18_ID);
       }
}
// Man darf gleichzeitig nur Checkbox fuer SegmError oder IntertelegramError aktiviert werden
on envVar A_ASG_70_1_0_18_SegmEn
{
       if(getValue(this)) 
       {
           putValue(A_ASG_70_1_0_18_IntTlgEn,0);
           sequence_err(A_ASG_70_1_0_18_ID,getValueSize(A_ASG_70_1_0_18_SegmEn));
       }
       else
       {
              sequence_err_off(A_ASG_70_1_0_18_ID);
       }
}

// [XL] Ueberwachung der CheckBox fuer AT
on envVar A_ASG_70_1_0_18_AT
{
	if(getValue(this))
	{
		EnableControl(panel_name,"panel_A_ASG_70_1_0_18_Status",0);
	}
	else
	{
   	EnableControl(panel_name,"panel_A_ASG_70_1_0_18_Status",1);
 	}
}

A_ASG_70_1_0_18_DataInd()
{
    int currentPos;
    byte head[5];
    byte stringTempValue[269];
    int i;
    int j;
    int startVal;
    int elementsVal;
    byte recordAddressVal;
    byte transmitPosVal;
    long tempValue;
    long index;
    byte nibbleSetted;
    currentPos = 0;
    nibbleSetted = 0;
    //Einzelparameter: ASG_ID
    if(nibbleSetted == 1)
    {
        //voriger Parameter war ein Nibble, => second nibble, Pos incr und Flag zuruecksetzen
        tempValue = (gBAP_Indication_data[currentPos++] &0xF);
        nibbleSetted = 0;
    }
    else
    {
        //first nibble, kein increment, Flag setzen
        tempValue = ((gBAP_Indication_data[currentPos]>>4) &0xF);
        nibbleSetted = 1;
    }
    putValue(A_ASG_70_1_0_18_1, tempValue);
    //Einzelparameter: TAID
    if(nibbleSetted == 1)
    {
        //voriger Parameter war ein Nibble, => second nibble, Pos incr und Flag zuruecksetzen
        tempValue = (gBAP_Indication_data[currentPos++] &0xF);
        nibbleSetted = 0;
    }
    else
    {
        //first nibble, kein increment, Flag setzen
        tempValue = ((gBAP_Indication_data[currentPos]>>4) &0xF);
        nibbleSetted = 1;
    }
    putValue(A_ASG_70_1_0_18_2, tempValue);
    //Einzelparameter: TotalNumListElements
    //voriger Parameter war ein first nibble, bei 1 Byte Werten Position incr
    if(nibbleSetted == 1) currentPos++;
    nibbleSetted = 0;
    tempValue = gBAP_Indication_data[currentPos++];
    putValue(A_ASG_70_1_0_18_3, tempValue);
    //head Parameter
    if(gBAP_Indication_header[4] >= (3+currentPos))
    {
        if( (gBAP_Indication_data[currentPos] & 0x80) > 0)
            if(gBAP_Indication_header[4] >= (5+currentPos))
            {
                for(i = 0; i < 5; i++) head[i] = gBAP_Indication_data[currentPos++];
                putValue(A_ASG_70_1_0_18, head, 5);
                startVal = (head[2]<<8) | head[1];
                elementsVal = (head[4]<<8) | head[3];
            }
            else write("received Data Error");
        else
        {
            for(i = 0; i < 3; i++) head[i] = gBAP_Indication_data[currentPos++];
            putValue(A_ASG_70_1_0_18, head, 3);
                startVal = head[1];
                elementsVal = head[2];
        }
        recordAddressVal = head[0] & 0x0F;
        transmitPosVal = head[0] & 0x40;
    }
    //data Parameter
     nibbleSetted = 0;
    if( (head[0] & 0x20) == 0) { // array header: increasing indices (Direction = 0).
      if( (head[0] & 0x10) > 0) { // array header: first element is one after specified start element (Shift = 1, Direction = 0).
        startVal++;
      }
      for ( i = startVal ; i < startVal + elementsVal ; i++) {
        if ( i < 0 || i >= A_ASG_70_1_0_18_ArrayDataList_Length ) {
          write("Array index ausserhalb der Grenzen, Fct: 18");
          break;
        }
        if(nibbleSetted == 1) currentPos++;
        nibbleSetted = 0;
     if( (head[0]&0x40) == 0){ /* Transmit_Pos = 0, keine Positionsdaten */ }
     else
     {
        if( (head[0]&0x80) == 0)
        {
           //IndexSize = 0, Pos als 1 Byte Wert
           A_ASG_70_1_0_18_ArrayDataList[i].Param1 = gBAP_Indication_data[currentPos++];
        }
        else
        {
           //IndexSize = 1, Pos als 2 Byte Wert
           A_ASG_70_1_0_18_ArrayDataList[i].Param1 = ( gBAP_Indication_data[currentPos++] &0xFF) + ((gBAP_Indication_data[currentPos++] &0xFF)<<8);
        }
     }
      // 0 - es kann vorkommen, dass das if leer ist dies wuerde zum Fehler fuehren. => automatische generierung der 0
      if( 0 || 1 == recordAddressVal || 2 == recordAddressVal )
      {
        //Sollte vor einem 2 Byte Wert 1 Nibble kommen, muss der index um 1 incrementiert werden!
        if( nibbleSetted==1) currentPos++;
        nibbleSetted = 0;
        A_ASG_70_1_0_18_ArrayDataList[i].Param2 = (gBAP_Indication_data[currentPos++] & 0xFF) + ((gBAP_Indication_data[currentPos++] & 0xFF) <<8);
      }
      // 0 - es kann vorkommen, dass das if leer ist dies wuerde zum Fehler fuehren. => automatische generierung der 0
      if( 0 || 1 == recordAddressVal || 3 == recordAddressVal )
      {
        //Sollte vor einem String Wert 1 Nibble kommen, muss der index um 1 incrementiert werden!
        if( nibbleSetted==1) currentPos++;
        nibbleSetted = 0;
        if((gBAP_Indication_data[currentPos] & 0x80) >= 1)
        {
        	 A_ASG_70_1_0_18_Data_3_CntList[i] = 1;
            A_ASG_70_1_0_18_ArrayDataList[i].Param3_Length = ( (gBAP_Indication_data[currentPos++] & 0x7F) << 8) + (gBAP_Indication_data[currentPos++] & 0xFF);
        }
        else
        {
        	 A_ASG_70_1_0_18_Data_3_CntList[i] = 0;
            A_ASG_70_1_0_18_ArrayDataList[i].Param3_Length = gBAP_Indication_data[currentPos++] & 0x7F;
        }
        for(j = 0; j < A_ASG_70_1_0_18_ArrayDataList[i].Param3_Length; j++)
        {
            A_ASG_70_1_0_18_ArrayDataList[i].Param3[j] = gBAP_Indication_data[currentPos++];
        }
      }
      // 0 - es kann vorkommen, dass das if leer ist dies wuerde zum Fehler fuehren. => automatische generierung der 0
      if( 0 )
      {
        //Sollte vor einem String Wert 1 Nibble kommen, muss der index um 1 incrementiert werden!
        if( nibbleSetted==1) currentPos++;
        nibbleSetted = 0;
        if((gBAP_Indication_data[currentPos] & 0x80) >= 1)
        {
        	 A_ASG_70_1_0_18_Data_4_CntList[i] = 1;
            A_ASG_70_1_0_18_ArrayDataList[i].Param4_Length = ( (gBAP_Indication_data[currentPos++] & 0x7F) << 8) + (gBAP_Indication_data[currentPos++] & 0xFF);
        }
        else
        {
        	 A_ASG_70_1_0_18_Data_4_CntList[i] = 0;
            A_ASG_70_1_0_18_ArrayDataList[i].Param4_Length = gBAP_Indication_data[currentPos++] & 0x7F;
        }
        for(j = 0; j < A_ASG_70_1_0_18_ArrayDataList[i].Param4_Length; j++)
        {
            A_ASG_70_1_0_18_ArrayDataList[i].Param4[j] = gBAP_Indication_data[currentPos++];
        }
      }
      } // for
    } else { // array header: decreasing indices (Direction = 1).
      if( (head[0] & 0x10) > 0) { // array header: first element is one before specified start element (Shift = 1, Direction = 1).
        if(startVal != 0) {          startVal--;
        } else {
          startVal = A_ASG_70_1_0_18_ArrayDataList_Length -1;
        }
      }
      for ( i = startVal ; i > startVal - elementsVal ; i--) {
        if ( i < 0 || i >= A_ASG_70_1_0_18_ArrayDataList_Length ) {
          write("Array index ausserhalb der Grenzen, Fct: 18");
          break;
        }
        if(nibbleSetted == 1) currentPos++;
        nibbleSetted = 0;
     if( (head[0]&0x40) == 0){ /* Transmit_Pos = 0, keine Positionsdaten */ }
     else
     {
        if( (head[0]&0x80) == 0)
        {
           //IndexSize = 0, Pos als 1 Byte Wert
           A_ASG_70_1_0_18_ArrayDataList[i].Param1 = gBAP_Indication_data[currentPos++];
        }
        else
        {
           //IndexSize = 1, Pos als 2 Byte Wert
           A_ASG_70_1_0_18_ArrayDataList[i].Param1 = ( gBAP_Indication_data[currentPos++] &0xFF) + ((gBAP_Indication_data[currentPos++] &0xFF)<<8);
        }
     }
      // 0 - es kann vorkommen, dass das if leer ist dies wuerde zum Fehler fuehren. => automatische generierung der 0
      if( 0 || 1 == recordAddressVal || 2 == recordAddressVal )
      {
        //Sollte vor einem 2 Byte Wert 1 Nibble kommen, muss der index um 1 incrementiert werden!
        if( nibbleSetted==1) currentPos++;
        nibbleSetted = 0;
        A_ASG_70_1_0_18_ArrayDataList[i].Param2 = (gBAP_Indication_data[currentPos++] & 0xFF) + ((gBAP_Indication_data[currentPos++] & 0xFF) <<8);
      }
      // 0 - es kann vorkommen, dass das if leer ist dies wuerde zum Fehler fuehren. => automatische generierung der 0
      if( 0 || 1 == recordAddressVal || 3 == recordAddressVal )
      {
        //Sollte vor einem String Wert 1 Nibble kommen, muss der index um 1 incrementiert werden!
        if( nibbleSetted==1) currentPos++;
        nibbleSetted = 0;
        if((gBAP_Indication_data[currentPos] & 0x80) >= 1)
        {
        	 A_ASG_70_1_0_18_Data_3_CntList[i] = 1;
            A_ASG_70_1_0_18_ArrayDataList[i].Param3_Length = ( (gBAP_Indication_data[currentPos++] & 0x7F) << 8) + (gBAP_Indication_data[currentPos++] & 0xFF);
        }
        else
        {
        	 A_ASG_70_1_0_18_Data_3_CntList[i] = 0;
            A_ASG_70_1_0_18_ArrayDataList[i].Param3_Length = gBAP_Indication_data[currentPos++] & 0x7F;
        }
        for(j = 0; j < A_ASG_70_1_0_18_ArrayDataList[i].Param3_Length; j++)
        {
            A_ASG_70_1_0_18_ArrayDataList[i].Param3[j] = gBAP_Indication_data[currentPos++];
        }
      }
      // 0 - es kann vorkommen, dass das if leer ist dies wuerde zum Fehler fuehren. => automatische generierung der 0
      if( 0 )
      {
        //Sollte vor einem String Wert 1 Nibble kommen, muss der index um 1 incrementiert werden!
        if( nibbleSetted==1) currentPos++;
        nibbleSetted = 0;
        if((gBAP_Indication_data[currentPos] & 0x80) >= 1)
        {
        	 A_ASG_70_1_0_18_Data_4_CntList[i] = 1;
            A_ASG_70_1_0_18_ArrayDataList[i].Param4_Length = ( (gBAP_Indication_data[currentPos++] & 0x7F) << 8) + (gBAP_Indication_data[currentPos++] & 0xFF);
        }
        else
        {
        	 A_ASG_70_1_0_18_Data_4_CntList[i] = 0;
            A_ASG_70_1_0_18_ArrayDataList[i].Param4_Length = gBAP_Indication_data[currentPos++] & 0x7F;
        }
        for(j = 0; j < A_ASG_70_1_0_18_ArrayDataList[i].Param4_Length; j++)
        {
            A_ASG_70_1_0_18_ArrayDataList[i].Param4[j] = gBAP_Indication_data[currentPos++];
        }
      }
      } // for
    }
    nibbleSetted = 0;
index = getValue(A_ASG_70_1_0_18_DataIndex);
    putValue(A_ASG_70_1_0_18_Data_1, A_ASG_70_1_0_18_ArrayDataList[index].Param1);
    putValue(A_ASG_70_1_0_18_Data_2, A_ASG_70_1_0_18_ArrayDataList[index].Param2);
    putValue(A_ASG_70_1_0_18_Data_3_len, A_ASG_70_1_0_18_Data_3_LenList[index]);
    putValue(A_ASG_70_1_0_18_Data_3_cnt, A_ASG_70_1_0_18_Data_3_CntList[index]);
    putValue(A_ASG_70_1_0_18_Data_3, A_ASG_70_1_0_18_ArrayDataList[index].Param3, A_ASG_70_1_0_18_ArrayDataList[index].Param3_Length);
    putValue(A_ASG_70_1_0_18_Data_4_len, A_ASG_70_1_0_18_Data_4_LenList[index]);
    putValue(A_ASG_70_1_0_18_Data_4_cnt, A_ASG_70_1_0_18_Data_4_CntList[index]);
    putValue(A_ASG_70_1_0_18_Data_4, A_ASG_70_1_0_18_ArrayDataList[index].Param4, A_ASG_70_1_0_18_ArrayDataList[index].Param4_Length);
}

A_ASG_70_1_0_18_ChangedInd()
{
    int currentPos;
    byte head[5];
    byte stringTempValue[269];
    int i;
    int j;
    int startVal;
    int elementsVal;
    byte recordAddressVal;
    byte transmitPosVal;
    long tempValue;
    long index;
    byte nibbleSetted;
    currentPos = 0;
    nibbleSetted = 0;
    //head Parameter
    if(gBAP_Indication_header[4] >= (3+currentPos))
    {
        if( (gBAP_Indication_data[currentPos] & 0x80) > 0)
            if(gBAP_Indication_header[4] >= (5+currentPos))
            {
                for(i = 0; i < 5; i++) head[i] = gBAP_Indication_data[currentPos++];
                putValue(A_ASG_70_1_0_18_Changed, head, 5);
                startVal = (head[2]<<8) | head[1];
                elementsVal = (head[4]<<8) | head[3];
            }
            else write("received Data Error");
        else
        {
            for(i = 0; i < 3; i++) head[i] = gBAP_Indication_data[currentPos++];
            putValue(A_ASG_70_1_0_18_Changed, head, 3);
                startVal = head[1];
                elementsVal = head[2];
        }
        recordAddressVal = head[0] & 0x0F;
        transmitPosVal = head[0] & 0x40;
    }
    //data Parameter
     nibbleSetted = 0;
    if( (head[0] & 0x20) == 0) { // array header: increasing indices (Direction = 0).
      if( (head[0] & 0x10) > 0) { // array header: first element is one after specified start element (Shift = 1, Direction = 0).
        startVal++;
      }
      for ( i = startVal ; i < startVal + elementsVal ; i++) {
        if ( i < 0 || i >= A_ASG_70_1_0_18_ArrayDataList_Length ) {
          write("Array index ausserhalb der Grenzen, Fct: 18");
          break;
        }
        if(nibbleSetted == 1) currentPos++;
        nibbleSetted = 0;
      } // for
    } else { // array header: decreasing indices (Direction = 1).
      if( (head[0] & 0x10) > 0) { // array header: first element is one before specified start element (Shift = 1, Direction = 1).
        if(startVal != 0) {          startVal--;
        } else {
          startVal = A_ASG_70_1_0_18_ArrayDataList_Length -1;
        }
      }
      for ( i = startVal ; i > startVal - elementsVal ; i--) {
        if ( i < 0 || i >= A_ASG_70_1_0_18_ArrayDataList_Length ) {
          write("Array index ausserhalb der Grenzen, Fct: 18");
          break;
        }
        if(nibbleSetted == 1) currentPos++;
        nibbleSetted = 0;
      } // for
    }
    nibbleSetted = 0;
index = getValue(A_ASG_70_1_0_18_DataIndex);
}




on envVar A_ASG_70_1_0_18_1
{
	byte superval[269];

	//Update Childvalue (Enum)
	byte thisval; // ASG_ID
	thisval = 0x0f & getValue(this);
}
// Ueberwachung der Darstellungsvariable der Range.
on envVar A_ASG_70_1_0_18_2_range // CommandList.TAID 
{
	@A_ASG_70_1_0_18_2 = @A_ASG_70_1_0_18_2_range - (0); // slider = range - min
}

on envVar A_ASG_70_1_0_18_2
{
	byte superval[269];

	//Update Childvalue (Number)
	byte thisval; // TAID
	float slider_value;

	slider_value = round(@A_ASG_70_1_0_18_2, 1.0);
	@A_ASG_70_1_0_18_2_range = slider_value + (0); // real value := slider value + range min.
	thisval = (byte)round((slider_value + (0) - (0)) / (1.0), 1); // bus value := (slider value + min - offset) / step.
}
// Ueberwachung der Darstellungsvariable der Range.
on envVar A_ASG_70_1_0_18_3_range // CommandList.TotalNumListElements 
{
	@A_ASG_70_1_0_18_3 = @A_ASG_70_1_0_18_3_range - (0); // slider = range - min
}

on envVar A_ASG_70_1_0_18_3
{
	byte superval[269];

	//Update Childvalue (Number)
	byte thisval; // TotalNumListElements
	float slider_value;

	slider_value = round(@A_ASG_70_1_0_18_3, 1.0);
	@A_ASG_70_1_0_18_3_range = slider_value + (0); // real value := slider value + range min.
	thisval = (byte)round((slider_value + (0) - (0)) / (1.0), 1); // bus value := (slider value + min - offset) / step.
}
// Ueberwachung der Darstellungsvariable der Range.
on envVar A_ASG_70_1_0_18_Data_1_range // CommandList.Pos 
{
	@A_ASG_70_1_0_18_Data_1 = @A_ASG_70_1_0_18_Data_1_range - (0); // slider = range - min
}

on envVar A_ASG_70_1_0_18_Data_1
{
	byte superval[269];

	//Update Childvalue (Number)
	byte thisval; // Pos
	float slider_value;

	slider_value = round(@A_ASG_70_1_0_18_Data_1, 1.0);
	@A_ASG_70_1_0_18_Data_1_range = slider_value + (0); // real value := slider value + range min.
	thisval = (byte)round((slider_value + (0) - (0)) / (1.0), 1); // bus value := (slider value + min - offset) / step.
    A_ASG_70_1_0_18_ArrayDataList[getValue(A_ASG_70_1_0_18_DataIndex)].Param1 = thisval;
}
// Ueberwachung der Darstellungsvariable der Range.
on envVar A_ASG_70_1_0_18_Data_2_range // CommandList.CommandID 
{
	@A_ASG_70_1_0_18_Data_2 = @A_ASG_70_1_0_18_Data_2_range - (0); // slider = range - min
}

on envVar A_ASG_70_1_0_18_Data_2
{
	byte superval[269];

	//Update Childvalue (Number)
	word thisval; // CommandID
	float slider_value;

	slider_value = round(@A_ASG_70_1_0_18_Data_2, 1.0);
	@A_ASG_70_1_0_18_Data_2_range = slider_value + (0); // real value := slider value + range min.
	thisval = (word)round((slider_value + (0) - (0)) / (1.0), 1); // bus value := (slider value + min - offset) / step.
    A_ASG_70_1_0_18_ArrayDataList[getValue(A_ASG_70_1_0_18_DataIndex)].Param2 = thisval;
}

// Ueberwachung der CheckBox fuer String
on envVar  A_ASG_70_1_0_18_Data_3_cnt
{
	word len;
	byte cnt;
	len = getValue(A_ASG_70_1_0_18_Data_3_len);
	cnt = getValue(this);

    /* Cnt Wert im Array aktualisieren */
	 A_ASG_70_1_0_18_Data_3_CntList[ getValue(A_ASG_70_1_0_18_DataIndex) ] = cnt;

	/* wird nur gerufen, wenn check box deaktiviert mit Length>127*/ 
	if(cnt == 0) 
	{
		if(len > 127 )
		{
			putValue(A_ASG_70_1_0_18_Data_3_len, 127);
		}
	}

}


on envVar A_ASG_70_1_0_18_Data_3_len
{
	long thisval;
	byte cnt;
	thisval = getValue(this);
	cnt = getValue(A_ASG_70_1_0_18_Data_3_cnt);

	/* wenn die Laenge ausserhalb des erlaubten Bereich liegt, wird diese begrenzt */
	if(thisval > 60 || thisval < 0 )
	{
		writelineEx(gBAP_Trace, 0, "Eingegebene Laenge: %d von A_ASG_70_1_0_18_Data_3 ist ungueltig. Die max. erlaubte Laenge ist %d. ", thisval, 60);
		thisval = 60;
	}
	if( thisval >127)
	{
		putValue(A_ASG_70_1_0_18_Data_3_cnt, 1); /* Switch checkbox on */
	}

	A_ASG_70_1_0_18_ArrayDataList[getValue(A_ASG_70_1_0_18_DataIndex)].Param3_Length = thisval;
	A_ASG_70_1_0_18_Data_3_LenList[ getValue(A_ASG_70_1_0_18_DataIndex) ] = thisval;
	putValue(A_ASG_70_1_0_18_Data_3_len, thisval);

}

on envVar A_ASG_70_1_0_18_Data_3
{
	byte superval[269];

	//Update Childvalue (String)
	word i;
	byte thisval[61];
	getValue(this, thisval);
    for(i = 0; i < getValueSize(this); i++)
        A_ASG_70_1_0_18_ArrayDataList[getValue(A_ASG_70_1_0_18_DataIndex)].Param3[i] = thisval[i];
    A_ASG_70_1_0_18_ArrayDataList[getValue(A_ASG_70_1_0_18_DataIndex)].Param3_Length = getValueSize(this);
    A_ASG_70_1_0_18_Data_3_LenList[getValue(A_ASG_70_1_0_18_DataIndex)]= getValueSize(this);
    putValue(A_ASG_70_1_0_18_Data_3_len, getValueSize(this));
}

// Ueberwachung der CheckBox fuer String
on envVar  A_ASG_70_1_0_18_Data_4_cnt
{
	word len;
	byte cnt;
	len = getValue(A_ASG_70_1_0_18_Data_4_len);
	cnt = getValue(this);

    /* Cnt Wert im Array aktualisieren */
	 A_ASG_70_1_0_18_Data_4_CntList[ getValue(A_ASG_70_1_0_18_DataIndex) ] = cnt;

	/* wird nur gerufen, wenn check box deaktiviert mit Length>127*/ 
	if(cnt == 0) 
	{
		if(len > 127 )
		{
			putValue(A_ASG_70_1_0_18_Data_4_len, 127);
		}
	}

}


on envVar A_ASG_70_1_0_18_Data_4_len
{
	long thisval;
	byte cnt;
	thisval = getValue(this);
	cnt = getValue(A_ASG_70_1_0_18_Data_4_cnt);

	/* wenn die Laenge ausserhalb des erlaubten Bereich liegt, wird diese begrenzt */
	if(thisval > 1 || thisval < 0 )
	{
		writelineEx(gBAP_Trace, 0, "Eingegebene Laenge: %d von A_ASG_70_1_0_18_Data_4 ist ungueltig. Die max. erlaubte Laenge ist %d. ", thisval, 1);
		thisval = 1;
	}
	if( thisval >127)
	{
		putValue(A_ASG_70_1_0_18_Data_4_cnt, 1); /* Switch checkbox on */
	}

	A_ASG_70_1_0_18_ArrayDataList[getValue(A_ASG_70_1_0_18_DataIndex)].Param4_Length = thisval;
	A_ASG_70_1_0_18_Data_4_LenList[ getValue(A_ASG_70_1_0_18_DataIndex) ] = thisval;
	putValue(A_ASG_70_1_0_18_Data_4_len, thisval);

}

on envVar A_ASG_70_1_0_18_Data_4
{
	byte superval[269];

	//Update Childvalue (String)
	word i;
	byte thisval[2];
	getValue(this, thisval);
    for(i = 0; i < getValueSize(this); i++)
        A_ASG_70_1_0_18_ArrayDataList[getValue(A_ASG_70_1_0_18_DataIndex)].Param4[i] = thisval[i];
    A_ASG_70_1_0_18_ArrayDataList[getValue(A_ASG_70_1_0_18_DataIndex)].Param4_Length = getValueSize(this);
    A_ASG_70_1_0_18_Data_4_LenList[getValue(A_ASG_70_1_0_18_DataIndex)]= getValueSize(this);
    putValue(A_ASG_70_1_0_18_Data_4_len, getValueSize(this));
}
on envVar A_ASG_70_1_0_18_1_SetGet
{
	byte superval[4];

	//Update Childvalue (Enum)
	byte thisval; // ASG_ID
	thisval = 0x0f & getValue(this);
}
// Ueberwachung der Darstellungsvariable der Range.
on envVar A_ASG_70_1_0_18_2_SetGet_range // CommandList.TAID 
{
	@A_ASG_70_1_0_18_2_SetGet = @A_ASG_70_1_0_18_2_SetGet_range - (0); // slider = range - min
}

on envVar A_ASG_70_1_0_18_2_SetGet
{
	byte superval[4];

	//Update Childvalue (Number)
	byte thisval; // TAID
	float slider_value;

	slider_value = round(@A_ASG_70_1_0_18_2_SetGet, 1.0);
	@A_ASG_70_1_0_18_2_SetGet_range = slider_value + (0); // real value := slider value + range min.
	thisval = (byte)round((slider_value + (0) - (0)) / (1.0), 1); // bus value := (slider value + min - offset) / step.
}
on envVar A_ASG_70_1_0_19Get_BTN
{
  byte data[5]; 
  byte stringValue[5];
  byte head[5];
  int i;
  int headLength;
  long tempValue;
  word currentPos;
  word startVal;
  word elementsVal;
  byte nibbleSetted;
  if (A_ASG_70_1_0_19Get_BTN_already_pressed == 0)
  {
     putValue(A_ASG_70_1_0_19_ErrCode,0);
     SetControlBackColor(panel_name,"errField_A_ASG_70_1_0_19",MakeRGB(255,255,255));
     A_ASG_70_1_0_19Get_BTN_already_pressed = 1;
  }
  else
  {
        currentPos = 0;
        //Einzelparameter: ASG_ID
        tempValue = getValue(A_ASG_70_1_0_19_1_SetGet);
    if(nibbleSetted == 1)
    {
        //voriger Parameter war ein Nibble, => second nibble, Pos incr und Flag zuruecksetzen
        data[currentPos] = (tempValue &0x0F) | (data[currentPos] &0xF0);
        currentPos++;
        nibbleSetted = 0;
    }
    else
    {
        //first nibble, kein increment, Flag setzen
        data[currentPos] = (tempValue<<4) &0xF0;
        nibbleSetted = 1;
    }
        //Einzelparameter: TAID
        tempValue = getValue(A_ASG_70_1_0_19_2_SetGet);
    if(nibbleSetted == 1)
    {
        //voriger Parameter war ein Nibble, => second nibble, Pos incr und Flag zuruecksetzen
        data[currentPos] = (tempValue &0x0F) | (data[currentPos] &0xF0);
        currentPos++;
        nibbleSetted = 0;
    }
    else
    {
        //first nibble, kein increment, Flag setzen
        data[currentPos] = (tempValue<<4) &0xF0;
        nibbleSetted = 1;
    }
        //head Parameter
        headLength = getValueSize(A_ASG_70_1_0_19_SetGet);
        getValue(A_ASG_70_1_0_19_SetGet,head);
        for(i=0; i< headLength; i++)
        {
            data[currentPos++] = head[i];
        }

     Request_ByteSequence(LSGID, A_ASG_70_1_0_19_ID, DataGet_REQ, data, currentPos);
     if(getValue(A_ASG_70_1_0_19_IntTlgEn)) //getValue(IT))
     {
       intertelegram_err(A_ASG_70_1_0_19_ID);
     }
     if(getValue(A_ASG_70_1_0_19_SegmEn))   //getvalue(SG)
     {
         sequence_err(A_ASG_70_1_0_19_ID,getValueSize(A_ASG_70_1_0_19_SetGet));
     }
     A_ASG_70_1_0_19Get_BTN_already_pressed = 0;
  }
}
A_ASG_70_1_0_19_SetGet_GenerateSetGet()
{
    byte head[5];
    //Record Address in Byte 0 Bit 0-3 kopieren - MAX Wert = 0x0F
    if(getValue(A_ASG_70_1_0_19_SetGet_RecAdr) > 0x0F)
        putValue(A_ASG_70_1_0_19_SetGet_RecAdr , 0x0F);
    head[0] = (head[0] & 0xF0) | getValue(A_ASG_70_1_0_19_SetGet_RecAdr);
    //Shift Bit in Byte 0 Bit 4 kopieren
    if( getValue(A_ASG_70_1_0_19_SetGet_Shift) > 0) head[0] = head[0] | 0x10;
    else head[0] = head[0] & 0xEF;
    // Direction Bit in Byte 0 Bit 5 kopieren
    if( getValue(A_ASG_70_1_0_19_SetGet_Direction) > 0) head[0] = head[0] | 0x20;
    else head[0] = head[0] & 0xDF;
    // reserverd:  Byte 0 Bit 6
    if( getValue(A_ASG_70_1_0_19_SetGet_IndexSize) > 0)
    {
        // 5 Byte Header
        head[0] = head[0] | 0x80;
        head[1] =  getValue(A_ASG_70_1_0_19_SetGet_Start) & 0xFF;
        head[2] = (getValue(A_ASG_70_1_0_19_SetGet_Start) >> 8 ) & 0xFF;
        head[3] =  getValue(A_ASG_70_1_0_19_SetGet_Elements) & 0xFF;
        head[4] = (getValue(A_ASG_70_1_0_19_SetGet_Elements)  >> 8 ) & 0xFF;
        //ToDo: DATA - derzeit einfach laenge = 5
        putValue(A_ASG_70_1_0_19_SetGet, head, 5); 
    }
    else 
    {
        // 3 Byte Header
        head[0] = head[0] & 0x7F;
        head[1] = getValue(A_ASG_70_1_0_19_SetGet_Start) & 0xFF;
        head[2] = getValue(A_ASG_70_1_0_19_SetGet_Elements) & 0xFF;
        //ToDo: DATA - derzeit einfach laenge = 3
        putValue(A_ASG_70_1_0_19_SetGet, head, 3); 
    }
}

on envVar A_ASG_70_1_0_19_SetGet_RecAdr
{
    A_ASG_70_1_0_19_SetGet_GenerateSetGet();
}

on envVar A_ASG_70_1_0_19_SetGet_Shift
{
    A_ASG_70_1_0_19_SetGet_GenerateSetGet();
}

on envVar A_ASG_70_1_0_19_SetGet_Direction
{
    A_ASG_70_1_0_19_SetGet_GenerateSetGet();
}

on envVar A_ASG_70_1_0_19_SetGet_Start
{
    A_ASG_70_1_0_19_SetGet_GenerateSetGet();
}

on envVar A_ASG_70_1_0_19_SetGet_Elements
{
    A_ASG_70_1_0_19_SetGet_GenerateSetGet();
}

on envVar A_ASG_70_1_0_19_SetGet_IndexSize
{
    A_ASG_70_1_0_19_SetGet_GenerateSetGet();
}
on envVar A_ASG_70_1_0_19
{
    byte temp[5];
    byte head[5];
    getValue(A_ASG_70_1_0_19, head);
    putValue(A_ASG_70_1_0_19_RecAdr, 0x0F & head[0]); //Record Address = Bit 0-3 von Byte 0
    if ( (0x10 & head[0]) >0)
        putValue(A_ASG_70_1_0_19_Shift, 1); //Shift = Bit 4 von Byte 0
    else
        putValue(A_ASG_70_1_0_19_Shift, 0); //Shift = Bit 4 von Byte 0
    if ( (0x20 & head[0]) >0)
        putValue(A_ASG_70_1_0_19_Direction, 1); //Direction = Bit 5 von Byte 0
    else
        putValue(A_ASG_70_1_0_19_Direction, 0); //Direction = Bit 5 von Byte 0
    if ( (0x40 & head[0]) >0)
        putValue(A_ASG_70_1_0_19_TransPos, 1); //Transmission Pos = Bit 6 von Byte 0
    else
        putValue(A_ASG_70_1_0_19_TransPos, 0); //Transmission Pos = Bit 6 von Byte 0
    if ( (0x80 & head[0]) >0)
        putValue(A_ASG_70_1_0_19_IndexSize, 1); //IndexSize = Bit 7 von Byte 0
    else
        putValue(A_ASG_70_1_0_19_IndexSize, 0); //IndexSize = Bit 7 von Byte 0
    if(getValue(A_ASG_70_1_0_19_IndexSize))
    {
        putValue(A_ASG_70_1_0_19_Start, ((head[2]<<8)| head[1]) ); //Start Wert, 2 Byte lang
        putValue(A_ASG_70_1_0_19_Elements, ((head[4]<<8)| head[3]) ); //Elements Wert, 2 Byte lang
    }
    else
    {
        putValue(A_ASG_70_1_0_19_Start, head[1]); //Start Wert, 1 Byte lang
        putValue(A_ASG_70_1_0_19_Elements, head[2]); //Start Wert, 1 Byte lang
    }
}
on envVar A_ASG_70_1_0_19_Changed
{
    byte temp[180];
    getValue(A_ASG_70_1_0_19_Changed, temp);
    putValue(A_ASG_70_1_0_19_Changed_RecAdr, 0x0F & temp[0]); //Record Address = Bit 0-3 von Byte 0
    if ( (0x10 & temp[0]) >0)
        putValue(A_ASG_70_1_0_19_Changed_Shift, 1); //Shift = Bit 4 von Byte 0
    else
        putValue(A_ASG_70_1_0_19_Changed_Shift, 0); //Shift = Bit 4 von Byte 0
    if ( (0x20 & temp[0]) >0)
        putValue(A_ASG_70_1_0_19_Changed_Direction, 1); //Direction = Bit 5 von Byte 0
    else
        putValue(A_ASG_70_1_0_19_Changed_Direction, 0); //Direction = Bit 5 von Byte 0
    if ( (0x40 & temp[0]) >0)
        putValue(A_ASG_70_1_0_19_Changed_TransPos, 1); //Transmission Pos = Bit 6 von Byte 0
    else
        putValue(A_ASG_70_1_0_19_Changed_TransPos, 0); //Transmission Pos = Bit 6 von Byte 0
    if ( (0x80 & temp[0]) >0)
        putValue(A_ASG_70_1_0_19_Changed_IndexSize, 1); //IndexSize = Bit 7 von Byte 0
    else
        putValue(A_ASG_70_1_0_19_Changed_IndexSize, 0); //IndexSize = Bit 7 von Byte 0
    if(getValue(A_ASG_70_1_0_19_Changed_IndexSize))
    {
        putValue(A_ASG_70_1_0_19_Changed_Start, ((temp[2]<<8)| temp[1]) ); //Start Wert, 2 Byte lang
        putValue(A_ASG_70_1_0_19_Changed_Elements, ((temp[4]<<8)| temp[3]) ); //Elements Wert, 2 Byte lang
    }
    else
    {
        putValue(A_ASG_70_1_0_19_Changed_Start, temp[1]); //Start Wert, 1 Byte lang
        putValue(A_ASG_70_1_0_19_Changed_Elements, temp[2]); //Start Wert, 1 Byte lang
    }
}
on envVar A_ASG_70_1_0_19_SetGet
{
    byte temp[5];
    getValue(A_ASG_70_1_0_19_SetGet, temp);
    putValue(A_ASG_70_1_0_19_SetGet_RecAdr, 0x0F & temp[0]); //Record Address = Bit 0-3 von Byte 0
    if ( (0x10 & temp[0]) >0)
        putValue(A_ASG_70_1_0_19_SetGet_Shift, 1); //Shift = Bit 4 von Byte 0
    else
        putValue(A_ASG_70_1_0_19_SetGet_Shift, 0); //Shift = Bit 4 von Byte 0
    if ( (0x20 & temp[0]) >0)
        putValue(A_ASG_70_1_0_19_SetGet_Direction, 1); //Direction = Bit 5 von Byte 0
    else
        putValue(A_ASG_70_1_0_19_SetGet_Direction, 0); //Direction = Bit 5 von Byte 0
    // Bit 6 von Byte 0 = reserved
    if ( (0x80 & temp[0]) >0)
        putValue(A_ASG_70_1_0_19_SetGet_IndexSize, 1); //IndexSize = Bit 7 von Byte 0
    else
        putValue(A_ASG_70_1_0_19_SetGet_IndexSize, 0); //IndexSize = Bit 7 von Byte 0
    if(getValue(A_ASG_70_1_0_19_SetGet_IndexSize))
    {
        putValue(A_ASG_70_1_0_19_SetGet_Start, ((temp[2]<<8)| temp[1]) ); //Start Wert, 2 Byte lang
        putValue(A_ASG_70_1_0_19_SetGet_Elements, ((temp[4]<<8)| temp[3]) ); //Elements Wert, 2 Byte lang
    }
    else
    {
        putValue(A_ASG_70_1_0_19_SetGet_Start, temp[1]); //Start Wert, 1 Byte lang
        putValue(A_ASG_70_1_0_19_SetGet_Elements, temp[2]); //Start Wert, 1 Byte lang
    }
}
A_ASG_70_1_0_19_LoadArray()
{
	/********* Statische Deklarationen ***********/
	dword CSVfileHandle;
	dword filePos;
	dword paramPos;
	dword Num_of_csv_byte;
	dword element;
	dword current_CSV_line;
	byte buffer_byte[0xFFFF];
	dword i;
	dword j;
	char CSV_filename[255];

	/********* Param Puffer Deklarationen ***********/
	char temp1[25];
	char temp2[25];

	/********* Initialisierungen ***********/
	CSVfileHandle = 0;
	filePos = 0;
	paramPos = 0;
	Num_of_csv_byte = 0;
	element = 1;
	current_CSV_line = 0;
	for(i = 0; i < A_ASG_70_1_0_19_ArrayDataList_Length; i++)
	{ /* Initialisierung von den Ziel-Strukturen */
		A_ASG_70_1_0_19_ArrayDataList[i].Param1 = 0;
		A_ASG_70_1_0_19_ArrayDataList[i].Param2 = 0;
		for(j=0; j<171; j++)
			A_ASG_70_1_0_19_ArrayDataList[i].Param3[j] = 0;
		A_ASG_70_1_0_19_ArrayDataList[i].Param3_Length = 0;
		A_ASG_70_1_0_19_Data_3_LenList[i] = 0;
		for(j=0; j<2; j++)
			A_ASG_70_1_0_19_ArrayDataList[i].Param4[j] = 0;
		A_ASG_70_1_0_19_ArrayDataList[i].Param4_Length = 0;
		A_ASG_70_1_0_19_Data_4_LenList[i] = 0;
	}

	/********* Laden der CSV-Datei ***********/
	getValue(A_ASG_70_1_0_19_fileSelector, CSV_filename);
	CSVfileHandle = openFileRead(CSV_filename, 1); //open *.csv (binary-mode ->get the ASCII/UTF-8 code)

	if (CSVfileHandle!=0) //*.csv file access successful
	{
		writelineEx(gBAP_Trace, 0,"Dateizugriff auf '%s' erfolgreich", CSV_filename);    //output result
		//get data from *.csv and store the total number of byte in *.csv-file
		Num_of_csv_byte = fileGetBinaryBlock (buffer_byte, elcount(buffer_byte), CSVfileHandle);

		for (filePos = 0; filePos < Num_of_csv_byte; filePos++) //copy data into "LastDestList"
		{
			if (buffer_byte[filePos] != 0x3B) //read data if no ";" is detected
			{
				//nextline in *.csv (next "record element" in LastDestList) -> "LF" and "CR" detected -> copy (transform string -> long) data from help values in global values
				if(buffer_byte[filePos] == 0x0D && buffer_byte[filePos+1] == 0x0A)
				{
					if(current_CSV_line > 0 && current_CSV_line < 255) //ignore first line in *.csv file
					{
						A_ASG_70_1_0_19_ArrayDataList[current_CSV_line-1].Param1 = atol(temp1); //Pos
						A_ASG_70_1_0_19_ArrayDataList[current_CSV_line-1].Param2 = atol(temp2); //ResultType
						for(i = 0; i < 25; i++)
						{ /* Temp-Puffer Initialisierung zur Vermeidung von Nebeneffekte */
							temp1[i]=0;
							temp2[i]=0;
						}
					}
					current_CSV_line++; //next line in *.csv file
					element = 1; //start at 'POS' (first record element of "array data")
					paramPos = 0; //reset value
				}
 				//copy data from "buffer_byte" (data from *.csv file) in help values and "name" until end of line is not detected
				else if(current_CSV_line > 0 && current_CSV_line < 255)
				{
					//writelineEx(gBAP_Trace, 0, "Element %x  Index %x", element, j);
					switch (element)
					{
						case 1: //Pos
								if( paramPos >= elCount(temp1) ){
									writelineEx(gBAP_Trace, 0, "Param%x in Zeile %d in der Input CSV Datei, enthaelt mehr Zeichen als erlaubt. Bearbeitung abgebrochen!", element, current_CSV_line);
									return; //False
								}else{
									temp1[paramPos] = buffer_byte[filePos];
									paramPos++;
								}
							break;
						case 2: //ResultType
								if( paramPos >= elCount(temp2) ){
									writelineEx(gBAP_Trace, 0, "Param%x in Zeile %d in der Input CSV Datei, enthaelt mehr Zeichen als erlaubt. Bearbeitung abgebrochen!", element, current_CSV_line);
									return; //False
								}else{
									temp2[paramPos] = buffer_byte[filePos];
									paramPos++;
								}
							break;
						case 3: //ResultText
								if(paramPos < 169)
								{
									A_ASG_70_1_0_19_ArrayDataList[current_CSV_line-1].Param3[paramPos] = buffer_byte[filePos];
									A_ASG_70_1_0_19_ArrayDataList[current_CSV_line-1].Param3_Length = paramPos +1;
								}
								paramPos++;
						break;
						case 4: //Extension
								if(paramPos < 1)
								{
									A_ASG_70_1_0_19_ArrayDataList[current_CSV_line-1].Param4[paramPos] = buffer_byte[filePos];
									A_ASG_70_1_0_19_ArrayDataList[current_CSV_line-1].Param4_Length = paramPos +1;
								}
								paramPos++;
						break;
						default:
						break;
					}
				}
			}
			else  // ";" is detected ->next record element of "array data"
			{
				//writelineEx(gBAP_Trace, 0, "naechstes Element %d Bytes",element);
				element++;
				paramPos=0; //reset value
			}
		}

		if(fileClose (CSVfileHandle) !=0) //close *.csv file
			writelineEx(gBAP_Trace, 0,"Datei '%s' geschlossen", CSV_filename); //output result
		else
			writelineEx(gBAP_Trace, 0,"Fehler beim Schliessen der Datei '%s'", CSV_filename);//output result
	}
	else //*.csv file access not successful
	{
		writelineEx(gBAP_Trace, 0,"Fehler beim Dateizugriff auf '%s'",CSV_filename); //output result
	}
}

on envVar A_ASG_70_1_0_19_loadArray_Btn
{
	char filePath[255];
	if (A_ASG_70_1_0_19_generateData_Btn_already_pressed == 0)
	{
		A_ASG_70_1_0_19_generateData_Btn_already_pressed = 1;
	}
	else
	{
		A_ASG_70_1_0_19_generateData_Btn_already_pressed = 0;
		getValue(A_ASG_70_1_0_19_fileSelector, filePath);
		if(0 == strlen(filePath))
		{
			writelineEx(gBAP_Trace, 0, "Invalid file path!");
		}
		else
		{
			A_ASG_70_1_0_19_LoadArray();
			writelineEx(gBAP_Trace, 0, "Load array from CSV file: %s", filePath);
		}
	}
	putValue(A_ASG_70_1_0_19_Data_1, A_ASG_70_1_0_19_ArrayDataList[ getValue( A_ASG_70_1_0_19_DataIndex) ].Param1);
	putValue(A_ASG_70_1_0_19_Data_2, A_ASG_70_1_0_19_ArrayDataList[ getValue( A_ASG_70_1_0_19_DataIndex) ].Param2);
	putValue(A_ASG_70_1_0_19_Data_3, A_ASG_70_1_0_19_ArrayDataList[ getValue( A_ASG_70_1_0_19_DataIndex) ].Param3, A_ASG_70_1_0_19_ArrayDataList[getValue(A_ASG_70_1_0_19_DataIndex)].Param3_Length);
	putValue(A_ASG_70_1_0_19_Data_4, A_ASG_70_1_0_19_ArrayDataList[ getValue( A_ASG_70_1_0_19_DataIndex) ].Param4, A_ASG_70_1_0_19_ArrayDataList[getValue(A_ASG_70_1_0_19_DataIndex)].Param4_Length);
}


on envVar A_ASG_70_1_0_19_generateData_Btn
{
	word i;
	dword elementsArray[6] = {1, 1, 171, 2, 2, 2};
	byte elementsTypeArray[6] = {0, 0, 0xE, 0xF, 0xE, 0xF};
	dword elementsMaxSizeArray[6] = {255, 0xFF, 0, 0, 0, 0};
	byte tempArray[45466];
	if (A_ASG_70_1_0_19_generateData_Btn_already_pressed == 0)
	{
		A_ASG_70_1_0_19_generateData_Btn_already_pressed = 1;
	}
	else
	{
		initStruct(tempArray, elementsArray, elementsTypeArray, elementsMaxSizeArray, 19, 254 );
		for(i = 0; i < 254; i++)
		{
			memcpy(A_ASG_70_1_0_19_ArrayDataList[i], tempArray, (i * 179) );
			if(A_ASG_70_1_0_19_ArrayDataList[i].Param3_Length > 127 )
				A_ASG_70_1_0_19_Data_3_CntList[i] = 1;
			if(A_ASG_70_1_0_19_ArrayDataList[i].Param4_Length > 127 )
				A_ASG_70_1_0_19_Data_4_CntList[i] = 1;
		}
		A_ASG_70_1_0_19_generateData_Btn_already_pressed = 0;
	}
	putValue(A_ASG_70_1_0_19_Data_1, A_ASG_70_1_0_19_ArrayDataList[ getValue( A_ASG_70_1_0_19_DataIndex) ].Param1);
	putValue(A_ASG_70_1_0_19_Data_2, A_ASG_70_1_0_19_ArrayDataList[ getValue( A_ASG_70_1_0_19_DataIndex) ].Param2);
	putValue(A_ASG_70_1_0_19_Data_3, A_ASG_70_1_0_19_ArrayDataList[ getValue( A_ASG_70_1_0_19_DataIndex) ].Param3, A_ASG_70_1_0_19_ArrayDataList[getValue(A_ASG_70_1_0_19_DataIndex)].Param3_Length);
	putValue(A_ASG_70_1_0_19_Data_4, A_ASG_70_1_0_19_ArrayDataList[ getValue( A_ASG_70_1_0_19_DataIndex) ].Param4, A_ASG_70_1_0_19_ArrayDataList[getValue(A_ASG_70_1_0_19_DataIndex)].Param4_Length);
}
// HME generateCaplOnEnv (3131)
on envVar A_ASG_70_1_0_19_DataIndex
{
    long index;
    long maxIndex = 254-1;
    index = getValue(this);
    if(index >= maxIndex) index = maxIndex;
    else if(index < 0) index = 0;
    putValue(this, index);
    putValue(A_ASG_70_1_0_19_Data_1, A_ASG_70_1_0_19_ArrayDataList[index].Param1);
    putValue(A_ASG_70_1_0_19_Data_2, A_ASG_70_1_0_19_ArrayDataList[index].Param2);
    putValue(A_ASG_70_1_0_19_Data_3_len, A_ASG_70_1_0_19_Data_3_LenList[index]);
    putValue(A_ASG_70_1_0_19_Data_3_cnt, A_ASG_70_1_0_19_Data_3_CntList[index]);
    putValue(A_ASG_70_1_0_19_Data_3, A_ASG_70_1_0_19_ArrayDataList[index].Param3, A_ASG_70_1_0_19_ArrayDataList[index].Param3_Length);
    putValue(A_ASG_70_1_0_19_Data_4_len, A_ASG_70_1_0_19_Data_4_LenList[index]);
    putValue(A_ASG_70_1_0_19_Data_4_cnt, A_ASG_70_1_0_19_Data_4_CntList[index]);
    putValue(A_ASG_70_1_0_19_Data_4, A_ASG_70_1_0_19_ArrayDataList[index].Param4, A_ASG_70_1_0_19_ArrayDataList[index].Param4_Length);

}
on envVar A_ASG_70_1_0_19_DataIndex_Incr
{
    long index;
    if(A_ASG_70_1_0_19_DataIndex_Incr_already_pressed == 0)
    {
        A_ASG_70_1_0_19_DataIndex_Incr_already_pressed = 1;
    }
    else
    {
        index = getValue(A_ASG_70_1_0_19_DataIndex);
        index++;
        putValue(A_ASG_70_1_0_19_DataIndex, index);
        A_ASG_70_1_0_19_DataIndex_Incr_already_pressed = 0;
    }
}
on envVar A_ASG_70_1_0_19_DataIndex_Decr
{
    long index;
    if(A_ASG_70_1_0_19_DataIndex_Decr_already_pressed == 0)
    {
        A_ASG_70_1_0_19_DataIndex_Decr_already_pressed = 1;
    }
    else
    {
        index = getValue(A_ASG_70_1_0_19_DataIndex);
        index--;
        putValue(A_ASG_70_1_0_19_DataIndex, index);
        A_ASG_70_1_0_19_DataIndex_Decr_already_pressed = 0;
    }
}
// Man darf gleichzeitig nur Checkbox fuer SegmError oder IntertelegramError aktiviert werden
on envVar A_ASG_70_1_0_19_IntTlgEn
{
       if(getValue(this)) 
       {
           putValue(A_ASG_70_1_0_19_SegmEn,0);
           intertelegram_err(A_ASG_70_1_0_19_ID);
       }
       else
       {
           intertelegram_err_off(A_ASG_70_1_0_19_ID);
       }
}
// Man darf gleichzeitig nur Checkbox fuer SegmError oder IntertelegramError aktiviert werden
on envVar A_ASG_70_1_0_19_SegmEn
{
       if(getValue(this)) 
       {
           putValue(A_ASG_70_1_0_19_IntTlgEn,0);
           sequence_err(A_ASG_70_1_0_19_ID,getValueSize(A_ASG_70_1_0_19_SegmEn));
       }
       else
       {
              sequence_err_off(A_ASG_70_1_0_19_ID);
       }
}

// [XL] Ueberwachung der CheckBox fuer AT
on envVar A_ASG_70_1_0_19_AT
{
	if(getValue(this))
	{
		EnableControl(panel_name,"panel_A_ASG_70_1_0_19_Status",0);
	}
	else
	{
   	EnableControl(panel_name,"panel_A_ASG_70_1_0_19_Status",1);
 	}
}

A_ASG_70_1_0_19_DataInd()
{
    int currentPos;
    byte head[5];
    byte stringTempValue[180];
    int i;
    int j;
    int startVal;
    int elementsVal;
    byte recordAddressVal;
    byte transmitPosVal;
    long tempValue;
    long index;
    byte nibbleSetted;
    currentPos = 0;
    nibbleSetted = 0;
    //Einzelparameter: ASG_ID
    if(nibbleSetted == 1)
    {
        //voriger Parameter war ein Nibble, => second nibble, Pos incr und Flag zuruecksetzen
        tempValue = (gBAP_Indication_data[currentPos++] &0xF);
        nibbleSetted = 0;
    }
    else
    {
        //first nibble, kein increment, Flag setzen
        tempValue = ((gBAP_Indication_data[currentPos]>>4) &0xF);
        nibbleSetted = 1;
    }
    putValue(A_ASG_70_1_0_19_1, tempValue);
    //Einzelparameter: TAID
    if(nibbleSetted == 1)
    {
        //voriger Parameter war ein Nibble, => second nibble, Pos incr und Flag zuruecksetzen
        tempValue = (gBAP_Indication_data[currentPos++] &0xF);
        nibbleSetted = 0;
    }
    else
    {
        //first nibble, kein increment, Flag setzen
        tempValue = ((gBAP_Indication_data[currentPos]>>4) &0xF);
        nibbleSetted = 1;
    }
    putValue(A_ASG_70_1_0_19_2, tempValue);
    //Einzelparameter: TotalNumListElements
    //voriger Parameter war ein first nibble, bei 1 Byte Werten Position incr
    if(nibbleSetted == 1) currentPos++;
    nibbleSetted = 0;
    tempValue = gBAP_Indication_data[currentPos++];
    putValue(A_ASG_70_1_0_19_3, tempValue);
    //head Parameter
    if(gBAP_Indication_header[4] >= (3+currentPos))
    {
        if( (gBAP_Indication_data[currentPos] & 0x80) > 0)
            if(gBAP_Indication_header[4] >= (5+currentPos))
            {
                for(i = 0; i < 5; i++) head[i] = gBAP_Indication_data[currentPos++];
                putValue(A_ASG_70_1_0_19, head, 5);
                startVal = (head[2]<<8) | head[1];
                elementsVal = (head[4]<<8) | head[3];
            }
            else write("received Data Error");
        else
        {
            for(i = 0; i < 3; i++) head[i] = gBAP_Indication_data[currentPos++];
            putValue(A_ASG_70_1_0_19, head, 3);
                startVal = head[1];
                elementsVal = head[2];
        }
        recordAddressVal = head[0] & 0x0F;
        transmitPosVal = head[0] & 0x40;
    }
    //data Parameter
     nibbleSetted = 0;
    if( (head[0] & 0x20) == 0) { // array header: increasing indices (Direction = 0).
      if( (head[0] & 0x10) > 0) { // array header: first element is one after specified start element (Shift = 1, Direction = 0).
        startVal++;
      }
      for ( i = startVal ; i < startVal + elementsVal ; i++) {
        if ( i < 0 || i >= A_ASG_70_1_0_19_ArrayDataList_Length ) {
          write("Array index ausserhalb der Grenzen, Fct: 19");
          break;
        }
        if(nibbleSetted == 1) currentPos++;
        nibbleSetted = 0;
     if( (head[0]&0x40) == 0){ /* Transmit_Pos = 0, keine Positionsdaten */ }
     else
     {
        if( (head[0]&0x80) == 0)
        {
           //IndexSize = 0, Pos als 1 Byte Wert
           A_ASG_70_1_0_19_ArrayDataList[i].Param1 = gBAP_Indication_data[currentPos++];
        }
        else
        {
           //IndexSize = 1, Pos als 2 Byte Wert
           A_ASG_70_1_0_19_ArrayDataList[i].Param1 = ( gBAP_Indication_data[currentPos++] &0xFF) + ((gBAP_Indication_data[currentPos++] &0xFF)<<8);
        }
     }
      // 0 - es kann vorkommen, dass das if leer ist dies wuerde zum Fehler fuehren. => automatische generierung der 0
      if( 0 || 1 == recordAddressVal )
      {
        //Sollte vor einem 1 Byte Wert 1 Nibble kommen, muss der index um 1 incrementiert werden!
        if( nibbleSetted==1) currentPos++;
        nibbleSetted = 0;
        A_ASG_70_1_0_19_ArrayDataList[i].Param2 = (gBAP_Indication_data[currentPos++] & 0xFF);
      }
      // 0 - es kann vorkommen, dass das if leer ist dies wuerde zum Fehler fuehren. => automatische generierung der 0
      if( 0 || 1 == recordAddressVal || 2 == recordAddressVal )
      {
        //Sollte vor einem String Wert 1 Nibble kommen, muss der index um 1 incrementiert werden!
        if( nibbleSetted==1) currentPos++;
        nibbleSetted = 0;
        if((gBAP_Indication_data[currentPos] & 0x80) >= 1)
        {
        	 A_ASG_70_1_0_19_Data_3_CntList[i] = 1;
            A_ASG_70_1_0_19_ArrayDataList[i].Param3_Length = ( (gBAP_Indication_data[currentPos++] & 0x7F) << 8) + (gBAP_Indication_data[currentPos++] & 0xFF);
        }
        else
        {
        	 A_ASG_70_1_0_19_Data_3_CntList[i] = 0;
            A_ASG_70_1_0_19_ArrayDataList[i].Param3_Length = gBAP_Indication_data[currentPos++] & 0x7F;
        }
        for(j = 0; j < A_ASG_70_1_0_19_ArrayDataList[i].Param3_Length; j++)
        {
            A_ASG_70_1_0_19_ArrayDataList[i].Param3[j] = gBAP_Indication_data[currentPos++];
        }
      }
      // 0 - es kann vorkommen, dass das if leer ist dies wuerde zum Fehler fuehren. => automatische generierung der 0
      if( 0 )
      {
        //Sollte vor einem String Wert 1 Nibble kommen, muss der index um 1 incrementiert werden!
        if( nibbleSetted==1) currentPos++;
        nibbleSetted = 0;
        if((gBAP_Indication_data[currentPos] & 0x80) >= 1)
        {
        	 A_ASG_70_1_0_19_Data_4_CntList[i] = 1;
            A_ASG_70_1_0_19_ArrayDataList[i].Param4_Length = ( (gBAP_Indication_data[currentPos++] & 0x7F) << 8) + (gBAP_Indication_data[currentPos++] & 0xFF);
        }
        else
        {
        	 A_ASG_70_1_0_19_Data_4_CntList[i] = 0;
            A_ASG_70_1_0_19_ArrayDataList[i].Param4_Length = gBAP_Indication_data[currentPos++] & 0x7F;
        }
        for(j = 0; j < A_ASG_70_1_0_19_ArrayDataList[i].Param4_Length; j++)
        {
            A_ASG_70_1_0_19_ArrayDataList[i].Param4[j] = gBAP_Indication_data[currentPos++];
        }
      }
      } // for
    } else { // array header: decreasing indices (Direction = 1).
      if( (head[0] & 0x10) > 0) { // array header: first element is one before specified start element (Shift = 1, Direction = 1).
        if(startVal != 0) {          startVal--;
        } else {
          startVal = A_ASG_70_1_0_19_ArrayDataList_Length -1;
        }
      }
      for ( i = startVal ; i > startVal - elementsVal ; i--) {
        if ( i < 0 || i >= A_ASG_70_1_0_19_ArrayDataList_Length ) {
          write("Array index ausserhalb der Grenzen, Fct: 19");
          break;
        }
        if(nibbleSetted == 1) currentPos++;
        nibbleSetted = 0;
     if( (head[0]&0x40) == 0){ /* Transmit_Pos = 0, keine Positionsdaten */ }
     else
     {
        if( (head[0]&0x80) == 0)
        {
           //IndexSize = 0, Pos als 1 Byte Wert
           A_ASG_70_1_0_19_ArrayDataList[i].Param1 = gBAP_Indication_data[currentPos++];
        }
        else
        {
           //IndexSize = 1, Pos als 2 Byte Wert
           A_ASG_70_1_0_19_ArrayDataList[i].Param1 = ( gBAP_Indication_data[currentPos++] &0xFF) + ((gBAP_Indication_data[currentPos++] &0xFF)<<8);
        }
     }
      // 0 - es kann vorkommen, dass das if leer ist dies wuerde zum Fehler fuehren. => automatische generierung der 0
      if( 0 || 1 == recordAddressVal )
      {
        //Sollte vor einem 1 Byte Wert 1 Nibble kommen, muss der index um 1 incrementiert werden!
        if( nibbleSetted==1) currentPos++;
        nibbleSetted = 0;
        A_ASG_70_1_0_19_ArrayDataList[i].Param2 = (gBAP_Indication_data[currentPos++] & 0xFF);
      }
      // 0 - es kann vorkommen, dass das if leer ist dies wuerde zum Fehler fuehren. => automatische generierung der 0
      if( 0 || 1 == recordAddressVal || 2 == recordAddressVal )
      {
        //Sollte vor einem String Wert 1 Nibble kommen, muss der index um 1 incrementiert werden!
        if( nibbleSetted==1) currentPos++;
        nibbleSetted = 0;
        if((gBAP_Indication_data[currentPos] & 0x80) >= 1)
        {
        	 A_ASG_70_1_0_19_Data_3_CntList[i] = 1;
            A_ASG_70_1_0_19_ArrayDataList[i].Param3_Length = ( (gBAP_Indication_data[currentPos++] & 0x7F) << 8) + (gBAP_Indication_data[currentPos++] & 0xFF);
        }
        else
        {
        	 A_ASG_70_1_0_19_Data_3_CntList[i] = 0;
            A_ASG_70_1_0_19_ArrayDataList[i].Param3_Length = gBAP_Indication_data[currentPos++] & 0x7F;
        }
        for(j = 0; j < A_ASG_70_1_0_19_ArrayDataList[i].Param3_Length; j++)
        {
            A_ASG_70_1_0_19_ArrayDataList[i].Param3[j] = gBAP_Indication_data[currentPos++];
        }
      }
      // 0 - es kann vorkommen, dass das if leer ist dies wuerde zum Fehler fuehren. => automatische generierung der 0
      if( 0 )
      {
        //Sollte vor einem String Wert 1 Nibble kommen, muss der index um 1 incrementiert werden!
        if( nibbleSetted==1) currentPos++;
        nibbleSetted = 0;
        if((gBAP_Indication_data[currentPos] & 0x80) >= 1)
        {
        	 A_ASG_70_1_0_19_Data_4_CntList[i] = 1;
            A_ASG_70_1_0_19_ArrayDataList[i].Param4_Length = ( (gBAP_Indication_data[currentPos++] & 0x7F) << 8) + (gBAP_Indication_data[currentPos++] & 0xFF);
        }
        else
        {
        	 A_ASG_70_1_0_19_Data_4_CntList[i] = 0;
            A_ASG_70_1_0_19_ArrayDataList[i].Param4_Length = gBAP_Indication_data[currentPos++] & 0x7F;
        }
        for(j = 0; j < A_ASG_70_1_0_19_ArrayDataList[i].Param4_Length; j++)
        {
            A_ASG_70_1_0_19_ArrayDataList[i].Param4[j] = gBAP_Indication_data[currentPos++];
        }
      }
      } // for
    }
    nibbleSetted = 0;
index = getValue(A_ASG_70_1_0_19_DataIndex);
    putValue(A_ASG_70_1_0_19_Data_1, A_ASG_70_1_0_19_ArrayDataList[index].Param1);
    putValue(A_ASG_70_1_0_19_Data_2, A_ASG_70_1_0_19_ArrayDataList[index].Param2);
    putValue(A_ASG_70_1_0_19_Data_3_len, A_ASG_70_1_0_19_Data_3_LenList[index]);
    putValue(A_ASG_70_1_0_19_Data_3_cnt, A_ASG_70_1_0_19_Data_3_CntList[index]);
    putValue(A_ASG_70_1_0_19_Data_3, A_ASG_70_1_0_19_ArrayDataList[index].Param3, A_ASG_70_1_0_19_ArrayDataList[index].Param3_Length);
    putValue(A_ASG_70_1_0_19_Data_4_len, A_ASG_70_1_0_19_Data_4_LenList[index]);
    putValue(A_ASG_70_1_0_19_Data_4_cnt, A_ASG_70_1_0_19_Data_4_CntList[index]);
    putValue(A_ASG_70_1_0_19_Data_4, A_ASG_70_1_0_19_ArrayDataList[index].Param4, A_ASG_70_1_0_19_ArrayDataList[index].Param4_Length);
}

A_ASG_70_1_0_19_ChangedInd()
{
    int currentPos;
    byte head[5];
    byte stringTempValue[180];
    int i;
    int j;
    int startVal;
    int elementsVal;
    byte recordAddressVal;
    byte transmitPosVal;
    long tempValue;
    long index;
    byte nibbleSetted;
    currentPos = 0;
    nibbleSetted = 0;
    //head Parameter
    if(gBAP_Indication_header[4] >= (3+currentPos))
    {
        if( (gBAP_Indication_data[currentPos] & 0x80) > 0)
            if(gBAP_Indication_header[4] >= (5+currentPos))
            {
                for(i = 0; i < 5; i++) head[i] = gBAP_Indication_data[currentPos++];
                putValue(A_ASG_70_1_0_19_Changed, head, 5);
                startVal = (head[2]<<8) | head[1];
                elementsVal = (head[4]<<8) | head[3];
            }
            else write("received Data Error");
        else
        {
            for(i = 0; i < 3; i++) head[i] = gBAP_Indication_data[currentPos++];
            putValue(A_ASG_70_1_0_19_Changed, head, 3);
                startVal = head[1];
                elementsVal = head[2];
        }
        recordAddressVal = head[0] & 0x0F;
        transmitPosVal = head[0] & 0x40;
    }
    //data Parameter
     nibbleSetted = 0;
    if( (head[0] & 0x20) == 0) { // array header: increasing indices (Direction = 0).
      if( (head[0] & 0x10) > 0) { // array header: first element is one after specified start element (Shift = 1, Direction = 0).
        startVal++;
      }
      for ( i = startVal ; i < startVal + elementsVal ; i++) {
        if ( i < 0 || i >= A_ASG_70_1_0_19_ArrayDataList_Length ) {
          write("Array index ausserhalb der Grenzen, Fct: 19");
          break;
        }
        if(nibbleSetted == 1) currentPos++;
        nibbleSetted = 0;
      } // for
    } else { // array header: decreasing indices (Direction = 1).
      if( (head[0] & 0x10) > 0) { // array header: first element is one before specified start element (Shift = 1, Direction = 1).
        if(startVal != 0) {          startVal--;
        } else {
          startVal = A_ASG_70_1_0_19_ArrayDataList_Length -1;
        }
      }
      for ( i = startVal ; i > startVal - elementsVal ; i--) {
        if ( i < 0 || i >= A_ASG_70_1_0_19_ArrayDataList_Length ) {
          write("Array index ausserhalb der Grenzen, Fct: 19");
          break;
        }
        if(nibbleSetted == 1) currentPos++;
        nibbleSetted = 0;
      } // for
    }
    nibbleSetted = 0;
index = getValue(A_ASG_70_1_0_19_DataIndex);
}




on envVar A_ASG_70_1_0_19_1
{
	byte superval[180];

	//Update Childvalue (Enum)
	byte thisval; // ASG_ID
	thisval = 0x0f & getValue(this);
}
// Ueberwachung der Darstellungsvariable der Range.
on envVar A_ASG_70_1_0_19_2_range // ResultList.TAID 
{
	@A_ASG_70_1_0_19_2 = @A_ASG_70_1_0_19_2_range - (0); // slider = range - min
}

on envVar A_ASG_70_1_0_19_2
{
	byte superval[180];

	//Update Childvalue (Number)
	byte thisval; // TAID
	float slider_value;

	slider_value = round(@A_ASG_70_1_0_19_2, 1.0);
	@A_ASG_70_1_0_19_2_range = slider_value + (0); // real value := slider value + range min.
	thisval = (byte)round((slider_value + (0) - (0)) / (1.0), 1); // bus value := (slider value + min - offset) / step.
}
// Ueberwachung der Darstellungsvariable der Range.
on envVar A_ASG_70_1_0_19_3_range // ResultList.TotalNumListElements 
{
	@A_ASG_70_1_0_19_3 = @A_ASG_70_1_0_19_3_range - (0); // slider = range - min
}

on envVar A_ASG_70_1_0_19_3
{
	byte superval[180];

	//Update Childvalue (Number)
	byte thisval; // TotalNumListElements
	float slider_value;

	slider_value = round(@A_ASG_70_1_0_19_3, 1.0);
	@A_ASG_70_1_0_19_3_range = slider_value + (0); // real value := slider value + range min.
	thisval = (byte)round((slider_value + (0) - (0)) / (1.0), 1); // bus value := (slider value + min - offset) / step.
}
// Ueberwachung der Darstellungsvariable der Range.
on envVar A_ASG_70_1_0_19_Data_1_range // ResultList.Pos 
{
	@A_ASG_70_1_0_19_Data_1 = @A_ASG_70_1_0_19_Data_1_range - (0); // slider = range - min
}

on envVar A_ASG_70_1_0_19_Data_1
{
	byte superval[180];

	//Update Childvalue (Number)
	byte thisval; // Pos
	float slider_value;

	slider_value = round(@A_ASG_70_1_0_19_Data_1, 1.0);
	@A_ASG_70_1_0_19_Data_1_range = slider_value + (0); // real value := slider value + range min.
	thisval = (byte)round((slider_value + (0) - (0)) / (1.0), 1); // bus value := (slider value + min - offset) / step.
    A_ASG_70_1_0_19_ArrayDataList[getValue(A_ASG_70_1_0_19_DataIndex)].Param1 = thisval;
}
on envVar A_ASG_70_1_0_19_Data_2
{
	byte superval[180];

	//Update Childvalue (Enum)
	byte thisval; // ResultType
	thisval = getValue(this);
    A_ASG_70_1_0_19_ArrayDataList[getValue(A_ASG_70_1_0_19_DataIndex)].Param2 = thisval;
}

// Ueberwachung der CheckBox fuer String
on envVar  A_ASG_70_1_0_19_Data_3_cnt
{
	word len;
	byte cnt;
	len = getValue(A_ASG_70_1_0_19_Data_3_len);
	cnt = getValue(this);

    /* Cnt Wert im Array aktualisieren */
	 A_ASG_70_1_0_19_Data_3_CntList[ getValue(A_ASG_70_1_0_19_DataIndex) ] = cnt;

	/* wird nur gerufen, wenn check box deaktiviert mit Length>127*/ 
	if(cnt == 0) 
	{
		if(len > 127 )
		{
			putValue(A_ASG_70_1_0_19_Data_3_len, 127);
		}
	}

}


on envVar A_ASG_70_1_0_19_Data_3_len
{
	long thisval;
	byte cnt;
	thisval = getValue(this);
	cnt = getValue(A_ASG_70_1_0_19_Data_3_cnt);

	/* wenn die Laenge ausserhalb des erlaubten Bereich liegt, wird diese begrenzt */
	if(thisval > 169 || thisval < 0 )
	{
		writelineEx(gBAP_Trace, 0, "Eingegebene Laenge: %d von A_ASG_70_1_0_19_Data_3 ist ungueltig. Die max. erlaubte Laenge ist %d. ", thisval, 169);
		thisval = 169;
	}
	if( thisval >127)
	{
		putValue(A_ASG_70_1_0_19_Data_3_cnt, 1); /* Switch checkbox on */
	}

	A_ASG_70_1_0_19_ArrayDataList[getValue(A_ASG_70_1_0_19_DataIndex)].Param3_Length = thisval;
	A_ASG_70_1_0_19_Data_3_LenList[ getValue(A_ASG_70_1_0_19_DataIndex) ] = thisval;
	putValue(A_ASG_70_1_0_19_Data_3_len, thisval);

}

on envVar A_ASG_70_1_0_19_Data_3
{
	byte superval[180];

	//Update Childvalue (String)
	word i;
	byte thisval[171];
	getValue(this, thisval);
    for(i = 0; i < getValueSize(this); i++)
        A_ASG_70_1_0_19_ArrayDataList[getValue(A_ASG_70_1_0_19_DataIndex)].Param3[i] = thisval[i];
    A_ASG_70_1_0_19_ArrayDataList[getValue(A_ASG_70_1_0_19_DataIndex)].Param3_Length = getValueSize(this);
    A_ASG_70_1_0_19_Data_3_LenList[getValue(A_ASG_70_1_0_19_DataIndex)]= getValueSize(this);
    putValue(A_ASG_70_1_0_19_Data_3_len, getValueSize(this));
}

// Ueberwachung der CheckBox fuer String
on envVar  A_ASG_70_1_0_19_Data_4_cnt
{
	word len;
	byte cnt;
	len = getValue(A_ASG_70_1_0_19_Data_4_len);
	cnt = getValue(this);

    /* Cnt Wert im Array aktualisieren */
	 A_ASG_70_1_0_19_Data_4_CntList[ getValue(A_ASG_70_1_0_19_DataIndex) ] = cnt;

	/* wird nur gerufen, wenn check box deaktiviert mit Length>127*/ 
	if(cnt == 0) 
	{
		if(len > 127 )
		{
			putValue(A_ASG_70_1_0_19_Data_4_len, 127);
		}
	}

}


on envVar A_ASG_70_1_0_19_Data_4_len
{
	long thisval;
	byte cnt;
	thisval = getValue(this);
	cnt = getValue(A_ASG_70_1_0_19_Data_4_cnt);

	/* wenn die Laenge ausserhalb des erlaubten Bereich liegt, wird diese begrenzt */
	if(thisval > 1 || thisval < 0 )
	{
		writelineEx(gBAP_Trace, 0, "Eingegebene Laenge: %d von A_ASG_70_1_0_19_Data_4 ist ungueltig. Die max. erlaubte Laenge ist %d. ", thisval, 1);
		thisval = 1;
	}
	if( thisval >127)
	{
		putValue(A_ASG_70_1_0_19_Data_4_cnt, 1); /* Switch checkbox on */
	}

	A_ASG_70_1_0_19_ArrayDataList[getValue(A_ASG_70_1_0_19_DataIndex)].Param4_Length = thisval;
	A_ASG_70_1_0_19_Data_4_LenList[ getValue(A_ASG_70_1_0_19_DataIndex) ] = thisval;
	putValue(A_ASG_70_1_0_19_Data_4_len, thisval);

}

on envVar A_ASG_70_1_0_19_Data_4
{
	byte superval[180];

	//Update Childvalue (String)
	word i;
	byte thisval[2];
	getValue(this, thisval);
    for(i = 0; i < getValueSize(this); i++)
        A_ASG_70_1_0_19_ArrayDataList[getValue(A_ASG_70_1_0_19_DataIndex)].Param4[i] = thisval[i];
    A_ASG_70_1_0_19_ArrayDataList[getValue(A_ASG_70_1_0_19_DataIndex)].Param4_Length = getValueSize(this);
    A_ASG_70_1_0_19_Data_4_LenList[getValue(A_ASG_70_1_0_19_DataIndex)]= getValueSize(this);
    putValue(A_ASG_70_1_0_19_Data_4_len, getValueSize(this));
}
on envVar A_ASG_70_1_0_19_1_SetGet
{
	byte superval[4];

	//Update Childvalue (Enum)
	byte thisval; // ASG_ID
	thisval = 0x0f & getValue(this);
}
// Ueberwachung der Darstellungsvariable der Range.
on envVar A_ASG_70_1_0_19_2_SetGet_range // ResultList.TAID 
{
	@A_ASG_70_1_0_19_2_SetGet = @A_ASG_70_1_0_19_2_SetGet_range - (0); // slider = range - min
}

on envVar A_ASG_70_1_0_19_2_SetGet
{
	byte superval[4];

	//Update Childvalue (Number)
	byte thisval; // TAID
	float slider_value;

	slider_value = round(@A_ASG_70_1_0_19_2_SetGet, 1.0);
	@A_ASG_70_1_0_19_2_SetGet_range = slider_value + (0); // real value := slider value + range min.
	thisval = (byte)round((slider_value + (0) - (0)) / (1.0), 1); // bus value := (slider value + min - offset) / step.
}
on envVar P_ASG_70_1_0_20Get_BTN
{
 if (P_ASG_70_1_0_20Get_BTN_already_pressed == 0)
  {
       putValue(P_ASG_70_1_0_20_ErrCode,0);
       SetControlBackColor(panel_name,"errField_P_ASG_70_1_0_20",MakeRGB(255,255,255));
       P_ASG_70_1_0_20Get_BTN_already_pressed = 1;
 }
 else
 {
       Request_Void(LSGID, P_ASG_70_1_0_20_ID, DataGet_REQ); 
       P_ASG_70_1_0_20Get_BTN_already_pressed = 0;
 }
}
on envVar P_ASG_70_1_0_20 // bus value of InfoStates (20).
{
	// opcodes: Error-Status
	byte param1; // States
	byte param2; // Extension1
	byte param3; // Extension2
	byte param4; // Extension3
	byte param5; // Extension4
	byte param6; // Extension5
	// DATATYPE_BYTESEQUENCE / DATATYPE_FIXEDBYTESEQUENCE
	int i;
	byte superval[6];
	int currentPos;
	currentPos = 0;
	for( i = 0; i < 6; i++ ) {
		superval[i] = 0;
	}
	getValue(P_ASG_70_1_0_20, superval);
	///////// Start param1 - UINT8 /////////
	param1 = superval[currentPos++];
	putValue(P_ASG_70_1_0_20_1, param1);
	///////// Start param2 - UINT8 /////////
	param2 = superval[currentPos++];
	putValue(P_ASG_70_1_0_20_2, round((param2 * 1.0) - (0) + (0), 1.0));
	///////// Start param3 - UINT8 /////////
	param3 = superval[currentPos++];
	putValue(P_ASG_70_1_0_20_3, round((param3 * 1.0) - (0) + (0), 1.0));
	///////// Start param4 - UINT8 /////////
	param4 = superval[currentPos++];
	putValue(P_ASG_70_1_0_20_4, round((param4 * 1.0) - (0) + (0), 1.0));
	///////// Start param5 - UINT8 /////////
	param5 = superval[currentPos++];
	putValue(P_ASG_70_1_0_20_5, round((param5 * 1.0) - (0) + (0), 1.0));
	///////// Start param6 - UINT8 /////////
	param6 = superval[currentPos++];
	putValue(P_ASG_70_1_0_20_6, round((param6 * 1.0) - (0) + (0), 1.0));
}

on envVar P_ASG_70_1_0_20_1 // InfoStates.States
{
	byte superval[6];

	//Update Childvalue (Enum)
	byte thisval; // States
	thisval = getValue(this);

    // Update superval
	getValue(P_ASG_70_1_0_20, superval);
	superval[0]=thisval;
	putValue(P_ASG_70_1_0_20,superval);
}

// Ueberwachung der Darstellungsvariable der Range.
on envVar P_ASG_70_1_0_20_2_range // InfoStates.Extension1 
{
	@P_ASG_70_1_0_20_2 = @P_ASG_70_1_0_20_2_range - (0); // slider = range - min
}

on envVar P_ASG_70_1_0_20_2 // InfoStates.Extension1
{
	byte superval[6];

	//Update Childvalue (Number)
	byte thisval; // Extension1
	float slider_value;

	slider_value = 0; // Konstanter Parameter.
	@P_ASG_70_1_0_20_2_range = slider_value + (0); // real value := slider value + range min.
	thisval = (byte)round((slider_value + (0) - (0)) / (1.0), 1); // bus value := (slider value + min - offset) / step.

    // Update superval
	getValue(P_ASG_70_1_0_20, superval);
	superval[1]=thisval;
	putValue(P_ASG_70_1_0_20,superval);
}

// Ueberwachung der Darstellungsvariable der Range.
on envVar P_ASG_70_1_0_20_3_range // InfoStates.Extension2 
{
	@P_ASG_70_1_0_20_3 = @P_ASG_70_1_0_20_3_range - (0); // slider = range - min
}

on envVar P_ASG_70_1_0_20_3 // InfoStates.Extension2
{
	byte superval[6];

	//Update Childvalue (Number)
	byte thisval; // Extension2
	float slider_value;

	slider_value = 0; // Konstanter Parameter.
	@P_ASG_70_1_0_20_3_range = slider_value + (0); // real value := slider value + range min.
	thisval = (byte)round((slider_value + (0) - (0)) / (1.0), 1); // bus value := (slider value + min - offset) / step.

    // Update superval
	getValue(P_ASG_70_1_0_20, superval);
	superval[2]=thisval;
	putValue(P_ASG_70_1_0_20,superval);
}

// Ueberwachung der Darstellungsvariable der Range.
on envVar P_ASG_70_1_0_20_4_range // InfoStates.Extension3 
{
	@P_ASG_70_1_0_20_4 = @P_ASG_70_1_0_20_4_range - (0); // slider = range - min
}

on envVar P_ASG_70_1_0_20_4 // InfoStates.Extension3
{
	byte superval[6];

	//Update Childvalue (Number)
	byte thisval; // Extension3
	float slider_value;

	slider_value = 0; // Konstanter Parameter.
	@P_ASG_70_1_0_20_4_range = slider_value + (0); // real value := slider value + range min.
	thisval = (byte)round((slider_value + (0) - (0)) / (1.0), 1); // bus value := (slider value + min - offset) / step.

    // Update superval
	getValue(P_ASG_70_1_0_20, superval);
	superval[3]=thisval;
	putValue(P_ASG_70_1_0_20,superval);
}

// Ueberwachung der Darstellungsvariable der Range.
on envVar P_ASG_70_1_0_20_5_range // InfoStates.Extension4 
{
	@P_ASG_70_1_0_20_5 = @P_ASG_70_1_0_20_5_range - (0); // slider = range - min
}

on envVar P_ASG_70_1_0_20_5 // InfoStates.Extension4
{
	byte superval[6];

	//Update Childvalue (Number)
	byte thisval; // Extension4
	float slider_value;

	slider_value = 0; // Konstanter Parameter.
	@P_ASG_70_1_0_20_5_range = slider_value + (0); // real value := slider value + range min.
	thisval = (byte)round((slider_value + (0) - (0)) / (1.0), 1); // bus value := (slider value + min - offset) / step.

    // Update superval
	getValue(P_ASG_70_1_0_20, superval);
	superval[4]=thisval;
	putValue(P_ASG_70_1_0_20,superval);
}

// Ueberwachung der Darstellungsvariable der Range.
on envVar P_ASG_70_1_0_20_6_range // InfoStates.Extension5 
{
	@P_ASG_70_1_0_20_6 = @P_ASG_70_1_0_20_6_range - (0); // slider = range - min
}

on envVar P_ASG_70_1_0_20_6 // InfoStates.Extension5
{
	byte superval[6];

	//Update Childvalue (Number)
	byte thisval; // Extension5
	float slider_value;

	slider_value = 0; // Konstanter Parameter.
	@P_ASG_70_1_0_20_6_range = slider_value + (0); // real value := slider value + range min.
	thisval = (byte)round((slider_value + (0) - (0)) / (1.0), 1); // bus value := (slider value + min - offset) / step.

    // Update superval
	getValue(P_ASG_70_1_0_20, superval);
	superval[5]=thisval;
	putValue(P_ASG_70_1_0_20,superval);
}



/**
*
* Template-Funktion zum automatischen befuellen der Array-Daten, die in einer Arrayfunktion genutzt werden.
* Die Funktion wird durch den von BAPSimGen generierten Code aufgerufen.
*
* Parameter:
* - structArray: Muss mindestens nMax * Arraygroesse Bytes Platz haben, wird vom BAPSimGen automatisch generiert
* - structElementsSizeArray: Enthaelt die Groesseangabe jedes Array-Elements. Die Arraygroesse entspricht der Elementanzahl im Array.
*       Byte & Nibble = 1; Word = 2; usw. Bei Strings wird die maximale Stringlaenge angegeben.
* - structElementsTypeArray: Gibt den Datentyp eines Array-Elements zurueck. Die Arraygroesse entspricht der Elmentanzahl im Array.
*                               0x0 = Zahlenwert, also ein Slider, Enum, Bitfield,...
*                               0xE = String (darauf folgt immer eine 2, mit der Angabe der benutzen Bytes im String)
*                               0xF = Laenge der Nutzdaten des Strings, nur return Wert
* - fctID: Kann zur Fallunterscheidung der Funktions-IDs verwendet werden.
* - nMax: Array-Index
*
* Die Funktion kann im Switch-Case beliebig erweitert werden. Der Switch-Case wertet den Parameter fctID aus.
*           
*                    
**/
initStruct(byte structArray[], dword structElementsSizeArray[], byte structElementsTypeArray[], dword structElementsMaxSizeArray[], word fctID, word nMax )
{
    byte rand8;
    word rand16;
    word randSize;
    word index;           //indexNr die an die String Parameter angehaengt wird.
    dword destArraySize;   //groesse von structArray
    dword destStructSize;  //groesse eines "Structs" also destArraySize / Anzahl Elemente (nMax))
    dword rand32;    
    dword i;
    dword pos;    //aktuelle Position im structArray
    dword elpos;  //aktuelle Position in den structElementsXXXArray's
    
    destArraySize = elCount(structArray);
    destStructSize = destArraySize / nMax;    

    Switch(fctID){

        //Idee ist, die Arrays je nach Funcion-ID speziell initalisieren zu koennen.
        //hierbei koennten die Daten z.B. aus einer Datei eingelesen werden,
        //oder auch ueber spezielle init Funktionen mit festen Werten initialisiert werden.
        //Der Default-Fall befuellt das Array mit Random-Werten und Strings mit einem vordefinierten Wort (hier test,)

        default :
        {
            pos = 0; 
            for(i = 1; i <= nMax; i++)
            {
                //walk through the array
                
                elpos = 0;
                while(pos < (destStructSize * i) )
                {   
                    //check Element type
                    if( structElementsTypeArray[elpos] == 0x0)          
                    { //Params like int, word, etc.
                        //check element length
                        Switch(structElementsSizeArray[elpos])
                        {
                            case(1) : //byte / nibble
                                rand8 = random(structElementsMaxSizeArray[elpos]);
                                structArray[pos] = rand8;
                                pos++;
                                break;

                            case(2) : //word / int
                                rand16 = random(structElementsMaxSizeArray[elpos]);
                                int2byte(structArray, pos, rand16);
                                pos += 2;
                                break;

                            case (4) : //dword / long
                                rand32 = random(structElementsMaxSizeArray[elpos]);
                                long2byte(structArray, pos, rand32);
                                pos += 4;
                                break;                        
                         }
                    }
                    else if(structElementsTypeArray[elpos] == 0xE)          
                    { //String Params like byte[]
                        randSize = random(structElementsSizeArray[elpos]);
                        if(randSize < 2) randSize = 2; 
                        index = i-1;
                        setRandomString(structArray ,pos ,structElementsSizeArray[elpos], randSize, index);
                        pos += structElementsSizeArray[elpos];
                    }
                    else if(structElementsTypeArray[elpos] == 0xF)          
                    {
                        int2byte(structArray, pos, randSize);
                        pos += 2;
                        //write("Pos: %d Strlth: %d Type: %d ",pos-1,randSize,structElementsTypeArray[elpos]);
                    
                    }
                    elpos++;
                }
            }   
        break;
        }            
    }
}

long2Byte(byte in[], dword pos, dword value)
{
    if( (elCount(in)-pos) < 4)
        write("Array out ouf bounds - too small!");
    in[pos] = value;
    in[++pos] = (value >> 8);
    in[++pos] = (value >> 16);
    in[++pos] = (value >> 24);
}

int2byte (byte in[],dword pos,word value)
{
    if( (elCount(in)-pos) < 2 )
        write("Array out of bounds - too small!");
    in[pos] = value;
    in[++pos] = (value >> 8);        
}

setRandomString (byte in[], dword pos, word strSize, word randSize, word count)
{
    word endPos, endString, j;
    byte testString[4]={'t','e','s','t'};
    
    endPos = pos + strSize;
    endString = pos + randSize;
    j=0;
    
    int2ascii(in, pos, count);
    pos += 2;
    
    for(pos; pos < endPos ;pos ++)
    {
        if(j > 3 )
            j = 0;
        if(pos < endString)
            in[pos] = testString[j++];
        else
            in[pos] = 0x0;
    }
}

int2ascii (byte in[], dword pos, word value)
{
    //Konvertiert nur die erste und zweite Dezimalstelle, also Zahlen zw. 0 und 99.
    
    //auf 2 Stellen kuerzen
    value = value%100;
    //10er schreiben
    in[pos] = (value/10) + 48;    //  0x30 hex = 48 dez = ascii null
    //1er schreiben
    in[pos+1] = (value%10) + 48;  //  0x30 hex = 48 dez = ascii null
}

