/*@!Encoding:1252*/
includes
{
    #include "messages\message_AAA_01.cin"
    #include "messages\message_ACC_19.cin"
    #include "messages\message_AGA_01.cin"
    #include "messages\message_Airbag_01.cin"
    #include "messages\message_Airbag_02.cin"
    #include "messages\message_Airbag_04.cin"
    #include "messages\message_Airbag_06.cin"
    #include "messages\message_Anhaenger_01.cin"
    #include "messages\message_ARA_Status_01.cin"
    #include "messages\message_AWV_02.cin"
    #include "messages\message_AZK_01.cin"
    #include "messages\message_BCM_01.cin"
    #include "messages\message_BCM_03.cin"
    #include "messages\message_BCM_04.cin"
    #include "messages\message_BCM_Taster_02.cin"
    #include "messages\message_BCM_Taster_03.cin"
    #include "messages\message_BEM_02.cin"
    #include "messages\message_BEM_06.cin"
    #include "messages\message_Blinkmodi_02.cin"
    #include "messages\message_BMS_05.cin"
    #include "messages\message_BMS_07.cin"
    #include "messages\message_Bremse_EV_02.cin"
    #include "messages\message_Charisma_03.cin"
    #include "messages\message_Daempfer_01.cin"
    #include "messages\message_Daempfer_05.cin"
    #include "messages\message_DCDC_02.cin"
    #include "messages\message_DIA_ABT_1_Req.cin"
    #include "messages\message_Diagnose_01.cin"
    #include "messages\message_DiETa_01.cin"
    #include "messages\message_Dimmung_01.cin"
    #include "messages\message_EA_02.cin"
    #include "messages\message_ELV_01.cin"
    #include "messages\message_EML_06.cin"
    #include "messages\message_EML_07.cin"
    #include "messages\message_Entfernungen_01.cin"
    #include "messages\message_EPB_03.cin"
    #include "messages\message_ESC_50.cin"
    #include "messages\message_ESC_51.cin"
    #include "messages\message_ESP_10.cin"
    #include "messages\message_ESP_20.cin"
    #include "messages\message_ESP_21.cin"
    #include "messages\message_ESP_24.cin"
    #include "messages\message_ESP_30.cin"
    #include "messages\message_FoD_01.cin"
    #include "messages\message_FoD_Kombi_Req.cin"
    #include "messages\message_FoD_ZR_Req.cin"
    #include "messages\message_Gateway_71.cin"
    #include "messages\message_Gateway_73.cin"
    #include "messages\message_Getriebe_16.cin"
    #include "messages\message_Heckradar_01.cin"
    #include "messages\message_HVK_01.cin"
    #include "messages\message_IPA_02.cin"
    #include "messages\message_ISO_Funktionaler_Req_All.cin"
    #include "messages\message_ISO_HUD_Req.cin"
    #include "messages\message_ISO_Kombi_Req.cin"
    #include "messages\message_ISO_NFCIApp_NFCIServ_Resp.cin"
    #include "messages\message_ISO_NFCIServ_NFCIApp_Req.cin"
    #include "messages\message_ISOx_DispKBI_FS_Req.cin"
    #include "messages\message_ISOx_DispKBI_FS_Req_FD.cin"
    #include "messages\message_ISOx_Funkt_Req_All_FD.cin"
    #include "messages\message_ISOx_HUD_Req_FD.cin"
    #include "messages\message_ISOx_Kombi_Req_FD.cin"
    #include "messages\message_ISOx_SmLi_01_Req.cin"
    #include "messages\message_ISOx_SmLi_01_Req_FD.cin"
    #include "messages\message_ISOx_WLC1_Req.cin"
    #include "messages\message_Kessy_04.cin"
    #include "messages\message_Klemmen_Status_01.cin"
    #include "messages\message_Klemmen_Status_02.cin"
    #include "messages\message_Klemmen_Steuerung_01.cin"
    #include "messages\message_Klima_03.cin"
    #include "messages\message_Klima_06.cin"
    #include "messages\message_Klima_12.cin"
    #include "messages\message_Klima_16.cin"
    #include "messages\message_Klima_Sensor_02.cin"
    #include "messages\message_KN_Gateway.cin"
    #include "messages\message_KonzernrollenModus_01.cin"
    #include "messages\message_KS_ICAS3Sys01_Req_FD.cin"
    #include "messages\message_KS_Info_El_Req_FD.cin"
    #include "messages\message_KS_Kombi_Req_FD.cin"
    #include "messages\message_KS_SSN_ABT_1_Req.cin"
    #include "messages\message_LDW_02.cin"
    #include "messages\message_LH_EPS_01.cin"
    #include "messages\message_Licht_Anf_01.cin"
    #include "messages\message_Licht_hinten_01.cin"
    #include "messages\message_Licht_vorne_01.cin"
    #include "messages\message_LiSi_01.cin"
    #include "messages\message_LWI_01.cin"
    #include "messages\message_Mem_BFS_01.cin"
    #include "messages\message_Mem_FS_01.cin"
    #include "messages\message_MFG_01.cin"
    #include "messages\message_MFL_01.cin"
    #include "messages\message_MFL_02.cin"
    #include "messages\message_MFL_Tasten_Kon_01.cin"
    #include "messages\message_Motor_14.cin"
    #include "messages\message_Motor_18.cin"
    #include "messages\message_Motor_26.cin"
    #include "messages\message_Motor_41.cin"
    #include "messages\message_Motor_51.cin"
    #include "messages\message_Motor_52.cin"
    #include "messages\message_Motor_53.cin"
    #include "messages\message_Motor_54.cin"
    #include "messages\message_Motor_57.cin"
    #include "messages\message_Motor_Hybrid_06.cin"
    #include "messages\message_NFC_01.cin"
    #include "messages\message_NFC_MiKo_01.cin"
    #include "messages\message_OBDC_DispKBI_FS_Req_FD.cin"
    #include "messages\message_OBDC_Funktionaler_Req_All.cin"
    #include "messages\message_OBDC_Funktionaler_Req_All_FD.cin"
    #include "messages\message_OBDC_HUD_Req_FD.cin"
    #include "messages\message_OBDC_Kombi_Req_FD.cin"
    #include "messages\message_OBDC_SmLi_01_Req_FD.cin"
    #include "messages\message_OBDC_SSN_ABT_1_Req.cin"
    #include "messages\message_OBDC_WLC1_Req.cin"
    #include "messages\message_OBDx_allOBD_Req.cin"
    #include "messages\message_ORU_01.cin"
    #include "messages\message_Parkhilfe_01.cin"
    #include "messages\message_Parkhilfe_04.cin"
    #include "messages\message_Personalisierung_01.cin"
    #include "messages\message_PreCrash_02.cin"
    #include "messages\message_Rear_View_04.cin"
    #include "messages\message_Rear_View_06.cin"
    #include "messages\message_Reichweite_01.cin"
    #include "messages\message_Reichweite_02.cin"
    #include "messages\message_Reichweite_03.cin"
    #include "messages\message_RKA_01.cin"
    #include "messages\message_RLS_01.cin"
    #include "messages\message_RLS_02.cin"
    #include "messages\message_SAL_01.cin"
    #include "messages\message_SAM_01.cin"
    #include "messages\message_SMLS_01.cin"
    #include "messages\message_Systeminfo_01.cin"
    #include "messages\message_TA_01.cin"
    #include "messages\message_Temperaturen_01.cin"
    #include "messages\message_Thermo_Verbrauch_01.cin"
    #include "messages\message_TM_01.cin"
    #include "messages\message_TSG_BT_01.cin"
    #include "messages\message_TSG_FT_01.cin"
    #include "messages\message_TSG_FT_02.cin"
    #include "messages\message_TSG_HBFS_01.cin"
    #include "messages\message_TSG_HFS_01.cin"
    #include "messages\message_UserStateServer_01.cin"
    #include "messages\message_VIN_01.cin"
    #include "messages\message_VLK_01.cin"
    #include "messages\message_VZE_04.cin"
    #include "messages\message_WBA_03.cin"
    #include "messages\message_WFS_01.cin"
    #include "messages\message_WFS_Transponder_Req_02.cin"
    #include "messages\message_Wischer_01.cin"
    #include "messages\message_WLC1_01.cin"
    #include "messages\message_Zeitmaster_02.cin"
    #include "messages\message_ZV_02.cin"
    #include "messages\message_ZV_04.cin"

}

variables
{
/*
Copyright ( C ) Continental AG 2019



Date of creation :  20.04.2019

Created by :                 Hans Jürgen Hipp


Version info

1.0        03.2018      Inital version
// #VERSION#
// #VERSION_END#
*/


    const TRUE    = 0xAA;
    const FALSE   = 0x00;
    const cManual = 0x00;
    const cAuto   = 0xAA;

    msTimer t_DBKomTimer_20ms;      // Timer zum zyklischen Aufruf der DBKom-Task
    int c_tDBKomTimer_20ms = 20;    // msec
    msTimer t_DBKomTimer_5ms;       // Timer zum zyklischen Aufruf der DBKom-Task
    int c_tDBKomTimer_5ms = 5;      // msec


    // BA_DEF_ BO_  "GenMsgSendType" ENUM
    //  0 : cyclicX
    //  1 : none
    //  2 : none
    //  3 : none
    //  4 : none
    //  5 : none
    //  6 : none
    //  7 : IfActive
    //  8 : NoMsgSendType
    //  9 : cyclicAndSpontanWithDelay
    //  10 : none

// #VAR_DEF#

// #VAR_DEF_END#


    Timer t_DoorNMCancelTimer;
    Timer t_KeyInLockNMCancelTimer;
    Timer t_StWhlButtonNMCancelTimer;
    Timer t_WakeWarningNMCancelTimer;
    Timer t_CarClosureNMCancelTimer;
    Timer t_EPKBWarningNMCancelTimer;
    Timer t_IlluNMCancelTimer;
    Timer t_GearIndNMCancelTimer;
    const byte c_NMCancelTimer_05sec = 5;
    const byte c_NMCancelTimer_30sec = 30;

    char buffer[1024], stringbuffer[512];
    int bActiveHelper;    // Hilfsvariable für "Aktive Signale"

//--------------------------------------- AUTOSAR NM ------------------------------------------------

    const byte cAUTO   = 0;
    const byte cMANUAL = 1;

    msTimer t_NM_Transmit;
    long  NM_Transmit_Cycle;
    msTimer t_NM_Wait_Bus_Sleep_Time;
    const c_NM_Wait_Bus_Sleep_Time = 750;
//    msTimer t_NM_Remote_Sleep_Ind_Time;
    const c_NM_Remote_Sleep_Ind_Time = 5000;
    msTimer t_NM_Repeat_Message_Time;
    const c_NM_Repeat_Message_Time = 5000;
    msTimer t_NM_Timeout_Time;
    const c_NM_Timeout_Time = 1000;

    byte NM_Mode = 0;
    const byte cNM_Mode_Init = 0;
    const byte cNM_Mode_Sleep = 1;
    const byte cNM_Mode_Prepare_Bus_Sleep = 2;
    const byte cNM_Mode_Ready_Sleep = 3;
    const byte cNM_Mode_Normal_Operation_State = 4;
    const byte cNM_Mode_RepeatMsg = 5;

    const byte cCANNormalNetworkLoad = 0;
    const byte cCANHeavyNetworkLoad = 1;
    byte bCanLoad = 0;
    const byte cCANNormalNetworkLoad_SpontanCnt = 1;
    const byte cCANHeavyNetworkLoad_SpontanCnt = 2;
    byte bCanLoad_SpontanCnt = 1;

    // Values NM_Gateway_NM_State
    byte bNM_xxx_NM_State;
    const byte cNM_RM_aus_BSM  = 1; // State "Repeat Message" entered from "Bus-Sleep Mode"
    const byte cNM_RM_aus_PBSM = 2; // State "Repeat Message" entered from "Prepare Bus-Sleep Mode"
    const byte cNM_NO_aus_RM   = 4; // State "Normal Operation" entered from "Repeat Message"
    const byte cNM_NO_aus_RS   = 8; // State "Normal Operation" entered from "Ready to Sleep"

    byte boCanNM_Rx_Indication = 0;
    byte boCanNM_Tx_Confirmation = 0;
    byte boCanNM_WaitBusSleep_Timer_Expired = 0;
    byte boCanNM_RepeatMessage_Timer_Expired = 0;
    byte boCanNM_NM_Timeout_Timer_Expired = 0;
    byte boCanNM_RepeatMessage_Requested = 0;

    const word cFLDoorNMRequest       = 0x0001;
    const word cFRDoorNMRequest       = 0x0002;
    const word cRLDoorNMRequest       = 0x0004;
    const word cRRDoorNMRequest       = 0x0008;
    const word cAllDoorNMRequest      = 0x000F;
    const word cIgnitionNMRequest     = 0x0010; // KL_15
    const word cKeyInLockNMRequest    = 0x0020; // KL_S
    const word cWakeWarningNMRequest  = 0x0040;
    const word cEPKBWarningNMRequest  = 0x0080;
    const word cIlluNMRequest         = 0x0100;
    const word cCarClosureNMRequest   = 0x0200;
    const word cGearIndNMRequest      = 0x0400;
    const word cLowBeamNMRequest      = 0x0800;
    const word cStWhlButtonNMRequest  = 0x1000;

    const word cManualNMRequest       = 0x8000;
    const word cAllNMRequest          = 0xFFFF;

    const CanNmNodeId_Base   = 0x1B000000; //     = 0dec
    const CanNmNodeId_Fahrerdisplay_Kombi = 0x109; //    = 265dec
            const CanNmNodeId_HUD                 = 0x1b; //    = 27dec
            const CanNmNodeId_ICAS1_Gateway       = 0x10; //    = 16dec
            const CanNmNodeId_ICAS3_Gateway       = 0x73; //    = 115dec
            const CanNmNodeId_Kombi               = 0x14; //    = 20dec
            const CanNmNodeId_SmartLight_01       = 0x10c; //    = 268dec

    const CanNmNodeDetectionEnabled          = 0; //false
    const CanNmNodeIdEnabled                 = 1; //true
    const CanNmUserDataEnabled               = 1; //true;
    const CanNmUserDataLentgh                = 7;
    const CanNmRepeatMsgIndEnabled           = 1; //true;
    const CanNmDevErrorDetect                = 0; //false
//    const CanNmUserDataEnabled             = 1; //true
    const CanNmRemoteSleepIndEnabled         = 0; //false
    const CanNmMsgReducedtime                = 80; //ms
    const CanNmPduRxIndicationEnabled        = 0; //false
    const CanNmStateChangeIndEnabled         = 0; //false
    const CanNmImmediateTxconfEnabled        = 0;// false
    const CanNmMsgTimeoutTime                = 5000; //ms
    const CanNmPduNidPosition                = 0; //CANNM_PDU_BYTE_0;
    const CanNmPduCbvPosition                = 0xFF; //ANNM_PDU_OFF;
    const CanNmPduLength                     = 8;
    const cCanNmPassiveModeEnabled           = 0; //false
    const CanNmBusSynchronizationEnabled     = 0; //false
    const CanNmBusLoadReductionEnabled       = 0; //false
//    const CanNmRemoteSleepIndEnabled       = 0; //false
//    const CanNmNodeDetectionEnabled        = 0; //false
    const CanNmComControlEnabled             = 1; //true    

    const NmAsrCanMsgStandardCycle           = 200;
    const NmAsrCanMsgReducedTime_Fahrerdisplay_Kombi = NmAsrCanMsgStandardCycle;
    const NmAsrCanMsgCycleOffset_Fahrerdisplay_Kombi = 0; 
    const NmAsrCanMsgReducedTime_HUD = NmAsrCanMsgStandardCycle;
    const NmAsrCanMsgCycleOffset_HUD                 = 10;
    const NmAsrCanMsgReducedTime_ICAS1_Gateway = NmAsrCanMsgStandardCycle;
    const NmAsrCanMsgCycleOffset_ICAS1_Gateway       = 20;
    const NmAsrCanMsgReducedTime_ICAS3_Gateway = NmAsrCanMsgStandardCycle;
    const NmAsrCanMsgCycleOffset_ICAS3_Gateway       = 30;
    const NmAsrCanMsgReducedTime_Kombi = NmAsrCanMsgStandardCycle;
    const NmAsrCanMsgCycleOffset_Kombi               = 40; 
    const NmAsrCanMsgReducedTime_SmartLight_01 = NmAsrCanMsgStandardCycle;
    const NmAsrCanMsgCycleOffset_SmartLight_01       = 50;

    char  gECU[19] = "KCAN_ICAS1_Gateway";

    word  CanNmNodeId            = CanNmNodeId_ICAS1_Gateway;
    dword NmNodeIdentifier       = CanNmNodeId_Base + CanNmNodeId_ICAS1_Gateway;
    word  NmAsrCanMsgCycleOffset = NmAsrCanMsgCycleOffset_ICAS1_Gateway;
    word  NmAsrCanMsgReducedTime = NmAsrCanMsgReducedTime_ICAS1_Gateway;
    word  NmAsrCanMsgCycleTime   = 200;
    byte  NM_Repeat_Message_State_Active = 0;
    byte  NM_AutomaticModeActive = 0;

//  message   NM_xxx_AR --- Sendeart cyclicX --- 
    message NMH_Gateway _mNM_xxx_AR;
    byte _mNM_xxx_Transmit_Allowed = 1;

//--------------------------------------- AUTOSAR NM ------------------------------------------------

    byte  crctable[256] = {
        0x00, 0x2f, 0x5e, 0x71, 0xbc, 0x93, 0xe2, 0xcd, 0x57, 0x78, 0x09, 0x26, 0xeb, 0xc4, 0xb5, 0x9a,
        0xae, 0x81, 0xf0, 0xdf, 0x12, 0x3d, 0x4c, 0x63, 0xf9, 0xd6, 0xa7, 0x88, 0x45, 0x6a, 0x1b, 0x34,
        0x73, 0x5c, 0x2d, 0x02, 0xcf, 0xe0, 0x91, 0xbe, 0x24, 0x0b, 0x7a, 0x55, 0x98, 0xb7, 0xc6, 0xe9,
        0xdd, 0xf2, 0x83, 0xac, 0x61, 0x4e, 0x3f, 0x10, 0x8a, 0xa5, 0xd4, 0xfb, 0x36, 0x19, 0x68, 0x47,
        0xe6, 0xc9, 0xb8, 0x97, 0x5a, 0x75, 0x04, 0x2b, 0xb1, 0x9e, 0xef, 0xc0, 0x0d, 0x22, 0x53, 0x7c,
        0x48, 0x67, 0x16, 0x39, 0xf4, 0xdb, 0xaa, 0x85, 0x1f, 0x30, 0x41, 0x6e, 0xa3, 0x8c, 0xfd, 0xd2,
        0x95, 0xba, 0xcb, 0xe4, 0x29, 0x06, 0x77, 0x58, 0xc2, 0xed, 0x9c, 0xb3, 0x7e, 0x51, 0x20, 0x0f,
        0x3b, 0x14, 0x65, 0x4a, 0x87, 0xa8, 0xd9, 0xf6, 0x6c, 0x43, 0x32, 0x1d, 0xd0, 0xff, 0x8e, 0xa1,
        0xe3, 0xcc, 0xbd, 0x92, 0x5f, 0x70, 0x01, 0x2e, 0xb4, 0x9b, 0xea, 0xc5, 0x08, 0x27, 0x56, 0x79,
        0x4d, 0x62, 0x13, 0x3c, 0xf1, 0xde, 0xaf, 0x80, 0x1a, 0x35, 0x44, 0x6b, 0xa6, 0x89, 0xf8, 0xd7,
        0x90, 0xbf, 0xce, 0xe1, 0x2c, 0x03, 0x72, 0x5d, 0xc7, 0xe8, 0x99, 0xb6, 0x7b, 0x54, 0x25, 0x0a,
        0x3e, 0x11, 0x60, 0x4f, 0x82, 0xad, 0xdc, 0xf3, 0x69, 0x46, 0x37, 0x18, 0xd5, 0xfa, 0x8b, 0xa4,
        0x05, 0x2a, 0x5b, 0x74, 0xb9, 0x96, 0xe7, 0xc8, 0x52, 0x7d, 0x0c, 0x23, 0xee, 0xc1, 0xb0, 0x9f,
        0xab, 0x84, 0xf5, 0xda, 0x17, 0x38, 0x49, 0x66, 0xfc, 0xd3, 0xa2, 0x8d, 0x40, 0x6f, 0x1e, 0x31,
        0x76, 0x59, 0x28, 0x07, 0xca, 0xe5, 0x94, 0xbb, 0x21, 0x0e, 0x7f, 0x50, 0x9d, 0xb2, 0xc3, 0xec,
        0xd8, 0xf7, 0x86, 0xa9, 0x64, 0x4b, 0x3a, 0x15, 0x8f, 0xa0, 0xd1, 0xfe, 0x33, 0x1c, 0x6d, 0x42
    };
}

on start
{
    putValue( KCAN__NMH_ICAS1_Gateway_NM_Request, 0 );  // reset all requests
    _NM_Switch_NM_Mode();
    
    __Init_Msg();
    __Startup_Delay();
    __Reset_E2E_SQC();

    putValue( KCAN__NMH_ICAS1_Gateway_AutomaticModeActive, 0 );
    putValue( KCAN__NMH_ICAS1_Gateway_AutomaticModeActive, 1 );
}


__Init_Msg()
{
// #START_INIT#
    AAA_01_init();
    ACC_19_init();
    AGA_01_init();
    Airbag_01_init();
    Airbag_02_init();
    Airbag_04_init();
    Airbag_06_init();
    Anhaenger_01_init();
    ARA_Status_01_init();
    AWV_02_init();
    AZK_01_init();
    BCM_01_init();
    BCM_03_init();
    BCM_04_init();
    BCM_Taster_02_init();
    BCM_Taster_03_init();
    BEM_02_init();
    BEM_06_init();
    Blinkmodi_02_init();
    BMS_05_init();
    BMS_07_init();
    Bremse_EV_02_init();
    Charisma_03_init();
    Daempfer_01_init();
    Daempfer_05_init();
    DCDC_02_init();
    DIA_ABT_1_Req_init();
    Diagnose_01_init();
    DiETa_01_init();
    Dimmung_01_init();
    EA_02_init();
    ELV_01_init();
    EML_06_init();
    EML_07_init();
    Entfernungen_01_init();
    EPB_03_init();
    ESC_50_init();
    ESC_51_init();
    ESP_10_init();
    ESP_20_init();
    ESP_21_init();
    ESP_24_init();
    ESP_30_init();
    FoD_01_init();
    FoD_Kombi_Req_init();
    FoD_ZR_Req_init();
    Gateway_71_init();
    Gateway_73_init();
    Getriebe_16_init();
    Heckradar_01_init();
    HVK_01_init();
    IPA_02_init();
    ISO_Funktionaler_Req_All_init();
    ISO_HUD_Req_init();
    ISO_Kombi_Req_init();
    ISO_NFCIApp_NFCIServ_Resp_init();
    ISO_NFCIServ_NFCIApp_Req_init();
    ISOx_DispKBI_FS_Req_init();
    ISOx_DispKBI_FS_Req_FD_init();
    ISOx_Funkt_Req_All_FD_init();
    ISOx_HUD_Req_FD_init();
    ISOx_Kombi_Req_FD_init();
    ISOx_SmLi_01_Req_init();
    ISOx_SmLi_01_Req_FD_init();
    ISOx_WLC1_Req_init();
    Kessy_04_init();
    Klemmen_Status_01_init();
    Klemmen_Status_02_init();
    Klemmen_Steuerung_01_init();
    Klima_03_init();
    Klima_06_init();
    Klima_12_init();
    Klima_16_init();
    Klima_Sensor_02_init();
    KN_Gateway_init();
    KonzernrollenModus_01_init();
    KS_ICAS3Sys01_Req_FD_init();
    KS_Info_El_Req_FD_init();
    KS_Kombi_Req_FD_init();
    KS_SSN_ABT_1_Req_init();
    LDW_02_init();
    LH_EPS_01_init();
    Licht_Anf_01_init();
    Licht_hinten_01_init();
    Licht_vorne_01_init();
    LiSi_01_init();
    LWI_01_init();
    Mem_BFS_01_init();
    Mem_FS_01_init();
    MFG_01_init();
    MFL_01_init();
    MFL_02_init();
    MFL_Tasten_Kon_01_init();
    Motor_14_init();
    Motor_18_init();
    Motor_26_init();
    Motor_41_init();
    Motor_51_init();
    Motor_52_init();
    Motor_53_init();
    Motor_54_init();
    Motor_57_init();
    Motor_Hybrid_06_init();
    NFC_01_init();
    NFC_MiKo_01_init();
    OBDC_DispKBI_FS_Req_FD_init();
    OBDC_Funktionaler_Req_All_init();
    OBDC_Funktionaler_Req_All_FD_init();
    OBDC_HUD_Req_FD_init();
    OBDC_Kombi_Req_FD_init();
    OBDC_SmLi_01_Req_FD_init();
    OBDC_SSN_ABT_1_Req_init();
    OBDC_WLC1_Req_init();
    OBDx_allOBD_Req_init();
    ORU_01_init();
    Parkhilfe_01_init();
    Parkhilfe_04_init();
    Personalisierung_01_init();
    PreCrash_02_init();
    Rear_View_04_init();
    Rear_View_06_init();
    Reichweite_01_init();
    Reichweite_02_init();
    Reichweite_03_init();
    RKA_01_init();
    RLS_01_init();
    RLS_02_init();
    SAL_01_init();
    SAM_01_init();
    SMLS_01_init();
    Systeminfo_01_init();
    TA_01_init();
    Temperaturen_01_init();
    Thermo_Verbrauch_01_init();
    TM_01_init();
    TSG_BT_01_init();
    TSG_FT_01_init();
    TSG_FT_02_init();
    TSG_HBFS_01_init();
    TSG_HFS_01_init();
    UserStateServer_01_init();
    VIN_01_init();
    VLK_01_init();
    VZE_04_init();
    WBA_03_init();
    WFS_01_init();
    WFS_Transponder_Req_02_init();
    Wischer_01_init();
    WLC1_01_init();
    Zeitmaster_02_init();
    ZV_02_init();
    ZV_04_init();
    
// #START_INIT_END#
//    APPL_ECU_APM_1_init();
//    APPL_ECU_APM_2_init();
//    APPL_ECU_DRVU_1_init();
//    APPL_ECU_DRVU_2_init();
//    APPL_ECU_HIL_TO_IC1_init();
//    APPL_ECU_ORC1_init();
//    APPL_ECU_RVC_SVS1_init();
//    APPL_ECU_TGW1_init();
//    NM_APPL_AR_init();
    NM_xxx_AR_init();
//    XCP_Rq_DRVU_1_init();
//    XCP_Rq_DRVU_2_init();
//    XCP_Rq_RBTM_FL_init();
//    XCP_Rq_RBTM_FR_init();
//    XCP_Rq_RVC_SVS_init();
//    XCP_Rq_TPM_init();
}

on envVar KCAN__STOP_All_MESSAGES_DEFAULT_STARTDELAY
{
    if( getValue( this ) )
    {
        __Init_Msg();
        __Startup_Delay();
    }
}

on envVar KCAN__STOP_All_MESSAGES_SET_STARTDELAY
{
    if( getValue( this ) )
    {
        __Startup_Delay();
    }
}

__Startup_Delay()
{
//    write(" Delay setzen :__BCM_Startup_Delay");
// #START_DELAY#
    _AAA_01_Cnt = getValue( KCAN__STMSGSD_AAA_01 ) / _AAA_01_Timebase;
    _ACC_19_Cnt = getValue( KCAN__STMSGSD_ACC_19 ) / _ACC_19_Timebase;
    _AGA_01_Cnt = getValue( KCAN__STMSGSD_AGA_01 ) / _AGA_01_Timebase;
    _Airbag_01_Cnt = getValue( KCAN__STMSGSD_Airbag_01 ) / _Airbag_01_Timebase;
    _Airbag_02_Cnt = getValue( KCAN__STMSGSD_Airbag_02 ) / _Airbag_02_Timebase;
    _Airbag_04_Cnt = getValue( KCAN__STMSGSD_Airbag_04 ) / _Airbag_04_Timebase;
    _Airbag_06_Cnt = getValue( KCAN__STMSGSD_Airbag_06 ) / _Airbag_06_Timebase;
    _Anhaenger_01_Cnt = getValue( KCAN__STMSGSD_Anhaenger_01 ) / _Anhaenger_01_Timebase;
    _ARA_Status_01_Cnt = getValue( KCAN__STMSGSD_ARA_Status_01 ) / _ARA_Status_01_Timebase;
    _AWV_02_Cnt = getValue( KCAN__STMSGSD_AWV_02 ) / _AWV_02_Timebase;
    _AZK_01_Cnt = getValue( KCAN__STMSGSD_AZK_01 ) / _AZK_01_Timebase;
    _BCM_01_Cnt = getValue( KCAN__STMSGSD_BCM_01 ) / _BCM_01_Timebase;
    _BCM_03_Cnt = getValue( KCAN__STMSGSD_BCM_03 ) / _BCM_03_Timebase;
    _BCM_04_Cnt = getValue( KCAN__STMSGSD_BCM_04 ) / _BCM_04_Timebase;
    _BCM_Taster_02_Cnt = getValue( KCAN__STMSGSD_BCM_Taster_02 ) / _BCM_Taster_02_Timebase;
    _BCM_Taster_03_Cnt = getValue( KCAN__STMSGSD_BCM_Taster_03 ) / _BCM_Taster_03_Timebase;
    _BEM_02_Cnt = getValue( KCAN__STMSGSD_BEM_02 ) / _BEM_02_Timebase;
    _BEM_06_Cnt = getValue( KCAN__STMSGSD_BEM_06 ) / _BEM_06_Timebase;
    _Blinkmodi_02_Cnt = getValue( KCAN__STMSGSD_Blinkmodi_02 ) / _Blinkmodi_02_Timebase;
    _BMS_05_Cnt = getValue( KCAN__STMSGSD_BMS_05 ) / _BMS_05_Timebase;
    _BMS_07_Cnt = getValue( KCAN__STMSGSD_BMS_07 ) / _BMS_07_Timebase;
    _Bremse_EV_02_Cnt = getValue( KCAN__STMSGSD_Bremse_EV_02 ) / _Bremse_EV_02_Timebase;
    _Charisma_03_Cnt = getValue( KCAN__STMSGSD_Charisma_03 ) / _Charisma_03_Timebase;
    _Daempfer_01_Cnt = getValue( KCAN__STMSGSD_Daempfer_01 ) / _Daempfer_01_Timebase;
    _Daempfer_05_Cnt = getValue( KCAN__STMSGSD_Daempfer_05 ) / _Daempfer_05_Timebase;
    _DCDC_02_Cnt = getValue( KCAN__STMSGSD_DCDC_02 ) / _DCDC_02_Timebase;
    _DIA_ABT_1_Req_Cnt = getValue( KCAN__STMSGSD_DIA_ABT_1_Req ) / _DIA_ABT_1_Req_Timebase;
    _Diagnose_01_Cnt = getValue( KCAN__STMSGSD_Diagnose_01 ) / _Diagnose_01_Timebase;
    _DiETa_01_Cnt = getValue( KCAN__STMSGSD_DiETa_01 ) / _DiETa_01_Timebase;
    _Dimmung_01_Cnt = getValue( KCAN__STMSGSD_Dimmung_01 ) / _Dimmung_01_Timebase;
    _EA_02_Cnt = getValue( KCAN__STMSGSD_EA_02 ) / _EA_02_Timebase;
    _ELV_01_Cnt = getValue( KCAN__STMSGSD_ELV_01 ) / _ELV_01_Timebase;
    _EML_06_Cnt = getValue( KCAN__STMSGSD_EML_06 ) / _EML_06_Timebase;
    _EML_07_Cnt = getValue( KCAN__STMSGSD_EML_07 ) / _EML_07_Timebase;
    _Entfernungen_01_Cnt = getValue( KCAN__STMSGSD_Entfernungen_01 ) / _Entfernungen_01_Timebase;
    _EPB_03_Cnt = getValue( KCAN__STMSGSD_EPB_03 ) / _EPB_03_Timebase;
    _ESC_50_Cnt = getValue( KCAN__STMSGSD_ESC_50 ) / _ESC_50_Timebase;
    _ESC_51_Cnt = getValue( KCAN__STMSGSD_ESC_51 ) / _ESC_51_Timebase;
    _ESP_10_Cnt = getValue( KCAN__STMSGSD_ESP_10 ) / _ESP_10_Timebase;
    _ESP_20_Cnt = getValue( KCAN__STMSGSD_ESP_20 ) / _ESP_20_Timebase;
    _ESP_21_Cnt = getValue( KCAN__STMSGSD_ESP_21 ) / _ESP_21_Timebase;
    _ESP_24_Cnt = getValue( KCAN__STMSGSD_ESP_24 ) / _ESP_24_Timebase;
    _ESP_30_Cnt = getValue( KCAN__STMSGSD_ESP_30 ) / _ESP_30_Timebase;
    _FoD_01_Cnt = getValue( KCAN__STMSGSD_FoD_01 ) / _FoD_01_Timebase;
    _FoD_Kombi_Req_Cnt = getValue( KCAN__STMSGSD_FoD_Kombi_Req ) / _FoD_Kombi_Req_Timebase;
    _FoD_ZR_Req_Cnt = getValue( KCAN__STMSGSD_FoD_ZR_Req ) / _FoD_ZR_Req_Timebase;
    _Gateway_71_Cnt = getValue( KCAN__STMSGSD_Gateway_71 ) / _Gateway_71_Timebase;
    _Gateway_73_Cnt = getValue( KCAN__STMSGSD_Gateway_73 ) / _Gateway_73_Timebase;
    _Getriebe_16_Cnt = getValue( KCAN__STMSGSD_Getriebe_16 ) / _Getriebe_16_Timebase;
    _Heckradar_01_Cnt = getValue( KCAN__STMSGSD_Heckradar_01 ) / _Heckradar_01_Timebase;
    _HVK_01_Cnt = getValue( KCAN__STMSGSD_HVK_01 ) / _HVK_01_Timebase;
    _IPA_02_Cnt = getValue( KCAN__STMSGSD_IPA_02 ) / _IPA_02_Timebase;
    _ISO_Funktionaler_Req_All_Cnt = getValue( KCAN__STMSGSD_ISO_Funktionaler_Req_All ) / _ISO_Funktionaler_Req_All_Timebase;
    _ISO_HUD_Req_Cnt = getValue( KCAN__STMSGSD_ISO_HUD_Req ) / _ISO_HUD_Req_Timebase;
    _ISO_Kombi_Req_Cnt = getValue( KCAN__STMSGSD_ISO_Kombi_Req ) / _ISO_Kombi_Req_Timebase;
    _ISO_NFCIApp_NFCIServ_Resp_Cnt = getValue( KCAN__STMSGSD_ISO_NFCIApp_NFCIServ_Resp ) / _ISO_NFCIApp_NFCIServ_Resp_Timebase;
    _ISO_NFCIServ_NFCIApp_Req_Cnt = getValue( KCAN__STMSGSD_ISO_NFCIServ_NFCIApp_Req ) / _ISO_NFCIServ_NFCIApp_Req_Timebase;
    _ISOx_DispKBI_FS_Req_Cnt = getValue( KCAN__STMSGSD_ISOx_DispKBI_FS_Req ) / _ISOx_DispKBI_FS_Req_Timebase;
    _ISOx_DispKBI_FS_Req_FD_Cnt = getValue( KCAN__STMSGSD_ISOx_DispKBI_FS_Req_FD ) / _ISOx_DispKBI_FS_Req_FD_Timebase;
    _ISOx_Funkt_Req_All_FD_Cnt = getValue( KCAN__STMSGSD_ISOx_Funkt_Req_All_FD ) / _ISOx_Funkt_Req_All_FD_Timebase;
    _ISOx_HUD_Req_FD_Cnt = getValue( KCAN__STMSGSD_ISOx_HUD_Req_FD ) / _ISOx_HUD_Req_FD_Timebase;
    _ISOx_Kombi_Req_FD_Cnt = getValue( KCAN__STMSGSD_ISOx_Kombi_Req_FD ) / _ISOx_Kombi_Req_FD_Timebase;
    _ISOx_SmLi_01_Req_Cnt = getValue( KCAN__STMSGSD_ISOx_SmLi_01_Req ) / _ISOx_SmLi_01_Req_Timebase;
    _ISOx_SmLi_01_Req_FD_Cnt = getValue( KCAN__STMSGSD_ISOx_SmLi_01_Req_FD ) / _ISOx_SmLi_01_Req_FD_Timebase;
    _ISOx_WLC1_Req_Cnt = getValue( KCAN__STMSGSD_ISOx_WLC1_Req ) / _ISOx_WLC1_Req_Timebase;
    _Kessy_04_Cnt = getValue( KCAN__STMSGSD_Kessy_04 ) / _Kessy_04_Timebase;
    _Klemmen_Status_01_Cnt = getValue( KCAN__STMSGSD_Klemmen_Status_01 ) / _Klemmen_Status_01_Timebase;
    _Klemmen_Status_02_Cnt = getValue( KCAN__STMSGSD_Klemmen_Status_02 ) / _Klemmen_Status_02_Timebase;
    _Klemmen_Steuerung_01_Cnt = getValue( KCAN__STMSGSD_Klemmen_Steuerung_01 ) / _Klemmen_Steuerung_01_Timebase;
    _Klima_03_Cnt = getValue( KCAN__STMSGSD_Klima_03 ) / _Klima_03_Timebase;
    _Klima_06_Cnt = getValue( KCAN__STMSGSD_Klima_06 ) / _Klima_06_Timebase;
    _Klima_12_Cnt = getValue( KCAN__STMSGSD_Klima_12 ) / _Klima_12_Timebase;
    _Klima_16_Cnt = getValue( KCAN__STMSGSD_Klima_16 ) / _Klima_16_Timebase;
    _Klima_Sensor_02_Cnt = getValue( KCAN__STMSGSD_Klima_Sensor_02 ) / _Klima_Sensor_02_Timebase;
    _KN_Gateway_Cnt = getValue( KCAN__STMSGSD_KN_Gateway ) / _KN_Gateway_Timebase;
    _KonzernrollenModus_01_Cnt = getValue( KCAN__STMSGSD_KonzernrollenModus_01 ) / _KonzernrollenModus_01_Timebase;
    _KS_ICAS3Sys01_Req_FD_Cnt = getValue( KCAN__STMSGSD_KS_ICAS3Sys01_Req_FD ) / _KS_ICAS3Sys01_Req_FD_Timebase;
    _KS_Info_El_Req_FD_Cnt = getValue( KCAN__STMSGSD_KS_Info_El_Req_FD ) / _KS_Info_El_Req_FD_Timebase;
    _KS_Kombi_Req_FD_Cnt = getValue( KCAN__STMSGSD_KS_Kombi_Req_FD ) / _KS_Kombi_Req_FD_Timebase;
    _KS_SSN_ABT_1_Req_Cnt = getValue( KCAN__STMSGSD_KS_SSN_ABT_1_Req ) / _KS_SSN_ABT_1_Req_Timebase;
    _LDW_02_Cnt = getValue( KCAN__STMSGSD_LDW_02 ) / _LDW_02_Timebase;
    _LH_EPS_01_Cnt = getValue( KCAN__STMSGSD_LH_EPS_01 ) / _LH_EPS_01_Timebase;
    _Licht_Anf_01_Cnt = getValue( KCAN__STMSGSD_Licht_Anf_01 ) / _Licht_Anf_01_Timebase;
    _Licht_hinten_01_Cnt = getValue( KCAN__STMSGSD_Licht_hinten_01 ) / _Licht_hinten_01_Timebase;
    _Licht_vorne_01_Cnt = getValue( KCAN__STMSGSD_Licht_vorne_01 ) / _Licht_vorne_01_Timebase;
    _LiSi_01_Cnt = getValue( KCAN__STMSGSD_LiSi_01 ) / _LiSi_01_Timebase;
    _LWI_01_Cnt = getValue( KCAN__STMSGSD_LWI_01 ) / _LWI_01_Timebase;
    _Mem_BFS_01_Cnt = getValue( KCAN__STMSGSD_Mem_BFS_01 ) / _Mem_BFS_01_Timebase;
    _Mem_FS_01_Cnt = getValue( KCAN__STMSGSD_Mem_FS_01 ) / _Mem_FS_01_Timebase;
    _MFG_01_Cnt = getValue( KCAN__STMSGSD_MFG_01 ) / _MFG_01_Timebase;
    _MFL_01_Cnt = getValue( KCAN__STMSGSD_MFL_01 ) / _MFL_01_Timebase;
    _MFL_02_Cnt = getValue( KCAN__STMSGSD_MFL_02 ) / _MFL_02_Timebase;
    _MFL_Tasten_Kon_01_Cnt = getValue( KCAN__STMSGSD_MFL_Tasten_Kon_01 ) / _MFL_Tasten_Kon_01_Timebase;
    _Motor_14_Cnt = getValue( KCAN__STMSGSD_Motor_14 ) / _Motor_14_Timebase;
    _Motor_18_Cnt = getValue( KCAN__STMSGSD_Motor_18 ) / _Motor_18_Timebase;
    _Motor_26_Cnt = getValue( KCAN__STMSGSD_Motor_26 ) / _Motor_26_Timebase;
    _Motor_41_Cnt = getValue( KCAN__STMSGSD_Motor_41 ) / _Motor_41_Timebase;
    _Motor_51_Cnt = getValue( KCAN__STMSGSD_Motor_51 ) / _Motor_51_Timebase;
    _Motor_52_Cnt = getValue( KCAN__STMSGSD_Motor_52 ) / _Motor_52_Timebase;
    _Motor_53_Cnt = getValue( KCAN__STMSGSD_Motor_53 ) / _Motor_53_Timebase;
    _Motor_54_Cnt = getValue( KCAN__STMSGSD_Motor_54 ) / _Motor_54_Timebase;
    _Motor_57_Cnt = getValue( KCAN__STMSGSD_Motor_57 ) / _Motor_57_Timebase;
    _Motor_Hybrid_06_Cnt = getValue( KCAN__STMSGSD_Motor_Hybrid_06 ) / _Motor_Hybrid_06_Timebase;
    _NFC_01_Cnt = getValue( KCAN__STMSGSD_NFC_01 ) / _NFC_01_Timebase;
    _NFC_MiKo_01_Cnt = getValue( KCAN__STMSGSD_NFC_MiKo_01 ) / _NFC_MiKo_01_Timebase;
    _OBDC_DispKBI_FS_Req_FD_Cnt = getValue( KCAN__STMSGSD_OBDC_DispKBI_FS_Req_FD ) / _OBDC_DispKBI_FS_Req_FD_Timebase;
    _OBDC_Funktionaler_Req_All_Cnt = getValue( KCAN__STMSGSD_OBDC_Funktionaler_Req_All ) / _OBDC_Funktionaler_Req_All_Timebase;
    _OBDC_Funktionaler_Req_All_FD_Cnt = getValue( KCAN__STMSGSD_OBDC_Funktionaler_Req_All_FD ) / _OBDC_Funktionaler_Req_All_FD_Timebase;
    _OBDC_HUD_Req_FD_Cnt = getValue( KCAN__STMSGSD_OBDC_HUD_Req_FD ) / _OBDC_HUD_Req_FD_Timebase;
    _OBDC_Kombi_Req_FD_Cnt = getValue( KCAN__STMSGSD_OBDC_Kombi_Req_FD ) / _OBDC_Kombi_Req_FD_Timebase;
    _OBDC_SmLi_01_Req_FD_Cnt = getValue( KCAN__STMSGSD_OBDC_SmLi_01_Req_FD ) / _OBDC_SmLi_01_Req_FD_Timebase;
    _OBDC_SSN_ABT_1_Req_Cnt = getValue( KCAN__STMSGSD_OBDC_SSN_ABT_1_Req ) / _OBDC_SSN_ABT_1_Req_Timebase;
    _OBDC_WLC1_Req_Cnt = getValue( KCAN__STMSGSD_OBDC_WLC1_Req ) / _OBDC_WLC1_Req_Timebase;
    _OBDx_allOBD_Req_Cnt = getValue( KCAN__STMSGSD_OBDx_allOBD_Req ) / _OBDx_allOBD_Req_Timebase;
    _ORU_01_Cnt = getValue( KCAN__STMSGSD_ORU_01 ) / _ORU_01_Timebase;
    _Parkhilfe_01_Cnt = getValue( KCAN__STMSGSD_Parkhilfe_01 ) / _Parkhilfe_01_Timebase;
    _Parkhilfe_04_Cnt = getValue( KCAN__STMSGSD_Parkhilfe_04 ) / _Parkhilfe_04_Timebase;
    _Personalisierung_01_Cnt = getValue( KCAN__STMSGSD_Personalisierung_01 ) / _Personalisierung_01_Timebase;
    _PreCrash_02_Cnt = getValue( KCAN__STMSGSD_PreCrash_02 ) / _PreCrash_02_Timebase;
    _Rear_View_04_Cnt = getValue( KCAN__STMSGSD_Rear_View_04 ) / _Rear_View_04_Timebase;
    _Rear_View_06_Cnt = getValue( KCAN__STMSGSD_Rear_View_06 ) / _Rear_View_06_Timebase;
    _Reichweite_01_Cnt = getValue( KCAN__STMSGSD_Reichweite_01 ) / _Reichweite_01_Timebase;
    _Reichweite_02_Cnt = getValue( KCAN__STMSGSD_Reichweite_02 ) / _Reichweite_02_Timebase;
    _Reichweite_03_Cnt = getValue( KCAN__STMSGSD_Reichweite_03 ) / _Reichweite_03_Timebase;
    _RKA_01_Cnt = getValue( KCAN__STMSGSD_RKA_01 ) / _RKA_01_Timebase;
    _RLS_01_Cnt = getValue( KCAN__STMSGSD_RLS_01 ) / _RLS_01_Timebase;
    _RLS_02_Cnt = getValue( KCAN__STMSGSD_RLS_02 ) / _RLS_02_Timebase;
    _SAL_01_Cnt = getValue( KCAN__STMSGSD_SAL_01 ) / _SAL_01_Timebase;
    _SAM_01_Cnt = getValue( KCAN__STMSGSD_SAM_01 ) / _SAM_01_Timebase;
    _SMLS_01_Cnt = getValue( KCAN__STMSGSD_SMLS_01 ) / _SMLS_01_Timebase;
    _Systeminfo_01_Cnt = getValue( KCAN__STMSGSD_Systeminfo_01 ) / _Systeminfo_01_Timebase;
    _TA_01_Cnt = getValue( KCAN__STMSGSD_TA_01 ) / _TA_01_Timebase;
    _Temperaturen_01_Cnt = getValue( KCAN__STMSGSD_Temperaturen_01 ) / _Temperaturen_01_Timebase;
    _Thermo_Verbrauch_01_Cnt = getValue( KCAN__STMSGSD_Thermo_Verbrauch_01 ) / _Thermo_Verbrauch_01_Timebase;
    _TM_01_Cnt = getValue( KCAN__STMSGSD_TM_01 ) / _TM_01_Timebase;
    _TSG_BT_01_Cnt = getValue( KCAN__STMSGSD_TSG_BT_01 ) / _TSG_BT_01_Timebase;
    _TSG_FT_01_Cnt = getValue( KCAN__STMSGSD_TSG_FT_01 ) / _TSG_FT_01_Timebase;
    _TSG_FT_02_Cnt = getValue( KCAN__STMSGSD_TSG_FT_02 ) / _TSG_FT_02_Timebase;
    _TSG_HBFS_01_Cnt = getValue( KCAN__STMSGSD_TSG_HBFS_01 ) / _TSG_HBFS_01_Timebase;
    _TSG_HFS_01_Cnt = getValue( KCAN__STMSGSD_TSG_HFS_01 ) / _TSG_HFS_01_Timebase;
    _UserStateServer_01_Cnt = getValue( KCAN__STMSGSD_UserStateServer_01 ) / _UserStateServer_01_Timebase;
    _VIN_01_Cnt = getValue( KCAN__STMSGSD_VIN_01 ) / _VIN_01_Timebase;
    _VLK_01_Cnt = getValue( KCAN__STMSGSD_VLK_01 ) / _VLK_01_Timebase;
    _VZE_04_Cnt = getValue( KCAN__STMSGSD_VZE_04 ) / _VZE_04_Timebase;
    _WBA_03_Cnt = getValue( KCAN__STMSGSD_WBA_03 ) / _WBA_03_Timebase;
    _WFS_01_Cnt = getValue( KCAN__STMSGSD_WFS_01 ) / _WFS_01_Timebase;
    _WFS_Transponder_Req_02_Cnt = getValue( KCAN__STMSGSD_WFS_Transponder_Req_02 ) / _WFS_Transponder_Req_02_Timebase;
    _Wischer_01_Cnt = getValue( KCAN__STMSGSD_Wischer_01 ) / _Wischer_01_Timebase;
    _WLC1_01_Cnt = getValue( KCAN__STMSGSD_WLC1_01 ) / _WLC1_01_Timebase;
    _Zeitmaster_02_Cnt = getValue( KCAN__STMSGSD_Zeitmaster_02 ) / _Zeitmaster_02_Timebase;
    _ZV_02_Cnt = getValue( KCAN__STMSGSD_ZV_02 ) / _ZV_02_Timebase;
    _ZV_04_Cnt = getValue( KCAN__STMSGSD_ZV_04 ) / _ZV_04_Timebase;

// #START_DELAY_END#
}

__Reset_E2E_SQC()
{
    putValue( KCAN_AAA_01_BZ, 15 );
    putValue( KCAN_Airbag_01_BZ, 15 );
    putValue( KCAN_Airbag_02_BZ, 15 );
    putValue( KCAN_Airbag_04_BZ, 15 );
    putValue( KCAN_AAG_BZ, 15 );
    putValue( KCAN_BEM_06_BZ, 15 );
    putValue( KCAN_Blinkmodi_02_BZ, 15 );
    putValue( KCAN_BMS_07_BZ, 15 );
    putValue( KCAN_Bremse_EV_02_BZ, 15 );
    putValue( KCAN_DCDC_02_BZ, 15 );
    putValue( KCAN_DiETas_01_BZ, 15 );
    putValue( KCAN_EA_02_BZ, 15 );
    putValue( KCAN_ELV_01_BZ, 15 );
    putValue( KCAN_EML_06_BZ, 15 );
    putValue( KCAN_EPB_03_BZ, 15 );
    putValue( KCAN_ESC_50_BZ, 15 );
    putValue( KCAN_ESC_51_BZ, 15 );
    putValue( KCAN_ESP_10_BZ, 15 );
    putValue( KCAN_ESP_20_BZ, 15 );
    putValue( KCAN_ESP_21_BZ, 15 );
    putValue( KCAN_ESP_24_BZ, 15 );
    putValue( KCAN_ESP_30_BZ, 15 );
    putValue( KCAN_Getriebe_16_BZ, 15 );
    putValue( KCAN_HVK_01_BZ, 15 );
    putValue( KCAN_IPA_02_BZ, 15 );
    putValue( KCAN_Klemmen_Status_01_BZ, 15 );
    putValue( KCAN_Klemmen_Steuerung_01_BZ, 15 );
    putValue( KCAN_EPS_01_BZ, 15 );
    putValue( KCAN_Licht_Anf_01_BZ, 15 );
    putValue( KCAN_Licht_hinten_01_BZ, 15 );
    putValue( KCAN_LTM_01_BZ, 15 );
    putValue( KCAN_LWI_01_BZ, 15 );
    putValue( KCAN_MFG_01_BZ, 15 );
    putValue( KCAN_Motor_14_BZ, 15 );
    putValue( KCAN_Motor_51_BZ, 15 );
    putValue( KCAN_Motor_54_BZ, 15 );
    putValue( KCAN_Motor_57_BZ, 15 );
    putValue( KCAN_RLS_02_BZ, 15 );
    putValue( KCAN_SAL_01_BZ, 15 );
    putValue( KCAN_SAM_01_BZ, 15 );
    putValue( KCAN_SMLS_01_BZ, 15 );
    putValue( KCAN_TA_01_BZ, 15 );
    putValue( KCAN_TSG_FT_02_BZ, 15 );
    putValue( KCAN_WBA_03_BZ, 15 );
    putValue( KCAN_ZV_04_BZ, 15 );

//    write(" E2E-simu: Reset SQC to 15 ");
}


on Timer t_DBKomTimer_5ms
{
// *** DBKom-Sendefunktion ***
    // timer aufziehen für nächsten Zyklus
    if( getValue( KCAN__NMH_ICAS1_Gateway_CommActive ) )
    {
        setTimer( t_DBKomTimer_5ms, c_tDBKomTimer_5ms );
    }
// #CYC_TIMER_5_MS_START#
    ACC_19_check_output();
    Airbag_01_check_output();
    Blinkmodi_02_check_output();
    BMS_05_check_output();
    DCDC_02_check_output();
    DIA_ABT_1_Req_check_output();
    DiETa_01_check_output();
    EML_06_check_output();
    EML_07_check_output();
    ESP_10_check_output();
    ESP_24_check_output();
    FoD_Kombi_Req_check_output();
    FoD_ZR_Req_check_output();
    Gateway_73_check_output();
    Getriebe_16_check_output();
    Heckradar_01_check_output();
    ISO_Funktionaler_Req_All_check_output();
    ISO_HUD_Req_check_output();
    ISO_Kombi_Req_check_output();
    ISO_NFCIApp_NFCIServ_Resp_check_output();
    ISO_NFCIServ_NFCIApp_Req_check_output();
    ISOx_DispKBI_FS_Req_check_output();
    ISOx_DispKBI_FS_Req_FD_check_output();
    ISOx_Funkt_Req_All_FD_check_output();
    ISOx_HUD_Req_FD_check_output();
    ISOx_Kombi_Req_FD_check_output();
    ISOx_SmLi_01_Req_check_output();
    ISOx_SmLi_01_Req_FD_check_output();
    ISOx_WLC1_Req_check_output();
    KS_ICAS3Sys01_Req_FD_check_output();
    KS_Info_El_Req_FD_check_output();
    KS_Kombi_Req_FD_check_output();
    KS_SSN_ABT_1_Req_check_output();
    LH_EPS_01_check_output();
    LiSi_01_check_output();
    Motor_51_check_output();
    Motor_52_check_output();
    Motor_53_check_output();
    OBDC_DispKBI_FS_Req_FD_check_output();
    OBDC_Funktionaler_Req_All_check_output();
    OBDC_Funktionaler_Req_All_FD_check_output();
    OBDC_HUD_Req_FD_check_output();
    OBDC_Kombi_Req_FD_check_output();
    OBDC_SmLi_01_Req_FD_check_output();
    OBDC_SSN_ABT_1_Req_check_output();
    OBDC_WLC1_Req_check_output();
    OBDx_allOBD_Req_check_output();
    RLS_02_check_output();
    SAL_01_check_output();

    /*
    _check_output();
    */
    
    
    
// #CYC_TIMER_5_MS_END#
}

on Timer t_DBKomTimer_20ms
{
// *** DBKom-Transmit-function ***
    // rearm timer for the next cycle
    if( getValue( KCAN__NMH_ICAS1_Gateway_CommActive ) )
    {
        setTimer( t_DBKomTimer_20ms, c_tDBKomTimer_20ms );
    }
// #CYC_TIMER_20_MS#
    AAA_01_check_output();
    AGA_01_check_output();
    Airbag_02_check_output();
    Airbag_04_check_output();
    Airbag_06_check_output();
    Anhaenger_01_check_output();
    ARA_Status_01_check_output();
    AWV_02_check_output();
    AZK_01_check_output();
    BCM_01_check_output();
    BCM_03_check_output();
    BCM_04_check_output();
    BCM_Taster_02_check_output();
    BCM_Taster_03_check_output();
    BEM_02_check_output();
    BEM_06_check_output();
    BMS_07_check_output();
    Bremse_EV_02_check_output();
    Charisma_03_check_output();
    Daempfer_01_check_output();
    Daempfer_05_check_output();
    Diagnose_01_check_output();
    Dimmung_01_check_output();
    EA_02_check_output();
    ELV_01_check_output();
    Entfernungen_01_check_output();
    EPB_03_check_output();
    ESC_50_check_output();
    ESC_51_check_output();
    ESP_20_check_output();
    ESP_21_check_output();
    ESP_30_check_output();
    FoD_01_check_output();
    Gateway_71_check_output();
    HVK_01_check_output();
    IPA_02_check_output();
    Kessy_04_check_output();
    Klemmen_Status_01_check_output();
    Klemmen_Status_02_check_output();
    Klemmen_Steuerung_01_check_output();
    Klima_03_check_output();
    Klima_06_check_output();
    Klima_12_check_output();
    Klima_16_check_output();
    Klima_Sensor_02_check_output();
    KN_Gateway_check_output();
    KonzernrollenModus_01_check_output();
    LDW_02_check_output();
    Licht_Anf_01_check_output();
    Licht_hinten_01_check_output();
    Licht_vorne_01_check_output();
    LWI_01_check_output();
    Mem_BFS_01_check_output();
    Mem_FS_01_check_output();
    MFG_01_check_output();
    MFL_01_check_output();
    MFL_02_check_output();
    MFL_Tasten_Kon_01_check_output();
    Motor_14_check_output();
    Motor_18_check_output();
    Motor_26_check_output();
    Motor_41_check_output();
    Motor_54_check_output();
    Motor_57_check_output();
    Motor_Hybrid_06_check_output();
    NFC_01_check_output();
    NFC_MiKo_01_check_output();
    ORU_01_check_output();
    Parkhilfe_01_check_output();
    Parkhilfe_04_check_output();
    Personalisierung_01_check_output();
    PreCrash_02_check_output();
    Rear_View_04_check_output();
    Rear_View_06_check_output();
    Reichweite_01_check_output();
    Reichweite_02_check_output();
    Reichweite_03_check_output();
    RKA_01_check_output();
    RLS_01_check_output();
    SAM_01_check_output();
    SMLS_01_check_output();
    Systeminfo_01_check_output();
    TA_01_check_output();
    Temperaturen_01_check_output();
    Thermo_Verbrauch_01_check_output();
    TM_01_check_output();
    TSG_BT_01_check_output();
    TSG_FT_01_check_output();
    TSG_FT_02_check_output();
    TSG_HBFS_01_check_output();
    TSG_HFS_01_check_output();
    UserStateServer_01_check_output();
    VIN_01_check_output();
    VLK_01_check_output();
    VZE_04_check_output();
    WBA_03_check_output();
    WFS_01_check_output();
    WFS_Transponder_Req_02_check_output();
    Wischer_01_check_output();
    WLC1_01_check_output();
    Zeitmaster_02_check_output();
    ZV_02_check_output();
    ZV_04_check_output();

    /*
    _check_output();
    */
    
// #CYC_TIMER_20_MS_END#
//    NM_xxx_AR_check_output();
}

on EnvVar KCAN__SAVE_PANEL_CONFIG
{
    dword hFile;

    if( getValue(this) )
    {
        write("Saving HMI Panel Variables ...");

        hFile = openFileWrite( "CONFIG\\HMI_PRESETS.ASC", 0 );
        filePutString( "base hex timestamps absolute\n", 31, hFile );

// #MSG_SAVEENVVAR#
   //     AAA_01_saveEnvVars( hFile );
   //     AGA_01_saveEnvVars( hFile );
   //     Airbag_02_saveEnvVars( hFile );
   //     Airbag_04_saveEnvVars( hFile );
   //     Airbag_06_saveEnvVars( hFile );
   //     Anhaenger_01_saveEnvVars( hFile );
   //     ARA_Status_01_saveEnvVars( hFile );
   //     AWV_02_saveEnvVars( hFile );
   //     AZK_01_saveEnvVars( hFile );
   //     BCM_01_saveEnvVars( hFile );
   //     BCM_03_saveEnvVars( hFile );
   //     BCM_04_saveEnvVars( hFile );
   //     BCM_Taster_02_saveEnvVars( hFile );
   //     BCM_Taster_03_saveEnvVars( hFile );
   //     BEM_02_saveEnvVars( hFile );
   //     BEM_06_saveEnvVars( hFile );
   //     Blinkmodi_02_saveEnvVars( hFile );
   //     BMS_07_saveEnvVars( hFile );
   //     Bremse_EV_02_saveEnvVars( hFile );
   //     Charisma_03_saveEnvVars( hFile );
   //     Daempfer_01_saveEnvVars( hFile );
   //     Daempfer_05_saveEnvVars( hFile );
   //     Diagnose_01_saveEnvVars( hFile );
   //     Dimmung_01_saveEnvVars( hFile );
   //     EA_02_saveEnvVars( hFile );
   //     ELV_01_saveEnvVars( hFile );
   //     Entfernungen_01_saveEnvVars( hFile );
   //     EPB_03_saveEnvVars( hFile );
   //     ESC_50_saveEnvVars( hFile );
   //     ESC_51_saveEnvVars( hFile );
   //     ESP_20_saveEnvVars( hFile );
   //     ESP_21_saveEnvVars( hFile );
   //     ESP_30_saveEnvVars( hFile );
   //     FoD_01_saveEnvVars( hFile );
   //     Gateway_71_saveEnvVars( hFile );
   //     HVK_01_saveEnvVars( hFile );
   //     IPA_02_saveEnvVars( hFile );
   //     Kessy_04_saveEnvVars( hFile );
   //     Klemmen_Status_01_saveEnvVars( hFile );
   //     Klemmen_Status_02_saveEnvVars( hFile );
   //     Klemmen_Steuerung_01_saveEnvVars( hFile );
   //     Klima_03_saveEnvVars( hFile );
   //     Klima_06_saveEnvVars( hFile );
   //     Klima_12_saveEnvVars( hFile );
   //     Klima_16_saveEnvVars( hFile );
   //     Klima_Sensor_02_saveEnvVars( hFile );
   //     KN_Gateway_saveEnvVars( hFile );
   //     KonzernrollenModus_01_saveEnvVars( hFile );
   //     LDW_02_saveEnvVars( hFile );
   //     Licht_Anf_01_saveEnvVars( hFile );
   //     Licht_hinten_01_saveEnvVars( hFile );
   //     Licht_vorne_01_saveEnvVars( hFile );
   //     LWI_01_saveEnvVars( hFile );
   //     Mem_BFS_01_saveEnvVars( hFile );
   //     Mem_FS_01_saveEnvVars( hFile );
   //     MFG_01_saveEnvVars( hFile );
   //     MFL_01_saveEnvVars( hFile );
   //     MFL_02_saveEnvVars( hFile );
   //     MFL_Tasten_Kon_01_saveEnvVars( hFile );
   //     Motor_14_saveEnvVars( hFile );
   //     Motor_18_saveEnvVars( hFile );
   //     Motor_26_saveEnvVars( hFile );
   //     Motor_41_saveEnvVars( hFile );
   //     Motor_54_saveEnvVars( hFile );
   //     Motor_57_saveEnvVars( hFile );
   //     Motor_Hybrid_06_saveEnvVars( hFile );
   //     NFC_01_saveEnvVars( hFile );
   //     NFC_MiKo_01_saveEnvVars( hFile );
   //     ORU_01_saveEnvVars( hFile );
   //     Parkhilfe_01_saveEnvVars( hFile );
   //     Parkhilfe_04_saveEnvVars( hFile );
   //     Personalisierung_01_saveEnvVars( hFile );
   //     PreCrash_02_saveEnvVars( hFile );
   //     Rear_View_04_saveEnvVars( hFile );
   //     Rear_View_06_saveEnvVars( hFile );
   //     Reichweite_01_saveEnvVars( hFile );
   //     Reichweite_02_saveEnvVars( hFile );
   //     Reichweite_03_saveEnvVars( hFile );
   //     RKA_01_saveEnvVars( hFile );
   //     RLS_01_saveEnvVars( hFile );
   //     SAM_01_saveEnvVars( hFile );
   //     SMLS_01_saveEnvVars( hFile );
   //     Systeminfo_01_saveEnvVars( hFile );
   //     TA_01_saveEnvVars( hFile );
   //     Temperaturen_01_saveEnvVars( hFile );
   //     Thermo_Verbrauch_01_saveEnvVars( hFile );
   //     TM_01_saveEnvVars( hFile );
   //     TSG_BT_01_saveEnvVars( hFile );
   //     TSG_FT_01_saveEnvVars( hFile );
   //     TSG_FT_02_saveEnvVars( hFile );
   //     TSG_HBFS_01_saveEnvVars( hFile );
   //     TSG_HFS_01_saveEnvVars( hFile );
   //     UserStateServer_01_saveEnvVars( hFile );
   //     VIN_01_saveEnvVars( hFile );
   //     VLK_01_saveEnvVars( hFile );
   //     VZE_04_saveEnvVars( hFile );
   //     WBA_03_saveEnvVars( hFile );
   //     WFS_01_saveEnvVars( hFile );
   //     WFS_Transponder_Req_02_saveEnvVars( hFile );
   //     Wischer_01_saveEnvVars( hFile );
   //     WLC1_01_saveEnvVars( hFile );
   //     Zeitmaster_02_saveEnvVars( hFile );
   //     ZV_02_saveEnvVars( hFile );
   //     ZV_04_saveEnvVars( hFile );


// #MSG_SAVEENVVAR_END#
        NM_xxx_AR_saveEnvVars( hFile );

        fileClose(hFile );
    }
}

on EnvVar KCAN__STOP_ICAS1_Gateway_MESSAGES_OFF
{
    if( getValue(this) )
    {
// #MSG_OFF#
        putValue( KCAN__STMSGT_AAA_01_CTRL, 4 );
        putValue( KCAN__STMSGT_AGA_01_CTRL, 4 );
        putValue( KCAN__STMSGT_Airbag_02_CTRL, 4 );
        putValue( KCAN__STMSGT_Airbag_04_CTRL, 4 );
        putValue( KCAN__STMSGT_Airbag_06_CTRL, 4 );
        putValue( KCAN__STMSGT_Anhaenger_01_CTRL, 4 );
        putValue( KCAN__STMSGT_ARA_Status_01_CTRL, 4 );
        putValue( KCAN__STMSGT_AWV_02_CTRL, 4 );
        putValue( KCAN__STMSGT_AZK_01_CTRL, 4 );
        putValue( KCAN__STMSGT_BCM_01_CTRL, 4 );
        putValue( KCAN__STMSGT_BCM_03_CTRL, 4 );
        putValue( KCAN__STMSGT_BCM_04_CTRL, 4 );
        putValue( KCAN__STMSGT_BCM_Taster_02_CTRL, 4 );
        putValue( KCAN__STMSGT_BCM_Taster_03_CTRL, 4 );
        putValue( KCAN__STMSGT_BEM_02_CTRL, 4 );
        putValue( KCAN__STMSGT_BEM_06_CTRL, 4 );
        putValue( KCAN__STMSGT_Blinkmodi_02_CTRL, 4 );
        putValue( KCAN__STMSGT_BMS_07_CTRL, 4 );
        putValue( KCAN__STMSGT_Bremse_EV_02_CTRL, 4 );
        putValue( KCAN__STMSGT_Charisma_03_CTRL, 4 );
        putValue( KCAN__STMSGT_Daempfer_01_CTRL, 4 );
        putValue( KCAN__STMSGT_Daempfer_05_CTRL, 4 );
        putValue( KCAN__STMSGT_Diagnose_01_CTRL, 4 );
        putValue( KCAN__STMSGT_Dimmung_01_CTRL, 4 );
        putValue( KCAN__STMSGT_EA_02_CTRL, 4 );
        putValue( KCAN__STMSGT_ELV_01_CTRL, 4 );
        putValue( KCAN__STMSGT_Entfernungen_01_CTRL, 4 );
        putValue( KCAN__STMSGT_EPB_03_CTRL, 4 );
        putValue( KCAN__STMSGT_ESC_50_CTRL, 4 );
        putValue( KCAN__STMSGT_ESC_51_CTRL, 4 );
        putValue( KCAN__STMSGT_ESP_20_CTRL, 4 );
        putValue( KCAN__STMSGT_ESP_21_CTRL, 4 );
        putValue( KCAN__STMSGT_ESP_30_CTRL, 4 );
        putValue( KCAN__STMSGT_FoD_01_CTRL, 4 );
        putValue( KCAN__STMSGT_Gateway_71_CTRL, 4 );
        putValue( KCAN__STMSGT_HVK_01_CTRL, 4 );
        putValue( KCAN__STMSGT_IPA_02_CTRL, 4 );
        putValue( KCAN__STMSGT_Kessy_04_CTRL, 4 );
        putValue( KCAN__STMSGT_Klemmen_Status_01_CTRL, 4 );
        putValue( KCAN__STMSGT_Klemmen_Status_02_CTRL, 4 );
        putValue( KCAN__STMSGT_Klemmen_Steuerung_01_CTRL, 4 );
        putValue( KCAN__STMSGT_Klima_03_CTRL, 4 );
        putValue( KCAN__STMSGT_Klima_06_CTRL, 4 );
        putValue( KCAN__STMSGT_Klima_12_CTRL, 4 );
        putValue( KCAN__STMSGT_Klima_16_CTRL, 4 );
        putValue( KCAN__STMSGT_Klima_Sensor_02_CTRL, 4 );
        putValue( KCAN__STMSGT_KN_Gateway_CTRL, 4 );
        putValue( KCAN__STMSGT_KonzernrollenModus_01_CTRL, 4 );
        putValue( KCAN__STMSGT_LDW_02_CTRL, 4 );
        putValue( KCAN__STMSGT_Licht_Anf_01_CTRL, 4 );
        putValue( KCAN__STMSGT_Licht_hinten_01_CTRL, 4 );
        putValue( KCAN__STMSGT_Licht_vorne_01_CTRL, 4 );
        putValue( KCAN__STMSGT_LWI_01_CTRL, 4 );
        putValue( KCAN__STMSGT_Mem_BFS_01_CTRL, 4 );
        putValue( KCAN__STMSGT_Mem_FS_01_CTRL, 4 );
        putValue( KCAN__STMSGT_MFG_01_CTRL, 4 );
        putValue( KCAN__STMSGT_MFL_01_CTRL, 4 );
        putValue( KCAN__STMSGT_MFL_02_CTRL, 4 );
        putValue( KCAN__STMSGT_MFL_Tasten_Kon_01_CTRL, 4 );
        putValue( KCAN__STMSGT_Motor_14_CTRL, 4 );
        putValue( KCAN__STMSGT_Motor_18_CTRL, 4 );
        putValue( KCAN__STMSGT_Motor_26_CTRL, 4 );
        putValue( KCAN__STMSGT_Motor_41_CTRL, 4 );
        putValue( KCAN__STMSGT_Motor_54_CTRL, 4 );
        putValue( KCAN__STMSGT_Motor_57_CTRL, 4 );
        putValue( KCAN__STMSGT_Motor_Hybrid_06_CTRL, 4 );
        putValue( KCAN__STMSGT_NFC_01_CTRL, 4 );
        putValue( KCAN__STMSGT_NFC_MiKo_01_CTRL, 4 );
        putValue( KCAN__STMSGT_ORU_01_CTRL, 4 );
        putValue( KCAN__STMSGT_Parkhilfe_01_CTRL, 4 );
        putValue( KCAN__STMSGT_Parkhilfe_04_CTRL, 4 );
        putValue( KCAN__STMSGT_Personalisierung_01_CTRL, 4 );
        putValue( KCAN__STMSGT_PreCrash_02_CTRL, 4 );
        putValue( KCAN__STMSGT_Rear_View_04_CTRL, 4 );
        putValue( KCAN__STMSGT_Rear_View_06_CTRL, 4 );
        putValue( KCAN__STMSGT_Reichweite_01_CTRL, 4 );
        putValue( KCAN__STMSGT_Reichweite_02_CTRL, 4 );
        putValue( KCAN__STMSGT_Reichweite_03_CTRL, 4 );
        putValue( KCAN__STMSGT_RKA_01_CTRL, 4 );
        putValue( KCAN__STMSGT_RLS_01_CTRL, 4 );
        putValue( KCAN__STMSGT_SAM_01_CTRL, 4 );
        putValue( KCAN__STMSGT_SMLS_01_CTRL, 4 );
        putValue( KCAN__STMSGT_Systeminfo_01_CTRL, 4 );
        putValue( KCAN__STMSGT_TA_01_CTRL, 4 );
        putValue( KCAN__STMSGT_Temperaturen_01_CTRL, 4 );
        putValue( KCAN__STMSGT_Thermo_Verbrauch_01_CTRL, 4 );
        putValue( KCAN__STMSGT_TM_01_CTRL, 4 );
        putValue( KCAN__STMSGT_TSG_BT_01_CTRL, 4 );
        putValue( KCAN__STMSGT_TSG_FT_01_CTRL, 4 );
        putValue( KCAN__STMSGT_TSG_FT_02_CTRL, 4 );
        putValue( KCAN__STMSGT_TSG_HBFS_01_CTRL, 4 );
        putValue( KCAN__STMSGT_TSG_HFS_01_CTRL, 4 );
        putValue( KCAN__STMSGT_UserStateServer_01_CTRL, 4 );
        putValue( KCAN__STMSGT_VIN_01_CTRL, 4 );
        putValue( KCAN__STMSGT_VLK_01_CTRL, 4 );
        putValue( KCAN__STMSGT_VZE_04_CTRL, 4 );
        putValue( KCAN__STMSGT_WBA_03_CTRL, 4 );
        putValue( KCAN__STMSGT_WFS_01_CTRL, 4 );
        putValue( KCAN__STMSGT_WFS_Transponder_Req_02_CTRL, 4 );
        putValue( KCAN__STMSGT_Wischer_01_CTRL, 4 );
        putValue( KCAN__STMSGT_WLC1_01_CTRL, 4 );
        putValue( KCAN__STMSGT_Zeitmaster_02_CTRL, 4 );
        putValue( KCAN__STMSGT_ZV_02_CTRL, 4 );
        putValue( KCAN__STMSGT_ZV_04_CTRL, 4 );

        

// #MSG_OFF_END#
    }
}

on envVar KCAN__STOP_ICAS1_Gateway_MESSAGES_ON
{
    if( getValue(this) )
    {
// #MSG_ON#
        putValue( KCAN__STMSGT_AAA_01_CTRL, 0 );
        putValue( KCAN__STMSGT_AGA_01_CTRL, 0 );
        putValue( KCAN__STMSGT_Airbag_02_CTRL, 0 );
        putValue( KCAN__STMSGT_Airbag_04_CTRL, 0 );
        putValue( KCAN__STMSGT_Airbag_06_CTRL, 0 );
        putValue( KCAN__STMSGT_Anhaenger_01_CTRL, 0 );
        putValue( KCAN__STMSGT_ARA_Status_01_CTRL, 0 );
        putValue( KCAN__STMSGT_AWV_02_CTRL, 0 );
        putValue( KCAN__STMSGT_AZK_01_CTRL, 0 );
        putValue( KCAN__STMSGT_BCM_01_CTRL, 0 );
        putValue( KCAN__STMSGT_BCM_03_CTRL, 0 );
        putValue( KCAN__STMSGT_BCM_04_CTRL, 0 );
        putValue( KCAN__STMSGT_BCM_Taster_02_CTRL, 0 );
        putValue( KCAN__STMSGT_BCM_Taster_03_CTRL, 0 );
        putValue( KCAN__STMSGT_BEM_02_CTRL, 0 );
        putValue( KCAN__STMSGT_BEM_06_CTRL, 0 );
        putValue( KCAN__STMSGT_Blinkmodi_02_CTRL, 0 );
        putValue( KCAN__STMSGT_BMS_07_CTRL, 0 );
        putValue( KCAN__STMSGT_Bremse_EV_02_CTRL, 0 );
        putValue( KCAN__STMSGT_Charisma_03_CTRL, 0 );
        putValue( KCAN__STMSGT_Daempfer_01_CTRL, 0 );
        putValue( KCAN__STMSGT_Daempfer_05_CTRL, 0 );
        putValue( KCAN__STMSGT_Diagnose_01_CTRL, 0 );
        putValue( KCAN__STMSGT_Dimmung_01_CTRL, 0 );
        putValue( KCAN__STMSGT_EA_02_CTRL, 0 );
        putValue( KCAN__STMSGT_ELV_01_CTRL, 0 );
        putValue( KCAN__STMSGT_Entfernungen_01_CTRL, 0 );
        putValue( KCAN__STMSGT_EPB_03_CTRL, 0 );
        putValue( KCAN__STMSGT_ESC_50_CTRL, 0 );
        putValue( KCAN__STMSGT_ESC_51_CTRL, 0 );
        putValue( KCAN__STMSGT_ESP_20_CTRL, 0 );
        putValue( KCAN__STMSGT_ESP_21_CTRL, 0 );
        putValue( KCAN__STMSGT_ESP_30_CTRL, 0 );
        putValue( KCAN__STMSGT_FoD_01_CTRL, 0 );
        putValue( KCAN__STMSGT_Gateway_71_CTRL, 0 );
        putValue( KCAN__STMSGT_HVK_01_CTRL, 0 );
        putValue( KCAN__STMSGT_IPA_02_CTRL, 0 );
        putValue( KCAN__STMSGT_Kessy_04_CTRL, 0 );
        putValue( KCAN__STMSGT_Klemmen_Status_01_CTRL, 0 );
        putValue( KCAN__STMSGT_Klemmen_Status_02_CTRL, 0 );
        putValue( KCAN__STMSGT_Klemmen_Steuerung_01_CTRL, 0 );
        putValue( KCAN__STMSGT_Klima_03_CTRL, 0 );
        putValue( KCAN__STMSGT_Klima_06_CTRL, 0 );
        putValue( KCAN__STMSGT_Klima_12_CTRL, 0 );
        putValue( KCAN__STMSGT_Klima_16_CTRL, 0 );
        putValue( KCAN__STMSGT_Klima_Sensor_02_CTRL, 0 );
        putValue( KCAN__STMSGT_KN_Gateway_CTRL, 0 );
        putValue( KCAN__STMSGT_KonzernrollenModus_01_CTRL, 0 );
        putValue( KCAN__STMSGT_LDW_02_CTRL, 0 );
        putValue( KCAN__STMSGT_Licht_Anf_01_CTRL, 0 );
        putValue( KCAN__STMSGT_Licht_hinten_01_CTRL, 0 );
        putValue( KCAN__STMSGT_Licht_vorne_01_CTRL, 0 );
        putValue( KCAN__STMSGT_LWI_01_CTRL, 0 );
        putValue( KCAN__STMSGT_Mem_BFS_01_CTRL, 0 );
        putValue( KCAN__STMSGT_Mem_FS_01_CTRL, 0 );
        putValue( KCAN__STMSGT_MFG_01_CTRL, 0 );
        putValue( KCAN__STMSGT_MFL_01_CTRL, 0 );
        putValue( KCAN__STMSGT_MFL_02_CTRL, 0 );
        putValue( KCAN__STMSGT_MFL_Tasten_Kon_01_CTRL, 0 );
        putValue( KCAN__STMSGT_Motor_14_CTRL, 0 );
        putValue( KCAN__STMSGT_Motor_18_CTRL, 0 );
        putValue( KCAN__STMSGT_Motor_26_CTRL, 0 );
        putValue( KCAN__STMSGT_Motor_41_CTRL, 0 );
        putValue( KCAN__STMSGT_Motor_54_CTRL, 0 );
        putValue( KCAN__STMSGT_Motor_57_CTRL, 0 );
        putValue( KCAN__STMSGT_Motor_Hybrid_06_CTRL, 0 );
        putValue( KCAN__STMSGT_NFC_01_CTRL, 0 );
        putValue( KCAN__STMSGT_NFC_MiKo_01_CTRL, 0 );
        putValue( KCAN__STMSGT_ORU_01_CTRL, 0 );
        putValue( KCAN__STMSGT_Parkhilfe_01_CTRL, 0 );
        putValue( KCAN__STMSGT_Parkhilfe_04_CTRL, 0 );
        putValue( KCAN__STMSGT_Personalisierung_01_CTRL, 0 );
        putValue( KCAN__STMSGT_PreCrash_02_CTRL, 0 );
        putValue( KCAN__STMSGT_Rear_View_04_CTRL, 0 );
        putValue( KCAN__STMSGT_Rear_View_06_CTRL, 0 );
        putValue( KCAN__STMSGT_Reichweite_01_CTRL, 0 );
        putValue( KCAN__STMSGT_Reichweite_02_CTRL, 0 );
        putValue( KCAN__STMSGT_Reichweite_03_CTRL, 0 );
        putValue( KCAN__STMSGT_RKA_01_CTRL, 0 );
        putValue( KCAN__STMSGT_RLS_01_CTRL, 0 );
        putValue( KCAN__STMSGT_SAM_01_CTRL, 0 );
        putValue( KCAN__STMSGT_SMLS_01_CTRL, 0 );
        putValue( KCAN__STMSGT_Systeminfo_01_CTRL, 0 );
        putValue( KCAN__STMSGT_TA_01_CTRL, 0 );
        putValue( KCAN__STMSGT_Temperaturen_01_CTRL, 0 );
        putValue( KCAN__STMSGT_Thermo_Verbrauch_01_CTRL, 0 );
        putValue( KCAN__STMSGT_TM_01_CTRL, 0 );
        putValue( KCAN__STMSGT_TSG_BT_01_CTRL, 0 );
        putValue( KCAN__STMSGT_TSG_FT_01_CTRL, 0 );
        putValue( KCAN__STMSGT_TSG_FT_02_CTRL, 0 );
        putValue( KCAN__STMSGT_TSG_HBFS_01_CTRL, 0 );
        putValue( KCAN__STMSGT_TSG_HFS_01_CTRL, 0 );
        putValue( KCAN__STMSGT_UserStateServer_01_CTRL, 0 );
        putValue( KCAN__STMSGT_VIN_01_CTRL, 0 );
        putValue( KCAN__STMSGT_VLK_01_CTRL, 0 );
        putValue( KCAN__STMSGT_VZE_04_CTRL, 0 );
        putValue( KCAN__STMSGT_WBA_03_CTRL, 0 );
        putValue( KCAN__STMSGT_WFS_01_CTRL, 0 );
        putValue( KCAN__STMSGT_WFS_Transponder_Req_02_CTRL, 0 );
        putValue( KCAN__STMSGT_Wischer_01_CTRL, 0 );
        putValue( KCAN__STMSGT_WLC1_01_CTRL, 0 );
        putValue( KCAN__STMSGT_Zeitmaster_02_CTRL, 0 );
        putValue( KCAN__STMSGT_ZV_02_CTRL, 0 );
        putValue( KCAN__STMSGT_ZV_04_CTRL, 0 );


// #MSG_ON_END#

    }
}

on EnvVar KCAN__STOP_All_MESSAGES_OFF
{
    if( getValue(this) )
    {
        putValue( KCAN__STOP_ICAS1_Gateway_MESSAGES_OFF, 1 );
    }
    else
    {
        putValue( KCAN__STOP_ICAS1_Gateway_MESSAGES_OFF, 0 );
    }
}

on EnvVar KCAN__STOP_All_MESSAGES_ON
{
    if( getValue(this) )
    {
        putValue( KCAN__STOP_ICAS1_Gateway_MESSAGES_ON, 1 );
    }
    else
    {
        putValue( KCAN__STOP_ICAS1_Gateway_MESSAGES_ON, 0 );
    }
}

on busOff
{
    resetCan();
    write("CAN has been resetted due to BUSOFF    ( coded version )");
}


on message 0x1B000000x-0x1B00007Fx
{
    byte Identifier;

    Identifier = this.byte( 1 );

    if( this.ID == NmNodeIdentifier )    // check, wether the received NM-Frame is an own one
    {
        boCanNM_Tx_Confirmation = TRUE;    // so it is a TX-confirmation
    }
    else
    {
        boCanNM_Rx_Indication = TRUE;     // else it is a NM-Frame from another ECU
    }
    _NM_Switch_NM_Mode();     // inform the state-mashine
}

on timer t_DoorNMCancelTimer
{
    if( getValue( KCAN__NMH_ICAS1_Gateway_AutomaticModeActive ) == 1 )
    {
        _ReleaseCommRequest( 15 );  // all doors reset their requests
    }
}

on timer t_KeyInLockNMCancelTimer
{
    if( getValue( KCAN__NMH_ICAS1_Gateway_AutomaticModeActive ) == 1 )
    {
        _ReleaseCommRequest( cIgnitionNMRequest );
    }
}

on timer t_StWhlButtonNMCancelTimer
{
    if( getValue( KCAN__NMH_ICAS1_Gateway_AutomaticModeActive ) == 1 )
    {
        _ReleaseCommRequest( cStWhlButtonNMRequest );  // all keys reset their requests
    }
}

on timer t_WakeWarningNMCancelTimer
{
    if( getValue( KCAN__NMH_ICAS1_Gateway_AutomaticModeActive ) == 1 )
    {
        _ReleaseCommRequest( cWakeWarningNMRequest );  // all keys reset their requests
    }
}

on timer t_EPKBWarningNMCancelTimer
{
    if( getValue( KCAN__NMH_ICAS1_Gateway_AutomaticModeActive ) == 1 )
    {
        _ReleaseCommRequest( cEPKBWarningNMRequest );  // all keys reset their requests
    }
}

on timer t_IlluNMCancelTimer
{
    if( getValue( KCAN__NMH_ICAS1_Gateway_AutomaticModeActive ) == 1 )
    {
        _ReleaseCommRequest( cIlluNMRequest );  // all keys reset their requests
    }
}

on timer t_CarClosureNMCancelTimer
{
    if( getValue( KCAN__NMH_ICAS1_Gateway_AutomaticModeActive ) == 1 )
    {
        _ReleaseCommRequest( cCarClosureNMRequest );  // all keys reset their requests
    }
}

on timer t_GearIndNMCancelTimer
{
    if( getValue( KCAN__NMH_ICAS1_Gateway_AutomaticModeActive ) == 1 )
    {
        _ReleaseCommRequest( cGearIndNMRequest );  // all keys reset their requests
    }
}

on timer t_NM_Repeat_Message_Time
{
    boCanNM_RepeatMessage_Timer_Expired = TRUE;
    _NM_Switch_NM_Mode();     // inform the state-mashine
}

on timer t_NM_Timeout_Time
{
    boCanNM_NM_Timeout_Timer_Expired = TRUE;
    _NM_Switch_NM_Mode();     // inform the state-mashine
}

on timer t_NM_Transmit
{
    if( NM_Transmit_Cycle > 1 )
        setTimer( t_NM_Transmit, NM_Transmit_Cycle );
    NM_xxx_AR_output();
}

on timer t_NM_Wait_Bus_Sleep_Time
{
    boCanNM_WaitBusSleep_Timer_Expired = TRUE;
    _NM_Switch_NM_Mode();     // inform the state-mashine
}

NM_xxx_AR_init()
{
    _mNM_xxx_AR.NM_Gateway_CAB_V10.phys = getValue( KCAN_NM_Gateway_CAB_V10 );
    _mNM_xxx_AR.NM_Gateway_Car_Wakeup.phys = getValue( KCAN_NM_Gateway_Car_Wakeup );
    _mNM_xxx_AR.NM_Gateway_CBV_AWB.phys = getValue( KCAN_NM_Gateway_CBV_AWB );
    _mNM_xxx_AR.NM_Gateway_CBV_CRI.phys = getValue( KCAN_NM_Gateway_CBV_CRI );
    _mNM_xxx_AR.NM_Gateway_NM_aktiv_CAB.phys = getValue( KCAN_NM_Gateway_NM_aktiv_CAB );
    _mNM_xxx_AR.NM_Gateway_NM_aktiv_Diagnose.phys = getValue( KCAN_NM_Gateway_NM_aktiv_Diagnose );
    _mNM_xxx_AR.NM_Gateway_NM_aktiv_Energie.phys = getValue( KCAN_NM_Gateway_NM_aktiv_Energie );
    _mNM_xxx_AR.NM_Gateway_NM_aktiv_FoD.phys = getValue( KCAN_NM_Gateway_NM_aktiv_FoD );
    _mNM_xxx_AR.NM_Gateway_NM_aktiv_IAA_PSO.phys = getValue( KCAN_NM_Gateway_NM_aktiv_IAA_PSO );
    _mNM_xxx_AR.NM_Gateway_NM_aktiv_Kessy.phys = getValue( KCAN_NM_Gateway_NM_aktiv_Kessy );
    _mNM_xxx_AR.NM_Gateway_NM_aktiv_KL15.phys = getValue( KCAN_NM_Gateway_NM_aktiv_KL15 );
    _mNM_xxx_AR.NM_Gateway_NM_aktiv_KS.phys = getValue( KCAN_NM_Gateway_NM_aktiv_KS );
    _mNM_xxx_AR.NM_Gateway_NM_aktiv_Licht.phys = getValue( KCAN_NM_Gateway_NM_aktiv_Licht );
    _mNM_xxx_AR.NM_Gateway_NM_aktiv_PaCo.phys = getValue( KCAN_NM_Gateway_NM_aktiv_PaCo );
    _mNM_xxx_AR.NM_Gateway_NM_aktiv_RTM.phys = getValue( KCAN_NM_Gateway_NM_aktiv_RTM );
    _mNM_xxx_AR.NM_Gateway_NM_aktiv_Standklima.phys = getValue( KCAN_NM_Gateway_NM_aktiv_Standklima );
    _mNM_xxx_AR.NM_Gateway_NM_aktiv_Tmin.phys = getValue( KCAN_NM_Gateway_NM_aktiv_Tmin );
    _mNM_xxx_AR.NM_Gateway_NM_aktiv_USS.phys = getValue( KCAN_NM_Gateway_NM_aktiv_USS );
    _mNM_xxx_AR.NM_Gateway_NM_aktiv_ZM.phys = getValue( KCAN_NM_Gateway_NM_aktiv_ZM );
    _mNM_xxx_AR.NM_Gateway_NM_aktiv_ZV.phys = getValue( KCAN_NM_Gateway_NM_aktiv_ZV );
    _mNM_xxx_AR.NM_Gateway_NM_State.phys = getValue( KCAN_NM_Gateway_NM_State );
    _mNM_xxx_AR.NM_Gateway_UDS_CC.phys = getValue( KCAN_NM_Gateway_UDS_CC );

}

NM_xxx_AR_output()
{
    _mNM_xxx_AR.byte( 1 ) = CanNmNodeId;
    putValue( KCAN_NM_Gateway_NM_State, bNM_xxx_NM_State );
    _mNM_xxx_AR.NM_Gateway_NM_State = bNM_xxx_NM_State;

    if( _mNM_xxx_Transmit_Allowed )
        output( _mNM_xxx_AR );
}

NM_xxx_AR_saveEnvVars( dword hFile )
{
    filePutString("\n// Knoten NMH_ICAS1_Gateway\n", 33, hFile );
    snprintf(buffer, elcount(buffer), "0.0000 KCAN__STMSG_NMH_ICAS1_Gateway := %X\n", getValue( KCAN__STMSG_NMH_ICAS1_Gateway ));        filePutString (buffer, elcount(buffer), hFile);
    snprintf(buffer, elcount(buffer), "0.0000 KCAN__STMSGT_NMH_ICAS1_Gateway := %X\n", getValue( KCAN__STMSGT_NMH_ICAS1_Gateway ));        filePutString (buffer, elcount(buffer), hFile);
    snprintf(buffer, elcount(buffer), "0.0000 KCAN_NM_Gateway_CAB_V10 := %X\n", getValue( KCAN_NM_Gateway_CAB_V10 ) );        filePutString (buffer, elcount(buffer), hFile);
    snprintf(buffer, elcount(buffer), "0.0000 KCAN_NM_Gateway_Car_Wakeup := %X\n", getValue( KCAN_NM_Gateway_Car_Wakeup ) );        filePutString (buffer, elcount(buffer), hFile);
    snprintf(buffer, elcount(buffer), "0.0000 KCAN_NM_Gateway_CBV_AWB := %X\n", getValue( KCAN_NM_Gateway_CBV_AWB ) );        filePutString (buffer, elcount(buffer), hFile);
    snprintf(buffer, elcount(buffer), "0.0000 KCAN_NM_Gateway_CBV_CRI := %X\n", getValue( KCAN_NM_Gateway_CBV_CRI ) );        filePutString (buffer, elcount(buffer), hFile);
    snprintf(buffer, elcount(buffer), "0.0000 KCAN_NM_Gateway_NM_aktiv_CAB := %X\n", getValue( KCAN_NM_Gateway_NM_aktiv_CAB ) );        filePutString (buffer, elcount(buffer), hFile);
    snprintf(buffer, elcount(buffer), "0.0000 KCAN_NM_Gateway_NM_aktiv_Diagnose := %X\n", getValue( KCAN_NM_Gateway_NM_aktiv_Diagnose ) );        filePutString (buffer, elcount(buffer), hFile);
    snprintf(buffer, elcount(buffer), "0.0000 KCAN_NM_Gateway_NM_aktiv_Energie := %X\n", getValue( KCAN_NM_Gateway_NM_aktiv_Energie ) );        filePutString (buffer, elcount(buffer), hFile);
    snprintf(buffer, elcount(buffer), "0.0000 KCAN_NM_Gateway_NM_aktiv_FoD := %X\n", getValue( KCAN_NM_Gateway_NM_aktiv_FoD ) );        filePutString (buffer, elcount(buffer), hFile);
    snprintf(buffer, elcount(buffer), "0.0000 KCAN_NM_Gateway_NM_aktiv_IAA_PSO := %X\n", getValue( KCAN_NM_Gateway_NM_aktiv_IAA_PSO ) );        filePutString (buffer, elcount(buffer), hFile);
    snprintf(buffer, elcount(buffer), "0.0000 KCAN_NM_Gateway_NM_aktiv_Kessy := %X\n", getValue( KCAN_NM_Gateway_NM_aktiv_Kessy ) );        filePutString (buffer, elcount(buffer), hFile);
    snprintf(buffer, elcount(buffer), "0.0000 KCAN_NM_Gateway_NM_aktiv_KL15 := %X\n", getValue( KCAN_NM_Gateway_NM_aktiv_KL15 ) );        filePutString (buffer, elcount(buffer), hFile);
    snprintf(buffer, elcount(buffer), "0.0000 KCAN_NM_Gateway_NM_aktiv_KS := %X\n", getValue( KCAN_NM_Gateway_NM_aktiv_KS ) );        filePutString (buffer, elcount(buffer), hFile);
    snprintf(buffer, elcount(buffer), "0.0000 KCAN_NM_Gateway_NM_aktiv_Licht := %X\n", getValue( KCAN_NM_Gateway_NM_aktiv_Licht ) );        filePutString (buffer, elcount(buffer), hFile);
    snprintf(buffer, elcount(buffer), "0.0000 KCAN_NM_Gateway_NM_aktiv_PaCo := %X\n", getValue( KCAN_NM_Gateway_NM_aktiv_PaCo ) );        filePutString (buffer, elcount(buffer), hFile);
    snprintf(buffer, elcount(buffer), "0.0000 KCAN_NM_Gateway_NM_aktiv_RTM := %X\n", getValue( KCAN_NM_Gateway_NM_aktiv_RTM ) );        filePutString (buffer, elcount(buffer), hFile);
    snprintf(buffer, elcount(buffer), "0.0000 KCAN_NM_Gateway_NM_aktiv_Standklima := %X\n", getValue( KCAN_NM_Gateway_NM_aktiv_Standklima ) );        filePutString (buffer, elcount(buffer), hFile);
    snprintf(buffer, elcount(buffer), "0.0000 KCAN_NM_Gateway_NM_aktiv_Tmin := %X\n", getValue( KCAN_NM_Gateway_NM_aktiv_Tmin ) );        filePutString (buffer, elcount(buffer), hFile);
    snprintf(buffer, elcount(buffer), "0.0000 KCAN_NM_Gateway_NM_aktiv_USS := %X\n", getValue( KCAN_NM_Gateway_NM_aktiv_USS ) );        filePutString (buffer, elcount(buffer), hFile);
    snprintf(buffer, elcount(buffer), "0.0000 KCAN_NM_Gateway_NM_aktiv_ZM := %X\n", getValue( KCAN_NM_Gateway_NM_aktiv_ZM ) );        filePutString (buffer, elcount(buffer), hFile);
    snprintf(buffer, elcount(buffer), "0.0000 KCAN_NM_Gateway_NM_aktiv_ZV := %X\n", getValue( KCAN_NM_Gateway_NM_aktiv_ZV ) );        filePutString (buffer, elcount(buffer), hFile);
    snprintf(buffer, elcount(buffer), "0.0000 KCAN_NM_Gateway_NM_State := %X\n", getValue( KCAN_NM_Gateway_NM_State ) );        filePutString (buffer, elcount(buffer), hFile);
    snprintf(buffer, elcount(buffer), "0.0000 KCAN_NM_Gateway_UDS_CC := %X\n", getValue( KCAN_NM_Gateway_UDS_CC ) );        filePutString (buffer, elcount(buffer), hFile);

}

on envVar KCAN__STMSG_NMH_ICAS1_Gateway
{
    if( getValue( this ) == 0 )
        _mNM_xxx_Transmit_Allowed = 1;
    else
        _mNM_xxx_Transmit_Allowed = 0;    
}



on EnvVar KCAN_NM_Gateway_CAB_V10
{
    _mNM_xxx_AR.NM_Gateway_CAB_V10.phys = getValue(this);
}


on EnvVar KCAN_NM_Gateway_Car_Wakeup
{
    _mNM_xxx_AR.NM_Gateway_Car_Wakeup.phys = getValue(this);
}


on EnvVar KCAN_NM_Gateway_CBV_AWB
{
    _mNM_xxx_AR.NM_Gateway_CBV_AWB.phys = getValue(this);
}


on EnvVar KCAN_NM_Gateway_CBV_CRI
{
    _mNM_xxx_AR.NM_Gateway_CBV_CRI.phys = getValue(this);
}


on EnvVar KCAN_NM_Gateway_NM_aktiv_CAB
{
    _mNM_xxx_AR.NM_Gateway_NM_aktiv_CAB.phys = getValue(this);
}


on EnvVar KCAN_NM_Gateway_NM_aktiv_Diagnose
{
    _mNM_xxx_AR.NM_Gateway_NM_aktiv_Diagnose.phys = getValue(this);
}


on EnvVar KCAN_NM_Gateway_NM_aktiv_Energie
{
    _mNM_xxx_AR.NM_Gateway_NM_aktiv_Energie.phys = getValue(this);
}


on EnvVar KCAN_NM_Gateway_NM_aktiv_FoD
{
    _mNM_xxx_AR.NM_Gateway_NM_aktiv_FoD.phys = getValue(this);
}


on EnvVar KCAN_NM_Gateway_NM_aktiv_IAA_PSO
{
    _mNM_xxx_AR.NM_Gateway_NM_aktiv_IAA_PSO.phys = getValue(this);
}


on EnvVar KCAN_NM_Gateway_NM_aktiv_Kessy
{
    _mNM_xxx_AR.NM_Gateway_NM_aktiv_Kessy.phys = getValue(this);
}


on EnvVar KCAN_NM_Gateway_NM_aktiv_KL15
{
    _mNM_xxx_AR.NM_Gateway_NM_aktiv_KL15.phys = getValue(this);
}


on EnvVar KCAN_NM_Gateway_NM_aktiv_KS
{
    _mNM_xxx_AR.NM_Gateway_NM_aktiv_KS.phys = getValue(this);
}


on EnvVar KCAN_NM_Gateway_NM_aktiv_Licht
{
    _mNM_xxx_AR.NM_Gateway_NM_aktiv_Licht.phys = getValue(this);
}


on EnvVar KCAN_NM_Gateway_NM_aktiv_PaCo
{
    _mNM_xxx_AR.NM_Gateway_NM_aktiv_PaCo.phys = getValue(this);
}


on EnvVar KCAN_NM_Gateway_NM_aktiv_RTM
{
    _mNM_xxx_AR.NM_Gateway_NM_aktiv_RTM.phys = getValue(this);
}


on EnvVar KCAN_NM_Gateway_NM_aktiv_Standklima
{
    _mNM_xxx_AR.NM_Gateway_NM_aktiv_Standklima.phys = getValue(this);
}


on EnvVar KCAN_NM_Gateway_NM_aktiv_Tmin
{
    _mNM_xxx_AR.NM_Gateway_NM_aktiv_Tmin.phys = getValue(this);
}


on EnvVar KCAN_NM_Gateway_NM_aktiv_USS
{
    _mNM_xxx_AR.NM_Gateway_NM_aktiv_USS.phys = getValue(this);
}


on EnvVar KCAN_NM_Gateway_NM_aktiv_ZM
{
    _mNM_xxx_AR.NM_Gateway_NM_aktiv_ZM.phys = getValue(this);
}


on EnvVar KCAN_NM_Gateway_NM_aktiv_ZV
{
    _mNM_xxx_AR.NM_Gateway_NM_aktiv_ZV.phys = getValue(this);
}


on EnvVar KCAN_NM_Gateway_NM_State
{
    _mNM_xxx_AR.NM_Gateway_NM_State.phys = getValue(this);
}


on EnvVar KCAN_NM_Gateway_UDS_CC
{
    _mNM_xxx_AR.NM_Gateway_UDS_CC.phys = getValue(this);
}


/*on EnvVar KCAN_NM_ICAS1_Gateway_Wakeup
{
    _mNM_xxx_AR.NM_ICAS1_Gateway_Wakeup.phys = getValue(this);
}*/

on envVar KCAN__NMH_ICAS1_Gateway_AutomaticModeActive
{
    byte temp; // actual NM request status

    if( getValue( this ) )
    {
        EnableControl( "Hauptpanel", "EnvVar:HMI__NM_BCM_Manually_Request_NM", 0 );

        temp = getValue( KCAN_ZAS_Kl_15 );
//        write( "HMI_ISw_Stat is %d", temp );
        if( temp > 1 ) // IGN not Lock
        {
            putValue( KCAN__NMH_ICAS1_Gateway_Manually_Request_NM, 1 );
            putValue( KCAN__NMH_ICAS1_Gateway_NM_Request, cIgnitionNMRequest );
            _NM_Switch_NM_Mode();
        }
        else
        {
            putValue( KCAN__NMH_ICAS1_Gateway_Manually_Request_NM, 0 );
            _ReleaseCommRequest( cAllNMRequest );  // release all requests
            _NM_Switch_NM_Mode();
        }
    }
    else
    {
        EnableControl( "Hauptpanel", "EnvVar:HMI__NM_BCM_Manually_Request_NM", 1 );
        if( getValue( KCAN_ZAS_Kl_15 ) > 1 )
        {
            _SetCommRequest( cIgnitionNMRequest );
            _NM_Switch_NM_Mode();
            putValue( KCAN__NMH_ICAS1_Gateway_Manually_Request_NM, 1 );
        }
    }
    NM_AutomaticModeActive = getValue( this );
}

on envVar KCAN__NMH_ICAS1_Gateway_Manually_Request_NM
{
    if( getValue ( KCAN__NMH_ICAS1_Gateway_AutomaticModeActive ) == 0 )
    {
        if( getValue( this ) )
        {
            _SetCommRequest( cManualNMRequest );
        }
        else
        {
            _ReleaseCommRequest( cAllNMRequest );// all
        }
    }
}

_NM_Switch_NM_Mode()
{
    byte bOld_NM_Mode;
    word NM_Request_State;

    bOld_NM_Mode = NM_Mode;
    NM_Request_State = getValue( KCAN__NMH_ICAS1_Gateway_NM_Request );
    switch( NM_Mode )
    {
        case cNM_Mode_Init:                   _NM_Init();
                                              NM_Mode = cNM_Mode_Sleep;
                                              break;
        case cNM_Mode_Sleep:                  if( boCanNM_Rx_Indication == TRUE )
                                              {
                                                  // _NM_NetworkStartIndication();   nothing to do
                                                  // _NM_PassiveStartUp();    is content of _NM_NetworkMode();
                                                  setTimer( t_NM_Transmit, NmAsrCanMsgCycleOffset );    // send NM-Frame delayed
                                                  boCanNM_Rx_Indication = FALSE;
                                                  cancelTimer( t_NM_Timeout_Time );
                                                  setTimer( t_NM_Timeout_Time, c_NM_Timeout_Time );
                                                  setTimer( t_NM_Repeat_Message_Time, c_NM_Repeat_Message_Time );
                                                  NM_Transmit_Cycle = NmAsrCanMsgStandardCycle;
                                                  _NM_NetworkMode();
                                                  NM_Mode = cNM_Mode_RepeatMsg;
                                                  bNM_xxx_NM_State = cNM_RM_aus_BSM;
                                              }
                                              if( NM_Request_State )
                                              {
                                                  setTimer( t_NM_Transmit, 1 );    //send NM-Franme immediately
                                                  NM_Transmit_Cycle = NmAsrCanMsgStandardCycle;
                                                  cancelTimer( t_NM_Timeout_Time );
                                                  setTimer( t_NM_Timeout_Time, c_NM_Timeout_Time );
                                                  setTimer( t_NM_Repeat_Message_Time, c_NM_Repeat_Message_Time );
                                                  NM_Transmit_Cycle = NmAsrCanMsgStandardCycle;
                                                  _NM_NetworkMode();
                                                  NM_Mode = cNM_Mode_RepeatMsg;
                                                  bNM_xxx_NM_State = cNM_RM_aus_BSM;
                                              }
                                              break;
        case cNM_Mode_Prepare_Bus_Sleep:      if( boCanNM_WaitBusSleep_Timer_Expired == TRUE )
                                              {
                                                  _NM_BusSleepModeInd();   // set message startup delay
                                                  NM_Mode = cNM_Mode_Sleep;
                                                  boCanNM_WaitBusSleep_Timer_Expired = FALSE;
                                              }
                                              if( boCanNM_NM_Timeout_Timer_Expired == TRUE )
                                                  boCanNM_NM_Timeout_Timer_Expired = FALSE;
                                              if( ( boCanNM_Rx_Indication == TRUE ) ||  NM_Request_State )
                                              {
                                                  boCanNM_Rx_Indication = FALSE;
                                                  if( NM_Request_State )
                                                  {
                                                      setTimer( t_NM_Transmit, 1 );    //send NM-Franme immediately
                                                  }
                                                  cancelTimer( t_NM_Timeout_Time );
                                                  setTimer( t_NM_Timeout_Time, c_NM_Timeout_Time );
                                                  setTimer( t_NM_Repeat_Message_Time, c_NM_Repeat_Message_Time );
                                                  _NM_NetworkMode();
                                                  NM_Transmit_Cycle = NmAsrCanMsgStandardCycle;
                                                  NM_Mode = cNM_Mode_RepeatMsg;
                                                  bNM_xxx_NM_State = cNM_RM_aus_PBSM;
                                              }
                                              break;
        case cNM_Mode_Ready_Sleep:            if( boCanNM_Rx_Indication == TRUE )
                                              {
                                                  cancelTimer( t_NM_Timeout_Time );
                                                  setTimer( t_NM_Timeout_Time, c_NM_Timeout_Time );
                                                  boCanNM_Rx_Indication = FALSE;
                                              }
                                              if( boCanNM_Tx_Confirmation == TRUE )
                                              {
                                                  cancelTimer( t_NM_Timeout_Time );
                                                  setTimer( t_NM_Timeout_Time, c_NM_Timeout_Time );
                                                  boCanNM_Tx_Confirmation = FALSE;
                                              }
                                              if( NM_Request_State )
                                              {
                                                  setTimer( t_NM_Transmit, 1 );    //send NM-Franme immediately
                                                  cancelTimer( t_NM_Timeout_Time );
                                                  setTimer( t_NM_Timeout_Time, c_NM_Timeout_Time );
                                                  if( CanNmBusLoadReductionEnabled )
                                                      NM_Transmit_Cycle = NmAsrCanMsgReducedTime;
                                                  else
                                                      NM_Transmit_Cycle = NmAsrCanMsgStandardCycle;
                                                  NM_Mode = cNM_Mode_Normal_Operation_State;
                                                  bNM_xxx_NM_State = cNM_NO_aus_RS;
                                              }
                                              if( boCanNM_RepeatMessage_Requested == TRUE )
                                              {
                                                  setTimer( t_NM_Transmit, NmAsrCanMsgCycleOffset );    // send NM-Frame delayed
                                                  cancelTimer( t_NM_Timeout_Time );
                                                  setTimer( t_NM_Timeout_Time, c_NM_Timeout_Time );
                                                  setTimer( t_NM_Repeat_Message_Time, c_NM_Repeat_Message_Time );
                                                  NM_Transmit_Cycle = NmAsrCanMsgStandardCycle;
                                                  boCanNM_RepeatMessage_Requested = FALSE;
                                                  NM_Mode = cNM_Mode_RepeatMsg;
                                              }
                                              if( boCanNM_NM_Timeout_Timer_Expired == TRUE )
                                              {
                                                  setTimer( t_NM_Wait_Bus_Sleep_Time, c_NM_Wait_Bus_Sleep_Time );
                                                  _NM_PrepareBusSleepModeInd();    // here t_DBKonTimer is stopped
                                                  NM_Mode = cNM_Mode_Prepare_Bus_Sleep;
                                                  boCanNM_NM_Timeout_Timer_Expired = FALSE;
                                              }
                                              break;
        case cNM_Mode_Normal_Operation_State: if( boCanNM_NM_Timeout_Timer_Expired == TRUE )
                                              {
                                                  setTimer( t_NM_Timeout_Time, c_NM_Timeout_Time );
                                                  // _NM_TimeoutExeption();    // no action to be done
                                                  boCanNM_NM_Timeout_Timer_Expired = FALSE;
                                              }
                                              if( boCanNM_Rx_Indication == TRUE )
                                              {
                                                  cancelTimer( t_NM_Timeout_Time );
                                                  setTimer( t_NM_Timeout_Time, c_NM_Timeout_Time );
                                                  if( CanNmBusLoadReductionEnabled )
                                                  {
                                                      cancelTimer( t_NM_Transmit );
                                                      setTimer( t_NM_Transmit, NmAsrCanMsgReducedTime );
                                                  }
                                                  else
                                                  {
                                                  //    cancelTimer( t_NM_Transmit );
                                                  //    setTimer( t_NM_Transmit, NmAsrCanMsgStandardCycle );;
                                                  }
                                                  boCanNM_Rx_Indication = FALSE;
                                              }
                                              if( boCanNM_Tx_Confirmation == TRUE )
                                              {
                                                  cancelTimer( t_NM_Timeout_Time );
                                                  setTimer( t_NM_Timeout_Time, c_NM_Timeout_Time );
                                                  cancelTimer( t_NM_Transmit );
                                                  setTimer( t_NM_Transmit, NmAsrCanMsgStandardCycle );
                                                  boCanNM_Tx_Confirmation = FALSE;
                                              }
                                              if( NM_Request_State == 0 )    //no network requested
                                              {
                                                  cancelTimer( t_NM_Transmit );    // stop NM-Franme immediately
                                                  NM_Mode = cNM_Mode_Ready_Sleep;
                                              }
                                              if( boCanNM_RepeatMessage_Requested == TRUE )
                                              {
                                                  setTimer( t_NM_Transmit, NmAsrCanMsgCycleOffset );    // send NM-Frame delayed
                                                  cancelTimer( t_NM_Timeout_Time );
                                                  setTimer( t_NM_Timeout_Time, c_NM_Timeout_Time );
                                                  setTimer( t_NM_Repeat_Message_Time, c_NM_Repeat_Message_Time );
                                                  boCanNM_RepeatMessage_Requested = FALSE;
                                                  NM_Transmit_Cycle = NmAsrCanMsgStandardCycle;
                                                  NM_Mode = cNM_Mode_RepeatMsg;
                                              }
                                              break;
        case cNM_Mode_RepeatMsg:              if( boCanNM_NM_Timeout_Timer_Expired == TRUE )
                                              {
                                                  setTimer( t_NM_Timeout_Time, c_NM_Timeout_Time );
                                                  boCanNM_NM_Timeout_Timer_Expired = FALSE;
                                              }
                                              if( boCanNM_Rx_Indication == TRUE )
                                              {
                                                  cancelTimer( t_NM_Timeout_Time );
                                                  setTimer( t_NM_Timeout_Time, c_NM_Timeout_Time );
                                                  boCanNM_Rx_Indication = FALSE;
                                              }
                                              if( boCanNM_Tx_Confirmation == TRUE )
                                              {
                                                  cancelTimer( t_NM_Timeout_Time );
                                                  setTimer( t_NM_Timeout_Time, c_NM_Timeout_Time );
                                                  boCanNM_Tx_Confirmation = FALSE;
                                              }
                                              if( boCanNM_RepeatMessage_Timer_Expired == TRUE )
                                              {
                                                  boCanNM_RepeatMessage_Timer_Expired = FALSE;
                                                  if( NM_Request_State )
                                                  {
                                                      NM_Mode = cNM_Mode_Normal_Operation_State;
                                                  if( CanNmBusLoadReductionEnabled )
                                                      NM_Transmit_Cycle = NmAsrCanMsgReducedTime;
                                                  else
                                                      NM_Transmit_Cycle = NmAsrCanMsgStandardCycle;
                                                      bNM_xxx_NM_State = cNM_NO_aus_RM;
                                                  }
                                                  else
                                                  {
                                                      cancelTimer( t_NM_Transmit );    // stop NM-Franme immediately
                                                      NM_Mode = cNM_Mode_Ready_Sleep;
                                                  }
                                              }
                                              break;
    }
    if( bOld_NM_Mode != NM_Mode )
    {
        _Nm_StateChangeNotification( bOld_NM_Mode, NM_Mode );    // does the Trace
        putValue( KCAN__NMH_ICAS1_Gateway_ActualState, NM_Mode );
    }
}

_NM_Init()
{
    NM_Transmit_Cycle = NmAsrCanMsgStandardCycle;
}

_NM_NetworkMode()
{
    setTimer( t_DBKomTimer_5ms, 1 ); //  ms     start CAN-communication immediately
    setTimer( t_DBKomTimer_20ms, 2 ); //  ms     start CAN-communication immediately
    putValue( KCAN__NMH_ICAS1_Gateway_CommActive, 1 );
}

_Nm_BusSleepModeInd()
{
//    write( "_Nm_BusSleepModeInd: Sleep Mode active");
    __Startup_Delay();
    __Reset_E2E_SQC();
}

void _Nm_PrepareBusSleepModeInd()
{
//    _Trace( "Nm_PrepareBusSleepModeInd", "Prepare Sleep Mode active");
    putValue( KCAN__NMH_ICAS1_Gateway_CommActive, 0 );
    cancelTimer( t_DBKomTimer_5ms );
    cancelTimer( t_DBKomTimer_20ms );
}

_Nm_StateChangeNotification( byte previousState, byte currentState )
{
/*
    char line[50];

    snprintf( line, elcount(line ), "Transition from %d to %d", previousState, currentState );
    _Trace( "Nm_StateChangeNotification", "", line );
*/
}

on EnvVar KCAN__HeavyBusload
{
    if( getValue( this ) )
    {
        bCanLoad            = cCANHeavyNetworkLoad;
        bCanLoad_SpontanCnt = cCANHeavyNetworkLoad_SpontanCnt;
        write("CANHeavyNetworkLoad");
    }
    else
    {
        bCanLoad            = cCANNormalNetworkLoad;
        bCanLoad_SpontanCnt = cCANNormalNetworkLoad_SpontanCnt;
        write("CANNormalNetworkLoad");
    }
}

_ReleaseCommRequest( word RequestID )
{
    word temp; // actual NM request status

    temp = getValue( KCAN__NMH_ICAS1_Gateway_NM_Request );
    temp &= ~RequestID; // reset NM request 
    putValue( KCAN__NMH_ICAS1_Gateway_NM_Request, temp );
    _NM_Switch_NM_Mode();
}

_SetCommRequest( word RequestID )
{
    word temp; // actual NM request status

    temp = getValue( KCAN__NMH_ICAS1_Gateway_NM_Request );
    temp |= RequestID; // set NM request 
    putValue( KCAN__NMH_ICAS1_Gateway_NM_Request, temp );
    _NM_Switch_NM_Mode();
}

on envVar KCAN__NMH_ICAS1_Gateway_Remote_SetCommRequest
{
    word temp; // actual NM request status

if( getValue( this ) )
    {
        temp = getValue( KCAN__NMH_ICAS1_Gateway_NM_Request );
        temp |= getValue( KCAN__NMH_ICAS1_Gateway_RequestID ); // set NM request 
        putValue( KCAN__NMH_ICAS1_Gateway_NM_Request, temp );
        _NM_Switch_NM_Mode();
        putValue( KCAN__NMH_ICAS1_Gateway_Remote_SetCommRequest, 0 );
    }
}

on envVar KCAN__NMH_ICAS1_Gateway_Remote_ReleaseCommRequest
{
    word temp, temp2; // actual NM request status

if( getValue( this ) )
    {
        temp = getValue( KCAN__NMH_ICAS1_Gateway_NM_Request );
        temp2 = getValue( KCAN__NMH_ICAS1_Gateway_RequestID );
        temp &= ~temp2; // reset NM request    
        putValue( KCAN__NMH_ICAS1_Gateway_NM_Request, temp );
        _NM_Switch_NM_Mode();
        putValue( KCAN__NMH_ICAS1_Gateway_Remote_ReleaseCommRequest, 0 );
    }
}


void _TraceCall( char functionName[], long callResult )
{
    char line[100];

    if( callResult == 1 )
        snprintf( line, elcount(line ), "calling %s", functionName );
    else
        snprintf( line, elcount(line ), "call to %s failed - wrong state?", functionName );
    _Trace( "", "", line );
}

void _Trace( char functionName[], char info[])
{
    _Trace( functionName, info, "");
}

void _Trace( char functionName[], char info[], char verbose[], long argument )
{
    char line[100];

    snprintf( line, elcount(line ), verbose, argument );
    _Trace( functionName, info, line );
}

void _Trace( char functionName[], char info[], char verbose[])
{
  char sep[2] = "/";
  sep[0] = functionName[0] ? '/' : 0;
  if( verbose[0])
  {
    write( "[%.3f]%s%s%s: %s", timeNow()/100000.0, gECU
           , sep
           , functionName
           , verbose
           );
  } else
  {
    write( "[%.3f]%s%s%s: %s", timeNow()/100000.0, gECU
           , sep
           , functionName
           , info
           );
  }
}
