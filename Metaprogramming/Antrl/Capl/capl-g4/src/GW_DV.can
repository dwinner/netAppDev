/*@!Encoding:1252*/
includes
{
  
}

variables
{
  
}

on message can1.*
{
    message 0x100 _msg1;
    
    _msg1 = this;
    _msg1.id = this.id;
    _msg1.CAN = 2;
    
    output( _msg1 );
    
}

on message can2.*
{
    message 0x100 _msg1;
    
    _msg1 = this;
    _msg1.id = this.id;
    _msg1.CAN = 1;
    
    output( _msg1 );
    
}

