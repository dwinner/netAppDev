/*@!Encoding:1252*/
variables
{
  byte result;
  
  diagRequest   DiagnServi_ReadDataByIdentCalibData               DiagnServi_ReadDataByIdentCalibData_Req;
  diagRequest   DiagnServi_WriteDataByIdentCalibData              DiagnServi_WriteDataByIdentCalibData_Req;
  
  diagRequest   DiagnServi_DiagnSessiContrOBDIIAndVWDefauSessi    DiagnServi_DiagnSessiContrOBDIIAndVWDefauSessi_Req;
  diagRequest   DiagnServi_DiagnSessiContrECUProgrSessi           DiagnServi_DiagnSessiContrECUProgrSessi_Req;
  diagRequest   DiagnServi_DiagnSessiContrExtenSessi              DiagnServi_DiagnSessiContrExtenSessi_Req;
  diagRequest   DiagnServi_DiagnSessiContrVWEndOfLineSessi        DiagnServi_DiagnSessiContrVWEndOfLineSessi_Req;
  diagRequest   DiagnServi_DiagnSessiContrDevelSessi              DiagnServi_DiagnSessiContrDevelSessi_Req;
  
  diagRequest   DiagnServi_WriteDataByIdentECUIdent               DiagnServi_WriteDataByIdentECUIdent_Req;
  diagRequest   DiagnServi_WriteDataByIdentGenerServi             DiagnServi_WriteDataByIdentGenerServi_Req;
  
  diagRequest   DiagnServi_SecurAccesRequeSeed                    DiagnServi_SecurAccesRequeSeed_Req;
  diagRequest   DiagnServi_SecurAccesSendKey                      DiagnServi_SecurAccesSendKey_Req;
  
  diagRequest   DiagnServi_TestePrese                             DiagnServi_TestePrese_Req;
  
  diagRequest   DiagnServi_ReadMemorByAddre                       DiagnServi_ReadMemorByAddre_Req;
  diagRequest   DiagnServi_WriteMemorByAddre                      DiagnServi_WriteMemorByAddre_Req;
  
  diagRequest   DiagnServi_RoutiContrStartBasicSetti              DiagnServi_RoutiContrStartBasicSetti_Req;
  diagRequest   DiagnServi_RoutiContrRequeRoutiResulBasicSetti    DiagnServi_RoutiContrRequeRoutiResulBasicSetti_Req;
  diagRequest   DiagnServi_RoutiContrStopBasicSetti               DiagnServi_RoutiContrStopBasicSetti_Req;
  diagRequest   DiagnServi_ReadDataByIdentBasicSettiStatu         DiagnServi_ReadDataByIdentBasicSettiStatu_Req;
  
  diagRequest   DiagnServi_ReadDataByIdentMeasuValue              DiagnServi_ReadDataByIdentMeasuValue_Req;
  
  byte sa_lock = 1;
  
  msTimer Tester_Present;
  message ISO_Funktionaler_Req_All mISO_Funktionaler_Req_All;
  
  byte routine_onoff = 0;
  byte routine_final_status = 0;

  byte check_0x826E = 0;
  byte check_0x0102 = 0;
  byte check_0x02B3 = 0;
  byte check_0x22D2 = 0;
  byte check_0x0286 = 0;
  byte check_0x1000 = 0;
  byte check_0x4293 = 0;
  
  mstimer read_measurement_0x826E;
  mstimer read_measurement_0x0102;
  mstimer read_measurement_0x02B3;
  mstimer read_measurement_0x22D2;
  mstimer read_measurement_0x0286;
  mstimer read_measurement_0x1000;
  mstimer read_measurement_0x4293;
  byte    number_of_measurement_channels = 7;
  float   measurement_channels_request_cycle_time = 100; // dummy wert
  
  int active_ref_id;
}

on start
{
  // Bezeichnung aus ODX
  diagSetTarget("BV_HeadUpDisplUDS");
  @Diag_HUD_Tester_Present = 0;
  
  @Diag_HUD_Measurement_blocks_cycle_time = 100;
  
  callAllOnEnvVar();
  
  // Lesezyklus für Messwerte starten
  settimer (read_measurement_0x02B3,0);
}

on envVar Diag_HUD_Measurement_blocks_cycle_time
{
  measurement_channels_request_cycle_time = @this / number_of_measurement_channels;
}


    //////////////////////////
    //////Start Sequenz///////
    //////////////////////////
    // -> Session Wechsel   //
    // -> Repair Shop Code  //
    // -> Programmign Date  //
    // -> Security Access   //
    // -> Daten schreiben   //
    //////////////////////////



//////////////////////// Codierung ////////////////////////

// -> nicht in pdx




//////////////////////// Anpassung ////////////////////////

/*
0x02CA Knockout_counter
0x02CB Knockout_timer
0x09F3 Knockout_test_mode
0x3B16 Picture_rotation
0x3B57 Reference_point_production
0x3B58 Reference_point_supplier
0x0501 Dimming_characteristic
0x0502 Dimming_parameters
0x0503 asil_parameters
*/




on envVar Knockout_counter_Read // 0x02CA Knockout_counter
{
  if (@this == 1)
    read_anpassung(0x02CA);
}

on envVar Knockout_timer_Read // 0x02CB Knockout_timer
{
  if (@this == 1)
    read_anpassung(0x02CB);
}

on envVar Knockout_test_mode_Read // 0x09F3 Knockout_test_mode
{
  if (@this == 1)
    read_anpassung(0x09F3);
}

on envVar Picture_rotation_Read // 0x3B16 Picture_rotation
{
  if (@this == 1)
    read_anpassung(0x3B16);
}

on envVar Reference_point_production_Read // 0x3B57 Reference_point_production
{
  if (@this == 1)
    read_anpassung(0x3B57);
}

on envVar Reference_point_supplier_Read // 0x3B58 Reference_point_supplier
{
  if (@this == 1)
    read_anpassung(0x3B58);
}

on envVar Dimming_characteristic_Read // 0x0501 Dimming_characteristic
{
  if (@this == 1)
    read_anpassung(0x0501);
}

on envVar Dimming_parameters_Read // 0x0502 Dimming_parameters
{
  if (@this == 1)
    read_anpassung(0x0502);
}

on envVar asil_parameters_Read // 0x0x0503 asil_parameters
{
  if (@this == 1)
    read_anpassung(0x0503);
}






read_anpassung(int ref_id)
{
  diagSetParameter(DiagnServi_ReadDataByIdentCalibData_Req,"Param_RecorDataIdent",ref_id);
  diagSendRequest (DiagnServi_ReadDataByIdentCalibData_Req);
}

on diagResponse DiagnServi_ReadDataByIdentCalibData
{
  int ref_id;
  byte error_code;

  ref_id = diagGetParameter(this, "Param_RecorDataIdent");
  
  if (diagIsPositiveResponse(this) != 0)
  {
    switch (ref_id)
    {
      case 0x02CA: // 0x02CA Knockout_counter
        @BusKnockOut_Ctr = diagGetParameter(this, "Param_BusKnCtr");
        @ECUKnockout_Ctr = diagGetParameter(this, "Param_ECUKnCtr");
      break;
      
      
      case 0x02CB: // 0x02CB Knockout_timer
        @ECUKnockOut_Tmr = diagGetParameter(this, "Param_ECUKnTmr");
        @BusKnockOut_Tmr = diagGetParameter(this, "Param_BusKnTmr");
        @BusKnockOut_Tmr_NVEM = diagGetParameter(this, "Param_BusKnTmrNVEM");
      break;
      
      
      case 0x09F3: // 0x09F3 Knockout_test_mode
        @KnockOut_Test_Bus_Sleep = diagGetParameter(this, "Param_BusSleep");
        @KnockOut_Test_Veto = diagGetParameter(this, "Param_Veto");
        @KnockOut_Test_Supress_Veto = diagGetParameter(this, "Param_SupreVeto");
      break;
      
      
      case 0x3B16: // 0x3B16 Picture_rotation
        @Rotation_angle = diagGetParameter(this, "Param_RotatAngle");
      break;
      
      
      case 0x3B57: // 0x3B57 Reference_point_production
        @Reference_point_production = diagGetParameter(this, "Param_ReferPoint");
      break;
      
      
      case 0x3B58: // 0x3B58 Reference_point_supplier
        @Reference_point_supplier = diagGetParameter(this, "Param_ReferPoint");
      break;
      
      
      case 0x0501: // 0x0501 Dimming_characteristic
        @Characteristic_curve_max_X1 = diagGetParameter(this, "Param_CharaCurveMaxX1");
        @Characteristic_curve_max_X2 = diagGetParameter(this, "Param_CharaCurveMaxX2");
        @Characteristic_curve_max_X3 = diagGetParameter(this, "Param_CharaCurveMaxX3");
        @Characteristic_curve_max_X4 = diagGetParameter(this, "Param_CharaCurveMaxX4");
        @Characteristic_curve_max_X5 = diagGetParameter(this, "Param_CharaCurveMaxX5");
        @Characteristic_curve_max_X6 = diagGetParameter(this, "Param_CharaCurveMaxX6");
        @Characteristic_curve_max_X7 = diagGetParameter(this, "Param_CharaCurveMaxX7");
        @Characteristic_curve_max_Y1 = diagGetParameter(this, "Param_CharaCurveMaxY1");
        @Characteristic_curve_max_Y2 = diagGetParameter(this, "Param_CharaCurveMaxY2");
        @Characteristic_curve_max_Y3 = diagGetParameter(this, "Param_CharaCurveMaxY3");
        @Characteristic_curve_max_Y4 = diagGetParameter(this, "Param_CharaCurveMaxY4");
        @Characteristic_curve_max_Y5 = diagGetParameter(this, "Param_CharaCurveMaxY5");
        @Characteristic_curve_max_Y6 = diagGetParameter(this, "Param_CharaCurveMaxY6");
        @Characteristic_curve_max_Y7 = diagGetParameter(this, "Param_CharaCurveMaxY7");
        @Characteristic_curve_min_X1 = diagGetParameter(this, "Param_CharaCurveMinX1");
        @Characteristic_curve_min_X2 = diagGetParameter(this, "Param_CharaCurveMinX2");
        @Characteristic_curve_min_X3 = diagGetParameter(this, "Param_CharaCurveMinX3");
        @Characteristic_curve_min_X4 = diagGetParameter(this, "Param_CharaCurveMinX4");
        @Characteristic_curve_min_X5 = diagGetParameter(this, "Param_CharaCurveMinX5");
        @Characteristic_curve_min_X6 = diagGetParameter(this, "Param_CharaCurveMinX6");
        @Characteristic_curve_min_X7 = diagGetParameter(this, "Param_CharaCurveMinX7");
        @Characteristic_curve_min_Y1 = diagGetParameter(this, "Param_CharaCurveMinY1");
        @Characteristic_curve_min_Y2 = diagGetParameter(this, "Param_CharaCurveMinY2");
        @Characteristic_curve_min_Y3 = diagGetParameter(this, "Param_CharaCurveMinY3");
        @Characteristic_curve_min_Y4 = diagGetParameter(this, "Param_CharaCurveMinY4");
        @Characteristic_curve_min_Y5 = diagGetParameter(this, "Param_CharaCurveMinY5");
        @Characteristic_curve_min_Y6 = diagGetParameter(this, "Param_CharaCurveMinY6");
        @Characteristic_curve_min_Y7 = diagGetParameter(this, "Param_CharaCurveMinY7");
      break;
        
        
      case 0x0502: // 0x0502 Dimming_parameters
        @Input_medium_customer = diagGetParameter(this, "Param_InputMediuCusto");
        @Input_medium_customer_hud = diagGetParameter(this, "Param_InputMediuCustoHud");
        @Loading_k = diagGetParameter(this, "Param_LoadiK");
        @Mapping_fotosensor = diagGetParameter(this, "Param_MappiFotos");
        @Mapping_RLS = diagGetParameter(this, "Param_MappiRLS");
        @Mapping_RLS_boost = diagGetParameter(this, "Param_MappiRLSBoost");
        @Max_implausible_Output_PWM = diagGetParameter(this, "Param_MaxImplaOutpuPWM");
        @Plausibility_threshold = diagGetParameter(this, "Param_PlausThres");
        @PT1_down_Boost = diagGetParameter(this, "Param_PT1DownBoost");
        @PT1_down_customer_wish = diagGetParameter(this, "Param_PT1DownCustoWish");
        @PT1_down_Fotosensor = diagGetParameter(this, "Param_PT1DownFotos");
        @PT1_down_HUD_HMI_brightness = diagGetParameter(this, "Param_PT1DownHUDHMIBrigh");
        @PT1_down_Output_PWM = diagGetParameter(this, "Param_PT1DownOutpuPWM");
        @PT1_down_RLS = diagGetParameter(this, "Param_PT1DownRLS");
        @PT1_switch_off = diagGetParameter(this, "Param_PT1SwitcOff");
        @PT1_switch_on = diagGetParameter(this, "Param_PT1SwitcOn");
        @PT1_up_Boost = diagGetParameter(this, "Param_PT1UpBoost");
        @PT1_up_customer_wish = diagGetParameter(this, "Param_PT1UpCustoWish");
        @PT1_up_Fotosensor = diagGetParameter(this, "Param_PT1UpFotos");
        @PT1_up_HUD_HMI_brightness = diagGetParameter(this, "Param_PT1UpHUDHMIBrigh");
        @PT1_up_Output_PWM = diagGetParameter(this, "Param_PT1UpOutpuPWM");
        @PT1_up_RLS = diagGetParameter(this, "Param_PT1UpRLS");
        @Substitute_value_customer_brighness = diagGetParameter(this, "Param_SubstValueCustoBrigh");
        @Substitute_value_Output_PWM = diagGetParameter(this, "Param_SubstValueOutpuPWM");
        @Substitute_value_s_BCM1_actuating_variable_Kl_58_s = diagGetParameter(this, "Param_SubstValueSBCM1ActuaVariaKl58S");
        @Substitute_value_s_Boost_Illumination = diagGetParameter(this, "Param_SubstValueSBoostIllum");
        @Substitute_value_s_RLS_illumination_FW = diagGetParameter(this, "Param_SubstValueSRLSIllumFW");
        @Threshold_level = diagGetParameter(this, "Param_ThresLevel");
        @White_balance = diagGetParameter(this, "Param_WhiteBalan");
      break;
        
        
      case 0x0503: // 0x0x0503 asil_parameters
        @ambient_light_sensor_value = diagGetParameter(this, "Param_AmbieLightSensoValue");
        @BLU_brightness_threshold = diagGetParameter(this, "Param_BLUBrighThres");
        @threshold_blinding_detection_all_delta_luminance = diagGetParameter(this, "Param_ThresBlindDetecAllDeltaLumin");
        @threshold_blinding_detection_all_luminance = diagGetParameter(this, "Param_ThresBlindDetecAllLumin");
        @threshold_blinding_detection_detection_test_set_luminance = diagGetParameter(this, "Param_ThresBlindDetecDetecTestSetLumin");
        @threshold_blinding_detection_full = diagGetParameter(this, "Param_ThresBlindDetecFull");
        @threshold_blinding_detection_matrix = diagGetParameter(this, "Param_ThresBlindDetecMatri");
        @threshold_blinding_detection_quarter_luminance = diagGetParameter(this, "Param_ThresBlindDetecQuartLumin");
        @threshold_blinding_detection = diagGetParameter(this, "Param_ThresFlashDetec");
        @vehicle_speed = diagGetParameter(this, "Param_VehicSpeed");
      break;
    }
    writelineex(4,0,"Anpasskanal 0x%x erfolgreich gelesen", ref_id);
    @Diag_HUD_ErrorState = 0;
  }

  else
  {
    error_code = diagGetParameter(this, "Param_NegatRespoCode");
    writelineex(4,3,"Fehler 0x%x beim Lesen von Anpasskanal",error_code);
    @Diag_HUD_ErrorState = 1;
  }
}


on envVar Knockout_counter_Write // 0x02CB Knockout_counter
{
  if (@this == 1)
    write_anpassung(0x02CA);
}

on envVar Knockout_timer_Write // 0x02CB Knockout_timer
{
  if (@this == 1)
    write_anpassung(0x02CB);
}

on envVar Knockout_test_mode_Write // 0x09F3 Knockout_test_mode
{
  if (@this == 1)
    write_anpassung(0x09F3);
}

on envVar Picture_rotation_Write // 0x3B16 Picture_rotation
{
  if (@this == 1)
    write_anpassung(0x3B16);
}

on envVar Reference_point_production_Write // 0x3B57 Reference_point_production
{
  if (@this == 1)
    write_anpassung(0x3B57);
}

on envVar Reference_point_supplier_Write // 0x3B58 Reference_point_supplier
{
  if (@this == 1)
    write_anpassung(0x3B58);
}

on envVar Dimming_characteristic_Write // 0x0501 Dimming_characteristic
{
  if (@this == 1)
    write_anpassung(0x0501);
}

on envVar Dimming_parameters_Write // 0x0502 Dimming_parameters
{
  if (@this == 1)
    write_anpassung(0x0502);
}

on envVar asil_parameters_Write // 0x0503 asil_parameters
{
  if (@this == 1)
    write_anpassung(0x0503);
}


write_anpassung(int ref_id)
{
  switch (ref_id)
  {
    case 0x02CA: // 0x02CB Knockout_counter
      diagSetParameter(DiagnServi_WriteDataByIdentCalibData_Req,"Param_RecorDataIdent",ref_id);
      
      diagSetParameter(DiagnServi_WriteDataByIdentCalibData_Req,"Param_BusKnCtr",@BusKnockOut_Ctr);
      diagSetParameter(DiagnServi_WriteDataByIdentCalibData_Req,"Param_ECUKnCtr",@ECUKnockout_Ctr);
      
      diagSendRequest (DiagnServi_WriteDataByIdentCalibData_Req); 
    break;
      
      
    case 0x02CB: // 0x02CB Knockout_timer
      diagSetParameter(DiagnServi_WriteDataByIdentCalibData_Req,"Param_RecorDataIdent",ref_id);
      
      diagSetParameter(DiagnServi_WriteDataByIdentCalibData_Req,"Param_ECUKnTmr",@ECUKnockOut_Tmr);
      diagSetParameter(DiagnServi_WriteDataByIdentCalibData_Req,"Param_BusKnTmr",@BusKnockOut_Tmr);
      diagSetParameter(DiagnServi_WriteDataByIdentCalibData_Req,"Param_BusKnTmrNVEM",@BusKnockOut_Tmr_NVEM);
      
      diagSendRequest (DiagnServi_WriteDataByIdentCalibData_Req); 
    break;
      
      
    case 0x09F3: // 0x09F3 Knockout_test_mode
      diagSetParameter(DiagnServi_WriteDataByIdentCalibData_Req,"Param_RecorDataIdent",ref_id);
      
      diagSetParameter(DiagnServi_WriteDataByIdentCalibData_Req,"Param_BusSleep",@KnockOut_Test_Bus_Sleep);
      diagSetParameter(DiagnServi_WriteDataByIdentCalibData_Req,"Param_Veto",@KnockOut_Test_Veto);
      diagSetParameter(DiagnServi_WriteDataByIdentCalibData_Req,"Param_SupreVeto",@KnockOut_Test_Supress_Veto);
      
      diagSendRequest (DiagnServi_WriteDataByIdentCalibData_Req); 
    break;
      
      
    case 0x3B16: // 0x3B16 Picture_rotation
      diagSetParameter(DiagnServi_WriteDataByIdentCalibData_Req,"Param_RecorDataIdent",ref_id);
      
      diagSetParameter(DiagnServi_WriteDataByIdentCalibData_Req,"Param_RotatAngle",@Rotation_angle);
      
      diagSendRequest (DiagnServi_WriteDataByIdentCalibData_Req); 
    break;
    
    
    case 0x3B57: // 0x3B57 Reference_point_production
      diagSetParameter(DiagnServi_WriteDataByIdentCalibData_Req,"Param_RecorDataIdent",ref_id);
      
      diagSetParameter(DiagnServi_WriteDataByIdentCalibData_Req,"Param_ReferPoint",@Reference_point_production);
      
      diagSendRequest (DiagnServi_WriteDataByIdentCalibData_Req); 
    break;
    
    
    case 0x3B58: // 0x3B58 Reference_point_supplier
      diagSetParameter(DiagnServi_WriteDataByIdentCalibData_Req,"Param_RecorDataIdent",ref_id);
      
      diagSetParameter(DiagnServi_WriteDataByIdentCalibData_Req,"Param_ReferPoint",@Reference_point_supplier);
      
      diagSendRequest (DiagnServi_WriteDataByIdentCalibData_Req); 
    break;
      
      
    case 0x0501: // 0x0501 Dimming_characteristic
      diagSetParameter(DiagnServi_WriteDataByIdentCalibData_Req,"Param_RecorDataIdent",ref_id);
      
      diagSetParameter(DiagnServi_WriteDataByIdentCalibData_Req,"Param_CharaCurveMaxX1",@Characteristic_curve_max_X1);
      diagSetParameter(DiagnServi_WriteDataByIdentCalibData_Req,"Param_CharaCurveMaxX2",@Characteristic_curve_max_X2);
      diagSetParameter(DiagnServi_WriteDataByIdentCalibData_Req,"Param_CharaCurveMaxX3",@Characteristic_curve_max_X3);
      diagSetParameter(DiagnServi_WriteDataByIdentCalibData_Req,"Param_CharaCurveMaxX4",@Characteristic_curve_max_X4);
      diagSetParameter(DiagnServi_WriteDataByIdentCalibData_Req,"Param_CharaCurveMaxX5",@Characteristic_curve_max_X5);
      diagSetParameter(DiagnServi_WriteDataByIdentCalibData_Req,"Param_CharaCurveMaxX6",@Characteristic_curve_max_X6);
      diagSetParameter(DiagnServi_WriteDataByIdentCalibData_Req,"Param_CharaCurveMaxX7",@Characteristic_curve_max_X7);
      diagSetParameter(DiagnServi_WriteDataByIdentCalibData_Req,"Param_CharaCurveMaxY1",@Characteristic_curve_max_Y1);
      diagSetParameter(DiagnServi_WriteDataByIdentCalibData_Req,"Param_CharaCurveMaxY2",@Characteristic_curve_max_Y2);
      diagSetParameter(DiagnServi_WriteDataByIdentCalibData_Req,"Param_CharaCurveMaxY3",@Characteristic_curve_max_Y3);
      diagSetParameter(DiagnServi_WriteDataByIdentCalibData_Req,"Param_CharaCurveMaxY4",@Characteristic_curve_max_Y4);
      diagSetParameter(DiagnServi_WriteDataByIdentCalibData_Req,"Param_CharaCurveMaxY5",@Characteristic_curve_max_Y5);
      diagSetParameter(DiagnServi_WriteDataByIdentCalibData_Req,"Param_CharaCurveMaxY6",@Characteristic_curve_max_Y6);
      diagSetParameter(DiagnServi_WriteDataByIdentCalibData_Req,"Param_CharaCurveMaxY7",@Characteristic_curve_max_Y7);
      diagSetParameter(DiagnServi_WriteDataByIdentCalibData_Req,"Param_CharaCurveMinX1",@Characteristic_curve_min_X1);
      diagSetParameter(DiagnServi_WriteDataByIdentCalibData_Req,"Param_CharaCurveMinX2",@Characteristic_curve_min_X2);
      diagSetParameter(DiagnServi_WriteDataByIdentCalibData_Req,"Param_CharaCurveMinX3",@Characteristic_curve_min_X3);
      diagSetParameter(DiagnServi_WriteDataByIdentCalibData_Req,"Param_CharaCurveMinX4",@Characteristic_curve_min_X4);
      diagSetParameter(DiagnServi_WriteDataByIdentCalibData_Req,"Param_CharaCurveMinX5",@Characteristic_curve_min_X5);
      diagSetParameter(DiagnServi_WriteDataByIdentCalibData_Req,"Param_CharaCurveMinX6",@Characteristic_curve_min_X6);
      diagSetParameter(DiagnServi_WriteDataByIdentCalibData_Req,"Param_CharaCurveMinX7",@Characteristic_curve_min_X7);
      diagSetParameter(DiagnServi_WriteDataByIdentCalibData_Req,"Param_CharaCurveMinY1",@Characteristic_curve_min_Y1);
      diagSetParameter(DiagnServi_WriteDataByIdentCalibData_Req,"Param_CharaCurveMinY2",@Characteristic_curve_min_Y2);
      diagSetParameter(DiagnServi_WriteDataByIdentCalibData_Req,"Param_CharaCurveMinY3",@Characteristic_curve_min_Y3);
      diagSetParameter(DiagnServi_WriteDataByIdentCalibData_Req,"Param_CharaCurveMinY4",@Characteristic_curve_min_Y4);
      diagSetParameter(DiagnServi_WriteDataByIdentCalibData_Req,"Param_CharaCurveMinY5",@Characteristic_curve_min_Y5);
      diagSetParameter(DiagnServi_WriteDataByIdentCalibData_Req,"Param_CharaCurveMinY6",@Characteristic_curve_min_Y6);
      diagSetParameter(DiagnServi_WriteDataByIdentCalibData_Req,"Param_CharaCurveMinY7",@Characteristic_curve_min_Y7);
      
      diagSendRequest (DiagnServi_WriteDataByIdentCalibData_Req); 
    break;
      
      
    case 0x0502: // 0x0502 Dimming_parameters
      diagSetParameter(DiagnServi_WriteDataByIdentCalibData_Req,"Param_RecorDataIdent",ref_id);
      
      diagSetParameter(DiagnServi_WriteDataByIdentCalibData_Req,"Param_InputMediuCusto",@Input_medium_customer);
      diagSetParameter(DiagnServi_WriteDataByIdentCalibData_Req,"Param_InputMediuCustoHud",@Input_medium_customer_hud);
      diagSetParameter(DiagnServi_WriteDataByIdentCalibData_Req,"Param_LoadiK",@Loading_k);
      diagSetParameter(DiagnServi_WriteDataByIdentCalibData_Req,"Param_MappiFotos",@Mapping_fotosensor);
      diagSetParameter(DiagnServi_WriteDataByIdentCalibData_Req,"Param_MappiRLS",@Mapping_RLS);
      diagSetParameter(DiagnServi_WriteDataByIdentCalibData_Req,"Param_MappiRLSBoost",@Mapping_RLS_boost);
      diagSetParameter(DiagnServi_WriteDataByIdentCalibData_Req,"Param_MaxImplaOutpuPWM",@Max_implausible_Output_PWM);
      diagSetParameter(DiagnServi_WriteDataByIdentCalibData_Req,"Param_PlausThres",@Plausibility_threshold);
      diagSetParameter(DiagnServi_WriteDataByIdentCalibData_Req,"Param_PT1DownBoost",@PT1_down_Boost);
      diagSetParameter(DiagnServi_WriteDataByIdentCalibData_Req,"Param_PT1DownCustoWish",@PT1_down_customer_wish);
      diagSetParameter(DiagnServi_WriteDataByIdentCalibData_Req,"Param_PT1DownFotos",@PT1_down_Fotosensor);
      diagSetParameter(DiagnServi_WriteDataByIdentCalibData_Req,"Param_PT1DownHUDHMIBrigh",@PT1_down_HUD_HMI_brightness);
      diagSetParameter(DiagnServi_WriteDataByIdentCalibData_Req,"Param_PT1DownOutpuPWM",@PT1_down_Output_PWM);
      diagSetParameter(DiagnServi_WriteDataByIdentCalibData_Req,"Param_PT1DownRLS",@PT1_down_RLS);
      diagSetParameter(DiagnServi_WriteDataByIdentCalibData_Req,"Param_PT1SwitcOff",@PT1_switch_off);
      diagSetParameter(DiagnServi_WriteDataByIdentCalibData_Req,"Param_PT1SwitcOn",@PT1_switch_on);
      diagSetParameter(DiagnServi_WriteDataByIdentCalibData_Req,"Param_PT1UpBoost",@PT1_up_Boost);
      diagSetParameter(DiagnServi_WriteDataByIdentCalibData_Req,"Param_PT1UpCustoWish",@PT1_up_customer_wish);
      diagSetParameter(DiagnServi_WriteDataByIdentCalibData_Req,"Param_PT1UpFotos",@PT1_up_Fotosensor);
      diagSetParameter(DiagnServi_WriteDataByIdentCalibData_Req,"Param_PT1UpHUDHMIBrigh",@PT1_up_HUD_HMI_brightness);
      diagSetParameter(DiagnServi_WriteDataByIdentCalibData_Req,"Param_PT1UpOutpuPWM",@PT1_up_Output_PWM);
      diagSetParameter(DiagnServi_WriteDataByIdentCalibData_Req,"Param_PT1UpRLS",@PT1_up_RLS);
      diagSetParameter(DiagnServi_WriteDataByIdentCalibData_Req,"Param_SubstValueCustoBrigh",@Substitute_value_customer_brighness);
      diagSetParameter(DiagnServi_WriteDataByIdentCalibData_Req,"Param_SubstValueOutpuPWM",@Substitute_value_Output_PWM);
      diagSetParameter(DiagnServi_WriteDataByIdentCalibData_Req,"Param_SubstValueSBCM1ActuaVariaKl58S",@Substitute_value_s_BCM1_actuating_variable_Kl_58_s);
      diagSetParameter(DiagnServi_WriteDataByIdentCalibData_Req,"Param_SubstValueSBoostIllum",@Substitute_value_s_Boost_Illumination);
      diagSetParameter(DiagnServi_WriteDataByIdentCalibData_Req,"Param_SubstValueSRLSIllumFW",@Substitute_value_s_RLS_illumination_FW);
      diagSetParameter(DiagnServi_WriteDataByIdentCalibData_Req,"Param_ThresLevel",@Threshold_level);
      diagSetParameter(DiagnServi_WriteDataByIdentCalibData_Req,"Param_WhiteBalan",@White_balance);
      
      diagSendRequest (DiagnServi_WriteDataByIdentCalibData_Req); 
    break;
      
      
    case 0x0503: // 0x0503 asil_parameters
      diagSetParameter(DiagnServi_WriteDataByIdentCalibData_Req,"Param_RecorDataIdent",ref_id);
      
      diagSetParameter(DiagnServi_WriteDataByIdentCalibData_Req,"Param_AmbieLightSensoValue",@ambient_light_sensor_value);
      diagSetParameter(DiagnServi_WriteDataByIdentCalibData_Req,"Param_BLUBrighThres",@BLU_brightness_threshold);
      diagSetParameter(DiagnServi_WriteDataByIdentCalibData_Req,"Param_ThresBlindDetecAllDeltaLumin",@threshold_blinding_detection_all_delta_luminance);
      diagSetParameter(DiagnServi_WriteDataByIdentCalibData_Req,"Param_ThresBlindDetecAllLumin",@threshold_blinding_detection_all_luminance);
      diagSetParameter(DiagnServi_WriteDataByIdentCalibData_Req,"Param_ThresBlindDetecDetecTestSetLumin",@threshold_blinding_detection_detection_test_set_luminance);
      diagSetParameter(DiagnServi_WriteDataByIdentCalibData_Req,"Param_ThresBlindDetecFull",@threshold_blinding_detection_full);
      diagSetParameter(DiagnServi_WriteDataByIdentCalibData_Req,"Param_ThresBlindDetecMatri",@threshold_blinding_detection_matrix);
      diagSetParameter(DiagnServi_WriteDataByIdentCalibData_Req,"Param_ThresBlindDetecQuartLumin",@threshold_blinding_detection_quarter_luminance);
      diagSetParameter(DiagnServi_WriteDataByIdentCalibData_Req,"Param_ThresFlashDetec",@threshold_blinding_detection);
      diagSetParameter(DiagnServi_WriteDataByIdentCalibData_Req,"Param_VehicSpeed",@vehicle_speed);
      
      diagSendRequest (DiagnServi_WriteDataByIdentCalibData_Req); 
  }
}


on diagResponse DiagnServi_WriteDataByIdentCalibData
{
  int ref_id;
  byte error_code;
  
  if (diagIsPositiveResponse(this) != 0)
  {
    ref_id = diagGetParameter(this, "Param_RecorDataIdent");
    writelineex(4,0,"Anpasskanal 0x%x erfolgreich geschrieben", ref_id);
    @Diag_HUD_ErrorState = 0;
  }
  else
  {
    error_code = diagGetParameter(this, "Param_NegatRespoCode");
    writelineex(4,3,"Fehler 0x%x beim Schreiben von Anpasskanal",error_code);
    @Diag_HUD_ErrorState = 1;
  }
}










//////////////////////// Diag Session ////////////////////////

on envVar Diag_HUD_DiagSession_Set
{
  if (@this == 1)
  {
    switch (@Diag_HUD_DiagSession)
    {
      case 0x00:   writelineex(4,3,"Bitte gültige Session waehlen");                      break;
      case 0x01:   diagSendRequest (DiagnServi_DiagnSessiContrOBDIIAndVWDefauSessi_Req);  break;
      case 0x02:   diagSendRequest (DiagnServi_DiagnSessiContrECUProgrSessi_Req);         break;
      case 0x03:   diagSendRequest (DiagnServi_DiagnSessiContrExtenSessi_Req);            break;
      case 0x40:   diagSendRequest (DiagnServi_DiagnSessiContrVWEndOfLineSessi_Req);      break;
      case 0x4F:   diagSendRequest (DiagnServi_DiagnSessiContrDevelSessi_Req);            break;
    }
  }
}

on diagResponse DiagnServi_DiagnSessiContrOBDIIAndVWDefauSessi
{
  if (diagIsPositiveResponse(this) != 0)
  {
    writelineex(4,0,"Wechsel zu Default Session erfolgreich");
    @Diag_HUD_ErrorState = 0;
  }
  else
  {
    writelineex(4,3,"Fehler bei Wechsel zu Default Session");
    @Diag_HUD_ErrorState = 1;
  }
}

on diagResponse DiagnServi_DiagnSessiContrECUProgrSessi
{
  if (diagIsPositiveResponse(this) != 0)
  {
    writelineex(4,0,"Wechsel zu ECU Programming Session erfolgreich");
    @Diag_HUD_ErrorState = 0;
  }
  else
  {
    writelineex(4,3,"Fehler bei Wechsel zu ECU Programming Session");
    @Diag_HUD_ErrorState = 1;
  }
}

on diagResponse DiagnServi_DiagnSessiContrExtenSessi
{
  if (diagIsPositiveResponse(this) != 0)
  {
    writelineex(4,0,"Wechsel zu Extended Diagnostic Session erfolgreich");
    @Diag_HUD_ErrorState = 0;
  }
  else
  {
    writelineex(4,3,"Fehler bei Wechsel zu Extended Diagnostic Session");
    @Diag_HUD_ErrorState = 1;
  }
}

on diagResponse DiagnServi_DiagnSessiContrVWEndOfLineSessi
{
  if (diagIsPositiveResponse(this) != 0)
  {
    writelineex(4,0,"Wechsel zu VW EOL Session erfolgreich");
    @Diag_HUD_ErrorState = 0;
  }
  else
  {
    writelineex(4,3,"Fehler bei Wechsel zu VW EOL Session");
    @Diag_HUD_ErrorState = 1;
  }
}

on diagResponse DiagnServi_DiagnSessiContrDevelSessi
{
  if (diagIsPositiveResponse(this) != 0)
  {
    writelineex(4,0,"Wechsel zu Development Session erfolgreich");
    @Diag_HUD_ErrorState = 0;
  }
  else
  {
    writelineex(4,3,"Fehler bei Wechsel zu Development Session");
    @Diag_HUD_ErrorState = 1;
  }
}





//////////////////////// Repair Shop Code & Programming Date ////////////////////////

on envVar Diag_HUD_RepairShopCode_Write
{
  dword Param_RequeDataIdent = 0xF198; // Identifier Repair Shop Code
  dword Param_VWDevicNumbe = 0x000386; // 21 Bit
  dword Param_ImporNumbe = 0x00C1;     // 10 Bit
  dword Param_WorksNumbe = 0x0014C5;   // 17 Bit
  byte data[6] = { 0x03, 0x86, 0xC1, 0x00, 0x14, 0xC5 };
  
  if (@this == 1)
  {
    diagSetParameter    (DiagnServi_WriteDataByIdentGenerServi_Req, "Param_RecorDataIdent", Param_RequeDataIdent);
    diagSetParameterRaw (DiagnServi_WriteDataByIdentGenerServi_Req, "Param_DataRecor", data, 6);
    
    diagSendRequest  (DiagnServi_WriteDataByIdentGenerServi_Req);
  }
}

on envVar Diag_HUD_ProgrammingDate_Write
{
  dword Param_RequeDataIdent = 0xF199; // Identifier Programming Date
  byte Param_Day;
  byte Param_Month;
  byte Param_Year;
  long date[9];
  byte data [3];
  
  if (@this == 1)
  {
    // Datum aus Windows Zeit holen und zuweisen
    getlocaltime(date);
    Param_Year  = date[5]-100; // Jahr
    Param_Month = date[4]+1;   // Monat
    Param_Day   = date[3];     // Tag
    
    data[0] = Param_Year  + (Param_Year/10) * 6;
    data[1] = Param_Month + (Param_Month/10) * 6;
    data[2] = Param_Day   + (Param_Day/10) * 6;
    
    diagSetParameter    (DiagnServi_WriteDataByIdentGenerServi_Req, "Param_RecorDataIdent" , Param_RequeDataIdent);
    diagSetParameterRaw (DiagnServi_WriteDataByIdentGenerServi_Req, "Param_DataRecor" , data, 3);
    
    diagSendRequest  (DiagnServi_WriteDataByIdentGenerServi_Req);
  }
}

on diagResponse DiagnServi_WriteDataByIdentGenerServi
{ write("drin");
  if (diagIsPositiveResponse(this) != 0)
  {
    if ( diagGetParameter (this, "Param_RecorDataIdent") == 0xF198) // Repair Shop Code
    {
      writelineex(4,0,"Schreiben des Werkstattcodes erfolgreich");
      @Diag_HUD_ErrorState = 0;
    }
    if ( diagGetParameter (this, "Param_RecorDataIdent") == 0xF199) // Programming Date
    {
      writelineex(4,0,"Schreiben des Datums erfolgreich");
      @Diag_HUD_ErrorState = 0;
    }
  }
  else
  {
    writelineex(4,3,"Fehler bei Schreiben des Wertes");
    @Diag_HUD_ErrorState = 1;
  }
}








//////////////////////// Security Access ////////////////////////

on envVar Diag_HUD_SecurityAccess_Start
{
  byte Param_SecurAccesType = 0x03;
  
  if (@this == 1)
  {
    sa_lock = 0;
    diagSetParameter (DiagnServi_SecurAccesRequeSeed_Req, "Param_SecurAccesType", Param_SecurAccesType);
    diagSendRequest  (DiagnServi_SecurAccesRequeSeed_Req);
  }
}

on diagResponse DiagnServi_SecurAccesRequeSeed
{
  dword Param_SecurAccesSeed = 0;
  
  if (sa_lock == 0)
  {
    if (diagIsPositiveResponse(this) != 0)
    {
      Param_SecurAccesSeed = diagGetParameter (this, "Param_SecurAccesSeed");
      security_access_send_key(Param_SecurAccesSeed);
      @Diag_HUD_ErrorState = 0;
    }
    else
    {
      writelineex(4,3,"Fehler bei Security Access - Request Seed");
      @Diag_HUD_ErrorState = 1;
    }
  }
}

security_access_send_key(dword security_access_seed)
{
  dword security_access_key;
  
  if (sa_lock == 0)
  {
    security_access_key = security_access_seed + @Diag_HUD_Login;

    diagSetParameter (DiagnServi_SecurAccesSendKey_Req, "Param_SecurAccesKey", security_access_key);
    
    diagSendRequest  (DiagnServi_SecurAccesSendKey_Req);
  }
}

on diagResponse DiagnServi_SecurAccesSendKey
{
  if (sa_lock == 0)
  {
    if (diagIsPositiveResponse(this) != 0)
    {
      writelineex(4,0,"Security Access erfolgreich");
      @Diag_HUD_ErrorState = 0;
    }
    else
    {
      writelineex(4,3,"Fehler bei Security Access - Send Key / Login prüfen");
      sa_lock = 1;
      @Diag_HUD_ErrorState = 1;
    }
  }
}







//////////////////////// Tester Present ////////////////////////

on envVar Diag_HUD_Tester_Present // Umsetzung aus Zeitgründen hardcoded, besser über callback Interface, später nochmal überarbeiten
{
  if (@this == 1)
    setTimer (Tester_Present,0);
  else
    canceltimer (Tester_Present);
}

on timer Tester_Present
{
  //diagSetParameter (DiagnServi_TestePrese_Req, "Param_SupprPositRespoMessaIndicBit", 1);
  //diagSendRequest  (DiagnServi_TestePrese_Req);
  
  mISO_Funktionaler_Req_All.byte(0) = 0x02;
  mISO_Funktionaler_Req_All.byte(1) = 0x3E;
  mISO_Funktionaler_Req_All.byte(2) = 0x80;
  mISO_Funktionaler_Req_All.byte(3) = 0x55;
  mISO_Funktionaler_Req_All.byte(4) = 0x55;
  mISO_Funktionaler_Req_All.byte(5) = 0x55;
  mISO_Funktionaler_Req_All.byte(6) = 0x55;
  mISO_Funktionaler_Req_All.byte(7) = 0x55;
  output(mISO_Funktionaler_Req_All);
  
  setTimer (Tester_Present,2000);
}









//////////////////////// EEPROM ////////////////////////

on envVar Diag_HUD_EEPROM_Read
{
  byte data[4];
  
  if (@this == 1)
  {
    data[0] = 0xEF;
    data[1] = 0x00;
    data[2] = (@Diag_HUD_EEPROM_Address >> 8) & 0x00FF;
    data[3] =  @Diag_HUD_EEPROM_Address       & 0x00FF;
    
    diagSetParameter (DiagnServi_ReadMemorByAddre_Req,   "Param_LengtFormaIdent", 1);
    diagSetParameter (DiagnServi_ReadMemorByAddre_Req,   "Param_AddreFormaIdent", 4);
    diagSetParameterRaw(DiagnServi_ReadMemorByAddre_Req, "Param_MemorAddre",  data,4);
    diagSetParameter (DiagnServi_ReadMemorByAddre_Req,   "Param_MemorSize", 1);
    diagSendRequest  (DiagnServi_ReadMemorByAddre_Req);
  }
}

on diagResponse DiagnServi_ReadMemorByAddre
{
  if (diagIsPositiveResponse(this) != 0)
  {
    writelineex(4,0,"EEPROM lesen erfolgreich");
    @Diag_HUD_EEPROM_Value = diagGetParameter(this, "Param_DataRecor");
    @Diag_HUD_ErrorState = 0;
  }
  else
  {
    writelineex(4,3,"Error 0x%x bei EEPROM lesen",diagGetParameter(this, "Param_NegatRespoCode"));
    @Diag_HUD_ErrorState = 1;
  }
}

on envVar Diag_HUD_EEPROM_Write
{
  byte data4[4];
  byte data1[1];
  
  if (@this == 1)
  {
    data4[0] = 0xEF;
    data4[1] = 0x00;
    data4[2] = (@Diag_HUD_EEPROM_Address >> 8) & 0x00FF;
    data4[3] =  @Diag_HUD_EEPROM_Address       & 0x00FF;
    
    data1[0] = @Diag_HUD_EEPROM_Value;
    
    diagSetParameter (DiagnServi_WriteMemorByAddre_Req,   "Param_LengtFormaIdent", 1);
    diagSetParameter (DiagnServi_WriteMemorByAddre_Req,   "Param_AddreFormaIdent", 4);
    diagSetParameterRaw(DiagnServi_WriteMemorByAddre_Req, "Param_MemorAddre",  data4,4);
    diagSetParameter (DiagnServi_WriteMemorByAddre_Req,   "Param_MemorSize", 1);
    diagSetParameterRaw(DiagnServi_WriteMemorByAddre_Req, "Param_DataRecor",  data1,1);
    diagSendRequest  (DiagnServi_WriteMemorByAddre_Req);
  }
}

on diagResponse DiagnServi_WriteMemorByAddre
{
  if (diagIsPositiveResponse(this) != 0)
  {
    writelineex(4,0,"EEPROM schreiben erfolgreich");
    @Diag_HUD_ErrorState = 0;
  }
  else
  {
    writelineex(4,3,"Error 0x%x bei EEPROM schreiben",diagGetParameter(this, "Param_NegatRespoCode"));
    @Diag_HUD_ErrorState = 1;
  }
}






//////////////////////// Routinen - Grundeinstellung ////////////////////////

// Reset of all adaptions

on envVar Diag_HUD_Reset_of_all_adaptions_Start
{
  byte data[3] = { 0x04, 0x00, 0x00 };
  
  if (@this == 1)
  {
    routine_onoff = 1;
    routine_final_status = 0;
    diagSetParameter    (DiagnServi_RoutiContrStartBasicSetti_Req, "Param_RoutiIdent", @Diag_HUD_Routine_Identifier);
    diagSetParameterRaw (DiagnServi_RoutiContrStartBasicSetti_Req, "Param_RoutiContrOptio23",  data, 3);
    diagSendRequest     (DiagnServi_RoutiContrStartBasicSetti_Req);
  }
}

on diagResponse DiagnServi_RoutiContrStartBasicSetti
{
  if (diagIsPositiveResponse(this) != 0)
  {
    writelineex(4,0,"Start Routine erfolgreich");
    @Diag_HUD_ErrorState = 0;
    read_Basic_Settings_Status();
  }
  else
  {
    writelineex(4,3,"Error 0x%x bei Start Routine",diagGetParameter(this, "Param_NegatRespoCode"));
    @Diag_HUD_ErrorState = 1;
  }
}

read_Basic_Settings_Status ()
{
  diagSendRequest (DiagnServi_ReadDataByIdentBasicSettiStatu_Req);
}

on diagResponse DiagnServi_ReadDataByIdentBasicSettiStatu
{
  if (diagIsPositiveResponse(this) != 0)
  {
    if (diagGetParameter(this, "Param_DataRecor") == 0x00)
      writelineex(4,0,"Routine Status Read erfolgreich - basic setting routine not running");
    
    if (diagGetParameter(this, "Param_DataRecor") == 0xC0)
    {
      writelineex(4,0,"Routine Status Read erfolgreich - basic setting routine running");
      @Diag_HUD_ErrorState = 0;
      if (routine_final_status == 0) Request_Routine_Results();
    }
  }
  else
  {
    writelineex(4,3,"Error bei Routine Status Read");
    @Diag_HUD_ErrorState = 1;
  }
}

Request_Routine_Results ()
{
  diagSetParameter (DiagnServi_RoutiContrRequeRoutiResulBasicSetti_Req, "Param_RoutiIdent",@Diag_HUD_Routine_Identifier);
  diagSendRequest  (DiagnServi_RoutiContrRequeRoutiResulBasicSetti_Req);
}

on diagResponse DiagnServi_RoutiContrRequeRoutiResulBasicSetti
{
  if (diagIsPositiveResponse(this) != 0)
  {
    // TODO: Auswertung -> falsche Länge?
    writelineex(4,0,"Request Routine Results erfolgreich");
    @Diag_HUD_ErrorState = 0;
    
    // Anfrageschleife erneut durchlaufen oder abbrechen
    if (routine_onoff == 1)
      read_Basic_Settings_Status();
    else
      Stop_Basic_Setting ();
  }
  else
  {
    writelineex(4,3,"Error bei Request Routine Results");
    @Diag_HUD_ErrorState = 1;
  }
}

on envVar Diag_HUD_Reset_of_all_adaptions_Stop
{
  routine_onoff = 0;  
}

Stop_Basic_Setting ()
{
  diagSetParameter (DiagnServi_RoutiContrStopBasicSetti_Req, "Param_RoutiIdent", @Diag_HUD_Routine_Identifier);
  diagSendRequest  (DiagnServi_RoutiContrStopBasicSetti_Req);
}

on diagResponse DiagnServi_RoutiContrStopBasicSetti
{
  if (diagIsPositiveResponse(this) != 0)
  {
    writelineex(4,0,"Stop Routine erfolgreich");
    @Diag_HUD_ErrorState = 0;
    routine_final_status = 1;
    read_Basic_Settings_Status ();
  }
  else
  {
    writelineex(4,3,"Stop Routine fehlgeschlagen");
    @Diag_HUD_ErrorState = 1;
  }
}





//////////////////////// Messwerte ////////////////////////

/*
0x826E Backlight
0x0102 Basic Settings Status
0x02B3 Response_On_Event
0x22D2 Vehicle_speed
0x0286 Voltage terminal 30
0x1000 Brightness_calculation
0x4293 Control_modul_temperature_head_up_display
*/




// 0x826E Backlight
on envVar Backlight_Start 
{
  check_0x826E = 1;
}
on envVar Backlight_Stop
{
  check_0x826E = 0;
}

// 0x0102 Basic Settings Status
on envVar Basic_Settings_Status_Start 
{
  check_0x0102 = 1;
}
on envVar Basic_Settings_Status_Stop
{
  check_0x0102 = 0;
}

// 0x02B3 Response_On_Event
on envVar Response_On_Event_Start 
{
  check_0x02B3 = 1;
}
on envVar Response_On_Event_Stop
{
  check_0x02B3 = 0;
}

// 0x22D2 Vehicle_speed
on envVar Vehicle_speed_Start 
{
  check_0x22D2 = 1;
}
on envVar Vehicle_speed_Stop
{
  check_0x22D2 = 0;
}

// 0x0286 Voltage terminal 30
on envVar Voltage_terminal_30_Start 
{
  check_0x0286 = 1;
}
on envVar Voltage_terminal_30_Stop
{
  check_0x0286 = 0;
}

// 0x1000 Brightness_calculation
on envVar Brightness_calculation_Start 
{
  check_0x1000 = 1;
}
on envVar Brightness_calculation_Stop
{
  check_0x1000 = 0;
}

// 0x4293 Control_modul_temperature_head_up_display
on envVar Control_modul_temperature_head_up_display_Start 
{
  check_0x4293 = 1;
}
on envVar Control_modul_temperature_head_up_display_Stop
{
  check_0x4293 = 0;
}






// 0x826E Backlight
on timer read_measurement_0x826E
{
  active_ref_id = 0x826E;
  
  if (check_0x826E == 1)
    read_measurement_data (0x826E);
  else
    setTimer (read_measurement_0x0102, measurement_channels_request_cycle_time);
}

// 0x0102 Basic Settings Status
on timer read_measurement_0x0102
{
  active_ref_id = 0x0102;
  
  if (check_0x0102 == 1)
    read_measurement_data (0x0102);
  else
    setTimer (read_measurement_0x02B3, measurement_channels_request_cycle_time);
}

// 0x02B3 Response_On_Event
on timer read_measurement_0x02B3
{
  active_ref_id = 0x02B3;
  
  if (check_0x02B3 == 1)
    read_measurement_data (0x02B3);
  else
    setTimer (read_measurement_0x22D2, measurement_channels_request_cycle_time);
}

// 0x22D2 Vehicle_speed
on timer read_measurement_0x22D2
{
  active_ref_id = 0x22D2;
  
  if (check_0x22D2 == 1)
    read_measurement_data (0x22D2);
  else
    setTimer (read_measurement_0x0286, measurement_channels_request_cycle_time);
}

// 0x0286 Voltage terminal 30
on timer read_measurement_0x0286
{
  active_ref_id = 0x0286;
  
  if (check_0x0286 == 1)
    read_measurement_data (0x0286);
  else
    setTimer (read_measurement_0x1000, measurement_channels_request_cycle_time);
}

// 0x1000 Brightness_calculation
on timer read_measurement_0x1000
{
  active_ref_id = 0x1000;
  
  if (check_0x1000 == 1)
    read_measurement_data (0x1000);
  else
    setTimer (read_measurement_0x4293, measurement_channels_request_cycle_time);
}

// 0x4293 Control_modul_temperature_head_up_display
on timer read_measurement_0x4293
{
  active_ref_id = 0x4293;
  
  if (check_0x4293 == 1)
    read_measurement_data (0x4293);
  else
    setTimer (read_measurement_0x826E, measurement_channels_request_cycle_time);
}





read_measurement_data (word ref_id)
{
  diagSetParameter(DiagnServi_ReadDataByIdentMeasuValue_Req,"Param_RecorDataIdent",ref_id);
  diagSendRequest (DiagnServi_ReadDataByIdentMeasuValue_Req);
}

on diagResponse DiagnServi_ReadDataByIdentMeasuValue
{
  word ref_id;
  
  ref_id = diagGetParameter(this, "Param_RecorDataIdent");
  
  if (diagIsPositiveResponse(this) != 0)
  {
    writelineex(4,0,"Messwertblock 0x%x erfolgreich gelesen",ref_id);
    @Diag_HUD_ErrorState = 0;
    
    switch (active_ref_id)
    {
      case 0x826E: // 0x826E Backlight
        @Control_State_Value = diagGetParameter(this, "Param_ContrStateValue");
        @Control_Timer = diagGetParameter(this, "Param_ContrTimer");
        @IO_Reached_Status = diagGetParameter(this, "Param_IOReachStatu");
        setTimer (read_measurement_0x0102, measurement_channels_request_cycle_time);
      break;
        
      case 0x0102: // 0x0102 Basic Settings Status
        @State_of_basic_settings = diagGetParameter(this, "Param_StateOfBasicSetti");
        setTimer (read_measurement_0x02B3, measurement_channels_request_cycle_time);
      break;
        
      case 0x02B3: // 0x02B3 Response_On_Event
        @Response_On_Event = diagGetParameter(this, "Param_RespoOnEvent");
        setTimer (read_measurement_0x22D2, measurement_channels_request_cycle_time);
      break;
      
      case 0x22D2: // 0x22D2 Vehicle_speed
        @Vehicle_Speed_Sensor = diagGetParameter(this, "Param_VehicSpeedSenso");
        setTimer (read_measurement_0x0286, measurement_channels_request_cycle_time);
      break;
      
      case 0x0286: // 0x0286 Voltage terminal 30
        @Terminal_voltage = diagGetParameter(this, "Param_ParamToDOP78708") / 10.0;
        setTimer (read_measurement_0x1000, measurement_channels_request_cycle_time);
      break;
        
      case 0x1000: // 0x1000 Brightness_calculation
        @HUD_MMI_illumination                  = diagGetParameter(this, "Param_HUDMMIIllum");
        @Customer_illumination_KL_58_s         = diagGetParameter(this, "Param_CustoIllumKL58S");
        @Customer_illumination                 = diagGetParameter(this, "Param_CustoIllum");
        @Brightness_RLS_intern_HUD             = diagGetParameter(this, "Param_BrighRLSInterHUD");
        @Output_PWM_calc                       = diagGetParameter(this, "Param_OutpuPWMCalc");
        @Output_PWM_actual                     = diagGetParameter(this, "Param_OutpuPWMActua");
        @Brightness_RLS_Boost_intern_HUD       = diagGetParameter(this, "Param_BrighRLSBoostInterHUD");
        @Brightness_Photosensor_Bus_intern_HUD = diagGetParameter(this, "Param_BrighPhotoBusInterHUD");
        @HUD_active                            = diagGetParameter(this, "Param_HUDActiv");
        @Boost_Signal_Raw_Bus_Value            = diagGetParameter(this, "Param_BoostSignaRawBusValue");
        @Boost_Signal_Phys_Value               = diagGetParameter(this, "Param_BoostSignaPhysValue");
        @Brightness_Photosensor_Bus            = diagGetParameter(this, "Param_BrighPhotoBus");
        setTimer (read_measurement_0x4293, measurement_channels_request_cycle_time);
      break;
      
      case 0x4293: // 0x4293 Control_modul_temperature_head_up_display
        @Temperature_LED          = diagGetParameter(this, "Param_TempeLED");
        @Temperature_display_unit = diagGetParameter(this, "Param_TempeDisplUnit");
        setTimer (read_measurement_0x826E, measurement_channels_request_cycle_time);
      break;
    }
  }
  
  else
  {
    writelineex(4,3,"Fehler bei Lesen von Messwertblock");
    @Diag_HUD_ErrorState = 1;
    
    switch (active_ref_id)
    {
      case 0x826E: setTimer (read_measurement_0x0102, measurement_channels_request_cycle_time); break;
      case 0x0102: setTimer (read_measurement_0x02B3, measurement_channels_request_cycle_time); break;
      case 0x02B3: setTimer (read_measurement_0x22D2, measurement_channels_request_cycle_time); break;
      case 0x22D2: setTimer (read_measurement_0x0286, measurement_channels_request_cycle_time); break;
      case 0x0286: setTimer (read_measurement_0x1000, measurement_channels_request_cycle_time); break;
      case 0x1000: setTimer (read_measurement_0x4293, measurement_channels_request_cycle_time); break;
      case 0x4293: setTimer (read_measurement_0x826E, measurement_channels_request_cycle_time); break;
    }
  }
}