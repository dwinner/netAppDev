/*@!Encoding:1252*/
includes
{
  #include "../../_DLL/latest_BAP_DLL.cin"
}

variables
{

	//@BAPSIMGEN_VAR_SECTION_BEGIN

	/***************************************************/
	/*            BapSimGen FSG template               */
	/***************************************************/

	/************** Ausgabe Konsole (Traces) ***********/
	dword gBAP_Trace;
	dword gError_Trace;

	/************** Node Verwaltung ***************/
	//Power on/off
	byte gSG_PowerOnOff=0x01;     // wird mit Power_off/on gesetzt
	byte gBAP_Init=0;             // schon mal initialisiert?

	const Power_off = 0x00;	
	const Power_on	= 0x01;

	mstimer TaskTimer;				//real communication timer

	/************** Request **************/
	const Requestbuffer_lines = 100;
	const BAP_buffer_size = 4096;
	const Max_Array_Size = 1024;
	const TRUE = 1;
  const FALSE = 0;
  
  ///////////////////// Structs Telefon ///////////////////// ///-> only combined numbers for call info access
  
  _align(1)struct Telefon_CombinedNumbers_ArrayDataStruct
  {
    word  Param1;
	  char  Param2[100];
	  word  Param2_Length;
	  byte  Param3;
	  byte  Param4;    
	  char  Param5[41];
	  word  Param5_Length;
	  byte  Param6;
	  byte  Param7;
	  byte  Param8;
	  byte  Param9;
	  byte  Param10;
	  byte  Param11;
  };
  
  struct  Telefon_CombinedNumbers_ArrayDataStruct   Telefon_CombinedNumbers[Max_Array_Size];
  
  
   _align(1) struct A_FSG_40_0_0_49_ArrayDataStruct {
		 word Param1;
		 byte Param2[100];
		 word Param2_Length;
		 byte Param3;
		 byte Param4;
		 byte Param5[41];
		 word Param5_Length;
		 byte Param6;
		 byte Param7;
		 byte Param8;
		 byte Param9;
		 byte Param10;
		 byte Param11;
	 };
	 struct A_FSG_40_0_0_49_ArrayDataStruct A_FSG_40_0_0_49_ArrayDataList[180];
	 const A_FSG_40_0_0_49_ArrayDataList_Length = 180;
	 long A_FSG_40_0_0_49_Data_2_LenList[180];
	 byte A_FSG_40_0_0_49_Data_2_CntList[180];
	 long A_FSG_40_0_0_49_Data_2_SetGet_LenList[180];
	 byte A_FSG_40_0_0_49_Data_2_SetGet_CntList[180];
	 long A_FSG_40_0_0_49_Data_5_LenList[180];
	 byte A_FSG_40_0_0_49_Data_5_CntList[180];
	 long A_FSG_40_0_0_49_Data_5_SetGet_LenList[180];
	 byte A_FSG_40_0_0_49_Data_5_SetGet_CntList[180];
	 
	  ///////////////////// Listen Variablen ///////////////////// -> phone 1 combined numbers for call info access
  
  byte   Telefon_CombinedNumbers_TotalListNum             = 0;
  char  gTelefon_CombinedNumbers_Path[255]                = "";
  const  Telefon_CombinedNumbers_Length                   = 255;

	/************ Speichern von Requests im "Ringbuffer" ***********/
	int   gBAP_Requestbuffer_status	[Requestbuffer_lines];		             // 0: kein Eintrag, 1: pending
	dword gBAP_Request_header		[Requestbuffer_lines] [6];				 // beinhaltet auch skalare Daten
	dword gBAP_Request_data         [Requestbuffer_lines] [BAP_buffer_size]; // Ringbuffer fuer BAP-Request


	/************** Indication **************/
	// enthaelt die derzeitige Indication
	dword gBAP_Indication_header[6];	
	byte  gBAP_Indication_data[BAP_buffer_size];		

	/************** Konstanten ****************/

	//BAP Data Type 
	const Bap_void				=0;
	const Bap_uint8				=1;
	const Bap_uint16			=2;
	const Bap_uint32			=3;
	const Bap_byteSequence		=4;
    const Bap_fixedByteSequence =4;
    const Bap_error				=5;
    const Bap_acknowledge		=6;

	char Datatype_Text[7][20] =
	{
		"void", "uint8", "uint16", "uint32", "byteSequence", "error", "acknowledge"
	};
	
	//BAP request types
	const DataSetGet_REQ	= 0x00;
	const DataSet_REQ		= 0x01;
	const DataGet_REQ		= 0x02;
	const Data_REQ			= 0x03;
	const Changed_REQ		= 0x04;
	const Start_REQ			= 0x05;
	const StartResult_REQ	= 0x06;
	const AbortResult_REQ	= 0x07;
	const Processing_REQ	= 0x08;
	const Result_REQ		= 0x09;
	const DataAck_REQ       = 0x0A;
	const Ack_REQ           = 0x0B;
	const Invalid_REQ    	= 0x1F; // Kennzeichnung fuer einen ungueltigen Request
	const Error_REQ         = 0x20;

	char Requesttype_Text[33][30] =
	{
		"DataSetGet_REQ", "DataSet_REQ", "DataGet_REQ", "Data_REQ",			/* 00 .. 03 */
		"Changed_REQ", "Start_REQ", "StartResult_REQ", "AbortResult_REQ",   /* 04 .. 07 */
		"Processing_REQ", "Result_REQ", "DataAck_REQ", "Ack_REQ", 		/* 08 .. 0b */
		"Invalid_REQ", "Invalid_REQ", "Invalid_REQ", "Invalid_REQ",  		/* 0c .. 0f */
		"Invalid_REQ", "Invalid_REQ", "Invalid_REQ", "Invalid_REQ",  		/* 10 .. 13 */
		"Invalid_REQ", "Invalid_REQ", "Invalid_REQ", "Invalid_REQ",  		/* 14 .. 17 */
		"Invalid_REQ", "Invalid_REQ", "Invalid_REQ", "Invalid_REQ", 		/* 18 .. 1b */
		"Invalid_REQ", "Invalid_REQ", "Invalid_REQ", "Invalid_REQ",  		/* 1c .. 1f */
		"Error_REQ"	  														/* 20 */
	};
	
	//BAP indication types
	const Data_IND				= 0x00;
	const Reset_IND				= 0x01;
	const DataAck_IND			= 0x02;
	const Result_IND			= 0x03;
	const Processing_IND	    = 0x04;
	const Changed_IND			= 0x05;
	const DataSetGet_IND	    = 0x06;
	const DataSet_IND			= 0x07;
	const DataGet_IND			= 0x08;
	const Ack_IND				= 0x09;
	const Processing_CNF_IND	= 0x0A;
	const Start_IND				= 0x0B;
	const StartResult_IND		= 0x0C;
	const AbortResult_IND		= 0x0D;
	const Invalid_IND			= 0x1F; // Kennzeichnung fuer eine ungueltige Indication
	const Error_IND             = 0x20;

	char Indicationtype_Text[33][30] =
	{
		"Data_IND", "Reset_IND", "DataAck_IND", "Result_IND",				/* 00 .. 03 */
		"Processing_IND", "Changed_IND", "DataSetGet_IND", "DataSet_IND",	/* 04 .. 07 */
		"DataGet_IND", "Ack_IND", "Processing_CNF_IND", "Start_REQ",		/* 08 .. 0b */
		"StartResult_REQ", "AbortResult_REQ", "Invalid_REQ", "Invalid_REQ", /* 0c .. 0f */
		"Invalid_REQ", "Invalid_REQ", "Invalid_REQ", "Invalid_REQ",			/* 10 .. 13 */
		"Invalid_REQ", "Invalid_REQ", "Invalid_REQ", "Invalid_REQ",			/* 14 .. 17 */
		"Invalid_REQ", "Invalid_REQ", "Invalid_REQ", "Invalid_REQ",			/* 18 .. 1b */
		"Invalid_REQ", "Invalid_REQ", "Invalid_REQ", "Invalid_REQ",			/* 1c .. 1f */
		"Error_REQ"	  														/* 20 */
	};	
	
	char Acknowledgetype_Text[24][30] =
	{
		"Property_SetGet_ACK", "Array_SetGet_ACK", "Property_Set_ACK", "Array_Set_ACK",				/* 00 .. 03 */
		"Method_Start_ACK", "Method_StartResult_ACK", "Method_AbortResult_ACK", "Property_Get_ACK",	/* 04 .. 07 */
		"Array_Get_ACK", "Cache_GetAll_ACK", "Property_Ack_ACK", "Property_Status_ACK",	   			/* 08 .. 0b */
		"Property_StatusAck_ACK", "Property_Error_ACK", "Array_Status_ACK", "Array_Changed_ACK",	/* 0c .. 0f */
		"Array_Error_ACK", "Method_Processing_ACK", "Method_Result_ACK", "Method_Error_ACK",  		/* 10 .. 13 */
		"Unknown_ACK", "Unknown_ACK", "Unknown_ACK", "Unknown_ACK"									/* 14 .. 17 */
	};

	/**************************** Global Function-ID's ******************************/

	byte already_pressed = 0;

	const FctID_GetAll									= 0x01;
	const FctID_BAP_Config								= 0x02;
	const FctID_FunctionList							= 0x03;
	const FctID_HeartBeat								= 0x04;
    
    char SGtype[4]="FSG";


	//// Begin: konfigurationsabhýngige Variablen, die als BAPCONFIG_VARS in Template definiert sind
	
	char  dbcan_path[255]           = "BAP\\FSG41_Telefon2_47\\bapdb\\BAP_only_MQB_MLBevo_KMatrix__42_17_V1.00E_20171024.dbc";
	char  xml_path[255]             = "BAP\\FSG41_Telefon2_47\\bapxml\\BAP_SW16_Telefon2_P30DF47_V2.70_FSG.xml";
	dword NODE_INDEX                =  0;
	char  NODE_NAME[100]            = "TEL2";
	const LSGID                     = 41;
	char  panel_name[100]           = "FSG41_0";
	char  bapconfig_panel_name[100]    = "panel1";
	char  common_panel_name[100]    = "panel2";
	const TaskTime                  = 10;
	 const C_FSG_41_0_0_1_ID = 1;
	 char gCheckbox1[100] = "checkbox_C_FSG_41_0_0_1";
	 char gErrField1[100] = "errfield_C_FSG_41_0_0_1";
	 byte gC_FSG_41_0_0_1_ErrCode = 1;
	 const P_FSG_41_0_0_2_ID = 2;
	 byte P_FSG_41_0_0_2Reset_BTN_already_pressed = 0;
	 char gCheckbox2[100] = "checkbox_P_FSG_41_0_0_2";
	 char gErrField2[100] = "errfield_P_FSG_41_0_0_2";
	 byte gP_FSG_41_0_0_2_ErrCode = 1;
	 const P_FSG_41_0_0_3_ID = 3;
	 byte P_FSG_41_0_0_3Status_BTN_already_pressed = 0;
	 char gCheckbox3[100] = "checkbox_P_FSG_41_0_0_3";
	 char gErrField3[100] = "errfield_P_FSG_41_0_0_3";
	 byte gP_FSG_41_0_0_3_ErrCode = 1;
	 const P_FSG_41_0_0_4_ID = 4;
	 byte P_FSG_41_0_0_4Status_BTN_already_pressed = 0;
	 char gCheckbox4[100] = "checkbox_P_FSG_41_0_0_4";
	 char gErrField4[100] = "errfield_P_FSG_41_0_0_4";
	 byte gP_FSG_41_0_0_4_ErrCode = 1;
	 const P_FSG_41_0_0_14_ID = 14;
	 byte P_FSG_41_0_0_14Status_BTN_already_pressed = 0;
	 char gCheckbox14[100] = "checkbox_P_FSG_41_0_0_14";
	 char gErrField14[100] = "errfield_P_FSG_41_0_0_14";
	 byte gP_FSG_41_0_0_14_ErrCode = 1;
	 char gPanel14[100] = "panel_P_FSG_41_0_0_14";
	 const P_FSG_41_0_0_15_ID = 15;
	 byte P_FSG_41_0_0_15Status_BTN_already_pressed = 0;
	 char gCheckbox15[100] = "checkbox_P_FSG_41_0_0_15";
	 char gErrField15[100] = "errfield_P_FSG_41_0_0_15";
	 byte gP_FSG_41_0_0_15_ErrCode = 1;
	 char gPanel15[100] = "panel_P_FSG_41_0_0_15";
	 const P_FSG_41_0_0_16_ID = 16;
	 byte P_FSG_41_0_0_16Status_BTN_already_pressed = 0;
	 char gCheckbox16[100] = "checkbox_P_FSG_41_0_0_16";
	 char gErrField16[100] = "errfield_P_FSG_41_0_0_16";
	 byte gP_FSG_41_0_0_16_ErrCode = 1;
	 char gPanel16[100] = "panel_P_FSG_41_0_0_16";
	 const P_FSG_41_0_0_17_ID = 17;
	 byte P_FSG_41_0_0_17Status_BTN_already_pressed = 0;
	 char gCheckbox17[100] = "checkbox_P_FSG_41_0_0_17";
	 char gErrField17[100] = "errfield_P_FSG_41_0_0_17";
	 byte gP_FSG_41_0_0_17_ErrCode = 1;
	 char gPanel17[100] = "panel_P_FSG_41_0_0_17";
	 const P_FSG_41_0_0_18_ID = 18;
	 byte P_FSG_41_0_0_18Status_BTN_already_pressed = 0;
	 char gCheckbox18[100] = "checkbox_P_FSG_41_0_0_18";
	 char gErrField18[100] = "errfield_P_FSG_41_0_0_18";
	 byte gP_FSG_41_0_0_18_ErrCode = 1;
	 char gPanel18[100] = "panel_P_FSG_41_0_0_18";
	 const P_FSG_41_0_0_19_ID = 19;
	 byte P_FSG_41_0_0_19Status_BTN_already_pressed = 0;
	 char gCheckbox19[100] = "checkbox_P_FSG_41_0_0_19";
	 char gErrField19[100] = "errfield_P_FSG_41_0_0_19";
	 byte gP_FSG_41_0_0_19_ErrCode = 1;
	 char gPanel19[100] = "panel_P_FSG_41_0_0_19";
	 const P_FSG_41_0_0_20_ID = 20;
	 byte P_FSG_41_0_0_20Status_BTN_already_pressed = 0;
	 char gCheckbox20[100] = "checkbox_P_FSG_41_0_0_20";
	 char gErrField20[100] = "errfield_P_FSG_41_0_0_20";
	 byte gP_FSG_41_0_0_20_ErrCode = 1;
	 char gPanel20[100] = "panel_P_FSG_41_0_0_20";
	 const P_FSG_41_0_0_21_ID = 21;
	 byte P_FSG_41_0_0_21Status_BTN_already_pressed = 0;
	 char gCheckbox21[100] = "checkbox_P_FSG_41_0_0_21";
	 char gErrField21[100] = "errfield_P_FSG_41_0_0_21";
	 byte gP_FSG_41_0_0_21_ErrCode = 1;
	 char gPanel21[100] = "panel_P_FSG_41_0_0_21";
	 const P_FSG_41_0_0_22_ID = 22;
	 byte P_FSG_41_0_0_22Status_BTN_already_pressed = 0;
	 char gCheckbox22[100] = "checkbox_P_FSG_41_0_0_22";
	 char gErrField22[100] = "errfield_P_FSG_41_0_0_22";
	 byte gP_FSG_41_0_0_22_ErrCode = 1;
	 char gPanel22[100] = "panel_P_FSG_41_0_0_22";
	 const P_FSG_41_0_0_23_ID = 23;
	 byte P_FSG_41_0_0_23Status_BTN_already_pressed = 0;
	 char gCheckbox23[100] = "checkbox_P_FSG_41_0_0_23";
	 char gErrField23[100] = "errfield_P_FSG_41_0_0_23";
	 byte gP_FSG_41_0_0_23_ErrCode = 1;
	 char gPanel23[100] = "panel_P_FSG_41_0_0_23";
	 const P_FSG_41_0_0_24_ID = 24;
	 byte P_FSG_41_0_0_24Status_BTN_already_pressed = 0;
	 char gCheckbox24[100] = "checkbox_P_FSG_41_0_0_24";
	 char gErrField24[100] = "errfield_P_FSG_41_0_0_24";
	 byte gP_FSG_41_0_0_24_ErrCode = 1;
	 char gPanel24[100] = "panel_P_FSG_41_0_0_24";
	 const P_FSG_41_0_0_25_ID = 25;
	 byte P_FSG_41_0_0_25Status_BTN_already_pressed = 0;
	 char gCheckbox25[100] = "checkbox_P_FSG_41_0_0_25";
	 char gErrField25[100] = "errfield_P_FSG_41_0_0_25";
	 byte gP_FSG_41_0_0_25_ErrCode = 1;
	 char gPanel25[100] = "panel_P_FSG_41_0_0_25";
	 const P_FSG_41_0_0_26_ID = 26;
	 byte P_FSG_41_0_0_26Status_BTN_already_pressed = 0;
	 char gCheckbox26[100] = "checkbox_P_FSG_41_0_0_26";
	 char gErrField26[100] = "errfield_P_FSG_41_0_0_26";
	 byte gP_FSG_41_0_0_26_ErrCode = 1;
	 char gPanel26[100] = "panel_P_FSG_41_0_0_26";
	 const P_FSG_41_0_0_27_ID = 27;
	 byte P_FSG_41_0_0_27Status_BTN_already_pressed = 0;
	 char gCheckbox27[100] = "checkbox_P_FSG_41_0_0_27";
	 char gErrField27[100] = "errfield_P_FSG_41_0_0_27";
	 byte gP_FSG_41_0_0_27_ErrCode = 1;
	 char gPanel27[100] = "panel_P_FSG_41_0_0_27";
	 const P_FSG_41_0_0_28_ID = 28;
	 byte P_FSG_41_0_0_28Status_BTN_already_pressed = 0;
	 char gCheckbox28[100] = "checkbox_P_FSG_41_0_0_28";
	 char gErrField28[100] = "errfield_P_FSG_41_0_0_28";
	 byte gP_FSG_41_0_0_28_ErrCode = 1;
	 char gPanel28[100] = "panel_P_FSG_41_0_0_28";
	 const P_FSG_41_0_0_29_ID = 29;
	 byte P_FSG_41_0_0_29Status_BTN_already_pressed = 0;
	 char gCheckbox29[100] = "checkbox_P_FSG_41_0_0_29";
	 char gErrField29[100] = "errfield_P_FSG_41_0_0_29";
	 byte gP_FSG_41_0_0_29_ErrCode = 1;
	 char gPanel29[100] = "panel_P_FSG_41_0_0_29";
	 const P_FSG_41_0_0_30_ID = 30;
	 byte P_FSG_41_0_0_30Status_BTN_already_pressed = 0;
	 char gCheckbox30[100] = "checkbox_P_FSG_41_0_0_30";
	 char gErrField30[100] = "errfield_P_FSG_41_0_0_30";
	 byte gP_FSG_41_0_0_30_ErrCode = 1;
	 char gPanel30[100] = "panel_P_FSG_41_0_0_30";
	 const P_FSG_41_0_0_31_ID = 31;
	 byte P_FSG_41_0_0_31Status_BTN_already_pressed = 0;
	 char gCheckbox31[100] = "checkbox_P_FSG_41_0_0_31";
	 char gErrField31[100] = "errfield_P_FSG_41_0_0_31";
	 byte gP_FSG_41_0_0_31_ErrCode = 1;
	 char gPanel31[100] = "panel_P_FSG_41_0_0_31";
	 const P_FSG_41_0_0_32_ID = 32;
	 byte P_FSG_41_0_0_32Status_BTN_already_pressed = 0;
	 char gCheckbox32[100] = "checkbox_P_FSG_41_0_0_32";
	 char gErrField32[100] = "errfield_P_FSG_41_0_0_32";
	 byte gP_FSG_41_0_0_32_ErrCode = 1;
	 char gPanel32[100] = "panel_P_FSG_41_0_0_32";
	 const M_FSG_41_0_0_33_ID = 33;
	 byte M_FSG_41_0_0_33Result_BTN_already_pressed = 0;
	 char gCheckbox33[100] = "checkbox_M_FSG_41_0_0_33";
	 char gErrField33[100] = "errfield_M_FSG_41_0_0_33";
	 byte gM_FSG_41_0_0_33_ErrCode = 1;
	 char gPanel33[100] = "panel_M_FSG_41_0_0_33";
	 const P_FSG_41_0_0_34_ID = 34;
	 byte P_FSG_41_0_0_34Status_BTN_already_pressed = 0;
	 char gCheckbox34[100] = "checkbox_P_FSG_41_0_0_34";
	 char gErrField34[100] = "errfield_P_FSG_41_0_0_34";
	 byte gP_FSG_41_0_0_34_ErrCode = 1;
	 char gPanel34[100] = "panel_P_FSG_41_0_0_34";
	 const P_FSG_41_0_0_35_ID = 35;
	 byte P_FSG_41_0_0_35Status_BTN_already_pressed = 0;
	 char gCheckbox35[100] = "checkbox_P_FSG_41_0_0_35";
	 char gErrField35[100] = "errfield_P_FSG_41_0_0_35";
	 byte gP_FSG_41_0_0_35_ErrCode = 1;
	 char gPanel35[100] = "panel_P_FSG_41_0_0_35";
	 const P_FSG_41_0_0_36_ID = 36;
	 byte P_FSG_41_0_0_36Status_BTN_already_pressed = 0;
	 char gCheckbox36[100] = "checkbox_P_FSG_41_0_0_36";
	 char gErrField36[100] = "errfield_P_FSG_41_0_0_36";
	 byte gP_FSG_41_0_0_36_ErrCode = 1;
	 char gPanel36[100] = "panel_P_FSG_41_0_0_36";
	 const P_FSG_41_0_0_37_ID = 37;
	 byte P_FSG_41_0_0_37Status_BTN_already_pressed = 0;
	 char gCheckbox37[100] = "checkbox_P_FSG_41_0_0_37";
	 char gErrField37[100] = "errfield_P_FSG_41_0_0_37";
	 byte gP_FSG_41_0_0_37_ErrCode = 1;
	 char gPanel37[100] = "panel_P_FSG_41_0_0_37";
	 const P_FSG_41_0_0_38_ID = 38;
	 byte P_FSG_41_0_0_38Status_BTN_already_pressed = 0;
	 char gCheckbox38[100] = "checkbox_P_FSG_41_0_0_38";
	 char gErrField38[100] = "errfield_P_FSG_41_0_0_38";
	 byte gP_FSG_41_0_0_38_ErrCode = 1;
	 char gPanel38[100] = "panel_P_FSG_41_0_0_38";
	 const P_FSG_41_0_0_39_ID = 39;
	 byte P_FSG_41_0_0_39Status_BTN_already_pressed = 0;
	 char gCheckbox39[100] = "checkbox_P_FSG_41_0_0_39";
	 char gErrField39[100] = "errfield_P_FSG_41_0_0_39";
	 byte gP_FSG_41_0_0_39_ErrCode = 1;
	 char gPanel39[100] = "panel_P_FSG_41_0_0_39";
	 const P_FSG_41_0_0_40_ID = 40;
	 byte P_FSG_41_0_0_40Status_BTN_already_pressed = 0;
	 char gCheckbox40[100] = "checkbox_P_FSG_41_0_0_40";
	 char gErrField40[100] = "errfield_P_FSG_41_0_0_40";
	 byte gP_FSG_41_0_0_40_ErrCode = 1;
	 char gPanel40[100] = "panel_P_FSG_41_0_0_40";
	 const P_FSG_41_0_0_41_ID = 41;
	 byte P_FSG_41_0_0_41Status_BTN_already_pressed = 0;
	 char gCheckbox41[100] = "checkbox_P_FSG_41_0_0_41";
	 char gErrField41[100] = "errfield_P_FSG_41_0_0_41";
	 byte gP_FSG_41_0_0_41_ErrCode = 1;
	 char gPanel41[100] = "panel_P_FSG_41_0_0_41";
	 const P_FSG_41_0_0_42_ID = 42;
	 byte P_FSG_41_0_0_42Status_BTN_already_pressed = 0;
	 char gCheckbox42[100] = "checkbox_P_FSG_41_0_0_42";
	 char gErrField42[100] = "errfield_P_FSG_41_0_0_42";
	 byte gP_FSG_41_0_0_42_ErrCode = 1;
	 char gPanel42[100] = "panel_P_FSG_41_0_0_42";
	 const P_FSG_41_0_0_43_ID = 43;
	 byte P_FSG_41_0_0_43Status_BTN_already_pressed = 0;
	 char gCheckbox43[100] = "checkbox_P_FSG_41_0_0_43";
	 char gErrField43[100] = "errfield_P_FSG_41_0_0_43";
	 byte gP_FSG_41_0_0_43_ErrCode = 1;
	 char gPanel43[100] = "panel_P_FSG_41_0_0_43";
	 const P_FSG_41_0_0_44_ID = 44;
	 byte P_FSG_41_0_0_44Status_BTN_already_pressed = 0;
	 char gCheckbox44[100] = "checkbox_P_FSG_41_0_0_44";
	 char gErrField44[100] = "errfield_P_FSG_41_0_0_44";
	 byte gP_FSG_41_0_0_44_ErrCode = 1;
	 char gPanel44[100] = "panel_P_FSG_41_0_0_44";
	 const P_FSG_41_0_0_45_ID = 45;
	 byte P_FSG_41_0_0_45Status_BTN_already_pressed = 0;
	 char gCheckbox45[100] = "checkbox_P_FSG_41_0_0_45";
	 char gErrField45[100] = "errfield_P_FSG_41_0_0_45";
	 byte gP_FSG_41_0_0_45_ErrCode = 1;
	 char gPanel45[100] = "panel_P_FSG_41_0_0_45";
	 const M_FSG_41_0_0_46_ID = 46;
	 byte M_FSG_41_0_0_46Result_BTN_already_pressed = 0;
	 char gCheckbox46[100] = "checkbox_M_FSG_41_0_0_46";
	 char gErrField46[100] = "errfield_M_FSG_41_0_0_46";
	 byte gM_FSG_41_0_0_46_ErrCode = 1;
	 char gPanel46[100] = "panel_M_FSG_41_0_0_46";
	 const P_FSG_41_0_0_47_ID = 47;
	 byte P_FSG_41_0_0_47Status_BTN_already_pressed = 0;
	 char gCheckbox47[100] = "checkbox_P_FSG_41_0_0_47";
	 char gErrField47[100] = "errfield_P_FSG_41_0_0_47";
	 byte gP_FSG_41_0_0_47_ErrCode = 1;
	 char gPanel47[100] = "panel_P_FSG_41_0_0_47";
	 const M_FSG_41_0_0_48_ID = 48;
	 byte M_FSG_41_0_0_48Result_BTN_already_pressed = 0;
	 char gCheckbox48[100] = "checkbox_M_FSG_41_0_0_48";
	 char gErrField48[100] = "errfield_M_FSG_41_0_0_48";
	 byte gM_FSG_41_0_0_48_ErrCode = 1;
	 char gPanel48[100] = "panel_M_FSG_41_0_0_48";
	 const P_FSG_41_0_0_49_ID = 49;
	 byte P_FSG_41_0_0_49Status_BTN_already_pressed = 0;
	 char gCheckbox49[100] = "checkbox_P_FSG_41_0_0_49";
	 char gErrField49[100] = "errfield_P_FSG_41_0_0_49";
	 byte gP_FSG_41_0_0_49_ErrCode = 1;
	 char gPanel49[100] = "panel_P_FSG_41_0_0_49";
	 const P_FSG_41_0_0_50_ID = 50;
	 byte P_FSG_41_0_0_50Status_BTN_already_pressed = 0;
	 char gCheckbox50[100] = "checkbox_P_FSG_41_0_0_50";
	 char gErrField50[100] = "errfield_P_FSG_41_0_0_50";
	 byte gP_FSG_41_0_0_50_ErrCode = 1;
	 char gPanel50[100] = "panel_P_FSG_41_0_0_50";
	 const A_FSG_41_0_0_51_ID = 51;
	 byte A_FSG_41_0_0_51Changed_BTN_already_pressed = 0;
	 byte A_FSG_41_0_0_51Status_BTN_already_pressed = 0;
	 char gCheckbox51[100] = "checkbox_A_FSG_41_0_0_51";
	 char gErrField51[100] = "errfield_A_FSG_41_0_0_51";
	 byte gA_FSG_41_0_0_51_ErrCode = 1;
	 char gPanel51[100] = "panel_A_FSG_41_0_0_51";
	 byte A_FSG_41_0_0_51_DataIndex_Decr_already_pressed = 0;
	 byte A_FSG_41_0_0_51_DataIndex_Incr_already_pressed = 0;
	 byte A_FSG_41_0_0_51_DataIndex_SetGet_Decr_already_pressed = 0;
	 byte A_FSG_41_0_0_51_DataIndex_SetGet_Incr_already_pressed = 0;
	 byte A_FSG_41_0_0_51_generateData_Btn_already_pressed = 0;
	 byte A_FSG_41_0_0_51_loadArray_Btn_already_pressed = 0;
	 _align(1) struct A_FSG_41_0_0_51_ArrayDataStruct {
		 byte Param1;
		 byte Param2;
		 byte Param3;
		 byte Param4;
		 byte Param5[17];
		 word Param5_Length;
		 word Param6;
		 byte Param7[602];
		 word Param7_Length;
	 };
	 struct A_FSG_41_0_0_51_ArrayDataStruct A_FSG_41_0_0_51_ArrayDataList[254];
	 const A_FSG_41_0_0_51_ArrayDataList_Length = 254;
	 long A_FSG_41_0_0_51_Data_5_LenList[254];
	 byte A_FSG_41_0_0_51_Data_5_CntList[254];
	 long A_FSG_41_0_0_51_Data_5_SetGet_LenList[254];
	 byte A_FSG_41_0_0_51_Data_5_SetGet_CntList[254];
	 long A_FSG_41_0_0_51_Data_7_LenList[254];
	 byte A_FSG_41_0_0_51_Data_7_CntList[254];
	 long A_FSG_41_0_0_51_Data_7_SetGet_LenList[254];
	 byte A_FSG_41_0_0_51_Data_7_SetGet_CntList[254];


	//// End konfigurationsabhýngige Variablen 
	
	/// Begin: Definition der BUS-Schnittstellen
	
	// FLEXRAY NOT ENABLED!
	
	// ETHERNET NOT ENABLED!

// call functions --- Methods 
  
  msTimer disconnectingTimer2;
  msTimer disconnectingTimer_Methods2; 
  char gDialTelNumber_string2[40];  
  byte gDialTelNumber_data2[40];
  char gDialName_string2[100];
  byte gDialName_data2[100];
  msTimer setDIALcallState2;
  msTimer setcallInfo2;
  int gcallID2;
  int gCallState2[7];
  int gcallIDActive2;
  
  msTimer disconnectingTimer3;
  msTimer disconnectingTimer_Methods3; 
  char gDialTelNumber_string3[40];  
  byte gDialTelNumber_data3[40];
  char gDialName_string3[100];
  byte gDialName_data3[100];
  msTimer setDIALcallState3;
  msTimer setcallInfo3;
  int gcallID3;
  int gCallState3[7];
  int gcallIDActive3;
  
  
   //CallState
  const idle=0x00;
  const ringing_waiting=0x01;
  const active=0x02;
  const dialing=0x03;
  const disconnecting=0x04;
  const onhold=0x05;
  const connected_CIB=0x06;
  const REMOTE_SIDE_BUSY=0x07;
  //const AUTOMATIC_REDIAL_ACTIVE=0x08;
  //const INCOMING_ON_HOLD=0x09;
  const INCOMING_ON_HOLD=0x08;
  
  const CALL_INFO_NUMBER_LENGTH=40;
  const CALL_INFO_NAME_LENGTH=99;
  
  char gincomingcall_number [CALL_INFO_NUMBER_LENGTH];
  char gincomingcall_name [CALL_INFO_NAME_LENGTH];
  
  
  byte gHangupCall_CallID=0;
  const ALL_ACTIVE_CALLS	    	=0xFC;
  const ALL_HELD_CALLS			=0xFD;
  const ALL_ACTIVE_AND_HELD_CALLS	=0xFE;
  const ALL_CALLS			    	=0xFF;

  byte gHangupCall_Result=0;
  
  msTimer MPswapTimer2;
  msTimer MPswapTimer3;
  
  // CallType 
  
  const unknownCall=0x00;
  const singleVoiceCall=0x01;
  const dataCall=0x02;
  const faxCall=0x03;
  const emergencyCall=0x04;
  const conferenceVoiceCall=0x05;
  const infoCall=0x06;
  const serviceCall=0x07;
  const ACNCall=0x08;	
	
	//// End Bus Schnittstellen

}

on preStart
{
    char Version[200];
    
    /***** Erzeugen der Ausgabeconsolen *****/  
    gBAP_Trace=writecreate("BAP-Trace");        //write-window for BAP-cummunication
    writeclear(gBAP_Trace);                     //clear BAP-window in write-window
    
    gError_Trace=writecreate("Error");          //error-window for BAP-cummunication
    writeclear(gError_Trace);                   //clear error-window in write-window
    
    writeclear(1);                              //clear CAPL-window in write-window
    
    /**** Versionsstring von DLL holen und auf Bildschirm ausgeben ***/ 
    BAP150_GetVersions(Version, 200);
    writelineEx(gBAP_Trace, 0, "Versionx:%s", Version);
                                            
    NODE_INDEX = BAP150_CreateNode();
    writelineEx(gBAP_Trace, 0, "FSG %d Nodeindex:%d", LSGID, Version);
    
    // FLEXRAY NOT ENABLED!
}



DisableFctCtrl ()
{
  	EnableControl(panel_name, common_panel_name, 0);
	EnableControl(panel_name,gErrField1,0);
	EnableControl(panel_name,gErrField2,0);
	EnableControl(panel_name,gErrField3,0);
	EnableControl(panel_name,gErrField4,0);
	EnableControl(panel_name,gErrField14,0);
	EnableControl(panel_name,gPanel14,0);
	EnableControl(panel_name,"panel_P_FSG_41_0_0_14",0);
	EnableControl(panel_name,gErrField15,0);
	EnableControl(panel_name,gPanel15,0);
	EnableControl(panel_name,"panel_P_FSG_41_0_0_15",0);
	EnableControl(panel_name,gErrField16,0);
	EnableControl(panel_name,gPanel16,0);
	EnableControl(panel_name,"panel_P_FSG_41_0_0_16",0);
	EnableControl(panel_name,gErrField17,0);
	EnableControl(panel_name,gPanel17,0);
	EnableControl(panel_name,"panel_P_FSG_41_0_0_17",0);
	EnableControl(panel_name,gErrField18,0);
	EnableControl(panel_name,gPanel18,0);
	EnableControl(panel_name,"panel_P_FSG_41_0_0_18",0);
	EnableControl(panel_name,gErrField19,0);
	EnableControl(panel_name,gPanel19,0);
	EnableControl(panel_name,"panel_P_FSG_41_0_0_19",0);
	EnableControl(panel_name,gErrField20,0);
	EnableControl(panel_name,gPanel20,0);
	EnableControl(panel_name,"panel_P_FSG_41_0_0_20",0);
	EnableControl(panel_name,gErrField21,0);
	EnableControl(panel_name,gPanel21,0);
	EnableControl(panel_name,"panel_P_FSG_41_0_0_21",0);
	EnableControl(panel_name,gErrField22,0);
	EnableControl(panel_name,gPanel22,0);
	EnableControl(panel_name,"panel_P_FSG_41_0_0_22",0);
	EnableControl(panel_name,gErrField23,0);
	EnableControl(panel_name,gPanel23,0);
	EnableControl(panel_name,"panel_P_FSG_41_0_0_23",0);
	EnableControl(panel_name,gErrField24,0);
	EnableControl(panel_name,gPanel24,0);
	EnableControl(panel_name,"panel_P_FSG_41_0_0_24",0);
	EnableControl(panel_name,gErrField25,0);
	EnableControl(panel_name,gPanel25,0);
	EnableControl(panel_name,"panel_P_FSG_41_0_0_25",0);
	EnableControl(panel_name,gErrField26,0);
	EnableControl(panel_name,gPanel26,0);
	EnableControl(panel_name,"panel_P_FSG_41_0_0_26",0);
	EnableControl(panel_name,gErrField27,0);
	EnableControl(panel_name,gPanel27,0);
	EnableControl(panel_name,"panel_P_FSG_41_0_0_27",0);
	EnableControl(panel_name,gErrField28,0);
	EnableControl(panel_name,gPanel28,0);
	EnableControl(panel_name,"panel_P_FSG_41_0_0_28",0);
	EnableControl(panel_name,gErrField29,0);
	EnableControl(panel_name,gPanel29,0);
	EnableControl(panel_name,"panel_P_FSG_41_0_0_29",0);
	EnableControl(panel_name,gErrField30,0);
	EnableControl(panel_name,gPanel30,0);
	EnableControl(panel_name,"panel_P_FSG_41_0_0_30",0);
	EnableControl(panel_name,gErrField31,0);
	EnableControl(panel_name,gPanel31,0);
	EnableControl(panel_name,"panel_P_FSG_41_0_0_31",0);
	EnableControl(panel_name,gErrField32,0);
	EnableControl(panel_name,gPanel32,0);
	EnableControl(panel_name,"panel_P_FSG_41_0_0_32",0);
	EnableControl(panel_name,gErrField33,0);
	EnableControl(panel_name,gPanel33,0);
	EnableControl(panel_name,"panel_M_FSG_41_0_0_33_Result",0);
	EnableControl(panel_name,"panel_M_FSG_41_0_0_33_Processing",0);
	EnableControl(panel_name,"panel_M_FSG_41_0_0_33_Start",0);
	EnableControl(panel_name,gErrField34,0);
	EnableControl(panel_name,gPanel34,0);
	EnableControl(panel_name,"panel_P_FSG_41_0_0_34",0);
	EnableControl(panel_name,gErrField35,0);
	EnableControl(panel_name,gPanel35,0);
	EnableControl(panel_name,"panel_P_FSG_41_0_0_35",0);
	EnableControl(panel_name,gErrField36,0);
	EnableControl(panel_name,gPanel36,0);
	EnableControl(panel_name,"panel_P_FSG_41_0_0_36",0);
	EnableControl(panel_name,gErrField37,0);
	EnableControl(panel_name,gPanel37,0);
	EnableControl(panel_name,"panel_P_FSG_41_0_0_37",0);
	EnableControl(panel_name,gErrField38,0);
	EnableControl(panel_name,gPanel38,0);
	EnableControl(panel_name,"panel_P_FSG_41_0_0_38",0);
	EnableControl(panel_name,gErrField39,0);
	EnableControl(panel_name,gPanel39,0);
	EnableControl(panel_name,"panel_P_FSG_41_0_0_39",0);
	EnableControl(panel_name,gErrField40,0);
	EnableControl(panel_name,gPanel40,0);
	EnableControl(panel_name,"panel_P_FSG_41_0_0_40",0);
	EnableControl(panel_name,gErrField41,0);
	EnableControl(panel_name,gPanel41,0);
	EnableControl(panel_name,"panel_P_FSG_41_0_0_41",0);
	EnableControl(panel_name,gErrField42,0);
	EnableControl(panel_name,gPanel42,0);
	EnableControl(panel_name,"panel_P_FSG_41_0_0_42",0);
	EnableControl(panel_name,gErrField43,0);
	EnableControl(panel_name,gPanel43,0);
	EnableControl(panel_name,"panel_P_FSG_41_0_0_43",0);
	EnableControl(panel_name,gErrField44,0);
	EnableControl(panel_name,gPanel44,0);
	EnableControl(panel_name,"panel_P_FSG_41_0_0_44",0);
	EnableControl(panel_name,gErrField45,0);
	EnableControl(panel_name,gPanel45,0);
	EnableControl(panel_name,"panel_P_FSG_41_0_0_45",0);
	EnableControl(panel_name,gErrField46,0);
	EnableControl(panel_name,gPanel46,0);
	EnableControl(panel_name,"panel_M_FSG_41_0_0_46_Result",0);
	EnableControl(panel_name,"panel_M_FSG_41_0_0_46_Processing",0);
	EnableControl(panel_name,"panel_M_FSG_41_0_0_46_Start",0);
	EnableControl(panel_name,gErrField47,0);
	EnableControl(panel_name,gPanel47,0);
	EnableControl(panel_name,"panel_P_FSG_41_0_0_47",0);
	EnableControl(panel_name,gErrField48,0);
	EnableControl(panel_name,gPanel48,0);
	EnableControl(panel_name,"panel_M_FSG_41_0_0_48_Result",0);
	EnableControl(panel_name,"panel_M_FSG_41_0_0_48_Processing",0);
	EnableControl(panel_name,"panel_M_FSG_41_0_0_48_Start",0);
	EnableControl(panel_name,gErrField49,0);
	EnableControl(panel_name,gPanel49,0);
	EnableControl(panel_name,"panel_P_FSG_41_0_0_49",0);
	EnableControl(panel_name,gErrField50,0);
	EnableControl(panel_name,gPanel50,0);
	EnableControl(panel_name,"panel_P_FSG_41_0_0_50",0);
	EnableControl(panel_name,gErrField51,0);
	EnableControl(panel_name,gPanel51,0);
	EnableControl(panel_name,"panel_A_FSG_41_0_0_51",0);
	EnableControl(panel_name,"panel_A_FSG_41_0_0_51_Status",0);
	EnableControl(panel_name,"panel_A_FSG_41_0_0_51_Changed",0);
	EnableControl(panel_name,"panel_A_FSG_41_0_0_51_SetGet",0);

}

EnableFctCtrl ()
{
  	EnableControl(panel_name, common_panel_name, 1);
	if(getValue(P_FSG_41_0_0_14_FctLstItemEn)){
		 EnableControl(panel_name,gPanel14,1);
		 EnableControl(panel_name,gErrField14,1);
	}
	if(getValue(P_FSG_41_0_0_15_FctLstItemEn)){
		 EnableControl(panel_name,gPanel15,1);
		 EnableControl(panel_name,gErrField15,1);
	}
	if(getValue(P_FSG_41_0_0_16_FctLstItemEn)){
		 EnableControl(panel_name,gPanel16,1);
		 EnableControl(panel_name,gErrField16,1);
	}
	if(getValue(P_FSG_41_0_0_17_FctLstItemEn)){
		 EnableControl(panel_name,gPanel17,1);
		 EnableControl(panel_name,gErrField17,1);
	}
	if(getValue(P_FSG_41_0_0_18_FctLstItemEn)){
		 EnableControl(panel_name,gPanel18,1);
		 EnableControl(panel_name,gErrField18,1);
	}
	if(getValue(P_FSG_41_0_0_19_FctLstItemEn)){
		 EnableControl(panel_name,gPanel19,1);
		 EnableControl(panel_name,gErrField19,1);
	}
	if(getValue(P_FSG_41_0_0_20_FctLstItemEn)){
		 EnableControl(panel_name,gPanel20,1);
		 EnableControl(panel_name,gErrField20,1);
	}
	if(getValue(P_FSG_41_0_0_21_FctLstItemEn)){
		 EnableControl(panel_name,gPanel21,1);
		 EnableControl(panel_name,gErrField21,1);
	}
	if(getValue(P_FSG_41_0_0_22_FctLstItemEn)){
		 EnableControl(panel_name,gPanel22,1);
		 EnableControl(panel_name,gErrField22,1);
	}
	if(getValue(P_FSG_41_0_0_23_FctLstItemEn)){
		 EnableControl(panel_name,gPanel23,1);
		 EnableControl(panel_name,gErrField23,1);
	}
	if(getValue(P_FSG_41_0_0_24_FctLstItemEn)){
		 EnableControl(panel_name,gPanel24,1);
		 EnableControl(panel_name,gErrField24,1);
	}
	if(getValue(P_FSG_41_0_0_25_FctLstItemEn)){
		 EnableControl(panel_name,gPanel25,1);
		 EnableControl(panel_name,gErrField25,1);
	}
	if(getValue(P_FSG_41_0_0_26_FctLstItemEn)){
		 EnableControl(panel_name,gPanel26,1);
		 EnableControl(panel_name,gErrField26,1);
	}
	if(getValue(P_FSG_41_0_0_27_FctLstItemEn)){
		 EnableControl(panel_name,gPanel27,1);
		 EnableControl(panel_name,gErrField27,1);
	}
	if(getValue(P_FSG_41_0_0_28_FctLstItemEn)){
		 EnableControl(panel_name,gPanel28,1);
		 EnableControl(panel_name,gErrField28,1);
	}
	if(getValue(P_FSG_41_0_0_29_FctLstItemEn)){
		 EnableControl(panel_name,gPanel29,1);
		 EnableControl(panel_name,gErrField29,1);
	}
	if(getValue(P_FSG_41_0_0_30_FctLstItemEn)){
		 EnableControl(panel_name,gPanel30,1);
		 EnableControl(panel_name,gErrField30,1);
	}
	if(getValue(P_FSG_41_0_0_31_FctLstItemEn)){
		 EnableControl(panel_name,gPanel31,1);
		 EnableControl(panel_name,gErrField31,1);
	}
	if(getValue(P_FSG_41_0_0_32_FctLstItemEn)){
		 EnableControl(panel_name,gPanel32,1);
		 EnableControl(panel_name,gErrField32,1);
	}
	if(getValue(M_FSG_41_0_0_33_FctLstItemEn)){
		 EnableControl(panel_name,gPanel33,1);
		 EnableControl(panel_name,gErrField33,1);
	}
	if(getValue(P_FSG_41_0_0_34_FctLstItemEn)){
		 EnableControl(panel_name,gPanel34,1);
		 EnableControl(panel_name,gErrField34,1);
	}
	if(getValue(P_FSG_41_0_0_35_FctLstItemEn)){
		 EnableControl(panel_name,gPanel35,1);
		 EnableControl(panel_name,gErrField35,1);
	}
	if(getValue(P_FSG_41_0_0_36_FctLstItemEn)){
		 EnableControl(panel_name,gPanel36,1);
		 EnableControl(panel_name,gErrField36,1);
	}
	if(getValue(P_FSG_41_0_0_37_FctLstItemEn)){
		 EnableControl(panel_name,gPanel37,1);
		 EnableControl(panel_name,gErrField37,1);
	}
	if(getValue(P_FSG_41_0_0_38_FctLstItemEn)){
		 EnableControl(panel_name,gPanel38,1);
		 EnableControl(panel_name,gErrField38,1);
	}
	if(getValue(P_FSG_41_0_0_39_FctLstItemEn)){
		 EnableControl(panel_name,gPanel39,1);
		 EnableControl(panel_name,gErrField39,1);
	}
	if(getValue(P_FSG_41_0_0_40_FctLstItemEn)){
		 EnableControl(panel_name,gPanel40,1);
		 EnableControl(panel_name,gErrField40,1);
	}
	if(getValue(P_FSG_41_0_0_41_FctLstItemEn)){
		 EnableControl(panel_name,gPanel41,1);
		 EnableControl(panel_name,gErrField41,1);
	}
	if(getValue(P_FSG_41_0_0_42_FctLstItemEn)){
		 EnableControl(panel_name,gPanel42,1);
		 EnableControl(panel_name,gErrField42,1);
	}
	if(getValue(P_FSG_41_0_0_43_FctLstItemEn)){
		 EnableControl(panel_name,gPanel43,1);
		 EnableControl(panel_name,gErrField43,1);
	}
	if(getValue(P_FSG_41_0_0_44_FctLstItemEn)){
		 EnableControl(panel_name,gPanel44,1);
		 EnableControl(panel_name,gErrField44,1);
	}
	if(getValue(P_FSG_41_0_0_45_FctLstItemEn)){
		 EnableControl(panel_name,gPanel45,1);
		 EnableControl(panel_name,gErrField45,1);
	}
	if(getValue(M_FSG_41_0_0_46_FctLstItemEn)){
		 EnableControl(panel_name,gPanel46,1);
		 EnableControl(panel_name,gErrField46,1);
	}
	if(getValue(P_FSG_41_0_0_47_FctLstItemEn)){
		 EnableControl(panel_name,gPanel47,1);
		 EnableControl(panel_name,gErrField47,1);
	}
	if(getValue(M_FSG_41_0_0_48_FctLstItemEn)){
		 EnableControl(panel_name,gPanel48,1);
		 EnableControl(panel_name,gErrField48,1);
	}
	if(getValue(P_FSG_41_0_0_49_FctLstItemEn)){
		 EnableControl(panel_name,gPanel49,1);
		 EnableControl(panel_name,gErrField49,1);
	}
	if(getValue(P_FSG_41_0_0_50_FctLstItemEn)){
		 EnableControl(panel_name,gPanel50,1);
		 EnableControl(panel_name,gErrField50,1);
	}
	if(getValue(A_FSG_41_0_0_51_FctLstItemEn)){
		 EnableControl(panel_name,gPanel51,1);
	EnableControl(panel_name,"panel_A_FSG_41_0_0_51_Status",1);
		 EnableControl(panel_name,gErrField51,1);
	}

}

DisableConfigCtrl ()
{
  	EnableControl(panel_name, bapconfig_panel_name, 0);
	EnableControl(panel_name, bapconfig_panel_name, 0);
	EnableControl(panel_name, "panel1_edit", 0);
//	EnableControl(panel_name,gCheckbox1,0);
//	if(!getValue(C_FSG_41_0_0_1_FctLstItemEn)){
//		 SetControlBackColor(panel_name,gCheckbox1,MakeRGB(200,200,200));
//	}
//	EnableControl(panel_name,gCheckbox2,0);
//	if(!getValue(P_FSG_41_0_0_2_FctLstItemEn)){
//		 SetControlBackColor(panel_name,gCheckbox2,MakeRGB(200,200,200));
//	}
//	EnableControl(panel_name,gCheckbox3,0);
//	if(!getValue(P_FSG_41_0_0_3_FctLstItemEn)){
//		 SetControlBackColor(panel_name,gCheckbox3,MakeRGB(200,200,200));
//	}
	EnableControl(panel_name, "panel_P_FSG_41_0_0_4", 0);
//	EnableControl(panel_name,gCheckbox4,0);
//	if(!getValue(P_FSG_41_0_0_4_FctLstItemEn)){
//		 SetControlBackColor(panel_name,gCheckbox4,MakeRGB(200,200,200));
//	}
//	EnableControl(panel_name,gCheckbox14,0);
//	if(!getValue(P_FSG_41_0_0_14_FctLstItemEn)){
//		 SetControlBackColor(panel_name,gCheckbox14,MakeRGB(200,200,200));
//	}
//	EnableControl(panel_name,gCheckbox15,0);
//	if(!getValue(P_FSG_41_0_0_15_FctLstItemEn)){
//		 SetControlBackColor(panel_name,gCheckbox15,MakeRGB(200,200,200));
//	}
//	EnableControl(panel_name,gCheckbox16,0);
//	if(!getValue(P_FSG_41_0_0_16_FctLstItemEn)){
//		 SetControlBackColor(panel_name,gCheckbox16,MakeRGB(200,200,200));
//	}
//	EnableControl(panel_name,gCheckbox17,0);
//	if(!getValue(P_FSG_41_0_0_17_FctLstItemEn)){
//		 SetControlBackColor(panel_name,gCheckbox17,MakeRGB(200,200,200));
//	}
//	EnableControl(panel_name,gCheckbox18,0);
//	if(!getValue(P_FSG_41_0_0_18_FctLstItemEn)){
//		 SetControlBackColor(panel_name,gCheckbox18,MakeRGB(200,200,200));
//	}
//	EnableControl(panel_name,gCheckbox19,0);
//	if(!getValue(P_FSG_41_0_0_19_FctLstItemEn)){
//		 SetControlBackColor(panel_name,gCheckbox19,MakeRGB(200,200,200));
//	}
//	EnableControl(panel_name,gCheckbox20,0);
//	if(!getValue(P_FSG_41_0_0_20_FctLstItemEn)){
//		 SetControlBackColor(panel_name,gCheckbox20,MakeRGB(200,200,200));
//	}
//	EnableControl(panel_name,gCheckbox21,0);
//	if(!getValue(P_FSG_41_0_0_21_FctLstItemEn)){
//		 SetControlBackColor(panel_name,gCheckbox21,MakeRGB(200,200,200));
//	}
//	EnableControl(panel_name,gCheckbox22,0);
//	if(!getValue(P_FSG_41_0_0_22_FctLstItemEn)){
//		 SetControlBackColor(panel_name,gCheckbox22,MakeRGB(200,200,200));
//	}
//	EnableControl(panel_name,gCheckbox23,0);
//	if(!getValue(P_FSG_41_0_0_23_FctLstItemEn)){
//		 SetControlBackColor(panel_name,gCheckbox23,MakeRGB(200,200,200));
//	}
//	EnableControl(panel_name,gCheckbox24,0);
//	if(!getValue(P_FSG_41_0_0_24_FctLstItemEn)){
//		 SetControlBackColor(panel_name,gCheckbox24,MakeRGB(200,200,200));
//	}
//	EnableControl(panel_name,gCheckbox25,0);
//	if(!getValue(P_FSG_41_0_0_25_FctLstItemEn)){
//		 SetControlBackColor(panel_name,gCheckbox25,MakeRGB(200,200,200));
//	}
//	EnableControl(panel_name,gCheckbox26,0);
//	if(!getValue(P_FSG_41_0_0_26_FctLstItemEn)){
//		 SetControlBackColor(panel_name,gCheckbox26,MakeRGB(200,200,200));
//	}
//	EnableControl(panel_name,gCheckbox27,0);
//	if(!getValue(P_FSG_41_0_0_27_FctLstItemEn)){
//		 SetControlBackColor(panel_name,gCheckbox27,MakeRGB(200,200,200));
//	}
//	EnableControl(panel_name,gCheckbox28,0);
//	if(!getValue(P_FSG_41_0_0_28_FctLstItemEn)){
//		 SetControlBackColor(panel_name,gCheckbox28,MakeRGB(200,200,200));
//	}
//	EnableControl(panel_name,gCheckbox29,0);
//	if(!getValue(P_FSG_41_0_0_29_FctLstItemEn)){
//		 SetControlBackColor(panel_name,gCheckbox29,MakeRGB(200,200,200));
//	}
//	EnableControl(panel_name,gCheckbox30,0);
//	if(!getValue(P_FSG_41_0_0_30_FctLstItemEn)){
//		 SetControlBackColor(panel_name,gCheckbox30,MakeRGB(200,200,200));
//	}
//	EnableControl(panel_name,gCheckbox31,0);
//	if(!getValue(P_FSG_41_0_0_31_FctLstItemEn)){
//		 SetControlBackColor(panel_name,gCheckbox31,MakeRGB(200,200,200));
//	}
//	EnableControl(panel_name,gCheckbox32,0);
//	if(!getValue(P_FSG_41_0_0_32_FctLstItemEn)){
//		 SetControlBackColor(panel_name,gCheckbox32,MakeRGB(200,200,200));
//	}
//	EnableControl(panel_name,gCheckbox33,0);
//	if(!getValue(M_FSG_41_0_0_33_FctLstItemEn)){
//		 SetControlBackColor(panel_name,gCheckbox33,MakeRGB(200,200,200));
//	}
//	EnableControl(panel_name,gCheckbox34,0);
//	if(!getValue(P_FSG_41_0_0_34_FctLstItemEn)){
//		 SetControlBackColor(panel_name,gCheckbox34,MakeRGB(200,200,200));
//	}
//	EnableControl(panel_name,gCheckbox35,0);
//	if(!getValue(P_FSG_41_0_0_35_FctLstItemEn)){
//		 SetControlBackColor(panel_name,gCheckbox35,MakeRGB(200,200,200));
//	}
//	EnableControl(panel_name,gCheckbox36,0);
//	if(!getValue(P_FSG_41_0_0_36_FctLstItemEn)){
//		 SetControlBackColor(panel_name,gCheckbox36,MakeRGB(200,200,200));
//	}
//	EnableControl(panel_name,gCheckbox37,0);
//	if(!getValue(P_FSG_41_0_0_37_FctLstItemEn)){
//		 SetControlBackColor(panel_name,gCheckbox37,MakeRGB(200,200,200));
//	}
//	EnableControl(panel_name,gCheckbox38,0);
//	if(!getValue(P_FSG_41_0_0_38_FctLstItemEn)){
//		 SetControlBackColor(panel_name,gCheckbox38,MakeRGB(200,200,200));
//	}
//	EnableControl(panel_name,gCheckbox39,0);
//	if(!getValue(P_FSG_41_0_0_39_FctLstItemEn)){
//		 SetControlBackColor(panel_name,gCheckbox39,MakeRGB(200,200,200));
//	}
//	EnableControl(panel_name,gCheckbox40,0);
//	if(!getValue(P_FSG_41_0_0_40_FctLstItemEn)){
//		 SetControlBackColor(panel_name,gCheckbox40,MakeRGB(200,200,200));
//	}
//	EnableControl(panel_name,gCheckbox41,0);
//	if(!getValue(P_FSG_41_0_0_41_FctLstItemEn)){
//		 SetControlBackColor(panel_name,gCheckbox41,MakeRGB(200,200,200));
//	}
//	EnableControl(panel_name,gCheckbox42,0);
//	if(!getValue(P_FSG_41_0_0_42_FctLstItemEn)){
//		 SetControlBackColor(panel_name,gCheckbox42,MakeRGB(200,200,200));
//	}
//	EnableControl(panel_name,gCheckbox43,0);
//	if(!getValue(P_FSG_41_0_0_43_FctLstItemEn)){
//		 SetControlBackColor(panel_name,gCheckbox43,MakeRGB(200,200,200));
//	}
//	EnableControl(panel_name,gCheckbox44,0);
//	if(!getValue(P_FSG_41_0_0_44_FctLstItemEn)){
//		 SetControlBackColor(panel_name,gCheckbox44,MakeRGB(200,200,200));
//	}
//	EnableControl(panel_name,gCheckbox45,0);
//	if(!getValue(P_FSG_41_0_0_45_FctLstItemEn)){
//		 SetControlBackColor(panel_name,gCheckbox45,MakeRGB(200,200,200));
//	}
//	EnableControl(panel_name,gCheckbox46,0);
//	if(!getValue(M_FSG_41_0_0_46_FctLstItemEn)){
//		 SetControlBackColor(panel_name,gCheckbox46,MakeRGB(200,200,200));
//	}
//	EnableControl(panel_name,gCheckbox47,0);
//	if(!getValue(P_FSG_41_0_0_47_FctLstItemEn)){
//		 SetControlBackColor(panel_name,gCheckbox47,MakeRGB(200,200,200));
//	}
//	EnableControl(panel_name,gCheckbox48,0);
//	if(!getValue(M_FSG_41_0_0_48_FctLstItemEn)){
//		 SetControlBackColor(panel_name,gCheckbox48,MakeRGB(200,200,200));
//	}
//	EnableControl(panel_name,gCheckbox49,0);
//	if(!getValue(P_FSG_41_0_0_49_FctLstItemEn)){
//		 SetControlBackColor(panel_name,gCheckbox49,MakeRGB(200,200,200));
//	}
//	EnableControl(panel_name,gCheckbox50,0);
//	if(!getValue(P_FSG_41_0_0_50_FctLstItemEn)){
//		 SetControlBackColor(panel_name,gCheckbox50,MakeRGB(200,200,200));
//	}
//	EnableControl(panel_name,gCheckbox51,0);
//	if(!getValue(A_FSG_41_0_0_51_FctLstItemEn)){
//		 SetControlBackColor(panel_name,gCheckbox51,MakeRGB(200,200,200));
//	}

}

EnableConfigCtrl ()
{
  	EnableControl(panel_name, bapconfig_panel_name, 1);
	EnableControl(panel_name, "panel1_edit", 1);
	if(getValue(C_FSG_41_0_0_1_FctLstItemEn))
	{
		setControlForeColor(panel_name, gCheckbox1, MakeRGB(0,240,0));
	}
	else
	{
		setControlForeColor(panel_name, gCheckbox1, MakeRGB(250,0,0));
	}
	if(getValue(P_FSG_41_0_0_2_FctLstItemEn))
	{
		setControlForeColor(panel_name, gCheckbox2, MakeRGB(0,240,0));
	}
	else
	{
		setControlForeColor(panel_name, gCheckbox2, MakeRGB(250,0,0));
	}
	if(getValue(P_FSG_41_0_0_3_FctLstItemEn))
	{
		setControlForeColor(panel_name, gCheckbox3, MakeRGB(0,240,0));
	}
	else
	{
		setControlForeColor(panel_name, gCheckbox3, MakeRGB(250,0,0));
	}
	EnableControl(panel_name, "panel_P_FSG_41_0_0_4", 1);
	if(getValue(P_FSG_41_0_0_4_FctLstItemEn))
	{
		setControlForeColor(panel_name, gCheckbox4, MakeRGB(0,240,0));
	}
	else
	{
		setControlForeColor(panel_name, gCheckbox4, MakeRGB(250,0,0));
	}
	if(getValue(P_FSG_41_0_0_14_FctLstItemEn))
	{
		EnableControl(panel_name, "panel_P_FSG_41_0_0_14",1);
		EnableControl(panel_name,"errfield_P_FSG_41_0_0_14",1);
		setControlForeColor(panel_name, gCheckbox14, MakeRGB(0,240,0));
	}
	else
	{
		EnableControl(panel_name, "panel_P_FSG_41_0_0_14",0);
		EnableControl(panel_name,"errfield_P_FSG_41_0_0_14",0);
		setControlForeColor(panel_name, gCheckbox14, MakeRGB(250,0,0));
	}
	if(getValue(P_FSG_41_0_0_15_FctLstItemEn))
	{
		EnableControl(panel_name, "panel_P_FSG_41_0_0_15",1);
		EnableControl(panel_name,"errfield_P_FSG_41_0_0_15",1);
		setControlForeColor(panel_name, gCheckbox15, MakeRGB(0,240,0));
	}
	else
	{
		EnableControl(panel_name, "panel_P_FSG_41_0_0_15",0);
		EnableControl(panel_name,"errfield_P_FSG_41_0_0_15",0);
		setControlForeColor(panel_name, gCheckbox15, MakeRGB(250,0,0));
	}
	if(getValue(P_FSG_41_0_0_16_FctLstItemEn))
	{
		EnableControl(panel_name, "panel_P_FSG_41_0_0_16",1);
		EnableControl(panel_name,"errfield_P_FSG_41_0_0_16",1);
		setControlForeColor(panel_name, gCheckbox16, MakeRGB(0,240,0));
	}
	else
	{
		EnableControl(panel_name, "panel_P_FSG_41_0_0_16",0);
		EnableControl(panel_name,"errfield_P_FSG_41_0_0_16",0);
		setControlForeColor(panel_name, gCheckbox16, MakeRGB(250,0,0));
	}
	if(getValue(P_FSG_41_0_0_17_FctLstItemEn))
	{
		EnableControl(panel_name, "panel_P_FSG_41_0_0_17",1);
		EnableControl(panel_name,"errfield_P_FSG_41_0_0_17",1);
		setControlForeColor(panel_name, gCheckbox17, MakeRGB(0,240,0));
	}
	else
	{
		EnableControl(panel_name, "panel_P_FSG_41_0_0_17",0);
		EnableControl(panel_name,"errfield_P_FSG_41_0_0_17",0);
		setControlForeColor(panel_name, gCheckbox17, MakeRGB(250,0,0));
	}
	if(getValue(P_FSG_41_0_0_18_FctLstItemEn))
	{
		EnableControl(panel_name, "panel_P_FSG_41_0_0_18",1);
		EnableControl(panel_name,"errfield_P_FSG_41_0_0_18",1);
		setControlForeColor(panel_name, gCheckbox18, MakeRGB(0,240,0));
	}
	else
	{
		EnableControl(panel_name, "panel_P_FSG_41_0_0_18",0);
		EnableControl(panel_name,"errfield_P_FSG_41_0_0_18",0);
		setControlForeColor(panel_name, gCheckbox18, MakeRGB(250,0,0));
	}
	if(getValue(P_FSG_41_0_0_19_FctLstItemEn))
	{
		EnableControl(panel_name, "panel_P_FSG_41_0_0_19",1);
		EnableControl(panel_name,"errfield_P_FSG_41_0_0_19",1);
		setControlForeColor(panel_name, gCheckbox19, MakeRGB(0,240,0));
	}
	else
	{
		EnableControl(panel_name, "panel_P_FSG_41_0_0_19",0);
		EnableControl(panel_name,"errfield_P_FSG_41_0_0_19",0);
		setControlForeColor(panel_name, gCheckbox19, MakeRGB(250,0,0));
	}
	if(getValue(P_FSG_41_0_0_20_FctLstItemEn))
	{
		EnableControl(panel_name, "panel_P_FSG_41_0_0_20",1);
		EnableControl(panel_name,"errfield_P_FSG_41_0_0_20",1);
		setControlForeColor(panel_name, gCheckbox20, MakeRGB(0,240,0));
	}
	else
	{
		EnableControl(panel_name, "panel_P_FSG_41_0_0_20",0);
		EnableControl(panel_name,"errfield_P_FSG_41_0_0_20",0);
		setControlForeColor(panel_name, gCheckbox20, MakeRGB(250,0,0));
	}
	if(getValue(P_FSG_41_0_0_21_FctLstItemEn))
	{
		EnableControl(panel_name, "panel_P_FSG_41_0_0_21",1);
		EnableControl(panel_name,"errfield_P_FSG_41_0_0_21",1);
		setControlForeColor(panel_name, gCheckbox21, MakeRGB(0,240,0));
	}
	else
	{
		EnableControl(panel_name, "panel_P_FSG_41_0_0_21",0);
		EnableControl(panel_name,"errfield_P_FSG_41_0_0_21",0);
		setControlForeColor(panel_name, gCheckbox21, MakeRGB(250,0,0));
	}
	if(getValue(P_FSG_41_0_0_22_FctLstItemEn))
	{
		EnableControl(panel_name, "panel_P_FSG_41_0_0_22",1);
		EnableControl(panel_name,"errfield_P_FSG_41_0_0_22",1);
		setControlForeColor(panel_name, gCheckbox22, MakeRGB(0,240,0));
	}
	else
	{
		EnableControl(panel_name, "panel_P_FSG_41_0_0_22",0);
		EnableControl(panel_name,"errfield_P_FSG_41_0_0_22",0);
		setControlForeColor(panel_name, gCheckbox22, MakeRGB(250,0,0));
	}
	if(getValue(P_FSG_41_0_0_23_FctLstItemEn))
	{
		EnableControl(panel_name, "panel_P_FSG_41_0_0_23",1);
		EnableControl(panel_name,"errfield_P_FSG_41_0_0_23",1);
		setControlForeColor(panel_name, gCheckbox23, MakeRGB(0,240,0));
	}
	else
	{
		EnableControl(panel_name, "panel_P_FSG_41_0_0_23",0);
		EnableControl(panel_name,"errfield_P_FSG_41_0_0_23",0);
		setControlForeColor(panel_name, gCheckbox23, MakeRGB(250,0,0));
	}
	if(getValue(P_FSG_41_0_0_24_FctLstItemEn))
	{
		EnableControl(panel_name, "panel_P_FSG_41_0_0_24",1);
		EnableControl(panel_name,"errfield_P_FSG_41_0_0_24",1);
		setControlForeColor(panel_name, gCheckbox24, MakeRGB(0,240,0));
	}
	else
	{
		EnableControl(panel_name, "panel_P_FSG_41_0_0_24",0);
		EnableControl(panel_name,"errfield_P_FSG_41_0_0_24",0);
		setControlForeColor(panel_name, gCheckbox24, MakeRGB(250,0,0));
	}
	if(getValue(P_FSG_41_0_0_25_FctLstItemEn))
	{
		EnableControl(panel_name, "panel_P_FSG_41_0_0_25",1);
		EnableControl(panel_name,"errfield_P_FSG_41_0_0_25",1);
		setControlForeColor(panel_name, gCheckbox25, MakeRGB(0,240,0));
	}
	else
	{
		EnableControl(panel_name, "panel_P_FSG_41_0_0_25",0);
		EnableControl(panel_name,"errfield_P_FSG_41_0_0_25",0);
		setControlForeColor(panel_name, gCheckbox25, MakeRGB(250,0,0));
	}
	if(getValue(P_FSG_41_0_0_26_FctLstItemEn))
	{
		EnableControl(panel_name, "panel_P_FSG_41_0_0_26",1);
		EnableControl(panel_name,"errfield_P_FSG_41_0_0_26",1);
		setControlForeColor(panel_name, gCheckbox26, MakeRGB(0,240,0));
	}
	else
	{
		EnableControl(panel_name, "panel_P_FSG_41_0_0_26",0);
		EnableControl(panel_name,"errfield_P_FSG_41_0_0_26",0);
		setControlForeColor(panel_name, gCheckbox26, MakeRGB(250,0,0));
	}
	if(getValue(P_FSG_41_0_0_27_FctLstItemEn))
	{
		EnableControl(panel_name, "panel_P_FSG_41_0_0_27",1);
		EnableControl(panel_name,"errfield_P_FSG_41_0_0_27",1);
		setControlForeColor(panel_name, gCheckbox27, MakeRGB(0,240,0));
	}
	else
	{
		EnableControl(panel_name, "panel_P_FSG_41_0_0_27",0);
		EnableControl(panel_name,"errfield_P_FSG_41_0_0_27",0);
		setControlForeColor(panel_name, gCheckbox27, MakeRGB(250,0,0));
	}
	if(getValue(P_FSG_41_0_0_28_FctLstItemEn))
	{
		EnableControl(panel_name, "panel_P_FSG_41_0_0_28",1);
		EnableControl(panel_name,"errfield_P_FSG_41_0_0_28",1);
		setControlForeColor(panel_name, gCheckbox28, MakeRGB(0,240,0));
	}
	else
	{
		EnableControl(panel_name, "panel_P_FSG_41_0_0_28",0);
		EnableControl(panel_name,"errfield_P_FSG_41_0_0_28",0);
		setControlForeColor(panel_name, gCheckbox28, MakeRGB(250,0,0));
	}
	if(getValue(P_FSG_41_0_0_29_FctLstItemEn))
	{
		EnableControl(panel_name, "panel_P_FSG_41_0_0_29",1);
		EnableControl(panel_name,"errfield_P_FSG_41_0_0_29",1);
		setControlForeColor(panel_name, gCheckbox29, MakeRGB(0,240,0));
	}
	else
	{
		EnableControl(panel_name, "panel_P_FSG_41_0_0_29",0);
		EnableControl(panel_name,"errfield_P_FSG_41_0_0_29",0);
		setControlForeColor(panel_name, gCheckbox29, MakeRGB(250,0,0));
	}
	if(getValue(P_FSG_41_0_0_30_FctLstItemEn))
	{
		EnableControl(panel_name, "panel_P_FSG_41_0_0_30",1);
		EnableControl(panel_name,"errfield_P_FSG_41_0_0_30",1);
		setControlForeColor(panel_name, gCheckbox30, MakeRGB(0,240,0));
	}
	else
	{
		EnableControl(panel_name, "panel_P_FSG_41_0_0_30",0);
		EnableControl(panel_name,"errfield_P_FSG_41_0_0_30",0);
		setControlForeColor(panel_name, gCheckbox30, MakeRGB(250,0,0));
	}
	if(getValue(P_FSG_41_0_0_31_FctLstItemEn))
	{
		EnableControl(panel_name, "panel_P_FSG_41_0_0_31",1);
		EnableControl(panel_name,"errfield_P_FSG_41_0_0_31",1);
		setControlForeColor(panel_name, gCheckbox31, MakeRGB(0,240,0));
	}
	else
	{
		EnableControl(panel_name, "panel_P_FSG_41_0_0_31",0);
		EnableControl(panel_name,"errfield_P_FSG_41_0_0_31",0);
		setControlForeColor(panel_name, gCheckbox31, MakeRGB(250,0,0));
	}
	if(getValue(P_FSG_41_0_0_32_FctLstItemEn))
	{
		EnableControl(panel_name, "panel_P_FSG_41_0_0_32",1);
		EnableControl(panel_name,"errfield_P_FSG_41_0_0_32",1);
		setControlForeColor(panel_name, gCheckbox32, MakeRGB(0,240,0));
	}
	else
	{
		EnableControl(panel_name, "panel_P_FSG_41_0_0_32",0);
		EnableControl(panel_name,"errfield_P_FSG_41_0_0_32",0);
		setControlForeColor(panel_name, gCheckbox32, MakeRGB(250,0,0));
	}
	if(getValue(M_FSG_41_0_0_33_FctLstItemEn))
	{
		EnableControl(panel_name, "panel_M_FSG_41_0_0_33",1);
		EnableControl(panel_name,"errfield_M_FSG_41_0_0_33",1);
		EnableControl(panel_name,"panel_M_FSG_41_0_0_33_Processing",1);
		EnableControl(panel_name,"panel_M_FSG_41_0_0_33_Start",1);
		setControlForeColor(panel_name, gCheckbox33, MakeRGB(0,240,0));
	}
	else
	{
		EnableControl(panel_name, "panel_M_FSG_41_0_0_33",0);
		EnableControl(panel_name,"errfield_M_FSG_41_0_0_33",0);
		EnableControl(panel_name,"panel_M_FSG_41_0_0_33_Processing",0);
		EnableControl(panel_name,"panel_M_FSG_41_0_0_33_Start",0);
		setControlForeColor(panel_name, gCheckbox33, MakeRGB(250,0,0));
	}
	if(getValue(P_FSG_41_0_0_34_FctLstItemEn))
	{
		EnableControl(panel_name, "panel_P_FSG_41_0_0_34",1);
		EnableControl(panel_name,"errfield_P_FSG_41_0_0_34",1);
		setControlForeColor(panel_name, gCheckbox34, MakeRGB(0,240,0));
	}
	else
	{
		EnableControl(panel_name, "panel_P_FSG_41_0_0_34",0);
		EnableControl(panel_name,"errfield_P_FSG_41_0_0_34",0);
		setControlForeColor(panel_name, gCheckbox34, MakeRGB(250,0,0));
	}
	if(getValue(P_FSG_41_0_0_35_FctLstItemEn))
	{
		EnableControl(panel_name, "panel_P_FSG_41_0_0_35",1);
		EnableControl(panel_name,"errfield_P_FSG_41_0_0_35",1);
		setControlForeColor(panel_name, gCheckbox35, MakeRGB(0,240,0));
	}
	else
	{
		EnableControl(panel_name, "panel_P_FSG_41_0_0_35",0);
		EnableControl(panel_name,"errfield_P_FSG_41_0_0_35",0);
		setControlForeColor(panel_name, gCheckbox35, MakeRGB(250,0,0));
	}
	if(getValue(P_FSG_41_0_0_36_FctLstItemEn))
	{
		EnableControl(panel_name, "panel_P_FSG_41_0_0_36",1);
		EnableControl(panel_name,"errfield_P_FSG_41_0_0_36",1);
		setControlForeColor(panel_name, gCheckbox36, MakeRGB(0,240,0));
	}
	else
	{
		EnableControl(panel_name, "panel_P_FSG_41_0_0_36",0);
		EnableControl(panel_name,"errfield_P_FSG_41_0_0_36",0);
		setControlForeColor(panel_name, gCheckbox36, MakeRGB(250,0,0));
	}
	if(getValue(P_FSG_41_0_0_37_FctLstItemEn))
	{
		EnableControl(panel_name, "panel_P_FSG_41_0_0_37",1);
		EnableControl(panel_name,"errfield_P_FSG_41_0_0_37",1);
		setControlForeColor(panel_name, gCheckbox37, MakeRGB(0,240,0));
	}
	else
	{
		EnableControl(panel_name, "panel_P_FSG_41_0_0_37",0);
		EnableControl(panel_name,"errfield_P_FSG_41_0_0_37",0);
		setControlForeColor(panel_name, gCheckbox37, MakeRGB(250,0,0));
	}
	if(getValue(P_FSG_41_0_0_38_FctLstItemEn))
	{
		EnableControl(panel_name, "panel_P_FSG_41_0_0_38",1);
		EnableControl(panel_name,"errfield_P_FSG_41_0_0_38",1);
		setControlForeColor(panel_name, gCheckbox38, MakeRGB(0,240,0));
	}
	else
	{
		EnableControl(panel_name, "panel_P_FSG_41_0_0_38",0);
		EnableControl(panel_name,"errfield_P_FSG_41_0_0_38",0);
		setControlForeColor(panel_name, gCheckbox38, MakeRGB(250,0,0));
	}
	if(getValue(P_FSG_41_0_0_39_FctLstItemEn))
	{
		EnableControl(panel_name, "panel_P_FSG_41_0_0_39",1);
		EnableControl(panel_name,"errfield_P_FSG_41_0_0_39",1);
		setControlForeColor(panel_name, gCheckbox39, MakeRGB(0,240,0));
	}
	else
	{
		EnableControl(panel_name, "panel_P_FSG_41_0_0_39",0);
		EnableControl(panel_name,"errfield_P_FSG_41_0_0_39",0);
		setControlForeColor(panel_name, gCheckbox39, MakeRGB(250,0,0));
	}
	if(getValue(P_FSG_41_0_0_40_FctLstItemEn))
	{
		EnableControl(panel_name, "panel_P_FSG_41_0_0_40",1);
		EnableControl(panel_name,"errfield_P_FSG_41_0_0_40",1);
		setControlForeColor(panel_name, gCheckbox40, MakeRGB(0,240,0));
	}
	else
	{
		EnableControl(panel_name, "panel_P_FSG_41_0_0_40",0);
		EnableControl(panel_name,"errfield_P_FSG_41_0_0_40",0);
		setControlForeColor(panel_name, gCheckbox40, MakeRGB(250,0,0));
	}
	if(getValue(P_FSG_41_0_0_41_FctLstItemEn))
	{
		EnableControl(panel_name, "panel_P_FSG_41_0_0_41",1);
		EnableControl(panel_name,"errfield_P_FSG_41_0_0_41",1);
		setControlForeColor(panel_name, gCheckbox41, MakeRGB(0,240,0));
	}
	else
	{
		EnableControl(panel_name, "panel_P_FSG_41_0_0_41",0);
		EnableControl(panel_name,"errfield_P_FSG_41_0_0_41",0);
		setControlForeColor(panel_name, gCheckbox41, MakeRGB(250,0,0));
	}
	if(getValue(P_FSG_41_0_0_42_FctLstItemEn))
	{
		EnableControl(panel_name, "panel_P_FSG_41_0_0_42",1);
		EnableControl(panel_name,"errfield_P_FSG_41_0_0_42",1);
		setControlForeColor(panel_name, gCheckbox42, MakeRGB(0,240,0));
	}
	else
	{
		EnableControl(panel_name, "panel_P_FSG_41_0_0_42",0);
		EnableControl(panel_name,"errfield_P_FSG_41_0_0_42",0);
		setControlForeColor(panel_name, gCheckbox42, MakeRGB(250,0,0));
	}
	if(getValue(P_FSG_41_0_0_43_FctLstItemEn))
	{
		EnableControl(panel_name, "panel_P_FSG_41_0_0_43",1);
		EnableControl(panel_name,"errfield_P_FSG_41_0_0_43",1);
		setControlForeColor(panel_name, gCheckbox43, MakeRGB(0,240,0));
	}
	else
	{
		EnableControl(panel_name, "panel_P_FSG_41_0_0_43",0);
		EnableControl(panel_name,"errfield_P_FSG_41_0_0_43",0);
		setControlForeColor(panel_name, gCheckbox43, MakeRGB(250,0,0));
	}
	if(getValue(P_FSG_41_0_0_44_FctLstItemEn))
	{
		EnableControl(panel_name, "panel_P_FSG_41_0_0_44",1);
		EnableControl(panel_name,"errfield_P_FSG_41_0_0_44",1);
		setControlForeColor(panel_name, gCheckbox44, MakeRGB(0,240,0));
	}
	else
	{
		EnableControl(panel_name, "panel_P_FSG_41_0_0_44",0);
		EnableControl(panel_name,"errfield_P_FSG_41_0_0_44",0);
		setControlForeColor(panel_name, gCheckbox44, MakeRGB(250,0,0));
	}
	if(getValue(P_FSG_41_0_0_45_FctLstItemEn))
	{
		EnableControl(panel_name, "panel_P_FSG_41_0_0_45",1);
		EnableControl(panel_name,"errfield_P_FSG_41_0_0_45",1);
		setControlForeColor(panel_name, gCheckbox45, MakeRGB(0,240,0));
	}
	else
	{
		EnableControl(panel_name, "panel_P_FSG_41_0_0_45",0);
		EnableControl(panel_name,"errfield_P_FSG_41_0_0_45",0);
		setControlForeColor(panel_name, gCheckbox45, MakeRGB(250,0,0));
	}
	if(getValue(M_FSG_41_0_0_46_FctLstItemEn))
	{
		EnableControl(panel_name, "panel_M_FSG_41_0_0_46",1);
		EnableControl(panel_name,"errfield_M_FSG_41_0_0_46",1);
		EnableControl(panel_name,"panel_M_FSG_41_0_0_46_Processing",1);
		EnableControl(panel_name,"panel_M_FSG_41_0_0_46_Start",1);
		setControlForeColor(panel_name, gCheckbox46, MakeRGB(0,240,0));
	}
	else
	{
		EnableControl(panel_name, "panel_M_FSG_41_0_0_46",0);
		EnableControl(panel_name,"errfield_M_FSG_41_0_0_46",0);
		EnableControl(panel_name,"panel_M_FSG_41_0_0_46_Processing",0);
		EnableControl(panel_name,"panel_M_FSG_41_0_0_46_Start",0);
		setControlForeColor(panel_name, gCheckbox46, MakeRGB(250,0,0));
	}
	if(getValue(P_FSG_41_0_0_47_FctLstItemEn))
	{
		EnableControl(panel_name, "panel_P_FSG_41_0_0_47",1);
		EnableControl(panel_name,"errfield_P_FSG_41_0_0_47",1);
		setControlForeColor(panel_name, gCheckbox47, MakeRGB(0,240,0));
	}
	else
	{
		EnableControl(panel_name, "panel_P_FSG_41_0_0_47",0);
		EnableControl(panel_name,"errfield_P_FSG_41_0_0_47",0);
		setControlForeColor(panel_name, gCheckbox47, MakeRGB(250,0,0));
	}
	if(getValue(M_FSG_41_0_0_48_FctLstItemEn))
	{
		EnableControl(panel_name, "panel_M_FSG_41_0_0_48",1);
		EnableControl(panel_name,"errfield_M_FSG_41_0_0_48",1);
		EnableControl(panel_name,"panel_M_FSG_41_0_0_48_Processing",1);
		EnableControl(panel_name,"panel_M_FSG_41_0_0_48_Start",1);
		setControlForeColor(panel_name, gCheckbox48, MakeRGB(0,240,0));
	}
	else
	{
		EnableControl(panel_name, "panel_M_FSG_41_0_0_48",0);
		EnableControl(panel_name,"errfield_M_FSG_41_0_0_48",0);
		EnableControl(panel_name,"panel_M_FSG_41_0_0_48_Processing",0);
		EnableControl(panel_name,"panel_M_FSG_41_0_0_48_Start",0);
		setControlForeColor(panel_name, gCheckbox48, MakeRGB(250,0,0));
	}
	if(getValue(P_FSG_41_0_0_49_FctLstItemEn))
	{
		EnableControl(panel_name, "panel_P_FSG_41_0_0_49",1);
		EnableControl(panel_name,"errfield_P_FSG_41_0_0_49",1);
		setControlForeColor(panel_name, gCheckbox49, MakeRGB(0,240,0));
	}
	else
	{
		EnableControl(panel_name, "panel_P_FSG_41_0_0_49",0);
		EnableControl(panel_name,"errfield_P_FSG_41_0_0_49",0);
		setControlForeColor(panel_name, gCheckbox49, MakeRGB(250,0,0));
	}
	if(getValue(P_FSG_41_0_0_50_FctLstItemEn))
	{
		EnableControl(panel_name, "panel_P_FSG_41_0_0_50",1);
		EnableControl(panel_name,"errfield_P_FSG_41_0_0_50",1);
		setControlForeColor(panel_name, gCheckbox50, MakeRGB(0,240,0));
	}
	else
	{
		EnableControl(panel_name, "panel_P_FSG_41_0_0_50",0);
		EnableControl(panel_name,"errfield_P_FSG_41_0_0_50",0);
		setControlForeColor(panel_name, gCheckbox50, MakeRGB(250,0,0));
	}
	if(getValue(A_FSG_41_0_0_51_FctLstItemEn))
	{
		EnableControl(panel_name, "panel_A_FSG_41_0_0_51",1);
		EnableControl(panel_name,"panel_A_FSG_41_0_0_51_Status",1);
		EnableControl(panel_name,"errfield_A_FSG_41_0_0_51",1);
		EnableControl(panel_name,"panel_A_FSG_41_0_0_51_Changed",1);
		EnableControl(panel_name,"panel_A_FSG_41_0_0_51_SetGet",1);
		setControlForeColor(panel_name, gCheckbox51, MakeRGB(0,240,0));
	}
	else
	{
		EnableControl(panel_name, "panel_A_FSG_41_0_0_51",0);
		EnableControl(panel_name,"panel_A_FSG_41_0_0_51_Status",0);
		EnableControl(panel_name,"errfield_A_FSG_41_0_0_51",0);
		EnableControl(panel_name,"panel_A_FSG_41_0_0_51_Changed",0);
		EnableControl(panel_name,"panel_A_FSG_41_0_0_51_SetGet",0);
		setControlForeColor(panel_name, gCheckbox51, MakeRGB(250,0,0));
	}

}

resetErrfieldColor()
{
  	setControlBackColor(panel_name, "errfield_C_FSG_41_0_0_1", MakeRGB(255,255,255));
	setControlBackColor(panel_name, "errfield_P_FSG_41_0_0_2", MakeRGB(255,255,255));
	setControlBackColor(panel_name, "errfield_P_FSG_41_0_0_3", MakeRGB(255,255,255));
	setControlBackColor(panel_name, "errfield_P_FSG_41_0_0_4", MakeRGB(255,255,255));
	setControlBackColor(panel_name, "errfield_P_FSG_41_0_0_14", MakeRGB(255,255,255));
	setControlBackColor(panel_name, "errfield_P_FSG_41_0_0_15", MakeRGB(255,255,255));
	setControlBackColor(panel_name, "errfield_P_FSG_41_0_0_16", MakeRGB(255,255,255));
	setControlBackColor(panel_name, "errfield_P_FSG_41_0_0_17", MakeRGB(255,255,255));
	setControlBackColor(panel_name, "errfield_P_FSG_41_0_0_18", MakeRGB(255,255,255));
	setControlBackColor(panel_name, "errfield_P_FSG_41_0_0_19", MakeRGB(255,255,255));
	setControlBackColor(panel_name, "errfield_P_FSG_41_0_0_20", MakeRGB(255,255,255));
	setControlBackColor(panel_name, "errfield_P_FSG_41_0_0_21", MakeRGB(255,255,255));
	setControlBackColor(panel_name, "errfield_P_FSG_41_0_0_22", MakeRGB(255,255,255));
	setControlBackColor(panel_name, "errfield_P_FSG_41_0_0_23", MakeRGB(255,255,255));
	setControlBackColor(panel_name, "errfield_P_FSG_41_0_0_24", MakeRGB(255,255,255));
	setControlBackColor(panel_name, "errfield_P_FSG_41_0_0_25", MakeRGB(255,255,255));
	setControlBackColor(panel_name, "errfield_P_FSG_41_0_0_26", MakeRGB(255,255,255));
	setControlBackColor(panel_name, "errfield_P_FSG_41_0_0_27", MakeRGB(255,255,255));
	setControlBackColor(panel_name, "errfield_P_FSG_41_0_0_28", MakeRGB(255,255,255));
	setControlBackColor(panel_name, "errfield_P_FSG_41_0_0_29", MakeRGB(255,255,255));
	setControlBackColor(panel_name, "errfield_P_FSG_41_0_0_30", MakeRGB(255,255,255));
	setControlBackColor(panel_name, "errfield_P_FSG_41_0_0_31", MakeRGB(255,255,255));
	setControlBackColor(panel_name, "errfield_P_FSG_41_0_0_32", MakeRGB(255,255,255));
	setControlBackColor(panel_name, "errfield_M_FSG_41_0_0_33", MakeRGB(255,255,255));
	setControlBackColor(panel_name, "errfield_P_FSG_41_0_0_34", MakeRGB(255,255,255));
	setControlBackColor(panel_name, "errfield_P_FSG_41_0_0_35", MakeRGB(255,255,255));
	setControlBackColor(panel_name, "errfield_P_FSG_41_0_0_36", MakeRGB(255,255,255));
	setControlBackColor(panel_name, "errfield_P_FSG_41_0_0_37", MakeRGB(255,255,255));
	setControlBackColor(panel_name, "errfield_P_FSG_41_0_0_38", MakeRGB(255,255,255));
	setControlBackColor(panel_name, "errfield_P_FSG_41_0_0_39", MakeRGB(255,255,255));
	setControlBackColor(panel_name, "errfield_P_FSG_41_0_0_40", MakeRGB(255,255,255));
	setControlBackColor(panel_name, "errfield_P_FSG_41_0_0_41", MakeRGB(255,255,255));
	setControlBackColor(panel_name, "errfield_P_FSG_41_0_0_42", MakeRGB(255,255,255));
	setControlBackColor(panel_name, "errfield_P_FSG_41_0_0_43", MakeRGB(255,255,255));
	setControlBackColor(panel_name, "errfield_P_FSG_41_0_0_44", MakeRGB(255,255,255));
	setControlBackColor(panel_name, "errfield_P_FSG_41_0_0_45", MakeRGB(255,255,255));
	setControlBackColor(panel_name, "errfield_M_FSG_41_0_0_46", MakeRGB(255,255,255));
	setControlBackColor(panel_name, "errfield_P_FSG_41_0_0_47", MakeRGB(255,255,255));
	setControlBackColor(panel_name, "errfield_M_FSG_41_0_0_48", MakeRGB(255,255,255));
	setControlBackColor(panel_name, "errfield_P_FSG_41_0_0_49", MakeRGB(255,255,255));
	setControlBackColor(panel_name, "errfield_P_FSG_41_0_0_50", MakeRGB(255,255,255));
	setControlBackColor(panel_name, "errfield_A_FSG_41_0_0_51", MakeRGB(255,255,255));

}

CANoe_Shutdown ()
{
	// Timer: cancel real CAN-communication timer
	canceltimer(TaskTimer);
	// Ruecksetzen der Hintergrundfarbe der Error-Felder
	resetErrfieldColor();
	// Deaktivierung aller Panel Elemente 
	EnableConfigCtrl();
}

on timer TaskTimer
{
	/*** Aufruf des BAP Task in DLL fuer NODE_INDEX ***/
	BAP150_Task(NODE_INDEX);	

	/*** Pollen ueber die anstehenden Indications (Lesen aus DLL, Auslesen eines Puffers der DLL) ***/
	BAP_DLL_Indication();	
	
	/*** Pollen ueber die anstehenden Requests (Schreiben in DLL, dort werden evt. Sendeauftraege gesetzt) ***/
	BAP_DLL_Request();
	
	/*** Abarbeiten der ausstehenden Sendeauftraege innerhalb der BAP DLL und Versenden ueber CANoe ***/
	if (getValue(KCAN__NMH_ICAS1_Gateway_CommActive))
	{
		BAP_CAN_TX_Request();
	}

	BAP_DLL_SetRxData();

	/*** Retriggern des Timers mit 10 ms ***/
	setTimer(TaskTimer, TaskTime); // @TODO bei anderer Taskzeit muss hier modifiziert werden
}


BAP_DLL_SetRxData()
{
}


BAP_DLL_Indication()	//function to get received BAP-data from DLL (at BAL-interface)
{
	int i, length, datalength, temp;
	byte Indication_data[BAP_buffer_size];		// indication data from DLL
	dword Indication_header[6];					// indication header from DLL
	byte BAP_data_type;

	// init local variables
	length=0;
	datalength=0;
	temp=0;
	BAP_data_type=0;

	for(i = 0; i < 6; i++)
		Indication_header[i]=0;

	for(i = 0; i < BAP_buffer_size; i++)
		Indication_data[i]=0;

	// BAP-Stack needs this information for successful BAP150_GetIndication 
	Indication_header[4]=BAP_buffer_size;

	while (BAP150_GetInd(NODE_INDEX, Indication_header, Indication_data) == 0)
	{		
		//read header and write in global variable
		for (i = 0; i < 6; i++) {
			gBAP_Indication_header[i]=Indication_header[i];	
		}

		// nur Bytesequneces haben Datenanteil
		if (gBAP_Indication_header[3] == Bap_byteSequence)
		{
			for (i = 0; i < BAP_buffer_size; i++) {
				gBAP_Indication_data[i]=Indication_data[i];	
			}
		}	
		// Verarbeiten der Indication
		Process_Current_Indication();

		// Vorbereiten fuer naechsten Durchlauf 
		Indication_header[4]=BAP_buffer_size;
	} 
}

setBitInFctList(word fctid, byte fctList[])
{
    byte byteNo ;
    byte bitno ;
    byte fctValue ;

    byteNo = fctid / 8;
    bitno = fctid % 8;
    fctValue = 0x80 >> bitno;
    fctList[byteNo] |= fctValue;
}

float round (float value, float step)
{
	return _floor(value / step + 0.5) * step;
}

ChangeConfig(long paramIndex,long config[])
{

        byte temp ;
        temp = BAP150_ChangeConfig(NODE_INDEX, paramIndex, config);
        if(temp == 0)
            writelineEx(gBAP_Trace, 0, "BAP150_ChangeConfig for %s succesful (LSG %d, NODE_INDEX %d)", NODE_NAME, LSGID, NODE_INDEX);
        else
            writelineEx(gError_Trace, 0, "BAP150_ChangeConfig error 0x%X for %s (LSG %d, NODE_INDEX %d)", temp, NODE_NAME, LSGID, NODE_INDEX);        
}

PrintIndicationError(char reason[])
{
	writelineEx(gError_Trace, 0, "%s - %s lsgId:%d fctid:%d indType:%d dataType:%s",
		reason, SGtype, gBAP_Indication_header[0], gBAP_Indication_header[1], Indicationtype_Text[gBAP_Indication_header[2]], Datatype_Text[gBAP_Indication_header[3]]);
}

initBapConfig()
{
        long config[3];
    config[0] = LSGID;
    config[1] = 0;
    config[2] = getValue(BAPCFG_FSG_41_0_0_ProtocolMajor);
    ChangeConfig(0x0012,config);
    config[2] = getValue(BAPCFG_FSG_41_0_0_ProtocolMinor);
    ChangeConfig(0x0013,config);
    config[2] = getValue(BAPCFG_FSG_41_0_0_LsgClassMajor);
    ChangeConfig(0x0010,config);
    config[2] = getValue(BAPCFG_FSG_41_0_0_LsgClassMinor);
    ChangeConfig(0x0011,config);
    config[2] = getValue(BAPCFG_FSG_41_0_0_DFMajor);
    ChangeConfig(0x0014,config);
    config[2] = getValue(BAPCFG_FSG_41_0_0_DFMinor);
    ChangeConfig(0x0015,config);
    
}

initFctList()
{
    byte fctList[8]={0,0,0,0,0,0,0,0};
    int i;
    dword request[6];
    byte errorCode;

    fctList[0]=0;
    fctList[1]=0;
    fctList[2]=0;
    fctList[3]=0;
    fctList[4]=0;
    fctList[5]=0;
    fctList[6]=0;
    fctList[7]=0;

    /*if(getValue(P_FSG_44_0_13_FunctionListId))
    {
        setBitInFctList(P_FSG_44_0_13_ID, fctList);
    }*/
           if(getValue(P_FSG_41_0_0_29_FctLstItemEn))
       {
           setBitInFctList(P_FSG_41_0_0_29_ID, fctList);
       }
       if(getValue(P_FSG_41_0_0_28_FctLstItemEn))
       {
           setBitInFctList(P_FSG_41_0_0_28_ID, fctList);
       }
       if(getValue(P_FSG_41_0_0_27_FctLstItemEn))
       {
           setBitInFctList(P_FSG_41_0_0_27_ID, fctList);
       }
       if(getValue(P_FSG_41_0_0_26_FctLstItemEn))
       {
           setBitInFctList(P_FSG_41_0_0_26_ID, fctList);
       }
       if(getValue(P_FSG_41_0_0_25_FctLstItemEn))
       {
           setBitInFctList(P_FSG_41_0_0_25_ID, fctList);
       }
       if(getValue(P_FSG_41_0_0_24_FctLstItemEn))
       {
           setBitInFctList(P_FSG_41_0_0_24_ID, fctList);
       }
       if(getValue(P_FSG_41_0_0_23_FctLstItemEn))
       {
           setBitInFctList(P_FSG_41_0_0_23_ID, fctList);
       }
       if(getValue(P_FSG_41_0_0_22_FctLstItemEn))
       {
           setBitInFctList(P_FSG_41_0_0_22_ID, fctList);
       }
       if(getValue(P_FSG_41_0_0_21_FctLstItemEn))
       {
           setBitInFctList(P_FSG_41_0_0_21_ID, fctList);
       }
       if(getValue(P_FSG_41_0_0_20_FctLstItemEn))
       {
           setBitInFctList(P_FSG_41_0_0_20_ID, fctList);
       }
       if(getValue(A_FSG_41_0_0_51_FctLstItemEn))
       {
           setBitInFctList(A_FSG_41_0_0_51_ID, fctList);
       }
       if(getValue(P_FSG_41_0_0_50_FctLstItemEn))
       {
           setBitInFctList(P_FSG_41_0_0_50_ID, fctList);
       }
       if(getValue(P_FSG_41_0_0_19_FctLstItemEn))
       {
           setBitInFctList(P_FSG_41_0_0_19_ID, fctList);
       }
       if(getValue(P_FSG_41_0_0_18_FctLstItemEn))
       {
           setBitInFctList(P_FSG_41_0_0_18_ID, fctList);
       }
       if(getValue(P_FSG_41_0_0_49_FctLstItemEn))
       {
           setBitInFctList(P_FSG_41_0_0_49_ID, fctList);
       }
       if(getValue(P_FSG_41_0_0_17_FctLstItemEn))
       {
           setBitInFctList(P_FSG_41_0_0_17_ID, fctList);
       }
       if(getValue(M_FSG_41_0_0_48_FctLstItemEn))
       {
           setBitInFctList(M_FSG_41_0_0_48_ID, fctList);
       }
       if(getValue(P_FSG_41_0_0_16_FctLstItemEn))
       {
           setBitInFctList(P_FSG_41_0_0_16_ID, fctList);
       }
       if(getValue(P_FSG_41_0_0_47_FctLstItemEn))
       {
           setBitInFctList(P_FSG_41_0_0_47_ID, fctList);
       }
       if(getValue(P_FSG_41_0_0_4_FctLstItemEn))
       {
           setBitInFctList(P_FSG_41_0_0_4_ID, fctList);
       }
       if(getValue(P_FSG_41_0_0_15_FctLstItemEn))
       {
           setBitInFctList(P_FSG_41_0_0_15_ID, fctList);
       }
       if(getValue(M_FSG_41_0_0_46_FctLstItemEn))
       {
           setBitInFctList(M_FSG_41_0_0_46_ID, fctList);
       }
       if(getValue(P_FSG_41_0_0_3_FctLstItemEn))
       {
           setBitInFctList(P_FSG_41_0_0_3_ID, fctList);
       }
       if(getValue(P_FSG_41_0_0_14_FctLstItemEn))
       {
           setBitInFctList(P_FSG_41_0_0_14_ID, fctList);
       }
       if(getValue(P_FSG_41_0_0_45_FctLstItemEn))
       {
           setBitInFctList(P_FSG_41_0_0_45_ID, fctList);
       }
       if(getValue(P_FSG_41_0_0_2_FctLstItemEn))
       {
           setBitInFctList(P_FSG_41_0_0_2_ID, fctList);
       }
       if(getValue(C_FSG_41_0_0_1_FctLstItemEn))
       {
           setBitInFctList(C_FSG_41_0_0_1_ID, fctList);
       }
       if(getValue(P_FSG_41_0_0_44_FctLstItemEn))
       {
           setBitInFctList(P_FSG_41_0_0_44_ID, fctList);
       }
       if(getValue(P_FSG_41_0_0_43_FctLstItemEn))
       {
           setBitInFctList(P_FSG_41_0_0_43_ID, fctList);
       }
       if(getValue(P_FSG_41_0_0_42_FctLstItemEn))
       {
           setBitInFctList(P_FSG_41_0_0_42_ID, fctList);
       }
       if(getValue(P_FSG_41_0_0_41_FctLstItemEn))
       {
           setBitInFctList(P_FSG_41_0_0_41_ID, fctList);
       }
       if(getValue(P_FSG_41_0_0_40_FctLstItemEn))
       {
           setBitInFctList(P_FSG_41_0_0_40_ID, fctList);
       }
       if(getValue(P_FSG_41_0_0_39_FctLstItemEn))
       {
           setBitInFctList(P_FSG_41_0_0_39_ID, fctList);
       }
       if(getValue(P_FSG_41_0_0_38_FctLstItemEn))
       {
           setBitInFctList(P_FSG_41_0_0_38_ID, fctList);
       }
       if(getValue(P_FSG_41_0_0_37_FctLstItemEn))
       {
           setBitInFctList(P_FSG_41_0_0_37_ID, fctList);
       }
       if(getValue(P_FSG_41_0_0_36_FctLstItemEn))
       {
           setBitInFctList(P_FSG_41_0_0_36_ID, fctList);
       }
       if(getValue(P_FSG_41_0_0_35_FctLstItemEn))
       {
           setBitInFctList(P_FSG_41_0_0_35_ID, fctList);
       }
       if(getValue(P_FSG_41_0_0_34_FctLstItemEn))
       {
           setBitInFctList(P_FSG_41_0_0_34_ID, fctList);
       }
       if(getValue(M_FSG_41_0_0_33_FctLstItemEn))
       {
           setBitInFctList(M_FSG_41_0_0_33_ID, fctList);
       }
       if(getValue(P_FSG_41_0_0_32_FctLstItemEn))
       {
           setBitInFctList(P_FSG_41_0_0_32_ID, fctList);
       }
       if(getValue(P_FSG_41_0_0_31_FctLstItemEn))
       {
           setBitInFctList(P_FSG_41_0_0_31_ID, fctList);
       }
       if(getValue(P_FSG_41_0_0_30_FctLstItemEn))
       {
           setBitInFctList(P_FSG_41_0_0_30_ID, fctList);
       }


    for(i=0;i<8;i++){
        writelineEx(gBAP_Trace, 0, "fctList[%d]: 0x%02x ",i,fctList[i]);
    }

    request [0]=LSGID;
    request [1]=3;
    request [3]= Bap_byteSequence;
    request [4]= 8;

    errorCode=BAP150_InitSendBuf(NODE_INDEX,request,fctList);
    if(errorCode)
        writelineEx(gError_Trace, 0, "BAP150_InitSendBuf(Functionlist) returns 0x%02x ",errorCode);
}

initHeartbeat()
{
       long data[2];
   data[0]=LSGID;
   if( getValue(P_FSG_41_0_0_4_FctLstItemEn) )
      data[1]=getValue(P_FSG_41_0_0_4);
   else
      data[1]=0;
   ChangeConfig(0x00,data);
   InitSendBuf_int8(P_FSG_41_0_0_4_ID, data[1]);

}

BapOnOff(byte _on)
{
  int length, temp;
  char Path[255];
  
  /***** Einschalten ******/
  if(_on==1){
    if(@BusType_FSG41_0 == 0){  // Uses CAN
      getAbsFilePath(dbcan_path, Path, 255);
      if(BAP180_LoadDB(NODE_INDEX,1, 0, Path) != 0){
        writelineEx(gError_Trace, 0, "Fehler beim Laden: %s !", Path);
      }
    }
      
    /**** Laden des BAP XML Files ****/
    getAbsFilePath(xml_path, Path, 255);
    writelineEx(gBAP_Trace, 0, "Load BAP-XML-File: %s", Path);
    if (BAP150_LoadConfig(NODE_INDEX, Path) != 0) {
        writelineEx(gError_Trace, 0, "Fehler beim Laden: %s !", Path);
    }

    if (BAP150_AddCanMap(NODE_INDEX, 1, 1) != 0) {
        writelineEx(gError_Trace, 0, "Fehler beim Mappen!");
    }
    
  
    // soll der BAP Stack wieder initlialisiert werden?                                 
    if(gBAP_Init==0){
        //gBAP_Init=1;
        temp=BAP150_Init(NODE_INDEX, LSGID);
        if(temp==0)
            writelineEx(gBAP_Trace, 0, "BAP_Init for %s succesful (LSG %d, NODE_INDEX %d)", NODE_NAME, LSGID, NODE_INDEX);
        else
            writelineEx(gError_Trace, 0, "BAP_Init error 0x%X for %s (LSG %d, NODE_INDEX %d)", temp, NODE_NAME, LSGID, NODE_INDEX);         
    }

    // Initialisierung aller Variablen
    Initialize_Variables();                     

    // Aktivierung aller Panelelemente
    EnableFctCtrl();
    //EnableControl(panel_name, bapconfig_panel_name, 0); // @TODO
    //DisableConfigCtrl();

    
    //BAP-Shutdown
    temp = BAP150_Shutdown(NODE_INDEX, LSGID);
    if(temp==0)
        writelineEx(gBAP_Trace, 0, "BAP_Shutdown for %s succesful (LSG %d, NODE_INDEX %d)", NODE_NAME, LSGID, NODE_INDEX);
    else
        writelineEx(gError_Trace, 0, "BAP_Shutdown error 0x%X for %s (LSG %d, NODE_INDEX %d)", temp, NODE_NAME, LSGID, NODE_INDEX); 

    initBapConfig();
    initFctList();
    initHeartbeat();

    temp = BAP150_Start(NODE_INDEX, LSGID);             
    if(temp == 0)
        writelineEx(gBAP_Trace, 0, "BAP_Start for %s succesful (LSG %d, NODE_INDEX %d)", NODE_NAME, LSGID, NODE_INDEX);
    else
        writelineEx(gError_Trace, 0, "BAP_Start error 0x%X for %s (LSG %d, NODE_INDEX %d)", temp, NODE_NAME, LSGID, NODE_INDEX);        

    // setze den Timer fuer den zyklischen Aufruf des CANoe-"Tasks"
    setTimer(TaskTimer, 10);                
// ETHERNET AND FLEXRAY NOT ENABLED!
    //  BAPFsg_ProcessDebug(NODE_INDEX,DEBUG_CAN_CHANNEL, DEBUG_ID, LSGID, DEBUG_SWITCH_ON);    
  }
  else{ /***** Ausschalten ****/
      
      BAP150_Shutdown(NODE_INDEX,LSGID);
      
      CANoe_Shutdown();
      
      // ETHERNET NOT ENABLED! (CALL_FCT_CLOSE_UPD_SOCKET_TOKEN)
  }
  P_FSG_41_0_0_4_FctEn();
}

Initialize_Variables()	//initialize/reset all global variables
{
	int temp, i;
	byte  InitSend_data[BAP_buffer_size];	// InitSend data for DLL
	dword InitSend_header[6];	// InitSend header for DLL

	/**** Request Buffer Geschichten initialisieren ****/
	for (i = 0; i < Requestbuffer_lines; i++)
	{
		gBAP_Requestbuffer_status[i] = 0;
	}	
	for (i = 0; i < BAP_buffer_size; i++)
	{
		InitSend_data[i] = 0;
	}	

	// @TODO nur FSG relevant
	/**** Es ist notwendig mittels InitSendbuffer alle Properties im FSG zu initialisieren ****/
           InitSend_header[0] = LSGID;       
       InitSend_header[1] = 14; 
       InitSend_header[3] = Bap_fixedByteSequence;
       InitSend_header[4] = 6;
       InitSend_header[5] = 0;
       getValue(P_FSG_41_0_0_14,InitSend_data);
       putValue(P_FSG_41_0_0_14,InitSend_data, 6);
       temp = Bap150_InitSendBuf(NODE_INDEX, InitSend_header, InitSend_data);
       for (i=0; i<(getValueSize(P_FSG_41_0_0_14)); i++) 
       {
           InitSend_data[i] = 0;
       }
       if(temp != 0)
           writelineEx(gError_Trace, 0, "BAP150_InitSendBuf error 0x%X for %s (LSG %d, FCTID %d)", temp, NODE_NAME, LSGID, InitSend_header[1]);
       InitSend_header[0] = LSGID;       
       InitSend_header[1] = 15; 
       InitSend_header[3] = Bap_uint8;
       InitSend_header[4] = 1;
       InitSend_header[5] = getValue(P_FSG_41_0_0_15);
	 putValue(P_FSG_41_0_0_15, InitSend_header[5]);
       temp = Bap150_InitSendBuf(NODE_INDEX, InitSend_header, InitSend_data);
       if(temp != 0)
           writelineEx(gError_Trace, 0, "BAP150_InitSendBuf error 0x%X for %s (LSG %d, FCTID %d)", temp, NODE_NAME, LSGID, InitSend_header[1]);
       InitSend_header[0] = LSGID;       
       InitSend_header[1] = 16; 
       InitSend_header[3] = Bap_byteSequence;
       InitSend_header[4] = 8;
       InitSend_header[5] = 0;
       getValue(P_FSG_41_0_0_16,InitSend_data);
       putValue(P_FSG_41_0_0_16,InitSend_data, 8);
       temp = Bap150_InitSendBuf(NODE_INDEX, InitSend_header, InitSend_data);
       for (i=0; i<(getValueSize(P_FSG_41_0_0_16)); i++) 
       {
           InitSend_data[i] = 0;
       }
       if(temp != 0)
           writelineEx(gError_Trace, 0, "BAP150_InitSendBuf error 0x%X for %s (LSG %d, FCTID %d)", temp, NODE_NAME, LSGID, InitSend_header[1]);
       InitSend_header[0] = LSGID;       
       InitSend_header[1] = 17; 
       InitSend_header[3] = Bap_fixedByteSequence;
       InitSend_header[4] = 3;
       InitSend_header[5] = 0;
       getValue(P_FSG_41_0_0_17,InitSend_data);
       putValue(P_FSG_41_0_0_17,InitSend_data, 3);
       temp = Bap150_InitSendBuf(NODE_INDEX, InitSend_header, InitSend_data);
       for (i=0; i<(getValueSize(P_FSG_41_0_0_17)); i++) 
       {
           InitSend_data[i] = 0;
       }
       if(temp != 0)
           writelineEx(gError_Trace, 0, "BAP150_InitSendBuf error 0x%X for %s (LSG %d, FCTID %d)", temp, NODE_NAME, LSGID, InitSend_header[1]);
       InitSend_header[0] = LSGID;       
       InitSend_header[1] = 18; 
       InitSend_header[3] = Bap_uint8;
       InitSend_header[4] = 1;
       InitSend_header[5] = getValue(P_FSG_41_0_0_18);
	 putValue(P_FSG_41_0_0_18, InitSend_header[5]);
       temp = Bap150_InitSendBuf(NODE_INDEX, InitSend_header, InitSend_data);
       if(temp != 0)
           writelineEx(gError_Trace, 0, "BAP150_InitSendBuf error 0x%X for %s (LSG %d, FCTID %d)", temp, NODE_NAME, LSGID, InitSend_header[1]);
       InitSend_header[0] = LSGID;       
       InitSend_header[1] = 19; 
       InitSend_header[3] = Bap_byteSequence;
       InitSend_header[4] = 4 + @P_FSG_41_0_0_19_2_len + @P_FSG_41_0_0_19_4_len; //82;
       InitSend_header[5] = 0;
       getValue(P_FSG_41_0_0_19,InitSend_data);
       putValue(P_FSG_41_0_0_19,InitSend_data, 82);
       temp = Bap150_InitSendBuf(NODE_INDEX, InitSend_header, InitSend_data);
       for (i=0; i<(getValueSize(P_FSG_41_0_0_19)); i++) 
       {
           InitSend_data[i] = 0;
       }
       if(temp != 0)
           writelineEx(gError_Trace, 0, "BAP150_InitSendBuf error 0x%X for %s (LSG %d, FCTID %d)", temp, NODE_NAME, LSGID, InitSend_header[1]);
       InitSend_header[0] = LSGID;       
       InitSend_header[1] = 20; 
       InitSend_header[3] = Bap_uint8;
       InitSend_header[4] = 1;
       InitSend_header[5] = getValue(P_FSG_41_0_0_20);
	 putValue(P_FSG_41_0_0_20, InitSend_header[5]);
       temp = Bap150_InitSendBuf(NODE_INDEX, InitSend_header, InitSend_data);
       if(temp != 0)
           writelineEx(gError_Trace, 0, "BAP150_InitSendBuf error 0x%X for %s (LSG %d, FCTID %d)", temp, NODE_NAME, LSGID, InitSend_header[1]);
       InitSend_header[0] = LSGID;       
       InitSend_header[1] = 21; 
       InitSend_header[3] = Bap_byteSequence;
       InitSend_header[4] = 9;
       InitSend_header[5] = 0;
       getValue(P_FSG_41_0_0_21,InitSend_data);
       putValue(P_FSG_41_0_0_21,InitSend_data, 9);
       temp = Bap150_InitSendBuf(NODE_INDEX, InitSend_header, InitSend_data);
       for (i=0; i<(getValueSize(P_FSG_41_0_0_21)); i++) 
       {
           InitSend_data[i] = 0;
       }
       if(temp != 0)
           writelineEx(gError_Trace, 0, "BAP150_InitSendBuf error 0x%X for %s (LSG %d, FCTID %d)", temp, NODE_NAME, LSGID, InitSend_header[1]);
       InitSend_header[0] = LSGID;       
       InitSend_header[1] = 22; 
       InitSend_header[3] = Bap_fixedByteSequence;
       InitSend_header[4] = 3;
       InitSend_header[5] = 0;
       getValue(P_FSG_41_0_0_22,InitSend_data);
       putValue(P_FSG_41_0_0_22,InitSend_data, 3);
       temp = Bap150_InitSendBuf(NODE_INDEX, InitSend_header, InitSend_data);
       for (i=0; i<(getValueSize(P_FSG_41_0_0_22)); i++) 
       {
           InitSend_data[i] = 0;
       }
       if(temp != 0)
           writelineEx(gError_Trace, 0, "BAP150_InitSendBuf error 0x%X for %s (LSG %d, FCTID %d)", temp, NODE_NAME, LSGID, InitSend_header[1]);
       InitSend_header[0] = LSGID;       
       InitSend_header[1] = 23; 
       InitSend_header[3] = Bap_fixedByteSequence;
       InitSend_header[4] = 5;
       InitSend_header[5] = 0;
       getValue(P_FSG_41_0_0_23,InitSend_data);
       putValue(P_FSG_41_0_0_23,InitSend_data, 5);
       temp = Bap150_InitSendBuf(NODE_INDEX, InitSend_header, InitSend_data);
       for (i=0; i<(getValueSize(P_FSG_41_0_0_23)); i++) 
       {
           InitSend_data[i] = 0;
       }
       if(temp != 0)
           writelineEx(gError_Trace, 0, "BAP150_InitSendBuf error 0x%X for %s (LSG %d, FCTID %d)", temp, NODE_NAME, LSGID, InitSend_header[1]);
       InitSend_header[0] = LSGID;       
       InitSend_header[1] = 24; 
       InitSend_header[3] = Bap_fixedByteSequence;
       InitSend_header[4] = 6;
       InitSend_header[5] = 0;
       getValue(P_FSG_41_0_0_24,InitSend_data);
       putValue(P_FSG_41_0_0_24,InitSend_data, 6);
       temp = Bap150_InitSendBuf(NODE_INDEX, InitSend_header, InitSend_data);
       for (i=0; i<(getValueSize(P_FSG_41_0_0_24)); i++) 
       {
           InitSend_data[i] = 0;
       }
       if(temp != 0)
           writelineEx(gError_Trace, 0, "BAP150_InitSendBuf error 0x%X for %s (LSG %d, FCTID %d)", temp, NODE_NAME, LSGID, InitSend_header[1]);
       InitSend_header[0] = LSGID;       
       InitSend_header[1] = 25; 
       InitSend_header[3] = Bap_uint16;
       InitSend_header[4] = 2;
       InitSend_header[5] = getValue(P_FSG_41_0_0_25);
	 putValue(P_FSG_41_0_0_25, InitSend_header[5]);
       temp = Bap150_InitSendBuf(NODE_INDEX, InitSend_header, InitSend_data);
       if(temp != 0)
           writelineEx(gError_Trace, 0, "BAP150_InitSendBuf error 0x%X for %s (LSG %d, FCTID %d)", temp, NODE_NAME, LSGID, InitSend_header[1]);
       InitSend_header[0] = LSGID;       
       InitSend_header[1] = 26; 
       InitSend_header[3] = Bap_fixedByteSequence;
       InitSend_header[4] = 6;
       InitSend_header[5] = 0;
       getValue(P_FSG_41_0_0_26,InitSend_data);
       putValue(P_FSG_41_0_0_26,InitSend_data, 6);
       temp = Bap150_InitSendBuf(NODE_INDEX, InitSend_header, InitSend_data);
       for (i=0; i<(getValueSize(P_FSG_41_0_0_26)); i++) 
       {
           InitSend_data[i] = 0;
       }
       if(temp != 0)
           writelineEx(gError_Trace, 0, "BAP150_InitSendBuf error 0x%X for %s (LSG %d, FCTID %d)", temp, NODE_NAME, LSGID, InitSend_header[1]);
       InitSend_header[0] = LSGID;       
       InitSend_header[1] = 27; 
       InitSend_header[3] = Bap_byteSequence;
       InitSend_header[4] = 1 + @P_FSG_41_0_0_27_1_len; //50;
       InitSend_header[5] = 0;
       getValue(P_FSG_41_0_0_27,InitSend_data);
       putValue(P_FSG_41_0_0_27,InitSend_data, 50);
       temp = Bap150_InitSendBuf(NODE_INDEX, InitSend_header, InitSend_data);
       for (i=0; i<(getValueSize(P_FSG_41_0_0_27)); i++) 
       {
           InitSend_data[i] = 0;
       }
       if(temp != 0)
           writelineEx(gError_Trace, 0, "BAP150_InitSendBuf error 0x%X for %s (LSG %d, FCTID %d)", temp, NODE_NAME, LSGID, InitSend_header[1]);
       InitSend_header[0] = LSGID;       
       InitSend_header[1] = 28; 
       InitSend_header[3] = Bap_fixedByteSequence;
       InitSend_header[4] = 3;
       InitSend_header[5] = 0;
       getValue(P_FSG_41_0_0_28,InitSend_data);
       putValue(P_FSG_41_0_0_28,InitSend_data, 3);
       temp = Bap150_InitSendBuf(NODE_INDEX, InitSend_header, InitSend_data);
       for (i=0; i<(getValueSize(P_FSG_41_0_0_28)); i++) 
       {
           InitSend_data[i] = 0;
       }
       if(temp != 0)
           writelineEx(gError_Trace, 0, "BAP150_InitSendBuf error 0x%X for %s (LSG %d, FCTID %d)", temp, NODE_NAME, LSGID, InitSend_header[1]);
       InitSend_header[0] = LSGID;       
       InitSend_header[1] = 29; 
       InitSend_header[3] = Bap_fixedByteSequence;
       InitSend_header[4] = 3;
       InitSend_header[5] = 0;
       getValue(P_FSG_41_0_0_29,InitSend_data);
       putValue(P_FSG_41_0_0_29,InitSend_data, 3);
       temp = Bap150_InitSendBuf(NODE_INDEX, InitSend_header, InitSend_data);
       for (i=0; i<(getValueSize(P_FSG_41_0_0_29)); i++) 
       {
           InitSend_data[i] = 0;
       }
       if(temp != 0)
           writelineEx(gError_Trace, 0, "BAP150_InitSendBuf error 0x%X for %s (LSG %d, FCTID %d)", temp, NODE_NAME, LSGID, InitSend_header[1]);
       InitSend_header[0] = LSGID;       
       InitSend_header[1] = 30; 
       InitSend_header[3] = Bap_byteSequence;
       InitSend_header[4] = 16;
       InitSend_header[5] = 0;
       getValue(P_FSG_41_0_0_30,InitSend_data);
       putValue(P_FSG_41_0_0_30,InitSend_data, 16);
       temp = Bap150_InitSendBuf(NODE_INDEX, InitSend_header, InitSend_data);
       for (i=0; i<(getValueSize(P_FSG_41_0_0_30)); i++) 
       {
           InitSend_data[i] = 0;
       }
       if(temp != 0)
           writelineEx(gError_Trace, 0, "BAP150_InitSendBuf error 0x%X for %s (LSG %d, FCTID %d)", temp, NODE_NAME, LSGID, InitSend_header[1]);
       InitSend_header[0] = LSGID;       
       InitSend_header[1] = 31; 
       InitSend_header[3] = Bap_byteSequence;
       InitSend_header[4] = 21 + @P_FSG_41_0_0_31_1_len + @P_FSG_41_0_0_31_2_len + @P_FSG_41_0_0_31_4_len + @P_FSG_41_0_0_31_5_len + @P_FSG_41_0_0_31_7_len + @P_FSG_41_0_0_31_8_len + @P_FSG_41_0_0_31_10_len + @P_FSG_41_0_0_31_11_len + @P_FSG_41_0_0_31_13_len + @P_FSG_41_0_0_31_14_len + @P_FSG_41_0_0_31_16_len + @P_FSG_41_0_0_31_17_len + @P_FSG_41_0_0_31_19_len + @P_FSG_41_0_0_31_20_len; //994;
       InitSend_header[5] = 0;
       getValue(P_FSG_41_0_0_31,InitSend_data);
       putValue(P_FSG_41_0_0_31,InitSend_data, 994);
       temp = Bap150_InitSendBuf(NODE_INDEX, InitSend_header, InitSend_data);
       for (i=0; i<(getValueSize(P_FSG_41_0_0_31)); i++) 
       {
           InitSend_data[i] = 0;
       }
       if(temp != 0)
           writelineEx(gError_Trace, 0, "BAP150_InitSendBuf error 0x%X for %s (LSG %d, FCTID %d)", temp, NODE_NAME, LSGID, InitSend_header[1]);
       InitSend_header[0] = LSGID;       
       InitSend_header[1] = 32; 
       InitSend_header[3] = Bap_byteSequence;
       InitSend_header[4] = 10;
       InitSend_header[5] = 0;
       getValue(P_FSG_41_0_0_32,InitSend_data);
       putValue(P_FSG_41_0_0_32,InitSend_data, 10);
       temp = Bap150_InitSendBuf(NODE_INDEX, InitSend_header, InitSend_data);
       for (i=0; i<(getValueSize(P_FSG_41_0_0_32)); i++) 
       {
           InitSend_data[i] = 0;
       }
       if(temp != 0)
           writelineEx(gError_Trace, 0, "BAP150_InitSendBuf error 0x%X for %s (LSG %d, FCTID %d)", temp, NODE_NAME, LSGID, InitSend_header[1]);
       InitSend_header[0] = LSGID;       
       InitSend_header[1] = 34; 
       InitSend_header[3] = Bap_byteSequence;
       InitSend_header[4] = 8;
       InitSend_header[5] = 0;
       getValue(P_FSG_41_0_0_34,InitSend_data);
       putValue(P_FSG_41_0_0_34,InitSend_data, 8);
       temp = Bap150_InitSendBuf(NODE_INDEX, InitSend_header, InitSend_data);
       for (i=0; i<(getValueSize(P_FSG_41_0_0_34)); i++) 
       {
           InitSend_data[i] = 0;
       }
       if(temp != 0)
           writelineEx(gError_Trace, 0, "BAP150_InitSendBuf error 0x%X for %s (LSG %d, FCTID %d)", temp, NODE_NAME, LSGID, InitSend_header[1]);
       InitSend_header[0] = LSGID;       
       InitSend_header[1] = 35; 
       InitSend_header[3] = Bap_byteSequence;
       InitSend_header[4] = 1 + @P_FSG_41_0_0_35_1_len; //50;
       InitSend_header[5] = 0;
       getValue(P_FSG_41_0_0_35,InitSend_data);
       putValue(P_FSG_41_0_0_35,InitSend_data, 50);
       temp = Bap150_InitSendBuf(NODE_INDEX, InitSend_header, InitSend_data);
       for (i=0; i<(getValueSize(P_FSG_41_0_0_35)); i++) 
       {
           InitSend_data[i] = 0;
       }
       if(temp != 0)
           writelineEx(gError_Trace, 0, "BAP150_InitSendBuf error 0x%X for %s (LSG %d, FCTID %d)", temp, NODE_NAME, LSGID, InitSend_header[1]);
       InitSend_header[0] = LSGID;       
       InitSend_header[1] = 36; 
       InitSend_header[3] = Bap_fixedByteSequence;
       InitSend_header[4] = 3;
       InitSend_header[5] = 0;
       getValue(P_FSG_41_0_0_36,InitSend_data);
       putValue(P_FSG_41_0_0_36,InitSend_data, 3);
       temp = Bap150_InitSendBuf(NODE_INDEX, InitSend_header, InitSend_data);
       for (i=0; i<(getValueSize(P_FSG_41_0_0_36)); i++) 
       {
           InitSend_data[i] = 0;
       }
       if(temp != 0)
           writelineEx(gError_Trace, 0, "BAP150_InitSendBuf error 0x%X for %s (LSG %d, FCTID %d)", temp, NODE_NAME, LSGID, InitSend_header[1]);
       InitSend_header[0] = LSGID;       
       InitSend_header[1] = 37; 
       InitSend_header[3] = Bap_fixedByteSequence;
       InitSend_header[4] = 5;
       InitSend_header[5] = 0;
       getValue(P_FSG_41_0_0_37,InitSend_data);
       putValue(P_FSG_41_0_0_37,InitSend_data, 5);
       temp = Bap150_InitSendBuf(NODE_INDEX, InitSend_header, InitSend_data);
       for (i=0; i<(getValueSize(P_FSG_41_0_0_37)); i++) 
       {
           InitSend_data[i] = 0;
       }
       if(temp != 0)
           writelineEx(gError_Trace, 0, "BAP150_InitSendBuf error 0x%X for %s (LSG %d, FCTID %d)", temp, NODE_NAME, LSGID, InitSend_header[1]);
       InitSend_header[0] = LSGID;       
       InitSend_header[1] = 38; 
       InitSend_header[3] = Bap_fixedByteSequence;
       InitSend_header[4] = 3;
       InitSend_header[5] = 0;
       getValue(P_FSG_41_0_0_38,InitSend_data);
       putValue(P_FSG_41_0_0_38,InitSend_data, 3);
       temp = Bap150_InitSendBuf(NODE_INDEX, InitSend_header, InitSend_data);
       for (i=0; i<(getValueSize(P_FSG_41_0_0_38)); i++) 
       {
           InitSend_data[i] = 0;
       }
       if(temp != 0)
           writelineEx(gError_Trace, 0, "BAP150_InitSendBuf error 0x%X for %s (LSG %d, FCTID %d)", temp, NODE_NAME, LSGID, InitSend_header[1]);
       InitSend_header[0] = LSGID;       
       InitSend_header[1] = 39; 
       InitSend_header[3] = Bap_byteSequence;
       InitSend_header[4] = 4 + @P_FSG_41_0_0_39_2_len + @P_FSG_41_0_0_39_4_len; //82;
       InitSend_header[5] = 0;
       getValue(P_FSG_41_0_0_39,InitSend_data);
       putValue(P_FSG_41_0_0_39,InitSend_data, 82);
       temp = Bap150_InitSendBuf(NODE_INDEX, InitSend_header, InitSend_data);
       for (i=0; i<(getValueSize(P_FSG_41_0_0_39)); i++) 
       {
           InitSend_data[i] = 0;
       }
       if(temp != 0)
           writelineEx(gError_Trace, 0, "BAP150_InitSendBuf error 0x%X for %s (LSG %d, FCTID %d)", temp, NODE_NAME, LSGID, InitSend_header[1]);
       InitSend_header[0] = LSGID;       
       InitSend_header[1] = 40; 
       InitSend_header[3] = Bap_fixedByteSequence;
       InitSend_header[4] = 3;
       InitSend_header[5] = 0;
       getValue(P_FSG_41_0_0_40,InitSend_data);
       putValue(P_FSG_41_0_0_40,InitSend_data, 3);
       temp = Bap150_InitSendBuf(NODE_INDEX, InitSend_header, InitSend_data);
       for (i=0; i<(getValueSize(P_FSG_41_0_0_40)); i++) 
       {
           InitSend_data[i] = 0;
       }
       if(temp != 0)
           writelineEx(gError_Trace, 0, "BAP150_InitSendBuf error 0x%X for %s (LSG %d, FCTID %d)", temp, NODE_NAME, LSGID, InitSend_header[1]);
       InitSend_header[0] = LSGID;       
       InitSend_header[1] = 41; 
       InitSend_header[3] = Bap_byteSequence;
       InitSend_header[4] = 10;
       InitSend_header[5] = 0;
       getValue(P_FSG_41_0_0_41,InitSend_data);
       putValue(P_FSG_41_0_0_41,InitSend_data, 10);
       temp = Bap150_InitSendBuf(NODE_INDEX, InitSend_header, InitSend_data);
       for (i=0; i<(getValueSize(P_FSG_41_0_0_41)); i++) 
       {
           InitSend_data[i] = 0;
       }
       if(temp != 0)
           writelineEx(gError_Trace, 0, "BAP150_InitSendBuf error 0x%X for %s (LSG %d, FCTID %d)", temp, NODE_NAME, LSGID, InitSend_header[1]);
       InitSend_header[0] = LSGID;       
       InitSend_header[1] = 42; 
       InitSend_header[3] = Bap_fixedByteSequence;
       InitSend_header[4] = 3;
       InitSend_header[5] = 0;
       getValue(P_FSG_41_0_0_42,InitSend_data);
       putValue(P_FSG_41_0_0_42,InitSend_data, 3);
       temp = Bap150_InitSendBuf(NODE_INDEX, InitSend_header, InitSend_data);
       for (i=0; i<(getValueSize(P_FSG_41_0_0_42)); i++) 
       {
           InitSend_data[i] = 0;
       }
       if(temp != 0)
           writelineEx(gError_Trace, 0, "BAP150_InitSendBuf error 0x%X for %s (LSG %d, FCTID %d)", temp, NODE_NAME, LSGID, InitSend_header[1]);
       InitSend_header[0] = LSGID;       
       InitSend_header[1] = 43; 
       InitSend_header[3] = Bap_byteSequence;
       InitSend_header[4] = 16;
       InitSend_header[5] = 0;
       getValue(P_FSG_41_0_0_43,InitSend_data);
       putValue(P_FSG_41_0_0_43,InitSend_data, 16);
       temp = Bap150_InitSendBuf(NODE_INDEX, InitSend_header, InitSend_data);
       for (i=0; i<(getValueSize(P_FSG_41_0_0_43)); i++) 
       {
           InitSend_data[i] = 0;
       }
       if(temp != 0)
           writelineEx(gError_Trace, 0, "BAP150_InitSendBuf error 0x%X for %s (LSG %d, FCTID %d)", temp, NODE_NAME, LSGID, InitSend_header[1]);
       InitSend_header[0] = LSGID;       
       InitSend_header[1] = 44; 
       InitSend_header[3] = Bap_byteSequence;
       InitSend_header[4] = 21 + @P_FSG_41_0_0_44_1_len + @P_FSG_41_0_0_44_2_len + @P_FSG_41_0_0_44_4_len + @P_FSG_41_0_0_44_5_len + @P_FSG_41_0_0_44_7_len + @P_FSG_41_0_0_44_8_len + @P_FSG_41_0_0_44_10_len + @P_FSG_41_0_0_44_11_len + @P_FSG_41_0_0_44_13_len + @P_FSG_41_0_0_44_14_len + @P_FSG_41_0_0_44_16_len + @P_FSG_41_0_0_44_17_len + @P_FSG_41_0_0_44_19_len + @P_FSG_41_0_0_44_20_len; //994;
       InitSend_header[5] = 0;
       getValue(P_FSG_41_0_0_44,InitSend_data);
       putValue(P_FSG_41_0_0_44,InitSend_data, 994);
       temp = Bap150_InitSendBuf(NODE_INDEX, InitSend_header, InitSend_data);
       for (i=0; i<(getValueSize(P_FSG_41_0_0_44)); i++) 
       {
           InitSend_data[i] = 0;
       }
       if(temp != 0)
           writelineEx(gError_Trace, 0, "BAP150_InitSendBuf error 0x%X for %s (LSG %d, FCTID %d)", temp, NODE_NAME, LSGID, InitSend_header[1]);
       InitSend_header[0] = LSGID;       
       InitSend_header[1] = 45; 
       InitSend_header[3] = Bap_byteSequence;
       InitSend_header[4] = 10;
       InitSend_header[5] = 0;
       getValue(P_FSG_41_0_0_45,InitSend_data);
       putValue(P_FSG_41_0_0_45,InitSend_data, 10);
       temp = Bap150_InitSendBuf(NODE_INDEX, InitSend_header, InitSend_data);
       for (i=0; i<(getValueSize(P_FSG_41_0_0_45)); i++) 
       {
           InitSend_data[i] = 0;
       }
       if(temp != 0)
           writelineEx(gError_Trace, 0, "BAP150_InitSendBuf error 0x%X for %s (LSG %d, FCTID %d)", temp, NODE_NAME, LSGID, InitSend_header[1]);
       InitSend_header[0] = LSGID;       
       InitSend_header[1] = 47; 
       InitSend_header[3] = Bap_fixedByteSequence;
       InitSend_header[4] = 4;
       InitSend_header[5] = 0;
       getValue(P_FSG_41_0_0_47,InitSend_data);
       putValue(P_FSG_41_0_0_47,InitSend_data, 4);
       temp = Bap150_InitSendBuf(NODE_INDEX, InitSend_header, InitSend_data);
       for (i=0; i<(getValueSize(P_FSG_41_0_0_47)); i++) 
       {
           InitSend_data[i] = 0;
       }
       if(temp != 0)
           writelineEx(gError_Trace, 0, "BAP150_InitSendBuf error 0x%X for %s (LSG %d, FCTID %d)", temp, NODE_NAME, LSGID, InitSend_header[1]);
       InitSend_header[0] = LSGID;       
       InitSend_header[1] = 49; 
       InitSend_header[3] = Bap_byteSequence;
       InitSend_header[4] = 8;
       InitSend_header[5] = 0;
       getValue(P_FSG_41_0_0_49,InitSend_data);
       putValue(P_FSG_41_0_0_49,InitSend_data, 8);
       temp = Bap150_InitSendBuf(NODE_INDEX, InitSend_header, InitSend_data);
       for (i=0; i<(getValueSize(P_FSG_41_0_0_49)); i++) 
       {
           InitSend_data[i] = 0;
       }
       if(temp != 0)
           writelineEx(gError_Trace, 0, "BAP150_InitSendBuf error 0x%X for %s (LSG %d, FCTID %d)", temp, NODE_NAME, LSGID, InitSend_header[1]);
       InitSend_header[0] = LSGID;       
       InitSend_header[1] = 50; 
       InitSend_header[3] = Bap_fixedByteSequence;
       InitSend_header[4] = 6;
       InitSend_header[5] = 0;
       getValue(P_FSG_41_0_0_50,InitSend_data);
       putValue(P_FSG_41_0_0_50,InitSend_data, 6);
       temp = Bap150_InitSendBuf(NODE_INDEX, InitSend_header, InitSend_data);
       for (i=0; i<(getValueSize(P_FSG_41_0_0_50)); i++) 
       {
           InitSend_data[i] = 0;
       }
       if(temp != 0)
           writelineEx(gError_Trace, 0, "BAP150_InitSendBuf error 0x%X for %s (LSG %d, FCTID %d)", temp, NODE_NAME, LSGID, InitSend_header[1]);

}

on start
{
  byte data_33[2] = { 0x00, 0x00 } ;
  byte data_46[2] = { 0x00, 0x00 } ;
  byte data_48[2] = { 0x00, 0x00 } ;
  
	// noch nicht eingeschaltet
	gSG_PowerOnOff=0;
	// noch nicht initialisiert
	gBAP_Init=0;
	// open the panel, nur fuer CANoe-Version >= 5.1 erlaubt
	//openPanel(panel_name);
	// deaktiviere alle aktiven Panel Elemente, ausser AN/AUSS
  
  putValue(Node_Index_FSG_41, NODE_INDEX); // CG: für BAPControl
  
    CANoe_Shutdown();
  
  //Start Init
  putvalue(M_FSG_41_0_0_33_Processing,data_33);
  putvalue(M_FSG_41_0_0_46_Processing,data_46);
  putvalue(M_FSG_41_0_0_48_Processing,data_48);
    
// ETHERNET AND FLEXRAY NOT ENABLED!
        
}

BAP_CAN_TX_Request()	//Function to send BAP-data over CAN
{
   int i;
   byte DestIp[16];
   byte TX_Data[1500];				// CAN-data
   byte TX_Data_FR[10];    		// FlexRay-Data
   dword TX_Header[13];			// Header
   message 0x100 TX_Message;	// dummy-message, Adresse wird noch modifiziert
   
   byte send_result;
   
   // ONLY CAN IS ENABLED! 
      TX_Header[0] = 1; /*BusType: 1=Can, 2=Lin, 3=Flexray, 4=Ethernet*/
   		TX_Header[2] = 8; // max-Length of TX_Data

		// Pollen ueber die Queue, die von der DLL zur Verfuegung gestellt wird
		// Diese Daten muessen ueber den CAN Bus gesendet werden
	   	while (BAP180_GetTxData(NODE_INDEX,TX_Header,TX_Data) == 0) {	
        TX_Message.CAN = TX_Header[1]; 		//CAN channel
        TX_Message.ID = TX_Header[3]; 	  //Can ID
        TX_Message.DataLength = TX_Header[2]; 		// received length
			
			  for (i=0; i<TX_Message.DataLength; i++) {	//CAN data-bytes
		  		TX_Message.byte(i) = TX_Data[i];
		  	}
		  	
        TX_Message.EDL = 0;
        TX_Message.BRS = 0;
        if(TX_Header[4] & 2) 
          TX_Message.EDL = 1;
        if(TX_Header[4] & 4) 
          TX_Message.BRS = 1;
        
		  	output(TX_Message);					//send CAN message
		  	
		  	//Versions Output
		  	if(TX_Data[0] == 0x40 && TX_Data[1] == 0x00 && TX_Header[2] == 4)
		  	{
		    	writelineEx(gBAP_Trace, 0,"Major Version: %i, Minor Version: %i", TX_Data[2], TX_Data[3]);
		  	}       
		  	TX_Header[2] = 8; // max-Length of TX_Data
	   	} 
   // ONLY CAN IS ENABLED!
   // FLEXRAY NOT ENABLED! (TX_FR_TOKEN)
   // ETHERNET NOT ENABLED! (TX_IP_TOKEN)
}

ringbuffer_write (byte lsgID, byte fctID, byte request, byte dataType, word length, dword singleData, byte data[])
{
	int bufferline, i;

	bufferline = getNextWriteIndex();	//get next free position in ring-buffer

	if (bufferline == -1) 
	{
		writelineEx(gError_Trace, 0, "Crititcal Error: No free buffer found!");
		return;
	}
		
	gBAP_Request_header[bufferline][0] = lsgID;	// LSG
	gBAP_Request_header[bufferline][1] = fctID;	// FCT
	gBAP_Request_header[bufferline][3] = dataType; // dataType
    //writelineEx(gBAP_Trace, 0, "Write request in buffer FSG NODEINDEX:%d lsgid:%d fctid:%d requesttype:%d datatype:%d length:%d", 
    //        NODE_INDEX,lsgID,fctID,request,dataType,length);


	switch (dataType)
	{
		case Bap_void:
			gBAP_Request_header[bufferline][2] = request;	// request
			gBAP_Request_header[bufferline][4] = 0;	// length
				// Void
			// @TODO?		
			break;
		case Bap_uint8:
			gBAP_Request_header[bufferline][2] = request;		// request
			gBAP_Request_header[bufferline][5] = singleData;	// Daten		
			break;
		case Bap_uint16:
			gBAP_Request_header[bufferline][2] = request;		// request
			gBAP_Request_header[bufferline][5] = singleData;	// Daten
			break;			
		case Bap_uint32:
			gBAP_Request_header[bufferline][2] = request;		// request
			gBAP_Request_header[bufferline][5] = singleData;	// Daten		
			break;	
		case Bap_byteSequence:
			gBAP_Request_header[bufferline][2] = request;	// request
			gBAP_Request_header[bufferline][4] = length;	// length
			// Daten der ByteSequence kopieren
			for(i = 0; i < BAP_buffer_size; i++)									
				gBAP_Request_data[bufferline][i] = data[i];
		case Bap_error:
			gBAP_Request_header[bufferline][5] = singleData;	// Errorcode						
			break;
		default:
			break;
	}

			

}

Request_void (byte lsgID, byte fctID, byte request)
{
	int i;
	byte dataArray [BAP_buffer_size];

	// Initialisieren eines Arrays
	for(i=0;i<BAP_buffer_size;i++) dataArray [i]=0;

	ringbuffer_write (lsgID, fctID, request, Bap_void, 0, 0, dataArray);	
}

Request_int8 (byte lsgID, byte fctID, byte request, dword data)
{
	int i;
	byte dataArray [BAP_buffer_size];

	// Initialisieren eines Arrays
	for(i=0;i<BAP_buffer_size;i++) dataArray [i]=0;

	ringbuffer_write (lsgID, fctID, request, Bap_uint8, 0, data, dataArray);

}

Request_int16 (byte lsgID, byte fctID, byte request, dword data)
{
	int i;
	byte dataArray [BAP_buffer_size];

	// Initialisieren eines Arrays
	for(i=0;i<BAP_buffer_size;i++) dataArray [i]=0;

	ringbuffer_write (lsgID, fctID, request, Bap_uint16, 0, data, dataArray);

}

Request_int32 (byte lsgID, byte fctID, byte request, dword data)
{
	int i;
	byte dataArray [BAP_buffer_size];

	// Initialisieren eines Arrays
	for(i=0;i<BAP_buffer_size;i++) dataArray [i]=0;

	ringbuffer_write (lsgID, fctID, request, Bap_uint32, 0, data, dataArray);
}

Request_byteSequence (byte lsgID, byte fctID, byte request, byte data[], word length)
{
	int i;
	byte dataArray [BAP_buffer_size];

	// Initialisieren eines Arrays
	for(i=0;i<BAP_buffer_size;i++) dataArray [i]=0;

	// Fuellen des Arrays
	for(i=0;i<length;i++) dataArray [i]=data[i];

	ringbuffer_write (lsgID, fctID, request, Bap_byteSequence, length, 0, dataArray);
}

Request_error (byte lsgID, byte fctID, byte errorCode)
{
	int i;
	byte dataArray [BAP_buffer_size];

	// Initialisieren eines Arrays
	for(i=0;i<BAP_buffer_size;i++) dataArray [i]=0;

	ringbuffer_write (lsgID, fctID, Error_REQ, Bap_error, 0, errorCode, dataArray);
}

InitSendBuf_int8 (byte fctID, dword data)
{
    dword request[6];
    int errorCode;
    byte  InitSend_data[1];

    request [0]= LSGID;
    request [1]= fctID;
    request [3]= Bap_uint8;
    request [5]= data;

    errorCode=
    BAP150_InitSendBuf(NODE_INDEX,request,InitSend_data);
    
    if(errorCode)
        writelineEx(gError_Trace, 0, "InitSendBuf_int8 error 0x%X for %s (LSG %d, FCTID %d)", errorCode, NODE_NAME, LSGID, fctID);
    
}

InitSendBuf_int16 (byte fctID, dword data)
{
    dword request[6];
    byte errorCode;
    byte  InitSend_data[1];

    request [0]= LSGID;
    request [1]= fctID;
    request [3]= Bap_uint16;
    request [5]= data;

    errorCode=BAP150_InitSendBuf(NODE_INDEX,request,InitSend_data);
    
    if(errorCode)
        writelineEx(gError_Trace, 0, "InitSendBuf_int16 error 0x%X for %s (LSG %d, FCTID %d)", errorCode, NODE_NAME, LSGID, fctID);
}

InitSendBuf_int32 (byte fctID, dword data)
{
    dword request[6];
    byte errorCode;
    byte  InitSend_data[1];

    request [0]= LSGID;
    request [1]= fctID;
    request [3]= Bap_uint32;
    request [5]= data;

    errorCode=BAP150_InitSendBuf(NODE_INDEX,request,InitSend_data);
    
    if(errorCode)
        writelineEx(gError_Trace, 0, "InitSendBuf_int32 error 0x%X for %s (LSG %d, FCTID %d)", errorCode, NODE_NAME, LSGID, fctID);
}

InitSendBuf_byteSequence (byte fctID, byte data[], word length)
{
    dword request[6];
    byte errorCode;

    request [0]= LSGID;
    request [1]= fctID;
    request [3]= Bap_uint32;
    request [4]= length;

    errorCode=BAP150_InitSendBuf(NODE_INDEX,request,data);
    
    if(errorCode)
        writelineEx(gError_Trace, 0, "InitSendBuf_byteSequence error 0x%X for %s (LSG %d, FCTID %d)", errorCode, NODE_NAME, LSGID, fctID);
}

DisplayRequestErrorCode(dword fctID, dword errCode)
{
       switch(fctID)
   {
       case C_FSG_41_0_0_1_ID:
           gC_FSG_41_0_0_1_ErrCode = 0;
           putValue(C_FSG_41_0_0_1_ErrCode,  errCode);
           setControlBackColor(panel_name,"errfield_C_FSG_41_0_0_1", MakeRGB(255,79,79));
       break;
       case P_FSG_41_0_0_2_ID:
           gP_FSG_41_0_0_2_ErrCode = 0;
           putValue(P_FSG_41_0_0_2_ErrCode,  errCode);
           setControlBackColor(panel_name,"errfield_P_FSG_41_0_0_2", MakeRGB(255,79,79));
       break;
       case P_FSG_41_0_0_3_ID:
           gP_FSG_41_0_0_3_ErrCode = 0;
           putValue(P_FSG_41_0_0_3_ErrCode,  errCode);
           setControlBackColor(panel_name,"errfield_P_FSG_41_0_0_3", MakeRGB(255,79,79));
       break;
       case P_FSG_41_0_0_4_ID:
           gP_FSG_41_0_0_4_ErrCode = 0;
           putValue(P_FSG_41_0_0_4_ErrCode,  errCode);
           setControlBackColor(panel_name,"errfield_P_FSG_41_0_0_4", MakeRGB(255,79,79));
       break;
       case P_FSG_41_0_0_14_ID:
           gP_FSG_41_0_0_14_ErrCode = 0;
           putValue(P_FSG_41_0_0_14_ErrCode,  errCode);
           setControlBackColor(panel_name,"errfield_P_FSG_41_0_0_14", MakeRGB(255,79,79));
       break;
       case P_FSG_41_0_0_15_ID:
           gP_FSG_41_0_0_15_ErrCode = 0;
           putValue(P_FSG_41_0_0_15_ErrCode,  errCode);
           setControlBackColor(panel_name,"errfield_P_FSG_41_0_0_15", MakeRGB(255,79,79));
       break;
       case P_FSG_41_0_0_16_ID:
           gP_FSG_41_0_0_16_ErrCode = 0;
           putValue(P_FSG_41_0_0_16_ErrCode,  errCode);
           setControlBackColor(panel_name,"errfield_P_FSG_41_0_0_16", MakeRGB(255,79,79));
       break;
       case P_FSG_41_0_0_17_ID:
           gP_FSG_41_0_0_17_ErrCode = 0;
           putValue(P_FSG_41_0_0_17_ErrCode,  errCode);
           setControlBackColor(panel_name,"errfield_P_FSG_41_0_0_17", MakeRGB(255,79,79));
       break;
       case P_FSG_41_0_0_18_ID:
           gP_FSG_41_0_0_18_ErrCode = 0;
           putValue(P_FSG_41_0_0_18_ErrCode,  errCode);
           setControlBackColor(panel_name,"errfield_P_FSG_41_0_0_18", MakeRGB(255,79,79));
       break;
       case P_FSG_41_0_0_19_ID:
           gP_FSG_41_0_0_19_ErrCode = 0;
           putValue(P_FSG_41_0_0_19_ErrCode,  errCode);
           setControlBackColor(panel_name,"errfield_P_FSG_41_0_0_19", MakeRGB(255,79,79));
       break;
       case P_FSG_41_0_0_20_ID:
           gP_FSG_41_0_0_20_ErrCode = 0;
           putValue(P_FSG_41_0_0_20_ErrCode,  errCode);
           setControlBackColor(panel_name,"errfield_P_FSG_41_0_0_20", MakeRGB(255,79,79));
       break;
       case P_FSG_41_0_0_21_ID:
           gP_FSG_41_0_0_21_ErrCode = 0;
           putValue(P_FSG_41_0_0_21_ErrCode,  errCode);
           setControlBackColor(panel_name,"errfield_P_FSG_41_0_0_21", MakeRGB(255,79,79));
       break;
       case P_FSG_41_0_0_22_ID:
           gP_FSG_41_0_0_22_ErrCode = 0;
           putValue(P_FSG_41_0_0_22_ErrCode,  errCode);
           setControlBackColor(panel_name,"errfield_P_FSG_41_0_0_22", MakeRGB(255,79,79));
       break;
       case P_FSG_41_0_0_23_ID:
           gP_FSG_41_0_0_23_ErrCode = 0;
           putValue(P_FSG_41_0_0_23_ErrCode,  errCode);
           setControlBackColor(panel_name,"errfield_P_FSG_41_0_0_23", MakeRGB(255,79,79));
       break;
       case P_FSG_41_0_0_24_ID:
           gP_FSG_41_0_0_24_ErrCode = 0;
           putValue(P_FSG_41_0_0_24_ErrCode,  errCode);
           setControlBackColor(panel_name,"errfield_P_FSG_41_0_0_24", MakeRGB(255,79,79));
       break;
       case P_FSG_41_0_0_25_ID:
           gP_FSG_41_0_0_25_ErrCode = 0;
           putValue(P_FSG_41_0_0_25_ErrCode,  errCode);
           setControlBackColor(panel_name,"errfield_P_FSG_41_0_0_25", MakeRGB(255,79,79));
       break;
       case P_FSG_41_0_0_26_ID:
           gP_FSG_41_0_0_26_ErrCode = 0;
           putValue(P_FSG_41_0_0_26_ErrCode,  errCode);
           setControlBackColor(panel_name,"errfield_P_FSG_41_0_0_26", MakeRGB(255,79,79));
       break;
       case P_FSG_41_0_0_27_ID:
           gP_FSG_41_0_0_27_ErrCode = 0;
           putValue(P_FSG_41_0_0_27_ErrCode,  errCode);
           setControlBackColor(panel_name,"errfield_P_FSG_41_0_0_27", MakeRGB(255,79,79));
       break;
       case P_FSG_41_0_0_28_ID:
           gP_FSG_41_0_0_28_ErrCode = 0;
           putValue(P_FSG_41_0_0_28_ErrCode,  errCode);
           setControlBackColor(panel_name,"errfield_P_FSG_41_0_0_28", MakeRGB(255,79,79));
       break;
       case P_FSG_41_0_0_29_ID:
           gP_FSG_41_0_0_29_ErrCode = 0;
           putValue(P_FSG_41_0_0_29_ErrCode,  errCode);
           setControlBackColor(panel_name,"errfield_P_FSG_41_0_0_29", MakeRGB(255,79,79));
       break;
       case P_FSG_41_0_0_30_ID:
           gP_FSG_41_0_0_30_ErrCode = 0;
           putValue(P_FSG_41_0_0_30_ErrCode,  errCode);
           setControlBackColor(panel_name,"errfield_P_FSG_41_0_0_30", MakeRGB(255,79,79));
       break;
       case P_FSG_41_0_0_31_ID:
           gP_FSG_41_0_0_31_ErrCode = 0;
           putValue(P_FSG_41_0_0_31_ErrCode,  errCode);
           setControlBackColor(panel_name,"errfield_P_FSG_41_0_0_31", MakeRGB(255,79,79));
       break;
       case P_FSG_41_0_0_32_ID:
           gP_FSG_41_0_0_32_ErrCode = 0;
           putValue(P_FSG_41_0_0_32_ErrCode,  errCode);
           setControlBackColor(panel_name,"errfield_P_FSG_41_0_0_32", MakeRGB(255,79,79));
       break;
       case M_FSG_41_0_0_33_ID:
           gM_FSG_41_0_0_33_ErrCode = 0;
           putValue(M_FSG_41_0_0_33_ErrCode,  errCode);
           setControlBackColor(panel_name,"errfield_M_FSG_41_0_0_33", MakeRGB(255,79,79));
           putValue(M_FSG_41_0_0_33_State,  "ReqErr");
       break;
       case P_FSG_41_0_0_34_ID:
           gP_FSG_41_0_0_34_ErrCode = 0;
           putValue(P_FSG_41_0_0_34_ErrCode,  errCode);
           setControlBackColor(panel_name,"errfield_P_FSG_41_0_0_34", MakeRGB(255,79,79));
       break;
       case P_FSG_41_0_0_35_ID:
           gP_FSG_41_0_0_35_ErrCode = 0;
           putValue(P_FSG_41_0_0_35_ErrCode,  errCode);
           setControlBackColor(panel_name,"errfield_P_FSG_41_0_0_35", MakeRGB(255,79,79));
       break;
       case P_FSG_41_0_0_36_ID:
           gP_FSG_41_0_0_36_ErrCode = 0;
           putValue(P_FSG_41_0_0_36_ErrCode,  errCode);
           setControlBackColor(panel_name,"errfield_P_FSG_41_0_0_36", MakeRGB(255,79,79));
       break;
       case P_FSG_41_0_0_37_ID:
           gP_FSG_41_0_0_37_ErrCode = 0;
           putValue(P_FSG_41_0_0_37_ErrCode,  errCode);
           setControlBackColor(panel_name,"errfield_P_FSG_41_0_0_37", MakeRGB(255,79,79));
       break;
       case P_FSG_41_0_0_38_ID:
           gP_FSG_41_0_0_38_ErrCode = 0;
           putValue(P_FSG_41_0_0_38_ErrCode,  errCode);
           setControlBackColor(panel_name,"errfield_P_FSG_41_0_0_38", MakeRGB(255,79,79));
       break;
       case P_FSG_41_0_0_39_ID:
           gP_FSG_41_0_0_39_ErrCode = 0;
           putValue(P_FSG_41_0_0_39_ErrCode,  errCode);
           setControlBackColor(panel_name,"errfield_P_FSG_41_0_0_39", MakeRGB(255,79,79));
       break;
       case P_FSG_41_0_0_40_ID:
           gP_FSG_41_0_0_40_ErrCode = 0;
           putValue(P_FSG_41_0_0_40_ErrCode,  errCode);
           setControlBackColor(panel_name,"errfield_P_FSG_41_0_0_40", MakeRGB(255,79,79));
       break;
       case P_FSG_41_0_0_41_ID:
           gP_FSG_41_0_0_41_ErrCode = 0;
           putValue(P_FSG_41_0_0_41_ErrCode,  errCode);
           setControlBackColor(panel_name,"errfield_P_FSG_41_0_0_41", MakeRGB(255,79,79));
       break;
       case P_FSG_41_0_0_42_ID:
           gP_FSG_41_0_0_42_ErrCode = 0;
           putValue(P_FSG_41_0_0_42_ErrCode,  errCode);
           setControlBackColor(panel_name,"errfield_P_FSG_41_0_0_42", MakeRGB(255,79,79));
       break;
       case P_FSG_41_0_0_43_ID:
           gP_FSG_41_0_0_43_ErrCode = 0;
           putValue(P_FSG_41_0_0_43_ErrCode,  errCode);
           setControlBackColor(panel_name,"errfield_P_FSG_41_0_0_43", MakeRGB(255,79,79));
       break;
       case P_FSG_41_0_0_44_ID:
           gP_FSG_41_0_0_44_ErrCode = 0;
           putValue(P_FSG_41_0_0_44_ErrCode,  errCode);
           setControlBackColor(panel_name,"errfield_P_FSG_41_0_0_44", MakeRGB(255,79,79));
       break;
       case P_FSG_41_0_0_45_ID:
           gP_FSG_41_0_0_45_ErrCode = 0;
           putValue(P_FSG_41_0_0_45_ErrCode,  errCode);
           setControlBackColor(panel_name,"errfield_P_FSG_41_0_0_45", MakeRGB(255,79,79));
       break;
       case M_FSG_41_0_0_46_ID:
           gM_FSG_41_0_0_46_ErrCode = 0;
           putValue(M_FSG_41_0_0_46_ErrCode,  errCode);
           setControlBackColor(panel_name,"errfield_M_FSG_41_0_0_46", MakeRGB(255,79,79));
           putValue(M_FSG_41_0_0_46_State,  "ReqErr");
       break;
       case P_FSG_41_0_0_47_ID:
           gP_FSG_41_0_0_47_ErrCode = 0;
           putValue(P_FSG_41_0_0_47_ErrCode,  errCode);
           setControlBackColor(panel_name,"errfield_P_FSG_41_0_0_47", MakeRGB(255,79,79));
       break;
       case M_FSG_41_0_0_48_ID:
           gM_FSG_41_0_0_48_ErrCode = 0;
           putValue(M_FSG_41_0_0_48_ErrCode,  errCode);
           setControlBackColor(panel_name,"errfield_M_FSG_41_0_0_48", MakeRGB(255,79,79));
           putValue(M_FSG_41_0_0_48_State,  "ReqErr");
       break;
       case P_FSG_41_0_0_49_ID:
           gP_FSG_41_0_0_49_ErrCode = 0;
           putValue(P_FSG_41_0_0_49_ErrCode,  errCode);
           setControlBackColor(panel_name,"errfield_P_FSG_41_0_0_49", MakeRGB(255,79,79));
       break;
       case P_FSG_41_0_0_50_ID:
           gP_FSG_41_0_0_50_ErrCode = 0;
           putValue(P_FSG_41_0_0_50_ErrCode,  errCode);
           setControlBackColor(panel_name,"errfield_P_FSG_41_0_0_50", MakeRGB(255,79,79));
       break;
       case A_FSG_41_0_0_51_ID:
           gA_FSG_41_0_0_51_ErrCode = 0;
           putValue(A_FSG_41_0_0_51_ErrCode,  errCode);
           setControlBackColor(panel_name,"errfield_A_FSG_41_0_0_51", MakeRGB(255,79,79));
       break;
       default:
           writelineEx(gError_Trace, 0, "%s%d/%d Unknown Functionid in  displayErrorCode", SGtype, LSGID,fctID);
   }

}

BAP_DLL_Request ()
{
    int i;
    int l=0;
    byte temp;
    byte Request_data[4096];    //Request data for DLL
    dword Request_header[6];    //Request header for DLL
    byte dataValid;
    int nextElementToRead;
    
    // defaultmaessig ist senden OK
    dataValid = 1;

    // loeschen der Daten "Container"
    for(i=0;i<6;i++)
        Request_header[i]=0;
    for(i=0;i<BAP_buffer_size;i++)
        Request_data[i]=0;

    
    // Verarbeiten aller noch offenen Requests  
    while ((nextElementToRead = getNextReadIndex()) != -1) 
    {
        // Fuer alle Datentypen gleich
        Request_header[0]=gBAP_Request_header [nextElementToRead][0];       //LSG-ID
        Request_header[1]=gBAP_Request_header [nextElementToRead][1];       //Function-ID
        Request_header[2]=gBAP_Request_header [nextElementToRead][2];       //request type
        Request_header[3]=gBAP_Request_header [nextElementToRead][3];       //BAP data type

        switch(gBAP_Request_header[nextElementToRead][3]){
            case Bap_uint32:
                l=2;
            case Bap_uint16:
                l++;
            case Bap_uint8:
            case Bap_error: // Request (2) wird dabei ignoriert
                l++;
            case Bap_void:  // Datenfeld (5) wird dabei ignoriert
                Request_header[4]=l;                                                //  not used
                Request_header[5]=gBAP_Request_header [nextElementToRead][5];       // Daten
            break;
            case Bap_byteSequence:                                  
                Request_header[4]=gBAP_Request_header [nextElementToRead][4];       // length
                Request_header[5]=0;                                                // not used

                // data-array for BAP-DLL funcion 'BAP_Request'
                for(i=0;i<BAP_buffer_size;i++)
                    Request_data[i]=gBAP_Request_data [nextElementToRead][i];
                break;          
            default:
                writelineEx(gError_Trace, 0, "BAP_DLL_Request: invalid BAP-Data-Type: %d", gBAP_Request_header[nextElementToRead][3]);
                dataValid = 0;
            break;          
        }
        
        if(dataValid){
            // wie heisst der Request?
            writelineEx(gBAP_Trace, 0, "%s%d/%d BAP_Request %s datatype:%s length:%d", SGtype, Request_header[0],Request_header[1],Requesttype_Text[Request_header[2]],Datatype_Text[Request_header[3]],Request_header[4]);
            temp = BAP150_Request(NODE_INDEX, Request_header, Request_data);    //send data to BAP-DLL  
            // BAP-Request failed
            if(temp != 0){
                // Fehlercode: Request failed
                writelineEx(gError_Trace, 0, "%s%d/%d Error during BAP_Request errorcode: 0x%X", SGtype, Request_header[0],Request_header[1],temp);
                DisplayRequestErrorCode(Request_header[1],temp);
            } 
        }

    }
} 

int getNextReadIndex ()
{
	int i, ret;
	// der Puffer wird nach dem naechsten zu lesenden Eintrag durchsucht
	// Existiert keiner wird -1 zurueckgegeben
	ret = -1;

	for (i = 0; i < Requestbuffer_lines; i++)
	{
		if (gBAP_Requestbuffer_status[i] == 1)
		{
			// zum verschicken
			ret = i;
			// und wieder freigeben
			gBAP_Requestbuffer_status[i] = 0;
			break;
		}
	}

	return (ret);
}

int getNextWriteIndex ()
{
	int i, ret;
	// der Puffer wird nach dem naechsten freien Eintrag durchsucht
	// Existiert keiner wird -1 zurueckgegeben
	ret = -1;

	for (i = 0; i < Requestbuffer_lines; i++)
	{
		if (gBAP_Requestbuffer_status[i] == 0)
		{
			// zum schreiben
			ret = i;
			// belegen
			gBAP_Requestbuffer_status[i] = 1;
			break;
		}
	}

	return (ret);
}

//gBAP_Indication_header[0])  // LSGID
//gBAP_Indication_header[1]) // FCTID
//gBAP_Indication_header[2]) // IndType
//gBAP_Indication_header[3]) // Datentyp

M_FSG_41_0_0_48_ProcessingRequest ()
{
   byte temp[BAP_buffer_size];
   getValue(M_FSG_41_0_0_48_Processing, temp);
   Request_byteSequence(LSGID, M_FSG_41_0_0_48_ID, Processing_REQ, temp, getValueSize(M_FSG_41_0_0_48_Processing));
}
M_FSG_41_0_0_46_ProcessingRequest ()
{
   byte temp[BAP_buffer_size];
   getValue(M_FSG_41_0_0_46_Processing, temp);
   Request_byteSequence(LSGID, M_FSG_41_0_0_46_ID, Processing_REQ, temp, getValueSize(M_FSG_41_0_0_46_Processing));
}
M_FSG_41_0_0_33_ProcessingRequest ()
{
   byte temp[BAP_buffer_size];
   getValue(M_FSG_41_0_0_33_Processing, temp);
   Request_byteSequence(LSGID, M_FSG_41_0_0_33_ID, Processing_REQ, temp, getValueSize(M_FSG_41_0_0_33_Processing));
}


Process_Current_Indication ()
{
   int rxsize;
   int txsize;
   byte temp[BAP_buffer_size];
   char buffer[BAP_buffer_size];
   int telNumberLength;
   char telNumber[40];
   int i,length;
   if(strncmp(Datatype_Text[gBAP_Indication_header[3]], "acknowledge", 4)!=0) 
       writelineEx(gBAP_Trace, 0, "NodeIndex: %d: CurrentIndication %s lsgid:%d fctid:%d indType:%s dataType=%s length=%d",
               NODE_INDEX, SGtype, gBAP_Indication_header[0], gBAP_Indication_header[1], Indicationtype_Text[gBAP_Indication_header[2]], Datatype_Text[gBAP_Indication_header[3]], gBAP_Indication_header[4]);
   else 
       writelineEx(gBAP_Trace, 0, "Internal acknowledge %s-%d fctid:%d indType:%s dataType=%s length=%d",
               SGtype, gBAP_Indication_header[0], gBAP_Indication_header[1], Acknowledgetype_Text[gBAP_Indication_header[5]], Datatype_Text[gBAP_Indication_header[3]], gBAP_Indication_header[4]);
   switch(gBAP_Indication_header[0])  // LSGID
   {
   case LSGID:
       switch(gBAP_Indication_header[1]) // FCTID
       {
    case P_FSG_41_0_0_14_ID: 
        switch(gBAP_Indication_header[3]) // Datentyp 
        {
            case Bap_error:
                gP_FSG_41_0_0_14_ErrCode = 0;
                setControlBackColor(panel_name, "errfield_P_FSG_41_0_0_14", MakeRGB(255,79,79));  
                gP_FSG_41_0_0_14_ErrCode = 1;
                break;
            case Bap_acknowledge:
                break;
            default:
                PrintIndicationError("Illegal DataType");
                break;
        }
    break;
    case P_FSG_41_0_0_15_ID: 
        switch(gBAP_Indication_header[3]) // Datentyp 
        {
            case Bap_error:
                gP_FSG_41_0_0_15_ErrCode = 0;
                setControlBackColor(panel_name, "errfield_P_FSG_41_0_0_15", MakeRGB(255,79,79));  
                gP_FSG_41_0_0_15_ErrCode = 1;
                break;
            case Bap_acknowledge:
                break;
            default:
                PrintIndicationError("Illegal DataType");
                break;
        }
    break;
    case P_FSG_41_0_0_16_ID: 
        switch(gBAP_Indication_header[3]) // Datentyp 
        {
            case Bap_error:
                gP_FSG_41_0_0_16_ErrCode = 0;
                setControlBackColor(panel_name, "errfield_P_FSG_41_0_0_16", MakeRGB(255,79,79));  
                gP_FSG_41_0_0_16_ErrCode = 1;
                break;
            case Bap_acknowledge:
                break;
            default:
                PrintIndicationError("Illegal DataType");
                break;
        }
    break;
    case P_FSG_41_0_0_17_ID: 
        switch(gBAP_Indication_header[3]) // Datentyp 
        {
            case Bap_error:
                gP_FSG_41_0_0_17_ErrCode = 0;
                setControlBackColor(panel_name, "errfield_P_FSG_41_0_0_17", MakeRGB(255,79,79));  
                gP_FSG_41_0_0_17_ErrCode = 1;
                break;
            case Bap_acknowledge:
                break;
            default:
                PrintIndicationError("Illegal DataType");
                break;
        }
    break;
    case P_FSG_41_0_0_18_ID: 
        switch(gBAP_Indication_header[3]) // Datentyp 
        {
            case Bap_error:
                gP_FSG_41_0_0_18_ErrCode = 0;
                setControlBackColor(panel_name, "errfield_P_FSG_41_0_0_18", MakeRGB(255,79,79));  
                gP_FSG_41_0_0_18_ErrCode = 1;
                break;
            case Bap_acknowledge:
                break;
            default:
                PrintIndicationError("Illegal DataType");
                break;
        }
    break;
    case P_FSG_41_0_0_19_ID: 
        switch(gBAP_Indication_header[3]) // Datentyp 
        {
            case Bap_error:
                gP_FSG_41_0_0_19_ErrCode = 0;
                setControlBackColor(panel_name, "errfield_P_FSG_41_0_0_19", MakeRGB(255,79,79));  
                gP_FSG_41_0_0_19_ErrCode = 1;
                break;
            case Bap_acknowledge:
                break;
            default:
                PrintIndicationError("Illegal DataType");
                break;
        }
    break;
    case P_FSG_41_0_0_20_ID: 
        switch(gBAP_Indication_header[3]) // Datentyp 
        {
            case Bap_error:
                gP_FSG_41_0_0_20_ErrCode = 0;
                setControlBackColor(panel_name, "errfield_P_FSG_41_0_0_20", MakeRGB(255,79,79));  
                gP_FSG_41_0_0_20_ErrCode = 1;
                break;
            case Bap_acknowledge:
                break;
            default:
                PrintIndicationError("Illegal DataType");
                break;
        }
    break;
    case P_FSG_41_0_0_21_ID: 
        switch(gBAP_Indication_header[3]) // Datentyp 
        {
            case Bap_error:
                gP_FSG_41_0_0_21_ErrCode = 0;
                setControlBackColor(panel_name, "errfield_P_FSG_41_0_0_21", MakeRGB(255,79,79));  
                gP_FSG_41_0_0_21_ErrCode = 1;
                break;
            case Bap_acknowledge:
                break;
            default:
                PrintIndicationError("Illegal DataType");
                break;
        }
    break;
    case P_FSG_41_0_0_22_ID: 
        switch(gBAP_Indication_header[3]) // Datentyp 
        {
            case Bap_error:
                gP_FSG_41_0_0_22_ErrCode = 0;
                setControlBackColor(panel_name, "errfield_P_FSG_41_0_0_22", MakeRGB(255,79,79));  
                gP_FSG_41_0_0_22_ErrCode = 1;
                break;
            case Bap_acknowledge:
                break;
            default:
                PrintIndicationError("Illegal DataType");
                break;
        }
    break;
    case P_FSG_41_0_0_23_ID: 
        switch(gBAP_Indication_header[3]) // Datentyp 
        {
            case Bap_error:
                gP_FSG_41_0_0_23_ErrCode = 0;
                setControlBackColor(panel_name, "errfield_P_FSG_41_0_0_23", MakeRGB(255,79,79));  
                gP_FSG_41_0_0_23_ErrCode = 1;
                break;
            case Bap_acknowledge:
                break;
            default:
                PrintIndicationError("Illegal DataType");
                break;
        }
    break;
    case P_FSG_41_0_0_24_ID: 
        switch(gBAP_Indication_header[3]) // Datentyp 
        {
            case Bap_byteSequence:
                switch (gBAP_Indication_header[2]) // IndType
                {
                    case DataSet_IND: // Indicationtyp pruefen
                       if (getValue(P_FSG_41_0_0_24_ErrEn)) { 
                           Request_error(LSGID,P_FSG_41_0_0_24_ID,getValue(P_FSG_41_0_0_24_ErrCode)); 
                           break;
                        }
                        // Daten setzen
                        putValue(P_FSG_41_0_0_24, gBAP_Indication_data, gBAP_Indication_header[4]);
                        setControlBackColor(panel_name, "errfield_P_FSG_41_0_0_24", MakeRGB(255,255,255));  
                        break;
                    case DataSetGet_IND: // Indicationtyp pruefen
                       if (getValue(P_FSG_41_0_0_24_ErrEn)) { 
                           Request_error(LSGID,P_FSG_41_0_0_24_ID,getValue(P_FSG_41_0_0_24_ErrCode)); 
                           break;
                        }
                        // Daten setzen
						getValue(P_FSG_41_0_0_24, temp);
						gBAP_Indication_data[1]=temp[1];
						gBAP_Indication_data[3]=temp[3];
						gBAP_Indication_data[4]=temp[4];
                        putValue(P_FSG_41_0_0_24, gBAP_Indication_data, gBAP_Indication_header[4]);
                        setControlBackColor(panel_name, "errfield_P_FSG_41_0_0_24", MakeRGB(255,255,255));  
                        // und antworten
                        getValue(P_FSG_41_0_0_24, temp);
                        Request_byteSequence(LSGID, P_FSG_41_0_0_24_ID, Data_REQ, temp, gBAP_Indication_header[4]);
                        break;
                    default:
                            PrintIndicationError("Illegal IndType");
                        break;
                }
                break;
            case Bap_error:
                gP_FSG_41_0_0_24_ErrCode = 0;
                putValue(P_FSG_41_0_0_24_ErrCode,  gBAP_Indication_header[5]);
                setControlBackColor(panel_name, "errfield_P_FSG_41_0_0_24", MakeRGB(255,79,79));  
                gP_FSG_41_0_0_24_ErrCode = 1;
                break;
            case Bap_acknowledge:
                break;
            default:
                PrintIndicationError("Illegal DataType");
                break;
        }
    break;
    case P_FSG_41_0_0_25_ID: 
        switch(gBAP_Indication_header[3]) // Datentyp 
        {
            case Bap_error:
                gP_FSG_41_0_0_25_ErrCode = 0;
                setControlBackColor(panel_name, "errfield_P_FSG_41_0_0_25", MakeRGB(255,79,79));  
                gP_FSG_41_0_0_25_ErrCode = 1;
                break;
            case Bap_acknowledge:
                break;
            default:
                PrintIndicationError("Illegal DataType");
                break;
        }
    break;
    case P_FSG_41_0_0_26_ID: 
        switch(gBAP_Indication_header[3]) // Datentyp 
        {
            case Bap_error:
                gP_FSG_41_0_0_26_ErrCode = 0;
                setControlBackColor(panel_name, "errfield_P_FSG_41_0_0_26", MakeRGB(255,79,79));  
                gP_FSG_41_0_0_26_ErrCode = 1;
                break;
            case Bap_acknowledge:
                break;
            default:
                PrintIndicationError("Illegal DataType");
                break;
        }
    break;
    case P_FSG_41_0_0_27_ID: 
        switch(gBAP_Indication_header[3]) // Datentyp 
        {
            case Bap_error:
                gP_FSG_41_0_0_27_ErrCode = 0;
                setControlBackColor(panel_name, "errfield_P_FSG_41_0_0_27", MakeRGB(255,79,79));  
                gP_FSG_41_0_0_27_ErrCode = 1;
                break;
            case Bap_acknowledge:
                break;
            default:
                PrintIndicationError("Illegal DataType");
                break;
        }
    break;
    case P_FSG_41_0_0_28_ID: 
        switch(gBAP_Indication_header[3]) // Datentyp 
        {
            case Bap_error:
                gP_FSG_41_0_0_28_ErrCode = 0;
                setControlBackColor(panel_name, "errfield_P_FSG_41_0_0_28", MakeRGB(255,79,79));  
                gP_FSG_41_0_0_28_ErrCode = 1;
                break;
            case Bap_acknowledge:
                break;
            default:
                PrintIndicationError("Illegal DataType");
                break;
        }
    break;
    case P_FSG_41_0_0_29_ID: 
        switch(gBAP_Indication_header[3]) // Datentyp 
        {
            case Bap_error:
                gP_FSG_41_0_0_29_ErrCode = 0;
                setControlBackColor(panel_name, "errfield_P_FSG_41_0_0_29", MakeRGB(255,79,79));  
                gP_FSG_41_0_0_29_ErrCode = 1;
                break;
            case Bap_acknowledge:
                break;
            default:
                PrintIndicationError("Illegal DataType");
                break;
        }
    break;
    case P_FSG_41_0_0_30_ID: 
        switch(gBAP_Indication_header[3]) // Datentyp 
        {
            case Bap_error:
                gP_FSG_41_0_0_30_ErrCode = 0;
                setControlBackColor(panel_name, "errfield_P_FSG_41_0_0_30", MakeRGB(255,79,79));  
                gP_FSG_41_0_0_30_ErrCode = 1;
                break;
            case Bap_acknowledge:
                break;
            default:
                PrintIndicationError("Illegal DataType");
                break;
        }
    break;
    case P_FSG_41_0_0_31_ID: 
        switch(gBAP_Indication_header[3]) // Datentyp 
        {
            case Bap_error:
                gP_FSG_41_0_0_31_ErrCode = 0;
                setControlBackColor(panel_name, "errfield_P_FSG_41_0_0_31", MakeRGB(255,79,79));  
                gP_FSG_41_0_0_31_ErrCode = 1;
                break;
            case Bap_acknowledge:
                break;
            default:
                PrintIndicationError("Illegal DataType");
                break;
        }
    break;
    case P_FSG_41_0_0_32_ID: 
        switch(gBAP_Indication_header[3]) // Datentyp 
        {
            case Bap_error:
                gP_FSG_41_0_0_32_ErrCode = 0;
                setControlBackColor(panel_name, "errfield_P_FSG_41_0_0_32", MakeRGB(255,79,79));  
                gP_FSG_41_0_0_32_ErrCode = 1;
                break;
            case Bap_acknowledge:
                break;
            default:
                PrintIndicationError("Illegal DataType");
                break;
        }
    break;
    case M_FSG_41_0_0_33_ID: 
            switch(gBAP_Indication_header[3]) // Datentyp
            {
                case Bap_byteSequence:
                    switch (gBAP_Indication_header[2]) // IndType
                    {
                        case StartResult_IND: 
                            if (getValue(M_FSG_41_0_0_33_ErrEn)) { 
                               Request_error(LSGID,M_FSG_41_0_0_33_ID,getValue(M_FSG_41_0_0_33_ErrCode)); 
                               break;
                            }
                           // running
                            putValue(M_FSG_41_0_0_33_State, "Running");
                            // Daten setzen
                            putValue(M_FSG_41_0_0_33_Start, gBAP_Indication_data, gBAP_Indication_header[4]);
                           
                            
                            
                            // get call ID from Call Functions indication 
                            gcallID2 = gBAP_Indication_data[1] >>4;
                         
                           
                            telNumberLength = gBAP_Indication_data[4];
                            
                                for (i=0; i<telNumberLength; i++)
                                { 
                                  gDialTelNumber_string2[i]=gBAP_Indication_data[i+5];
                                  gDialTelNumber_data2[i]=gBAP_Indication_data[i+5];                              
                                }
                            
                            
                              if(gBAP_Indication_data[0] == 0x00 || gBAP_Indication_data[0] == 0x01) // if Start-Result - "Dial Number" or "DialService" received
                            {  
                              gcallID2 = searchFREEcallID2(dialing);
                              searchandSetNameNr2(gcallID2);
                             // setcallINFO();
                              settimer(setcallInfo2,10);
                             // setcallState();
                              settimer(setDIALcallState2,50);
                                                                  
                            }
                            
                             
                            if(gBAP_Indication_data[0] == 0x2) // if Start-Result - "Confirm emergency call" received
                            {
                               gcallID2 = searchFREEcallID2(dialing);
                               setcallType2(gcallID2,4); //4-emergency call // set "emergency call" call type //
                               setcallState2(gcallID2,dialing); // set "dialing" call state
                               sendCallStateStatus2();
//                               P_FSG_41_0_0_30_BuildFct();
//                               getValue(P_FSG_41_0_0_30, BAPTemp);
//                               Request_ByteSequence(LSGID, P_FSG_41_0_0_30_ID, Data_REQ, BAPTemp, getValueSize(P_FSG_41_0_0_30));                              
                            }
                            
                            
                            
                           if(gBAP_Indication_data[0] == 0x3) // if Start-Result - "Hang up" received
                            {
                              if (gcallID2 == 0xC)
                              {
                                for(i=0;i<7;i++)
                                    {															//check call-states for active call
                                			if(gCallState2[i]==active )
                                      {
                                        gcallID2=i;
                                        setcallState2(gcallID2,disconnecting);// set "disconecting " call state 
                                        sendCallStateStatus2();
                                      }
                                    }
                                settimer(disconnectingTimer_Methods2 ,1500);
                              }
                              else
                                {
                              setcallState2(gcallID2,disconnecting);// set "disconecting " call state                             
                              sendCallStateStatus2(); 
                              setTimer(disconnectingTimer2, 1500); // set "idle" call state after 1,5 seconds
                                }
                            }
                            
                             if(gBAP_Indication_data[0] == 0x4) // if Start-Result - "Accept Call" received
                            {  
                              
                              for(i=0;i<7;i++)
                                    {															//check call-states for incoming call
                                			if(gCallState2[i]==ringing_waiting )
                                			{
                                        gcallID2=i;
                                        setcallState2(gcallID2,active); // set " Active " call state
                                        sendCallStateStatus2();
                                        gcallIDActive2=gcallID2; // store CallID for Active Call
//                                        P_FSG_41_0_0_30_BuildFct();
//                                        getValue(P_FSG_41_0_0_30, BAPTemp);
//                                        Request_ByteSequence(LSGID, P_FSG_41_0_0_30_ID, Data_REQ, BAPTemp, getValueSize(P_FSG_41_0_0_30));
                                		    break;
                                      }
                                    }  
                               
                            }
                          
                              if(gBAP_Indication_data[0] == 0x5) // if Start-Result - "Call Hold" received
                            {
                              for(i=0;i<7;i++){
		                            	if(gCallState2[i]==active)
                                  {                                    
                                     gcallID2 = i; 
                                     setcallState2(gcallID2,onhold); // set " on Hold " call state
                                     sendCallStateStatus2();
                                     break;
                                  }
                              }
                                                     
                            }
                            
                                if(gBAP_Indication_data[0] == 0x6) // if Start-Result - "Resume Call" received
                            {  
                               for(i=0;i<7;i++)
                              {
		                            	if(gCallState2[i]==onhold)
                                  {    
                                     gcallID2 = i; 
                                     setcallState2(gcallID2,active); // set " Active " call state  
                                     sendCallStateStatus2();
                                     gcallIDActive2=gcallID2; // store CallID for Active Call

                                     break;
                                  }
                                }
                            }
                            
                                if(gBAP_Indication_data[0] == 0x7) // if Start-Result - "MPReleaseActiveCallAcceptWaitingCall" received
                            {
                            for(i=0;i<7;i++)
                            {  
                              if(gCallState2[i]==active)
                                  {                                    
                                     gcallID2 = i; 
                                     setcallState2(gcallID2,disconnecting); // set " on Hold " call state
                                     sendCallStateStatus2();
                                     setTimer(disconnectingTimer2, 1500); // set "idle" call state after 1,5 seconds
                                  }
                                  
                              if(gCallState2[i]==ringing_waiting)
                                  {                                    
                                     gcallID2 = i; 
                                     setcallState2(gcallID2,active); // set " Active " call state
                                     sendCallStateStatus2();
                                  }
                            }
                            
                            }
                            
                              
                                if(gBAP_Indication_data[0] == 0x8) // if Start-Result - "MPSwap" received ///nu gasesc in MSC
                            {                              
                               settimer(MPswapTimer2,500);
                            }
                            
                            
                                 if(gBAP_Indication_data[0] == 0x9) // if Start-Result - "MPCallHoldAcceptWaitingCall" received
                            {
                            for(i=0;i<7;i++)
                            {  
                              if(gCallState2[i]==active)
                                  {                                    
                                     gcallID2 = i; 
                                     setcallState2(gcallID2,onhold); // set " on Hold " call state
                                     sendCallStateStatus2();
                                  }
                              if(gCallState2[i]==ringing_waiting)
                                  {                                    
                                     gcallID2 = i; 
                                     setcallState2(gcallID2,active); // set " Active " call state
                                     sendCallStateStatus2();
                                  }
                            }
                                  
                            }
                            
//                               if(gBAP_Indication_data[0] == 0x0A) // if Start-Result - "MPReleaseAllCallsAcceptWaitingCall" received ///nu gasesc in MSC
//                            {
//                               putValue(P_FSG_41_0_0_30_1,5); // set " on hold " call state for call id 0 // de facut handling automat intre call id
//                               putValue(P_FSG_41_0_0_30_4,2); // set " idle " call state for call id 1
//                               P_FSG_41_0_0_30_BuildFct();
//                               getValue(P_FSG_41_0_0_30, BAPTemp);
//                               Request_ByteSequence(LSGID, P_FSG_41_0_0_30_ID, Data_REQ, BAPTemp, getValueSize(P_FSG_41_0_0_30));
//                            }
                            
//                                if(gBAP_Indication_data[0] == 0x0B) // if Start-Result - "MPSetWaitingCallOnHold" received ///nu gasesc in MSC
//                            {
//                               putValue(P_FSG_41_0_0_30_1,5); // set " on hold " call state for call id 0 // de facut handling automat intre call id
//                               putValue(P_FSG_41_0_0_30_4,2); // set " idle " call state for call id 1
//                               P_FSG_41_0_0_30_BuildFct();
//                               getValue(P_FSG_41_0_0_30, BAPTemp);
//                               Request_ByteSequence(LSGID, P_FSG_41_0_0_30_ID, Data_REQ, BAPTemp, getValueSize(P_FSG_41_0_0_30));
//                            }
                                  
                                if(gBAP_Indication_data[0] == 0x0C) // if Start-Result - "CCJoin" received 
                            {
          
                              for(i=0;i<7;i++)
                              {
		                            	if(gCallState2[i]==onhold)
                                  {    
                                     gcallID2 = i; 
                                     setcallType2(gcallID2,conferenceVoiceCall);
                                     setcallState2(gcallID2,active); // set " Active " call state
                                     sendCallStateStatus2();
                                     
                                  }
                                  
                                  if(gCallState2[i]==active)
                                  {    
                                     gcallID2 = i; 
                                     setcallType2(gcallID2,conferenceVoiceCall);
                                     setcallState2(gcallID2,active); // set " Active " call state
                                     sendCallStateStatus2();
                                  }
                              }
                              
//                               P_FSG_41_0_0_30_BuildFct();
//                               getValue(P_FSG_41_0_0_30, BAPTemp);
//                               Request_ByteSequence(LSGID, P_FSG_41_0_0_30_ID, Data_REQ, BAPTemp, getValueSize(P_FSG_41_0_0_30));
                            }                                
                                 
           //                       if(gBAP_Indication_data[0] == 0x0D) // if Start-Result - "CCSplit" received ///nu gasesc in MSC
//                            {
//                               putValue(P_FSG_41_0_0_30_1,5); // set " on hold " call state for call id 0 // de facut handling automat intre call id
//                               putValue(P_FSG_41_0_0_30_4,2); // set " idle " call state for call id 1
//                               P_FSG_41_0_0_30_BuildFct();
//                               getValue(P_FSG_41_0_0_30, BAPTemp);
//                               Request_ByteSequence(LSGID, P_FSG_41_0_0_30_ID, Data_REQ, BAPTemp, getValueSize(P_FSG_41_0_0_30));
//                            }                           
                            
                            
           //                       if(gBAP_Indication_data[0] == 0x0E) // if Start-Result - "SelectAudioSink" received ///nu gasesc in MSC
//                            {
//                               putValue(P_FSG_41_0_0_30_1,5); // set " on hold " call state for call id 0 // de facut handling automat intre call id
//                               putValue(P_FSG_41_0_0_30_4,2); // set " idle " call state for call id 1
//                               P_FSG_41_0_0_30_BuildFct();
//                               getValue(P_FSG_41_0_0_30, BAPTemp);
//                               Request_ByteSequence(LSGID, P_FSG_41_0_0_30_ID, Data_REQ, BAPTemp, getValueSize(P_FSG_41_0_0_30));
//                            } 
                                    
                          
           //                       if(gBAP_Indication_data[0] == 0x0F) // if Start-Result - "RejectCallWithMessage" received ///nu gasesc in MSC
//                            {
//                               putValue(P_FSG_41_0_0_30_1,5); // set " on hold " call state for call id 0 // de facut handling automat intre call id
//                               putValue(P_FSG_41_0_0_30_4,2); // set " idle " call state for call id 1
//                               P_FSG_41_0_0_30_BuildFct();
//                               getValue(P_FSG_41_0_0_30, BAPTemp);
//                               Request_ByteSequence(LSGID, P_FSG_41_0_0_30_ID, Data_REQ, BAPTemp, getValueSize(P_FSG_41_0_0_30));
//                            }    
                            setControlBackColor(panel_name, "errfield_M_FSG_41_0_0_33", MakeRGB(255,255,255));  
                            break;
                        case Start_IND:
                            if (getValue(M_FSG_41_0_0_33_ErrEn)) { 
                               Request_error(LSGID,M_FSG_41_0_0_33_ID,getValue(M_FSG_41_0_0_33_ErrCode)); 
                               break;
                            }
                            putValue(M_FSG_41_0_0_33_State, "Started");
                            // Daten setzen
                            putValue(M_FSG_41_0_0_33_Start, gBAP_Indication_data, gBAP_Indication_header[4]);
                            setControlBackColor(panel_name, "errfield_M_FSG_41_0_0_33", MakeRGB(255,255,255));  
                            break;
                        default:
                            PrintIndicationError("Illegal IndType");
                            break;
                    }
                    break;
              case Bap_void:
                    switch (gBAP_Indication_header[2]) // IndType
                    {
                        case AbortResult_IND:
                            putValue(M_FSG_41_0_0_33_State, "Aborted");
                            //if (getValue(M_FSG_41_0_0_33_ErrEn)) 
                            { 
                               // Fehler als Quittierung schicken
                               Request_Error(LSGID, M_FSG_41_0_0_33_ID, getValue(M_FSG_41_0_0_33_ErrCode));
                            }
                            break;
                        case Processing_CNF_IND:    
                            if (getValue(M_FSG_41_0_0_33_ErrEn)) { 
                               // Fehler als Quittierung schicken
                               Request_Error(LSGID, M_FSG_41_0_0_33_ID, getValue(M_FSG_41_0_0_33_ErrCode));
                               break;
                            }
                            // Processing schicken
                            //getValue(M_FSG_41_0_0_33_Processing, temp);
                            //Request_byteSequence(LSGID, M_FSG_41_0_0_33_ID, Processing_REQ, temp, getValueSize(M_FSG_41_0_0_33_Processing));
                            M_FSG_41_0_0_33_ProcessingRequest();
                            setControlBackColor(panel_name, "errfield_M_FSG_41_0_0_33", MakeRGB(255,255,255));  
                            break;
                        default:
                            PrintIndicationError("Illegal IndType");
                            break;
                    }
                    break;
            case Bap_error:
                gM_FSG_41_0_0_33_ErrCode = 0;
                putValue(M_FSG_41_0_0_33_ErrCode,  gBAP_Indication_header[5]);
                setControlBackColor(panel_name, "errfield_M_FSG_41_0_0_33", MakeRGB(255,79,79));  
                gM_FSG_41_0_0_33_ErrCode = 1;
                break;
            case Bap_acknowledge:
                break;
            default:
                    PrintIndicationError("Illegal DataType");
                    break;
            }
    break;
    case P_FSG_41_0_0_34_ID: 
        switch(gBAP_Indication_header[3]) // Datentyp 
        {
            case Bap_error:
                gP_FSG_41_0_0_34_ErrCode = 0;
                setControlBackColor(panel_name, "errfield_P_FSG_41_0_0_34", MakeRGB(255,79,79));  
                gP_FSG_41_0_0_34_ErrCode = 1;
                break;
            case Bap_acknowledge:
                break;
            default:
                PrintIndicationError("Illegal DataType");
                break;
        }
    break;
    case P_FSG_41_0_0_35_ID: 
        switch(gBAP_Indication_header[3]) // Datentyp 
        {
            case Bap_error:
                gP_FSG_41_0_0_35_ErrCode = 0;
                setControlBackColor(panel_name, "errfield_P_FSG_41_0_0_35", MakeRGB(255,79,79));  
                gP_FSG_41_0_0_35_ErrCode = 1;
                break;
            case Bap_acknowledge:
                break;
            default:
                PrintIndicationError("Illegal DataType");
                break;
        }
    break;
    case P_FSG_41_0_0_36_ID: 
        switch(gBAP_Indication_header[3]) // Datentyp 
        {
            case Bap_error:
                gP_FSG_41_0_0_36_ErrCode = 0;
                setControlBackColor(panel_name, "errfield_P_FSG_41_0_0_36", MakeRGB(255,79,79));  
                gP_FSG_41_0_0_36_ErrCode = 1;
                break;
            case Bap_acknowledge:
                break;
            default:
                PrintIndicationError("Illegal DataType");
                break;
        }
    break;
    case P_FSG_41_0_0_37_ID: 
        switch(gBAP_Indication_header[3]) // Datentyp 
        {
            case Bap_error:
                gP_FSG_41_0_0_37_ErrCode = 0;
                setControlBackColor(panel_name, "errfield_P_FSG_41_0_0_37", MakeRGB(255,79,79));  
                gP_FSG_41_0_0_37_ErrCode = 1;
                break;
            case Bap_acknowledge:
                break;
            default:
                PrintIndicationError("Illegal DataType");
                break;
        }
    break;
    case P_FSG_41_0_0_38_ID: 
        switch(gBAP_Indication_header[3]) // Datentyp 
        {
            case Bap_error:
                gP_FSG_41_0_0_38_ErrCode = 0;
                setControlBackColor(panel_name, "errfield_P_FSG_41_0_0_38", MakeRGB(255,79,79));  
                gP_FSG_41_0_0_38_ErrCode = 1;
                break;
            case Bap_acknowledge:
                break;
            default:
                PrintIndicationError("Illegal DataType");
                break;
        }
    break;
    case P_FSG_41_0_0_39_ID: 
        switch(gBAP_Indication_header[3]) // Datentyp 
        {
            case Bap_error:
                gP_FSG_41_0_0_39_ErrCode = 0;
                setControlBackColor(panel_name, "errfield_P_FSG_41_0_0_39", MakeRGB(255,79,79));  
                gP_FSG_41_0_0_39_ErrCode = 1;
                break;
            case Bap_acknowledge:
                break;
            default:
                PrintIndicationError("Illegal DataType");
                break;
        }
    break;
    case P_FSG_41_0_0_40_ID: 
        switch(gBAP_Indication_header[3]) // Datentyp 
        {
            case Bap_error:
                gP_FSG_41_0_0_40_ErrCode = 0;
                setControlBackColor(panel_name, "errfield_P_FSG_41_0_0_40", MakeRGB(255,79,79));  
                gP_FSG_41_0_0_40_ErrCode = 1;
                break;
            case Bap_acknowledge:
                break;
            default:
                PrintIndicationError("Illegal DataType");
                break;
        }
    break;
    case P_FSG_41_0_0_41_ID: 
        switch(gBAP_Indication_header[3]) // Datentyp 
        {
            case Bap_error:
                gP_FSG_41_0_0_41_ErrCode = 0;
                setControlBackColor(panel_name, "errfield_P_FSG_41_0_0_41", MakeRGB(255,79,79));  
                gP_FSG_41_0_0_41_ErrCode = 1;
                break;
            case Bap_acknowledge:
                break;
            default:
                PrintIndicationError("Illegal DataType");
                break;
        }
    break;
    case P_FSG_41_0_0_42_ID: 
        switch(gBAP_Indication_header[3]) // Datentyp 
        {
            case Bap_error:
                gP_FSG_41_0_0_42_ErrCode = 0;
                setControlBackColor(panel_name, "errfield_P_FSG_41_0_0_42", MakeRGB(255,79,79));  
                gP_FSG_41_0_0_42_ErrCode = 1;
                break;
            case Bap_acknowledge:
                break;
            default:
                PrintIndicationError("Illegal DataType");
                break;
        }
    break;
    case P_FSG_41_0_0_43_ID: 
        switch(gBAP_Indication_header[3]) // Datentyp 
        {
            case Bap_error:
                gP_FSG_41_0_0_43_ErrCode = 0;
                setControlBackColor(panel_name, "errfield_P_FSG_41_0_0_43", MakeRGB(255,79,79));  
                gP_FSG_41_0_0_43_ErrCode = 1;
                break;
            case Bap_acknowledge:
                break;
            default:
                PrintIndicationError("Illegal DataType");
                break;
        }
    break;
    case P_FSG_41_0_0_44_ID: 
        switch(gBAP_Indication_header[3]) // Datentyp 
        {
            case Bap_error:
                gP_FSG_41_0_0_44_ErrCode = 0;
                setControlBackColor(panel_name, "errfield_P_FSG_41_0_0_44", MakeRGB(255,79,79));  
                gP_FSG_41_0_0_44_ErrCode = 1;
                break;
            case Bap_acknowledge:
                break;
            default:
                PrintIndicationError("Illegal DataType");
                break;
        }
    break;
    case P_FSG_41_0_0_45_ID: 
        switch(gBAP_Indication_header[3]) // Datentyp 
        {
            case Bap_error:
                gP_FSG_41_0_0_45_ErrCode = 0;
                setControlBackColor(panel_name, "errfield_P_FSG_41_0_0_45", MakeRGB(255,79,79));  
                gP_FSG_41_0_0_45_ErrCode = 1;
                break;
            case Bap_acknowledge:
                break;
            default:
                PrintIndicationError("Illegal DataType");
                break;
        }
    break;
    case M_FSG_41_0_0_46_ID: 
            switch(gBAP_Indication_header[3]) // Datentyp
            {
                case Bap_byteSequence:
                    switch (gBAP_Indication_header[2]) // IndType
                    {
                        case StartResult_IND: 
                            if (getValue(M_FSG_41_0_0_46_ErrEn)) { 
                               Request_error(LSGID,M_FSG_41_0_0_46_ID,getValue(M_FSG_41_0_0_46_ErrCode)); 
                               break;
                            }
                           // running
                            putValue(M_FSG_41_0_0_46_State, "Running");
                            // Daten setzen
                            putValue(M_FSG_41_0_0_46_Start, gBAP_Indication_data, gBAP_Indication_header[4]);
                            setControlBackColor(panel_name, "errfield_M_FSG_41_0_0_46", MakeRGB(255,255,255));
                            
                            
                            
                                                        
                            // get call ID from Call Functions indication 
                            gcallID3 = gBAP_Indication_data[1] >>4;
                         
                           
                            telNumberLength = gBAP_Indication_data[4];
                            
                                for (i=0; i<telNumberLength; i++)
                                { 
                                  gDialTelNumber_string3[i]=gBAP_Indication_data[i+5];
                                  gDialTelNumber_data3[i]=gBAP_Indication_data[i+5];                              
                                }
                            
                            
                              if(gBAP_Indication_data[0] == 0x00 || gBAP_Indication_data[0] == 0x01) // if Start-Result - "Dial Number" or "DialService" received
                            {  
                              gcallID3 = searchFREEcallID3(dialing);
                              searchandSetNameNr3(gcallID3);
                             // setcallINFO();
                              settimer(setcallInfo3,10);
                             // setcallState();
                              settimer(setDIALcallState3,50);
                                                                  
                            }
                            
                             
                            if(gBAP_Indication_data[0] == 0x2) // if Start-Result - "Confirm emergency call" received
                            {
                               gcallID3 = searchFREEcallID3(dialing);
                               setcallType3(gcallID3,4); //4-emergency call // set "emergency call" call type //
                               setcallState3(gcallID3,dialing); // set "dialing" call state
                               sendCallStateStatus3();
//                               P_FSG_41_0_0_30_BuildFct();
//                               getValue(P_FSG_41_0_0_30, BAPTemp);
//                               Request_ByteSequence(LSGID, P_FSG_41_0_0_30_ID, Data_REQ, BAPTemp, getValueSize(P_FSG_41_0_0_30));                              
                            }
                            
                            
                            
                           if(gBAP_Indication_data[0] == 0x3) // if Start-Result - "Hang up" received
                            {
                              if (gcallID3 == 0xC)
                              {
                                for(i=0;i<7;i++)
                                    {															//check call-states for active call
                                			if(gCallState3[i]==active )
                                      {
                                        gcallID3=i;
                                        setcallState3(gcallID3,disconnecting);// set "disconecting " call state 
                                        sendCallStateStatus3();
                                      }
                                    }
                                settimer(disconnectingTimer_Methods3 ,1500);
                              }
                              else
                                {
                              setcallState3(gcallID3,disconnecting);// set "disconecting " call state                             
                              sendCallStateStatus3(); 
                              setTimer(disconnectingTimer3, 1500); // set "idle" call state after 1,5 seconds
                                }
                            }
                            
                             if(gBAP_Indication_data[0] == 0x4) // if Start-Result - "Accept Call" received
                            {  
                              
                              for(i=0;i<7;i++)
                                    {															//check call-states for incoming call
                                			if(gCallState3[i]==ringing_waiting )
                                			{
                                        gcallID3=i;
                                        setcallState3(gcallID3,active); // set " Active " call state
                                        sendCallStateStatus3();
                                        gcallIDActive3=gcallID3; // store CallID for Active Call
//                                        P_FSG_41_0_0_30_BuildFct();
//                                        getValue(P_FSG_41_0_0_30, BAPTemp);
//                                        Request_ByteSequence(LSGID, P_FSG_41_0_0_30_ID, Data_REQ, BAPTemp, getValueSize(P_FSG_41_0_0_30));
                                		    break;
                                      }
                                    }  
                               
                            }
                          
                              if(gBAP_Indication_data[0] == 0x5) // if Start-Result - "Call Hold" received
                            {
                              for(i=0;i<7;i++){
		                            	if(gCallState3[i]==active)
                                  {                                    
                                     gcallID3 = i; 
                                     setcallState3(gcallID3,onhold); // set " on Hold " call state
                                     sendCallStateStatus3();
                                     break;
                                  }
                              }
                                                     
                            }
                            
                                if(gBAP_Indication_data[0] == 0x6) // if Start-Result - "Resume Call" received
                            {  
                               for(i=0;i<7;i++)
                              {
		                            	if(gCallState3[i]==onhold)
                                  {    
                                     gcallID3 = i; 
                                     setcallState3(gcallID3,active); // set " Active " call state  
                                     sendCallStateStatus3();
                                     gcallIDActive3=gcallID3; // store CallID for Active Call

                                     break;
                                  }
                                }
                            }
                            
                                if(gBAP_Indication_data[0] == 0x7) // if Start-Result - "MPReleaseActiveCallAcceptWaitingCall" received
                            {
                            for(i=0;i<7;i++)
                            {  
                              if(gCallState3[i]==active)
                                  {                                    
                                     gcallID3 = i; 
                                     setcallState3(gcallID3,disconnecting); // set " on Hold " call state
                                     sendCallStateStatus3();
                                     setTimer(disconnectingTimer3, 1500); // set "idle" call state after 1,5 seconds
                                  }
                                  
                              if(gCallState3[i]==ringing_waiting)
                                  {                                    
                                     gcallID3 = i; 
                                     setcallState3(gcallID3,active); // set " Active " call state
                                     sendCallStateStatus3();
                                  }
                            }
                            
                            }
                            
                              
                                if(gBAP_Indication_data[0] == 0x8) // if Start-Result - "MPSwap" received ///nu gasesc in MSC
                            {                              
                               settimer(MPswapTimer3,500);
                            }
                            
                            
                                 if(gBAP_Indication_data[0] == 0x9) // if Start-Result - "MPCallHoldAcceptWaitingCall" received
                            {
                            for(i=0;i<7;i++)
                            {  
                              if(gCallState3[i]==active)
                                  {                                    
                                     gcallID3 = i; 
                                     setcallState3(gcallID3,onhold); // set " on Hold " call state
                                     sendCallStateStatus3();
                                  }
                              if(gCallState3[i]==ringing_waiting)
                                  {                                    
                                     gcallID3 = i; 
                                     setcallState3(gcallID3,active); // set " Active " call state
                                     sendCallStateStatus3();
                                  }
                            }
                                  
                            }
                            
//                               if(gBAP_Indication_data[0] == 0x0A) // if Start-Result - "MPReleaseAllCallsAcceptWaitingCall" received ///nu gasesc in MSC
//                            {
//                               putValue(P_FSG_41_0_0_30_1,5); // set " on hold " call state for call id 0 // de facut handling automat intre call id
//                               putValue(P_FSG_41_0_0_30_4,2); // set " idle " call state for call id 1
//                               P_FSG_41_0_0_30_BuildFct();
//                               getValue(P_FSG_41_0_0_30, BAPTemp);
//                               Request_ByteSequence(LSGID, P_FSG_41_0_0_30_ID, Data_REQ, BAPTemp, getValueSize(P_FSG_41_0_0_30));
//                            }
                            
//                                if(gBAP_Indication_data[0] == 0x0B) // if Start-Result - "MPSetWaitingCallOnHold" received ///nu gasesc in MSC
//                            {
//                               putValue(P_FSG_41_0_0_30_1,5); // set " on hold " call state for call id 0 // de facut handling automat intre call id
//                               putValue(P_FSG_41_0_0_30_4,2); // set " idle " call state for call id 1
//                               P_FSG_41_0_0_30_BuildFct();
//                               getValue(P_FSG_41_0_0_30, BAPTemp);
//                               Request_ByteSequence(LSGID, P_FSG_41_0_0_30_ID, Data_REQ, BAPTemp, getValueSize(P_FSG_41_0_0_30));
//                            }
                                  
                                if(gBAP_Indication_data[0] == 0x0C) // if Start-Result - "CCJoin" received 
                            {
          
                              for(i=0;i<7;i++)
                              {
		                            	if(gCallState3[i]==onhold)
                                  {    
                                     gcallID3 = i; 
                                     setcallType3(gcallID3,conferenceVoiceCall);
                                     setcallState3(gcallID3,active); // set " Active " call state
                                     sendCallStateStatus3();
                                     
                                  }
                                  
                                  if(gCallState3[i]==active)
                                  {    
                                     gcallID3 = i; 
                                     setcallType3(gcallID3,conferenceVoiceCall);
                                     setcallState3(gcallID3,active); // set " Active " call state
                                     sendCallStateStatus3();
                                  }
                              }
                              
//                               P_FSG_41_0_0_30_BuildFct();
//                               getValue(P_FSG_41_0_0_30, BAPTemp);
//                               Request_ByteSequence(LSGID, P_FSG_41_0_0_30_ID, Data_REQ, BAPTemp, getValueSize(P_FSG_41_0_0_30));
                            }                                
                                 
           //                       if(gBAP_Indication_data[0] == 0x0D) // if Start-Result - "CCSplit" received ///nu gasesc in MSC
//                            {
//                               putValue(P_FSG_41_0_0_30_1,5); // set " on hold " call state for call id 0 // de facut handling automat intre call id
//                               putValue(P_FSG_41_0_0_30_4,2); // set " idle " call state for call id 1
//                               P_FSG_41_0_0_30_BuildFct();
//                               getValue(P_FSG_41_0_0_30, BAPTemp);
//                               Request_ByteSequence(LSGID, P_FSG_41_0_0_30_ID, Data_REQ, BAPTemp, getValueSize(P_FSG_41_0_0_30));
//                            }                           
                            
                            
           //                       if(gBAP_Indication_data[0] == 0x0E) // if Start-Result - "SelectAudioSink" received ///nu gasesc in MSC
//                            {
//                               putValue(P_FSG_41_0_0_30_1,5); // set " on hold " call state for call id 0 // de facut handling automat intre call id
//                               putValue(P_FSG_41_0_0_30_4,2); // set " idle " call state for call id 1
//                               P_FSG_41_0_0_30_BuildFct();
//                               getValue(P_FSG_41_0_0_30, BAPTemp);
//                               Request_ByteSequence(LSGID, P_FSG_41_0_0_30_ID, Data_REQ, BAPTemp, getValueSize(P_FSG_41_0_0_30));
//                            } 
                                    
                          
           //                       if(gBAP_Indication_data[0] == 0x0F) // if Start-Result - "RejectCallWithMessage" received ///nu gasesc in MSC
//                            {
//                               putValue(P_FSG_41_0_0_30_1,5); // set " on hold " call state for call id 0 // de facut handling automat intre call id
//                               putValue(P_FSG_41_0_0_30_4,2); // set " idle " call state for call id 1
//                               P_FSG_41_0_0_30_BuildFct();
//                               getValue(P_FSG_41_0_0_30, BAPTemp);
//                               Request_ByteSequence(LSGID, P_FSG_41_0_0_30_ID, Data_REQ, BAPTemp, getValueSize(P_FSG_41_0_0_30));
//                            }    
                            
                            
                            
                            
                            setControlBackColor(panel_name, "errfield_M_FSG_41_0_0_46", MakeRGB(255,255,255));  
                            break;
                        case Start_IND:
                            if (getValue(M_FSG_41_0_0_46_ErrEn)) { 
                               Request_error(LSGID,M_FSG_41_0_0_46_ID,getValue(M_FSG_41_0_0_46_ErrCode)); 
                               break;
                            }
                            putValue(M_FSG_41_0_0_46_State, "Started");
                            // Daten setzen
                            putValue(M_FSG_41_0_0_46_Start, gBAP_Indication_data, gBAP_Indication_header[4]);
                            setControlBackColor(panel_name, "errfield_M_FSG_41_0_0_46", MakeRGB(255,255,255));  
                            break;
                        default:
                            PrintIndicationError("Illegal IndType");
                            break;
                    }
                    break;
              case Bap_void:
                    switch (gBAP_Indication_header[2]) // IndType
                    {
                        case AbortResult_IND:
                            putValue(M_FSG_41_0_0_46_State, "Aborted");
                            //if (getValue(M_FSG_41_0_0_46_ErrEn)) 
                            { 
                               // Fehler als Quittierung schicken
                               Request_Error(LSGID, M_FSG_41_0_0_46_ID, getValue(M_FSG_41_0_0_46_ErrCode));
                            }
                            break;
                        case Processing_CNF_IND:    
                            if (getValue(M_FSG_41_0_0_46_ErrEn)) { 
                               // Fehler als Quittierung schicken
                               Request_Error(LSGID, M_FSG_41_0_0_46_ID, getValue(M_FSG_41_0_0_46_ErrCode));
                               break;
                            }
                            // Processing schicken
                            //getValue(M_FSG_41_0_0_46_Processing, temp);
                            //Request_byteSequence(LSGID, M_FSG_41_0_0_46_ID, Processing_REQ, temp, getValueSize(M_FSG_41_0_0_46_Processing));
                            M_FSG_41_0_0_46_ProcessingRequest();
                            setControlBackColor(panel_name, "errfield_M_FSG_41_0_0_46", MakeRGB(255,255,255));  
                            break;
                        default:
                            PrintIndicationError("Illegal IndType");
                            break;
                    }
                    break;
            case Bap_error:
                gM_FSG_41_0_0_46_ErrCode = 0;
                putValue(M_FSG_41_0_0_46_ErrCode,  gBAP_Indication_header[5]);
                setControlBackColor(panel_name, "errfield_M_FSG_41_0_0_46", MakeRGB(255,79,79));  
                gM_FSG_41_0_0_46_ErrCode = 1;
                break;
            case Bap_acknowledge:
                break;
            default:
                    PrintIndicationError("Illegal DataType");
                    break;
            }
    break;
    case P_FSG_41_0_0_47_ID: 
        switch(gBAP_Indication_header[3]) // Datentyp 
        {
            case Bap_error:
                gP_FSG_41_0_0_47_ErrCode = 0;
                setControlBackColor(panel_name, "errfield_P_FSG_41_0_0_47", MakeRGB(255,79,79));  
                gP_FSG_41_0_0_47_ErrCode = 1;
                break;
            case Bap_acknowledge:
                break;
            default:
                PrintIndicationError("Illegal DataType");
                break;
        }
    break;
    case M_FSG_41_0_0_48_ID: 
            switch(gBAP_Indication_header[3]) // Datentyp
            {
                case Bap_uint8:
                    switch (gBAP_Indication_header[2]) // IndType
                    {
                        case StartResult_IND: 
                            if (getValue(M_FSG_41_0_0_48_ErrEn)) { 
                               Request_error(LSGID,M_FSG_41_0_0_48_ID,getValue(M_FSG_41_0_0_48_ErrCode)); 
                               break;
                            }
                           // running
                            putValue(M_FSG_41_0_0_48_State, "Running");
                            // Daten setzen
                            putValue(M_FSG_41_0_0_48_Start, gBAP_Indication_header[5]);
                            setControlBackColor(panel_name, "errfield_M_FSG_41_0_0_48", MakeRGB(255,255,255));  
                            break;
                        case Start_IND:
                            if (getValue(M_FSG_41_0_0_48_ErrEn)) { 
                               Request_error(LSGID,M_FSG_41_0_0_48_ID,getValue(M_FSG_41_0_0_48_ErrCode)); 
                               break;
                            }
                            putValue(M_FSG_41_0_0_48_State, "Started");
                            // Daten setzen
                            putValue(M_FSG_41_0_0_48_Start, gBAP_Indication_header[5]);
                            setControlBackColor(panel_name, "errfield_M_FSG_41_0_0_48", MakeRGB(255,255,255));  
                            break;
                        default:
                            PrintIndicationError("Illegal IndType");
                            break;
                    }
                    break;
              case Bap_void:
                    switch (gBAP_Indication_header[2]) // IndType
                    {
                        case AbortResult_IND:
                            putValue(M_FSG_41_0_0_48_State, "Aborted");
                            // Fehler als Quittierung schicken
                            //if (getValue(M_FSG_41_0_0_48_ErrEn)) 
                            { 
                               // Fehler als Quittierung schicken
                               Request_Error(LSGID, M_FSG_41_0_0_48_ID, getValue(M_FSG_41_0_0_48_ErrCode));
                            }
                            break;
                        case Processing_CNF_IND:    
                            if (getValue(M_FSG_41_0_0_48_ErrEn)) { 
                               // Fehler als Quittierung schicken
                               Request_Error(LSGID, M_FSG_41_0_0_48_ID, getValue(M_FSG_41_0_0_48_ErrCode));
                            }
                            // Processing schicken
                           //Request_Int8(LSGID, M_FSG_41_0_0_48_ID, Processing_REQ, getValue(M_FSG_41_0_0_48_Processing));
                            M_FSG_41_0_0_48_ProcessingRequest();
                            setControlBackColor(panel_name, "errfield_M_FSG_41_0_0_48", MakeRGB(255,255,255));  
                            break;
                        default:
                            PrintIndicationError("Illegal IndType");
                            break;
                    }
                    break;
            case Bap_error:
                gM_FSG_41_0_0_48_ErrCode = 0;
                putValue(M_FSG_41_0_0_48_ErrCode,  gBAP_Indication_header[5]);
                setControlBackColor(panel_name, "errfield_M_FSG_41_0_0_48", MakeRGB(255,79,79));  
                gM_FSG_41_0_0_48_ErrCode = 1;
                break;
            case Bap_acknowledge:
                break;
            default:
                    PrintIndicationError("Illegal DataType");
                    break;
            }
    break;
    case P_FSG_41_0_0_49_ID: 
        switch(gBAP_Indication_header[3]) // Datentyp 
        {
            case Bap_error:
                gP_FSG_41_0_0_49_ErrCode = 0;
                setControlBackColor(panel_name, "errfield_P_FSG_41_0_0_49", MakeRGB(255,79,79));  
                gP_FSG_41_0_0_49_ErrCode = 1;
                break;
            case Bap_acknowledge:
                break;
            default:
                PrintIndicationError("Illegal DataType");
                break;
        }
    break;
    case P_FSG_41_0_0_50_ID: 
        switch(gBAP_Indication_header[3]) // Datentyp 
        {
            case Bap_byteSequence:
                switch (gBAP_Indication_header[2]) // IndType
                {
                    case DataSet_IND: // Indicationtyp pruefen
                       if (getValue(P_FSG_41_0_0_50_ErrEn)) { 
                           Request_error(LSGID,P_FSG_41_0_0_50_ID,getValue(P_FSG_41_0_0_50_ErrCode)); 
                           break;
                        }
                        // Daten setzen
                        putValue(P_FSG_41_0_0_50, gBAP_Indication_data, gBAP_Indication_header[4]);
                        setControlBackColor(panel_name, "errfield_P_FSG_41_0_0_50", MakeRGB(255,255,255));  
                        break;
                    case DataSetGet_IND: // Indicationtyp pruefen
                       if (getValue(P_FSG_41_0_0_50_ErrEn)) { 
                           Request_error(LSGID,P_FSG_41_0_0_50_ID,getValue(P_FSG_41_0_0_50_ErrCode)); 
                           break;
                        }
                        // Daten setzen
                        putValue(P_FSG_41_0_0_50, gBAP_Indication_data, gBAP_Indication_header[4]);
                        setControlBackColor(panel_name, "errfield_P_FSG_41_0_0_50", MakeRGB(255,255,255));  
                        // und antworten
                        getValue(P_FSG_41_0_0_50, temp);
                        Request_byteSequence(LSGID, P_FSG_41_0_0_50_ID, Data_REQ, temp, gBAP_Indication_header[4]);
                        break;
                    default:
                            PrintIndicationError("Illegal IndType");
                        break;
                }
                break;
            case Bap_error:
                gP_FSG_41_0_0_50_ErrCode = 0;
                putValue(P_FSG_41_0_0_50_ErrCode,  gBAP_Indication_header[5]);
                setControlBackColor(panel_name, "errfield_P_FSG_41_0_0_50", MakeRGB(255,79,79));  
                gP_FSG_41_0_0_50_ErrCode = 1;
                break;
            case Bap_acknowledge:
                break;
            default:
                PrintIndicationError("Illegal DataType");
                break;
        }
    break;
    case A_FSG_41_0_0_51_ID: 
    switch(gBAP_Indication_header[3]) // Datentyp
    {
        case Bap_byteSequence:
            switch (gBAP_Indication_header[2]) // IndType
            {
                case DataSet_IND: // Indicationtyp pruefen
                    if (getValue(A_FSG_41_0_0_51_ErrEn)) { 
                               Request_error(LSGID,A_FSG_41_0_0_51_ID,getValue(A_FSG_41_0_0_51_ErrCode)); 
                               break;
                    }
                    // Daten setzen
                    //putValue(A_FSG_41_0_0_51_SetGet, gBAP_Indication_data, gBAP_Indication_header[4]);
                        A_FSG_41_0_0_51_SetInd();
                    setControlBackColor(panel_name, "errfield_A_FSG_41_0_0_51", MakeRGB(255,255,255));  
                    break;
                case DataGet_IND:
                    if (getValue(A_FSG_41_0_0_51_ErrEn)) { 
                               Request_error(LSGID,A_FSG_41_0_0_51_ID,getValue(A_FSG_41_0_0_51_ErrCode)); 
                               break;
                    }
                    // Daten setzen
                    //putValue(A_FSG_41_0_0_51_SetGet, gBAP_Indication_data, gBAP_Indication_header[4]);
                        A_FSG_41_0_0_51_GetInd();
                    setControlBackColor(panel_name, "errfield_A_FSG_41_0_0_51", MakeRGB(255,255,255));  
                    // und antworten
                    //getValue(A_FSG_41_0_0_51, temp);
                    //Request_byteSequence(LSGID, A_FSG_41_0_0_51_ID, Data_REQ, temp, getValueSize(A_FSG_41_0_0_51));
                    //Button fuer Status betaetigen => antwort status wird geschickt, code sparen
                    //putValue(A_FSG_41_0_0_51Status_BTN, 1);
                    //putValue(A_FSG_41_0_0_51Status_BTN, 0);
                    A_FSG_41_0_0_51_SendStatus();
                    break;
                case DataSetGet_IND: // Indicationtyp pruefen
                    if (getValue(A_FSG_41_0_0_51_ErrEn)) { 
                               Request_error(LSGID,A_FSG_41_0_0_51_ID,getValue(A_FSG_41_0_0_51_ErrCode)); 
                               break;
                    }
                    // Daten setzen
                    //putValue(A_FSG_41_0_0_51_SetGet, gBAP_Indication_data, gBAP_Indication_header[4]);
                        A_FSG_41_0_0_51_SetGetInd();
                    setControlBackColor(panel_name, "errfield_A_FSG_41_0_0_51", MakeRGB(255,255,255));  
                    // und antworten
                    //getValue(A_FSG_41_0_0_51, temp);
                    //Request_byteSequence(LSGID, A_FSG_41_0_0_51_ID, Data_REQ, temp, getValueSize(A_FSG_41_0_0_51));
                    //Button fuer Status betaetigen => antwort status wird geschickt, code sparen
                    //putValue(A_FSG_41_0_0_51Status_BTN, 1);
                    //putValue(A_FSG_41_0_0_51Status_BTN, 0);
                    A_FSG_41_0_0_51_SendStatus();
                    break;
                default:
                    PrintIndicationError("Illegal IndType");
                    break;
            }
            break;
            case Bap_error:
                gA_FSG_41_0_0_51_ErrCode = 0;
                putValue(A_FSG_41_0_0_51_ErrCode,  gBAP_Indication_header[5]);
                setControlBackColor(panel_name, "errfield_A_FSG_41_0_0_51", MakeRGB(255,79,79));  
                gA_FSG_41_0_0_51_ErrCode = 1;
                break;
            case Bap_acknowledge:
                break;
            default:
                PrintIndicationError("Illegal DataType");
                break;
        }
    break;
       default:
           writelineEx(gError_Trace, 0, "NodeIndex: %d: Illegal Fct: lsgid:%d fctid:%d indType:%d",
           NODE_INDEX, gBAP_Indication_header[0], gBAP_Indication_header[1], gBAP_Indication_header[2]);
           break;
       }
       break;
   default:
       writelineEx(gError_Trace, 0, "NodeIndex: %d: Illegal LSGID: lsgid:%d fctid:%d indType:%s", NODE_INDEX, gBAP_Indication_header[0], gBAP_Indication_header[1], Indicationtype_Text[gBAP_Indication_header[2]]);
       break;
   }
}


on message BAP_Telefon2_ASG_02
{
   int i, temp;
   byte RX_Data[64];            // received CAN-DATA
   dword RX_Header[4];         // received CAN-Header
   if(gSG_PowerOnOff==Power_on){
       if(this.msgChannel == 1){
           RX_Header[0]=1; /*BusType: 1=Can, 2=Lin, 3=Flexray, 4=Ethernet*/
           RX_Header[1]=1;
           RX_Header[2]=this.DataLength; // received length
           RX_Header[3]=this.ID;
           for (i=0; i<this.DataLength; i++) {
               RX_Data[i]=this.byte(i);
           }
		   
		   //MR61529 - start
        //temp=BAP180_SetRxData(NODE_INDEX,RX_Header,RX_Data);	
         switch ((RX_Data[1] & 0x0F))
        {
        //getAll
        case 1: //error
                if (getValue(C_FSG_41_0_0_0_1_ErrEn)==0x01)
                Request_error(LSGID,FctID_GetAll,getValue(C_FSG_41_0_0_0_1_ErrCode)); 
                
                else if (getValue(C_FSG_41_0_0_0_1_FctEn) == 0x01)
                temp=BAP180_SetRxData(NODE_INDEX,RX_Header,RX_Data);//send recieved CAN-data with CAN-header to BAP-DLL
                break;

        case 2: //error
                if (getValue(P_FSG_41_0_0_0_2_ErrEn)==0x01)
                Request_error(LSGID,FctID_BAP_Config,getValue(P_FSG_41_0_0_0_2_ErrCode)); 

                else if (getValue(P_FSG_41_0_0_0_2_FctEn) == 0x01)
                temp=BAP180_SetRxData(NODE_INDEX,RX_Header,RX_Data);//send recieved CAN-data with CAN-header to BAP-DLL
                break;

        case 3: //error
                if (getValue(P_FSG_41_0_0_0_3_ErrEn)==0x01)
                Request_error(LSGID,FctID_FunctionList,getValue(P_FSG_41_0_0_0_3_ErrCode)); 
                
                else if (getValue(P_FSG_41_0_0_0_3_FctEn) == 0x01)
       		temp=BAP180_SetRxData(NODE_INDEX, RX_Header, RX_Data);
       		break;
             
        
        default: temp=BAP180_SetRxData(NODE_INDEX,RX_Header,RX_Data);	//send recieved CAN-data with CAN-header to BAP-DLL
                break;
        }
		   
           //temp=BAP180_SetRxData(NODE_INDEX, RX_Header, RX_Data);
       }
   }
}

on message BAP_Telefon2_ASG_01
{
   int i, temp;
   byte RX_Data[64];            // received CAN-DATA
   dword RX_Header[4];         // received CAN-Header
   if(gSG_PowerOnOff==Power_on){
       if(this.msgChannel == 1){
           RX_Header[0]=1; /*BusType: 1=Can, 2=Lin, 3=Flexray, 4=Ethernet*/
           RX_Header[1]=1;
           RX_Header[2]=this.DataLength; // received length
           RX_Header[3]=this.ID;
           for (i=0; i<this.DataLength; i++) {
               RX_Data[i]=this.byte(i);
           }
		   //MR61529 - start
        //temp=BAP180_SetRxData(NODE_INDEX,RX_Header,RX_Data);	
         switch ((RX_Data[1] & 0x0F))
        {
        //getAll
        case 1: //error
                if (getValue(C_FSG_41_0_0_0_1_ErrEn)==0x01)
                Request_error(LSGID,FctID_GetAll,getValue(C_FSG_41_0_0_0_1_ErrCode)); 
                
                else if (getValue(C_FSG_41_0_0_0_1_FctEn) == 0x01)
                temp=BAP180_SetRxData(NODE_INDEX,RX_Header,RX_Data);//send recieved CAN-data with CAN-header to BAP-DLL
                break;

        case 2: //error
                if (getValue(P_FSG_41_0_0_0_2_ErrEn)==0x01)
                Request_error(LSGID,FctID_BAP_Config,getValue(P_FSG_41_0_0_0_2_ErrCode)); 

                else if (getValue(P_FSG_41_0_0_0_2_FctEn) == 0x01)
                temp=BAP180_SetRxData(NODE_INDEX,RX_Header,RX_Data);//send recieved CAN-data with CAN-header to BAP-DLL
                break;

        case 3: //error
                if (getValue(P_FSG_41_0_0_0_3_ErrEn)==0x01)
                Request_error(LSGID,FctID_FunctionList,getValue(P_FSG_41_0_0_0_3_ErrCode)); 
                
                else if (getValue(P_FSG_41_0_0_0_3_FctEn) == 0x01)
       		temp=BAP180_SetRxData(NODE_INDEX, RX_Header, RX_Data);
       		break;
             
        
        default: temp=BAP180_SetRxData(NODE_INDEX,RX_Header,RX_Data);	//send recieved CAN-data with CAN-header to BAP-DLL
                break;
        }
           //temp=BAP180_SetRxData(NODE_INDEX, RX_Header, RX_Data);
       }
   }
}



intertelegram_err(long fctId)
{
    long data[4];
    data[0]=LSGID;
    data[1]=fctId;
    data[2]=1;
    data[3]=940;
    ChangeConfig(0x0020,data);
}

sequence_err(long fctId, long size)
{
    long data[5];
    long lastSeg;

    lastSeg = size-5;

    data[0]=LSGID;
    data[1]=fctId;
    data[2]=lastSeg/7+1;
    data[3]=1;
    data[4]=(lastSeg/7+4) & 15;
    ChangeConfig(0x0021,data);
}

intertelegram_err_off(long fctId)
{
    long data[4];
    data[0]=LSGID;
    data[1]=fctId;
    data[2]=5000;
    data[3]=0;
    ChangeConfig(0x0020,data);
}

sequence_err_off(long fctId)
{
    long data[5];

    data[0]=LSGID;
    data[1]=fctId;
    data[2]=5000;
    data[3]=0;
    data[4]=0;
    ChangeConfig(0x0021,data);
}

// START OF BUS CONFIG PANEL CAPL

// ETHERNET AND FLEXRAY NOT ENABLED! (ENABLE_BUS_SELECTOR_PANEL_TOKEN)

// ETHERNET AND FLEXRAY NOT ENABLED! (ENABLE_CAN_FRAME_TOKEN)

// ETHERNET AND FLEXRAY NOT ENABLED! (ENABLE_FR_FRAME_TOKEN)

// ETHERNET AND FLEXRAY NOT ENABLED! (ENABLE_ETHERNET_FRAME_TOKEN)

// ETHERNET AND FLEXRAY NOT ENABLED! (ON_ENVVAR_BUSTYPE_TOKEN)

// ETHERNET NOT ENABLED! (ON_UDP_RECEIVE_FROM_TOKEN)

// ETHERNET NOT ENABLED!

on envVar ON_OFF_FSG41_0
{
   BapOnOff(getvalue(this));
   gSG_PowerOnOff=getvalue(ON_OFF_FSG41_0);
}
on envVar BAPCFG_FSG_41_0_0_DFMajor
{
    long temp[3];
    byte ret,i ;
    for (i = 0; i < 4; i++)
    {
        temp[0] = LSGID;
        temp[1] = i;
        temp[2] = getValue(this);
        ret = BAP150_ChangeConfig(NODE_INDEX, 9, temp);
        if (ret != 0)
        {
            writeLineEx(gBAP_Trace, 0, "NodeIndex: %d: Error %d occured during setting of Minor DF Version.",NODE_INDEX, ret);
        }
    }
}
on envVar BAPCFG_FSG_41_0_0_DFMinor
{
    long temp[3];
    byte ret,i ;
    for (i = 0; i < 4; i++)
    {
        temp[0] = LSGID;
        temp[1] = i;
        temp[2] = getValue(this);
        ret = BAP150_ChangeConfig(NODE_INDEX, 10, temp);
        if (ret != 0)
        {
            writeLineEx(gBAP_Trace, 0, "NodeIndex: %d: Error %d occured during setting of Minor DF Version.",NODE_INDEX, ret);
        }
    }
}
on envVar BAPCFG_FSG_41_0_0_LsgClassMajor
{
    long temp[3];
    byte ret,i ;
    for (i = 0; i < 4; i++)
    {
        temp[0] = LSGID;
        temp[1] = i;
        temp[2] = getValue(this);
        ret = BAP150_ChangeConfig(NODE_INDEX, 5, temp);
        if (ret != 0)
        {
            writeLineEx(gBAP_Trace, 0, "NodeIndex: %d: Error %d occured during setting of Minor DF Version.",NODE_INDEX, ret);
        }
    }
}
on envVar BAPCFG_FSG_41_0_0_LsgClassMinor
{
    long temp[3];
    byte ret,i ;
    for (i = 0; i < 4; i++)
    {
        temp[0] = LSGID;
        temp[1] = i;
        temp[2] = getValue(this);
        ret = BAP150_ChangeConfig(NODE_INDEX, 6, temp);
        if (ret != 0)
        {
            writeLineEx(gBAP_Trace, 0, "NodeIndex: %d: Error %d occured during setting of Minor DF Version.",NODE_INDEX, ret);
        }
    }
}
on envVar BAPCFG_FSG_41_0_0_ProtocolMajor
{
    long temp[3];
    byte ret,i ;
    for (i = 0; i < 4; i++)
    {
        temp[0] = LSGID;
        temp[1] = i;
        temp[2] = getValue(this);
        ret = BAP150_ChangeConfig(NODE_INDEX, 7, temp);
        if (ret != 0)
        {
            writeLineEx(gBAP_Trace, 0, "NodeIndex: %d: Error %d occured during setting of Minor DF Version.",NODE_INDEX, ret);
        }
    }
}
on envVar BAPCFG_FSG_41_0_0_ProtocolMinor
{
    long temp[3];
    byte ret,i ;
    for (i = 0; i < 4; i++)
    {
        temp[0] = LSGID;
        temp[1] = i;
        temp[2] = getValue(this);
        ret = BAP150_ChangeConfig(NODE_INDEX, 8, temp);
        if (ret != 0)
        {
            writeLineEx(gBAP_Trace, 0, "NodeIndex: %d: Error %d occured during setting of Minor DF Version.",NODE_INDEX, ret);
        }
    }
}
// Setzen der Schriftfarbe bei Zustandswechsel der FCTID C_FSG_41_0_0_1_ID
on envVar C_FSG_41_0_0_1_FctLstItemEn
{
       if(getValue(this)) 
       {
           setControlForeColor(panel_name, "checkbox_C_FSG_41_0_0_1", MakeRGB(0,240,0));
       }
       else
       {
           setControlForeColor(panel_name, "checkbox_C_FSG_41_0_0_1", MakeRGB(250,0,0));
       }
}
// Setzen der Schriftfarbe bei Zustandswechsel der FCTID P_FSG_41_0_0_2_ID
on envVar P_FSG_41_0_0_2_FctLstItemEn
{
       if(getValue(this)) 
       {
           setControlForeColor(panel_name, "checkbox_P_FSG_41_0_0_2", MakeRGB(0,240,0));
       }
       else
       {
           setControlForeColor(panel_name, "checkbox_P_FSG_41_0_0_2", MakeRGB(250,0,0));
       }
}
// Ruecksetzen des Fehlerstatus durch manuelle Fehlereingabe
on envVar P_FSG_41_0_0_2_ErrCode
{
       if(gP_FSG_41_0_0_2_ErrCode) 
       {
           setControlBackColor(panel_name,"errfield_P_FSG_41_0_0_2", MakeRGB(255,255,255));
       }
       gP_FSG_41_0_0_2_ErrCode = 1;
}
// Setzen der Schriftfarbe bei Zustandswechsel der FCTID P_FSG_41_0_0_3_ID
on envVar P_FSG_41_0_0_3_FctLstItemEn
{
       if(getValue(this)) 
       {
           setControlForeColor(panel_name, "checkbox_P_FSG_41_0_0_3", MakeRGB(0,240,0));
       }
       else
       {
           setControlForeColor(panel_name, "checkbox_P_FSG_41_0_0_3", MakeRGB(250,0,0));
       }
}
// Ruecksetzen des Fehlerstatus durch manuelle Fehlereingabe
on envVar P_FSG_41_0_0_3_ErrCode
{
       if(gP_FSG_41_0_0_3_ErrCode) 
       {
           setControlBackColor(panel_name,"errfield_P_FSG_41_0_0_3", MakeRGB(255,255,255));
       }
       gP_FSG_41_0_0_3_ErrCode = 1;
}
// De-Aktivierung der Eingabefelder der HB-FCT P_FSG_41_0_0_4
on envVar P_FSG_41_0_0_4_FctLstItemEn
{
       if(getValue(this)) 
       {
//           EnableControl(panel_name,"panel_FSG_41_0_0_4",1);
//           EnableControl(panel_name,"${ERRFIELD}",1);
           EnableControl(panel_name,"panel_P_FSG_41_0_0_4_HBEn",1);
           setControlForeColor(panel_name, "checkbox_P_FSG_41_0_0_4", MakeRGB(0,240,0));
       }
       else
       {
//           EnableControl(panel_name,"panel_FSG_41_0_0_4",0);
//           EnableControl(panel_name,"${ERRFIELD}",0);
           EnableControl(panel_name,"panel_P_FSG_41_0_0_4_HBEn",0);
           setControlForeColor(panel_name, "checkbox_P_FSG_41_0_0_4", MakeRGB(250,0,0));
       }
}
on envVar P_FSG_41_0_0_4_FctEn
{
  P_FSG_41_0_0_4_FctEn();
}

P_FSG_41_0_0_4_FctEn()
{
	long data[2];
	if(getValue(P_FSG_41_0_0_4_FctEn)>0)
	{
		data[0] = 41;
		data[1] = getValue(P_FSG_41_0_0_4);
		write("enable HB");
	}
	else
	{
		data[0] = 41;
		data[1] = 0;
		write("disable HB");
	}
	Bap150_ChangeConfig(NODE_INDEX, 0x00, data);
}
// Ruecksetzen des Fehlerstatus durch manuelle Fehlereingabe
on envVar P_FSG_41_0_0_4_ErrCode
{
       if(gP_FSG_41_0_0_4_ErrCode) 
       {
           setControlBackColor(panel_name,"errfield_P_FSG_41_0_0_4", MakeRGB(255,255,255));
       }
       gP_FSG_41_0_0_4_ErrCode = 1;
}
// Ruecksetzen des Fehlerstatus durch manuelle Fehlereingabe
on envVar P_FSG_41_0_0_14_ErrCode
{
       if(gP_FSG_41_0_0_14_ErrCode) 
       {
           setControlBackColor(panel_name,"errfield_P_FSG_41_0_0_14", MakeRGB(255,255,255));
       }
       gP_FSG_41_0_0_14_ErrCode = 1;
}
on envVar P_FSG_41_0_0_14Status_BTN
{
	byte BAPTemp[6];
   if (P_FSG_41_0_0_14Status_BTN_already_pressed == 0)
   {
      putValue(P_FSG_41_0_0_14_ErrCode,0);
      SetControlBackColor(panel_name,"errField_P_FSG_41_0_0_14",MakeRGB(255,255,255));
      P_FSG_41_0_0_14Status_BTN_already_pressed = 1;
   }
   else
   {
      getValue(P_FSG_41_0_0_14, BAPTemp);
      Request_ByteSequence(LSGID, P_FSG_41_0_0_14_ID, Data_REQ, BAPTemp, getValueSize(P_FSG_41_0_0_14));
      P_FSG_41_0_0_14Status_BTN_already_pressed = 0;
   }
}
on envVar P_FSG_41_0_0_14_FctEn
{
    long data[3];
    data[0]=LSGID;
    data[1]=P_FSG_41_0_0_14_ID;
    data[2]=getValue(P_FSG_41_0_0_14_FctEn);
    ChangeConfig(0x0031,data);
}
// De-Aktivierung der Eingabefelder der FCTID P_FSG_41_0_0_14
on envVar P_FSG_41_0_0_14_FctLstItemEn
{
       if(getValue(this)) 
       {
           EnableControl(panel_name,"panel_FSG_41_0_0_14",1);
           EnableControl(panel_name,"errfield_P_FSG_41_0_0_14",1);
           EnableControl(panel_name,"panel_P_FSG_41_0_0_14",1);
           setControlForeColor(panel_name, "checkbox_P_FSG_41_0_0_14", MakeRGB(0,240,0));
       }
       else
       {
           EnableControl(panel_name,"panel_FSG_41_0_0_14",0);
           EnableControl(panel_name,"errfield_P_FSG_41_0_0_14",0);
           EnableControl(panel_name,"panel_P_FSG_41_0_0_14",0);
           setControlForeColor(panel_name, "checkbox_P_FSG_41_0_0_14", MakeRGB(250,0,0));
       }
}
on envVar P_FSG_41_0_0_14 // bus value of FSG_Setup (14).
{
	// opcodes: Error-Status
	word param1; // BuiltInAudioSinks
	byte param2; // MobileConnectionType2
	byte param3; // MobileConnectionType3
	byte param4; // MobileConnectionTypeAttributes
	byte param5; // Extension_2
	// DATATYPE_BYTESEQUENCE / DATATYPE_FIXEDBYTESEQUENCE
	int i;
	byte superval[6];
	int currentPos;
	currentPos = 0;
	for( i = 0; i < 6; i++ ) {
		superval[i] = 0;
	}
	getValue(P_FSG_41_0_0_14, superval);
	///////// Start param1 - UINT16 /////////
	param1 = superval[currentPos++]|(superval[currentPos++]<<8);
	putValue(P_FSG_41_0_0_14_1, param1);
	///////// Start param2 - UINT8 /////////
	param2 = superval[currentPos++];
	putValue(P_FSG_41_0_0_14_2, param2);
	///////// Start param3 - UINT8 /////////
	param3 = superval[currentPos++];
	putValue(P_FSG_41_0_0_14_3, param3);
	///////// Start param4 - UINT8 /////////
	param4 = superval[currentPos++];
	putValue(P_FSG_41_0_0_14_4, param4);
	///////// Start param5 - UINT8 /////////
	param5 = superval[currentPos++];
	putValue(P_FSG_41_0_0_14_5, round((param5 * 1.0) - (0) + (0), 1.0));
}

on envVar P_FSG_41_0_0_14_1_0
{
	byte bitval;
	//thisval steht hier fuer den bitfield-wert, 
	//aus Generierungsgruenden hier keine einheitliche Bezeichnung moeglich.
	word thisval; // BuiltInAudioSinks
	bitval= getValue(this);
	thisval = getValue(P_FSG_41_0_0_14_1);
	thisval = thisval&~(1<<0)|(bitval<<0);
	putValue(P_FSG_41_0_0_14_1,thisval);
}

on envVar P_FSG_41_0_0_14_1_1
{
	byte bitval;
	//thisval steht hier fuer den bitfield-wert, 
	//aus Generierungsgruenden hier keine einheitliche Bezeichnung moeglich.
	word thisval; // BuiltInAudioSinks
	bitval= getValue(this);
	thisval = getValue(P_FSG_41_0_0_14_1);
	thisval = thisval&~(1<<1)|(bitval<<1);
	putValue(P_FSG_41_0_0_14_1,thisval);
}

on envVar P_FSG_41_0_0_14_1_2
{
	byte bitval;
	//thisval steht hier fuer den bitfield-wert, 
	//aus Generierungsgruenden hier keine einheitliche Bezeichnung moeglich.
	word thisval; // BuiltInAudioSinks
	bitval= getValue(this);
	thisval = getValue(P_FSG_41_0_0_14_1);
	thisval = thisval&~(1<<2)|(bitval<<2);
	putValue(P_FSG_41_0_0_14_1,thisval);
}

on envVar P_FSG_41_0_0_14_1_3
{
	byte bitval;
	//thisval steht hier fuer den bitfield-wert, 
	//aus Generierungsgruenden hier keine einheitliche Bezeichnung moeglich.
	word thisval; // BuiltInAudioSinks
	bitval= getValue(this);
	thisval = getValue(P_FSG_41_0_0_14_1);
	thisval = thisval&~(1<<3)|(bitval<<3);
	putValue(P_FSG_41_0_0_14_1,thisval);
}

on envVar P_FSG_41_0_0_14_1_4
{
	byte bitval;
	//thisval steht hier fuer den bitfield-wert, 
	//aus Generierungsgruenden hier keine einheitliche Bezeichnung moeglich.
	word thisval; // BuiltInAudioSinks
	bitval= getValue(this);
	thisval = getValue(P_FSG_41_0_0_14_1);
	thisval = thisval&~(1<<4)|(bitval<<4);
	putValue(P_FSG_41_0_0_14_1,thisval);
}

on envVar P_FSG_41_0_0_14_1_5
{
	byte bitval;
	//thisval steht hier fuer den bitfield-wert, 
	//aus Generierungsgruenden hier keine einheitliche Bezeichnung moeglich.
	word thisval; // BuiltInAudioSinks
	bitval= getValue(this);
	thisval = getValue(P_FSG_41_0_0_14_1);
	thisval = thisval&~(1<<5)|(bitval<<5);
	putValue(P_FSG_41_0_0_14_1,thisval);
}

on envVar P_FSG_41_0_0_14_1_6
{
	byte bitval;
	//thisval steht hier fuer den bitfield-wert, 
	//aus Generierungsgruenden hier keine einheitliche Bezeichnung moeglich.
	word thisval; // BuiltInAudioSinks
	bitval= getValue(this);
	thisval = getValue(P_FSG_41_0_0_14_1);
	thisval = thisval&~(1<<6)|(bitval<<6);
	putValue(P_FSG_41_0_0_14_1,thisval);
}

on envVar P_FSG_41_0_0_14_1_7
{
	byte bitval;
	//thisval steht hier fuer den bitfield-wert, 
	//aus Generierungsgruenden hier keine einheitliche Bezeichnung moeglich.
	word thisval; // BuiltInAudioSinks
	bitval= getValue(this);
	thisval = getValue(P_FSG_41_0_0_14_1);
	thisval = thisval&~(1<<7)|(bitval<<7);
	putValue(P_FSG_41_0_0_14_1,thisval);
}

on envVar P_FSG_41_0_0_14_1_8
{
	byte bitval;
	//thisval steht hier fuer den bitfield-wert, 
	//aus Generierungsgruenden hier keine einheitliche Bezeichnung moeglich.
	word thisval; // BuiltInAudioSinks
	bitval= getValue(this);
	thisval = getValue(P_FSG_41_0_0_14_1);
	thisval = thisval&~(1<<8)|(bitval<<8);
	putValue(P_FSG_41_0_0_14_1,thisval);
}

on envVar P_FSG_41_0_0_14_1 // FSG_Setup.BuiltInAudioSinks
{
	byte superval[6];

	//Update Childvalue (BitField)
	byte mask=0x01;
	int i = 0;
	word thisval; // BuiltInAudioSinks
	thisval = getValue(this);
	if(thisval&(mask<<0))
		putValue(P_FSG_41_0_0_14_1_0, 1);
	else
		putValue(P_FSG_41_0_0_14_1_0, 0);
	if(thisval&(mask<<1))
		putValue(P_FSG_41_0_0_14_1_1, 1);
	else
		putValue(P_FSG_41_0_0_14_1_1, 0);
	if(thisval&(mask<<2))
		putValue(P_FSG_41_0_0_14_1_2, 1);
	else
		putValue(P_FSG_41_0_0_14_1_2, 0);
	if(thisval&(mask<<3))
		putValue(P_FSG_41_0_0_14_1_3, 1);
	else
		putValue(P_FSG_41_0_0_14_1_3, 0);
	if(thisval&(mask<<4))
		putValue(P_FSG_41_0_0_14_1_4, 1);
	else
		putValue(P_FSG_41_0_0_14_1_4, 0);
	if(thisval&(mask<<5))
		putValue(P_FSG_41_0_0_14_1_5, 1);
	else
		putValue(P_FSG_41_0_0_14_1_5, 0);
	if(thisval&(mask<<6))
		putValue(P_FSG_41_0_0_14_1_6, 1);
	else
		putValue(P_FSG_41_0_0_14_1_6, 0);
	if(thisval&(mask<<7))
		putValue(P_FSG_41_0_0_14_1_7, 1);
	else
		putValue(P_FSG_41_0_0_14_1_7, 0);
	if(thisval&(mask<<8))
		putValue(P_FSG_41_0_0_14_1_8, 1);
	else
		putValue(P_FSG_41_0_0_14_1_8, 0);

    // Update superval
	getValue(P_FSG_41_0_0_14, superval);
	superval[0]=thisval&0x00ff;
	superval[1]=(thisval&0xff00)>>8;
	putValue(P_FSG_41_0_0_14,superval);
}

on envVar P_FSG_41_0_0_14_2 // FSG_Setup.MobileConnectionType2
{
	byte superval[6];

	//Update Childvalue (Enum)
	byte thisval; // MobileConnectionType2
	thisval = getValue(this);

    // Update superval
	getValue(P_FSG_41_0_0_14, superval);
	superval[2]=thisval;
	putValue(P_FSG_41_0_0_14,superval);
}

on envVar P_FSG_41_0_0_14_3 // FSG_Setup.MobileConnectionType3
{
	byte superval[6];

	//Update Childvalue (Enum)
	byte thisval; // MobileConnectionType3
	thisval = getValue(this);

    // Update superval
	getValue(P_FSG_41_0_0_14, superval);
	superval[3]=thisval;
	putValue(P_FSG_41_0_0_14,superval);
}

on envVar P_FSG_41_0_0_14_4_0
{
	byte bitval;
	//thisval steht hier fuer den bitfield-wert, 
	//aus Generierungsgruenden hier keine einheitliche Bezeichnung moeglich.
	byte thisval; // MobileConnectionTypeAttributes
	bitval= getValue(this);
	thisval = getValue(P_FSG_41_0_0_14_4);
	thisval = thisval&~(1<<0)|(bitval<<0);
	putValue(P_FSG_41_0_0_14_4,thisval);
}

on envVar P_FSG_41_0_0_14_4_1
{
	byte bitval;
	//thisval steht hier fuer den bitfield-wert, 
	//aus Generierungsgruenden hier keine einheitliche Bezeichnung moeglich.
	byte thisval; // MobileConnectionTypeAttributes
	bitval= getValue(this);
	thisval = getValue(P_FSG_41_0_0_14_4);
	thisval = thisval&~(1<<1)|(bitval<<1);
	putValue(P_FSG_41_0_0_14_4,thisval);
}

on envVar P_FSG_41_0_0_14_4_2
{
	byte bitval;
	//thisval steht hier fuer den bitfield-wert, 
	//aus Generierungsgruenden hier keine einheitliche Bezeichnung moeglich.
	byte thisval; // MobileConnectionTypeAttributes
	bitval= getValue(this);
	thisval = getValue(P_FSG_41_0_0_14_4);
	thisval = thisval&~(1<<2)|(bitval<<2);
	putValue(P_FSG_41_0_0_14_4,thisval);
}

on envVar P_FSG_41_0_0_14_4 // FSG_Setup.MobileConnectionTypeAttributes
{
	byte superval[6];

	//Update Childvalue (BitField)
	byte mask=0x01;
	int i = 0;
	byte thisval; // MobileConnectionTypeAttributes
	thisval = getValue(this);
	if(thisval&(mask<<0))
		putValue(P_FSG_41_0_0_14_4_0, 1);
	else
		putValue(P_FSG_41_0_0_14_4_0, 0);
	if(thisval&(mask<<1))
		putValue(P_FSG_41_0_0_14_4_1, 1);
	else
		putValue(P_FSG_41_0_0_14_4_1, 0);
	if(thisval&(mask<<2))
		putValue(P_FSG_41_0_0_14_4_2, 1);
	else
		putValue(P_FSG_41_0_0_14_4_2, 0);

    // Update superval
	getValue(P_FSG_41_0_0_14, superval);
	superval[4]=thisval;
	putValue(P_FSG_41_0_0_14,superval);
}

// Ueberwachung der Darstellungsvariable der Range.
on envVar P_FSG_41_0_0_14_5_range // FSG_Setup.Extension_2 
{
	@P_FSG_41_0_0_14_5 = @P_FSG_41_0_0_14_5_range - (0); // slider = range - min
}

on envVar P_FSG_41_0_0_14_5 // FSG_Setup.Extension_2
{
	byte superval[6];

	//Update Childvalue (Number)
	byte thisval; // Extension_2
	float slider_value;

	slider_value = 0; // Konstanter Parameter.
	@P_FSG_41_0_0_14_5_range = slider_value + (0); // real value := slider value + range min.
	thisval = (byte)round((slider_value + (0) - (0)) / (1.0), 1); // bus value := (slider value + min - offset) / step.

    // Update superval
	getValue(P_FSG_41_0_0_14, superval);
	superval[5]=thisval;
	putValue(P_FSG_41_0_0_14,superval);
}

// Ruecksetzen des Fehlerstatus durch manuelle Fehlereingabe
on envVar P_FSG_41_0_0_15_ErrCode
{
       if(gP_FSG_41_0_0_15_ErrCode) 
       {
           setControlBackColor(panel_name,"errfield_P_FSG_41_0_0_15", MakeRGB(255,255,255));
       }
       gP_FSG_41_0_0_15_ErrCode = 1;
}
on envVar P_FSG_41_0_0_15Status_BTN
{
    if (P_FSG_41_0_0_15Status_BTN_already_pressed == 0)
    {
       putValue(P_FSG_41_0_0_15_ErrCode,0);
       SetControlBackColor(panel_name,"errField_P_FSG_41_0_0_15",MakeRGB(255,255,255));
       P_FSG_41_0_0_15Status_BTN_already_pressed = 1;
    }
    else
    {
       Request_Int8(LSGID, P_FSG_41_0_0_15_ID, Data_REQ, getValue(P_FSG_41_0_0_15));
      P_FSG_41_0_0_15Status_BTN_already_pressed = 0;
    }
}
on envVar P_FSG_41_0_0_15_FctEn
{
    long data[3];
    data[0]=LSGID;
    data[1]=P_FSG_41_0_0_15_ID;
    data[2]=getValue(P_FSG_41_0_0_15_FctEn);
    ChangeConfig(0x0031,data);
}
// De-Aktivierung der Eingabefelder der FCTID P_FSG_41_0_0_15
on envVar P_FSG_41_0_0_15_FctLstItemEn
{
       if(getValue(this)) 
       {
           EnableControl(panel_name,"panel_FSG_41_0_0_15",1);
           EnableControl(panel_name,"errfield_P_FSG_41_0_0_15",1);
           EnableControl(panel_name,"panel_P_FSG_41_0_0_15",1);
           setControlForeColor(panel_name, "checkbox_P_FSG_41_0_0_15", MakeRGB(0,240,0));
       }
       else
       {
           EnableControl(panel_name,"panel_FSG_41_0_0_15",0);
           EnableControl(panel_name,"errfield_P_FSG_41_0_0_15",0);
           EnableControl(panel_name,"panel_P_FSG_41_0_0_15",0);
           setControlForeColor(panel_name, "checkbox_P_FSG_41_0_0_15", MakeRGB(250,0,0));
       }
}
on envVar P_FSG_41_0_0_15 // bus value of FSG_OperationState (15).
{
	// opcodes: Error-Status
	byte param1; // OP_State
	// DATATYPE_UINTXX
	param1 = getValue(P_FSG_41_0_0_15);
	putValue(P_FSG_41_0_0_15_1, param1);
}

on envVar P_FSG_41_0_0_15_1 // FSG_OperationState.OP_State
{
	byte superval;

	//Update Childvalue (Enum)
	byte thisval; // OP_State
	thisval = getValue(this);

    // Update superval
	superval = getValue(P_FSG_41_0_0_15);
	superval = thisval;
	putValue(P_FSG_41_0_0_15,superval);
}

// Ruecksetzen des Fehlerstatus durch manuelle Fehlereingabe
on envVar P_FSG_41_0_0_16_ErrCode
{
       if(gP_FSG_41_0_0_16_ErrCode) 
       {
           setControlBackColor(panel_name,"errfield_P_FSG_41_0_0_16", MakeRGB(255,255,255));
       }
       gP_FSG_41_0_0_16_ErrCode = 1;
}
on envVar P_FSG_41_0_0_16Status_BTN
{
	byte BAPTemp[8];
    if (P_FSG_41_0_0_16Status_BTN_already_pressed == 0)
    {
        putValue(P_FSG_41_0_0_16_ErrCode,0);
        SetControlBackColor(panel_name,"errField_P_FSG_41_0_0_16",MakeRGB(255,255,255));
        P_FSG_41_0_0_16Status_BTN_already_pressed = 1;
    }
    else
    {
		P_FSG_41_0_0_16_BuildFct();
        getValue(P_FSG_41_0_0_16, BAPTemp);
        Request_ByteSequence(LSGID, P_FSG_41_0_0_16_ID, Data_REQ, BAPTemp, getValueSize(P_FSG_41_0_0_16));
        if(getValue(P_FSG_41_0_0_16_IntTlgEn)) //getValue(IT))
        {
           intertelegram_err(P_FSG_41_0_0_16_ID);
        }
        if(getValue(P_FSG_41_0_0_16_SegmEn))   //getvalue(SG)
        {
           sequence_err(P_FSG_41_0_0_16_ID,elCount(BAPTemp));
        }
       P_FSG_41_0_0_16Status_BTN_already_pressed = 0;
    }
}
on envVar P_FSG_41_0_0_16_FctEn
{
    long data[3];
    data[0]=LSGID;
    data[1]=P_FSG_41_0_0_16_ID;
    data[2]=getValue(P_FSG_41_0_0_16_FctEn);
    ChangeConfig(0x0031,data);
}
// De-Aktivierung der Eingabefelder der FCTID P_FSG_41_0_0_16
on envVar P_FSG_41_0_0_16_FctLstItemEn
{
       if(getValue(this)) 
       {
           EnableControl(panel_name,"panel_FSG_41_0_0_16",1);
           EnableControl(panel_name,"errfield_P_FSG_41_0_0_16",1);
           EnableControl(panel_name,"panel_P_FSG_41_0_0_16",1);
           setControlForeColor(panel_name, "checkbox_P_FSG_41_0_0_16", MakeRGB(0,240,0));
       }
       else
       {
           EnableControl(panel_name,"panel_FSG_41_0_0_16",0);
           EnableControl(panel_name,"errfield_P_FSG_41_0_0_16",0);
           EnableControl(panel_name,"panel_P_FSG_41_0_0_16",0);
           setControlForeColor(panel_name, "checkbox_P_FSG_41_0_0_16", MakeRGB(250,0,0));
       }
}
// Man darf gleichzeitig nur Checkbox fuer SegmError oder IntertelegramError aktiviert werden
on envVar P_FSG_41_0_0_16_IntTlgEn
{
       if(getValue(this)) 
       {
           putValue(P_FSG_41_0_0_16_SegmEn,0);
           intertelegram_err(P_FSG_41_0_0_16_ID);
       }
       else
       {
           intertelegram_err_off(P_FSG_41_0_0_16_ID);
       }
}
// Man darf gleichzeitig nur Checkbox fuer SegmError oder IntertelegramError aktiviert werden
on envVar P_FSG_41_0_0_16_SegmEn
{
       if(getValue(this)) 
       {
           putValue(P_FSG_41_0_0_16_IntTlgEn,0);
           sequence_err(P_FSG_41_0_0_16_ID,getValueSize(P_FSG_41_0_0_16_SegmEn));
       }
       else
       {
              sequence_err_off(P_FSG_41_0_0_16_ID);
       }
}
on envVar P_FSG_41_0_0_16 // bus value of MobileServiceSupport (16).
{
	// opcodes: Error-Status
	byte param1[8]; // FctList
	// DATATYPE_BYTESEQUENCE / DATATYPE_FIXEDBYTESEQUENCE
	int i;
	byte superval[8];
	int currentPos;
	currentPos = 0;
	for( i = 0; i < 8; i++ ) {
		superval[i] = 0;
	}
	getValue(P_FSG_41_0_0_16, superval);
	///////// Start param1 - 6/8BSTRING /////////
	for( i = 0; i < 8; i++ )
	{
		param1[i] = superval[currentPos++];
	}
	putValue(P_FSG_41_0_0_16_1, param1);
}

// Updates the bus value field and other dependencies.
P_FSG_41_0_0_16_BuildFct()
{
	byte param1[8]; // FctList

	int i;
	byte superval[8];
	int currentPos;
	currentPos = 0;
// gen_BuildFunc_SetSuperVals 
	getValue(P_FSG_41_0_0_16_1, param1);
	@P_FSG_41_0_0_16_1_17 = (param1[2] & 64) > 0;
	@P_FSG_41_0_0_16_1_18 = (param1[2] & 32) > 0;
	@P_FSG_41_0_0_16_1_19 = (param1[2] & 16) > 0;
	@P_FSG_41_0_0_16_1_20 = (param1[2] & 8) > 0;
	@P_FSG_41_0_0_16_1_21 = (param1[2] & 4) > 0;
	@P_FSG_41_0_0_16_1_22 = (param1[2] & 2) > 0;
	@P_FSG_41_0_0_16_1_23 = (param1[2] & 1) > 0;
	@P_FSG_41_0_0_16_1_24 = (param1[3] & 128) > 0;
	@P_FSG_41_0_0_16_1_25 = (param1[3] & 64) > 0;
	@P_FSG_41_0_0_16_1_26 = (param1[3] & 32) > 0;
	@P_FSG_41_0_0_16_1_27 = (param1[3] & 16) > 0;
	@P_FSG_41_0_0_16_1_28 = (param1[3] & 8) > 0;
	@P_FSG_41_0_0_16_1_29 = (param1[3] & 4) > 0;
	@P_FSG_41_0_0_16_1_30 = (param1[3] & 2) > 0;
	@P_FSG_41_0_0_16_1_31 = (param1[3] & 1) > 0;
	@P_FSG_41_0_0_16_1_32 = (param1[4] & 128) > 0;
	@P_FSG_41_0_0_16_1_33 = (param1[4] & 64) > 0;
	@P_FSG_41_0_0_16_1_34 = (param1[4] & 32) > 0;
	@P_FSG_41_0_0_16_1_35 = (param1[4] & 16) > 0;
	@P_FSG_41_0_0_16_1_36 = (param1[4] & 8) > 0;
	@P_FSG_41_0_0_16_1_37 = (param1[4] & 4) > 0;
	@P_FSG_41_0_0_16_1_38 = (param1[4] & 2) > 0;
	@P_FSG_41_0_0_16_1_39 = (param1[4] & 1) > 0;
	@P_FSG_41_0_0_16_1_40 = (param1[5] & 128) > 0;
	@P_FSG_41_0_0_16_1_41 = (param1[5] & 64) > 0;
	@P_FSG_41_0_0_16_1_42 = (param1[5] & 32) > 0;
	@P_FSG_41_0_0_16_1_43 = (param1[5] & 16) > 0;
	@P_FSG_41_0_0_16_1_44 = (param1[5] & 8) > 0;
	@P_FSG_41_0_0_16_1_45 = (param1[5] & 4) > 0;
	@P_FSG_41_0_0_16_1_46 = (param1[5] & 2) > 0;
	@P_FSG_41_0_0_16_1_47 = (param1[5] & 1) > 0;
	@P_FSG_41_0_0_16_1_48 = (param1[6] & 128) > 0;
	@P_FSG_41_0_0_16_1_49 = (param1[6] & 64) > 0;
  @P_FSG_41_0_0_16_1_50 = (param1[6] & 32) > 0;
  @P_FSG_41_0_0_16_1_51 = (param1[6] & 16) > 0;
	for( i = 0; i < 8; i++)
	{
	 superval[currentPos++] = param1[i];
	}
	putValue(P_FSG_41_0_0_16, superval, currentPos);
}


on envVar P_FSG_41_0_0_16_1_17
{
	byte bitval;
	//thisval steht hier fuer den bitfield-wert, 
	//aus Generierungsgruenden hier keine einheitliche Bezeichnung moeglich.
	byte thisval[8]; // FctList
	bitval= getValue(this);
	getValue(P_FSG_41_0_0_16_1, thisval);
	thisval[2] = thisval[2]&~(1<<6)|(bitval<<6);
	putValue(P_FSG_41_0_0_16_1,thisval);
}

on envVar P_FSG_41_0_0_16_1_18
{
	byte bitval;
	//thisval steht hier fuer den bitfield-wert, 
	//aus Generierungsgruenden hier keine einheitliche Bezeichnung moeglich.
	byte thisval[8]; // FctList
	bitval= getValue(this);
	getValue(P_FSG_41_0_0_16_1, thisval);
	thisval[2] = thisval[2]&~(1<<5)|(bitval<<5);
	putValue(P_FSG_41_0_0_16_1,thisval);
}

on envVar P_FSG_41_0_0_16_1_19
{
	byte bitval;
	//thisval steht hier fuer den bitfield-wert, 
	//aus Generierungsgruenden hier keine einheitliche Bezeichnung moeglich.
	byte thisval[8]; // FctList
	bitval= getValue(this);
	getValue(P_FSG_41_0_0_16_1, thisval);
	thisval[2] = thisval[2]&~(1<<4)|(bitval<<4);
	putValue(P_FSG_41_0_0_16_1,thisval);
}

on envVar P_FSG_41_0_0_16_1_20
{
	byte bitval;
	//thisval steht hier fuer den bitfield-wert, 
	//aus Generierungsgruenden hier keine einheitliche Bezeichnung moeglich.
	byte thisval[8]; // FctList
	bitval= getValue(this);
	getValue(P_FSG_41_0_0_16_1, thisval);
	thisval[2] = thisval[2]&~(1<<3)|(bitval<<3);
	putValue(P_FSG_41_0_0_16_1,thisval);
}

on envVar P_FSG_41_0_0_16_1_21
{
	byte bitval;
	//thisval steht hier fuer den bitfield-wert, 
	//aus Generierungsgruenden hier keine einheitliche Bezeichnung moeglich.
	byte thisval[8]; // FctList
	bitval= getValue(this);
	getValue(P_FSG_41_0_0_16_1, thisval);
	thisval[2] = thisval[2]&~(1<<2)|(bitval<<2);
	putValue(P_FSG_41_0_0_16_1,thisval);
}

on envVar P_FSG_41_0_0_16_1_22
{
	byte bitval;
	//thisval steht hier fuer den bitfield-wert, 
	//aus Generierungsgruenden hier keine einheitliche Bezeichnung moeglich.
	byte thisval[8]; // FctList
	bitval= getValue(this);
	getValue(P_FSG_41_0_0_16_1, thisval);
	thisval[2] = thisval[2]&~(1<<1)|(bitval<<1);
	putValue(P_FSG_41_0_0_16_1,thisval);
}

on envVar P_FSG_41_0_0_16_1_23
{
	byte bitval;
	//thisval steht hier fuer den bitfield-wert, 
	//aus Generierungsgruenden hier keine einheitliche Bezeichnung moeglich.
	byte thisval[8]; // FctList
	bitval= getValue(this);
	getValue(P_FSG_41_0_0_16_1, thisval);
	thisval[2] = thisval[2]&~(1<<0)|(bitval<<0);
	putValue(P_FSG_41_0_0_16_1,thisval);
}

on envVar P_FSG_41_0_0_16_1_24
{
	byte bitval;
	//thisval steht hier fuer den bitfield-wert, 
	//aus Generierungsgruenden hier keine einheitliche Bezeichnung moeglich.
	byte thisval[8]; // FctList
	bitval= getValue(this);
	getValue(P_FSG_41_0_0_16_1, thisval);
	thisval[3] = thisval[3]&~(1<<7)|(bitval<<7);
	putValue(P_FSG_41_0_0_16_1,thisval);
}

on envVar P_FSG_41_0_0_16_1_25
{
	byte bitval;
	//thisval steht hier fuer den bitfield-wert, 
	//aus Generierungsgruenden hier keine einheitliche Bezeichnung moeglich.
	byte thisval[8]; // FctList
	bitval= getValue(this);
	getValue(P_FSG_41_0_0_16_1, thisval);
	thisval[3] = thisval[3]&~(1<<6)|(bitval<<6);
	putValue(P_FSG_41_0_0_16_1,thisval);
}

on envVar P_FSG_41_0_0_16_1_26
{
	byte bitval;
	//thisval steht hier fuer den bitfield-wert, 
	//aus Generierungsgruenden hier keine einheitliche Bezeichnung moeglich.
	byte thisval[8]; // FctList
	bitval= getValue(this);
	getValue(P_FSG_41_0_0_16_1, thisval);
	thisval[3] = thisval[3]&~(1<<5)|(bitval<<5);
	putValue(P_FSG_41_0_0_16_1,thisval);
}

on envVar P_FSG_41_0_0_16_1_27
{
	byte bitval;
	//thisval steht hier fuer den bitfield-wert, 
	//aus Generierungsgruenden hier keine einheitliche Bezeichnung moeglich.
	byte thisval[8]; // FctList
	bitval= getValue(this);
	getValue(P_FSG_41_0_0_16_1, thisval);
	thisval[3] = thisval[3]&~(1<<4)|(bitval<<4);
	putValue(P_FSG_41_0_0_16_1,thisval);
}

on envVar P_FSG_41_0_0_16_1_28
{
	byte bitval;
	//thisval steht hier fuer den bitfield-wert, 
	//aus Generierungsgruenden hier keine einheitliche Bezeichnung moeglich.
	byte thisval[8]; // FctList
	bitval= getValue(this);
	getValue(P_FSG_41_0_0_16_1, thisval);
	thisval[3] = thisval[3]&~(1<<3)|(bitval<<3);
	putValue(P_FSG_41_0_0_16_1,thisval);
}

on envVar P_FSG_41_0_0_16_1_29
{
	byte bitval;
	//thisval steht hier fuer den bitfield-wert, 
	//aus Generierungsgruenden hier keine einheitliche Bezeichnung moeglich.
	byte thisval[8]; // FctList
	bitval= getValue(this);
	getValue(P_FSG_41_0_0_16_1, thisval);
	thisval[3] = thisval[3]&~(1<<2)|(bitval<<2);
	putValue(P_FSG_41_0_0_16_1,thisval);
}

on envVar P_FSG_41_0_0_16_1_30
{
	byte bitval;
	//thisval steht hier fuer den bitfield-wert, 
	//aus Generierungsgruenden hier keine einheitliche Bezeichnung moeglich.
	byte thisval[8]; // FctList
	bitval= getValue(this);
	getValue(P_FSG_41_0_0_16_1, thisval);
	thisval[3] = thisval[3]&~(1<<1)|(bitval<<1);
	putValue(P_FSG_41_0_0_16_1,thisval);
}

on envVar P_FSG_41_0_0_16_1_31
{
	byte bitval;
	//thisval steht hier fuer den bitfield-wert, 
	//aus Generierungsgruenden hier keine einheitliche Bezeichnung moeglich.
	byte thisval[8]; // FctList
	bitval= getValue(this);
	getValue(P_FSG_41_0_0_16_1, thisval);
	thisval[3] = thisval[3]&~(1<<0)|(bitval<<0);
	putValue(P_FSG_41_0_0_16_1,thisval);
}

on envVar P_FSG_41_0_0_16_1_32
{
	byte bitval;
	//thisval steht hier fuer den bitfield-wert, 
	//aus Generierungsgruenden hier keine einheitliche Bezeichnung moeglich.
	byte thisval[8]; // FctList
	bitval= getValue(this);
	getValue(P_FSG_41_0_0_16_1, thisval);
	thisval[4] = thisval[4]&~(1<<7)|(bitval<<7);
	putValue(P_FSG_41_0_0_16_1,thisval);
}

on envVar P_FSG_41_0_0_16_1_33
{
	byte bitval;
	//thisval steht hier fuer den bitfield-wert, 
	//aus Generierungsgruenden hier keine einheitliche Bezeichnung moeglich.
	byte thisval[8]; // FctList
	bitval= getValue(this);
	getValue(P_FSG_41_0_0_16_1, thisval);
	thisval[4] = thisval[4]&~(1<<6)|(bitval<<6);
	putValue(P_FSG_41_0_0_16_1,thisval);
}

on envVar P_FSG_41_0_0_16_1_34
{
	byte bitval;
	//thisval steht hier fuer den bitfield-wert, 
	//aus Generierungsgruenden hier keine einheitliche Bezeichnung moeglich.
	byte thisval[8]; // FctList
	bitval= getValue(this);
	getValue(P_FSG_41_0_0_16_1, thisval);
	thisval[4] = thisval[4]&~(1<<5)|(bitval<<5);
	putValue(P_FSG_41_0_0_16_1,thisval);
}

on envVar P_FSG_41_0_0_16_1_35
{
	byte bitval;
	//thisval steht hier fuer den bitfield-wert, 
	//aus Generierungsgruenden hier keine einheitliche Bezeichnung moeglich.
	byte thisval[8]; // FctList
	bitval= getValue(this);
	getValue(P_FSG_41_0_0_16_1, thisval);
	thisval[4] = thisval[4]&~(1<<4)|(bitval<<4);
	putValue(P_FSG_41_0_0_16_1,thisval);
}

on envVar P_FSG_41_0_0_16_1_36
{
	byte bitval;
	//thisval steht hier fuer den bitfield-wert, 
	//aus Generierungsgruenden hier keine einheitliche Bezeichnung moeglich.
	byte thisval[8]; // FctList
	bitval= getValue(this);
	getValue(P_FSG_41_0_0_16_1, thisval);
	thisval[4] = thisval[4]&~(1<<3)|(bitval<<3);
	putValue(P_FSG_41_0_0_16_1,thisval);
}

on envVar P_FSG_41_0_0_16_1_37
{
	byte bitval;
	//thisval steht hier fuer den bitfield-wert, 
	//aus Generierungsgruenden hier keine einheitliche Bezeichnung moeglich.
	byte thisval[8]; // FctList
	bitval= getValue(this);
	getValue(P_FSG_41_0_0_16_1, thisval);
	thisval[4] = thisval[4]&~(1<<2)|(bitval<<2);
	putValue(P_FSG_41_0_0_16_1,thisval);
}

on envVar P_FSG_41_0_0_16_1_38
{
	byte bitval;
	//thisval steht hier fuer den bitfield-wert, 
	//aus Generierungsgruenden hier keine einheitliche Bezeichnung moeglich.
	byte thisval[8]; // FctList
	bitval= getValue(this);
	getValue(P_FSG_41_0_0_16_1, thisval);
	thisval[4] = thisval[4]&~(1<<1)|(bitval<<1);
	putValue(P_FSG_41_0_0_16_1,thisval);
}

on envVar P_FSG_41_0_0_16_1_39
{
	byte bitval;
	//thisval steht hier fuer den bitfield-wert, 
	//aus Generierungsgruenden hier keine einheitliche Bezeichnung moeglich.
	byte thisval[8]; // FctList
	bitval= getValue(this);
	getValue(P_FSG_41_0_0_16_1, thisval);
	thisval[4] = thisval[4]&~(1<<0)|(bitval<<0);
	putValue(P_FSG_41_0_0_16_1,thisval);
}

on envVar P_FSG_41_0_0_16_1_40
{
	byte bitval;
	//thisval steht hier fuer den bitfield-wert, 
	//aus Generierungsgruenden hier keine einheitliche Bezeichnung moeglich.
	byte thisval[8]; // FctList
	bitval= getValue(this);
	getValue(P_FSG_41_0_0_16_1, thisval);
	thisval[5] = thisval[5]&~(1<<7)|(bitval<<7);
	putValue(P_FSG_41_0_0_16_1,thisval);
}

on envVar P_FSG_41_0_0_16_1_41
{
	byte bitval;
	//thisval steht hier fuer den bitfield-wert, 
	//aus Generierungsgruenden hier keine einheitliche Bezeichnung moeglich.
	byte thisval[8]; // FctList
	bitval= getValue(this);
	getValue(P_FSG_41_0_0_16_1, thisval);
	thisval[5] = thisval[5]&~(1<<6)|(bitval<<6);
	putValue(P_FSG_41_0_0_16_1,thisval);
}

on envVar P_FSG_41_0_0_16_1_42
{
	byte bitval;
	//thisval steht hier fuer den bitfield-wert, 
	//aus Generierungsgruenden hier keine einheitliche Bezeichnung moeglich.
	byte thisval[8]; // FctList
	bitval= getValue(this);
	getValue(P_FSG_41_0_0_16_1, thisval);
	thisval[5] = thisval[5]&~(1<<5)|(bitval<<5);
	putValue(P_FSG_41_0_0_16_1,thisval);
}

on envVar P_FSG_41_0_0_16_1_43
{
	byte bitval;
	//thisval steht hier fuer den bitfield-wert, 
	//aus Generierungsgruenden hier keine einheitliche Bezeichnung moeglich.
	byte thisval[8]; // FctList
	bitval= getValue(this);
	getValue(P_FSG_41_0_0_16_1, thisval);
	thisval[5] = thisval[5]&~(1<<4)|(bitval<<4);
	putValue(P_FSG_41_0_0_16_1,thisval);
}

on envVar P_FSG_41_0_0_16_1_44
{
	byte bitval;
	//thisval steht hier fuer den bitfield-wert, 
	//aus Generierungsgruenden hier keine einheitliche Bezeichnung moeglich.
	byte thisval[8]; // FctList
	bitval= getValue(this);
	getValue(P_FSG_41_0_0_16_1, thisval);
	thisval[5] = thisval[5]&~(1<<3)|(bitval<<3);
	putValue(P_FSG_41_0_0_16_1,thisval);
}

on envVar P_FSG_41_0_0_16_1_45
{
	byte bitval;
	//thisval steht hier fuer den bitfield-wert, 
	//aus Generierungsgruenden hier keine einheitliche Bezeichnung moeglich.
	byte thisval[8]; // FctList
	bitval= getValue(this);
	getValue(P_FSG_41_0_0_16_1, thisval);
	thisval[5] = thisval[5]&~(1<<2)|(bitval<<2);
	putValue(P_FSG_41_0_0_16_1,thisval);
}

on envVar P_FSG_41_0_0_16_1_46
{
	byte bitval;
	//thisval steht hier fuer den bitfield-wert, 
	//aus Generierungsgruenden hier keine einheitliche Bezeichnung moeglich.
	byte thisval[8]; // FctList
	bitval= getValue(this);
	getValue(P_FSG_41_0_0_16_1, thisval);
	thisval[5] = thisval[5]&~(1<<1)|(bitval<<1);
	putValue(P_FSG_41_0_0_16_1,thisval);
}

on envVar P_FSG_41_0_0_16_1_47
{
	byte bitval;
	//thisval steht hier fuer den bitfield-wert, 
	//aus Generierungsgruenden hier keine einheitliche Bezeichnung moeglich.
	byte thisval[8]; // FctList
	bitval= getValue(this);
	getValue(P_FSG_41_0_0_16_1, thisval);
	thisval[5] = thisval[5]&~(1<<0)|(bitval<<0);
	putValue(P_FSG_41_0_0_16_1,thisval);
}

on envVar P_FSG_41_0_0_16_1_48
{
	byte bitval;
	//thisval steht hier fuer den bitfield-wert, 
	//aus Generierungsgruenden hier keine einheitliche Bezeichnung moeglich.
	byte thisval[8]; // FctList
	bitval= getValue(this);
	getValue(P_FSG_41_0_0_16_1, thisval);
	thisval[6] = thisval[6]&~(1<<7)|(bitval<<7);
	putValue(P_FSG_41_0_0_16_1,thisval);
}

on envVar P_FSG_41_0_0_16_1_49
{
	byte bitval;
	//thisval steht hier fuer den bitfield-wert, 
	//aus Generierungsgruenden hier keine einheitliche Bezeichnung moeglich.
	byte thisval[8]; // FctList
	bitval= getValue(this);
	getValue(P_FSG_41_0_0_16_1, thisval);
	thisval[6] = thisval[6]&~(1<<6)|(bitval<<6);
	putValue(P_FSG_41_0_0_16_1,thisval);
}

on envVar P_FSG_41_0_0_16_1_50
{
	byte bitval;
	//thisval steht hier fuer den bitfield-wert, 
	//aus Generierungsgruenden hier keine einheitliche Bezeichnung moeglich.
	byte thisval[8]; // FctList
	bitval= getValue(this);
	getValue(P_FSG_41_0_0_16_1, thisval);
	thisval[6] = thisval[6]&~(1<<5)|(bitval<<5);
	putValue(P_FSG_41_0_0_16_1,thisval);
}

on envVar P_FSG_41_0_0_16_1_51
{
	byte bitval;
	//thisval steht hier fuer den bitfield-wert, 
	//aus Generierungsgruenden hier keine einheitliche Bezeichnung moeglich.
	byte thisval[8]; // FctList
	bitval= getValue(this);
	getValue(P_FSG_41_0_0_16_1, thisval);
	thisval[6] = thisval[6]&~(1<<4)|(bitval<<4);
	putValue(P_FSG_41_0_0_16_1,thisval);
}

on envVar P_FSG_41_0_0_16_1 // MobileServiceSupport.FctList
{
	P_FSG_41_0_0_16_BuildFct();
}

// Ruecksetzen des Fehlerstatus durch manuelle Fehlereingabe
on envVar P_FSG_41_0_0_17_ErrCode
{
       if(gP_FSG_41_0_0_17_ErrCode) 
       {
           setControlBackColor(panel_name,"errfield_P_FSG_41_0_0_17", MakeRGB(255,255,255));
       }
       gP_FSG_41_0_0_17_ErrCode = 1;
}
on envVar P_FSG_41_0_0_17Status_BTN
{
	byte BAPTemp[3];
   if (P_FSG_41_0_0_17Status_BTN_already_pressed == 0)
   {
      putValue(P_FSG_41_0_0_17_ErrCode,0);
      SetControlBackColor(panel_name,"errField_P_FSG_41_0_0_17",MakeRGB(255,255,255));
      P_FSG_41_0_0_17Status_BTN_already_pressed = 1;
   }
   else
   {
      getValue(P_FSG_41_0_0_17, BAPTemp);
      Request_ByteSequence(LSGID, P_FSG_41_0_0_17_ID, Data_REQ, BAPTemp, getValueSize(P_FSG_41_0_0_17));
      P_FSG_41_0_0_17Status_BTN_already_pressed = 0;
   }
}
on envVar P_FSG_41_0_0_17_FctEn
{
    long data[3];
    data[0]=LSGID;
    data[1]=P_FSG_41_0_0_17_ID;
    data[2]=getValue(P_FSG_41_0_0_17_FctEn);
    ChangeConfig(0x0031,data);
}
// De-Aktivierung der Eingabefelder der FCTID P_FSG_41_0_0_17
on envVar P_FSG_41_0_0_17_FctLstItemEn
{
       if(getValue(this)) 
       {
           EnableControl(panel_name,"panel_FSG_41_0_0_17",1);
           EnableControl(panel_name,"errfield_P_FSG_41_0_0_17",1);
           EnableControl(panel_name,"panel_P_FSG_41_0_0_17",1);
           setControlForeColor(panel_name, "checkbox_P_FSG_41_0_0_17", MakeRGB(0,240,0));
       }
       else
       {
           EnableControl(panel_name,"panel_FSG_41_0_0_17",0);
           EnableControl(panel_name,"errfield_P_FSG_41_0_0_17",0);
           EnableControl(panel_name,"panel_P_FSG_41_0_0_17",0);
           setControlForeColor(panel_name, "checkbox_P_FSG_41_0_0_17", MakeRGB(250,0,0));
       }
}
on envVar P_FSG_41_0_0_17 // bus value of RegisterState2 (17).
{
	// opcodes: Error-Status
	byte param1; // RegisterState
	byte param2; // NetworkType
	byte param3; // PacketDataNetworkType
	// DATATYPE_BYTESEQUENCE / DATATYPE_FIXEDBYTESEQUENCE
	int i;
	byte superval[3];
	int currentPos;
	currentPos = 0;
	for( i = 0; i < 3; i++ ) {
		superval[i] = 0;
	}
	getValue(P_FSG_41_0_0_17, superval);
	///////// Start param1 - UINT8 /////////
	param1 = superval[currentPos++];
	putValue(P_FSG_41_0_0_17_1, param1);
	///////// Start param2 - UINT8 /////////
	param2 = superval[currentPos++];
	putValue(P_FSG_41_0_0_17_2, param2);
	///////// Start param3 - UINT8 /////////
	param3 = superval[currentPos++];
	putValue(P_FSG_41_0_0_17_3, param3);
}

on envVar P_FSG_41_0_0_17_1 // RegisterState2.RegisterState
{
	byte superval[3];

	//Update Childvalue (Enum)
	byte thisval; // RegisterState
	thisval = getValue(this);

    // Update superval
	getValue(P_FSG_41_0_0_17, superval);
	superval[0]=thisval;
	putValue(P_FSG_41_0_0_17,superval);
}

on envVar P_FSG_41_0_0_17_2 // RegisterState2.NetworkType
{
	byte superval[3];

	//Update Childvalue (Enum)
	byte thisval; // NetworkType
	thisval = getValue(this);

    // Update superval
	getValue(P_FSG_41_0_0_17, superval);
	superval[1]=thisval;
	putValue(P_FSG_41_0_0_17,superval);
}

on envVar P_FSG_41_0_0_17_3 // RegisterState2.PacketDataNetworkType
{
	byte superval[3];

	//Update Childvalue (Enum)
	byte thisval; // PacketDataNetworkType
	thisval = getValue(this);

    // Update superval
	getValue(P_FSG_41_0_0_17, superval);
	superval[2]=thisval;
	putValue(P_FSG_41_0_0_17,superval);
}

// Ruecksetzen des Fehlerstatus durch manuelle Fehlereingabe
on envVar P_FSG_41_0_0_18_ErrCode
{
       if(gP_FSG_41_0_0_18_ErrCode) 
       {
           setControlBackColor(panel_name,"errfield_P_FSG_41_0_0_18", MakeRGB(255,255,255));
       }
       gP_FSG_41_0_0_18_ErrCode = 1;
}
on envVar P_FSG_41_0_0_18Status_BTN
{
    if (P_FSG_41_0_0_18Status_BTN_already_pressed == 0)
    {
       putValue(P_FSG_41_0_0_18_ErrCode,0);
       SetControlBackColor(panel_name,"errField_P_FSG_41_0_0_18",MakeRGB(255,255,255));
       P_FSG_41_0_0_18Status_BTN_already_pressed = 1;
    }
    else
    {
       Request_Int8(LSGID, P_FSG_41_0_0_18_ID, Data_REQ, getValue(P_FSG_41_0_0_18));
      P_FSG_41_0_0_18Status_BTN_already_pressed = 0;
    }
}
on envVar P_FSG_41_0_0_18_FctEn
{
    long data[3];
    data[0]=LSGID;
    data[1]=P_FSG_41_0_0_18_ID;
    data[2]=getValue(P_FSG_41_0_0_18_FctEn);
    ChangeConfig(0x0031,data);
}
// De-Aktivierung der Eingabefelder der FCTID P_FSG_41_0_0_18
on envVar P_FSG_41_0_0_18_FctLstItemEn
{
       if(getValue(this)) 
       {
           EnableControl(panel_name,"panel_FSG_41_0_0_18",1);
           EnableControl(panel_name,"errfield_P_FSG_41_0_0_18",1);
           EnableControl(panel_name,"panel_P_FSG_41_0_0_18",1);
           setControlForeColor(panel_name, "checkbox_P_FSG_41_0_0_18", MakeRGB(0,240,0));
       }
       else
       {
           EnableControl(panel_name,"panel_FSG_41_0_0_18",0);
           EnableControl(panel_name,"errfield_P_FSG_41_0_0_18",0);
           EnableControl(panel_name,"panel_P_FSG_41_0_0_18",0);
           setControlForeColor(panel_name, "checkbox_P_FSG_41_0_0_18", MakeRGB(250,0,0));
       }
}
on envVar P_FSG_41_0_0_18 // bus value of LockState2 (18).
{
	// opcodes: Error-Status
	byte param1; // LockState
	// DATATYPE_UINTXX
	param1 = getValue(P_FSG_41_0_0_18);
	putValue(P_FSG_41_0_0_18_1, param1);
}

on envVar P_FSG_41_0_0_18_1 // LockState2.LockState
{
	byte superval;

	//Update Childvalue (Enum)
	byte thisval; // LockState
	thisval = getValue(this);

    // Update superval
	superval = getValue(P_FSG_41_0_0_18);
	superval = thisval;
	putValue(P_FSG_41_0_0_18,superval);
}

// Ruecksetzen des Fehlerstatus durch manuelle Fehlereingabe
on envVar P_FSG_41_0_0_19_ErrCode
{
       if(gP_FSG_41_0_0_19_ErrCode) 
       {
           setControlBackColor(panel_name,"errfield_P_FSG_41_0_0_19", MakeRGB(255,255,255));
       }
       gP_FSG_41_0_0_19_ErrCode = 1;
}
on envVar P_FSG_41_0_0_19Status_BTN
{
	byte BAPTemp[82];
    if (P_FSG_41_0_0_19Status_BTN_already_pressed == 0)
    {
        putValue(P_FSG_41_0_0_19_ErrCode,0);
        SetControlBackColor(panel_name,"errField_P_FSG_41_0_0_19",MakeRGB(255,255,255));
        P_FSG_41_0_0_19Status_BTN_already_pressed = 1;
    }
    else
    {
		P_FSG_41_0_0_19_BuildFct();
        getValue(P_FSG_41_0_0_19, BAPTemp);
        Request_ByteSequence(LSGID, P_FSG_41_0_0_19_ID, Data_REQ, BAPTemp, getValueSize(P_FSG_41_0_0_19));
        if(getValue(P_FSG_41_0_0_19_IntTlgEn)) //getValue(IT))
        {
           intertelegram_err(P_FSG_41_0_0_19_ID);
        }
        if(getValue(P_FSG_41_0_0_19_SegmEn))   //getvalue(SG)
        {
           sequence_err(P_FSG_41_0_0_19_ID,elCount(BAPTemp));
        }
       P_FSG_41_0_0_19Status_BTN_already_pressed = 0;
    }
}
on envVar P_FSG_41_0_0_19_FctEn
{
    long data[3];
    data[0]=LSGID;
    data[1]=P_FSG_41_0_0_19_ID;
    data[2]=getValue(P_FSG_41_0_0_19_FctEn);
    ChangeConfig(0x0031,data);
}
// De-Aktivierung der Eingabefelder der FCTID P_FSG_41_0_0_19
on envVar P_FSG_41_0_0_19_FctLstItemEn
{
       if(getValue(this)) 
       {
           EnableControl(panel_name,"panel_FSG_41_0_0_19",1);
           EnableControl(panel_name,"errfield_P_FSG_41_0_0_19",1);
           EnableControl(panel_name,"panel_P_FSG_41_0_0_19",1);
           setControlForeColor(panel_name, "checkbox_P_FSG_41_0_0_19", MakeRGB(0,240,0));
       }
       else
       {
           EnableControl(panel_name,"panel_FSG_41_0_0_19",0);
           EnableControl(panel_name,"errfield_P_FSG_41_0_0_19",0);
           EnableControl(panel_name,"panel_P_FSG_41_0_0_19",0);
           setControlForeColor(panel_name, "checkbox_P_FSG_41_0_0_19", MakeRGB(250,0,0));
       }
}
// Man darf gleichzeitig nur Checkbox fuer SegmError oder IntertelegramError aktiviert werden
on envVar P_FSG_41_0_0_19_IntTlgEn
{
       if(getValue(this)) 
       {
           putValue(P_FSG_41_0_0_19_SegmEn,0);
           intertelegram_err(P_FSG_41_0_0_19_ID);
       }
       else
       {
           intertelegram_err_off(P_FSG_41_0_0_19_ID);
       }
}
// Man darf gleichzeitig nur Checkbox fuer SegmError oder IntertelegramError aktiviert werden
on envVar P_FSG_41_0_0_19_SegmEn
{
       if(getValue(this)) 
       {
           putValue(P_FSG_41_0_0_19_IntTlgEn,0);
           sequence_err(P_FSG_41_0_0_19_ID,getValueSize(P_FSG_41_0_0_19_SegmEn));
       }
       else
       {
              sequence_err_off(P_FSG_41_0_0_19_ID);
       }
}
on envVar P_FSG_41_0_0_19 // bus value of NetworkProvider2 (19).
{
	// opcodes: Error-Status
	byte param1; // NetworkProviderState
	byte param2[40]; // NetworkProviderName
	word len2;
	byte cnt2;
	byte param3; // ServiceProviderState
	byte param4[40]; // ServiceProviderName
	word len4;
	byte cnt4;
	// DATATYPE_BYTESEQUENCE / DATATYPE_FIXEDBYTESEQUENCE
	int i;
	byte superval[82];
	int currentPos;
	currentPos = 0;
	for( i = 0; i < 82; i++ ) {
		superval[i] = 0;
	}
	getValue(P_FSG_41_0_0_19, superval);
	///////// Start param1 - UINT8 /////////
	param1 = superval[currentPos++];
	putValue(P_FSG_41_0_0_19_1, param1);
	///////// Start param2 - STRING /////////
	getValue(P_FSG_41_0_0_19_2_Hex, param2);
	if((superval[currentPos] & 0x80) > 0)
	{
		if(39>127) /* Max Fct-Katalog Laenge: 39*/
		{
			len2 = ( (superval[currentPos]&0x7F) <<8) + superval[currentPos+1];
			currentPos = currentPos + 2;
			cnt2 = 1;
		}
		else
		{
			len2 = 39;
			writelineEx(gBAP_Trace, 0, "Anzahl der Laengeninformation-Bytes in P_FSG_41_0_0_19 ueberschreitet die erlaubte 1 Byte vom Fct-Kalatog.");
		}
	}
	else
	{
		len2 = superval[currentPos]&0x7F;
		currentPos = currentPos + 1;
		cnt2 = 0;
	}
	
	if(len2 > 39)
	{
		writelineEx(gBAP_Trace, 0, "Laenge:%d bei der Byte Position:%d ueberschreitet die Maximale erlaubte Laenge von Fct-Kalatog", len2, currentPos);
		len2 = 39;
	
		if(len2 < 128) cnt2 = 0;
		else cnt2 = 1;
	}
	
	for(i = 0; i < len2; i++)
	{
		param2[i] = superval[currentPos++];
	}
	
	putValue(P_FSG_41_0_0_19_2_len, len2);
	putValue(P_FSG_41_0_0_19_2_cnt, cnt2);
	
	if(len2 > getValueSize(P_FSG_41_0_0_19_2_Hex))
		putValue(P_FSG_41_0_0_19_2_Hex, param2, len2);
	else
		putValue(P_FSG_41_0_0_19_2_Hex, param2, getValueSize(P_FSG_41_0_0_19_2_Hex));

	///////// Start param3 - UINT8 /////////
	param3 = superval[currentPos++];
	putValue(P_FSG_41_0_0_19_3, param3);
	///////// Start param4 - STRING /////////
	getValue(P_FSG_41_0_0_19_4_Hex, param4);
	if((superval[currentPos] & 0x80) > 0)
	{
		if(39>127) /* Max Fct-Katalog Laenge: 39*/
		{
			len4 = ( (superval[currentPos]&0x7F) <<8) + superval[currentPos+1];
			currentPos = currentPos + 2;
			cnt4 = 1;
		}
		else
		{
			len4 = 39;
			writelineEx(gBAP_Trace, 0, "Anzahl der Laengeninformation-Bytes in P_FSG_41_0_0_19 ueberschreitet die erlaubte 1 Byte vom Fct-Kalatog.");
		}
	}
	else
	{
		len4 = superval[currentPos]&0x7F;
		currentPos = currentPos + 1;
		cnt4 = 0;
	}
	
	if(len4 > 39)
	{
		writelineEx(gBAP_Trace, 0, "Laenge:%d bei der Byte Position:%d ueberschreitet die Maximale erlaubte Laenge von Fct-Kalatog", len4, currentPos);
		len4 = 39;
	
		if(len4 < 128) cnt4 = 0;
		else cnt4 = 1;
	}
	
	for(i = 0; i < len4; i++)
	{
		param4[i] = superval[currentPos++];
	}
	
	putValue(P_FSG_41_0_0_19_4_len, len4);
	putValue(P_FSG_41_0_0_19_4_cnt, cnt4);
	
	if(len4 > getValueSize(P_FSG_41_0_0_19_4_Hex))
		putValue(P_FSG_41_0_0_19_4_Hex, param4, len4);
	else
		putValue(P_FSG_41_0_0_19_4_Hex, param4, getValueSize(P_FSG_41_0_0_19_4_Hex));

}

// Updates the bus value field and other dependencies.
P_FSG_41_0_0_19_BuildFct()
{
	byte param1; // NetworkProviderState
	byte param2[40]; // NetworkProviderName
	word len2;
	byte cnt2;
	byte param3; // ServiceProviderState
	byte param4[40]; // ServiceProviderName
	word len4;
	byte cnt4;

	int i;
	byte superval[82];
	int currentPos;
	currentPos = 0;
// gen_BuildFunc_SetSuperVals 
	param1 = getValue(P_FSG_41_0_0_19_1);
	superval[currentPos++]=param1;
// gen_BuildFunc_SetSuperVals 
	getValue(P_FSG_41_0_0_19_2_Hex, param2);
	len2 = getValue(P_FSG_41_0_0_19_2_len);
	cnt2= getValue(P_FSG_41_0_0_19_2_cnt);
	
	/* check box aktiviert*/
	if (cnt2 == 1)
	{
		/* 0 bis 39 (MaxString - 1B oder 2B) */
		if(len2 >= 0 && len2 <= 39)
		{
			//writelineEx(gBAP_Trace, 0, "[Debug-1] Len2: %d", len2);
			superval[currentPos] = (len2&0x7f00) | 0x80;
			superval[currentPos+1] = len2 & 0x00ff;
		}
		else
		{
			writelineEx(gBAP_Trace, 0, "Eingegebene Laenge: %d von P_FSG_41_0_0_19_2 ist ungueltig. Die max. erlaubte Laenge ist %d.", len2, 39);
			return;
		}
	}
	else if(cnt2 == 0) /*check box deaktiviert*/
	{
		if(len2 >= 0 && len2 <= 127)
		{
			//writelineEx(gBAP_Trace, 0, "[Debug-1] Len2: %d", len2);
			superval[currentPos]= len2 & 0x00ff;
			putValue(P_FSG_41_0_0_19_2_len, len2);
		}
		else if(len2 > 127 && len2 <= 39)
		{
			superval[currentPos] = (len2&0x7f00) | 0x80;
			superval[currentPos+1] = len2 & 0x00ff;
			putValue(P_FSG_41_0_0_19_2_len, len2);
			putValue(P_FSG_41_0_0_19_2_cnt, 1);
		}
		else
		{
			writelineEx(gBAP_Trace, 0, "Eingegebene Laenge: %d von P_FSG_41_0_0_19_2 ist ungueltig. Die max. erlaubte Laenge ist %d.", len2, 39);
			return;
		}
	}
	currentPos += cnt2+1;
	for(i = 0; i < len2; i++)
	{
		superval[currentPos++]= param2[i];
	}

// gen_BuildFunc_SetSuperVals 
	param3 = getValue(P_FSG_41_0_0_19_3);
	superval[currentPos++]=param3;
// gen_BuildFunc_SetSuperVals 
	getValue(P_FSG_41_0_0_19_4_Hex, param4);
	len4 = getValue(P_FSG_41_0_0_19_4_len);
	cnt4= getValue(P_FSG_41_0_0_19_4_cnt);
	
	/* check box aktiviert*/
	if (cnt4 == 1)
	{
		/* 0 bis 39 (MaxString - 1B oder 2B) */
		if(len4 >= 0 && len4 <= 39)
		{
			//writelineEx(gBAP_Trace, 0, "[Debug-1] Len4: %d", len4);
			superval[currentPos] = (len4&0x7f00) | 0x80;
			superval[currentPos+1] = len4 & 0x00ff;
		}
		else
		{
			writelineEx(gBAP_Trace, 0, "Eingegebene Laenge: %d von P_FSG_41_0_0_19_4 ist ungueltig. Die max. erlaubte Laenge ist %d.", len4, 39);
			return;
		}
	}
	else if(cnt4 == 0) /*check box deaktiviert*/
	{
		if(len4 >= 0 && len4 <= 127)
		{
			//writelineEx(gBAP_Trace, 0, "[Debug-1] Len4: %d", len4);
			superval[currentPos]= len4 & 0x00ff;
			putValue(P_FSG_41_0_0_19_4_len, len4);
		}
		else if(len4 > 127 && len4 <= 39)
		{
			superval[currentPos] = (len4&0x7f00) | 0x80;
			superval[currentPos+1] = len4 & 0x00ff;
			putValue(P_FSG_41_0_0_19_4_len, len4);
			putValue(P_FSG_41_0_0_19_4_cnt, 1);
		}
		else
		{
			writelineEx(gBAP_Trace, 0, "Eingegebene Laenge: %d von P_FSG_41_0_0_19_4 ist ungueltig. Die max. erlaubte Laenge ist %d.", len4, 39);
			return;
		}
	}
	currentPos += cnt4+1;
	for(i = 0; i < len4; i++)
	{
		superval[currentPos++]= param4[i];
	}

	putValue(P_FSG_41_0_0_19, superval, currentPos);
}


on envVar P_FSG_41_0_0_19_1 // NetworkProvider2.NetworkProviderState
{
	P_FSG_41_0_0_19_BuildFct();
}


// Ueberwachung der CheckBox fuer String
on envVar  P_FSG_41_0_0_19_2_cnt
{
	word len;
	byte cnt;
	len = getValue(P_FSG_41_0_0_19_2_len);
	cnt = getValue(P_FSG_41_0_0_19_2_cnt);

	/* wird nur gerufen, wenn check box deaktiviert mit Length>127*/ 
	if( cnt == 0) 
	{
		if(len > 127 )
		{
			putValue(P_FSG_41_0_0_19_2_len, 127);
		}
	}

	P_FSG_41_0_0_19_BuildFct();
}



// Ueberwachung der Eingabefeld fuer String Data
on envVar P_FSG_41_0_0_19_2_len
{
	word len;
	len = getValue(this);
	/* Validierung der Eingabe*/
	if(len > 39)
	{
		writelineEx(gBAP_Trace, 0, "Eingegebene Laenge: %d von P_FSG_41_0_0_19_2 ist ungueltig. Die max. erlaubte Laenge ist %d. ", len, 39);
		putValue(this, 39);
	}
	P_FSG_41_0_0_19_BuildFct();
}


on envVar P_FSG_41_0_0_19_2 // NetworkProvider2.NetworkProviderName
{
	int j, offset;
  int temp;
  int string_length_org;
  int string_length_mod;
  byte string_buffer_org[255];
  byte string_buffer_mod[255];
  
  //Start-Länge
  string_length_org = getValueSize(this);
  string_length_mod = string_length_org;
  
  //Start-String in Buffer
  getvalue(this,string_buffer_org);
  
  //Buffer auf Sonderzeichen checken und ersetzen
  offset = 0;
  for (j=0;j<string_length_org;j++)
  {
    if ( string_buffer_org[j] >= 0x80 && string_buffer_org[j] <= 0xBF ) 
    {
      temp = string_buffer_org[j] + 0xC200;
      
      string_buffer_mod[j+offset] = temp>>8;
      string_buffer_mod[j+offset+1] = temp;
      offset++;
      string_length_mod++;
    }
    else if ( string_buffer_org[j] >= 0xC0 && string_buffer_org[j] <= 0xFF ) 
    {
      temp = string_buffer_org[j] + 0xC2C0;
      
      string_buffer_mod[j+offset] = temp>>8;
      string_buffer_mod[j+offset+1] = temp;
      offset++;
      string_length_mod++;
    }
    else
      string_buffer_mod[j+offset] = string_buffer_org[j];
  }
    
  //neuen String schreiben
  putvalue(P_FSG_41_0_0_19_2_Hex,string_buffer_mod,string_length_mod);
  putValue(P_FSG_41_0_0_19_2_len, string_length_mod);
}

on envVar P_FSG_41_0_0_19_3 // NetworkProvider2.ServiceProviderState
{
	P_FSG_41_0_0_19_BuildFct();
}


// Ueberwachung der CheckBox fuer String
on envVar  P_FSG_41_0_0_19_4_cnt
{
	word len;
	byte cnt;
	len = getValue(P_FSG_41_0_0_19_4_len);
	cnt = getValue(P_FSG_41_0_0_19_4_cnt);

	/* wird nur gerufen, wenn check box deaktiviert mit Length>127*/ 
	if( cnt == 0) 
	{
		if(len > 127 )
		{
			putValue(P_FSG_41_0_0_19_4_len, 127);
		}
	}

	P_FSG_41_0_0_19_BuildFct();
}



// Ueberwachung der Eingabefeld fuer String Data
on envVar P_FSG_41_0_0_19_4_len
{
	word len;
	len = getValue(this);
	/* Validierung der Eingabe*/
	if(len > 39)
	{
		writelineEx(gBAP_Trace, 0, "Eingegebene Laenge: %d von P_FSG_41_0_0_19_4 ist ungueltig. Die max. erlaubte Laenge ist %d. ", len, 39);
		putValue(this, 39);
	}
	P_FSG_41_0_0_19_BuildFct();
}


on envVar P_FSG_41_0_0_19_4 // NetworkProvider2.ServiceProviderName
{
	int j, offset;
  int temp;
  int string_length_org;
  int string_length_mod;
  byte string_buffer_org[255];
  byte string_buffer_mod[255];
  
  //Start-Länge
  string_length_org = getValueSize(this);
  string_length_mod = string_length_org;
  
  //Start-String in Buffer
  getvalue(this,string_buffer_org);
  
  //Buffer auf Sonderzeichen checken und ersetzen
  offset = 0;
  for (j=0;j<string_length_org;j++)
  {
    if ( string_buffer_org[j] >= 0x80 && string_buffer_org[j] <= 0xBF ) 
    {
      temp = string_buffer_org[j] + 0xC200;
      
      string_buffer_mod[j+offset] = temp>>8;
      string_buffer_mod[j+offset+1] = temp;
      offset++;
      string_length_mod++;
    }
    else if ( string_buffer_org[j] >= 0xC0 && string_buffer_org[j] <= 0xFF ) 
    {
      temp = string_buffer_org[j] + 0xC2C0;
      
      string_buffer_mod[j+offset] = temp>>8;
      string_buffer_mod[j+offset+1] = temp;
      offset++;
      string_length_mod++;
    }
    else
      string_buffer_mod[j+offset] = string_buffer_org[j];
  }
    
  //neuen String schreiben
  putvalue(P_FSG_41_0_0_19_4_Hex,string_buffer_mod,string_length_mod);
  putValue(P_FSG_41_0_0_19_4_len, string_length_mod);
}

// Ruecksetzen des Fehlerstatus durch manuelle Fehlereingabe
on envVar P_FSG_41_0_0_20_ErrCode
{
       if(gP_FSG_41_0_0_20_ErrCode) 
       {
           setControlBackColor(panel_name,"errfield_P_FSG_41_0_0_20", MakeRGB(255,255,255));
       }
       gP_FSG_41_0_0_20_ErrCode = 1;
}
on envVar P_FSG_41_0_0_20Status_BTN
{
    if (P_FSG_41_0_0_20Status_BTN_already_pressed == 0)
    {
       putValue(P_FSG_41_0_0_20_ErrCode,0);
       SetControlBackColor(panel_name,"errField_P_FSG_41_0_0_20",MakeRGB(255,255,255));
       P_FSG_41_0_0_20Status_BTN_already_pressed = 1;
    }
    else
    {
       Request_Int8(LSGID, P_FSG_41_0_0_20_ID, Data_REQ, getValue(P_FSG_41_0_0_20));
      P_FSG_41_0_0_20Status_BTN_already_pressed = 0;
    }
}
on envVar P_FSG_41_0_0_20_FctEn
{
    long data[3];
    data[0]=LSGID;
    data[1]=P_FSG_41_0_0_20_ID;
    data[2]=getValue(P_FSG_41_0_0_20_FctEn);
    ChangeConfig(0x0031,data);
}
// De-Aktivierung der Eingabefelder der FCTID P_FSG_41_0_0_20
on envVar P_FSG_41_0_0_20_FctLstItemEn
{
       if(getValue(this)) 
       {
           EnableControl(panel_name,"panel_FSG_41_0_0_20",1);
           EnableControl(panel_name,"errfield_P_FSG_41_0_0_20",1);
           EnableControl(panel_name,"panel_P_FSG_41_0_0_20",1);
           setControlForeColor(panel_name, "checkbox_P_FSG_41_0_0_20", MakeRGB(0,240,0));
       }
       else
       {
           EnableControl(panel_name,"panel_FSG_41_0_0_20",0);
           EnableControl(panel_name,"errfield_P_FSG_41_0_0_20",0);
           EnableControl(panel_name,"panel_P_FSG_41_0_0_20",0);
           setControlForeColor(panel_name, "checkbox_P_FSG_41_0_0_20", MakeRGB(250,0,0));
       }
}
on envVar P_FSG_41_0_0_20 // bus value of SignalQuality2 (20).
{
	// opcodes: Error-Status
	byte param1; // Quality
	// DATATYPE_UINTXX
	param1 = getValue(P_FSG_41_0_0_20);
	putValue(P_FSG_41_0_0_20_1, round((param1 * 1.0) - (0) + (0), 1.0));
}

// Ueberwachung der Darstellungsvariable der Range.
on envVar P_FSG_41_0_0_20_1_range // SignalQuality2.Quality 
{
	@P_FSG_41_0_0_20_1 = @P_FSG_41_0_0_20_1_range - (0); // slider = range - min
}

on envVar P_FSG_41_0_0_20_1 // SignalQuality2.Quality
{
	byte superval;

	//Update Childvalue (Number)
	byte thisval; // Quality
	float slider_value;

	slider_value = round(@P_FSG_41_0_0_20_1, 1.0);
	@P_FSG_41_0_0_20_1_range = slider_value + (0); // real value := slider value + range min.
	thisval = (byte)round((slider_value + (0) - (0)) / (1.0), 1); // bus value := (slider value + min - offset) / step.

    // Update superval
	superval = getValue(P_FSG_41_0_0_20);
	superval = thisval;
	putValue(P_FSG_41_0_0_20,superval);
}

// Ruecksetzen des Fehlerstatus durch manuelle Fehlereingabe
on envVar P_FSG_41_0_0_21_ErrCode
{
       if(gP_FSG_41_0_0_21_ErrCode) 
       {
           setControlBackColor(panel_name,"errfield_P_FSG_41_0_0_21", MakeRGB(255,255,255));
       }
       gP_FSG_41_0_0_21_ErrCode = 1;
}
on envVar P_FSG_41_0_0_21Status_BTN
{
	byte BAPTemp[9];
    if (P_FSG_41_0_0_21Status_BTN_already_pressed == 0)
    {
        putValue(P_FSG_41_0_0_21_ErrCode,0);
        SetControlBackColor(panel_name,"errField_P_FSG_41_0_0_21",MakeRGB(255,255,255));
        P_FSG_41_0_0_21Status_BTN_already_pressed = 1;
    }
    else
    {
		P_FSG_41_0_0_21_BuildFct();
        getValue(P_FSG_41_0_0_21, BAPTemp);
        Request_ByteSequence(LSGID, P_FSG_41_0_0_21_ID, Data_REQ, BAPTemp, getValueSize(P_FSG_41_0_0_21));
        if(getValue(P_FSG_41_0_0_21_IntTlgEn)) //getValue(IT))
        {
           intertelegram_err(P_FSG_41_0_0_21_ID);
        }
        if(getValue(P_FSG_41_0_0_21_SegmEn))   //getvalue(SG)
        {
           sequence_err(P_FSG_41_0_0_21_ID,elCount(BAPTemp));
        }
       P_FSG_41_0_0_21Status_BTN_already_pressed = 0;
    }
}
on envVar P_FSG_41_0_0_21_FctEn
{
    long data[3];
    data[0]=LSGID;
    data[1]=P_FSG_41_0_0_21_ID;
    data[2]=getValue(P_FSG_41_0_0_21_FctEn);
    ChangeConfig(0x0031,data);
}
// De-Aktivierung der Eingabefelder der FCTID P_FSG_41_0_0_21
on envVar P_FSG_41_0_0_21_FctLstItemEn
{
       if(getValue(this)) 
       {
           EnableControl(panel_name,"panel_FSG_41_0_0_21",1);
           EnableControl(panel_name,"errfield_P_FSG_41_0_0_21",1);
           EnableControl(panel_name,"panel_P_FSG_41_0_0_21",1);
           setControlForeColor(panel_name, "checkbox_P_FSG_41_0_0_21", MakeRGB(0,240,0));
       }
       else
       {
           EnableControl(panel_name,"panel_FSG_41_0_0_21",0);
           EnableControl(panel_name,"errfield_P_FSG_41_0_0_21",0);
           EnableControl(panel_name,"panel_P_FSG_41_0_0_21",0);
           setControlForeColor(panel_name, "checkbox_P_FSG_41_0_0_21", MakeRGB(250,0,0));
       }
}
// Man darf gleichzeitig nur Checkbox fuer SegmError oder IntertelegramError aktiviert werden
on envVar P_FSG_41_0_0_21_IntTlgEn
{
       if(getValue(this)) 
       {
           putValue(P_FSG_41_0_0_21_SegmEn,0);
           intertelegram_err(P_FSG_41_0_0_21_ID);
       }
       else
       {
           intertelegram_err_off(P_FSG_41_0_0_21_ID);
       }
}
// Man darf gleichzeitig nur Checkbox fuer SegmError oder IntertelegramError aktiviert werden
on envVar P_FSG_41_0_0_21_SegmEn
{
       if(getValue(this)) 
       {
           putValue(P_FSG_41_0_0_21_IntTlgEn,0);
           sequence_err(P_FSG_41_0_0_21_ID,getValueSize(P_FSG_41_0_0_21_SegmEn));
       }
       else
       {
              sequence_err_off(P_FSG_41_0_0_21_ID);
       }
}
on envVar P_FSG_41_0_0_21 // bus value of DataConnectionIndication2 (21).
{
	// opcodes: Error-Status
	byte param1; // ConnectionIndication
	dword param2; // DataVolumeUplink
	dword param3; // DataVolumeDownlink
	// DATATYPE_BYTESEQUENCE / DATATYPE_FIXEDBYTESEQUENCE
	int i;
	byte superval[9];
	int currentPos;
	currentPos = 0;
	for( i = 0; i < 9; i++ ) {
		superval[i] = 0;
	}
	getValue(P_FSG_41_0_0_21, superval);
	///////// Start param1 - UINT8 /////////
	param1 = superval[currentPos++];
	putValue(P_FSG_41_0_0_21_1, param1);
	///////// Start param2 - UINT32 /////////
	param2 = superval[currentPos++]|(superval[currentPos++]<<8)|(superval[currentPos++]<<16)|(superval[currentPos++]<<24);
	putValue(P_FSG_41_0_0_21_2, round((param2 * 1.0) - (0) + (0), 1.0));
	///////// Start param3 - UINT32 /////////
	param3 = superval[currentPos++]|(superval[currentPos++]<<8)|(superval[currentPos++]<<16)|(superval[currentPos++]<<24);
	putValue(P_FSG_41_0_0_21_3, round((param3 * 1.0) - (0) + (0), 1.0));
}

// Updates the bus value field and other dependencies.
P_FSG_41_0_0_21_BuildFct()
{
	byte param1; // ConnectionIndication
	dword param2; // DataVolumeUplink
	dword param3; // DataVolumeDownlink

	int i;
	byte superval[9];
	int currentPos;
	currentPos = 0;
// gen_BuildFunc_SetSuperVals 
	param1 = getValue(P_FSG_41_0_0_21_1);
	superval[currentPos++]=param1;
// gen_BuildFunc_SetSuperVals 
	@P_FSG_41_0_0_21_2_range = round(@P_FSG_41_0_0_21_2 + (0), 1.0); // slider value + min = real value
	param2 = round( (@P_FSG_41_0_0_21_2 + (0) - (0)) / (1.0), 1.0); // (slider value + min - offset) / step = busvalue
	superval[currentPos++]= param2&0x000000ff;
	superval[currentPos++]=(param2&0x0000ff00)>>8;
	superval[currentPos++]=(param2&0x00ff0000)>>16;
	superval[currentPos++]=(param2&0xff000000)>>24;
// gen_BuildFunc_SetSuperVals 
	@P_FSG_41_0_0_21_3_range = round(@P_FSG_41_0_0_21_3 + (0), 1.0); // slider value + min = real value
	param3 = round( (@P_FSG_41_0_0_21_3 + (0) - (0)) / (1.0), 1.0); // (slider value + min - offset) / step = busvalue
	superval[currentPos++]= param3&0x000000ff;
	superval[currentPos++]=(param3&0x0000ff00)>>8;
	superval[currentPos++]=(param3&0x00ff0000)>>16;
	superval[currentPos++]=(param3&0xff000000)>>24;
	putValue(P_FSG_41_0_0_21, superval, currentPos);
}


on envVar P_FSG_41_0_0_21_1 // DataConnectionIndication2.ConnectionIndication
{
	P_FSG_41_0_0_21_BuildFct();
}

// Ueberwachung der Darstellungsvariable der Range.
on envVar P_FSG_41_0_0_21_2_range // DataConnectionIndication2.DataVolumeUplink 
{
	@P_FSG_41_0_0_21_2 = @P_FSG_41_0_0_21_2_range - (0); // slider = range - min
}

on envVar P_FSG_41_0_0_21_2 // DataConnectionIndication2.DataVolumeUplink
{
	P_FSG_41_0_0_21_BuildFct();
}

// Ueberwachung der Darstellungsvariable der Range.
on envVar P_FSG_41_0_0_21_3_range // DataConnectionIndication2.DataVolumeDownlink 
{
	@P_FSG_41_0_0_21_3 = @P_FSG_41_0_0_21_3_range - (0); // slider = range - min
}

on envVar P_FSG_41_0_0_21_3 // DataConnectionIndication2.DataVolumeDownlink
{
	P_FSG_41_0_0_21_BuildFct();
}

// Ruecksetzen des Fehlerstatus durch manuelle Fehlereingabe
on envVar P_FSG_41_0_0_22_ErrCode
{
       if(gP_FSG_41_0_0_22_ErrCode) 
       {
           setControlBackColor(panel_name,"errfield_P_FSG_41_0_0_22", MakeRGB(255,255,255));
       }
       gP_FSG_41_0_0_22_ErrCode = 1;
}
on envVar P_FSG_41_0_0_22Status_BTN
{
	byte BAPTemp[3];
   if (P_FSG_41_0_0_22Status_BTN_already_pressed == 0)
   {
      putValue(P_FSG_41_0_0_22_ErrCode,0);
      SetControlBackColor(panel_name,"errField_P_FSG_41_0_0_22",MakeRGB(255,255,255));
      P_FSG_41_0_0_22Status_BTN_already_pressed = 1;
   }
   else
   {
      getValue(P_FSG_41_0_0_22, BAPTemp);
      Request_ByteSequence(LSGID, P_FSG_41_0_0_22_ID, Data_REQ, BAPTemp, getValueSize(P_FSG_41_0_0_22));
      P_FSG_41_0_0_22Status_BTN_already_pressed = 0;
   }
}
on envVar P_FSG_41_0_0_22_FctEn
{
    long data[3];
    data[0]=LSGID;
    data[1]=P_FSG_41_0_0_22_ID;
    data[2]=getValue(P_FSG_41_0_0_22_FctEn);
    ChangeConfig(0x0031,data);
}
// De-Aktivierung der Eingabefelder der FCTID P_FSG_41_0_0_22
on envVar P_FSG_41_0_0_22_FctLstItemEn
{
       if(getValue(this)) 
       {
           EnableControl(panel_name,"panel_FSG_41_0_0_22",1);
           EnableControl(panel_name,"errfield_P_FSG_41_0_0_22",1);
           EnableControl(panel_name,"panel_P_FSG_41_0_0_22",1);
           setControlForeColor(panel_name, "checkbox_P_FSG_41_0_0_22", MakeRGB(0,240,0));
       }
       else
       {
           EnableControl(panel_name,"panel_FSG_41_0_0_22",0);
           EnableControl(panel_name,"errfield_P_FSG_41_0_0_22",0);
           EnableControl(panel_name,"panel_P_FSG_41_0_0_22",0);
           setControlForeColor(panel_name, "checkbox_P_FSG_41_0_0_22", MakeRGB(250,0,0));
       }
}
on envVar P_FSG_41_0_0_22 // bus value of EmailState (22).
{
	// opcodes: Error-Status
	byte param1; // StorageState
	word param2; // NumberOfNewEmail
	// DATATYPE_BYTESEQUENCE / DATATYPE_FIXEDBYTESEQUENCE
	int i;
	byte superval[3];
	int currentPos;
	currentPos = 0;
	for( i = 0; i < 3; i++ ) {
		superval[i] = 0;
	}
	getValue(P_FSG_41_0_0_22, superval);
	///////// Start param1 - UINT8 /////////
	param1 = superval[currentPos++];
	putValue(P_FSG_41_0_0_22_1, param1);
	///////// Start param2 - UINT16 /////////
	param2 = superval[currentPos++]|(superval[currentPos++]<<8);
	putValue(P_FSG_41_0_0_22_2, round((param2 * 1.0) - (0) + (0), 1.0));
}

on envVar P_FSG_41_0_0_22_1 // EmailState.StorageState
{
	byte superval[3];

	//Update Childvalue (Enum)
	byte thisval; // StorageState
	thisval = getValue(this);

    // Update superval
	getValue(P_FSG_41_0_0_22, superval);
	superval[0]=thisval;
	putValue(P_FSG_41_0_0_22,superval);
}

// Ueberwachung der Darstellungsvariable der Range.
on envVar P_FSG_41_0_0_22_2_range // EmailState.NumberOfNewEmail 
{
	@P_FSG_41_0_0_22_2 = @P_FSG_41_0_0_22_2_range - (0); // slider = range - min
}

on envVar P_FSG_41_0_0_22_2 // EmailState.NumberOfNewEmail
{
	byte superval[3];

	//Update Childvalue (Number)
	word thisval; // NumberOfNewEmail
	float slider_value;

	slider_value = round(@P_FSG_41_0_0_22_2, 1.0);
	@P_FSG_41_0_0_22_2_range = slider_value + (0); // real value := slider value + range min.
	thisval = (word)round((slider_value + (0) - (0)) / (1.0), 1); // bus value := (slider value + min - offset) / step.

    // Update superval
	getValue(P_FSG_41_0_0_22, superval);
	superval[1]=thisval&0x00ff;
	superval[2]=(thisval&0xff00)>>8;
	putValue(P_FSG_41_0_0_22,superval);
}

// Ruecksetzen des Fehlerstatus durch manuelle Fehlereingabe
on envVar P_FSG_41_0_0_23_ErrCode
{
       if(gP_FSG_41_0_0_23_ErrCode) 
       {
           setControlBackColor(panel_name,"errfield_P_FSG_41_0_0_23", MakeRGB(255,255,255));
       }
       gP_FSG_41_0_0_23_ErrCode = 1;
}
on envVar P_FSG_41_0_0_23Status_BTN
{
	byte BAPTemp[5];
   if (P_FSG_41_0_0_23Status_BTN_already_pressed == 0)
   {
      putValue(P_FSG_41_0_0_23_ErrCode,0);
      SetControlBackColor(panel_name,"errField_P_FSG_41_0_0_23",MakeRGB(255,255,255));
      P_FSG_41_0_0_23Status_BTN_already_pressed = 1;
   }
   else
   {
      getValue(P_FSG_41_0_0_23, BAPTemp);
      Request_ByteSequence(LSGID, P_FSG_41_0_0_23_ID, Data_REQ, BAPTemp, getValueSize(P_FSG_41_0_0_23));
      P_FSG_41_0_0_23Status_BTN_already_pressed = 0;
   }
}
on envVar P_FSG_41_0_0_23_FctEn
{
    long data[3];
    data[0]=LSGID;
    data[1]=P_FSG_41_0_0_23_ID;
    data[2]=getValue(P_FSG_41_0_0_23_FctEn);
    ChangeConfig(0x0031,data);
}
// De-Aktivierung der Eingabefelder der FCTID P_FSG_41_0_0_23
on envVar P_FSG_41_0_0_23_FctLstItemEn
{
       if(getValue(this)) 
       {
           EnableControl(panel_name,"panel_FSG_41_0_0_23",1);
           EnableControl(panel_name,"errfield_P_FSG_41_0_0_23",1);
           EnableControl(panel_name,"panel_P_FSG_41_0_0_23",1);
           setControlForeColor(panel_name, "checkbox_P_FSG_41_0_0_23", MakeRGB(0,240,0));
       }
       else
       {
           EnableControl(panel_name,"panel_FSG_41_0_0_23",0);
           EnableControl(panel_name,"errfield_P_FSG_41_0_0_23",0);
           EnableControl(panel_name,"panel_P_FSG_41_0_0_23",0);
           setControlForeColor(panel_name, "checkbox_P_FSG_41_0_0_23", MakeRGB(250,0,0));
       }
}
on envVar P_FSG_41_0_0_23 // bus value of PhoneModuleState (23).
{
	// opcodes: Error-Status
	byte param1; // ModuleState
	byte param2; // ModuleSupportedServices
	byte param3; // ModuleActiveServices
	byte param4; // SIMState
	byte param5; // Extension_1
	// DATATYPE_BYTESEQUENCE / DATATYPE_FIXEDBYTESEQUENCE
	int i;
	byte superval[5];
	int currentPos;
	currentPos = 0;
	for( i = 0; i < 5; i++ ) {
		superval[i] = 0;
	}
	getValue(P_FSG_41_0_0_23, superval);
	///////// Start param1 - UINT8 /////////
	param1 = superval[currentPos++];
	putValue(P_FSG_41_0_0_23_1, param1);
	///////// Start param2 - UINT8 /////////
	param2 = superval[currentPos++];
	putValue(P_FSG_41_0_0_23_2, param2);
	///////// Start param3 - UINT8 /////////
	param3 = superval[currentPos++];
	putValue(P_FSG_41_0_0_23_3, param3);
	///////// Start param4 - UINT8 /////////
	param4 = superval[currentPos++];
	putValue(P_FSG_41_0_0_23_4, param4);
	///////// Start param5 - UINT8 /////////
	param5 = superval[currentPos++];
	putValue(P_FSG_41_0_0_23_5, round((param5 * 1.0) - (0) + (0), 1.0));
}

on envVar P_FSG_41_0_0_23_1 // PhoneModuleState.ModuleState
{
	byte superval[5];

	//Update Childvalue (Enum)
	byte thisval; // ModuleState
	thisval = getValue(this);

    // Update superval
	getValue(P_FSG_41_0_0_23, superval);
	superval[0]=thisval;
	putValue(P_FSG_41_0_0_23,superval);
}

on envVar P_FSG_41_0_0_23_2 // PhoneModuleState.ModuleSupportedServices
{
	byte superval[5];

	//Update Childvalue (Enum)
	byte thisval; // ModuleSupportedServices
	thisval = getValue(this);

    // Update superval
	getValue(P_FSG_41_0_0_23, superval);
	superval[1]=thisval;
	putValue(P_FSG_41_0_0_23,superval);
}

on envVar P_FSG_41_0_0_23_3 // PhoneModuleState.ModuleActiveServices
{
	byte superval[5];

	//Update Childvalue (Enum)
	byte thisval; // ModuleActiveServices
	thisval = getValue(this);

    // Update superval
	getValue(P_FSG_41_0_0_23, superval);
	superval[2]=thisval;
	putValue(P_FSG_41_0_0_23,superval);
}

on envVar P_FSG_41_0_0_23_4 // PhoneModuleState.SIMState
{
	byte superval[5];

	//Update Childvalue (Enum)
	byte thisval; // SIMState
	thisval = getValue(this);

    // Update superval
	getValue(P_FSG_41_0_0_23, superval);
	superval[3]=thisval;
	putValue(P_FSG_41_0_0_23,superval);
}

// Ueberwachung der Darstellungsvariable der Range.
on envVar P_FSG_41_0_0_23_5_range // PhoneModuleState.Extension_1 
{
	@P_FSG_41_0_0_23_5 = @P_FSG_41_0_0_23_5_range - (0); // slider = range - min
}

on envVar P_FSG_41_0_0_23_5 // PhoneModuleState.Extension_1
{
	byte superval[5];

	//Update Childvalue (Number)
	byte thisval; // Extension_1
	float slider_value;

	slider_value = 0; // Konstanter Parameter.
	@P_FSG_41_0_0_23_5_range = slider_value + (0); // real value := slider value + range min.
	thisval = (byte)round((slider_value + (0) - (0)) / (1.0), 1); // bus value := (slider value + min - offset) / step.

    // Update superval
	getValue(P_FSG_41_0_0_23, superval);
	superval[4]=thisval;
	putValue(P_FSG_41_0_0_23,superval);
}

// Ruecksetzen des Fehlerstatus durch manuelle Fehlereingabe
on envVar P_FSG_41_0_0_24_ErrCode
{
       if(gP_FSG_41_0_0_24_ErrCode) 
       {
           setControlBackColor(panel_name,"errfield_P_FSG_41_0_0_24", MakeRGB(255,255,255));
       }
       gP_FSG_41_0_0_24_ErrCode = 1;
}
on envVar P_FSG_41_0_0_24Status_BTN
{
	byte BAPTemp[6];
   if (P_FSG_41_0_0_24Status_BTN_already_pressed == 0)
   {
      putValue(P_FSG_41_0_0_24_ErrCode,0);
      SetControlBackColor(panel_name,"errField_P_FSG_41_0_0_24",MakeRGB(255,255,255));
      P_FSG_41_0_0_24Status_BTN_already_pressed = 1;
   }
   else
   {
      getValue(P_FSG_41_0_0_24, BAPTemp);
      Request_ByteSequence(LSGID, P_FSG_41_0_0_24_ID, Data_REQ, BAPTemp, getValueSize(P_FSG_41_0_0_24));
      P_FSG_41_0_0_24Status_BTN_already_pressed = 0;
   }
}
on envVar P_FSG_41_0_0_24_FctEn
{
    long data[3];
    data[0]=LSGID;
    data[1]=P_FSG_41_0_0_24_ID;
    data[2]=getValue(P_FSG_41_0_0_24_FctEn);
    ChangeConfig(0x0031,data);
}
// De-Aktivierung der Eingabefelder der FCTID P_FSG_41_0_0_24
on envVar P_FSG_41_0_0_24_FctLstItemEn
{
       if(getValue(this)) 
       {
           EnableControl(panel_name,"panel_FSG_41_0_0_24",1);
           EnableControl(panel_name,"errfield_P_FSG_41_0_0_24",1);
           EnableControl(panel_name,"panel_P_FSG_41_0_0_24",1);
           setControlForeColor(panel_name, "checkbox_P_FSG_41_0_0_24", MakeRGB(0,240,0));
       }
       else
       {
           EnableControl(panel_name,"panel_FSG_41_0_0_24",0);
           EnableControl(panel_name,"errfield_P_FSG_41_0_0_24",0);
           EnableControl(panel_name,"panel_P_FSG_41_0_0_24",0);
           setControlForeColor(panel_name, "checkbox_P_FSG_41_0_0_24", MakeRGB(250,0,0));
       }
}
on envVar P_FSG_41_0_0_24 // bus value of ConnectionState (24).
{
	// opcodes: Error-Status
	byte param1; // BluetoothState
	byte param2; // BluetoothVisibility
	byte param3; // BluetoothConnections
	byte param4; // WLANState
	byte param5; // WLANVisibility
	byte param6; // WLANConnections
	byte param7; // BluetoothConnections2
	byte param8; // BluetoothSettings
	// DATATYPE_BYTESEQUENCE / DATATYPE_FIXEDBYTESEQUENCE
	int i;
	byte superval[6];
	int currentPos;
	currentPos = 0;
	for( i = 0; i < 6; i++ ) {
		superval[i] = 0;
	}
	getValue(P_FSG_41_0_0_24, superval);
	///////// Start param1 - NIBBLE /////////
	param1 = (superval[currentPos] & 0xf0)>>4;
	putValue(P_FSG_41_0_0_24_1, param1);
	///////// Start param2 - NIBBLE /////////
	param2 = superval[currentPos++] & 0x0f;
	putValue(P_FSG_41_0_0_24_2, param2);
	///////// Start param3 - UINT8 /////////
	param3 = superval[currentPos++];
	putValue(P_FSG_41_0_0_24_3, param3);
	///////// Start param4 - NIBBLE /////////
	param4 = (superval[currentPos] & 0xf0)>>4;
	putValue(P_FSG_41_0_0_24_4, param4);
	///////// Start param5 - NIBBLE /////////
	param5 = superval[currentPos++] & 0x0f;
	putValue(P_FSG_41_0_0_24_5, param5);
	///////// Start param6 - UINT8 /////////
	param6 = superval[currentPos++];
	putValue(P_FSG_41_0_0_24_6, round((param6 * 1.0) - (0) + (0), 1.0));
	///////// Start param7 - UINT8 /////////
	param7 = superval[currentPos++];
	putValue(P_FSG_41_0_0_24_7, param7);
	///////// Start param8 - UINT8 /////////
	param8 = superval[currentPos++];
	putValue(P_FSG_41_0_0_24_8, param8);
}

on envVar P_FSG_41_0_0_24_1 // ConnectionState.BluetoothState
{
	byte superval[6];

	//Update Childvalue (Enum)
	byte thisval; // BluetoothState
	thisval = 0x0f & getValue(this);

    // Update superval
	getValue(P_FSG_41_0_0_24, superval);
	superval[0]= superval[0]&0x0f;
	superval[0]= superval[0]|(thisval<<4);
	putValue(P_FSG_41_0_0_24,superval);
}

on envVar P_FSG_41_0_0_24_2 // ConnectionState.BluetoothVisibility
{
	byte superval[6];

	//Update Childvalue (Enum)
	byte thisval; // BluetoothVisibility
	thisval = 0x0f & getValue(this);

    // Update superval
	getValue(P_FSG_41_0_0_24, superval);
	superval[0]= superval[0]&0xf0;
	superval[0]= superval[0]|thisval;
	putValue(P_FSG_41_0_0_24,superval);
}

on envVar P_FSG_41_0_0_24_3_0
{
	byte bitval;
	//thisval steht hier fuer den bitfield-wert, 
	//aus Generierungsgruenden hier keine einheitliche Bezeichnung moeglich.
	byte thisval; // BluetoothConnections
	bitval= getValue(this);
	thisval = getValue(P_FSG_41_0_0_24_3);
	thisval = thisval&~(1<<0)|(bitval<<0);
	putValue(P_FSG_41_0_0_24_3,thisval);
}

on envVar P_FSG_41_0_0_24_3_1
{
	byte bitval;
	//thisval steht hier fuer den bitfield-wert, 
	//aus Generierungsgruenden hier keine einheitliche Bezeichnung moeglich.
	byte thisval; // BluetoothConnections
	bitval= getValue(this);
	thisval = getValue(P_FSG_41_0_0_24_3);
	thisval = thisval&~(1<<1)|(bitval<<1);
	putValue(P_FSG_41_0_0_24_3,thisval);
}

on envVar P_FSG_41_0_0_24_3_2
{
	byte bitval;
	//thisval steht hier fuer den bitfield-wert, 
	//aus Generierungsgruenden hier keine einheitliche Bezeichnung moeglich.
	byte thisval; // BluetoothConnections
	bitval= getValue(this);
	thisval = getValue(P_FSG_41_0_0_24_3);
	thisval = thisval&~(1<<2)|(bitval<<2);
	putValue(P_FSG_41_0_0_24_3,thisval);
}

on envVar P_FSG_41_0_0_24_3_3
{
	byte bitval;
	//thisval steht hier fuer den bitfield-wert, 
	//aus Generierungsgruenden hier keine einheitliche Bezeichnung moeglich.
	byte thisval; // BluetoothConnections
	bitval= getValue(this);
	thisval = getValue(P_FSG_41_0_0_24_3);
	thisval = thisval&~(1<<3)|(bitval<<3);
	putValue(P_FSG_41_0_0_24_3,thisval);
}

on envVar P_FSG_41_0_0_24_3 // ConnectionState.BluetoothConnections
{
	byte superval[6];

	//Update Childvalue (BitField)
	byte mask=0x01;
	int i = 0;
	byte thisval; // BluetoothConnections
	thisval = getValue(this);
	if(thisval&(mask<<0))
		putValue(P_FSG_41_0_0_24_3_0, 1);
	else
		putValue(P_FSG_41_0_0_24_3_0, 0);
	if(thisval&(mask<<1))
		putValue(P_FSG_41_0_0_24_3_1, 1);
	else
		putValue(P_FSG_41_0_0_24_3_1, 0);
	if(thisval&(mask<<2))
		putValue(P_FSG_41_0_0_24_3_2, 1);
	else
		putValue(P_FSG_41_0_0_24_3_2, 0);
	if(thisval&(mask<<3))
		putValue(P_FSG_41_0_0_24_3_3, 1);
	else
		putValue(P_FSG_41_0_0_24_3_3, 0);

    // Update superval
	getValue(P_FSG_41_0_0_24, superval);
	superval[1]=thisval;
	putValue(P_FSG_41_0_0_24,superval);
}

on envVar P_FSG_41_0_0_24_4 // ConnectionState.WLANState
{
	byte superval[6];

	//Update Childvalue (Enum)
	byte thisval; // WLANState
	thisval = 0x0f & getValue(this);

    // Update superval
	getValue(P_FSG_41_0_0_24, superval);
	superval[2]= superval[2]&0x0f;
	superval[2]= superval[2]|(thisval<<4);
	putValue(P_FSG_41_0_0_24,superval);
}

on envVar P_FSG_41_0_0_24_5 // ConnectionState.WLANVisibility
{
	byte superval[6];

	//Update Childvalue (Enum)
	byte thisval; // WLANVisibility
	thisval = 0x0f & getValue(this);

    // Update superval
	getValue(P_FSG_41_0_0_24, superval);
	superval[2]= superval[2]&0xf0;
	superval[2]= superval[2]|thisval;
	putValue(P_FSG_41_0_0_24,superval);
}

// Ueberwachung der Darstellungsvariable der Range.
on envVar P_FSG_41_0_0_24_6_range // ConnectionState.WLANConnections 
{
	@P_FSG_41_0_0_24_6 = @P_FSG_41_0_0_24_6_range - (0); // slider = range - min
}

on envVar P_FSG_41_0_0_24_6 // ConnectionState.WLANConnections
{
	byte superval[6];

	//Update Childvalue (Number)
	byte thisval; // WLANConnections
	float slider_value;

	slider_value = round(@P_FSG_41_0_0_24_6, 1.0);
	@P_FSG_41_0_0_24_6_range = slider_value + (0); // real value := slider value + range min.
	thisval = (byte)round((slider_value + (0) - (0)) / (1.0), 1); // bus value := (slider value + min - offset) / step.

    // Update superval
	getValue(P_FSG_41_0_0_24, superval);
	superval[3]=thisval;
	putValue(P_FSG_41_0_0_24,superval);
}

on envVar P_FSG_41_0_0_24_7_0
{
	byte bitval;
	//thisval steht hier fuer den bitfield-wert, 
	//aus Generierungsgruenden hier keine einheitliche Bezeichnung moeglich.
	byte thisval; // BluetoothConnections2
	bitval= getValue(this);
	thisval = getValue(P_FSG_41_0_0_24_7);
	thisval = thisval&~(1<<0)|(bitval<<0);
	putValue(P_FSG_41_0_0_24_7,thisval);
}

on envVar P_FSG_41_0_0_24_7_1
{
	byte bitval;
	//thisval steht hier fuer den bitfield-wert, 
	//aus Generierungsgruenden hier keine einheitliche Bezeichnung moeglich.
	byte thisval; // BluetoothConnections2
	bitval= getValue(this);
	thisval = getValue(P_FSG_41_0_0_24_7);
	thisval = thisval&~(1<<1)|(bitval<<1);
	putValue(P_FSG_41_0_0_24_7,thisval);
}

on envVar P_FSG_41_0_0_24_7_2
{
	byte bitval;
	//thisval steht hier fuer den bitfield-wert, 
	//aus Generierungsgruenden hier keine einheitliche Bezeichnung moeglich.
	byte thisval; // BluetoothConnections2
	bitval= getValue(this);
	thisval = getValue(P_FSG_41_0_0_24_7);
	thisval = thisval&~(1<<2)|(bitval<<2);
	putValue(P_FSG_41_0_0_24_7,thisval);
}

on envVar P_FSG_41_0_0_24_7_3
{
	byte bitval;
	//thisval steht hier fuer den bitfield-wert, 
	//aus Generierungsgruenden hier keine einheitliche Bezeichnung moeglich.
	byte thisval; // BluetoothConnections2
	bitval= getValue(this);
	thisval = getValue(P_FSG_41_0_0_24_7);
	thisval = thisval&~(1<<3)|(bitval<<3);
	putValue(P_FSG_41_0_0_24_7,thisval);
}

on envVar P_FSG_41_0_0_24_7 // ConnectionState.BluetoothConnections2
{
	byte superval[6];

	//Update Childvalue (BitField)
	byte mask=0x01;
	int i = 0;
	byte thisval; // BluetoothConnections2
	thisval = getValue(this);
	if(thisval&(mask<<0))
		putValue(P_FSG_41_0_0_24_7_0, 1);
	else
		putValue(P_FSG_41_0_0_24_7_0, 0);
	if(thisval&(mask<<1))
		putValue(P_FSG_41_0_0_24_7_1, 1);
	else
		putValue(P_FSG_41_0_0_24_7_1, 0);
	if(thisval&(mask<<2))
		putValue(P_FSG_41_0_0_24_7_2, 1);
	else
		putValue(P_FSG_41_0_0_24_7_2, 0);
	if(thisval&(mask<<3))
		putValue(P_FSG_41_0_0_24_7_3, 1);
	else
		putValue(P_FSG_41_0_0_24_7_3, 0);

    // Update superval
	getValue(P_FSG_41_0_0_24, superval);
	superval[4]=thisval;
	putValue(P_FSG_41_0_0_24,superval);
}

on envVar P_FSG_41_0_0_24_8_0
{
	byte bitval;
	//thisval steht hier fuer den bitfield-wert, 
	//aus Generierungsgruenden hier keine einheitliche Bezeichnung moeglich.
	byte thisval; // BluetoothSettings
	bitval= getValue(this);
	thisval = getValue(P_FSG_41_0_0_24_8);
	thisval = thisval&~(1<<0)|(bitval<<0);
	putValue(P_FSG_41_0_0_24_8,thisval);
}

on envVar P_FSG_41_0_0_24_8 // ConnectionState.BluetoothSettings
{
	byte superval[6];

	//Update Childvalue (BitField)
	byte mask=0x01;
	int i = 0;
	byte thisval; // BluetoothSettings
	thisval = getValue(this);
	if(thisval&(mask<<0))
		putValue(P_FSG_41_0_0_24_8_0, 1);
	else
		putValue(P_FSG_41_0_0_24_8_0, 0);

    // Update superval
	getValue(P_FSG_41_0_0_24, superval);
	superval[5]=thisval;
	putValue(P_FSG_41_0_0_24,superval);
}

// Ruecksetzen des Fehlerstatus durch manuelle Fehlereingabe
on envVar P_FSG_41_0_0_25_ErrCode
{
       if(gP_FSG_41_0_0_25_ErrCode) 
       {
           setControlBackColor(panel_name,"errfield_P_FSG_41_0_0_25", MakeRGB(255,255,255));
       }
       gP_FSG_41_0_0_25_ErrCode = 1;
}
on envVar P_FSG_41_0_0_25Status_BTN
{
    if (P_FSG_41_0_0_25Status_BTN_already_pressed == 0)
    {
       putValue(P_FSG_41_0_0_25_ErrCode,0);
       SetControlBackColor(panel_name,"errField_P_FSG_41_0_0_25",MakeRGB(255,255,255));
       P_FSG_41_0_0_25Status_BTN_already_pressed = 1;
    }
    else
    {
       Request_Int16(LSGID, P_FSG_41_0_0_25_ID, Data_REQ, getValue(P_FSG_41_0_0_25));
      P_FSG_41_0_0_25Status_BTN_already_pressed = 0;
    }
}
on envVar P_FSG_41_0_0_25_FctEn
{
    long data[3];
    data[0]=LSGID;
    data[1]=P_FSG_41_0_0_25_ID;
    data[2]=getValue(P_FSG_41_0_0_25_FctEn);
    ChangeConfig(0x0031,data);
}
// De-Aktivierung der Eingabefelder der FCTID P_FSG_41_0_0_25
on envVar P_FSG_41_0_0_25_FctLstItemEn
{
       if(getValue(this)) 
       {
           EnableControl(panel_name,"panel_FSG_41_0_0_25",1);
           EnableControl(panel_name,"errfield_P_FSG_41_0_0_25",1);
           EnableControl(panel_name,"panel_P_FSG_41_0_0_25",1);
           setControlForeColor(panel_name, "checkbox_P_FSG_41_0_0_25", MakeRGB(0,240,0));
       }
       else
       {
           EnableControl(panel_name,"panel_FSG_41_0_0_25",0);
           EnableControl(panel_name,"errfield_P_FSG_41_0_0_25",0);
           EnableControl(panel_name,"panel_P_FSG_41_0_0_25",0);
           setControlForeColor(panel_name, "checkbox_P_FSG_41_0_0_25", MakeRGB(250,0,0));
       }
}
on envVar P_FSG_41_0_0_25 // bus value of AutomaticCallForwarding (25).
{
	// opcodes: Error-Status
	word param1; // DivertState
	// DATATYPE_UINTXX
	param1 = getValue(P_FSG_41_0_0_25);
	putValue(P_FSG_41_0_0_25_1, param1);
}

on envVar P_FSG_41_0_0_25_1_0
{
	byte bitval;
	//thisval steht hier fuer den bitfield-wert, 
	//aus Generierungsgruenden hier keine einheitliche Bezeichnung moeglich.
	word thisval; // DivertState
	bitval= getValue(this);
	thisval = getValue(P_FSG_41_0_0_25_1);
	thisval = thisval&~(1<<0)|(bitval<<0);
	putValue(P_FSG_41_0_0_25_1,thisval);
}

on envVar P_FSG_41_0_0_25_1_1
{
	byte bitval;
	//thisval steht hier fuer den bitfield-wert, 
	//aus Generierungsgruenden hier keine einheitliche Bezeichnung moeglich.
	word thisval; // DivertState
	bitval= getValue(this);
	thisval = getValue(P_FSG_41_0_0_25_1);
	thisval = thisval&~(1<<1)|(bitval<<1);
	putValue(P_FSG_41_0_0_25_1,thisval);
}

on envVar P_FSG_41_0_0_25_1_2
{
	byte bitval;
	//thisval steht hier fuer den bitfield-wert, 
	//aus Generierungsgruenden hier keine einheitliche Bezeichnung moeglich.
	word thisval; // DivertState
	bitval= getValue(this);
	thisval = getValue(P_FSG_41_0_0_25_1);
	thisval = thisval&~(1<<2)|(bitval<<2);
	putValue(P_FSG_41_0_0_25_1,thisval);
}

on envVar P_FSG_41_0_0_25_1_3
{
	byte bitval;
	//thisval steht hier fuer den bitfield-wert, 
	//aus Generierungsgruenden hier keine einheitliche Bezeichnung moeglich.
	word thisval; // DivertState
	bitval= getValue(this);
	thisval = getValue(P_FSG_41_0_0_25_1);
	thisval = thisval&~(1<<3)|(bitval<<3);
	putValue(P_FSG_41_0_0_25_1,thisval);
}

on envVar P_FSG_41_0_0_25_1_4
{
	byte bitval;
	//thisval steht hier fuer den bitfield-wert, 
	//aus Generierungsgruenden hier keine einheitliche Bezeichnung moeglich.
	word thisval; // DivertState
	bitval= getValue(this);
	thisval = getValue(P_FSG_41_0_0_25_1);
	thisval = thisval&~(1<<4)|(bitval<<4);
	putValue(P_FSG_41_0_0_25_1,thisval);
}

on envVar P_FSG_41_0_0_25_1_5
{
	byte bitval;
	//thisval steht hier fuer den bitfield-wert, 
	//aus Generierungsgruenden hier keine einheitliche Bezeichnung moeglich.
	word thisval; // DivertState
	bitval= getValue(this);
	thisval = getValue(P_FSG_41_0_0_25_1);
	thisval = thisval&~(1<<5)|(bitval<<5);
	putValue(P_FSG_41_0_0_25_1,thisval);
}

on envVar P_FSG_41_0_0_25_1_6
{
	byte bitval;
	//thisval steht hier fuer den bitfield-wert, 
	//aus Generierungsgruenden hier keine einheitliche Bezeichnung moeglich.
	word thisval; // DivertState
	bitval= getValue(this);
	thisval = getValue(P_FSG_41_0_0_25_1);
	thisval = thisval&~(1<<6)|(bitval<<6);
	putValue(P_FSG_41_0_0_25_1,thisval);
}

on envVar P_FSG_41_0_0_25_1_7
{
	byte bitval;
	//thisval steht hier fuer den bitfield-wert, 
	//aus Generierungsgruenden hier keine einheitliche Bezeichnung moeglich.
	word thisval; // DivertState
	bitval= getValue(this);
	thisval = getValue(P_FSG_41_0_0_25_1);
	thisval = thisval&~(1<<7)|(bitval<<7);
	putValue(P_FSG_41_0_0_25_1,thisval);
}

on envVar P_FSG_41_0_0_25_1 // AutomaticCallForwarding.DivertState
{
	word superval;

	//Update Childvalue (BitField)
	byte mask=0x01;
	int i = 0;
	word thisval; // DivertState
	thisval = getValue(this);
	if(thisval&(mask<<0))
		putValue(P_FSG_41_0_0_25_1_0, 1);
	else
		putValue(P_FSG_41_0_0_25_1_0, 0);
	if(thisval&(mask<<1))
		putValue(P_FSG_41_0_0_25_1_1, 1);
	else
		putValue(P_FSG_41_0_0_25_1_1, 0);
	if(thisval&(mask<<2))
		putValue(P_FSG_41_0_0_25_1_2, 1);
	else
		putValue(P_FSG_41_0_0_25_1_2, 0);
	if(thisval&(mask<<3))
		putValue(P_FSG_41_0_0_25_1_3, 1);
	else
		putValue(P_FSG_41_0_0_25_1_3, 0);
	if(thisval&(mask<<4))
		putValue(P_FSG_41_0_0_25_1_4, 1);
	else
		putValue(P_FSG_41_0_0_25_1_4, 0);
	if(thisval&(mask<<5))
		putValue(P_FSG_41_0_0_25_1_5, 1);
	else
		putValue(P_FSG_41_0_0_25_1_5, 0);
	if(thisval&(mask<<6))
		putValue(P_FSG_41_0_0_25_1_6, 1);
	else
		putValue(P_FSG_41_0_0_25_1_6, 0);
	if(thisval&(mask<<7))
		putValue(P_FSG_41_0_0_25_1_7, 1);
	else
		putValue(P_FSG_41_0_0_25_1_7, 0);

    // Update superval
	superval = getValue(P_FSG_41_0_0_25);
	superval = thisval;
	putValue(P_FSG_41_0_0_25,superval);
}

// Ruecksetzen des Fehlerstatus durch manuelle Fehlereingabe
on envVar P_FSG_41_0_0_26_ErrCode
{
       if(gP_FSG_41_0_0_26_ErrCode) 
       {
           setControlBackColor(panel_name,"errfield_P_FSG_41_0_0_26", MakeRGB(255,255,255));
       }
       gP_FSG_41_0_0_26_ErrCode = 1;
}
on envVar P_FSG_41_0_0_26Status_BTN
{
	byte BAPTemp[6];
   if (P_FSG_41_0_0_26Status_BTN_already_pressed == 0)
   {
      putValue(P_FSG_41_0_0_26_ErrCode,0);
      SetControlBackColor(panel_name,"errField_P_FSG_41_0_0_26",MakeRGB(255,255,255));
      P_FSG_41_0_0_26Status_BTN_already_pressed = 1;
   }
   else
   {
      getValue(P_FSG_41_0_0_26, BAPTemp);
      Request_ByteSequence(LSGID, P_FSG_41_0_0_26_ID, Data_REQ, BAPTemp, getValueSize(P_FSG_41_0_0_26));
      P_FSG_41_0_0_26Status_BTN_already_pressed = 0;
   }
}
on envVar P_FSG_41_0_0_26_FctEn
{
    long data[3];
    data[0]=LSGID;
    data[1]=P_FSG_41_0_0_26_ID;
    data[2]=getValue(P_FSG_41_0_0_26_FctEn);
    ChangeConfig(0x0031,data);
}
// De-Aktivierung der Eingabefelder der FCTID P_FSG_41_0_0_26
on envVar P_FSG_41_0_0_26_FctLstItemEn
{
       if(getValue(this)) 
       {
           EnableControl(panel_name,"panel_FSG_41_0_0_26",1);
           EnableControl(panel_name,"errfield_P_FSG_41_0_0_26",1);
           EnableControl(panel_name,"panel_P_FSG_41_0_0_26",1);
           setControlForeColor(panel_name, "checkbox_P_FSG_41_0_0_26", MakeRGB(0,240,0));
       }
       else
       {
           EnableControl(panel_name,"panel_FSG_41_0_0_26",0);
           EnableControl(panel_name,"errfield_P_FSG_41_0_0_26",0);
           EnableControl(panel_name,"panel_P_FSG_41_0_0_26",0);
           setControlForeColor(panel_name, "checkbox_P_FSG_41_0_0_26", MakeRGB(250,0,0));
       }
}
on envVar P_FSG_41_0_0_26 // bus value of PhonebookDownloadProgress (26).
{
	// opcodes: Error-Status
	byte param1; // DownloadState
	byte param2; // ProgressPhonebookDownload
	word param3; // TotalPbEntries
	word param4; // CurrentlyLoadedPbEntries
	// DATATYPE_BYTESEQUENCE / DATATYPE_FIXEDBYTESEQUENCE
	int i;
	byte superval[6];
	int currentPos;
	currentPos = 0;
	for( i = 0; i < 6; i++ ) {
		superval[i] = 0;
	}
	getValue(P_FSG_41_0_0_26, superval);
	///////// Start param1 - UINT8 /////////
	param1 = superval[currentPos++];
	putValue(P_FSG_41_0_0_26_1, param1);
	///////// Start param2 - UINT8 /////////
	param2 = superval[currentPos++];
	putValue(P_FSG_41_0_0_26_2, round((param2 * 1.0) - (0) + (0), 1.0));
	///////// Start param3 - UINT16 /////////
	param3 = superval[currentPos++]|(superval[currentPos++]<<8);
	putValue(P_FSG_41_0_0_26_3, round((param3 * 1.0) - (0) + (0), 1.0));
	///////// Start param4 - UINT16 /////////
	param4 = superval[currentPos++]|(superval[currentPos++]<<8);
	putValue(P_FSG_41_0_0_26_4, round((param4 * 1.0) - (0) + (0), 1.0));
}

on envVar P_FSG_41_0_0_26_1 // PhonebookDownloadProgress.DownloadState
{
	byte superval[6];

	//Update Childvalue (Enum)
	byte thisval; // DownloadState
	thisval = getValue(this);

    // Update superval
	getValue(P_FSG_41_0_0_26, superval);
	superval[0]=thisval;
	putValue(P_FSG_41_0_0_26,superval);
}

// Ueberwachung der Darstellungsvariable der Range.
on envVar P_FSG_41_0_0_26_2_range // PhonebookDownloadProgress.ProgressPhonebookDownload 
{
	@P_FSG_41_0_0_26_2 = @P_FSG_41_0_0_26_2_range - (0); // slider = range - min
}

on envVar P_FSG_41_0_0_26_2 // PhonebookDownloadProgress.ProgressPhonebookDownload
{
	byte superval[6];

	//Update Childvalue (Number)
	byte thisval; // ProgressPhonebookDownload
	float slider_value;

	slider_value = round(@P_FSG_41_0_0_26_2, 1.0);
	@P_FSG_41_0_0_26_2_range = slider_value + (0); // real value := slider value + range min.
	thisval = (byte)round((slider_value + (0) - (0)) / (1.0), 1); // bus value := (slider value + min - offset) / step.

    // Update superval
	getValue(P_FSG_41_0_0_26, superval);
	superval[1]=thisval;
	putValue(P_FSG_41_0_0_26,superval);
}

// Ueberwachung der Darstellungsvariable der Range.
on envVar P_FSG_41_0_0_26_3_range // PhonebookDownloadProgress.TotalPbEntries 
{
	@P_FSG_41_0_0_26_3 = @P_FSG_41_0_0_26_3_range - (0); // slider = range - min
}

on envVar P_FSG_41_0_0_26_3 // PhonebookDownloadProgress.TotalPbEntries
{
	byte superval[6];

	//Update Childvalue (Number)
	word thisval; // TotalPbEntries
	float slider_value;

	slider_value = round(@P_FSG_41_0_0_26_3, 1.0);
	@P_FSG_41_0_0_26_3_range = slider_value + (0); // real value := slider value + range min.
	thisval = (word)round((slider_value + (0) - (0)) / (1.0), 1); // bus value := (slider value + min - offset) / step.

    // Update superval
	getValue(P_FSG_41_0_0_26, superval);
	superval[2]=thisval&0x00ff;
	superval[3]=(thisval&0xff00)>>8;
	putValue(P_FSG_41_0_0_26,superval);
}

// Ueberwachung der Darstellungsvariable der Range.
on envVar P_FSG_41_0_0_26_4_range // PhonebookDownloadProgress.CurrentlyLoadedPbEntries 
{
	@P_FSG_41_0_0_26_4 = @P_FSG_41_0_0_26_4_range - (0); // slider = range - min
}

on envVar P_FSG_41_0_0_26_4 // PhonebookDownloadProgress.CurrentlyLoadedPbEntries
{
	byte superval[6];

	//Update Childvalue (Number)
	word thisval; // CurrentlyLoadedPbEntries
	float slider_value;

	slider_value = round(@P_FSG_41_0_0_26_4, 1.0);
	@P_FSG_41_0_0_26_4_range = slider_value + (0); // real value := slider value + range min.
	thisval = (word)round((slider_value + (0) - (0)) / (1.0), 1); // bus value := (slider value + min - offset) / step.

    // Update superval
	getValue(P_FSG_41_0_0_26, superval);
	superval[4]=thisval&0x00ff;
	superval[5]=(thisval&0xff00)>>8;
	putValue(P_FSG_41_0_0_26,superval);
}

// Ruecksetzen des Fehlerstatus durch manuelle Fehlereingabe
on envVar P_FSG_41_0_0_27_ErrCode
{
       if(gP_FSG_41_0_0_27_ErrCode) 
       {
           setControlBackColor(panel_name,"errfield_P_FSG_41_0_0_27", MakeRGB(255,255,255));
       }
       gP_FSG_41_0_0_27_ErrCode = 1;
}
on envVar P_FSG_41_0_0_27Status_BTN
{
	byte BAPTemp[50];
    if (P_FSG_41_0_0_27Status_BTN_already_pressed == 0)
    {
        putValue(P_FSG_41_0_0_27_ErrCode,0);
        SetControlBackColor(panel_name,"errField_P_FSG_41_0_0_27",MakeRGB(255,255,255));
        P_FSG_41_0_0_27Status_BTN_already_pressed = 1;
    }
    else
    {
		P_FSG_41_0_0_27_BuildFct();
        getValue(P_FSG_41_0_0_27, BAPTemp);
        Request_ByteSequence(LSGID, P_FSG_41_0_0_27_ID, Data_REQ, BAPTemp, getValueSize(P_FSG_41_0_0_27));
        if(getValue(P_FSG_41_0_0_27_IntTlgEn)) //getValue(IT))
        {
           intertelegram_err(P_FSG_41_0_0_27_ID);
        }
        if(getValue(P_FSG_41_0_0_27_SegmEn))   //getvalue(SG)
        {
           sequence_err(P_FSG_41_0_0_27_ID,elCount(BAPTemp));
        }
       P_FSG_41_0_0_27Status_BTN_already_pressed = 0;
    }
}
on envVar P_FSG_41_0_0_27_FctEn
{
    long data[3];
    data[0]=LSGID;
    data[1]=P_FSG_41_0_0_27_ID;
    data[2]=getValue(P_FSG_41_0_0_27_FctEn);
    ChangeConfig(0x0031,data);
}
// De-Aktivierung der Eingabefelder der FCTID P_FSG_41_0_0_27
on envVar P_FSG_41_0_0_27_FctLstItemEn
{
       if(getValue(this)) 
       {
           EnableControl(panel_name,"panel_FSG_41_0_0_27",1);
           EnableControl(panel_name,"errfield_P_FSG_41_0_0_27",1);
           EnableControl(panel_name,"panel_P_FSG_41_0_0_27",1);
           setControlForeColor(panel_name, "checkbox_P_FSG_41_0_0_27", MakeRGB(0,240,0));
       }
       else
       {
           EnableControl(panel_name,"panel_FSG_41_0_0_27",0);
           EnableControl(panel_name,"errfield_P_FSG_41_0_0_27",0);
           EnableControl(panel_name,"panel_P_FSG_41_0_0_27",0);
           setControlForeColor(panel_name, "checkbox_P_FSG_41_0_0_27", MakeRGB(250,0,0));
       }
}
// Man darf gleichzeitig nur Checkbox fuer SegmError oder IntertelegramError aktiviert werden
on envVar P_FSG_41_0_0_27_IntTlgEn
{
       if(getValue(this)) 
       {
           putValue(P_FSG_41_0_0_27_SegmEn,0);
           intertelegram_err(P_FSG_41_0_0_27_ID);
       }
       else
       {
           intertelegram_err_off(P_FSG_41_0_0_27_ID);
       }
}
// Man darf gleichzeitig nur Checkbox fuer SegmError oder IntertelegramError aktiviert werden
on envVar P_FSG_41_0_0_27_SegmEn
{
       if(getValue(this)) 
       {
           putValue(P_FSG_41_0_0_27_IntTlgEn,0);
           sequence_err(P_FSG_41_0_0_27_ID,getValueSize(P_FSG_41_0_0_27_SegmEn));
       }
       else
       {
              sequence_err_off(P_FSG_41_0_0_27_ID);
       }
}
on envVar P_FSG_41_0_0_27 // bus value of ActiveUser2 (27).
{
	// opcodes: Error-Status
	byte param1[50]; // UserName
	word len1;
	byte cnt1;
	// DATATYPE_BYTESEQUENCE / DATATYPE_FIXEDBYTESEQUENCE
	int i;
	byte superval[50];
	int currentPos;
	currentPos = 0;
	for( i = 0; i < 50; i++ ) {
		superval[i] = 0;
	}
	getValue(P_FSG_41_0_0_27, superval);
	///////// Start param1 - STRING /////////
	getValue(P_FSG_41_0_0_27_1_Hex, param1);
	if((superval[currentPos] & 0x80) > 0)
	{
		if(49>127) /* Max Fct-Katalog Laenge: 49*/
		{
			len1 = ( (superval[currentPos]&0x7F) <<8) + superval[currentPos+1];
			currentPos = currentPos + 2;
			cnt1 = 1;
		}
		else
		{
			len1 = 49;
			writelineEx(gBAP_Trace, 0, "Anzahl der Laengeninformation-Bytes in P_FSG_41_0_0_27 ueberschreitet die erlaubte 1 Byte vom Fct-Kalatog.");
		}
	}
	else
	{
		len1 = superval[currentPos]&0x7F;
		currentPos = currentPos + 1;
		cnt1 = 0;
	}
	
	if(len1 > 49)
	{
		writelineEx(gBAP_Trace, 0, "Laenge:%d bei der Byte Position:%d ueberschreitet die Maximale erlaubte Laenge von Fct-Kalatog", len1, currentPos);
		len1 = 49;
	
		if(len1 < 128) cnt1 = 0;
		else cnt1 = 1;
	}
	
	for(i = 0; i < len1; i++)
	{
		param1[i] = superval[currentPos++];
	}
	
	putValue(P_FSG_41_0_0_27_1_len, len1);
	putValue(P_FSG_41_0_0_27_1_cnt, cnt1);
	
	if(len1 > getValueSize(P_FSG_41_0_0_27_1_Hex))
		putValue(P_FSG_41_0_0_27_1_Hex, param1, len1);
	else
		putValue(P_FSG_41_0_0_27_1_Hex, param1, getValueSize(P_FSG_41_0_0_27_1_Hex));

}

// Updates the bus value field and other dependencies.
P_FSG_41_0_0_27_BuildFct()
{
	byte param1[50]; // UserName
	word len1;
	byte cnt1;

	int i;
	byte superval[50];
	int currentPos;
	currentPos = 0;
// gen_BuildFunc_SetSuperVals 
	getValue(P_FSG_41_0_0_27_1_Hex, param1);
	len1 = getValue(P_FSG_41_0_0_27_1_len);
	cnt1= getValue(P_FSG_41_0_0_27_1_cnt);
	
	/* check box aktiviert*/
	if (cnt1 == 1)
	{
		/* 0 bis 49 (MaxString - 1B oder 2B) */
		if(len1 >= 0 && len1 <= 49)
		{
			//writelineEx(gBAP_Trace, 0, "[Debug-1] Len1: %d", len1);
			superval[currentPos] = (len1&0x7f00) | 0x80;
			superval[currentPos+1] = len1 & 0x00ff;
		}
		else
		{
			writelineEx(gBAP_Trace, 0, "Eingegebene Laenge: %d von P_FSG_41_0_0_27_1 ist ungueltig. Die max. erlaubte Laenge ist %d.", len1, 49);
			return;
		}
	}
	else if(cnt1 == 0) /*check box deaktiviert*/
	{
		if(len1 >= 0 && len1 <= 127)
		{
			//writelineEx(gBAP_Trace, 0, "[Debug-1] Len1: %d", len1);
			superval[currentPos]= len1 & 0x00ff;
			putValue(P_FSG_41_0_0_27_1_len, len1);
		}
		else if(len1 > 127 && len1 <= 49)
		{
			superval[currentPos] = (len1&0x7f00) | 0x80;
			superval[currentPos+1] = len1 & 0x00ff;
			putValue(P_FSG_41_0_0_27_1_len, len1);
			putValue(P_FSG_41_0_0_27_1_cnt, 1);
		}
		else
		{
			writelineEx(gBAP_Trace, 0, "Eingegebene Laenge: %d von P_FSG_41_0_0_27_1 ist ungueltig. Die max. erlaubte Laenge ist %d.", len1, 49);
			return;
		}
	}
	currentPos += cnt1+1;
	for(i = 0; i < len1; i++)
	{
		superval[currentPos++]= param1[i];
	}

	putValue(P_FSG_41_0_0_27, superval, currentPos);
}



// Ueberwachung der CheckBox fuer String
on envVar  P_FSG_41_0_0_27_1_cnt
{
	word len;
	byte cnt;
	len = getValue(P_FSG_41_0_0_27_1_len);
	cnt = getValue(P_FSG_41_0_0_27_1_cnt);

	/* wird nur gerufen, wenn check box deaktiviert mit Length>127*/ 
	if( cnt == 0) 
	{
		if(len > 127 )
		{
			putValue(P_FSG_41_0_0_27_1_len, 127);
		}
	}

	P_FSG_41_0_0_27_BuildFct();
}



// Ueberwachung der Eingabefeld fuer String Data
on envVar P_FSG_41_0_0_27_1_len
{
	word len;
	len = getValue(this);
	/* Validierung der Eingabe*/
	if(len > 49)
	{
		writelineEx(gBAP_Trace, 0, "Eingegebene Laenge: %d von P_FSG_41_0_0_27_1 ist ungueltig. Die max. erlaubte Laenge ist %d. ", len, 49);
		putValue(this, 49);
	}
	P_FSG_41_0_0_27_BuildFct();
}


on envVar P_FSG_41_0_0_27_1 // ActiveUser2.UserName
{
	int j, offset;
  int temp;
  int string_length_org;
  int string_length_mod;
  byte string_buffer_org[255];
  byte string_buffer_mod[255];
  
  //Start-Länge
  string_length_org = getValueSize(this);
  string_length_mod = string_length_org;
  
  //Start-String in Buffer
  getvalue(this,string_buffer_org);
  
  //Buffer auf Sonderzeichen checken und ersetzen
  offset = 0;
  for (j=0;j<string_length_org;j++)
  {
    if ( string_buffer_org[j] >= 0x80 && string_buffer_org[j] <= 0xBF ) 
    {
      temp = string_buffer_org[j] + 0xC200;
      
      string_buffer_mod[j+offset] = temp>>8;
      string_buffer_mod[j+offset+1] = temp;
      offset++;
      string_length_mod++;
    }
    else if ( string_buffer_org[j] >= 0xC0 && string_buffer_org[j] <= 0xFF ) 
    {
      temp = string_buffer_org[j] + 0xC2C0;
      
      string_buffer_mod[j+offset] = temp>>8;
      string_buffer_mod[j+offset+1] = temp;
      offset++;
      string_length_mod++;
    }
    else
      string_buffer_mod[j+offset] = string_buffer_org[j];
  }
    
  //neuen String schreiben
  putvalue(P_FSG_41_0_0_27_1_Hex,string_buffer_mod,string_length_mod);
  putValue(P_FSG_41_0_0_27_1_len, string_length_mod);
}

// Ruecksetzen des Fehlerstatus durch manuelle Fehlereingabe
on envVar P_FSG_41_0_0_28_ErrCode
{
       if(gP_FSG_41_0_0_28_ErrCode) 
       {
           setControlBackColor(panel_name,"errfield_P_FSG_41_0_0_28", MakeRGB(255,255,255));
       }
       gP_FSG_41_0_0_28_ErrCode = 1;
}
on envVar P_FSG_41_0_0_28Status_BTN
{
	byte BAPTemp[3];
   if (P_FSG_41_0_0_28Status_BTN_already_pressed == 0)
   {
      putValue(P_FSG_41_0_0_28_ErrCode,0);
      SetControlBackColor(panel_name,"errField_P_FSG_41_0_0_28",MakeRGB(255,255,255));
      P_FSG_41_0_0_28Status_BTN_already_pressed = 1;
   }
   else
   {
      getValue(P_FSG_41_0_0_28, BAPTemp);
      Request_ByteSequence(LSGID, P_FSG_41_0_0_28_ID, Data_REQ, BAPTemp, getValueSize(P_FSG_41_0_0_28));
      P_FSG_41_0_0_28Status_BTN_already_pressed = 0;
   }
}
on envVar P_FSG_41_0_0_28_FctEn
{
    long data[3];
    data[0]=LSGID;
    data[1]=P_FSG_41_0_0_28_ID;
    data[2]=getValue(P_FSG_41_0_0_28_FctEn);
    ChangeConfig(0x0031,data);
}
// De-Aktivierung der Eingabefelder der FCTID P_FSG_41_0_0_28
on envVar P_FSG_41_0_0_28_FctLstItemEn
{
       if(getValue(this)) 
       {
           EnableControl(panel_name,"panel_FSG_41_0_0_28",1);
           EnableControl(panel_name,"errfield_P_FSG_41_0_0_28",1);
           EnableControl(panel_name,"panel_P_FSG_41_0_0_28",1);
           setControlForeColor(panel_name, "checkbox_P_FSG_41_0_0_28", MakeRGB(0,240,0));
       }
       else
       {
           EnableControl(panel_name,"panel_FSG_41_0_0_28",0);
           EnableControl(panel_name,"errfield_P_FSG_41_0_0_28",0);
           EnableControl(panel_name,"panel_P_FSG_41_0_0_28",0);
           setControlForeColor(panel_name, "checkbox_P_FSG_41_0_0_28", MakeRGB(250,0,0));
       }
}
on envVar P_FSG_41_0_0_28 // bus value of TelState2 (28).
{
	// opcodes: Error-Status
	byte param1; // Tel_State
	byte param2; // Extension_1
	byte param3; // Extension_2
	// DATATYPE_BYTESEQUENCE / DATATYPE_FIXEDBYTESEQUENCE
	int i;
	byte superval[3];
	int currentPos;
	currentPos = 0;
	for( i = 0; i < 3; i++ ) {
		superval[i] = 0;
	}
	getValue(P_FSG_41_0_0_28, superval);
	///////// Start param1 - UINT8 /////////
	param1 = superval[currentPos++];
	putValue(P_FSG_41_0_0_28_1, param1);
	///////// Start param2 - UINT8 /////////
	param2 = superval[currentPos++];
	putValue(P_FSG_41_0_0_28_2, round((param2 * 1.0) - (0) + (0), 1.0));
	///////// Start param3 - UINT8 /////////
	param3 = superval[currentPos++];
	putValue(P_FSG_41_0_0_28_3, round((param3 * 1.0) - (0) + (0), 1.0));
}

on envVar P_FSG_41_0_0_28_1 // TelState2.Tel_State
{
	byte superval[3];

	//Update Childvalue (Enum)
	byte thisval; // Tel_State
	thisval = getValue(this);

    // Update superval
	getValue(P_FSG_41_0_0_28, superval);
	superval[0]=thisval;
	putValue(P_FSG_41_0_0_28,superval);
}

// Ueberwachung der Darstellungsvariable der Range.
on envVar P_FSG_41_0_0_28_2_range // TelState2.Extension_1 
{
	@P_FSG_41_0_0_28_2 = @P_FSG_41_0_0_28_2_range - (0); // slider = range - min
}

on envVar P_FSG_41_0_0_28_2 // TelState2.Extension_1
{
	byte superval[3];

	//Update Childvalue (Number)
	byte thisval; // Extension_1
	float slider_value;

	slider_value = 0; // Konstanter Parameter.
	@P_FSG_41_0_0_28_2_range = slider_value + (0); // real value := slider value + range min.
	thisval = (byte)round((slider_value + (0) - (0)) / (1.0), 1); // bus value := (slider value + min - offset) / step.

    // Update superval
	getValue(P_FSG_41_0_0_28, superval);
	superval[1]=thisval;
	putValue(P_FSG_41_0_0_28,superval);
}

// Ueberwachung der Darstellungsvariable der Range.
on envVar P_FSG_41_0_0_28_3_range // TelState2.Extension_2 
{
	@P_FSG_41_0_0_28_3 = @P_FSG_41_0_0_28_3_range - (0); // slider = range - min
}

on envVar P_FSG_41_0_0_28_3 // TelState2.Extension_2
{
	byte superval[3];

	//Update Childvalue (Number)
	byte thisval; // Extension_2
	float slider_value;

	slider_value = 0; // Konstanter Parameter.
	@P_FSG_41_0_0_28_3_range = slider_value + (0); // real value := slider value + range min.
	thisval = (byte)round((slider_value + (0) - (0)) / (1.0), 1); // bus value := (slider value + min - offset) / step.

    // Update superval
	getValue(P_FSG_41_0_0_28, superval);
	superval[2]=thisval;
	putValue(P_FSG_41_0_0_28,superval);
}

// Ruecksetzen des Fehlerstatus durch manuelle Fehlereingabe
on envVar P_FSG_41_0_0_29_ErrCode
{
       if(gP_FSG_41_0_0_29_ErrCode) 
       {
           setControlBackColor(panel_name,"errfield_P_FSG_41_0_0_29", MakeRGB(255,255,255));
       }
       gP_FSG_41_0_0_29_ErrCode = 1;
}
on envVar P_FSG_41_0_0_29Status_BTN
{
	byte BAPTemp[3];
   if (P_FSG_41_0_0_29Status_BTN_already_pressed == 0)
   {
      putValue(P_FSG_41_0_0_29_ErrCode,0);
      SetControlBackColor(panel_name,"errField_P_FSG_41_0_0_29",MakeRGB(255,255,255));
      P_FSG_41_0_0_29Status_BTN_already_pressed = 1;
   }
   else
   {
      getValue(P_FSG_41_0_0_29, BAPTemp);
      Request_ByteSequence(LSGID, P_FSG_41_0_0_29_ID, Data_REQ, BAPTemp, getValueSize(P_FSG_41_0_0_29));
      P_FSG_41_0_0_29Status_BTN_already_pressed = 0;
   }
}
on envVar P_FSG_41_0_0_29_FctEn
{
    long data[3];
    data[0]=LSGID;
    data[1]=P_FSG_41_0_0_29_ID;
    data[2]=getValue(P_FSG_41_0_0_29_FctEn);
    ChangeConfig(0x0031,data);
}
// De-Aktivierung der Eingabefelder der FCTID P_FSG_41_0_0_29
on envVar P_FSG_41_0_0_29_FctLstItemEn
{
       if(getValue(this)) 
       {
           EnableControl(panel_name,"panel_FSG_41_0_0_29",1);
           EnableControl(panel_name,"errfield_P_FSG_41_0_0_29",1);
           EnableControl(panel_name,"panel_P_FSG_41_0_0_29",1);
           setControlForeColor(panel_name, "checkbox_P_FSG_41_0_0_29", MakeRGB(0,240,0));
       }
       else
       {
           EnableControl(panel_name,"panel_FSG_41_0_0_29",0);
           EnableControl(panel_name,"errfield_P_FSG_41_0_0_29",0);
           EnableControl(panel_name,"panel_P_FSG_41_0_0_29",0);
           setControlForeColor(panel_name, "checkbox_P_FSG_41_0_0_29", MakeRGB(250,0,0));
       }
}
on envVar P_FSG_41_0_0_29 // bus value of DisconnectReason2 (29).
{
	// opcodes: Error-Status
	byte param1; // DisconnectReason
	byte param2; // Extension_1
	byte param3; // Extension_2
	// DATATYPE_BYTESEQUENCE / DATATYPE_FIXEDBYTESEQUENCE
	int i;
	byte superval[3];
	int currentPos;
	currentPos = 0;
	for( i = 0; i < 3; i++ ) {
		superval[i] = 0;
	}
	getValue(P_FSG_41_0_0_29, superval);
	///////// Start param1 - UINT8 /////////
	param1 = superval[currentPos++];
	putValue(P_FSG_41_0_0_29_1, param1);
	///////// Start param2 - UINT8 /////////
	param2 = superval[currentPos++];
	putValue(P_FSG_41_0_0_29_2, round((param2 * 1.0) - (0) + (0), 1.0));
	///////// Start param3 - UINT8 /////////
	param3 = superval[currentPos++];
	putValue(P_FSG_41_0_0_29_3, round((param3 * 1.0) - (0) + (0), 1.0));
}

on envVar P_FSG_41_0_0_29_1 // DisconnectReason2.DisconnectReason
{
	byte superval[3];

	//Update Childvalue (Enum)
	byte thisval; // DisconnectReason
	thisval = getValue(this);

    // Update superval
	getValue(P_FSG_41_0_0_29, superval);
	superval[0]=thisval;
	putValue(P_FSG_41_0_0_29,superval);
}

// Ueberwachung der Darstellungsvariable der Range.
on envVar P_FSG_41_0_0_29_2_range // DisconnectReason2.Extension_1 
{
	@P_FSG_41_0_0_29_2 = @P_FSG_41_0_0_29_2_range - (0); // slider = range - min
}

on envVar P_FSG_41_0_0_29_2 // DisconnectReason2.Extension_1
{
	byte superval[3];

	//Update Childvalue (Number)
	byte thisval; // Extension_1
	float slider_value;

	slider_value = 0; // Konstanter Parameter.
	@P_FSG_41_0_0_29_2_range = slider_value + (0); // real value := slider value + range min.
	thisval = (byte)round((slider_value + (0) - (0)) / (1.0), 1); // bus value := (slider value + min - offset) / step.

    // Update superval
	getValue(P_FSG_41_0_0_29, superval);
	superval[1]=thisval;
	putValue(P_FSG_41_0_0_29,superval);
}

// Ueberwachung der Darstellungsvariable der Range.
on envVar P_FSG_41_0_0_29_3_range // DisconnectReason2.Extension_2 
{
	@P_FSG_41_0_0_29_3 = @P_FSG_41_0_0_29_3_range - (0); // slider = range - min
}

on envVar P_FSG_41_0_0_29_3 // DisconnectReason2.Extension_2
{
	byte superval[3];

	//Update Childvalue (Number)
	byte thisval; // Extension_2
	float slider_value;

	slider_value = 0; // Konstanter Parameter.
	@P_FSG_41_0_0_29_3_range = slider_value + (0); // real value := slider value + range min.
	thisval = (byte)round((slider_value + (0) - (0)) / (1.0), 1); // bus value := (slider value + min - offset) / step.

    // Update superval
	getValue(P_FSG_41_0_0_29, superval);
	superval[2]=thisval;
	putValue(P_FSG_41_0_0_29,superval);
}

// Ruecksetzen des Fehlerstatus durch manuelle Fehlereingabe
on envVar P_FSG_41_0_0_30_ErrCode
{
       if(gP_FSG_41_0_0_30_ErrCode) 
       {
           setControlBackColor(panel_name,"errfield_P_FSG_41_0_0_30", MakeRGB(255,255,255));
       }
       gP_FSG_41_0_0_30_ErrCode = 1;
}
on envVar P_FSG_41_0_0_30Status_BTN
{
	byte BAPTemp[16];
    if (P_FSG_41_0_0_30Status_BTN_already_pressed == 0)
    {
        putValue(P_FSG_41_0_0_30_ErrCode,0);
        SetControlBackColor(panel_name,"errField_P_FSG_41_0_0_30",MakeRGB(255,255,255));
        P_FSG_41_0_0_30Status_BTN_already_pressed = 1;
    }
    else
    {
	      updateCallState2();
		P_FSG_41_0_0_30_BuildFct();
        getValue(P_FSG_41_0_0_30, BAPTemp);
        Request_ByteSequence(LSGID, P_FSG_41_0_0_30_ID, Data_REQ, BAPTemp, getValueSize(P_FSG_41_0_0_30));
        if(getValue(P_FSG_41_0_0_30_IntTlgEn)) //getValue(IT))
        {
           intertelegram_err(P_FSG_41_0_0_30_ID);
        }
        if(getValue(P_FSG_41_0_0_30_SegmEn))   //getvalue(SG)
        {
           sequence_err(P_FSG_41_0_0_30_ID,elCount(BAPTemp));
        }
       P_FSG_41_0_0_30Status_BTN_already_pressed = 0;
    }
}
on envVar P_FSG_41_0_0_30_FctEn
{
    long data[3];
    data[0]=LSGID;
    data[1]=P_FSG_41_0_0_30_ID;
    data[2]=getValue(P_FSG_41_0_0_30_FctEn);
    ChangeConfig(0x0031,data);
}
// De-Aktivierung der Eingabefelder der FCTID P_FSG_41_0_0_30
on envVar P_FSG_41_0_0_30_FctLstItemEn
{
       if(getValue(this)) 
       {
           EnableControl(panel_name,"panel_FSG_41_0_0_30",1);
           EnableControl(panel_name,"errfield_P_FSG_41_0_0_30",1);
           EnableControl(panel_name,"panel_P_FSG_41_0_0_30",1);
           setControlForeColor(panel_name, "checkbox_P_FSG_41_0_0_30", MakeRGB(0,240,0));
       }
       else
       {
           EnableControl(panel_name,"panel_FSG_41_0_0_30",0);
           EnableControl(panel_name,"errfield_P_FSG_41_0_0_30",0);
           EnableControl(panel_name,"panel_P_FSG_41_0_0_30",0);
           setControlForeColor(panel_name, "checkbox_P_FSG_41_0_0_30", MakeRGB(250,0,0));
       }
}
// Man darf gleichzeitig nur Checkbox fuer SegmError oder IntertelegramError aktiviert werden
on envVar P_FSG_41_0_0_30_IntTlgEn
{
       if(getValue(this)) 
       {
           putValue(P_FSG_41_0_0_30_SegmEn,0);
           intertelegram_err(P_FSG_41_0_0_30_ID);
       }
       else
       {
           intertelegram_err_off(P_FSG_41_0_0_30_ID);
       }
}
// Man darf gleichzeitig nur Checkbox fuer SegmError oder IntertelegramError aktiviert werden
on envVar P_FSG_41_0_0_30_SegmEn
{
       if(getValue(this)) 
       {
           putValue(P_FSG_41_0_0_30_IntTlgEn,0);
           sequence_err(P_FSG_41_0_0_30_ID,getValueSize(P_FSG_41_0_0_30_SegmEn));
       }
       else
       {
              sequence_err_off(P_FSG_41_0_0_30_ID);
       }
}
on envVar P_FSG_41_0_0_30 // bus value of CallState2 (30).
{
	// opcodes: Error-Status
	byte param1; // CallState0
	byte param2; // CallType0
	byte param3; // CallOptions0
	byte param4; // CallState1
	byte param5; // CallType1
	byte param6; // CallOptions1
	byte param7; // CallState2
	byte param8; // CallType2
	byte param9; // CallOptions2
	byte param10; // CallState3
	byte param11; // CallType3
	byte param12; // CallOptions3
	byte param13; // CallState4
	byte param14; // CallType4
	byte param15; // CallOptions4
	byte param16; // CallState5
	byte param17; // CallType5
	byte param18; // CallOptions5
	byte param19; // CallState6
	byte param20; // CallType6
	byte param21; // CallOptions6
	byte param22; // CallIncomingDiverted
	byte param23; // CallOutgoingDiverted_eCallConfirmationPending
	// DATATYPE_BYTESEQUENCE / DATATYPE_FIXEDBYTESEQUENCE
	int i;
	byte superval[16];
	int currentPos;
	currentPos = 0;
	for( i = 0; i < 16; i++ ) {
		superval[i] = 0;
	}
	getValue(P_FSG_41_0_0_30, superval);
	///////// Start param1 - NIBBLE /////////
	param1 = (superval[currentPos] & 0xf0)>>4;
	putValue(P_FSG_41_0_0_30_1, param1);
	///////// Start param2 - NIBBLE /////////
	param2 = superval[currentPos++] & 0x0f;
	putValue(P_FSG_41_0_0_30_2, param2);
	///////// Start param3 - UINT8 /////////
	param3 = superval[currentPos++];
	putValue(P_FSG_41_0_0_30_3, param3);
	///////// Start param4 - NIBBLE /////////
	param4 = (superval[currentPos] & 0xf0)>>4;
	putValue(P_FSG_41_0_0_30_4, param4);
	///////// Start param5 - NIBBLE /////////
	param5 = superval[currentPos++] & 0x0f;
	putValue(P_FSG_41_0_0_30_5, param5);
	///////// Start param6 - UINT8 /////////
	param6 = superval[currentPos++];
	putValue(P_FSG_41_0_0_30_6, param6);
	///////// Start param7 - NIBBLE /////////
	param7 = (superval[currentPos] & 0xf0)>>4;
	putValue(P_FSG_41_0_0_30_7, param7);
	///////// Start param8 - NIBBLE /////////
	param8 = superval[currentPos++] & 0x0f;
	putValue(P_FSG_41_0_0_30_8, param8);
	///////// Start param9 - UINT8 /////////
	param9 = superval[currentPos++];
	putValue(P_FSG_41_0_0_30_9, param9);
	///////// Start param10 - NIBBLE /////////
	param10 = (superval[currentPos] & 0xf0)>>4;
	putValue(P_FSG_41_0_0_30_10, param10);
	///////// Start param11 - NIBBLE /////////
	param11 = superval[currentPos++] & 0x0f;
	putValue(P_FSG_41_0_0_30_11, param11);
	///////// Start param12 - UINT8 /////////
	param12 = superval[currentPos++];
	putValue(P_FSG_41_0_0_30_12, param12);
	///////// Start param13 - NIBBLE /////////
	param13 = (superval[currentPos] & 0xf0)>>4;
	putValue(P_FSG_41_0_0_30_13, param13);
	///////// Start param14 - NIBBLE /////////
	param14 = superval[currentPos++] & 0x0f;
	putValue(P_FSG_41_0_0_30_14, param14);
	///////// Start param15 - UINT8 /////////
	param15 = superval[currentPos++];
	putValue(P_FSG_41_0_0_30_15, param15);
	///////// Start param16 - NIBBLE /////////
	param16 = (superval[currentPos] & 0xf0)>>4;
	putValue(P_FSG_41_0_0_30_16, param16);
	///////// Start param17 - NIBBLE /////////
	param17 = superval[currentPos++] & 0x0f;
	putValue(P_FSG_41_0_0_30_17, param17);
	///////// Start param18 - UINT8 /////////
	param18 = superval[currentPos++];
	putValue(P_FSG_41_0_0_30_18, param18);
	///////// Start param19 - NIBBLE /////////
	param19 = (superval[currentPos] & 0xf0)>>4;
	putValue(P_FSG_41_0_0_30_19, param19);
	///////// Start param20 - NIBBLE /////////
	param20 = superval[currentPos++] & 0x0f;
	putValue(P_FSG_41_0_0_30_20, param20);
	///////// Start param21 - UINT8 /////////
	param21 = superval[currentPos++];
	putValue(P_FSG_41_0_0_30_21, param21);
	///////// Start param22 - UINT8 /////////
	param22 = superval[currentPos++];
	putValue(P_FSG_41_0_0_30_22, param22);
	///////// Start param23 - UINT8 /////////
	param23 = superval[currentPos++];
	putValue(P_FSG_41_0_0_30_23, param23);
}

// Updates the bus value field and other dependencies.
P_FSG_41_0_0_30_BuildFct()
{
	byte param1; // CallState0
	byte param2; // CallType0
	byte param3; // CallOptions0
	byte param4; // CallState1
	byte param5; // CallType1
	byte param6; // CallOptions1
	byte param7; // CallState2
	byte param8; // CallType2
	byte param9; // CallOptions2
	byte param10; // CallState3
	byte param11; // CallType3
	byte param12; // CallOptions3
	byte param13; // CallState4
	byte param14; // CallType4
	byte param15; // CallOptions4
	byte param16; // CallState5
	byte param17; // CallType5
	byte param18; // CallOptions5
	byte param19; // CallState6
	byte param20; // CallType6
	byte param21; // CallOptions6
	byte param22; // CallIncomingDiverted
	byte param23; // CallOutgoingDiverted_eCallConfirmationPending

	int i;
	byte superval[16];
	int currentPos;
	currentPos = 0;
// gen_BuildFunc_SetSuperVals 
	param1 = getValue(P_FSG_41_0_0_30_1);
	param1 = param1 & 0x0f;
	superval[currentPos]= superval[currentPos]&0x0f;
	superval[currentPos]= superval[currentPos]|(param1<<4);
// gen_BuildFunc_SetSuperVals 
	param2 = getValue(P_FSG_41_0_0_30_2);
	param2 = param2 & 0x0f;
	superval[currentPos]= superval[currentPos]&0xf0;
	superval[currentPos]= superval[currentPos]|param2;
	currentPos++;
// gen_BuildFunc_SetSuperVals 
	param3 = getValue(P_FSG_41_0_0_30_3);
	@P_FSG_41_0_0_30_3_0 = (param3 & 1) > 0;
	@P_FSG_41_0_0_30_3_1 = (param3 & 2) > 0;
	@P_FSG_41_0_0_30_3_2 = (param3 & 4) > 0;
	@P_FSG_41_0_0_30_3_3 = (param3 & 8) > 0;
	@P_FSG_41_0_0_30_3_4 = (param3 & 16) > 0;
	@P_FSG_41_0_0_30_3_5 = (param3 & 32) > 0;
	@P_FSG_41_0_0_30_3_6 = (param3 & 64) > 0;
	@P_FSG_41_0_0_30_3_7 = (param3 & 128) > 0;
	superval[currentPos++]=param3;
// gen_BuildFunc_SetSuperVals 
	param4 = getValue(P_FSG_41_0_0_30_4);
	param4 = param4 & 0x0f;
	superval[currentPos]= superval[currentPos]&0x0f;
	superval[currentPos]= superval[currentPos]|(param4<<4);
// gen_BuildFunc_SetSuperVals 
	param5 = getValue(P_FSG_41_0_0_30_5);
	param5 = param5 & 0x0f;
	superval[currentPos]= superval[currentPos]&0xf0;
	superval[currentPos]= superval[currentPos]|param5;
	currentPos++;
// gen_BuildFunc_SetSuperVals 
	param6 = getValue(P_FSG_41_0_0_30_6);
	@P_FSG_41_0_0_30_6_0 = (param6 & 1) > 0;
	@P_FSG_41_0_0_30_6_1 = (param6 & 2) > 0;
	@P_FSG_41_0_0_30_6_2 = (param6 & 4) > 0;
	@P_FSG_41_0_0_30_6_3 = (param6 & 8) > 0;
	@P_FSG_41_0_0_30_6_4 = (param6 & 16) > 0;
	@P_FSG_41_0_0_30_6_5 = (param6 & 32) > 0;
	@P_FSG_41_0_0_30_6_6 = (param6 & 64) > 0;
	@P_FSG_41_0_0_30_6_7 = (param6 & 128) > 0;
	superval[currentPos++]=param6;
// gen_BuildFunc_SetSuperVals 
	param7 = getValue(P_FSG_41_0_0_30_7);
	param7 = param7 & 0x0f;
	superval[currentPos]= superval[currentPos]&0x0f;
	superval[currentPos]= superval[currentPos]|(param7<<4);
// gen_BuildFunc_SetSuperVals 
	param8 = getValue(P_FSG_41_0_0_30_8);
	param8 = param8 & 0x0f;
	superval[currentPos]= superval[currentPos]&0xf0;
	superval[currentPos]= superval[currentPos]|param8;
	currentPos++;
// gen_BuildFunc_SetSuperVals 
	param9 = getValue(P_FSG_41_0_0_30_9);
	@P_FSG_41_0_0_30_9_0 = (param9 & 1) > 0;
	@P_FSG_41_0_0_30_9_1 = (param9 & 2) > 0;
	@P_FSG_41_0_0_30_9_2 = (param9 & 4) > 0;
	@P_FSG_41_0_0_30_9_3 = (param9 & 8) > 0;
	@P_FSG_41_0_0_30_9_4 = (param9 & 16) > 0;
	@P_FSG_41_0_0_30_9_5 = (param9 & 32) > 0;
	@P_FSG_41_0_0_30_9_6 = (param9 & 64) > 0;
	@P_FSG_41_0_0_30_9_7 = (param9 & 128) > 0;
	superval[currentPos++]=param9;
// gen_BuildFunc_SetSuperVals 
	param10 = getValue(P_FSG_41_0_0_30_10);
	param10 = param10 & 0x0f;
	superval[currentPos]= superval[currentPos]&0x0f;
	superval[currentPos]= superval[currentPos]|(param10<<4);
// gen_BuildFunc_SetSuperVals 
	param11 = getValue(P_FSG_41_0_0_30_11);
	param11 = param11 & 0x0f;
	superval[currentPos]= superval[currentPos]&0xf0;
	superval[currentPos]= superval[currentPos]|param11;
	currentPos++;
// gen_BuildFunc_SetSuperVals 
	param12 = getValue(P_FSG_41_0_0_30_12);
	@P_FSG_41_0_0_30_12_0 = (param12 & 1) > 0;
	@P_FSG_41_0_0_30_12_1 = (param12 & 2) > 0;
	@P_FSG_41_0_0_30_12_2 = (param12 & 4) > 0;
	@P_FSG_41_0_0_30_12_3 = (param12 & 8) > 0;
	@P_FSG_41_0_0_30_12_4 = (param12 & 16) > 0;
	@P_FSG_41_0_0_30_12_5 = (param12 & 32) > 0;
	@P_FSG_41_0_0_30_12_6 = (param12 & 64) > 0;
	@P_FSG_41_0_0_30_12_7 = (param12 & 128) > 0;
	superval[currentPos++]=param12;
// gen_BuildFunc_SetSuperVals 
	param13 = getValue(P_FSG_41_0_0_30_13);
	param13 = param13 & 0x0f;
	superval[currentPos]= superval[currentPos]&0x0f;
	superval[currentPos]= superval[currentPos]|(param13<<4);
// gen_BuildFunc_SetSuperVals 
	param14 = getValue(P_FSG_41_0_0_30_14);
	param14 = param14 & 0x0f;
	superval[currentPos]= superval[currentPos]&0xf0;
	superval[currentPos]= superval[currentPos]|param14;
	currentPos++;
// gen_BuildFunc_SetSuperVals 
	param15 = getValue(P_FSG_41_0_0_30_15);
	@P_FSG_41_0_0_30_15_0 = (param15 & 1) > 0;
	@P_FSG_41_0_0_30_15_1 = (param15 & 2) > 0;
	@P_FSG_41_0_0_30_15_2 = (param15 & 4) > 0;
	@P_FSG_41_0_0_30_15_3 = (param15 & 8) > 0;
	@P_FSG_41_0_0_30_15_4 = (param15 & 16) > 0;
	@P_FSG_41_0_0_30_15_5 = (param15 & 32) > 0;
	@P_FSG_41_0_0_30_15_6 = (param15 & 64) > 0;
	@P_FSG_41_0_0_30_15_7 = (param15 & 128) > 0;
	superval[currentPos++]=param15;
// gen_BuildFunc_SetSuperVals 
	param16 = getValue(P_FSG_41_0_0_30_16);
	param16 = param16 & 0x0f;
	superval[currentPos]= superval[currentPos]&0x0f;
	superval[currentPos]= superval[currentPos]|(param16<<4);
// gen_BuildFunc_SetSuperVals 
	param17 = getValue(P_FSG_41_0_0_30_17);
	param17 = param17 & 0x0f;
	superval[currentPos]= superval[currentPos]&0xf0;
	superval[currentPos]= superval[currentPos]|param17;
	currentPos++;
// gen_BuildFunc_SetSuperVals 
	param18 = getValue(P_FSG_41_0_0_30_18);
	@P_FSG_41_0_0_30_18_0 = (param18 & 1) > 0;
	@P_FSG_41_0_0_30_18_1 = (param18 & 2) > 0;
	@P_FSG_41_0_0_30_18_2 = (param18 & 4) > 0;
	@P_FSG_41_0_0_30_18_3 = (param18 & 8) > 0;
	@P_FSG_41_0_0_30_18_4 = (param18 & 16) > 0;
	@P_FSG_41_0_0_30_18_5 = (param18 & 32) > 0;
	@P_FSG_41_0_0_30_18_6 = (param18 & 64) > 0;
	@P_FSG_41_0_0_30_18_7 = (param18 & 128) > 0;
	superval[currentPos++]=param18;
// gen_BuildFunc_SetSuperVals 
	param19 = getValue(P_FSG_41_0_0_30_19);
	param19 = param19 & 0x0f;
	superval[currentPos]= superval[currentPos]&0x0f;
	superval[currentPos]= superval[currentPos]|(param19<<4);
// gen_BuildFunc_SetSuperVals 
	param20 = getValue(P_FSG_41_0_0_30_20);
	param20 = param20 & 0x0f;
	superval[currentPos]= superval[currentPos]&0xf0;
	superval[currentPos]= superval[currentPos]|param20;
	currentPos++;
// gen_BuildFunc_SetSuperVals 
	param21 = getValue(P_FSG_41_0_0_30_21);
	@P_FSG_41_0_0_30_21_0 = (param21 & 1) > 0;
	@P_FSG_41_0_0_30_21_1 = (param21 & 2) > 0;
	@P_FSG_41_0_0_30_21_2 = (param21 & 4) > 0;
	@P_FSG_41_0_0_30_21_3 = (param21 & 8) > 0;
	@P_FSG_41_0_0_30_21_4 = (param21 & 16) > 0;
	@P_FSG_41_0_0_30_21_5 = (param21 & 32) > 0;
	@P_FSG_41_0_0_30_21_6 = (param21 & 64) > 0;
	@P_FSG_41_0_0_30_21_7 = (param21 & 128) > 0;
	superval[currentPos++]=param21;
// gen_BuildFunc_SetSuperVals 
	param22 = getValue(P_FSG_41_0_0_30_22);
	@P_FSG_41_0_0_30_22_0 = (param22 & 1) > 0;
	@P_FSG_41_0_0_30_22_1 = (param22 & 2) > 0;
	@P_FSG_41_0_0_30_22_2 = (param22 & 4) > 0;
	@P_FSG_41_0_0_30_22_3 = (param22 & 8) > 0;
	@P_FSG_41_0_0_30_22_4 = (param22 & 16) > 0;
	@P_FSG_41_0_0_30_22_5 = (param22 & 32) > 0;
	@P_FSG_41_0_0_30_22_6 = (param22 & 64) > 0;
	superval[currentPos++]=param22;
// gen_BuildFunc_SetSuperVals 
	param23 = getValue(P_FSG_41_0_0_30_23);
	@P_FSG_41_0_0_30_23_0 = (param23 & 1) > 0;
	@P_FSG_41_0_0_30_23_1 = (param23 & 2) > 0;
	@P_FSG_41_0_0_30_23_2 = (param23 & 4) > 0;
	@P_FSG_41_0_0_30_23_3 = (param23 & 8) > 0;
	@P_FSG_41_0_0_30_23_4 = (param23 & 16) > 0;
	@P_FSG_41_0_0_30_23_5 = (param23 & 32) > 0;
	@P_FSG_41_0_0_30_23_6 = (param23 & 64) > 0;
	@P_FSG_41_0_0_30_23_7 = (param23 & 128) > 0;
	superval[currentPos++]=param23;
	putValue(P_FSG_41_0_0_30, superval, currentPos);
}


on envVar P_FSG_41_0_0_30_1 // CallState2.CallState0
{
	P_FSG_41_0_0_30_BuildFct();
}

on envVar P_FSG_41_0_0_30_2 // CallState2.CallType0
{
	P_FSG_41_0_0_30_BuildFct();
}

on envVar P_FSG_41_0_0_30_3_0
{
	byte bitval;
	//thisval steht hier fuer den bitfield-wert, 
	//aus Generierungsgruenden hier keine einheitliche Bezeichnung moeglich.
	byte thisval; // CallOptions0
	bitval= getValue(this);
	thisval = getValue(P_FSG_41_0_0_30_3);
	thisval = thisval&~(1<<0)|(bitval<<0);
	putValue(P_FSG_41_0_0_30_3,thisval);
}

on envVar P_FSG_41_0_0_30_3_1
{
	byte bitval;
	//thisval steht hier fuer den bitfield-wert, 
	//aus Generierungsgruenden hier keine einheitliche Bezeichnung moeglich.
	byte thisval; // CallOptions0
	bitval= getValue(this);
	thisval = getValue(P_FSG_41_0_0_30_3);
	thisval = thisval&~(1<<1)|(bitval<<1);
	putValue(P_FSG_41_0_0_30_3,thisval);
}

on envVar P_FSG_41_0_0_30_3_2
{
	byte bitval;
	//thisval steht hier fuer den bitfield-wert, 
	//aus Generierungsgruenden hier keine einheitliche Bezeichnung moeglich.
	byte thisval; // CallOptions0
	bitval= getValue(this);
	thisval = getValue(P_FSG_41_0_0_30_3);
	thisval = thisval&~(1<<2)|(bitval<<2);
	putValue(P_FSG_41_0_0_30_3,thisval);
}

on envVar P_FSG_41_0_0_30_3_3
{
	byte bitval;
	//thisval steht hier fuer den bitfield-wert, 
	//aus Generierungsgruenden hier keine einheitliche Bezeichnung moeglich.
	byte thisval; // CallOptions0
	bitval= getValue(this);
	thisval = getValue(P_FSG_41_0_0_30_3);
	thisval = thisval&~(1<<3)|(bitval<<3);
	putValue(P_FSG_41_0_0_30_3,thisval);
}

on envVar P_FSG_41_0_0_30_3_4
{
	byte bitval;
	//thisval steht hier fuer den bitfield-wert, 
	//aus Generierungsgruenden hier keine einheitliche Bezeichnung moeglich.
	byte thisval; // CallOptions0
	bitval= getValue(this);
	thisval = getValue(P_FSG_41_0_0_30_3);
	thisval = thisval&~(1<<4)|(bitval<<4);
	putValue(P_FSG_41_0_0_30_3,thisval);
}

on envVar P_FSG_41_0_0_30_3_5
{
	byte bitval;
	//thisval steht hier fuer den bitfield-wert, 
	//aus Generierungsgruenden hier keine einheitliche Bezeichnung moeglich.
	byte thisval; // CallOptions0
	bitval= getValue(this);
	thisval = getValue(P_FSG_41_0_0_30_3);
	thisval = thisval&~(1<<5)|(bitval<<5);
	putValue(P_FSG_41_0_0_30_3,thisval);
}

on envVar P_FSG_41_0_0_30_3_6
{
	byte bitval;
	//thisval steht hier fuer den bitfield-wert, 
	//aus Generierungsgruenden hier keine einheitliche Bezeichnung moeglich.
	byte thisval; // CallOptions0
	bitval= getValue(this);
	thisval = getValue(P_FSG_41_0_0_30_3);
	thisval = thisval&~(1<<6)|(bitval<<6);
	putValue(P_FSG_41_0_0_30_3,thisval);
}

on envVar P_FSG_41_0_0_30_3_7
{
	byte bitval;
	//thisval steht hier fuer den bitfield-wert, 
	//aus Generierungsgruenden hier keine einheitliche Bezeichnung moeglich.
	byte thisval; // CallOptions0
	bitval= getValue(this);
	thisval = getValue(P_FSG_41_0_0_30_3);
	thisval = thisval&~(1<<7)|(bitval<<7);
	putValue(P_FSG_41_0_0_30_3,thisval);
}

on envVar P_FSG_41_0_0_30_3 // CallState2.CallOptions0
{
	P_FSG_41_0_0_30_BuildFct();
}

on envVar P_FSG_41_0_0_30_4 // CallState2.CallState1
{
	P_FSG_41_0_0_30_BuildFct();
}

on envVar P_FSG_41_0_0_30_5 // CallState2.CallType1
{
	P_FSG_41_0_0_30_BuildFct();
}

on envVar P_FSG_41_0_0_30_6_0
{
	byte bitval;
	//thisval steht hier fuer den bitfield-wert, 
	//aus Generierungsgruenden hier keine einheitliche Bezeichnung moeglich.
	byte thisval; // CallOptions1
	bitval= getValue(this);
	thisval = getValue(P_FSG_41_0_0_30_6);
	thisval = thisval&~(1<<0)|(bitval<<0);
	putValue(P_FSG_41_0_0_30_6,thisval);
}

on envVar P_FSG_41_0_0_30_6_1
{
	byte bitval;
	//thisval steht hier fuer den bitfield-wert, 
	//aus Generierungsgruenden hier keine einheitliche Bezeichnung moeglich.
	byte thisval; // CallOptions1
	bitval= getValue(this);
	thisval = getValue(P_FSG_41_0_0_30_6);
	thisval = thisval&~(1<<1)|(bitval<<1);
	putValue(P_FSG_41_0_0_30_6,thisval);
}

on envVar P_FSG_41_0_0_30_6_2
{
	byte bitval;
	//thisval steht hier fuer den bitfield-wert, 
	//aus Generierungsgruenden hier keine einheitliche Bezeichnung moeglich.
	byte thisval; // CallOptions1
	bitval= getValue(this);
	thisval = getValue(P_FSG_41_0_0_30_6);
	thisval = thisval&~(1<<2)|(bitval<<2);
	putValue(P_FSG_41_0_0_30_6,thisval);
}

on envVar P_FSG_41_0_0_30_6_3
{
	byte bitval;
	//thisval steht hier fuer den bitfield-wert, 
	//aus Generierungsgruenden hier keine einheitliche Bezeichnung moeglich.
	byte thisval; // CallOptions1
	bitval= getValue(this);
	thisval = getValue(P_FSG_41_0_0_30_6);
	thisval = thisval&~(1<<3)|(bitval<<3);
	putValue(P_FSG_41_0_0_30_6,thisval);
}

on envVar P_FSG_41_0_0_30_6_4
{
	byte bitval;
	//thisval steht hier fuer den bitfield-wert, 
	//aus Generierungsgruenden hier keine einheitliche Bezeichnung moeglich.
	byte thisval; // CallOptions1
	bitval= getValue(this);
	thisval = getValue(P_FSG_41_0_0_30_6);
	thisval = thisval&~(1<<4)|(bitval<<4);
	putValue(P_FSG_41_0_0_30_6,thisval);
}

on envVar P_FSG_41_0_0_30_6_5
{
	byte bitval;
	//thisval steht hier fuer den bitfield-wert, 
	//aus Generierungsgruenden hier keine einheitliche Bezeichnung moeglich.
	byte thisval; // CallOptions1
	bitval= getValue(this);
	thisval = getValue(P_FSG_41_0_0_30_6);
	thisval = thisval&~(1<<5)|(bitval<<5);
	putValue(P_FSG_41_0_0_30_6,thisval);
}

on envVar P_FSG_41_0_0_30_6_6
{
	byte bitval;
	//thisval steht hier fuer den bitfield-wert, 
	//aus Generierungsgruenden hier keine einheitliche Bezeichnung moeglich.
	byte thisval; // CallOptions1
	bitval= getValue(this);
	thisval = getValue(P_FSG_41_0_0_30_6);
	thisval = thisval&~(1<<6)|(bitval<<6);
	putValue(P_FSG_41_0_0_30_6,thisval);
}

on envVar P_FSG_41_0_0_30_6_7
{
	byte bitval;
	//thisval steht hier fuer den bitfield-wert, 
	//aus Generierungsgruenden hier keine einheitliche Bezeichnung moeglich.
	byte thisval; // CallOptions1
	bitval= getValue(this);
	thisval = getValue(P_FSG_41_0_0_30_6);
	thisval = thisval&~(1<<7)|(bitval<<7);
	putValue(P_FSG_41_0_0_30_6,thisval);
}

on envVar P_FSG_41_0_0_30_6 // CallState2.CallOptions1
{
	P_FSG_41_0_0_30_BuildFct();
}

on envVar P_FSG_41_0_0_30_7 // CallState2.CallState2
{
	P_FSG_41_0_0_30_BuildFct();
}

on envVar P_FSG_41_0_0_30_8 // CallState2.CallType2
{
	P_FSG_41_0_0_30_BuildFct();
}

on envVar P_FSG_41_0_0_30_9_0
{
	byte bitval;
	//thisval steht hier fuer den bitfield-wert, 
	//aus Generierungsgruenden hier keine einheitliche Bezeichnung moeglich.
	byte thisval; // CallOptions2
	bitval= getValue(this);
	thisval = getValue(P_FSG_41_0_0_30_9);
	thisval = thisval&~(1<<0)|(bitval<<0);
	putValue(P_FSG_41_0_0_30_9,thisval);
}

on envVar P_FSG_41_0_0_30_9_1
{
	byte bitval;
	//thisval steht hier fuer den bitfield-wert, 
	//aus Generierungsgruenden hier keine einheitliche Bezeichnung moeglich.
	byte thisval; // CallOptions2
	bitval= getValue(this);
	thisval = getValue(P_FSG_41_0_0_30_9);
	thisval = thisval&~(1<<1)|(bitval<<1);
	putValue(P_FSG_41_0_0_30_9,thisval);
}

on envVar P_FSG_41_0_0_30_9_2
{
	byte bitval;
	//thisval steht hier fuer den bitfield-wert, 
	//aus Generierungsgruenden hier keine einheitliche Bezeichnung moeglich.
	byte thisval; // CallOptions2
	bitval= getValue(this);
	thisval = getValue(P_FSG_41_0_0_30_9);
	thisval = thisval&~(1<<2)|(bitval<<2);
	putValue(P_FSG_41_0_0_30_9,thisval);
}

on envVar P_FSG_41_0_0_30_9_3
{
	byte bitval;
	//thisval steht hier fuer den bitfield-wert, 
	//aus Generierungsgruenden hier keine einheitliche Bezeichnung moeglich.
	byte thisval; // CallOptions2
	bitval= getValue(this);
	thisval = getValue(P_FSG_41_0_0_30_9);
	thisval = thisval&~(1<<3)|(bitval<<3);
	putValue(P_FSG_41_0_0_30_9,thisval);
}

on envVar P_FSG_41_0_0_30_9_4
{
	byte bitval;
	//thisval steht hier fuer den bitfield-wert, 
	//aus Generierungsgruenden hier keine einheitliche Bezeichnung moeglich.
	byte thisval; // CallOptions2
	bitval= getValue(this);
	thisval = getValue(P_FSG_41_0_0_30_9);
	thisval = thisval&~(1<<4)|(bitval<<4);
	putValue(P_FSG_41_0_0_30_9,thisval);
}

on envVar P_FSG_41_0_0_30_9_5
{
	byte bitval;
	//thisval steht hier fuer den bitfield-wert, 
	//aus Generierungsgruenden hier keine einheitliche Bezeichnung moeglich.
	byte thisval; // CallOptions2
	bitval= getValue(this);
	thisval = getValue(P_FSG_41_0_0_30_9);
	thisval = thisval&~(1<<5)|(bitval<<5);
	putValue(P_FSG_41_0_0_30_9,thisval);
}

on envVar P_FSG_41_0_0_30_9_6
{
	byte bitval;
	//thisval steht hier fuer den bitfield-wert, 
	//aus Generierungsgruenden hier keine einheitliche Bezeichnung moeglich.
	byte thisval; // CallOptions2
	bitval= getValue(this);
	thisval = getValue(P_FSG_41_0_0_30_9);
	thisval = thisval&~(1<<6)|(bitval<<6);
	putValue(P_FSG_41_0_0_30_9,thisval);
}

on envVar P_FSG_41_0_0_30_9_7
{
	byte bitval;
	//thisval steht hier fuer den bitfield-wert, 
	//aus Generierungsgruenden hier keine einheitliche Bezeichnung moeglich.
	byte thisval; // CallOptions2
	bitval= getValue(this);
	thisval = getValue(P_FSG_41_0_0_30_9);
	thisval = thisval&~(1<<7)|(bitval<<7);
	putValue(P_FSG_41_0_0_30_9,thisval);
}

on envVar P_FSG_41_0_0_30_9 // CallState2.CallOptions2
{
	P_FSG_41_0_0_30_BuildFct();
}

on envVar P_FSG_41_0_0_30_10 // CallState2.CallState3
{
	P_FSG_41_0_0_30_BuildFct();
}

on envVar P_FSG_41_0_0_30_11 // CallState2.CallType3
{
	P_FSG_41_0_0_30_BuildFct();
}

on envVar P_FSG_41_0_0_30_12_0
{
	byte bitval;
	//thisval steht hier fuer den bitfield-wert, 
	//aus Generierungsgruenden hier keine einheitliche Bezeichnung moeglich.
	byte thisval; // CallOptions3
	bitval= getValue(this);
	thisval = getValue(P_FSG_41_0_0_30_12);
	thisval = thisval&~(1<<0)|(bitval<<0);
	putValue(P_FSG_41_0_0_30_12,thisval);
}

on envVar P_FSG_41_0_0_30_12_1
{
	byte bitval;
	//thisval steht hier fuer den bitfield-wert, 
	//aus Generierungsgruenden hier keine einheitliche Bezeichnung moeglich.
	byte thisval; // CallOptions3
	bitval= getValue(this);
	thisval = getValue(P_FSG_41_0_0_30_12);
	thisval = thisval&~(1<<1)|(bitval<<1);
	putValue(P_FSG_41_0_0_30_12,thisval);
}

on envVar P_FSG_41_0_0_30_12_2
{
	byte bitval;
	//thisval steht hier fuer den bitfield-wert, 
	//aus Generierungsgruenden hier keine einheitliche Bezeichnung moeglich.
	byte thisval; // CallOptions3
	bitval= getValue(this);
	thisval = getValue(P_FSG_41_0_0_30_12);
	thisval = thisval&~(1<<2)|(bitval<<2);
	putValue(P_FSG_41_0_0_30_12,thisval);
}

on envVar P_FSG_41_0_0_30_12_3
{
	byte bitval;
	//thisval steht hier fuer den bitfield-wert, 
	//aus Generierungsgruenden hier keine einheitliche Bezeichnung moeglich.
	byte thisval; // CallOptions3
	bitval= getValue(this);
	thisval = getValue(P_FSG_41_0_0_30_12);
	thisval = thisval&~(1<<3)|(bitval<<3);
	putValue(P_FSG_41_0_0_30_12,thisval);
}

on envVar P_FSG_41_0_0_30_12_4
{
	byte bitval;
	//thisval steht hier fuer den bitfield-wert, 
	//aus Generierungsgruenden hier keine einheitliche Bezeichnung moeglich.
	byte thisval; // CallOptions3
	bitval= getValue(this);
	thisval = getValue(P_FSG_41_0_0_30_12);
	thisval = thisval&~(1<<4)|(bitval<<4);
	putValue(P_FSG_41_0_0_30_12,thisval);
}

on envVar P_FSG_41_0_0_30_12_5
{
	byte bitval;
	//thisval steht hier fuer den bitfield-wert, 
	//aus Generierungsgruenden hier keine einheitliche Bezeichnung moeglich.
	byte thisval; // CallOptions3
	bitval= getValue(this);
	thisval = getValue(P_FSG_41_0_0_30_12);
	thisval = thisval&~(1<<5)|(bitval<<5);
	putValue(P_FSG_41_0_0_30_12,thisval);
}

on envVar P_FSG_41_0_0_30_12_6
{
	byte bitval;
	//thisval steht hier fuer den bitfield-wert, 
	//aus Generierungsgruenden hier keine einheitliche Bezeichnung moeglich.
	byte thisval; // CallOptions3
	bitval= getValue(this);
	thisval = getValue(P_FSG_41_0_0_30_12);
	thisval = thisval&~(1<<6)|(bitval<<6);
	putValue(P_FSG_41_0_0_30_12,thisval);
}

on envVar P_FSG_41_0_0_30_12_7
{
	byte bitval;
	//thisval steht hier fuer den bitfield-wert, 
	//aus Generierungsgruenden hier keine einheitliche Bezeichnung moeglich.
	byte thisval; // CallOptions3
	bitval= getValue(this);
	thisval = getValue(P_FSG_41_0_0_30_12);
	thisval = thisval&~(1<<7)|(bitval<<7);
	putValue(P_FSG_41_0_0_30_12,thisval);
}

on envVar P_FSG_41_0_0_30_12 // CallState2.CallOptions3
{
	P_FSG_41_0_0_30_BuildFct();
}

on envVar P_FSG_41_0_0_30_13 // CallState2.CallState4
{
	P_FSG_41_0_0_30_BuildFct();
}

on envVar P_FSG_41_0_0_30_14 // CallState2.CallType4
{
	P_FSG_41_0_0_30_BuildFct();
}

on envVar P_FSG_41_0_0_30_15_0
{
	byte bitval;
	//thisval steht hier fuer den bitfield-wert, 
	//aus Generierungsgruenden hier keine einheitliche Bezeichnung moeglich.
	byte thisval; // CallOptions4
	bitval= getValue(this);
	thisval = getValue(P_FSG_41_0_0_30_15);
	thisval = thisval&~(1<<0)|(bitval<<0);
	putValue(P_FSG_41_0_0_30_15,thisval);
}

on envVar P_FSG_41_0_0_30_15_1
{
	byte bitval;
	//thisval steht hier fuer den bitfield-wert, 
	//aus Generierungsgruenden hier keine einheitliche Bezeichnung moeglich.
	byte thisval; // CallOptions4
	bitval= getValue(this);
	thisval = getValue(P_FSG_41_0_0_30_15);
	thisval = thisval&~(1<<1)|(bitval<<1);
	putValue(P_FSG_41_0_0_30_15,thisval);
}

on envVar P_FSG_41_0_0_30_15_2
{
	byte bitval;
	//thisval steht hier fuer den bitfield-wert, 
	//aus Generierungsgruenden hier keine einheitliche Bezeichnung moeglich.
	byte thisval; // CallOptions4
	bitval= getValue(this);
	thisval = getValue(P_FSG_41_0_0_30_15);
	thisval = thisval&~(1<<2)|(bitval<<2);
	putValue(P_FSG_41_0_0_30_15,thisval);
}

on envVar P_FSG_41_0_0_30_15_3
{
	byte bitval;
	//thisval steht hier fuer den bitfield-wert, 
	//aus Generierungsgruenden hier keine einheitliche Bezeichnung moeglich.
	byte thisval; // CallOptions4
	bitval= getValue(this);
	thisval = getValue(P_FSG_41_0_0_30_15);
	thisval = thisval&~(1<<3)|(bitval<<3);
	putValue(P_FSG_41_0_0_30_15,thisval);
}

on envVar P_FSG_41_0_0_30_15_4
{
	byte bitval;
	//thisval steht hier fuer den bitfield-wert, 
	//aus Generierungsgruenden hier keine einheitliche Bezeichnung moeglich.
	byte thisval; // CallOptions4
	bitval= getValue(this);
	thisval = getValue(P_FSG_41_0_0_30_15);
	thisval = thisval&~(1<<4)|(bitval<<4);
	putValue(P_FSG_41_0_0_30_15,thisval);
}

on envVar P_FSG_41_0_0_30_15_5
{
	byte bitval;
	//thisval steht hier fuer den bitfield-wert, 
	//aus Generierungsgruenden hier keine einheitliche Bezeichnung moeglich.
	byte thisval; // CallOptions4
	bitval= getValue(this);
	thisval = getValue(P_FSG_41_0_0_30_15);
	thisval = thisval&~(1<<5)|(bitval<<5);
	putValue(P_FSG_41_0_0_30_15,thisval);
}

on envVar P_FSG_41_0_0_30_15_6
{
	byte bitval;
	//thisval steht hier fuer den bitfield-wert, 
	//aus Generierungsgruenden hier keine einheitliche Bezeichnung moeglich.
	byte thisval; // CallOptions4
	bitval= getValue(this);
	thisval = getValue(P_FSG_41_0_0_30_15);
	thisval = thisval&~(1<<6)|(bitval<<6);
	putValue(P_FSG_41_0_0_30_15,thisval);
}

on envVar P_FSG_41_0_0_30_15_7
{
	byte bitval;
	//thisval steht hier fuer den bitfield-wert, 
	//aus Generierungsgruenden hier keine einheitliche Bezeichnung moeglich.
	byte thisval; // CallOptions4
	bitval= getValue(this);
	thisval = getValue(P_FSG_41_0_0_30_15);
	thisval = thisval&~(1<<7)|(bitval<<7);
	putValue(P_FSG_41_0_0_30_15,thisval);
}

on envVar P_FSG_41_0_0_30_15 // CallState2.CallOptions4
{
	P_FSG_41_0_0_30_BuildFct();
}

on envVar P_FSG_41_0_0_30_16 // CallState2.CallState5
{
	P_FSG_41_0_0_30_BuildFct();
}

on envVar P_FSG_41_0_0_30_17 // CallState2.CallType5
{
	P_FSG_41_0_0_30_BuildFct();
}

on envVar P_FSG_41_0_0_30_18_0
{
	byte bitval;
	//thisval steht hier fuer den bitfield-wert, 
	//aus Generierungsgruenden hier keine einheitliche Bezeichnung moeglich.
	byte thisval; // CallOptions5
	bitval= getValue(this);
	thisval = getValue(P_FSG_41_0_0_30_18);
	thisval = thisval&~(1<<0)|(bitval<<0);
	putValue(P_FSG_41_0_0_30_18,thisval);
}

on envVar P_FSG_41_0_0_30_18_1
{
	byte bitval;
	//thisval steht hier fuer den bitfield-wert, 
	//aus Generierungsgruenden hier keine einheitliche Bezeichnung moeglich.
	byte thisval; // CallOptions5
	bitval= getValue(this);
	thisval = getValue(P_FSG_41_0_0_30_18);
	thisval = thisval&~(1<<1)|(bitval<<1);
	putValue(P_FSG_41_0_0_30_18,thisval);
}

on envVar P_FSG_41_0_0_30_18_2
{
	byte bitval;
	//thisval steht hier fuer den bitfield-wert, 
	//aus Generierungsgruenden hier keine einheitliche Bezeichnung moeglich.
	byte thisval; // CallOptions5
	bitval= getValue(this);
	thisval = getValue(P_FSG_41_0_0_30_18);
	thisval = thisval&~(1<<2)|(bitval<<2);
	putValue(P_FSG_41_0_0_30_18,thisval);
}

on envVar P_FSG_41_0_0_30_18_3
{
	byte bitval;
	//thisval steht hier fuer den bitfield-wert, 
	//aus Generierungsgruenden hier keine einheitliche Bezeichnung moeglich.
	byte thisval; // CallOptions5
	bitval= getValue(this);
	thisval = getValue(P_FSG_41_0_0_30_18);
	thisval = thisval&~(1<<3)|(bitval<<3);
	putValue(P_FSG_41_0_0_30_18,thisval);
}

on envVar P_FSG_41_0_0_30_18_4
{
	byte bitval;
	//thisval steht hier fuer den bitfield-wert, 
	//aus Generierungsgruenden hier keine einheitliche Bezeichnung moeglich.
	byte thisval; // CallOptions5
	bitval= getValue(this);
	thisval = getValue(P_FSG_41_0_0_30_18);
	thisval = thisval&~(1<<4)|(bitval<<4);
	putValue(P_FSG_41_0_0_30_18,thisval);
}

on envVar P_FSG_41_0_0_30_18_5
{
	byte bitval;
	//thisval steht hier fuer den bitfield-wert, 
	//aus Generierungsgruenden hier keine einheitliche Bezeichnung moeglich.
	byte thisval; // CallOptions5
	bitval= getValue(this);
	thisval = getValue(P_FSG_41_0_0_30_18);
	thisval = thisval&~(1<<5)|(bitval<<5);
	putValue(P_FSG_41_0_0_30_18,thisval);
}

on envVar P_FSG_41_0_0_30_18_6
{
	byte bitval;
	//thisval steht hier fuer den bitfield-wert, 
	//aus Generierungsgruenden hier keine einheitliche Bezeichnung moeglich.
	byte thisval; // CallOptions5
	bitval= getValue(this);
	thisval = getValue(P_FSG_41_0_0_30_18);
	thisval = thisval&~(1<<6)|(bitval<<6);
	putValue(P_FSG_41_0_0_30_18,thisval);
}

on envVar P_FSG_41_0_0_30_18_7
{
	byte bitval;
	//thisval steht hier fuer den bitfield-wert, 
	//aus Generierungsgruenden hier keine einheitliche Bezeichnung moeglich.
	byte thisval; // CallOptions5
	bitval= getValue(this);
	thisval = getValue(P_FSG_41_0_0_30_18);
	thisval = thisval&~(1<<7)|(bitval<<7);
	putValue(P_FSG_41_0_0_30_18,thisval);
}

on envVar P_FSG_41_0_0_30_18 // CallState2.CallOptions5
{
	P_FSG_41_0_0_30_BuildFct();
}

on envVar P_FSG_41_0_0_30_19 // CallState2.CallState6
{
	P_FSG_41_0_0_30_BuildFct();
}

on envVar P_FSG_41_0_0_30_20 // CallState2.CallType6
{
	P_FSG_41_0_0_30_BuildFct();
}

on envVar P_FSG_41_0_0_30_21_0
{
	byte bitval;
	//thisval steht hier fuer den bitfield-wert, 
	//aus Generierungsgruenden hier keine einheitliche Bezeichnung moeglich.
	byte thisval; // CallOptions6
	bitval= getValue(this);
	thisval = getValue(P_FSG_41_0_0_30_21);
	thisval = thisval&~(1<<0)|(bitval<<0);
	putValue(P_FSG_41_0_0_30_21,thisval);
}

on envVar P_FSG_41_0_0_30_21_1
{
	byte bitval;
	//thisval steht hier fuer den bitfield-wert, 
	//aus Generierungsgruenden hier keine einheitliche Bezeichnung moeglich.
	byte thisval; // CallOptions6
	bitval= getValue(this);
	thisval = getValue(P_FSG_41_0_0_30_21);
	thisval = thisval&~(1<<1)|(bitval<<1);
	putValue(P_FSG_41_0_0_30_21,thisval);
}

on envVar P_FSG_41_0_0_30_21_2
{
	byte bitval;
	//thisval steht hier fuer den bitfield-wert, 
	//aus Generierungsgruenden hier keine einheitliche Bezeichnung moeglich.
	byte thisval; // CallOptions6
	bitval= getValue(this);
	thisval = getValue(P_FSG_41_0_0_30_21);
	thisval = thisval&~(1<<2)|(bitval<<2);
	putValue(P_FSG_41_0_0_30_21,thisval);
}

on envVar P_FSG_41_0_0_30_21_3
{
	byte bitval;
	//thisval steht hier fuer den bitfield-wert, 
	//aus Generierungsgruenden hier keine einheitliche Bezeichnung moeglich.
	byte thisval; // CallOptions6
	bitval= getValue(this);
	thisval = getValue(P_FSG_41_0_0_30_21);
	thisval = thisval&~(1<<3)|(bitval<<3);
	putValue(P_FSG_41_0_0_30_21,thisval);
}

on envVar P_FSG_41_0_0_30_21_4
{
	byte bitval;
	//thisval steht hier fuer den bitfield-wert, 
	//aus Generierungsgruenden hier keine einheitliche Bezeichnung moeglich.
	byte thisval; // CallOptions6
	bitval= getValue(this);
	thisval = getValue(P_FSG_41_0_0_30_21);
	thisval = thisval&~(1<<4)|(bitval<<4);
	putValue(P_FSG_41_0_0_30_21,thisval);
}

on envVar P_FSG_41_0_0_30_21_5
{
	byte bitval;
	//thisval steht hier fuer den bitfield-wert, 
	//aus Generierungsgruenden hier keine einheitliche Bezeichnung moeglich.
	byte thisval; // CallOptions6
	bitval= getValue(this);
	thisval = getValue(P_FSG_41_0_0_30_21);
	thisval = thisval&~(1<<5)|(bitval<<5);
	putValue(P_FSG_41_0_0_30_21,thisval);
}

on envVar P_FSG_41_0_0_30_21_6
{
	byte bitval;
	//thisval steht hier fuer den bitfield-wert, 
	//aus Generierungsgruenden hier keine einheitliche Bezeichnung moeglich.
	byte thisval; // CallOptions6
	bitval= getValue(this);
	thisval = getValue(P_FSG_41_0_0_30_21);
	thisval = thisval&~(1<<6)|(bitval<<6);
	putValue(P_FSG_41_0_0_30_21,thisval);
}

on envVar P_FSG_41_0_0_30_21_7
{
	byte bitval;
	//thisval steht hier fuer den bitfield-wert, 
	//aus Generierungsgruenden hier keine einheitliche Bezeichnung moeglich.
	byte thisval; // CallOptions6
	bitval= getValue(this);
	thisval = getValue(P_FSG_41_0_0_30_21);
	thisval = thisval&~(1<<7)|(bitval<<7);
	putValue(P_FSG_41_0_0_30_21,thisval);
}

on envVar P_FSG_41_0_0_30_21 // CallState2.CallOptions6
{
	P_FSG_41_0_0_30_BuildFct();
}

on envVar P_FSG_41_0_0_30_22_0
{
	byte bitval;
	//thisval steht hier fuer den bitfield-wert, 
	//aus Generierungsgruenden hier keine einheitliche Bezeichnung moeglich.
	byte thisval; // CallIncomingDiverted
	bitval= getValue(this);
	thisval = getValue(P_FSG_41_0_0_30_22);
	thisval = thisval&~(1<<0)|(bitval<<0);
	putValue(P_FSG_41_0_0_30_22,thisval);
}

on envVar P_FSG_41_0_0_30_22_1
{
	byte bitval;
	//thisval steht hier fuer den bitfield-wert, 
	//aus Generierungsgruenden hier keine einheitliche Bezeichnung moeglich.
	byte thisval; // CallIncomingDiverted
	bitval= getValue(this);
	thisval = getValue(P_FSG_41_0_0_30_22);
	thisval = thisval&~(1<<1)|(bitval<<1);
	putValue(P_FSG_41_0_0_30_22,thisval);
}

on envVar P_FSG_41_0_0_30_22_2
{
	byte bitval;
	//thisval steht hier fuer den bitfield-wert, 
	//aus Generierungsgruenden hier keine einheitliche Bezeichnung moeglich.
	byte thisval; // CallIncomingDiverted
	bitval= getValue(this);
	thisval = getValue(P_FSG_41_0_0_30_22);
	thisval = thisval&~(1<<2)|(bitval<<2);
	putValue(P_FSG_41_0_0_30_22,thisval);
}

on envVar P_FSG_41_0_0_30_22_3
{
	byte bitval;
	//thisval steht hier fuer den bitfield-wert, 
	//aus Generierungsgruenden hier keine einheitliche Bezeichnung moeglich.
	byte thisval; // CallIncomingDiverted
	bitval= getValue(this);
	thisval = getValue(P_FSG_41_0_0_30_22);
	thisval = thisval&~(1<<3)|(bitval<<3);
	putValue(P_FSG_41_0_0_30_22,thisval);
}

on envVar P_FSG_41_0_0_30_22_4
{
	byte bitval;
	//thisval steht hier fuer den bitfield-wert, 
	//aus Generierungsgruenden hier keine einheitliche Bezeichnung moeglich.
	byte thisval; // CallIncomingDiverted
	bitval= getValue(this);
	thisval = getValue(P_FSG_41_0_0_30_22);
	thisval = thisval&~(1<<4)|(bitval<<4);
	putValue(P_FSG_41_0_0_30_22,thisval);
}

on envVar P_FSG_41_0_0_30_22_5
{
	byte bitval;
	//thisval steht hier fuer den bitfield-wert, 
	//aus Generierungsgruenden hier keine einheitliche Bezeichnung moeglich.
	byte thisval; // CallIncomingDiverted
	bitval= getValue(this);
	thisval = getValue(P_FSG_41_0_0_30_22);
	thisval = thisval&~(1<<5)|(bitval<<5);
	putValue(P_FSG_41_0_0_30_22,thisval);
}

on envVar P_FSG_41_0_0_30_22_6
{
	byte bitval;
	//thisval steht hier fuer den bitfield-wert, 
	//aus Generierungsgruenden hier keine einheitliche Bezeichnung moeglich.
	byte thisval; // CallIncomingDiverted
	bitval= getValue(this);
	thisval = getValue(P_FSG_41_0_0_30_22);
	thisval = thisval&~(1<<6)|(bitval<<6);
	putValue(P_FSG_41_0_0_30_22,thisval);
}

on envVar P_FSG_41_0_0_30_22 // CallState2.CallIncomingDiverted
{
	P_FSG_41_0_0_30_BuildFct();
}

on envVar P_FSG_41_0_0_30_23_0
{
	byte bitval;
	//thisval steht hier fuer den bitfield-wert, 
	//aus Generierungsgruenden hier keine einheitliche Bezeichnung moeglich.
	byte thisval; // CallOutgoingDiverted_eCallConfirmationPending
	bitval= getValue(this);
	thisval = getValue(P_FSG_41_0_0_30_23);
	thisval = thisval&~(1<<0)|(bitval<<0);
	putValue(P_FSG_41_0_0_30_23,thisval);
}

on envVar P_FSG_41_0_0_30_23_1
{
	byte bitval;
	//thisval steht hier fuer den bitfield-wert, 
	//aus Generierungsgruenden hier keine einheitliche Bezeichnung moeglich.
	byte thisval; // CallOutgoingDiverted_eCallConfirmationPending
	bitval= getValue(this);
	thisval = getValue(P_FSG_41_0_0_30_23);
	thisval = thisval&~(1<<1)|(bitval<<1);
	putValue(P_FSG_41_0_0_30_23,thisval);
}

on envVar P_FSG_41_0_0_30_23_2
{
	byte bitval;
	//thisval steht hier fuer den bitfield-wert, 
	//aus Generierungsgruenden hier keine einheitliche Bezeichnung moeglich.
	byte thisval; // CallOutgoingDiverted_eCallConfirmationPending
	bitval= getValue(this);
	thisval = getValue(P_FSG_41_0_0_30_23);
	thisval = thisval&~(1<<2)|(bitval<<2);
	putValue(P_FSG_41_0_0_30_23,thisval);
}

on envVar P_FSG_41_0_0_30_23_3
{
	byte bitval;
	//thisval steht hier fuer den bitfield-wert, 
	//aus Generierungsgruenden hier keine einheitliche Bezeichnung moeglich.
	byte thisval; // CallOutgoingDiverted_eCallConfirmationPending
	bitval= getValue(this);
	thisval = getValue(P_FSG_41_0_0_30_23);
	thisval = thisval&~(1<<3)|(bitval<<3);
	putValue(P_FSG_41_0_0_30_23,thisval);
}

on envVar P_FSG_41_0_0_30_23_4
{
	byte bitval;
	//thisval steht hier fuer den bitfield-wert, 
	//aus Generierungsgruenden hier keine einheitliche Bezeichnung moeglich.
	byte thisval; // CallOutgoingDiverted_eCallConfirmationPending
	bitval= getValue(this);
	thisval = getValue(P_FSG_41_0_0_30_23);
	thisval = thisval&~(1<<4)|(bitval<<4);
	putValue(P_FSG_41_0_0_30_23,thisval);
}

on envVar P_FSG_41_0_0_30_23_5
{
	byte bitval;
	//thisval steht hier fuer den bitfield-wert, 
	//aus Generierungsgruenden hier keine einheitliche Bezeichnung moeglich.
	byte thisval; // CallOutgoingDiverted_eCallConfirmationPending
	bitval= getValue(this);
	thisval = getValue(P_FSG_41_0_0_30_23);
	thisval = thisval&~(1<<5)|(bitval<<5);
	putValue(P_FSG_41_0_0_30_23,thisval);
}

on envVar P_FSG_41_0_0_30_23_6
{
	byte bitval;
	//thisval steht hier fuer den bitfield-wert, 
	//aus Generierungsgruenden hier keine einheitliche Bezeichnung moeglich.
	byte thisval; // CallOutgoingDiverted_eCallConfirmationPending
	bitval= getValue(this);
	thisval = getValue(P_FSG_41_0_0_30_23);
	thisval = thisval&~(1<<6)|(bitval<<6);
	putValue(P_FSG_41_0_0_30_23,thisval);
}

on envVar P_FSG_41_0_0_30_23_7
{
	byte bitval;
	//thisval steht hier fuer den bitfield-wert, 
	//aus Generierungsgruenden hier keine einheitliche Bezeichnung moeglich.
	byte thisval; // CallOutgoingDiverted_eCallConfirmationPending
	bitval= getValue(this);
	thisval = getValue(P_FSG_41_0_0_30_23);
	thisval = thisval&~(1<<7)|(bitval<<7);
	putValue(P_FSG_41_0_0_30_23,thisval);
}

on envVar P_FSG_41_0_0_30_23 // CallState2.CallOutgoingDiverted_eCallConfirmationPending
{
	P_FSG_41_0_0_30_BuildFct();
}

// Ruecksetzen des Fehlerstatus durch manuelle Fehlereingabe
on envVar P_FSG_41_0_0_31_ErrCode
{
       if(gP_FSG_41_0_0_31_ErrCode) 
       {
           setControlBackColor(panel_name,"errfield_P_FSG_41_0_0_31", MakeRGB(255,255,255));
       }
       gP_FSG_41_0_0_31_ErrCode = 1;
}
on envVar P_FSG_41_0_0_31Status_BTN
{
	byte BAPTemp[994];
    if (P_FSG_41_0_0_31Status_BTN_already_pressed == 0)
    {
        putValue(P_FSG_41_0_0_31_ErrCode,0);
        SetControlBackColor(panel_name,"errField_P_FSG_41_0_0_31",MakeRGB(255,255,255));
        P_FSG_41_0_0_31Status_BTN_already_pressed = 1;
    }
    else
    {
		P_FSG_41_0_0_31_BuildFct();
        getValue(P_FSG_41_0_0_31, BAPTemp);
        Request_ByteSequence(LSGID, P_FSG_41_0_0_31_ID, Data_REQ, BAPTemp, getValueSize(P_FSG_41_0_0_31));
        if(getValue(P_FSG_41_0_0_31_IntTlgEn)) //getValue(IT))
        {
           intertelegram_err(P_FSG_41_0_0_31_ID);
        }
        if(getValue(P_FSG_41_0_0_31_SegmEn))   //getvalue(SG)
        {
           sequence_err(P_FSG_41_0_0_31_ID,elCount(BAPTemp));
        }
       P_FSG_41_0_0_31Status_BTN_already_pressed = 0;
    }
}
on envVar P_FSG_41_0_0_31_FctEn
{
    long data[3];
    data[0]=LSGID;
    data[1]=P_FSG_41_0_0_31_ID;
    data[2]=getValue(P_FSG_41_0_0_31_FctEn);
    ChangeConfig(0x0031,data);
}
// De-Aktivierung der Eingabefelder der FCTID P_FSG_41_0_0_31
on envVar P_FSG_41_0_0_31_FctLstItemEn
{
       if(getValue(this)) 
       {
           EnableControl(panel_name,"panel_FSG_41_0_0_31",1);
           EnableControl(panel_name,"errfield_P_FSG_41_0_0_31",1);
           EnableControl(panel_name,"panel_P_FSG_41_0_0_31",1);
           setControlForeColor(panel_name, "checkbox_P_FSG_41_0_0_31", MakeRGB(0,240,0));
       }
       else
       {
           EnableControl(panel_name,"panel_FSG_41_0_0_31",0);
           EnableControl(panel_name,"errfield_P_FSG_41_0_0_31",0);
           EnableControl(panel_name,"panel_P_FSG_41_0_0_31",0);
           setControlForeColor(panel_name, "checkbox_P_FSG_41_0_0_31", MakeRGB(250,0,0));
       }
}
// Man darf gleichzeitig nur Checkbox fuer SegmError oder IntertelegramError aktiviert werden
on envVar P_FSG_41_0_0_31_IntTlgEn
{
       if(getValue(this)) 
       {
           putValue(P_FSG_41_0_0_31_SegmEn,0);
           intertelegram_err(P_FSG_41_0_0_31_ID);
       }
       else
       {
           intertelegram_err_off(P_FSG_41_0_0_31_ID);
       }
}
// Man darf gleichzeitig nur Checkbox fuer SegmError oder IntertelegramError aktiviert werden
on envVar P_FSG_41_0_0_31_SegmEn
{
       if(getValue(this)) 
       {
           putValue(P_FSG_41_0_0_31_IntTlgEn,0);
           sequence_err(P_FSG_41_0_0_31_ID,getValueSize(P_FSG_41_0_0_31_SegmEn));
       }
       else
       {
              sequence_err_off(P_FSG_41_0_0_31_ID);
       }
}
on envVar P_FSG_41_0_0_31 // bus value of CallInfo2 (31).
{
	// opcodes: Error-Status
	byte param1[100]; // PbName0
	word len1;
	byte cnt1;
	byte param2[41]; // TelNumber0
	word len2;
	byte cnt2;
	byte param3; // Category0
	byte param4[100]; // PbName1
	word len4;
	byte cnt4;
	byte param5[41]; // TelNumber1
	word len5;
	byte cnt5;
	byte param6; // Category1
	byte param7[100]; // PbName2
	word len7;
	byte cnt7;
	byte param8[41]; // TelNumber2
	word len8;
	byte cnt8;
	byte param9; // Category2
	byte param10[100]; // PbName3
	word len10;
	byte cnt10;
	byte param11[41]; // TelNumber3
	word len11;
	byte cnt11;
	byte param12; // Category3
	byte param13[100]; // PbName4
	word len13;
	byte cnt13;
	byte param14[41]; // TelNumber4
	word len14;
	byte cnt14;
	byte param15; // Category4
	byte param16[100]; // PbName5
	word len16;
	byte cnt16;
	byte param17[41]; // TelNumber5
	word len17;
	byte cnt17;
	byte param18; // Category5
	byte param19[100]; // PbName6
	word len19;
	byte cnt19;
	byte param20[41]; // TelNumber6
	word len20;
	byte cnt20;
	byte param21; // Category6
	// DATATYPE_BYTESEQUENCE / DATATYPE_FIXEDBYTESEQUENCE
	int i;
	byte superval[994];
	int currentPos;
	currentPos = 0;
	for( i = 0; i < 994; i++ ) {
		superval[i] = 0;
	}
	getValue(P_FSG_41_0_0_31, superval);
	///////// Start param1 - STRING /////////
	getValue(P_FSG_41_0_0_31_1_Hex, param1);
	if((superval[currentPos] & 0x80) > 0)
	{
		if(99>127) /* Max Fct-Katalog Laenge: 99*/
		{
			len1 = ( (superval[currentPos]&0x7F) <<8) + superval[currentPos+1];
			currentPos = currentPos + 2;
			cnt1 = 1;
		}
		else
		{
			len1 = 99;
			writelineEx(gBAP_Trace, 0, "Anzahl der Laengeninformation-Bytes in P_FSG_41_0_0_31 ueberschreitet die erlaubte 1 Byte vom Fct-Kalatog.");
		}
	}
	else
	{
		len1 = superval[currentPos]&0x7F;
		currentPos = currentPos + 1;
		cnt1 = 0;
	}
	
	if(len1 > 99)
	{
		writelineEx(gBAP_Trace, 0, "Laenge:%d bei der Byte Position:%d ueberschreitet die Maximale erlaubte Laenge von Fct-Kalatog", len1, currentPos);
		len1 = 99;
	
		if(len1 < 128) cnt1 = 0;
		else cnt1 = 1;
	}
	
	for(i = 0; i < len1; i++)
	{
		param1[i] = superval[currentPos++];
	}
	
	putValue(P_FSG_41_0_0_31_1_len, len1);
	putValue(P_FSG_41_0_0_31_1_cnt, cnt1);
	
	if(len1 > getValueSize(P_FSG_41_0_0_31_1_Hex))
		putValue(P_FSG_41_0_0_31_1_Hex, param1, len1);
	else
		putValue(P_FSG_41_0_0_31_1_Hex, param1, getValueSize(P_FSG_41_0_0_31_1_Hex));

	///////// Start param2 - STRING /////////
	getValue(P_FSG_41_0_0_31_2_Hex, param2);
	if((superval[currentPos] & 0x80) > 0)
	{
		if(40>127) /* Max Fct-Katalog Laenge: 40*/
		{
			len2 = ( (superval[currentPos]&0x7F) <<8) + superval[currentPos+1];
			currentPos = currentPos + 2;
			cnt2 = 1;
		}
		else
		{
			len2 = 40;
			writelineEx(gBAP_Trace, 0, "Anzahl der Laengeninformation-Bytes in P_FSG_41_0_0_31 ueberschreitet die erlaubte 1 Byte vom Fct-Kalatog.");
		}
	}
	else
	{
		len2 = superval[currentPos]&0x7F;
		currentPos = currentPos + 1;
		cnt2 = 0;
	}
	
	if(len2 > 40)
	{
		writelineEx(gBAP_Trace, 0, "Laenge:%d bei der Byte Position:%d ueberschreitet die Maximale erlaubte Laenge von Fct-Kalatog", len2, currentPos);
		len2 = 40;
	
		if(len2 < 128) cnt2 = 0;
		else cnt2 = 1;
	}
	
	for(i = 0; i < len2; i++)
	{
		param2[i] = superval[currentPos++];
	}
	
	putValue(P_FSG_41_0_0_31_2_len, len2);
	putValue(P_FSG_41_0_0_31_2_cnt, cnt2);
	
	if(len2 > getValueSize(P_FSG_41_0_0_31_2_Hex))
		putValue(P_FSG_41_0_0_31_2_Hex, param2, len2);
	else
		putValue(P_FSG_41_0_0_31_2_Hex, param2, getValueSize(P_FSG_41_0_0_31_2_Hex));

	///////// Start param3 - UINT8 /////////
	param3 = superval[currentPos++];
	putValue(P_FSG_41_0_0_31_3, param3);
	///////// Start param4 - STRING /////////
	getValue(P_FSG_41_0_0_31_4_Hex, param4);
	if((superval[currentPos] & 0x80) > 0)
	{
		if(99>127) /* Max Fct-Katalog Laenge: 99*/
		{
			len4 = ( (superval[currentPos]&0x7F) <<8) + superval[currentPos+1];
			currentPos = currentPos + 2;
			cnt4 = 1;
		}
		else
		{
			len4 = 99;
			writelineEx(gBAP_Trace, 0, "Anzahl der Laengeninformation-Bytes in P_FSG_41_0_0_31 ueberschreitet die erlaubte 1 Byte vom Fct-Kalatog.");
		}
	}
	else
	{
		len4 = superval[currentPos]&0x7F;
		currentPos = currentPos + 1;
		cnt4 = 0;
	}
	
	if(len4 > 99)
	{
		writelineEx(gBAP_Trace, 0, "Laenge:%d bei der Byte Position:%d ueberschreitet die Maximale erlaubte Laenge von Fct-Kalatog", len4, currentPos);
		len4 = 99;
	
		if(len4 < 128) cnt4 = 0;
		else cnt4 = 1;
	}
	
	for(i = 0; i < len4; i++)
	{
		param4[i] = superval[currentPos++];
	}
	
	putValue(P_FSG_41_0_0_31_4_len, len4);
	putValue(P_FSG_41_0_0_31_4_cnt, cnt4);
	
	if(len4 > getValueSize(P_FSG_41_0_0_31_4_Hex))
		putValue(P_FSG_41_0_0_31_4_Hex, param4, len4);
	else
		putValue(P_FSG_41_0_0_31_4_Hex, param4, getValueSize(P_FSG_41_0_0_31_4_Hex));

	///////// Start param5 - STRING /////////
	getValue(P_FSG_41_0_0_31_5_Hex, param5);
	if((superval[currentPos] & 0x80) > 0)
	{
		if(40>127) /* Max Fct-Katalog Laenge: 40*/
		{
			len5 = ( (superval[currentPos]&0x7F) <<8) + superval[currentPos+1];
			currentPos = currentPos + 2;
			cnt5 = 1;
		}
		else
		{
			len5 = 40;
			writelineEx(gBAP_Trace, 0, "Anzahl der Laengeninformation-Bytes in P_FSG_41_0_0_31 ueberschreitet die erlaubte 1 Byte vom Fct-Kalatog.");
		}
	}
	else
	{
		len5 = superval[currentPos]&0x7F;
		currentPos = currentPos + 1;
		cnt5 = 0;
	}
	
	if(len5 > 40)
	{
		writelineEx(gBAP_Trace, 0, "Laenge:%d bei der Byte Position:%d ueberschreitet die Maximale erlaubte Laenge von Fct-Kalatog", len5, currentPos);
		len5 = 40;
	
		if(len5 < 128) cnt5 = 0;
		else cnt5 = 1;
	}
	
	for(i = 0; i < len5; i++)
	{
		param5[i] = superval[currentPos++];
	}
	
	putValue(P_FSG_41_0_0_31_5_len, len5);
	putValue(P_FSG_41_0_0_31_5_cnt, cnt5);
	
	if(len5 > getValueSize(P_FSG_41_0_0_31_5_Hex))
		putValue(P_FSG_41_0_0_31_5_Hex, param5, len5);
	else
		putValue(P_FSG_41_0_0_31_5_Hex, param5, getValueSize(P_FSG_41_0_0_31_5_Hex));

	///////// Start param6 - UINT8 /////////
	param6 = superval[currentPos++];
	putValue(P_FSG_41_0_0_31_6, param6);
	///////// Start param7 - STRING /////////
	getValue(P_FSG_41_0_0_31_7_Hex, param7);
	if((superval[currentPos] & 0x80) > 0)
	{
		if(99>127) /* Max Fct-Katalog Laenge: 99*/
		{
			len7 = ( (superval[currentPos]&0x7F) <<8) + superval[currentPos+1];
			currentPos = currentPos + 2;
			cnt7 = 1;
		}
		else
		{
			len7 = 99;
			writelineEx(gBAP_Trace, 0, "Anzahl der Laengeninformation-Bytes in P_FSG_41_0_0_31 ueberschreitet die erlaubte 1 Byte vom Fct-Kalatog.");
		}
	}
	else
	{
		len7 = superval[currentPos]&0x7F;
		currentPos = currentPos + 1;
		cnt7 = 0;
	}
	
	if(len7 > 99)
	{
		writelineEx(gBAP_Trace, 0, "Laenge:%d bei der Byte Position:%d ueberschreitet die Maximale erlaubte Laenge von Fct-Kalatog", len7, currentPos);
		len7 = 99;
	
		if(len7 < 128) cnt7 = 0;
		else cnt7 = 1;
	}
	
	for(i = 0; i < len7; i++)
	{
		param7[i] = superval[currentPos++];
	}
	
	putValue(P_FSG_41_0_0_31_7_len, len7);
	putValue(P_FSG_41_0_0_31_7_cnt, cnt7);
	
	if(len7 > getValueSize(P_FSG_41_0_0_31_7_Hex))
		putValue(P_FSG_41_0_0_31_7_Hex, param7, len7);
	else
		putValue(P_FSG_41_0_0_31_7_Hex, param7, getValueSize(P_FSG_41_0_0_31_7_Hex));

	///////// Start param8 - STRING /////////
	getValue(P_FSG_41_0_0_31_8_Hex, param8);
	if((superval[currentPos] & 0x80) > 0)
	{
		if(40>127) /* Max Fct-Katalog Laenge: 40*/
		{
			len8 = ( (superval[currentPos]&0x7F) <<8) + superval[currentPos+1];
			currentPos = currentPos + 2;
			cnt8 = 1;
		}
		else
		{
			len8 = 40;
			writelineEx(gBAP_Trace, 0, "Anzahl der Laengeninformation-Bytes in P_FSG_41_0_0_31 ueberschreitet die erlaubte 1 Byte vom Fct-Kalatog.");
		}
	}
	else
	{
		len8 = superval[currentPos]&0x7F;
		currentPos = currentPos + 1;
		cnt8 = 0;
	}
	
	if(len8 > 40)
	{
		writelineEx(gBAP_Trace, 0, "Laenge:%d bei der Byte Position:%d ueberschreitet die Maximale erlaubte Laenge von Fct-Kalatog", len8, currentPos);
		len8 = 40;
	
		if(len8 < 128) cnt8 = 0;
		else cnt8 = 1;
	}
	
	for(i = 0; i < len8; i++)
	{
		param8[i] = superval[currentPos++];
	}
	
	putValue(P_FSG_41_0_0_31_8_len, len8);
	putValue(P_FSG_41_0_0_31_8_cnt, cnt8);
	
	if(len8 > getValueSize(P_FSG_41_0_0_31_8_Hex))
		putValue(P_FSG_41_0_0_31_8_Hex, param8, len8);
	else
		putValue(P_FSG_41_0_0_31_8_Hex, param8, getValueSize(P_FSG_41_0_0_31_8_Hex));

	///////// Start param9 - UINT8 /////////
	param9 = superval[currentPos++];
	putValue(P_FSG_41_0_0_31_9, param9);
	///////// Start param10 - STRING /////////
	getValue(P_FSG_41_0_0_31_10_Hex, param10);
	if((superval[currentPos] & 0x80) > 0)
	{
		if(99>127) /* Max Fct-Katalog Laenge: 99*/
		{
			len10 = ( (superval[currentPos]&0x7F) <<8) + superval[currentPos+1];
			currentPos = currentPos + 2;
			cnt10 = 1;
		}
		else
		{
			len10 = 99;
			writelineEx(gBAP_Trace, 0, "Anzahl der Laengeninformation-Bytes in P_FSG_41_0_0_31 ueberschreitet die erlaubte 1 Byte vom Fct-Kalatog.");
		}
	}
	else
	{
		len10 = superval[currentPos]&0x7F;
		currentPos = currentPos + 1;
		cnt10 = 0;
	}
	
	if(len10 > 99)
	{
		writelineEx(gBAP_Trace, 0, "Laenge:%d bei der Byte Position:%d ueberschreitet die Maximale erlaubte Laenge von Fct-Kalatog", len10, currentPos);
		len10 = 99;
	
		if(len10 < 128) cnt10 = 0;
		else cnt10 = 1;
	}
	
	for(i = 0; i < len10; i++)
	{
		param10[i] = superval[currentPos++];
	}
	
	putValue(P_FSG_41_0_0_31_10_len, len10);
	putValue(P_FSG_41_0_0_31_10_cnt, cnt10);
	
	if(len10 > getValueSize(P_FSG_41_0_0_31_10_Hex))
		putValue(P_FSG_41_0_0_31_10_Hex, param10, len10);
	else
		putValue(P_FSG_41_0_0_31_10_Hex, param10, getValueSize(P_FSG_41_0_0_31_10_Hex));

	///////// Start param11 - STRING /////////
	getValue(P_FSG_41_0_0_31_11_Hex, param11);
	if((superval[currentPos] & 0x80) > 0)
	{
		if(40>127) /* Max Fct-Katalog Laenge: 40*/
		{
			len11 = ( (superval[currentPos]&0x7F) <<8) + superval[currentPos+1];
			currentPos = currentPos + 2;
			cnt11 = 1;
		}
		else
		{
			len11 = 40;
			writelineEx(gBAP_Trace, 0, "Anzahl der Laengeninformation-Bytes in P_FSG_41_0_0_31 ueberschreitet die erlaubte 1 Byte vom Fct-Kalatog.");
		}
	}
	else
	{
		len11 = superval[currentPos]&0x7F;
		currentPos = currentPos + 1;
		cnt11 = 0;
	}
	
	if(len11 > 40)
	{
		writelineEx(gBAP_Trace, 0, "Laenge:%d bei der Byte Position:%d ueberschreitet die Maximale erlaubte Laenge von Fct-Kalatog", len11, currentPos);
		len11 = 40;
	
		if(len11 < 128) cnt11 = 0;
		else cnt11 = 1;
	}
	
	for(i = 0; i < len11; i++)
	{
		param11[i] = superval[currentPos++];
	}
	
	putValue(P_FSG_41_0_0_31_11_len, len11);
	putValue(P_FSG_41_0_0_31_11_cnt, cnt11);
	
	if(len11 > getValueSize(P_FSG_41_0_0_31_11_Hex))
		putValue(P_FSG_41_0_0_31_11_Hex, param11, len11);
	else
		putValue(P_FSG_41_0_0_31_11_Hex, param11, getValueSize(P_FSG_41_0_0_31_11_Hex));

	///////// Start param12 - UINT8 /////////
	param12 = superval[currentPos++];
	putValue(P_FSG_41_0_0_31_12, param12);
	///////// Start param13 - STRING /////////
	getValue(P_FSG_41_0_0_31_13_Hex, param13);
	if((superval[currentPos] & 0x80) > 0)
	{
		if(99>127) /* Max Fct-Katalog Laenge: 99*/
		{
			len13 = ( (superval[currentPos]&0x7F) <<8) + superval[currentPos+1];
			currentPos = currentPos + 2;
			cnt13 = 1;
		}
		else
		{
			len13 = 99;
			writelineEx(gBAP_Trace, 0, "Anzahl der Laengeninformation-Bytes in P_FSG_41_0_0_31 ueberschreitet die erlaubte 1 Byte vom Fct-Kalatog.");
		}
	}
	else
	{
		len13 = superval[currentPos]&0x7F;
		currentPos = currentPos + 1;
		cnt13 = 0;
	}
	
	if(len13 > 99)
	{
		writelineEx(gBAP_Trace, 0, "Laenge:%d bei der Byte Position:%d ueberschreitet die Maximale erlaubte Laenge von Fct-Kalatog", len13, currentPos);
		len13 = 99;
	
		if(len13 < 128) cnt13 = 0;
		else cnt13 = 1;
	}
	
	for(i = 0; i < len13; i++)
	{
		param13[i] = superval[currentPos++];
	}
	
	putValue(P_FSG_41_0_0_31_13_len, len13);
	putValue(P_FSG_41_0_0_31_13_cnt, cnt13);
	
	if(len13 > getValueSize(P_FSG_41_0_0_31_13_Hex))
		putValue(P_FSG_41_0_0_31_13_Hex, param13, len13);
	else
		putValue(P_FSG_41_0_0_31_13_Hex, param13, getValueSize(P_FSG_41_0_0_31_13_Hex));

	///////// Start param14 - STRING /////////
	getValue(P_FSG_41_0_0_31_14_Hex, param14);
	if((superval[currentPos] & 0x80) > 0)
	{
		if(40>127) /* Max Fct-Katalog Laenge: 40*/
		{
			len14 = ( (superval[currentPos]&0x7F) <<8) + superval[currentPos+1];
			currentPos = currentPos + 2;
			cnt14 = 1;
		}
		else
		{
			len14 = 40;
			writelineEx(gBAP_Trace, 0, "Anzahl der Laengeninformation-Bytes in P_FSG_41_0_0_31 ueberschreitet die erlaubte 1 Byte vom Fct-Kalatog.");
		}
	}
	else
	{
		len14 = superval[currentPos]&0x7F;
		currentPos = currentPos + 1;
		cnt14 = 0;
	}
	
	if(len14 > 40)
	{
		writelineEx(gBAP_Trace, 0, "Laenge:%d bei der Byte Position:%d ueberschreitet die Maximale erlaubte Laenge von Fct-Kalatog", len14, currentPos);
		len14 = 40;
	
		if(len14 < 128) cnt14 = 0;
		else cnt14 = 1;
	}
	
	for(i = 0; i < len14; i++)
	{
		param14[i] = superval[currentPos++];
	}
	
	putValue(P_FSG_41_0_0_31_14_len, len14);
	putValue(P_FSG_41_0_0_31_14_cnt, cnt14);
	
	if(len14 > getValueSize(P_FSG_41_0_0_31_14_Hex))
		putValue(P_FSG_41_0_0_31_14_Hex, param14, len14);
	else
		putValue(P_FSG_41_0_0_31_14_Hex, param14, getValueSize(P_FSG_41_0_0_31_14_Hex));

	///////// Start param15 - UINT8 /////////
	param15 = superval[currentPos++];
	putValue(P_FSG_41_0_0_31_15, param15);
	///////// Start param16 - STRING /////////
	getValue(P_FSG_41_0_0_31_16_Hex, param16);
	if((superval[currentPos] & 0x80) > 0)
	{
		if(99>127) /* Max Fct-Katalog Laenge: 99*/
		{
			len16 = ( (superval[currentPos]&0x7F) <<8) + superval[currentPos+1];
			currentPos = currentPos + 2;
			cnt16 = 1;
		}
		else
		{
			len16 = 99;
			writelineEx(gBAP_Trace, 0, "Anzahl der Laengeninformation-Bytes in P_FSG_41_0_0_31 ueberschreitet die erlaubte 1 Byte vom Fct-Kalatog.");
		}
	}
	else
	{
		len16 = superval[currentPos]&0x7F;
		currentPos = currentPos + 1;
		cnt16 = 0;
	}
	
	if(len16 > 99)
	{
		writelineEx(gBAP_Trace, 0, "Laenge:%d bei der Byte Position:%d ueberschreitet die Maximale erlaubte Laenge von Fct-Kalatog", len16, currentPos);
		len16 = 99;
	
		if(len16 < 128) cnt16 = 0;
		else cnt16 = 1;
	}
	
	for(i = 0; i < len16; i++)
	{
		param16[i] = superval[currentPos++];
	}
	
	putValue(P_FSG_41_0_0_31_16_len, len16);
	putValue(P_FSG_41_0_0_31_16_cnt, cnt16);
	
	if(len16 > getValueSize(P_FSG_41_0_0_31_16_Hex))
		putValue(P_FSG_41_0_0_31_16_Hex, param16, len16);
	else
		putValue(P_FSG_41_0_0_31_16_Hex, param16, getValueSize(P_FSG_41_0_0_31_16_Hex));

	///////// Start param17 - STRING /////////
	getValue(P_FSG_41_0_0_31_17_Hex, param17);
	if((superval[currentPos] & 0x80) > 0)
	{
		if(40>127) /* Max Fct-Katalog Laenge: 40*/
		{
			len17 = ( (superval[currentPos]&0x7F) <<8) + superval[currentPos+1];
			currentPos = currentPos + 2;
			cnt17 = 1;
		}
		else
		{
			len17 = 40;
			writelineEx(gBAP_Trace, 0, "Anzahl der Laengeninformation-Bytes in P_FSG_41_0_0_31 ueberschreitet die erlaubte 1 Byte vom Fct-Kalatog.");
		}
	}
	else
	{
		len17 = superval[currentPos]&0x7F;
		currentPos = currentPos + 1;
		cnt17 = 0;
	}
	
	if(len17 > 40)
	{
		writelineEx(gBAP_Trace, 0, "Laenge:%d bei der Byte Position:%d ueberschreitet die Maximale erlaubte Laenge von Fct-Kalatog", len17, currentPos);
		len17 = 40;
	
		if(len17 < 128) cnt17 = 0;
		else cnt17 = 1;
	}
	
	for(i = 0; i < len17; i++)
	{
		param17[i] = superval[currentPos++];
	}
	
	putValue(P_FSG_41_0_0_31_17_len, len17);
	putValue(P_FSG_41_0_0_31_17_cnt, cnt17);
	
	if(len17 > getValueSize(P_FSG_41_0_0_31_17_Hex))
		putValue(P_FSG_41_0_0_31_17_Hex, param17, len17);
	else
		putValue(P_FSG_41_0_0_31_17_Hex, param17, getValueSize(P_FSG_41_0_0_31_17_Hex));

	///////// Start param18 - UINT8 /////////
	param18 = superval[currentPos++];
	putValue(P_FSG_41_0_0_31_18, param18);
	///////// Start param19 - STRING /////////
	getValue(P_FSG_41_0_0_31_19_Hex, param19);
	if((superval[currentPos] & 0x80) > 0)
	{
		if(99>127) /* Max Fct-Katalog Laenge: 99*/
		{
			len19 = ( (superval[currentPos]&0x7F) <<8) + superval[currentPos+1];
			currentPos = currentPos + 2;
			cnt19 = 1;
		}
		else
		{
			len19 = 99;
			writelineEx(gBAP_Trace, 0, "Anzahl der Laengeninformation-Bytes in P_FSG_41_0_0_31 ueberschreitet die erlaubte 1 Byte vom Fct-Kalatog.");
		}
	}
	else
	{
		len19 = superval[currentPos]&0x7F;
		currentPos = currentPos + 1;
		cnt19 = 0;
	}
	
	if(len19 > 99)
	{
		writelineEx(gBAP_Trace, 0, "Laenge:%d bei der Byte Position:%d ueberschreitet die Maximale erlaubte Laenge von Fct-Kalatog", len19, currentPos);
		len19 = 99;
	
		if(len19 < 128) cnt19 = 0;
		else cnt19 = 1;
	}
	
	for(i = 0; i < len19; i++)
	{
		param19[i] = superval[currentPos++];
	}
	
	putValue(P_FSG_41_0_0_31_19_len, len19);
	putValue(P_FSG_41_0_0_31_19_cnt, cnt19);
	
	if(len19 > getValueSize(P_FSG_41_0_0_31_19_Hex))
		putValue(P_FSG_41_0_0_31_19_Hex, param19, len19);
	else
		putValue(P_FSG_41_0_0_31_19_Hex, param19, getValueSize(P_FSG_41_0_0_31_19_Hex));

	///////// Start param20 - STRING /////////
	getValue(P_FSG_41_0_0_31_20_Hex, param20);
	if((superval[currentPos] & 0x80) > 0)
	{
		if(40>127) /* Max Fct-Katalog Laenge: 40*/
		{
			len20 = ( (superval[currentPos]&0x7F) <<8) + superval[currentPos+1];
			currentPos = currentPos + 2;
			cnt20 = 1;
		}
		else
		{
			len20 = 40;
			writelineEx(gBAP_Trace, 0, "Anzahl der Laengeninformation-Bytes in P_FSG_41_0_0_31 ueberschreitet die erlaubte 1 Byte vom Fct-Kalatog.");
		}
	}
	else
	{
		len20 = superval[currentPos]&0x7F;
		currentPos = currentPos + 1;
		cnt20 = 0;
	}
	
	if(len20 > 40)
	{
		writelineEx(gBAP_Trace, 0, "Laenge:%d bei der Byte Position:%d ueberschreitet die Maximale erlaubte Laenge von Fct-Kalatog", len20, currentPos);
		len20 = 40;
	
		if(len20 < 128) cnt20 = 0;
		else cnt20 = 1;
	}
	
	for(i = 0; i < len20; i++)
	{
		param20[i] = superval[currentPos++];
	}
	
	putValue(P_FSG_41_0_0_31_20_len, len20);
	putValue(P_FSG_41_0_0_31_20_cnt, cnt20);
	
	if(len20 > getValueSize(P_FSG_41_0_0_31_20_Hex))
		putValue(P_FSG_41_0_0_31_20_Hex, param20, len20);
	else
		putValue(P_FSG_41_0_0_31_20_Hex, param20, getValueSize(P_FSG_41_0_0_31_20_Hex));

	///////// Start param21 - UINT8 /////////
	param21 = superval[currentPos++];
	putValue(P_FSG_41_0_0_31_21, param21);
}

// Updates the bus value field and other dependencies.
P_FSG_41_0_0_31_BuildFct()
{
	byte param1[100]; // PbName0
	word len1;
	byte cnt1;
	byte param2[41]; // TelNumber0
	word len2;
	byte cnt2;
	byte param3; // Category0
	byte param4[100]; // PbName1
	word len4;
	byte cnt4;
	byte param5[41]; // TelNumber1
	word len5;
	byte cnt5;
	byte param6; // Category1
	byte param7[100]; // PbName2
	word len7;
	byte cnt7;
	byte param8[41]; // TelNumber2
	word len8;
	byte cnt8;
	byte param9; // Category2
	byte param10[100]; // PbName3
	word len10;
	byte cnt10;
	byte param11[41]; // TelNumber3
	word len11;
	byte cnt11;
	byte param12; // Category3
	byte param13[100]; // PbName4
	word len13;
	byte cnt13;
	byte param14[41]; // TelNumber4
	word len14;
	byte cnt14;
	byte param15; // Category4
	byte param16[100]; // PbName5
	word len16;
	byte cnt16;
	byte param17[41]; // TelNumber5
	word len17;
	byte cnt17;
	byte param18; // Category5
	byte param19[100]; // PbName6
	word len19;
	byte cnt19;
	byte param20[41]; // TelNumber6
	word len20;
	byte cnt20;
	byte param21; // Category6

	int i;
	byte superval[994];
	int currentPos;
	currentPos = 0;
// gen_BuildFunc_SetSuperVals 
	getValue(P_FSG_41_0_0_31_1_Hex, param1);
	len1 = getValue(P_FSG_41_0_0_31_1_len);
	cnt1= getValue(P_FSG_41_0_0_31_1_cnt);
	
	/* check box aktiviert*/
	if (cnt1 == 1)
	{
		/* 0 bis 99 (MaxString - 1B oder 2B) */
		if(len1 >= 0 && len1 <= 99)
		{
			//writelineEx(gBAP_Trace, 0, "[Debug-1] Len1: %d", len1);
			superval[currentPos] = (len1&0x7f00) | 0x80;
			superval[currentPos+1] = len1 & 0x00ff;
		}
		else
		{
			writelineEx(gBAP_Trace, 0, "Eingegebene Laenge: %d von P_FSG_41_0_0_31_1 ist ungueltig. Die max. erlaubte Laenge ist %d.", len1, 99);
			return;
		}
	}
	else if(cnt1 == 0) /*check box deaktiviert*/
	{
		if(len1 >= 0 && len1 <= 127)
		{
			//writelineEx(gBAP_Trace, 0, "[Debug-1] Len1: %d", len1);
			superval[currentPos]= len1 & 0x00ff;
			putValue(P_FSG_41_0_0_31_1_len, len1);
		}
		else if(len1 > 127 && len1 <= 99)
		{
			superval[currentPos] = (len1&0x7f00) | 0x80;
			superval[currentPos+1] = len1 & 0x00ff;
			putValue(P_FSG_41_0_0_31_1_len, len1);
			putValue(P_FSG_41_0_0_31_1_cnt, 1);
		}
		else
		{
			writelineEx(gBAP_Trace, 0, "Eingegebene Laenge: %d von P_FSG_41_0_0_31_1 ist ungueltig. Die max. erlaubte Laenge ist %d.", len1, 99);
			return;
		}
	}
	currentPos += cnt1+1;
	for(i = 0; i < len1; i++)
	{
		superval[currentPos++]= param1[i];
	}

// gen_BuildFunc_SetSuperVals 
	getValue(P_FSG_41_0_0_31_2_Hex, param2);
	len2 = getValue(P_FSG_41_0_0_31_2_len);
	cnt2= getValue(P_FSG_41_0_0_31_2_cnt);
	
	/* check box aktiviert*/
	if (cnt2 == 1)
	{
		/* 0 bis 40 (MaxString - 1B oder 2B) */
		if(len2 >= 0 && len2 <= 40)
		{
			//writelineEx(gBAP_Trace, 0, "[Debug-1] Len2: %d", len2);
			superval[currentPos] = (len2&0x7f00) | 0x80;
			superval[currentPos+1] = len2 & 0x00ff;
		}
		else
		{
			writelineEx(gBAP_Trace, 0, "Eingegebene Laenge: %d von P_FSG_41_0_0_31_2 ist ungueltig. Die max. erlaubte Laenge ist %d.", len2, 40);
			return;
		}
	}
	else if(cnt2 == 0) /*check box deaktiviert*/
	{
		if(len2 >= 0 && len2 <= 127)
		{
			//writelineEx(gBAP_Trace, 0, "[Debug-1] Len2: %d", len2);
			superval[currentPos]= len2 & 0x00ff;
			putValue(P_FSG_41_0_0_31_2_len, len2);
		}
		else if(len2 > 127 && len2 <= 40)
		{
			superval[currentPos] = (len2&0x7f00) | 0x80;
			superval[currentPos+1] = len2 & 0x00ff;
			putValue(P_FSG_41_0_0_31_2_len, len2);
			putValue(P_FSG_41_0_0_31_2_cnt, 1);
		}
		else
		{
			writelineEx(gBAP_Trace, 0, "Eingegebene Laenge: %d von P_FSG_41_0_0_31_2 ist ungueltig. Die max. erlaubte Laenge ist %d.", len2, 40);
			return;
		}
	}
	currentPos += cnt2+1;
	for(i = 0; i < len2; i++)
	{
		superval[currentPos++]= param2[i];
	}

// gen_BuildFunc_SetSuperVals 
	param3 = getValue(P_FSG_41_0_0_31_3);
	superval[currentPos++]=param3;
// gen_BuildFunc_SetSuperVals 
	getValue(P_FSG_41_0_0_31_4_Hex, param4);
	len4 = getValue(P_FSG_41_0_0_31_4_len);
	cnt4= getValue(P_FSG_41_0_0_31_4_cnt);
	
	/* check box aktiviert*/
	if (cnt4 == 1)
	{
		/* 0 bis 99 (MaxString - 1B oder 2B) */
		if(len4 >= 0 && len4 <= 99)
		{
			//writelineEx(gBAP_Trace, 0, "[Debug-1] Len4: %d", len4);
			superval[currentPos] = (len4&0x7f00) | 0x80;
			superval[currentPos+1] = len4 & 0x00ff;
		}
		else
		{
			writelineEx(gBAP_Trace, 0, "Eingegebene Laenge: %d von P_FSG_41_0_0_31_4 ist ungueltig. Die max. erlaubte Laenge ist %d.", len4, 99);
			return;
		}
	}
	else if(cnt4 == 0) /*check box deaktiviert*/
	{
		if(len4 >= 0 && len4 <= 127)
		{
			//writelineEx(gBAP_Trace, 0, "[Debug-1] Len4: %d", len4);
			superval[currentPos]= len4 & 0x00ff;
			putValue(P_FSG_41_0_0_31_4_len, len4);
		}
		else if(len4 > 127 && len4 <= 99)
		{
			superval[currentPos] = (len4&0x7f00) | 0x80;
			superval[currentPos+1] = len4 & 0x00ff;
			putValue(P_FSG_41_0_0_31_4_len, len4);
			putValue(P_FSG_41_0_0_31_4_cnt, 1);
		}
		else
		{
			writelineEx(gBAP_Trace, 0, "Eingegebene Laenge: %d von P_FSG_41_0_0_31_4 ist ungueltig. Die max. erlaubte Laenge ist %d.", len4, 99);
			return;
		}
	}
	currentPos += cnt4+1;
	for(i = 0; i < len4; i++)
	{
		superval[currentPos++]= param4[i];
	}

// gen_BuildFunc_SetSuperVals 
	getValue(P_FSG_41_0_0_31_5_Hex, param5);
	len5 = getValue(P_FSG_41_0_0_31_5_len);
	cnt5= getValue(P_FSG_41_0_0_31_5_cnt);
	
	/* check box aktiviert*/
	if (cnt5 == 1)
	{
		/* 0 bis 40 (MaxString - 1B oder 2B) */
		if(len5 >= 0 && len5 <= 40)
		{
			//writelineEx(gBAP_Trace, 0, "[Debug-1] Len5: %d", len5);
			superval[currentPos] = (len5&0x7f00) | 0x80;
			superval[currentPos+1] = len5 & 0x00ff;
		}
		else
		{
			writelineEx(gBAP_Trace, 0, "Eingegebene Laenge: %d von P_FSG_41_0_0_31_5 ist ungueltig. Die max. erlaubte Laenge ist %d.", len5, 40);
			return;
		}
	}
	else if(cnt5 == 0) /*check box deaktiviert*/
	{
		if(len5 >= 0 && len5 <= 127)
		{
			//writelineEx(gBAP_Trace, 0, "[Debug-1] Len5: %d", len5);
			superval[currentPos]= len5 & 0x00ff;
			putValue(P_FSG_41_0_0_31_5_len, len5);
		}
		else if(len5 > 127 && len5 <= 40)
		{
			superval[currentPos] = (len5&0x7f00) | 0x80;
			superval[currentPos+1] = len5 & 0x00ff;
			putValue(P_FSG_41_0_0_31_5_len, len5);
			putValue(P_FSG_41_0_0_31_5_cnt, 1);
		}
		else
		{
			writelineEx(gBAP_Trace, 0, "Eingegebene Laenge: %d von P_FSG_41_0_0_31_5 ist ungueltig. Die max. erlaubte Laenge ist %d.", len5, 40);
			return;
		}
	}
	currentPos += cnt5+1;
	for(i = 0; i < len5; i++)
	{
		superval[currentPos++]= param5[i];
	}

// gen_BuildFunc_SetSuperVals 
	param6 = getValue(P_FSG_41_0_0_31_6);
	superval[currentPos++]=param6;
// gen_BuildFunc_SetSuperVals 
	getValue(P_FSG_41_0_0_31_7_Hex, param7);
	len7 = getValue(P_FSG_41_0_0_31_7_len);
	cnt7= getValue(P_FSG_41_0_0_31_7_cnt);
	
	/* check box aktiviert*/
	if (cnt7 == 1)
	{
		/* 0 bis 99 (MaxString - 1B oder 2B) */
		if(len7 >= 0 && len7 <= 99)
		{
			//writelineEx(gBAP_Trace, 0, "[Debug-1] Len7: %d", len7);
			superval[currentPos] = (len7&0x7f00) | 0x80;
			superval[currentPos+1] = len7 & 0x00ff;
		}
		else
		{
			writelineEx(gBAP_Trace, 0, "Eingegebene Laenge: %d von P_FSG_41_0_0_31_7 ist ungueltig. Die max. erlaubte Laenge ist %d.", len7, 99);
			return;
		}
	}
	else if(cnt7 == 0) /*check box deaktiviert*/
	{
		if(len7 >= 0 && len7 <= 127)
		{
			//writelineEx(gBAP_Trace, 0, "[Debug-1] Len7: %d", len7);
			superval[currentPos]= len7 & 0x00ff;
			putValue(P_FSG_41_0_0_31_7_len, len7);
		}
		else if(len7 > 127 && len7 <= 99)
		{
			superval[currentPos] = (len7&0x7f00) | 0x80;
			superval[currentPos+1] = len7 & 0x00ff;
			putValue(P_FSG_41_0_0_31_7_len, len7);
			putValue(P_FSG_41_0_0_31_7_cnt, 1);
		}
		else
		{
			writelineEx(gBAP_Trace, 0, "Eingegebene Laenge: %d von P_FSG_41_0_0_31_7 ist ungueltig. Die max. erlaubte Laenge ist %d.", len7, 99);
			return;
		}
	}
	currentPos += cnt7+1;
	for(i = 0; i < len7; i++)
	{
		superval[currentPos++]= param7[i];
	}

// gen_BuildFunc_SetSuperVals 
	getValue(P_FSG_41_0_0_31_8_Hex, param8);
	len8 = getValue(P_FSG_41_0_0_31_8_len);
	cnt8= getValue(P_FSG_41_0_0_31_8_cnt);
	
	/* check box aktiviert*/
	if (cnt8 == 1)
	{
		/* 0 bis 40 (MaxString - 1B oder 2B) */
		if(len8 >= 0 && len8 <= 40)
		{
			//writelineEx(gBAP_Trace, 0, "[Debug-1] Len8: %d", len8);
			superval[currentPos] = (len8&0x7f00) | 0x80;
			superval[currentPos+1] = len8 & 0x00ff;
		}
		else
		{
			writelineEx(gBAP_Trace, 0, "Eingegebene Laenge: %d von P_FSG_41_0_0_31_8 ist ungueltig. Die max. erlaubte Laenge ist %d.", len8, 40);
			return;
		}
	}
	else if(cnt8 == 0) /*check box deaktiviert*/
	{
		if(len8 >= 0 && len8 <= 127)
		{
			//writelineEx(gBAP_Trace, 0, "[Debug-1] Len8: %d", len8);
			superval[currentPos]= len8 & 0x00ff;
			putValue(P_FSG_41_0_0_31_8_len, len8);
		}
		else if(len8 > 127 && len8 <= 40)
		{
			superval[currentPos] = (len8&0x7f00) | 0x80;
			superval[currentPos+1] = len8 & 0x00ff;
			putValue(P_FSG_41_0_0_31_8_len, len8);
			putValue(P_FSG_41_0_0_31_8_cnt, 1);
		}
		else
		{
			writelineEx(gBAP_Trace, 0, "Eingegebene Laenge: %d von P_FSG_41_0_0_31_8 ist ungueltig. Die max. erlaubte Laenge ist %d.", len8, 40);
			return;
		}
	}
	currentPos += cnt8+1;
	for(i = 0; i < len8; i++)
	{
		superval[currentPos++]= param8[i];
	}

// gen_BuildFunc_SetSuperVals 
	param9 = getValue(P_FSG_41_0_0_31_9);
	superval[currentPos++]=param9;
// gen_BuildFunc_SetSuperVals 
	getValue(P_FSG_41_0_0_31_10_Hex, param10);
	len10 = getValue(P_FSG_41_0_0_31_10_len);
	cnt10= getValue(P_FSG_41_0_0_31_10_cnt);
	
	/* check box aktiviert*/
	if (cnt10 == 1)
	{
		/* 0 bis 99 (MaxString - 1B oder 2B) */
		if(len10 >= 0 && len10 <= 99)
		{
			//writelineEx(gBAP_Trace, 0, "[Debug-1] Len10: %d", len10);
			superval[currentPos] = (len10&0x7f00) | 0x80;
			superval[currentPos+1] = len10 & 0x00ff;
		}
		else
		{
			writelineEx(gBAP_Trace, 0, "Eingegebene Laenge: %d von P_FSG_41_0_0_31_10 ist ungueltig. Die max. erlaubte Laenge ist %d.", len10, 99);
			return;
		}
	}
	else if(cnt10 == 0) /*check box deaktiviert*/
	{
		if(len10 >= 0 && len10 <= 127)
		{
			//writelineEx(gBAP_Trace, 0, "[Debug-1] Len10: %d", len10);
			superval[currentPos]= len10 & 0x00ff;
			putValue(P_FSG_41_0_0_31_10_len, len10);
		}
		else if(len10 > 127 && len10 <= 99)
		{
			superval[currentPos] = (len10&0x7f00) | 0x80;
			superval[currentPos+1] = len10 & 0x00ff;
			putValue(P_FSG_41_0_0_31_10_len, len10);
			putValue(P_FSG_41_0_0_31_10_cnt, 1);
		}
		else
		{
			writelineEx(gBAP_Trace, 0, "Eingegebene Laenge: %d von P_FSG_41_0_0_31_10 ist ungueltig. Die max. erlaubte Laenge ist %d.", len10, 99);
			return;
		}
	}
	currentPos += cnt10+1;
	for(i = 0; i < len10; i++)
	{
		superval[currentPos++]= param10[i];
	}

// gen_BuildFunc_SetSuperVals 
	getValue(P_FSG_41_0_0_31_11_Hex, param11);
	len11 = getValue(P_FSG_41_0_0_31_11_len);
	cnt11= getValue(P_FSG_41_0_0_31_11_cnt);
	
	/* check box aktiviert*/
	if (cnt11 == 1)
	{
		/* 0 bis 40 (MaxString - 1B oder 2B) */
		if(len11 >= 0 && len11 <= 40)
		{
			//writelineEx(gBAP_Trace, 0, "[Debug-1] Len11: %d", len11);
			superval[currentPos] = (len11&0x7f00) | 0x80;
			superval[currentPos+1] = len11 & 0x00ff;
		}
		else
		{
			writelineEx(gBAP_Trace, 0, "Eingegebene Laenge: %d von P_FSG_41_0_0_31_11 ist ungueltig. Die max. erlaubte Laenge ist %d.", len11, 40);
			return;
		}
	}
	else if(cnt11 == 0) /*check box deaktiviert*/
	{
		if(len11 >= 0 && len11 <= 127)
		{
			//writelineEx(gBAP_Trace, 0, "[Debug-1] Len11: %d", len11);
			superval[currentPos]= len11 & 0x00ff;
			putValue(P_FSG_41_0_0_31_11_len, len11);
		}
		else if(len11 > 127 && len11 <= 40)
		{
			superval[currentPos] = (len11&0x7f00) | 0x80;
			superval[currentPos+1] = len11 & 0x00ff;
			putValue(P_FSG_41_0_0_31_11_len, len11);
			putValue(P_FSG_41_0_0_31_11_cnt, 1);
		}
		else
		{
			writelineEx(gBAP_Trace, 0, "Eingegebene Laenge: %d von P_FSG_41_0_0_31_11 ist ungueltig. Die max. erlaubte Laenge ist %d.", len11, 40);
			return;
		}
	}
	currentPos += cnt11+1;
	for(i = 0; i < len11; i++)
	{
		superval[currentPos++]= param11[i];
	}

// gen_BuildFunc_SetSuperVals 
	param12 = getValue(P_FSG_41_0_0_31_12);
	superval[currentPos++]=param12;
// gen_BuildFunc_SetSuperVals 
	getValue(P_FSG_41_0_0_31_13_Hex, param13);
	len13 = getValue(P_FSG_41_0_0_31_13_len);
	cnt13= getValue(P_FSG_41_0_0_31_13_cnt);
	
	/* check box aktiviert*/
	if (cnt13 == 1)
	{
		/* 0 bis 99 (MaxString - 1B oder 2B) */
		if(len13 >= 0 && len13 <= 99)
		{
			//writelineEx(gBAP_Trace, 0, "[Debug-1] Len13: %d", len13);
			superval[currentPos] = (len13&0x7f00) | 0x80;
			superval[currentPos+1] = len13 & 0x00ff;
		}
		else
		{
			writelineEx(gBAP_Trace, 0, "Eingegebene Laenge: %d von P_FSG_41_0_0_31_13 ist ungueltig. Die max. erlaubte Laenge ist %d.", len13, 99);
			return;
		}
	}
	else if(cnt13 == 0) /*check box deaktiviert*/
	{
		if(len13 >= 0 && len13 <= 127)
		{
			//writelineEx(gBAP_Trace, 0, "[Debug-1] Len13: %d", len13);
			superval[currentPos]= len13 & 0x00ff;
			putValue(P_FSG_41_0_0_31_13_len, len13);
		}
		else if(len13 > 127 && len13 <= 99)
		{
			superval[currentPos] = (len13&0x7f00) | 0x80;
			superval[currentPos+1] = len13 & 0x00ff;
			putValue(P_FSG_41_0_0_31_13_len, len13);
			putValue(P_FSG_41_0_0_31_13_cnt, 1);
		}
		else
		{
			writelineEx(gBAP_Trace, 0, "Eingegebene Laenge: %d von P_FSG_41_0_0_31_13 ist ungueltig. Die max. erlaubte Laenge ist %d.", len13, 99);
			return;
		}
	}
	currentPos += cnt13+1;
	for(i = 0; i < len13; i++)
	{
		superval[currentPos++]= param13[i];
	}

// gen_BuildFunc_SetSuperVals 
	getValue(P_FSG_41_0_0_31_14_Hex, param14);
	len14 = getValue(P_FSG_41_0_0_31_14_len);
	cnt14= getValue(P_FSG_41_0_0_31_14_cnt);
	
	/* check box aktiviert*/
	if (cnt14 == 1)
	{
		/* 0 bis 40 (MaxString - 1B oder 2B) */
		if(len14 >= 0 && len14 <= 40)
		{
			//writelineEx(gBAP_Trace, 0, "[Debug-1] Len14: %d", len14);
			superval[currentPos] = (len14&0x7f00) | 0x80;
			superval[currentPos+1] = len14 & 0x00ff;
		}
		else
		{
			writelineEx(gBAP_Trace, 0, "Eingegebene Laenge: %d von P_FSG_41_0_0_31_14 ist ungueltig. Die max. erlaubte Laenge ist %d.", len14, 40);
			return;
		}
	}
	else if(cnt14 == 0) /*check box deaktiviert*/
	{
		if(len14 >= 0 && len14 <= 127)
		{
			//writelineEx(gBAP_Trace, 0, "[Debug-1] Len14: %d", len14);
			superval[currentPos]= len14 & 0x00ff;
			putValue(P_FSG_41_0_0_31_14_len, len14);
		}
		else if(len14 > 127 && len14 <= 40)
		{
			superval[currentPos] = (len14&0x7f00) | 0x80;
			superval[currentPos+1] = len14 & 0x00ff;
			putValue(P_FSG_41_0_0_31_14_len, len14);
			putValue(P_FSG_41_0_0_31_14_cnt, 1);
		}
		else
		{
			writelineEx(gBAP_Trace, 0, "Eingegebene Laenge: %d von P_FSG_41_0_0_31_14 ist ungueltig. Die max. erlaubte Laenge ist %d.", len14, 40);
			return;
		}
	}
	currentPos += cnt14+1;
	for(i = 0; i < len14; i++)
	{
		superval[currentPos++]= param14[i];
	}

// gen_BuildFunc_SetSuperVals 
	param15 = getValue(P_FSG_41_0_0_31_15);
	superval[currentPos++]=param15;
// gen_BuildFunc_SetSuperVals 
	getValue(P_FSG_41_0_0_31_16_Hex, param16);
	len16 = getValue(P_FSG_41_0_0_31_16_len);
	cnt16= getValue(P_FSG_41_0_0_31_16_cnt);
	
	/* check box aktiviert*/
	if (cnt16 == 1)
	{
		/* 0 bis 99 (MaxString - 1B oder 2B) */
		if(len16 >= 0 && len16 <= 99)
		{
			//writelineEx(gBAP_Trace, 0, "[Debug-1] Len16: %d", len16);
			superval[currentPos] = (len16&0x7f00) | 0x80;
			superval[currentPos+1] = len16 & 0x00ff;
		}
		else
		{
			writelineEx(gBAP_Trace, 0, "Eingegebene Laenge: %d von P_FSG_41_0_0_31_16 ist ungueltig. Die max. erlaubte Laenge ist %d.", len16, 99);
			return;
		}
	}
	else if(cnt16 == 0) /*check box deaktiviert*/
	{
		if(len16 >= 0 && len16 <= 127)
		{
			//writelineEx(gBAP_Trace, 0, "[Debug-1] Len16: %d", len16);
			superval[currentPos]= len16 & 0x00ff;
			putValue(P_FSG_41_0_0_31_16_len, len16);
		}
		else if(len16 > 127 && len16 <= 99)
		{
			superval[currentPos] = (len16&0x7f00) | 0x80;
			superval[currentPos+1] = len16 & 0x00ff;
			putValue(P_FSG_41_0_0_31_16_len, len16);
			putValue(P_FSG_41_0_0_31_16_cnt, 1);
		}
		else
		{
			writelineEx(gBAP_Trace, 0, "Eingegebene Laenge: %d von P_FSG_41_0_0_31_16 ist ungueltig. Die max. erlaubte Laenge ist %d.", len16, 99);
			return;
		}
	}
	currentPos += cnt16+1;
	for(i = 0; i < len16; i++)
	{
		superval[currentPos++]= param16[i];
	}

// gen_BuildFunc_SetSuperVals 
	getValue(P_FSG_41_0_0_31_17_Hex, param17);
	len17 = getValue(P_FSG_41_0_0_31_17_len);
	cnt17= getValue(P_FSG_41_0_0_31_17_cnt);
	
	/* check box aktiviert*/
	if (cnt17 == 1)
	{
		/* 0 bis 40 (MaxString - 1B oder 2B) */
		if(len17 >= 0 && len17 <= 40)
		{
			//writelineEx(gBAP_Trace, 0, "[Debug-1] Len17: %d", len17);
			superval[currentPos] = (len17&0x7f00) | 0x80;
			superval[currentPos+1] = len17 & 0x00ff;
		}
		else
		{
			writelineEx(gBAP_Trace, 0, "Eingegebene Laenge: %d von P_FSG_41_0_0_31_17 ist ungueltig. Die max. erlaubte Laenge ist %d.", len17, 40);
			return;
		}
	}
	else if(cnt17 == 0) /*check box deaktiviert*/
	{
		if(len17 >= 0 && len17 <= 127)
		{
			//writelineEx(gBAP_Trace, 0, "[Debug-1] Len17: %d", len17);
			superval[currentPos]= len17 & 0x00ff;
			putValue(P_FSG_41_0_0_31_17_len, len17);
		}
		else if(len17 > 127 && len17 <= 40)
		{
			superval[currentPos] = (len17&0x7f00) | 0x80;
			superval[currentPos+1] = len17 & 0x00ff;
			putValue(P_FSG_41_0_0_31_17_len, len17);
			putValue(P_FSG_41_0_0_31_17_cnt, 1);
		}
		else
		{
			writelineEx(gBAP_Trace, 0, "Eingegebene Laenge: %d von P_FSG_41_0_0_31_17 ist ungueltig. Die max. erlaubte Laenge ist %d.", len17, 40);
			return;
		}
	}
	currentPos += cnt17+1;
	for(i = 0; i < len17; i++)
	{
		superval[currentPos++]= param17[i];
	}

// gen_BuildFunc_SetSuperVals 
	param18 = getValue(P_FSG_41_0_0_31_18);
	superval[currentPos++]=param18;
// gen_BuildFunc_SetSuperVals 
	getValue(P_FSG_41_0_0_31_19_Hex, param19);
	len19 = getValue(P_FSG_41_0_0_31_19_len);
	cnt19= getValue(P_FSG_41_0_0_31_19_cnt);
	
	/* check box aktiviert*/
	if (cnt19 == 1)
	{
		/* 0 bis 99 (MaxString - 1B oder 2B) */
		if(len19 >= 0 && len19 <= 99)
		{
			//writelineEx(gBAP_Trace, 0, "[Debug-1] Len19: %d", len19);
			superval[currentPos] = (len19&0x7f00) | 0x80;
			superval[currentPos+1] = len19 & 0x00ff;
		}
		else
		{
			writelineEx(gBAP_Trace, 0, "Eingegebene Laenge: %d von P_FSG_41_0_0_31_19 ist ungueltig. Die max. erlaubte Laenge ist %d.", len19, 99);
			return;
		}
	}
	else if(cnt19 == 0) /*check box deaktiviert*/
	{
		if(len19 >= 0 && len19 <= 127)
		{
			//writelineEx(gBAP_Trace, 0, "[Debug-1] Len19: %d", len19);
			superval[currentPos]= len19 & 0x00ff;
			putValue(P_FSG_41_0_0_31_19_len, len19);
		}
		else if(len19 > 127 && len19 <= 99)
		{
			superval[currentPos] = (len19&0x7f00) | 0x80;
			superval[currentPos+1] = len19 & 0x00ff;
			putValue(P_FSG_41_0_0_31_19_len, len19);
			putValue(P_FSG_41_0_0_31_19_cnt, 1);
		}
		else
		{
			writelineEx(gBAP_Trace, 0, "Eingegebene Laenge: %d von P_FSG_41_0_0_31_19 ist ungueltig. Die max. erlaubte Laenge ist %d.", len19, 99);
			return;
		}
	}
	currentPos += cnt19+1;
	for(i = 0; i < len19; i++)
	{
		superval[currentPos++]= param19[i];
	}

// gen_BuildFunc_SetSuperVals 
	getValue(P_FSG_41_0_0_31_20_Hex, param20);
	len20 = getValue(P_FSG_41_0_0_31_20_len);
	cnt20= getValue(P_FSG_41_0_0_31_20_cnt);
	
	/* check box aktiviert*/
	if (cnt20 == 1)
	{
		/* 0 bis 40 (MaxString - 1B oder 2B) */
		if(len20 >= 0 && len20 <= 40)
		{
			//writelineEx(gBAP_Trace, 0, "[Debug-1] Len20: %d", len20);
			superval[currentPos] = (len20&0x7f00) | 0x80;
			superval[currentPos+1] = len20 & 0x00ff;
		}
		else
		{
			writelineEx(gBAP_Trace, 0, "Eingegebene Laenge: %d von P_FSG_41_0_0_31_20 ist ungueltig. Die max. erlaubte Laenge ist %d.", len20, 40);
			return;
		}
	}
	else if(cnt20 == 0) /*check box deaktiviert*/
	{
		if(len20 >= 0 && len20 <= 127)
		{
			//writelineEx(gBAP_Trace, 0, "[Debug-1] Len20: %d", len20);
			superval[currentPos]= len20 & 0x00ff;
			putValue(P_FSG_41_0_0_31_20_len, len20);
		}
		else if(len20 > 127 && len20 <= 40)
		{
			superval[currentPos] = (len20&0x7f00) | 0x80;
			superval[currentPos+1] = len20 & 0x00ff;
			putValue(P_FSG_41_0_0_31_20_len, len20);
			putValue(P_FSG_41_0_0_31_20_cnt, 1);
		}
		else
		{
			writelineEx(gBAP_Trace, 0, "Eingegebene Laenge: %d von P_FSG_41_0_0_31_20 ist ungueltig. Die max. erlaubte Laenge ist %d.", len20, 40);
			return;
		}
	}
	currentPos += cnt20+1;
	for(i = 0; i < len20; i++)
	{
		superval[currentPos++]= param20[i];
	}

// gen_BuildFunc_SetSuperVals 
	param21 = getValue(P_FSG_41_0_0_31_21);
	superval[currentPos++]=param21;
	putValue(P_FSG_41_0_0_31, superval, currentPos);
}



// Ueberwachung der CheckBox fuer String
on envVar  P_FSG_41_0_0_31_1_cnt
{
	word len;
	byte cnt;
	len = getValue(P_FSG_41_0_0_31_1_len);
	cnt = getValue(P_FSG_41_0_0_31_1_cnt);

	/* wird nur gerufen, wenn check box deaktiviert mit Length>127*/ 
	if( cnt == 0) 
	{
		if(len > 127 )
		{
			putValue(P_FSG_41_0_0_31_1_len, 127);
		}
	}

	P_FSG_41_0_0_31_BuildFct();
}



// Ueberwachung der Eingabefeld fuer String Data
on envVar P_FSG_41_0_0_31_1_len
{
	word len;
	len = getValue(this);
	/* Validierung der Eingabe*/
	if(len > 99)
	{
		writelineEx(gBAP_Trace, 0, "Eingegebene Laenge: %d von P_FSG_41_0_0_31_1 ist ungueltig. Die max. erlaubte Laenge ist %d. ", len, 99);
		putValue(this, 99);
	}
	P_FSG_41_0_0_31_BuildFct();
}


on envVar P_FSG_41_0_0_31_1 // CallInfo2.PbName0
{
	int j, offset;
  int temp;
  int string_length_org;
  int string_length_mod;
  byte string_buffer_org[255];
  byte string_buffer_mod[255];
  
  //Start-Länge
  string_length_org = getValueSize(this);
  string_length_mod = string_length_org;
  
  //Start-String in Buffer
  getvalue(this,string_buffer_org);
  
  //Buffer auf Sonderzeichen checken und ersetzen
  offset = 0;
  for (j=0;j<string_length_org;j++)
  {
    if ( string_buffer_org[j] >= 0x80 && string_buffer_org[j] <= 0xBF ) 
    {
      temp = string_buffer_org[j] + 0xC200;
      
      string_buffer_mod[j+offset] = temp>>8;
      string_buffer_mod[j+offset+1] = temp;
      offset++;
      string_length_mod++;
    }
    else if ( string_buffer_org[j] >= 0xC0 && string_buffer_org[j] <= 0xFF ) 
    {
      temp = string_buffer_org[j] + 0xC2C0;
      
      string_buffer_mod[j+offset] = temp>>8;
      string_buffer_mod[j+offset+1] = temp;
      offset++;
      string_length_mod++;
    }
    else
      string_buffer_mod[j+offset] = string_buffer_org[j];
  }
    
  //neuen String schreiben
  putvalue(P_FSG_41_0_0_31_1_Hex,string_buffer_mod,string_length_mod);
  putValue(P_FSG_41_0_0_31_1_len, string_length_mod);
}


// Ueberwachung der CheckBox fuer String
on envVar  P_FSG_41_0_0_31_2_cnt
{
	word len;
	byte cnt;
	len = getValue(P_FSG_41_0_0_31_2_len);
	cnt = getValue(P_FSG_41_0_0_31_2_cnt);

	/* wird nur gerufen, wenn check box deaktiviert mit Length>127*/ 
	if( cnt == 0) 
	{
		if(len > 127 )
		{
			putValue(P_FSG_41_0_0_31_2_len, 127);
		}
	}

	P_FSG_41_0_0_31_BuildFct();
}



// Ueberwachung der Eingabefeld fuer String Data
on envVar P_FSG_41_0_0_31_2_len
{
	word len;
	len = getValue(this);
	/* Validierung der Eingabe*/
	if(len > 40)
	{
		writelineEx(gBAP_Trace, 0, "Eingegebene Laenge: %d von P_FSG_41_0_0_31_2 ist ungueltig. Die max. erlaubte Laenge ist %d. ", len, 40);
		putValue(this, 40);
	}
	P_FSG_41_0_0_31_BuildFct();
}


on envVar P_FSG_41_0_0_31_2 // CallInfo2.TelNumber0
{
	int j, offset;
  int temp;
  int string_length_org;
  int string_length_mod;
  byte string_buffer_org[255];
  byte string_buffer_mod[255];
  
  //Start-Länge
  string_length_org = getValueSize(this);
  string_length_mod = string_length_org;
  
  //Start-String in Buffer
  getvalue(this,string_buffer_org);
  
  //Buffer auf Sonderzeichen checken und ersetzen
  offset = 0;
  for (j=0;j<string_length_org;j++)
  {
    if ( string_buffer_org[j] >= 0x80 && string_buffer_org[j] <= 0xBF ) 
    {
      temp = string_buffer_org[j] + 0xC200;
      
      string_buffer_mod[j+offset] = temp>>8;
      string_buffer_mod[j+offset+1] = temp;
      offset++;
      string_length_mod++;
    }
    else if ( string_buffer_org[j] >= 0xC0 && string_buffer_org[j] <= 0xFF ) 
    {
      temp = string_buffer_org[j] + 0xC2C0;
      
      string_buffer_mod[j+offset] = temp>>8;
      string_buffer_mod[j+offset+1] = temp;
      offset++;
      string_length_mod++;
    }
    else
      string_buffer_mod[j+offset] = string_buffer_org[j];
  }
    
  //neuen String schreiben
  putvalue(P_FSG_41_0_0_31_2_Hex,string_buffer_mod,string_length_mod);
  putValue(P_FSG_41_0_0_31_2_len, string_length_mod);
}

on envVar P_FSG_41_0_0_31_3 // CallInfo2.Category0
{
	P_FSG_41_0_0_31_BuildFct();
}


// Ueberwachung der CheckBox fuer String
on envVar  P_FSG_41_0_0_31_4_cnt
{
	word len;
	byte cnt;
	len = getValue(P_FSG_41_0_0_31_4_len);
	cnt = getValue(P_FSG_41_0_0_31_4_cnt);

	/* wird nur gerufen, wenn check box deaktiviert mit Length>127*/ 
	if( cnt == 0) 
	{
		if(len > 127 )
		{
			putValue(P_FSG_41_0_0_31_4_len, 127);
		}
	}

	P_FSG_41_0_0_31_BuildFct();
}



// Ueberwachung der Eingabefeld fuer String Data
on envVar P_FSG_41_0_0_31_4_len
{
	word len;
	len = getValue(this);
	/* Validierung der Eingabe*/
	if(len > 99)
	{
		writelineEx(gBAP_Trace, 0, "Eingegebene Laenge: %d von P_FSG_41_0_0_31_4 ist ungueltig. Die max. erlaubte Laenge ist %d. ", len, 99);
		putValue(this, 99);
	}
	P_FSG_41_0_0_31_BuildFct();
}


on envVar P_FSG_41_0_0_31_4 // CallInfo2.PbName1
{
	int j, offset;
  int temp;
  int string_length_org;
  int string_length_mod;
  byte string_buffer_org[255];
  byte string_buffer_mod[255];
  
  //Start-Länge
  string_length_org = getValueSize(this);
  string_length_mod = string_length_org;
  
  //Start-String in Buffer
  getvalue(this,string_buffer_org);
  
  //Buffer auf Sonderzeichen checken und ersetzen
  offset = 0;
  for (j=0;j<string_length_org;j++)
  {
    if ( string_buffer_org[j] >= 0x80 && string_buffer_org[j] <= 0xBF ) 
    {
      temp = string_buffer_org[j] + 0xC200;
      
      string_buffer_mod[j+offset] = temp>>8;
      string_buffer_mod[j+offset+1] = temp;
      offset++;
      string_length_mod++;
    }
    else if ( string_buffer_org[j] >= 0xC0 && string_buffer_org[j] <= 0xFF ) 
    {
      temp = string_buffer_org[j] + 0xC2C0;
      
      string_buffer_mod[j+offset] = temp>>8;
      string_buffer_mod[j+offset+1] = temp;
      offset++;
      string_length_mod++;
    }
    else
      string_buffer_mod[j+offset] = string_buffer_org[j];
  }
    
  //neuen String schreiben
  putvalue(P_FSG_41_0_0_31_4_Hex,string_buffer_mod,string_length_mod);
  putValue(P_FSG_41_0_0_31_4_len, string_length_mod);
}


// Ueberwachung der CheckBox fuer String
on envVar  P_FSG_41_0_0_31_5_cnt
{
	word len;
	byte cnt;
	len = getValue(P_FSG_41_0_0_31_5_len);
	cnt = getValue(P_FSG_41_0_0_31_5_cnt);

	/* wird nur gerufen, wenn check box deaktiviert mit Length>127*/ 
	if( cnt == 0) 
	{
		if(len > 127 )
		{
			putValue(P_FSG_41_0_0_31_5_len, 127);
		}
	}

	P_FSG_41_0_0_31_BuildFct();
}



// Ueberwachung der Eingabefeld fuer String Data
on envVar P_FSG_41_0_0_31_5_len
{
	word len;
	len = getValue(this);
	/* Validierung der Eingabe*/
	if(len > 40)
	{
		writelineEx(gBAP_Trace, 0, "Eingegebene Laenge: %d von P_FSG_41_0_0_31_5 ist ungueltig. Die max. erlaubte Laenge ist %d. ", len, 40);
		putValue(this, 40);
	}
	P_FSG_41_0_0_31_BuildFct();
}


on envVar P_FSG_41_0_0_31_5 // CallInfo2.TelNumber1
{
	int j, offset;
  int temp;
  int string_length_org;
  int string_length_mod;
  byte string_buffer_org[255];
  byte string_buffer_mod[255];
  
  //Start-Länge
  string_length_org = getValueSize(this);
  string_length_mod = string_length_org;
  
  //Start-String in Buffer
  getvalue(this,string_buffer_org);
  
  //Buffer auf Sonderzeichen checken und ersetzen
  offset = 0;
  for (j=0;j<string_length_org;j++)
  {
    if ( string_buffer_org[j] >= 0x80 && string_buffer_org[j] <= 0xBF ) 
    {
      temp = string_buffer_org[j] + 0xC200;
      
      string_buffer_mod[j+offset] = temp>>8;
      string_buffer_mod[j+offset+1] = temp;
      offset++;
      string_length_mod++;
    }
    else if ( string_buffer_org[j] >= 0xC0 && string_buffer_org[j] <= 0xFF ) 
    {
      temp = string_buffer_org[j] + 0xC2C0;
      
      string_buffer_mod[j+offset] = temp>>8;
      string_buffer_mod[j+offset+1] = temp;
      offset++;
      string_length_mod++;
    }
    else
      string_buffer_mod[j+offset] = string_buffer_org[j];
  }
    
  //neuen String schreiben
  putvalue(P_FSG_41_0_0_31_5_Hex,string_buffer_mod,string_length_mod);
  putValue(P_FSG_41_0_0_31_5_len, string_length_mod);
}

on envVar P_FSG_41_0_0_31_6 // CallInfo2.Category1
{
	P_FSG_41_0_0_31_BuildFct();
}


// Ueberwachung der CheckBox fuer String
on envVar  P_FSG_41_0_0_31_7_cnt
{
	word len;
	byte cnt;
	len = getValue(P_FSG_41_0_0_31_7_len);
	cnt = getValue(P_FSG_41_0_0_31_7_cnt);

	/* wird nur gerufen, wenn check box deaktiviert mit Length>127*/ 
	if( cnt == 0) 
	{
		if(len > 127 )
		{
			putValue(P_FSG_41_0_0_31_7_len, 127);
		}
	}

	P_FSG_41_0_0_31_BuildFct();
}



// Ueberwachung der Eingabefeld fuer String Data
on envVar P_FSG_41_0_0_31_7_len
{
	word len;
	len = getValue(this);
	/* Validierung der Eingabe*/
	if(len > 99)
	{
		writelineEx(gBAP_Trace, 0, "Eingegebene Laenge: %d von P_FSG_41_0_0_31_7 ist ungueltig. Die max. erlaubte Laenge ist %d. ", len, 99);
		putValue(this, 99);
	}
	P_FSG_41_0_0_31_BuildFct();
}


on envVar P_FSG_41_0_0_31_7 // CallInfo2.PbName2
{
	int j, offset;
  int temp;
  int string_length_org;
  int string_length_mod;
  byte string_buffer_org[255];
  byte string_buffer_mod[255];
  
  //Start-Länge
  string_length_org = getValueSize(this);
  string_length_mod = string_length_org;
  
  //Start-String in Buffer
  getvalue(this,string_buffer_org);
  
  //Buffer auf Sonderzeichen checken und ersetzen
  offset = 0;
  for (j=0;j<string_length_org;j++)
  {
    if ( string_buffer_org[j] >= 0x80 && string_buffer_org[j] <= 0xBF ) 
    {
      temp = string_buffer_org[j] + 0xC200;
      
      string_buffer_mod[j+offset] = temp>>8;
      string_buffer_mod[j+offset+1] = temp;
      offset++;
      string_length_mod++;
    }
    else if ( string_buffer_org[j] >= 0xC0 && string_buffer_org[j] <= 0xFF ) 
    {
      temp = string_buffer_org[j] + 0xC2C0;
      
      string_buffer_mod[j+offset] = temp>>8;
      string_buffer_mod[j+offset+1] = temp;
      offset++;
      string_length_mod++;
    }
    else
      string_buffer_mod[j+offset] = string_buffer_org[j];
  }
    
  //neuen String schreiben
  putvalue(P_FSG_41_0_0_31_7_Hex,string_buffer_mod,string_length_mod);
  putValue(P_FSG_41_0_0_31_7_len, string_length_mod);
}


// Ueberwachung der CheckBox fuer String
on envVar  P_FSG_41_0_0_31_8_cnt
{
	word len;
	byte cnt;
	len = getValue(P_FSG_41_0_0_31_8_len);
	cnt = getValue(P_FSG_41_0_0_31_8_cnt);

	/* wird nur gerufen, wenn check box deaktiviert mit Length>127*/ 
	if( cnt == 0) 
	{
		if(len > 127 )
		{
			putValue(P_FSG_41_0_0_31_8_len, 127);
		}
	}

	P_FSG_41_0_0_31_BuildFct();
}



// Ueberwachung der Eingabefeld fuer String Data
on envVar P_FSG_41_0_0_31_8_len
{
	word len;
	len = getValue(this);
	/* Validierung der Eingabe*/
	if(len > 40)
	{
		writelineEx(gBAP_Trace, 0, "Eingegebene Laenge: %d von P_FSG_41_0_0_31_8 ist ungueltig. Die max. erlaubte Laenge ist %d. ", len, 40);
		putValue(this, 40);
	}
	P_FSG_41_0_0_31_BuildFct();
}


on envVar P_FSG_41_0_0_31_8 // CallInfo2.TelNumber2
{
	int j, offset;
  int temp;
  int string_length_org;
  int string_length_mod;
  byte string_buffer_org[255];
  byte string_buffer_mod[255];
  
  //Start-Länge
  string_length_org = getValueSize(this);
  string_length_mod = string_length_org;
  
  //Start-String in Buffer
  getvalue(this,string_buffer_org);
  
  //Buffer auf Sonderzeichen checken und ersetzen
  offset = 0;
  for (j=0;j<string_length_org;j++)
  {
    if ( string_buffer_org[j] >= 0x80 && string_buffer_org[j] <= 0xBF ) 
    {
      temp = string_buffer_org[j] + 0xC200;
      
      string_buffer_mod[j+offset] = temp>>8;
      string_buffer_mod[j+offset+1] = temp;
      offset++;
      string_length_mod++;
    }
    else if ( string_buffer_org[j] >= 0xC0 && string_buffer_org[j] <= 0xFF ) 
    {
      temp = string_buffer_org[j] + 0xC2C0;
      
      string_buffer_mod[j+offset] = temp>>8;
      string_buffer_mod[j+offset+1] = temp;
      offset++;
      string_length_mod++;
    }
    else
      string_buffer_mod[j+offset] = string_buffer_org[j];
  }
    
  //neuen String schreiben
  putvalue(P_FSG_41_0_0_31_8_Hex,string_buffer_mod,string_length_mod);
  putValue(P_FSG_41_0_0_31_8_len, string_length_mod);
}

on envVar P_FSG_41_0_0_31_9 // CallInfo2.Category2
{
	P_FSG_41_0_0_31_BuildFct();
}


// Ueberwachung der CheckBox fuer String
on envVar  P_FSG_41_0_0_31_10_cnt
{
	word len;
	byte cnt;
	len = getValue(P_FSG_41_0_0_31_10_len);
	cnt = getValue(P_FSG_41_0_0_31_10_cnt);

	/* wird nur gerufen, wenn check box deaktiviert mit Length>127*/ 
	if( cnt == 0) 
	{
		if(len > 127 )
		{
			putValue(P_FSG_41_0_0_31_10_len, 127);
		}
	}

	P_FSG_41_0_0_31_BuildFct();
}



// Ueberwachung der Eingabefeld fuer String Data
on envVar P_FSG_41_0_0_31_10_len
{
	word len;
	len = getValue(this);
	/* Validierung der Eingabe*/
	if(len > 99)
	{
		writelineEx(gBAP_Trace, 0, "Eingegebene Laenge: %d von P_FSG_41_0_0_31_10 ist ungueltig. Die max. erlaubte Laenge ist %d. ", len, 99);
		putValue(this, 99);
	}
	P_FSG_41_0_0_31_BuildFct();
}


on envVar P_FSG_41_0_0_31_10 // CallInfo2.PbName3
{
	int j, offset;
  int temp;
  int string_length_org;
  int string_length_mod;
  byte string_buffer_org[255];
  byte string_buffer_mod[255];
  
  //Start-Länge
  string_length_org = getValueSize(this);
  string_length_mod = string_length_org;
  
  //Start-String in Buffer
  getvalue(this,string_buffer_org);
  
  //Buffer auf Sonderzeichen checken und ersetzen
  offset = 0;
  for (j=0;j<string_length_org;j++)
  {
    if ( string_buffer_org[j] >= 0x80 && string_buffer_org[j] <= 0xBF ) 
    {
      temp = string_buffer_org[j] + 0xC200;
      
      string_buffer_mod[j+offset] = temp>>8;
      string_buffer_mod[j+offset+1] = temp;
      offset++;
      string_length_mod++;
    }
    else if ( string_buffer_org[j] >= 0xC0 && string_buffer_org[j] <= 0xFF ) 
    {
      temp = string_buffer_org[j] + 0xC2C0;
      
      string_buffer_mod[j+offset] = temp>>8;
      string_buffer_mod[j+offset+1] = temp;
      offset++;
      string_length_mod++;
    }
    else
      string_buffer_mod[j+offset] = string_buffer_org[j];
  }
    
  //neuen String schreiben
  putvalue(P_FSG_41_0_0_31_10_Hex,string_buffer_mod,string_length_mod);
  putValue(P_FSG_41_0_0_31_10_len, string_length_mod);
}


// Ueberwachung der CheckBox fuer String
on envVar  P_FSG_41_0_0_31_11_cnt
{
	word len;
	byte cnt;
	len = getValue(P_FSG_41_0_0_31_11_len);
	cnt = getValue(P_FSG_41_0_0_31_11_cnt);

	/* wird nur gerufen, wenn check box deaktiviert mit Length>127*/ 
	if( cnt == 0) 
	{
		if(len > 127 )
		{
			putValue(P_FSG_41_0_0_31_11_len, 127);
		}
	}

	P_FSG_41_0_0_31_BuildFct();
}



// Ueberwachung der Eingabefeld fuer String Data
on envVar P_FSG_41_0_0_31_11_len
{
	word len;
	len = getValue(this);
	/* Validierung der Eingabe*/
	if(len > 40)
	{
		writelineEx(gBAP_Trace, 0, "Eingegebene Laenge: %d von P_FSG_41_0_0_31_11 ist ungueltig. Die max. erlaubte Laenge ist %d. ", len, 40);
		putValue(this, 40);
	}
	P_FSG_41_0_0_31_BuildFct();
}


on envVar P_FSG_41_0_0_31_11 // CallInfo2.TelNumber3
{
	int j, offset;
  int temp;
  int string_length_org;
  int string_length_mod;
  byte string_buffer_org[255];
  byte string_buffer_mod[255];
  
  //Start-Länge
  string_length_org = getValueSize(this);
  string_length_mod = string_length_org;
  
  //Start-String in Buffer
  getvalue(this,string_buffer_org);
  
  //Buffer auf Sonderzeichen checken und ersetzen
  offset = 0;
  for (j=0;j<string_length_org;j++)
  {
    if ( string_buffer_org[j] >= 0x80 && string_buffer_org[j] <= 0xBF ) 
    {
      temp = string_buffer_org[j] + 0xC200;
      
      string_buffer_mod[j+offset] = temp>>8;
      string_buffer_mod[j+offset+1] = temp;
      offset++;
      string_length_mod++;
    }
    else if ( string_buffer_org[j] >= 0xC0 && string_buffer_org[j] <= 0xFF ) 
    {
      temp = string_buffer_org[j] + 0xC2C0;
      
      string_buffer_mod[j+offset] = temp>>8;
      string_buffer_mod[j+offset+1] = temp;
      offset++;
      string_length_mod++;
    }
    else
      string_buffer_mod[j+offset] = string_buffer_org[j];
  }
    
  //neuen String schreiben
  putvalue(P_FSG_41_0_0_31_11_Hex,string_buffer_mod,string_length_mod);
  putValue(P_FSG_41_0_0_31_11_len, string_length_mod);
}

on envVar P_FSG_41_0_0_31_12 // CallInfo2.Category3
{
	P_FSG_41_0_0_31_BuildFct();
}


// Ueberwachung der CheckBox fuer String
on envVar  P_FSG_41_0_0_31_13_cnt
{
	word len;
	byte cnt;
	len = getValue(P_FSG_41_0_0_31_13_len);
	cnt = getValue(P_FSG_41_0_0_31_13_cnt);

	/* wird nur gerufen, wenn check box deaktiviert mit Length>127*/ 
	if( cnt == 0) 
	{
		if(len > 127 )
		{
			putValue(P_FSG_41_0_0_31_13_len, 127);
		}
	}

	P_FSG_41_0_0_31_BuildFct();
}



// Ueberwachung der Eingabefeld fuer String Data
on envVar P_FSG_41_0_0_31_13_len
{
	word len;
	len = getValue(this);
	/* Validierung der Eingabe*/
	if(len > 99)
	{
		writelineEx(gBAP_Trace, 0, "Eingegebene Laenge: %d von P_FSG_41_0_0_31_13 ist ungueltig. Die max. erlaubte Laenge ist %d. ", len, 99);
		putValue(this, 99);
	}
	P_FSG_41_0_0_31_BuildFct();
}


on envVar P_FSG_41_0_0_31_13 // CallInfo2.PbName4
{
	int j, offset;
  int temp;
  int string_length_org;
  int string_length_mod;
  byte string_buffer_org[255];
  byte string_buffer_mod[255];
  
  //Start-Länge
  string_length_org = getValueSize(this);
  string_length_mod = string_length_org;
  
  //Start-String in Buffer
  getvalue(this,string_buffer_org);
  
  //Buffer auf Sonderzeichen checken und ersetzen
  offset = 0;
  for (j=0;j<string_length_org;j++)
  {
    if ( string_buffer_org[j] >= 0x80 && string_buffer_org[j] <= 0xBF ) 
    {
      temp = string_buffer_org[j] + 0xC200;
      
      string_buffer_mod[j+offset] = temp>>8;
      string_buffer_mod[j+offset+1] = temp;
      offset++;
      string_length_mod++;
    }
    else if ( string_buffer_org[j] >= 0xC0 && string_buffer_org[j] <= 0xFF ) 
    {
      temp = string_buffer_org[j] + 0xC2C0;
      
      string_buffer_mod[j+offset] = temp>>8;
      string_buffer_mod[j+offset+1] = temp;
      offset++;
      string_length_mod++;
    }
    else
      string_buffer_mod[j+offset] = string_buffer_org[j];
  }
    
  //neuen String schreiben
  putvalue(P_FSG_41_0_0_31_13_Hex,string_buffer_mod,string_length_mod);
  putValue(P_FSG_41_0_0_31_13_len, string_length_mod);
}


// Ueberwachung der CheckBox fuer String
on envVar  P_FSG_41_0_0_31_14_cnt
{
	word len;
	byte cnt;
	len = getValue(P_FSG_41_0_0_31_14_len);
	cnt = getValue(P_FSG_41_0_0_31_14_cnt);

	/* wird nur gerufen, wenn check box deaktiviert mit Length>127*/ 
	if( cnt == 0) 
	{
		if(len > 127 )
		{
			putValue(P_FSG_41_0_0_31_14_len, 127);
		}
	}

	P_FSG_41_0_0_31_BuildFct();
}



// Ueberwachung der Eingabefeld fuer String Data
on envVar P_FSG_41_0_0_31_14_len
{
	word len;
	len = getValue(this);
	/* Validierung der Eingabe*/
	if(len > 40)
	{
		writelineEx(gBAP_Trace, 0, "Eingegebene Laenge: %d von P_FSG_41_0_0_31_14 ist ungueltig. Die max. erlaubte Laenge ist %d. ", len, 40);
		putValue(this, 40);
	}
	P_FSG_41_0_0_31_BuildFct();
}


on envVar P_FSG_41_0_0_31_14 // CallInfo2.TelNumber4
{
	int j, offset;
  int temp;
  int string_length_org;
  int string_length_mod;
  byte string_buffer_org[255];
  byte string_buffer_mod[255];
  
  //Start-Länge
  string_length_org = getValueSize(this);
  string_length_mod = string_length_org;
  
  //Start-String in Buffer
  getvalue(this,string_buffer_org);
  
  //Buffer auf Sonderzeichen checken und ersetzen
  offset = 0;
  for (j=0;j<string_length_org;j++)
  {
    if ( string_buffer_org[j] >= 0x80 && string_buffer_org[j] <= 0xBF ) 
    {
      temp = string_buffer_org[j] + 0xC200;
      
      string_buffer_mod[j+offset] = temp>>8;
      string_buffer_mod[j+offset+1] = temp;
      offset++;
      string_length_mod++;
    }
    else if ( string_buffer_org[j] >= 0xC0 && string_buffer_org[j] <= 0xFF ) 
    {
      temp = string_buffer_org[j] + 0xC2C0;
      
      string_buffer_mod[j+offset] = temp>>8;
      string_buffer_mod[j+offset+1] = temp;
      offset++;
      string_length_mod++;
    }
    else
      string_buffer_mod[j+offset] = string_buffer_org[j];
  }
    
  //neuen String schreiben
  putvalue(P_FSG_41_0_0_31_14_Hex,string_buffer_mod,string_length_mod);
  putValue(P_FSG_41_0_0_31_14_len, string_length_mod);
}

on envVar P_FSG_41_0_0_31_15 // CallInfo2.Category4
{
	P_FSG_41_0_0_31_BuildFct();
}


// Ueberwachung der CheckBox fuer String
on envVar  P_FSG_41_0_0_31_16_cnt
{
	word len;
	byte cnt;
	len = getValue(P_FSG_41_0_0_31_16_len);
	cnt = getValue(P_FSG_41_0_0_31_16_cnt);

	/* wird nur gerufen, wenn check box deaktiviert mit Length>127*/ 
	if( cnt == 0) 
	{
		if(len > 127 )
		{
			putValue(P_FSG_41_0_0_31_16_len, 127);
		}
	}

	P_FSG_41_0_0_31_BuildFct();
}



// Ueberwachung der Eingabefeld fuer String Data
on envVar P_FSG_41_0_0_31_16_len
{
	word len;
	len = getValue(this);
	/* Validierung der Eingabe*/
	if(len > 99)
	{
		writelineEx(gBAP_Trace, 0, "Eingegebene Laenge: %d von P_FSG_41_0_0_31_16 ist ungueltig. Die max. erlaubte Laenge ist %d. ", len, 99);
		putValue(this, 99);
	}
	P_FSG_41_0_0_31_BuildFct();
}


on envVar P_FSG_41_0_0_31_16 // CallInfo2.PbName5
{
	int j, offset;
  int temp;
  int string_length_org;
  int string_length_mod;
  byte string_buffer_org[255];
  byte string_buffer_mod[255];
  
  //Start-Länge
  string_length_org = getValueSize(this);
  string_length_mod = string_length_org;
  
  //Start-String in Buffer
  getvalue(this,string_buffer_org);
  
  //Buffer auf Sonderzeichen checken und ersetzen
  offset = 0;
  for (j=0;j<string_length_org;j++)
  {
    if ( string_buffer_org[j] >= 0x80 && string_buffer_org[j] <= 0xBF ) 
    {
      temp = string_buffer_org[j] + 0xC200;
      
      string_buffer_mod[j+offset] = temp>>8;
      string_buffer_mod[j+offset+1] = temp;
      offset++;
      string_length_mod++;
    }
    else if ( string_buffer_org[j] >= 0xC0 && string_buffer_org[j] <= 0xFF ) 
    {
      temp = string_buffer_org[j] + 0xC2C0;
      
      string_buffer_mod[j+offset] = temp>>8;
      string_buffer_mod[j+offset+1] = temp;
      offset++;
      string_length_mod++;
    }
    else
      string_buffer_mod[j+offset] = string_buffer_org[j];
  }
    
  //neuen String schreiben
  putvalue(P_FSG_41_0_0_31_16_Hex,string_buffer_mod,string_length_mod);
  putValue(P_FSG_41_0_0_31_16_len, string_length_mod);
}


// Ueberwachung der CheckBox fuer String
on envVar  P_FSG_41_0_0_31_17_cnt
{
	word len;
	byte cnt;
	len = getValue(P_FSG_41_0_0_31_17_len);
	cnt = getValue(P_FSG_41_0_0_31_17_cnt);

	/* wird nur gerufen, wenn check box deaktiviert mit Length>127*/ 
	if( cnt == 0) 
	{
		if(len > 127 )
		{
			putValue(P_FSG_41_0_0_31_17_len, 127);
		}
	}

	P_FSG_41_0_0_31_BuildFct();
}



// Ueberwachung der Eingabefeld fuer String Data
on envVar P_FSG_41_0_0_31_17_len
{
	word len;
	len = getValue(this);
	/* Validierung der Eingabe*/
	if(len > 40)
	{
		writelineEx(gBAP_Trace, 0, "Eingegebene Laenge: %d von P_FSG_41_0_0_31_17 ist ungueltig. Die max. erlaubte Laenge ist %d. ", len, 40);
		putValue(this, 40);
	}
	P_FSG_41_0_0_31_BuildFct();
}


on envVar P_FSG_41_0_0_31_17 // CallInfo2.TelNumber5
{
	int j, offset;
  int temp;
  int string_length_org;
  int string_length_mod;
  byte string_buffer_org[255];
  byte string_buffer_mod[255];
  
  //Start-Länge
  string_length_org = getValueSize(this);
  string_length_mod = string_length_org;
  
  //Start-String in Buffer
  getvalue(this,string_buffer_org);
  
  //Buffer auf Sonderzeichen checken und ersetzen
  offset = 0;
  for (j=0;j<string_length_org;j++)
  {
    if ( string_buffer_org[j] >= 0x80 && string_buffer_org[j] <= 0xBF ) 
    {
      temp = string_buffer_org[j] + 0xC200;
      
      string_buffer_mod[j+offset] = temp>>8;
      string_buffer_mod[j+offset+1] = temp;
      offset++;
      string_length_mod++;
    }
    else if ( string_buffer_org[j] >= 0xC0 && string_buffer_org[j] <= 0xFF ) 
    {
      temp = string_buffer_org[j] + 0xC2C0;
      
      string_buffer_mod[j+offset] = temp>>8;
      string_buffer_mod[j+offset+1] = temp;
      offset++;
      string_length_mod++;
    }
    else
      string_buffer_mod[j+offset] = string_buffer_org[j];
  }
    
  //neuen String schreiben
  putvalue(P_FSG_41_0_0_31_17_Hex,string_buffer_mod,string_length_mod);
  putValue(P_FSG_41_0_0_31_17_len, string_length_mod);
}

on envVar P_FSG_41_0_0_31_18 // CallInfo2.Category5
{
	P_FSG_41_0_0_31_BuildFct();
}


// Ueberwachung der CheckBox fuer String
on envVar  P_FSG_41_0_0_31_19_cnt
{
	word len;
	byte cnt;
	len = getValue(P_FSG_41_0_0_31_19_len);
	cnt = getValue(P_FSG_41_0_0_31_19_cnt);

	/* wird nur gerufen, wenn check box deaktiviert mit Length>127*/ 
	if( cnt == 0) 
	{
		if(len > 127 )
		{
			putValue(P_FSG_41_0_0_31_19_len, 127);
		}
	}

	P_FSG_41_0_0_31_BuildFct();
}



// Ueberwachung der Eingabefeld fuer String Data
on envVar P_FSG_41_0_0_31_19_len
{
	word len;
	len = getValue(this);
	/* Validierung der Eingabe*/
	if(len > 99)
	{
		writelineEx(gBAP_Trace, 0, "Eingegebene Laenge: %d von P_FSG_41_0_0_31_19 ist ungueltig. Die max. erlaubte Laenge ist %d. ", len, 99);
		putValue(this, 99);
	}
	P_FSG_41_0_0_31_BuildFct();
}


on envVar P_FSG_41_0_0_31_19 // CallInfo2.PbName6
{
	int j, offset;
  int temp;
  int string_length_org;
  int string_length_mod;
  byte string_buffer_org[255];
  byte string_buffer_mod[255];
  
  //Start-Länge
  string_length_org = getValueSize(this);
  string_length_mod = string_length_org;
  
  //Start-String in Buffer
  getvalue(this,string_buffer_org);
  
  //Buffer auf Sonderzeichen checken und ersetzen
  offset = 0;
  for (j=0;j<string_length_org;j++)
  {
    if ( string_buffer_org[j] >= 0x80 && string_buffer_org[j] <= 0xBF ) 
    {
      temp = string_buffer_org[j] + 0xC200;
      
      string_buffer_mod[j+offset] = temp>>8;
      string_buffer_mod[j+offset+1] = temp;
      offset++;
      string_length_mod++;
    }
    else if ( string_buffer_org[j] >= 0xC0 && string_buffer_org[j] <= 0xFF ) 
    {
      temp = string_buffer_org[j] + 0xC2C0;
      
      string_buffer_mod[j+offset] = temp>>8;
      string_buffer_mod[j+offset+1] = temp;
      offset++;
      string_length_mod++;
    }
    else
      string_buffer_mod[j+offset] = string_buffer_org[j];
  }
    
  //neuen String schreiben
  putvalue(P_FSG_41_0_0_31_19_Hex,string_buffer_mod,string_length_mod);
  putValue(P_FSG_41_0_0_31_19_len, string_length_mod);
}


// Ueberwachung der CheckBox fuer String
on envVar  P_FSG_41_0_0_31_20_cnt
{
	word len;
	byte cnt;
	len = getValue(P_FSG_41_0_0_31_20_len);
	cnt = getValue(P_FSG_41_0_0_31_20_cnt);

	/* wird nur gerufen, wenn check box deaktiviert mit Length>127*/ 
	if( cnt == 0) 
	{
		if(len > 127 )
		{
			putValue(P_FSG_41_0_0_31_20_len, 127);
		}
	}

	P_FSG_41_0_0_31_BuildFct();
}



// Ueberwachung der Eingabefeld fuer String Data
on envVar P_FSG_41_0_0_31_20_len
{
	word len;
	len = getValue(this);
	/* Validierung der Eingabe*/
	if(len > 40)
	{
		writelineEx(gBAP_Trace, 0, "Eingegebene Laenge: %d von P_FSG_41_0_0_31_20 ist ungueltig. Die max. erlaubte Laenge ist %d. ", len, 40);
		putValue(this, 40);
	}
	P_FSG_41_0_0_31_BuildFct();
}


on envVar P_FSG_41_0_0_31_20 // CallInfo2.TelNumber6
{
	int j, offset;
  int temp;
  int string_length_org;
  int string_length_mod;
  byte string_buffer_org[255];
  byte string_buffer_mod[255];
  
  //Start-Länge
  string_length_org = getValueSize(this);
  string_length_mod = string_length_org;
  
  //Start-String in Buffer
  getvalue(this,string_buffer_org);
  
  //Buffer auf Sonderzeichen checken und ersetzen
  offset = 0;
  for (j=0;j<string_length_org;j++)
  {
    if ( string_buffer_org[j] >= 0x80 && string_buffer_org[j] <= 0xBF ) 
    {
      temp = string_buffer_org[j] + 0xC200;
      
      string_buffer_mod[j+offset] = temp>>8;
      string_buffer_mod[j+offset+1] = temp;
      offset++;
      string_length_mod++;
    }
    else if ( string_buffer_org[j] >= 0xC0 && string_buffer_org[j] <= 0xFF ) 
    {
      temp = string_buffer_org[j] + 0xC2C0;
      
      string_buffer_mod[j+offset] = temp>>8;
      string_buffer_mod[j+offset+1] = temp;
      offset++;
      string_length_mod++;
    }
    else
      string_buffer_mod[j+offset] = string_buffer_org[j];
  }
    
  //neuen String schreiben
  putvalue(P_FSG_41_0_0_31_20_Hex,string_buffer_mod,string_length_mod);
  putValue(P_FSG_41_0_0_31_20_len, string_length_mod);
}

on envVar P_FSG_41_0_0_31_21 // CallInfo2.Category6
{
	P_FSG_41_0_0_31_BuildFct();
}

// Ruecksetzen des Fehlerstatus durch manuelle Fehlereingabe
on envVar P_FSG_41_0_0_32_ErrCode
{
       if(gP_FSG_41_0_0_32_ErrCode) 
       {
           setControlBackColor(panel_name,"errfield_P_FSG_41_0_0_32", MakeRGB(255,255,255));
       }
       gP_FSG_41_0_0_32_ErrCode = 1;
}
on envVar P_FSG_41_0_0_32Status_BTN
{
	byte BAPTemp[10];
    if (P_FSG_41_0_0_32Status_BTN_already_pressed == 0)
    {
        putValue(P_FSG_41_0_0_32_ErrCode,0);
        SetControlBackColor(panel_name,"errField_P_FSG_41_0_0_32",MakeRGB(255,255,255));
        P_FSG_41_0_0_32Status_BTN_already_pressed = 1;
    }
    else
    {
		P_FSG_41_0_0_32_BuildFct();
        getValue(P_FSG_41_0_0_32, BAPTemp);
        Request_ByteSequence(LSGID, P_FSG_41_0_0_32_ID, Data_REQ, BAPTemp, getValueSize(P_FSG_41_0_0_32));
        if(getValue(P_FSG_41_0_0_32_IntTlgEn)) //getValue(IT))
        {
           intertelegram_err(P_FSG_41_0_0_32_ID);
        }
        if(getValue(P_FSG_41_0_0_32_SegmEn))   //getvalue(SG)
        {
           sequence_err(P_FSG_41_0_0_32_ID,elCount(BAPTemp));
        }
       P_FSG_41_0_0_32Status_BTN_already_pressed = 0;
    }
}
on envVar P_FSG_41_0_0_32_FctEn
{
    long data[3];
    data[0]=LSGID;
    data[1]=P_FSG_41_0_0_32_ID;
    data[2]=getValue(P_FSG_41_0_0_32_FctEn);
    ChangeConfig(0x0031,data);
}
// De-Aktivierung der Eingabefelder der FCTID P_FSG_41_0_0_32
on envVar P_FSG_41_0_0_32_FctLstItemEn
{
       if(getValue(this)) 
       {
           EnableControl(panel_name,"panel_FSG_41_0_0_32",1);
           EnableControl(panel_name,"errfield_P_FSG_41_0_0_32",1);
           EnableControl(panel_name,"panel_P_FSG_41_0_0_32",1);
           setControlForeColor(panel_name, "checkbox_P_FSG_41_0_0_32", MakeRGB(0,240,0));
       }
       else
       {
           EnableControl(panel_name,"panel_FSG_41_0_0_32",0);
           EnableControl(panel_name,"errfield_P_FSG_41_0_0_32",0);
           EnableControl(panel_name,"panel_P_FSG_41_0_0_32",0);
           setControlForeColor(panel_name, "checkbox_P_FSG_41_0_0_32", MakeRGB(250,0,0));
       }
}
// Man darf gleichzeitig nur Checkbox fuer SegmError oder IntertelegramError aktiviert werden
on envVar P_FSG_41_0_0_32_IntTlgEn
{
       if(getValue(this)) 
       {
           putValue(P_FSG_41_0_0_32_SegmEn,0);
           intertelegram_err(P_FSG_41_0_0_32_ID);
       }
       else
       {
           intertelegram_err_off(P_FSG_41_0_0_32_ID);
       }
}
// Man darf gleichzeitig nur Checkbox fuer SegmError oder IntertelegramError aktiviert werden
on envVar P_FSG_41_0_0_32_SegmEn
{
       if(getValue(this)) 
       {
           putValue(P_FSG_41_0_0_32_IntTlgEn,0);
           sequence_err(P_FSG_41_0_0_32_ID,getValueSize(P_FSG_41_0_0_32_SegmEn));
       }
       else
       {
              sequence_err_off(P_FSG_41_0_0_32_ID);
       }
}
on envVar P_FSG_41_0_0_32 // bus value of CallOptions_Extended2 (32).
{
	// opcodes: Error-Status
	byte param1; // CallOptions_Extended0
	byte param2; // CallOptions_Extended1
	byte param3; // CallOptions_Extended2
	byte param4; // CallOptions_Extended3
	byte param5; // CallOptions_Extended4
	byte param6; // CallOptions_Extended5
	byte param7; // CallOptions_Extended6
	byte param8; // CurrentAudioSink
	word param9; // AvailableAudioSinks
	// DATATYPE_BYTESEQUENCE / DATATYPE_FIXEDBYTESEQUENCE
	int i;
	byte superval[10];
	int currentPos;
	currentPos = 0;
	for( i = 0; i < 10; i++ ) {
		superval[i] = 0;
	}
	getValue(P_FSG_41_0_0_32, superval);
	///////// Start param1 - UINT8 /////////
	param1 = superval[currentPos++];
	putValue(P_FSG_41_0_0_32_1, param1);
	///////// Start param2 - UINT8 /////////
	param2 = superval[currentPos++];
	putValue(P_FSG_41_0_0_32_2, param2);
	///////// Start param3 - UINT8 /////////
	param3 = superval[currentPos++];
	putValue(P_FSG_41_0_0_32_3, param3);
	///////// Start param4 - UINT8 /////////
	param4 = superval[currentPos++];
	putValue(P_FSG_41_0_0_32_4, param4);
	///////// Start param5 - UINT8 /////////
	param5 = superval[currentPos++];
	putValue(P_FSG_41_0_0_32_5, param5);
	///////// Start param6 - UINT8 /////////
	param6 = superval[currentPos++];
	putValue(P_FSG_41_0_0_32_6, param6);
	///////// Start param7 - UINT8 /////////
	param7 = superval[currentPos++];
	putValue(P_FSG_41_0_0_32_7, param7);
	///////// Start param8 - UINT8 /////////
	param8 = superval[currentPos++];
	putValue(P_FSG_41_0_0_32_8, param8);
	///////// Start param9 - UINT16 /////////
	param9 = superval[currentPos++]|(superval[currentPos++]<<8);
	putValue(P_FSG_41_0_0_32_9, param9);
}

// Updates the bus value field and other dependencies.
P_FSG_41_0_0_32_BuildFct()
{
	byte param1; // CallOptions_Extended0
	byte param2; // CallOptions_Extended1
	byte param3; // CallOptions_Extended2
	byte param4; // CallOptions_Extended3
	byte param5; // CallOptions_Extended4
	byte param6; // CallOptions_Extended5
	byte param7; // CallOptions_Extended6
	byte param8; // CurrentAudioSink
	word param9; // AvailableAudioSinks

	int i;
	byte superval[10];
	int currentPos;
	currentPos = 0;
// gen_BuildFunc_SetSuperVals 
	param1 = getValue(P_FSG_41_0_0_32_1);
	@P_FSG_41_0_0_32_1_0 = (param1 & 1) > 0;
	superval[currentPos++]=param1;
// gen_BuildFunc_SetSuperVals 
	param2 = getValue(P_FSG_41_0_0_32_2);
	@P_FSG_41_0_0_32_2_0 = (param2 & 1) > 0;
	superval[currentPos++]=param2;
// gen_BuildFunc_SetSuperVals 
	param3 = getValue(P_FSG_41_0_0_32_3);
	@P_FSG_41_0_0_32_3_0 = (param3 & 1) > 0;
	superval[currentPos++]=param3;
// gen_BuildFunc_SetSuperVals 
	param4 = getValue(P_FSG_41_0_0_32_4);
	@P_FSG_41_0_0_32_4_0 = (param4 & 1) > 0;
	superval[currentPos++]=param4;
// gen_BuildFunc_SetSuperVals 
	param5 = getValue(P_FSG_41_0_0_32_5);
	@P_FSG_41_0_0_32_5_0 = (param5 & 1) > 0;
	superval[currentPos++]=param5;
// gen_BuildFunc_SetSuperVals 
	param6 = getValue(P_FSG_41_0_0_32_6);
	@P_FSG_41_0_0_32_6_0 = (param6 & 1) > 0;
	superval[currentPos++]=param6;
// gen_BuildFunc_SetSuperVals 
	param7 = getValue(P_FSG_41_0_0_32_7);
	@P_FSG_41_0_0_32_7_0 = (param7 & 1) > 0;
	superval[currentPos++]=param7;
// gen_BuildFunc_SetSuperVals 
	param8 = getValue(P_FSG_41_0_0_32_8);
	superval[currentPos++]=param8;
// gen_BuildFunc_SetSuperVals 
	param9 = getValue(P_FSG_41_0_0_32_9);
	@P_FSG_41_0_0_32_9_0 = (param9 & 1) > 0;
	@P_FSG_41_0_0_32_9_1 = (param9 & 2) > 0;
	@P_FSG_41_0_0_32_9_2 = (param9 & 4) > 0;
	@P_FSG_41_0_0_32_9_3 = (param9 & 8) > 0;
	@P_FSG_41_0_0_32_9_4 = (param9 & 16) > 0;
	@P_FSG_41_0_0_32_9_5 = (param9 & 32) > 0;
	@P_FSG_41_0_0_32_9_6 = (param9 & 64) > 0;
	@P_FSG_41_0_0_32_9_7 = (param9 & 128) > 0;
	@P_FSG_41_0_0_32_9_8 = (param9 & 256) > 0;
	superval[currentPos++]=param9&0x00ff;
	superval[currentPos++]=(param9&0xff00)>>8;
	putValue(P_FSG_41_0_0_32, superval, currentPos);
}


on envVar P_FSG_41_0_0_32_1_0
{
	byte bitval;
	//thisval steht hier fuer den bitfield-wert, 
	//aus Generierungsgruenden hier keine einheitliche Bezeichnung moeglich.
	byte thisval; // CallOptions_Extended0
	bitval= getValue(this);
	thisval = getValue(P_FSG_41_0_0_32_1);
	thisval = thisval&~(1<<0)|(bitval<<0);
	putValue(P_FSG_41_0_0_32_1,thisval);
}

on envVar P_FSG_41_0_0_32_1 // CallOptions_Extended2.CallOptions_Extended0
{
	P_FSG_41_0_0_32_BuildFct();
}

on envVar P_FSG_41_0_0_32_2_0
{
	byte bitval;
	//thisval steht hier fuer den bitfield-wert, 
	//aus Generierungsgruenden hier keine einheitliche Bezeichnung moeglich.
	byte thisval; // CallOptions_Extended1
	bitval= getValue(this);
	thisval = getValue(P_FSG_41_0_0_32_2);
	thisval = thisval&~(1<<0)|(bitval<<0);
	putValue(P_FSG_41_0_0_32_2,thisval);
}

on envVar P_FSG_41_0_0_32_2 // CallOptions_Extended2.CallOptions_Extended1
{
	P_FSG_41_0_0_32_BuildFct();
}

on envVar P_FSG_41_0_0_32_3_0
{
	byte bitval;
	//thisval steht hier fuer den bitfield-wert, 
	//aus Generierungsgruenden hier keine einheitliche Bezeichnung moeglich.
	byte thisval; // CallOptions_Extended2
	bitval= getValue(this);
	thisval = getValue(P_FSG_41_0_0_32_3);
	thisval = thisval&~(1<<0)|(bitval<<0);
	putValue(P_FSG_41_0_0_32_3,thisval);
}

on envVar P_FSG_41_0_0_32_3 // CallOptions_Extended2.CallOptions_Extended2
{
	P_FSG_41_0_0_32_BuildFct();
}

on envVar P_FSG_41_0_0_32_4_0
{
	byte bitval;
	//thisval steht hier fuer den bitfield-wert, 
	//aus Generierungsgruenden hier keine einheitliche Bezeichnung moeglich.
	byte thisval; // CallOptions_Extended3
	bitval= getValue(this);
	thisval = getValue(P_FSG_41_0_0_32_4);
	thisval = thisval&~(1<<0)|(bitval<<0);
	putValue(P_FSG_41_0_0_32_4,thisval);
}

on envVar P_FSG_41_0_0_32_4 // CallOptions_Extended2.CallOptions_Extended3
{
	P_FSG_41_0_0_32_BuildFct();
}

on envVar P_FSG_41_0_0_32_5_0
{
	byte bitval;
	//thisval steht hier fuer den bitfield-wert, 
	//aus Generierungsgruenden hier keine einheitliche Bezeichnung moeglich.
	byte thisval; // CallOptions_Extended4
	bitval= getValue(this);
	thisval = getValue(P_FSG_41_0_0_32_5);
	thisval = thisval&~(1<<0)|(bitval<<0);
	putValue(P_FSG_41_0_0_32_5,thisval);
}

on envVar P_FSG_41_0_0_32_5 // CallOptions_Extended2.CallOptions_Extended4
{
	P_FSG_41_0_0_32_BuildFct();
}

on envVar P_FSG_41_0_0_32_6_0
{
	byte bitval;
	//thisval steht hier fuer den bitfield-wert, 
	//aus Generierungsgruenden hier keine einheitliche Bezeichnung moeglich.
	byte thisval; // CallOptions_Extended5
	bitval= getValue(this);
	thisval = getValue(P_FSG_41_0_0_32_6);
	thisval = thisval&~(1<<0)|(bitval<<0);
	putValue(P_FSG_41_0_0_32_6,thisval);
}

on envVar P_FSG_41_0_0_32_6 // CallOptions_Extended2.CallOptions_Extended5
{
	P_FSG_41_0_0_32_BuildFct();
}

on envVar P_FSG_41_0_0_32_7_0
{
	byte bitval;
	//thisval steht hier fuer den bitfield-wert, 
	//aus Generierungsgruenden hier keine einheitliche Bezeichnung moeglich.
	byte thisval; // CallOptions_Extended6
	bitval= getValue(this);
	thisval = getValue(P_FSG_41_0_0_32_7);
	thisval = thisval&~(1<<0)|(bitval<<0);
	putValue(P_FSG_41_0_0_32_7,thisval);
}

on envVar P_FSG_41_0_0_32_7 // CallOptions_Extended2.CallOptions_Extended6
{
	P_FSG_41_0_0_32_BuildFct();
}

on envVar P_FSG_41_0_0_32_8 // CallOptions_Extended2.CurrentAudioSink
{
	P_FSG_41_0_0_32_BuildFct();
}

on envVar P_FSG_41_0_0_32_9_0
{
	byte bitval;
	//thisval steht hier fuer den bitfield-wert, 
	//aus Generierungsgruenden hier keine einheitliche Bezeichnung moeglich.
	word thisval; // AvailableAudioSinks
	bitval= getValue(this);
	thisval = getValue(P_FSG_41_0_0_32_9);
	thisval = thisval&~(1<<0)|(bitval<<0);
	putValue(P_FSG_41_0_0_32_9,thisval);
}

on envVar P_FSG_41_0_0_32_9_1
{
	byte bitval;
	//thisval steht hier fuer den bitfield-wert, 
	//aus Generierungsgruenden hier keine einheitliche Bezeichnung moeglich.
	word thisval; // AvailableAudioSinks
	bitval= getValue(this);
	thisval = getValue(P_FSG_41_0_0_32_9);
	thisval = thisval&~(1<<1)|(bitval<<1);
	putValue(P_FSG_41_0_0_32_9,thisval);
}

on envVar P_FSG_41_0_0_32_9_2
{
	byte bitval;
	//thisval steht hier fuer den bitfield-wert, 
	//aus Generierungsgruenden hier keine einheitliche Bezeichnung moeglich.
	word thisval; // AvailableAudioSinks
	bitval= getValue(this);
	thisval = getValue(P_FSG_41_0_0_32_9);
	thisval = thisval&~(1<<2)|(bitval<<2);
	putValue(P_FSG_41_0_0_32_9,thisval);
}

on envVar P_FSG_41_0_0_32_9_3
{
	byte bitval;
	//thisval steht hier fuer den bitfield-wert, 
	//aus Generierungsgruenden hier keine einheitliche Bezeichnung moeglich.
	word thisval; // AvailableAudioSinks
	bitval= getValue(this);
	thisval = getValue(P_FSG_41_0_0_32_9);
	thisval = thisval&~(1<<3)|(bitval<<3);
	putValue(P_FSG_41_0_0_32_9,thisval);
}

on envVar P_FSG_41_0_0_32_9_4
{
	byte bitval;
	//thisval steht hier fuer den bitfield-wert, 
	//aus Generierungsgruenden hier keine einheitliche Bezeichnung moeglich.
	word thisval; // AvailableAudioSinks
	bitval= getValue(this);
	thisval = getValue(P_FSG_41_0_0_32_9);
	thisval = thisval&~(1<<4)|(bitval<<4);
	putValue(P_FSG_41_0_0_32_9,thisval);
}

on envVar P_FSG_41_0_0_32_9_5
{
	byte bitval;
	//thisval steht hier fuer den bitfield-wert, 
	//aus Generierungsgruenden hier keine einheitliche Bezeichnung moeglich.
	word thisval; // AvailableAudioSinks
	bitval= getValue(this);
	thisval = getValue(P_FSG_41_0_0_32_9);
	thisval = thisval&~(1<<5)|(bitval<<5);
	putValue(P_FSG_41_0_0_32_9,thisval);
}

on envVar P_FSG_41_0_0_32_9_6
{
	byte bitval;
	//thisval steht hier fuer den bitfield-wert, 
	//aus Generierungsgruenden hier keine einheitliche Bezeichnung moeglich.
	word thisval; // AvailableAudioSinks
	bitval= getValue(this);
	thisval = getValue(P_FSG_41_0_0_32_9);
	thisval = thisval&~(1<<6)|(bitval<<6);
	putValue(P_FSG_41_0_0_32_9,thisval);
}

on envVar P_FSG_41_0_0_32_9_7
{
	byte bitval;
	//thisval steht hier fuer den bitfield-wert, 
	//aus Generierungsgruenden hier keine einheitliche Bezeichnung moeglich.
	word thisval; // AvailableAudioSinks
	bitval= getValue(this);
	thisval = getValue(P_FSG_41_0_0_32_9);
	thisval = thisval&~(1<<7)|(bitval<<7);
	putValue(P_FSG_41_0_0_32_9,thisval);
}

on envVar P_FSG_41_0_0_32_9_8
{
	byte bitval;
	//thisval steht hier fuer den bitfield-wert, 
	//aus Generierungsgruenden hier keine einheitliche Bezeichnung moeglich.
	word thisval; // AvailableAudioSinks
	bitval= getValue(this);
	thisval = getValue(P_FSG_41_0_0_32_9);
	thisval = thisval&~(1<<8)|(bitval<<8);
	putValue(P_FSG_41_0_0_32_9,thisval);
}

on envVar P_FSG_41_0_0_32_9 // CallOptions_Extended2.AvailableAudioSinks
{
	P_FSG_41_0_0_32_BuildFct();
}

// Ruecksetzen des Fehlerstatus durch manuelle Fehlereingabe
on envVar M_FSG_41_0_0_33_ErrCode
{
       if(gM_FSG_41_0_0_33_ErrCode) 
       {
           setControlBackColor(panel_name,"errfield_M_FSG_41_0_0_33", MakeRGB(255,255,255));
       }
       gM_FSG_41_0_0_33_ErrCode = 1;
}
on envVar M_FSG_41_0_0_33Result_BTN
{
    byte temp[2];
    if (M_FSG_41_0_0_33Result_BTN_already_pressed == 0)
    {
        putValue(M_FSG_41_0_0_33_ErrCode,0);
        SetControlBackColor(panel_name,"errField_M_FSG_41_0_0_33",MakeRGB(255,255,255));
        M_FSG_41_0_0_33Result_BTN_already_pressed = 1;
    }
    else
    {
        putValue(M_FSG_41_0_0_33_State, "Result");
        getValue(M_FSG_41_0_0_33_Result, temp);
        Request_ByteSequence(LSGID, M_FSG_41_0_0_33_ID, Result_REQ, temp, getValueSize(M_FSG_41_0_0_33_Result));
        M_FSG_41_0_0_33Result_BTN_already_pressed = 0;
    }
}
on envVar M_FSG_41_0_0_33_FctEn
{
    long data[3];
    data[0]=LSGID;
    data[1]=M_FSG_41_0_0_33_ID;
    data[2]=getValue(M_FSG_41_0_0_33_FctEn);
    ChangeConfig(0x0031,data);
}
// De-Aktivierung der Eingabefelder der FCTID M_FSG_41_0_0_33
on envVar M_FSG_41_0_0_33_FctLstItemEn
{
       if(getValue(this)) 
       {
           EnableControl(panel_name,"panel_FSG_41_0_0_33",1);
           EnableControl(panel_name,"errfield_M_FSG_41_0_0_33",1);
           EnableControl(panel_name,"panel_M_FSG_41_0_0_33",1);
           EnableControl(panel_name,"panel_M_FSG_41_0_0_33_Processing",1);
           EnableControl(panel_name,"panel_M_FSG_41_0_0_33_Start",1);
           setControlForeColor(panel_name, "checkbox_M_FSG_41_0_0_33", MakeRGB(0,240,0));
       }
       else
       {
           EnableControl(panel_name,"panel_FSG_41_0_0_33",0);
           EnableControl(panel_name,"errfield_M_FSG_41_0_0_33",0);
           EnableControl(panel_name,"panel_M_FSG_41_0_0_33",0);
           EnableControl(panel_name,"panel_M_FSG_41_0_0_33_Processing",0);
           EnableControl(panel_name,"panel_M_FSG_41_0_0_33_Start",0);
           setControlForeColor(panel_name, "checkbox_M_FSG_41_0_0_33", MakeRGB(250,0,0));
       }
}
on envVar M_FSG_41_0_0_33_Result // bus value of CallFunctions2 (33).
{
	// opcodes: Error-Processing-Result
	byte param1; // CallFunction
	byte param2; // CallFunctions_Result
	// DATATYPE_BYTESEQUENCE / DATATYPE_FIXEDBYTESEQUENCE
	int i;
	byte superval[2];
	int currentPos;
	currentPos = 0;
	for( i = 0; i < 2; i++ ) {
		superval[i] = 0;
	}
	getValue(M_FSG_41_0_0_33_Result, superval);
	///////// Start param1 - UINT8 /////////
	param1 = superval[currentPos++];
	putValue(M_FSG_41_0_0_33_Result_1, param1);
	///////// Start param2 - UINT8 /////////
	param2 = superval[currentPos++];
	putValue(M_FSG_41_0_0_33_Result_2, param2);
}

on envVar M_FSG_41_0_0_33_Result_1 // CallFunctions2.CallFunction
{
	byte superval[2];

	//Update Childvalue (Enum)
	byte thisval; // CallFunction
	thisval = getValue(this);

    // Update superval
	getValue(M_FSG_41_0_0_33_Result, superval);
	superval[0]=thisval;
	putValue(M_FSG_41_0_0_33_Result,superval);
}

on envVar M_FSG_41_0_0_33_Result_2 // CallFunctions2.CallFunctions_Result
{
	byte superval[2];

	//Update Childvalue (Enum)
	byte thisval; // CallFunctions_Result
	thisval = getValue(this);

    // Update superval
	getValue(M_FSG_41_0_0_33_Result, superval);
	superval[1]=thisval;
	putValue(M_FSG_41_0_0_33_Result,superval);
}

on envVar M_FSG_41_0_0_33_Processing // bus value of CallFunctions2 (33).
{
	// opcodes: Error-Processing-Result
	byte param1; // CallFunction
	byte param2; // Reserve1
	// DATATYPE_BYTESEQUENCE / DATATYPE_FIXEDBYTESEQUENCE
	int i;
	byte superval[2];
	int currentPos;
	currentPos = 0;
	for( i = 0; i < 2; i++ ) {
		superval[i] = 0;
	}
	getValue(M_FSG_41_0_0_33_Processing, superval);
	///////// Start param1 - UINT8 /////////
	param1 = superval[currentPos++];
	putValue(M_FSG_41_0_0_33_Processing_1, param1);
	///////// Start param2 - UINT8 /////////
	param2 = superval[currentPos++];
	putValue(M_FSG_41_0_0_33_Processing_2, round((param2 * 1.0) - (0) + (0), 1.0));
}

on envVar M_FSG_41_0_0_33_Processing_1 // CallFunctions2.CallFunction
{
	byte superval[2];

	//Update Childvalue (Enum)
	byte thisval; // CallFunction
	thisval = getValue(this);

    // Update superval
	getValue(M_FSG_41_0_0_33_Processing, superval);
	superval[0]=thisval;
	putValue(M_FSG_41_0_0_33_Processing,superval);
}

// Ueberwachung der Darstellungsvariable der Range.
on envVar M_FSG_41_0_0_33_Processing_2_range // CallFunctions2.Reserve1 
{
	@M_FSG_41_0_0_33_Processing_2 = @M_FSG_41_0_0_33_Processing_2_range - (0); // slider = range - min
}

on envVar M_FSG_41_0_0_33_Processing_2 // CallFunctions2.Reserve1
{
	byte superval[2];

	//Update Childvalue (Number)
	byte thisval; // Reserve1
	float slider_value;

	slider_value = 0; // Konstanter Parameter.
	@M_FSG_41_0_0_33_Processing_2_range = slider_value + (0); // real value := slider value + range min.
	thisval = (byte)round((slider_value + (0) - (0)) / (1.0), 1); // bus value := (slider value + min - offset) / step.

    // Update superval
	getValue(M_FSG_41_0_0_33_Processing, superval);
	superval[1]=thisval;
	putValue(M_FSG_41_0_0_33_Processing,superval);
}

on envVar M_FSG_41_0_0_33_Start // bus value of CallFunctions2 (33).
{
	// opcodes: AbortResult-StartResult
	byte param1; // CallFunction
	byte param2; // CallID
	byte param3; // MessageID
	byte param4; // ServiceType
	byte param5; // Control
	byte param6; // SelectedAudioSink
	byte param7[41]; // TelNumber
	word len7;
	byte cnt7;
	byte param8[150]; // Name
	word len8;
	byte cnt8;
	// DATATYPE_BYTESEQUENCE / DATATYPE_FIXEDBYTESEQUENCE
	int i;
	byte superval[195];
	int currentPos;
	currentPos = 0;
	for( i = 0; i < 195; i++ ) {
		superval[i] = 0;
	}
	getValue(M_FSG_41_0_0_33_Start, superval);
	///////// Start param1 - UINT8 /////////
	param1 = superval[currentPos++];
	putValue(M_FSG_41_0_0_33_Start_1, param1);
	///////// Start param2 - NIBBLE /////////
	param2 = (superval[currentPos] & 0xf0)>>4;
	putValue(M_FSG_41_0_0_33_Start_2, param2);
	///////// Start param3 - NIBBLE /////////
	param3 = superval[currentPos++] & 0x0f;
	putValue(M_FSG_41_0_0_33_Start_3, param3);
	///////// Start param4 - NIBBLE /////////
	param4 = (superval[currentPos] & 0xf0)>>4;
	putValue(M_FSG_41_0_0_33_Start_4, param4);
	///////// Start param5 - NIBBLE /////////
	param5 = superval[currentPos++] & 0x0f;
	putValue(M_FSG_41_0_0_33_Start_5, param5);
	///////// Start param6 - UINT8 /////////
	param6 = superval[currentPos++];
	putValue(M_FSG_41_0_0_33_Start_6, param6);
	///////// Start param7 - STRING /////////
	getValue(M_FSG_41_0_0_33_Start_7_Hex, param7);
	if((superval[currentPos] & 0x80) > 0)
	{
		if(40>127) /* Max Fct-Katalog Laenge: 40*/
		{
			len7 = ( (superval[currentPos]&0x7F) <<8) + superval[currentPos+1];
			currentPos = currentPos + 2;
			cnt7 = 1;
		}
		else
		{
			len7 = 40;
			writelineEx(gBAP_Trace, 0, "Anzahl der Laengeninformation-Bytes in M_FSG_41_0_0_33_Start ueberschreitet die erlaubte 1 Byte vom Fct-Kalatog.");
		}
	}
	else
	{
		len7 = superval[currentPos]&0x7F;
		currentPos = currentPos + 1;
		cnt7 = 0;
	}
	
	if(len7 > 40)
	{
		writelineEx(gBAP_Trace, 0, "Laenge:%d bei der Byte Position:%d ueberschreitet die Maximale erlaubte Laenge von Fct-Kalatog", len7, currentPos);
		len7 = 40;
	
		if(len7 < 128) cnt7 = 0;
		else cnt7 = 1;
	}
	
	for(i = 0; i < len7; i++)
	{
		param7[i] = superval[currentPos++];
	}
	
	putValue(M_FSG_41_0_0_33_Start_7_len, len7);
	putValue(M_FSG_41_0_0_33_Start_7_cnt, cnt7);
	
	if(len7 > getValueSize(M_FSG_41_0_0_33_Start_7_Hex))
		putValue(M_FSG_41_0_0_33_Start_7_Hex, param7, len7);
	else
		putValue(M_FSG_41_0_0_33_Start_7_Hex, param7, getValueSize(M_FSG_41_0_0_33_Start_7_Hex));

	///////// Start param8 - STRING /////////
	getValue(M_FSG_41_0_0_33_Start_8_Hex, param8);
	if((superval[currentPos] & 0x80) > 0)
	{
		if(148>127) /* Max Fct-Katalog Laenge: 148*/
		{
			len8 = ( (superval[currentPos]&0x7F) <<8) + superval[currentPos+1];
			currentPos = currentPos + 2;
			cnt8 = 1;
		}
		else
		{
			len8 = 148;
			writelineEx(gBAP_Trace, 0, "Anzahl der Laengeninformation-Bytes in M_FSG_41_0_0_33_Start ueberschreitet die erlaubte 1 Byte vom Fct-Kalatog.");
		}
	}
	else
	{
		len8 = superval[currentPos]&0x7F;
		currentPos = currentPos + 1;
		cnt8 = 0;
	}
	
	if(len8 > 148)
	{
		writelineEx(gBAP_Trace, 0, "Laenge:%d bei der Byte Position:%d ueberschreitet die Maximale erlaubte Laenge von Fct-Kalatog", len8, currentPos);
		len8 = 148;
	
		if(len8 < 128) cnt8 = 0;
		else cnt8 = 1;
	}
	
	for(i = 0; i < len8; i++)
	{
		param8[i] = superval[currentPos++];
	}
	
	putValue(M_FSG_41_0_0_33_Start_8_len, len8);
	putValue(M_FSG_41_0_0_33_Start_8_cnt, cnt8);
	
	if(len8 > getValueSize(M_FSG_41_0_0_33_Start_8_Hex))
		putValue(M_FSG_41_0_0_33_Start_8_Hex, param8, len8);
	else
		putValue(M_FSG_41_0_0_33_Start_8_Hex, param8, getValueSize(M_FSG_41_0_0_33_Start_8_Hex));

}

// Updates the bus value field and other dependencies.
M_FSG_41_0_0_33_Start_BuildFct()
{
	byte param1; // CallFunction
	byte param2; // CallID
	byte param3; // MessageID
	byte param4; // ServiceType
	byte param5; // Control
	byte param6; // SelectedAudioSink
	byte param7[41]; // TelNumber
	word len7;
	byte cnt7;
	byte param8[150]; // Name
	word len8;
	byte cnt8;

	int i;
	byte superval[195];
	int currentPos;
	currentPos = 0;
// gen_BuildFunc_SetSuperVals 
	param1 = getValue(M_FSG_41_0_0_33_Start_1);
	superval[currentPos++]=param1;
// gen_BuildFunc_SetSuperVals 
	param2 = getValue(M_FSG_41_0_0_33_Start_2);
	param2 = param2 & 0x0f;
	superval[currentPos]= superval[currentPos]&0x0f;
	superval[currentPos]= superval[currentPos]|(param2<<4);
// gen_BuildFunc_SetSuperVals 
	param3 = getValue(M_FSG_41_0_0_33_Start_3);
	param3 = param3 & 0x0f;
	superval[currentPos]= superval[currentPos]&0xf0;
	superval[currentPos]= superval[currentPos]|param3;
	currentPos++;
// gen_BuildFunc_SetSuperVals 
	param4 = getValue(M_FSG_41_0_0_33_Start_4);
	param4 = param4 & 0x0f;
	superval[currentPos]= superval[currentPos]&0x0f;
	superval[currentPos]= superval[currentPos]|(param4<<4);
// gen_BuildFunc_SetSuperVals 
	param5 = getValue(M_FSG_41_0_0_33_Start_5);
	param5 = param5 & 0x0f;
	superval[currentPos]= superval[currentPos]&0xf0;
	superval[currentPos]= superval[currentPos]|param5;
	currentPos++;
// gen_BuildFunc_SetSuperVals 
	param6 = getValue(M_FSG_41_0_0_33_Start_6);
	superval[currentPos++]=param6;
// gen_BuildFunc_SetSuperVals 
	getValue(M_FSG_41_0_0_33_Start_7_Hex, param7);
	len7 = getValue(M_FSG_41_0_0_33_Start_7_len);
	cnt7= getValue(M_FSG_41_0_0_33_Start_7_cnt);
	
	/* check box aktiviert*/
	if (cnt7 == 1)
	{
		/* 0 bis 40 (MaxString - 1B oder 2B) */
		if(len7 >= 0 && len7 <= 40)
		{
			//writelineEx(gBAP_Trace, 0, "[Debug-1] Len7: %d", len7);
			superval[currentPos] = (len7&0x7f00) | 0x80;
			superval[currentPos+1] = len7 & 0x00ff;
		}
		else
		{
			writelineEx(gBAP_Trace, 0, "Eingegebene Laenge: %d von M_FSG_41_0_0_33_Start_7 ist ungueltig. Die max. erlaubte Laenge ist %d.", len7, 40);
			return;
		}
	}
	else if(cnt7 == 0) /*check box deaktiviert*/
	{
		if(len7 >= 0 && len7 <= 127)
		{
			//writelineEx(gBAP_Trace, 0, "[Debug-1] Len7: %d", len7);
			superval[currentPos]= len7 & 0x00ff;
			putValue(M_FSG_41_0_0_33_Start_7_len, len7);
		}
		else if(len7 > 127 && len7 <= 40)
		{
			superval[currentPos] = (len7&0x7f00) | 0x80;
			superval[currentPos+1] = len7 & 0x00ff;
			putValue(M_FSG_41_0_0_33_Start_7_len, len7);
			putValue(M_FSG_41_0_0_33_Start_7_cnt, 1);
		}
		else
		{
			writelineEx(gBAP_Trace, 0, "Eingegebene Laenge: %d von M_FSG_41_0_0_33_Start_7 ist ungueltig. Die max. erlaubte Laenge ist %d.", len7, 40);
			return;
		}
	}
	currentPos += cnt7+1;
	for(i = 0; i < len7; i++)
	{
		superval[currentPos++]= param7[i];
	}

// gen_BuildFunc_SetSuperVals 
	getValue(M_FSG_41_0_0_33_Start_8_Hex, param8);
	len8 = getValue(M_FSG_41_0_0_33_Start_8_len);
	cnt8= getValue(M_FSG_41_0_0_33_Start_8_cnt);
	
	/* check box aktiviert*/
	if (cnt8 == 1)
	{
		/* 0 bis 148 (MaxString - 1B oder 2B) */
		if(len8 >= 0 && len8 <= 148)
		{
			//writelineEx(gBAP_Trace, 0, "[Debug-1] Len8: %d", len8);
			superval[currentPos] = (len8&0x7f00) | 0x80;
			superval[currentPos+1] = len8 & 0x00ff;
		}
		else
		{
			writelineEx(gBAP_Trace, 0, "Eingegebene Laenge: %d von M_FSG_41_0_0_33_Start_8 ist ungueltig. Die max. erlaubte Laenge ist %d.", len8, 148);
			return;
		}
	}
	else if(cnt8 == 0) /*check box deaktiviert*/
	{
		if(len8 >= 0 && len8 <= 127)
		{
			//writelineEx(gBAP_Trace, 0, "[Debug-1] Len8: %d", len8);
			superval[currentPos]= len8 & 0x00ff;
			putValue(M_FSG_41_0_0_33_Start_8_len, len8);
		}
		else if(len8 > 127 && len8 <= 148)
		{
			superval[currentPos] = (len8&0x7f00) | 0x80;
			superval[currentPos+1] = len8 & 0x00ff;
			putValue(M_FSG_41_0_0_33_Start_8_len, len8);
			putValue(M_FSG_41_0_0_33_Start_8_cnt, 1);
		}
		else
		{
			writelineEx(gBAP_Trace, 0, "Eingegebene Laenge: %d von M_FSG_41_0_0_33_Start_8 ist ungueltig. Die max. erlaubte Laenge ist %d.", len8, 148);
			return;
		}
	}
	currentPos += cnt8+1;
	for(i = 0; i < len8; i++)
	{
		superval[currentPos++]= param8[i];
	}

	putValue(M_FSG_41_0_0_33_Start, superval, currentPos);
}


on envVar M_FSG_41_0_0_33_Start_1 // CallFunctions2.CallFunction
{
	M_FSG_41_0_0_33_Start_BuildFct();
}

on envVar M_FSG_41_0_0_33_Start_2 // CallFunctions2.CallID
{
	M_FSG_41_0_0_33_Start_BuildFct();
}

on envVar M_FSG_41_0_0_33_Start_3 // CallFunctions2.MessageID
{
	M_FSG_41_0_0_33_Start_BuildFct();
}

on envVar M_FSG_41_0_0_33_Start_4 // CallFunctions2.ServiceType
{
	M_FSG_41_0_0_33_Start_BuildFct();
}

on envVar M_FSG_41_0_0_33_Start_5 // CallFunctions2.Control
{
	M_FSG_41_0_0_33_Start_BuildFct();
}

on envVar M_FSG_41_0_0_33_Start_6 // CallFunctions2.SelectedAudioSink
{
	M_FSG_41_0_0_33_Start_BuildFct();
}


// Ueberwachung der CheckBox fuer String
on envVar  M_FSG_41_0_0_33_Start_7_cnt
{
	word len;
	byte cnt;
	len = getValue(M_FSG_41_0_0_33_Start_7_len);
	cnt = getValue(M_FSG_41_0_0_33_Start_7_cnt);

	/* wird nur gerufen, wenn check box deaktiviert mit Length>127*/ 
	if( cnt == 0) 
	{
		if(len > 127 )
		{
			putValue(M_FSG_41_0_0_33_Start_7_len, 127);
		}
	}

	M_FSG_41_0_0_33_Start_BuildFct();
}



// Ueberwachung der Eingabefeld fuer String Data
on envVar M_FSG_41_0_0_33_Start_7_len
{
	word len;
	len = getValue(this);
	/* Validierung der Eingabe*/
	if(len > 40)
	{
		writelineEx(gBAP_Trace, 0, "Eingegebene Laenge: %d von M_FSG_41_0_0_33_Start_7 ist ungueltig. Die max. erlaubte Laenge ist %d. ", len, 40);
		putValue(this, 40);
	}
	M_FSG_41_0_0_33_Start_BuildFct();
}


on envVar M_FSG_41_0_0_33_Start_7 // CallFunctions2.TelNumber
{
	int j, offset;
  int temp;
  int string_length_org;
  int string_length_mod;
  byte string_buffer_org[255];
  byte string_buffer_mod[255];
  
  //Start-Länge
  string_length_org = getValueSize(this);
  string_length_mod = string_length_org;
  
  //Start-String in Buffer
  getvalue(this,string_buffer_org);
  
  //Buffer auf Sonderzeichen checken und ersetzen
  offset = 0;
  for (j=0;j<string_length_org;j++)
  {
    if ( string_buffer_org[j] >= 0x80 && string_buffer_org[j] <= 0xBF ) 
    {
      temp = string_buffer_org[j] + 0xC200;
      
      string_buffer_mod[j+offset] = temp>>8;
      string_buffer_mod[j+offset+1] = temp;
      offset++;
      string_length_mod++;
    }
    else if ( string_buffer_org[j] >= 0xC0 && string_buffer_org[j] <= 0xFF ) 
    {
      temp = string_buffer_org[j] + 0xC2C0;
      
      string_buffer_mod[j+offset] = temp>>8;
      string_buffer_mod[j+offset+1] = temp;
      offset++;
      string_length_mod++;
    }
    else
      string_buffer_mod[j+offset] = string_buffer_org[j];
  }
    
  //neuen String schreiben
  putvalue(M_FSG_41_0_0_33_Start_7_Hex,string_buffer_mod,string_length_mod);
  putValue(M_FSG_41_0_0_33_Start_7_len, string_length_mod);
}


// Ueberwachung der CheckBox fuer String
on envVar  M_FSG_41_0_0_33_Start_8_cnt
{
	word len;
	byte cnt;
	len = getValue(M_FSG_41_0_0_33_Start_8_len);
	cnt = getValue(M_FSG_41_0_0_33_Start_8_cnt);

	/* wird nur gerufen, wenn check box deaktiviert mit Length>127*/ 
	if( cnt == 0) 
	{
		if(len > 127 )
		{
			putValue(M_FSG_41_0_0_33_Start_8_len, 127);
		}
	}

	M_FSG_41_0_0_33_Start_BuildFct();
}



// Ueberwachung der Eingabefeld fuer String Data
on envVar M_FSG_41_0_0_33_Start_8_len
{
	word len;
	len = getValue(this);
	/* Validierung der Eingabe*/
	if(len > 148)
	{
		writelineEx(gBAP_Trace, 0, "Eingegebene Laenge: %d von M_FSG_41_0_0_33_Start_8 ist ungueltig. Die max. erlaubte Laenge ist %d. ", len, 148);
		putValue(this, 148);
	}
	M_FSG_41_0_0_33_Start_BuildFct();
}


on envVar M_FSG_41_0_0_33_Start_8 // CallFunctions2.Name
{
	int j, offset;
  int temp;
  int string_length_org;
  int string_length_mod;
  byte string_buffer_org[255];
  byte string_buffer_mod[255];
  
  //Start-Länge
  string_length_org = getValueSize(this);
  string_length_mod = string_length_org;
  
  //Start-String in Buffer
  getvalue(this,string_buffer_org);
  
  //Buffer auf Sonderzeichen checken und ersetzen
  offset = 0;
  for (j=0;j<string_length_org;j++)
  {
    if ( string_buffer_org[j] >= 0x80 && string_buffer_org[j] <= 0xBF ) 
    {
      temp = string_buffer_org[j] + 0xC200;
      
      string_buffer_mod[j+offset] = temp>>8;
      string_buffer_mod[j+offset+1] = temp;
      offset++;
      string_length_mod++;
    }
    else if ( string_buffer_org[j] >= 0xC0 && string_buffer_org[j] <= 0xFF ) 
    {
      temp = string_buffer_org[j] + 0xC2C0;
      
      string_buffer_mod[j+offset] = temp>>8;
      string_buffer_mod[j+offset+1] = temp;
      offset++;
      string_length_mod++;
    }
    else
      string_buffer_mod[j+offset] = string_buffer_org[j];
  }
    
  //neuen String schreiben
  putvalue(M_FSG_41_0_0_33_Start_8_Hex,string_buffer_mod,string_length_mod);
  putValue(M_FSG_41_0_0_33_Start_8_len, string_length_mod);
}

// Ruecksetzen des Fehlerstatus durch manuelle Fehlereingabe
on envVar P_FSG_41_0_0_34_ErrCode
{
       if(gP_FSG_41_0_0_34_ErrCode) 
       {
           setControlBackColor(panel_name,"errfield_P_FSG_41_0_0_34", MakeRGB(255,255,255));
       }
       gP_FSG_41_0_0_34_ErrCode = 1;
}
on envVar P_FSG_41_0_0_34Status_BTN
{
	byte BAPTemp[8];
    if (P_FSG_41_0_0_34Status_BTN_already_pressed == 0)
    {
        putValue(P_FSG_41_0_0_34_ErrCode,0);
        SetControlBackColor(panel_name,"errField_P_FSG_41_0_0_34",MakeRGB(255,255,255));
        P_FSG_41_0_0_34Status_BTN_already_pressed = 1;
    }
    else
    {
		P_FSG_41_0_0_34_BuildFct();
        getValue(P_FSG_41_0_0_34, BAPTemp);
        Request_ByteSequence(LSGID, P_FSG_41_0_0_34_ID, Data_REQ, BAPTemp, getValueSize(P_FSG_41_0_0_34));
        if(getValue(P_FSG_41_0_0_34_IntTlgEn)) //getValue(IT))
        {
           intertelegram_err(P_FSG_41_0_0_34_ID);
        }
        if(getValue(P_FSG_41_0_0_34_SegmEn))   //getvalue(SG)
        {
           sequence_err(P_FSG_41_0_0_34_ID,elCount(BAPTemp));
        }
       P_FSG_41_0_0_34Status_BTN_already_pressed = 0;
    }
}
on envVar P_FSG_41_0_0_34_FctEn
{
    long data[3];
    data[0]=LSGID;
    data[1]=P_FSG_41_0_0_34_ID;
    data[2]=getValue(P_FSG_41_0_0_34_FctEn);
    ChangeConfig(0x0031,data);
}
// De-Aktivierung der Eingabefelder der FCTID P_FSG_41_0_0_34
on envVar P_FSG_41_0_0_34_FctLstItemEn
{
       if(getValue(this)) 
       {
           EnableControl(panel_name,"panel_FSG_41_0_0_34",1);
           EnableControl(panel_name,"errfield_P_FSG_41_0_0_34",1);
           EnableControl(panel_name,"panel_P_FSG_41_0_0_34",1);
           setControlForeColor(panel_name, "checkbox_P_FSG_41_0_0_34", MakeRGB(0,240,0));
       }
       else
       {
           EnableControl(panel_name,"panel_FSG_41_0_0_34",0);
           EnableControl(panel_name,"errfield_P_FSG_41_0_0_34",0);
           EnableControl(panel_name,"panel_P_FSG_41_0_0_34",0);
           setControlForeColor(panel_name, "checkbox_P_FSG_41_0_0_34", MakeRGB(250,0,0));
       }
}
// Man darf gleichzeitig nur Checkbox fuer SegmError oder IntertelegramError aktiviert werden
on envVar P_FSG_41_0_0_34_IntTlgEn
{
       if(getValue(this)) 
       {
           putValue(P_FSG_41_0_0_34_SegmEn,0);
           intertelegram_err(P_FSG_41_0_0_34_ID);
       }
       else
       {
           intertelegram_err_off(P_FSG_41_0_0_34_ID);
       }
}
// Man darf gleichzeitig nur Checkbox fuer SegmError oder IntertelegramError aktiviert werden
on envVar P_FSG_41_0_0_34_SegmEn
{
       if(getValue(this)) 
       {
           putValue(P_FSG_41_0_0_34_IntTlgEn,0);
           sequence_err(P_FSG_41_0_0_34_ID,getValueSize(P_FSG_41_0_0_34_SegmEn));
       }
       else
       {
              sequence_err_off(P_FSG_41_0_0_34_ID);
       }
}
on envVar P_FSG_41_0_0_34 // bus value of MobileServiceSupport3 (34).
{
	// opcodes: Error-Status
	byte param1[8]; // FctList
	// DATATYPE_BYTESEQUENCE / DATATYPE_FIXEDBYTESEQUENCE
	int i;
	byte superval[8];
	int currentPos;
	currentPos = 0;
	for( i = 0; i < 8; i++ ) {
		superval[i] = 0;
	}
	getValue(P_FSG_41_0_0_34, superval);
	///////// Start param1 - 6/8BSTRING /////////
	for( i = 0; i < 8; i++ )
	{
		param1[i] = superval[currentPos++];
	}
	putValue(P_FSG_41_0_0_34_1, param1);
}

// Updates the bus value field and other dependencies.
P_FSG_41_0_0_34_BuildFct()
{
	byte param1[8]; // FctList

	int i;
	byte superval[8];
	int currentPos;
	currentPos = 0;
// gen_BuildFunc_SetSuperVals 
	getValue(P_FSG_41_0_0_34_1, param1);
	@P_FSG_41_0_0_34_1_17 = (param1[2] & 64) > 0;
	@P_FSG_41_0_0_34_1_18 = (param1[2] & 32) > 0;
	@P_FSG_41_0_0_34_1_19 = (param1[2] & 16) > 0;
	@P_FSG_41_0_0_34_1_20 = (param1[2] & 8) > 0;
	@P_FSG_41_0_0_34_1_21 = (param1[2] & 4) > 0;
	@P_FSG_41_0_0_34_1_22 = (param1[2] & 2) > 0;
	@P_FSG_41_0_0_34_1_23 = (param1[2] & 1) > 0;
	@P_FSG_41_0_0_34_1_24 = (param1[3] & 128) > 0;
	@P_FSG_41_0_0_34_1_25 = (param1[3] & 64) > 0;
	@P_FSG_41_0_0_34_1_26 = (param1[3] & 32) > 0;
	@P_FSG_41_0_0_34_1_27 = (param1[3] & 16) > 0;
	@P_FSG_41_0_0_34_1_28 = (param1[3] & 8) > 0;
	@P_FSG_41_0_0_34_1_29 = (param1[3] & 4) > 0;
	@P_FSG_41_0_0_34_1_30 = (param1[3] & 2) > 0;
	@P_FSG_41_0_0_34_1_31 = (param1[3] & 1) > 0;
	@P_FSG_41_0_0_34_1_32 = (param1[4] & 128) > 0;
	@P_FSG_41_0_0_34_1_33 = (param1[4] & 64) > 0;
	@P_FSG_41_0_0_34_1_34 = (param1[4] & 32) > 0;
	@P_FSG_41_0_0_34_1_35 = (param1[4] & 16) > 0;
	@P_FSG_41_0_0_34_1_36 = (param1[4] & 8) > 0;
	@P_FSG_41_0_0_34_1_37 = (param1[4] & 4) > 0;
	@P_FSG_41_0_0_34_1_38 = (param1[4] & 2) > 0;
	@P_FSG_41_0_0_34_1_39 = (param1[4] & 1) > 0;
	@P_FSG_41_0_0_34_1_40 = (param1[5] & 128) > 0;
	@P_FSG_41_0_0_34_1_41 = (param1[5] & 64) > 0;
	@P_FSG_41_0_0_34_1_42 = (param1[5] & 32) > 0;
	@P_FSG_41_0_0_34_1_43 = (param1[5] & 16) > 0;
	@P_FSG_41_0_0_34_1_44 = (param1[5] & 8) > 0;
	@P_FSG_41_0_0_34_1_45 = (param1[5] & 4) > 0;
	@P_FSG_41_0_0_34_1_46 = (param1[5] & 2) > 0;
	@P_FSG_41_0_0_34_1_47 = (param1[5] & 1) > 0;
	@P_FSG_41_0_0_34_1_48 = (param1[6] & 128) > 0;
	@P_FSG_41_0_0_34_1_49 = (param1[6] & 64) > 0;
	@P_FSG_41_0_0_34_1_50 = (param1[6] & 32) > 0;
	for( i = 0; i < 8; i++)
	{
	 superval[currentPos++] = param1[i];
	}
	putValue(P_FSG_41_0_0_34, superval, currentPos);
}


on envVar P_FSG_41_0_0_34_1_17
{
	byte bitval;
	//thisval steht hier fuer den bitfield-wert, 
	//aus Generierungsgruenden hier keine einheitliche Bezeichnung moeglich.
	byte thisval[8]; // FctList
	bitval= getValue(this);
	getValue(P_FSG_41_0_0_34_1, thisval);
	thisval[2] = thisval[2]&~(1<<6)|(bitval<<6);
	putValue(P_FSG_41_0_0_34_1,thisval);
}

on envVar P_FSG_41_0_0_34_1_18
{
	byte bitval;
	//thisval steht hier fuer den bitfield-wert, 
	//aus Generierungsgruenden hier keine einheitliche Bezeichnung moeglich.
	byte thisval[8]; // FctList
	bitval= getValue(this);
	getValue(P_FSG_41_0_0_34_1, thisval);
	thisval[2] = thisval[2]&~(1<<5)|(bitval<<5);
	putValue(P_FSG_41_0_0_34_1,thisval);
}

on envVar P_FSG_41_0_0_34_1_19
{
	byte bitval;
	//thisval steht hier fuer den bitfield-wert, 
	//aus Generierungsgruenden hier keine einheitliche Bezeichnung moeglich.
	byte thisval[8]; // FctList
	bitval= getValue(this);
	getValue(P_FSG_41_0_0_34_1, thisval);
	thisval[2] = thisval[2]&~(1<<4)|(bitval<<4);
	putValue(P_FSG_41_0_0_34_1,thisval);
}

on envVar P_FSG_41_0_0_34_1_20
{
	byte bitval;
	//thisval steht hier fuer den bitfield-wert, 
	//aus Generierungsgruenden hier keine einheitliche Bezeichnung moeglich.
	byte thisval[8]; // FctList
	bitval= getValue(this);
	getValue(P_FSG_41_0_0_34_1, thisval);
	thisval[2] = thisval[2]&~(1<<3)|(bitval<<3);
	putValue(P_FSG_41_0_0_34_1,thisval);
}

on envVar P_FSG_41_0_0_34_1_21
{
	byte bitval;
	//thisval steht hier fuer den bitfield-wert, 
	//aus Generierungsgruenden hier keine einheitliche Bezeichnung moeglich.
	byte thisval[8]; // FctList
	bitval= getValue(this);
	getValue(P_FSG_41_0_0_34_1, thisval);
	thisval[2] = thisval[2]&~(1<<2)|(bitval<<2);
	putValue(P_FSG_41_0_0_34_1,thisval);
}

on envVar P_FSG_41_0_0_34_1_22
{
	byte bitval;
	//thisval steht hier fuer den bitfield-wert, 
	//aus Generierungsgruenden hier keine einheitliche Bezeichnung moeglich.
	byte thisval[8]; // FctList
	bitval= getValue(this);
	getValue(P_FSG_41_0_0_34_1, thisval);
	thisval[2] = thisval[2]&~(1<<1)|(bitval<<1);
	putValue(P_FSG_41_0_0_34_1,thisval);
}

on envVar P_FSG_41_0_0_34_1_23
{
	byte bitval;
	//thisval steht hier fuer den bitfield-wert, 
	//aus Generierungsgruenden hier keine einheitliche Bezeichnung moeglich.
	byte thisval[8]; // FctList
	bitval= getValue(this);
	getValue(P_FSG_41_0_0_34_1, thisval);
	thisval[2] = thisval[2]&~(1<<0)|(bitval<<0);
	putValue(P_FSG_41_0_0_34_1,thisval);
}

on envVar P_FSG_41_0_0_34_1_24
{
	byte bitval;
	//thisval steht hier fuer den bitfield-wert, 
	//aus Generierungsgruenden hier keine einheitliche Bezeichnung moeglich.
	byte thisval[8]; // FctList
	bitval= getValue(this);
	getValue(P_FSG_41_0_0_34_1, thisval);
	thisval[3] = thisval[3]&~(1<<7)|(bitval<<7);
	putValue(P_FSG_41_0_0_34_1,thisval);
}

on envVar P_FSG_41_0_0_34_1_25
{
	byte bitval;
	//thisval steht hier fuer den bitfield-wert, 
	//aus Generierungsgruenden hier keine einheitliche Bezeichnung moeglich.
	byte thisval[8]; // FctList
	bitval= getValue(this);
	getValue(P_FSG_41_0_0_34_1, thisval);
	thisval[3] = thisval[3]&~(1<<6)|(bitval<<6);
	putValue(P_FSG_41_0_0_34_1,thisval);
}

on envVar P_FSG_41_0_0_34_1_26
{
	byte bitval;
	//thisval steht hier fuer den bitfield-wert, 
	//aus Generierungsgruenden hier keine einheitliche Bezeichnung moeglich.
	byte thisval[8]; // FctList
	bitval= getValue(this);
	getValue(P_FSG_41_0_0_34_1, thisval);
	thisval[3] = thisval[3]&~(1<<5)|(bitval<<5);
	putValue(P_FSG_41_0_0_34_1,thisval);
}

on envVar P_FSG_41_0_0_34_1_27
{
	byte bitval;
	//thisval steht hier fuer den bitfield-wert, 
	//aus Generierungsgruenden hier keine einheitliche Bezeichnung moeglich.
	byte thisval[8]; // FctList
	bitval= getValue(this);
	getValue(P_FSG_41_0_0_34_1, thisval);
	thisval[3] = thisval[3]&~(1<<4)|(bitval<<4);
	putValue(P_FSG_41_0_0_34_1,thisval);
}

on envVar P_FSG_41_0_0_34_1_28
{
	byte bitval;
	//thisval steht hier fuer den bitfield-wert, 
	//aus Generierungsgruenden hier keine einheitliche Bezeichnung moeglich.
	byte thisval[8]; // FctList
	bitval= getValue(this);
	getValue(P_FSG_41_0_0_34_1, thisval);
	thisval[3] = thisval[3]&~(1<<3)|(bitval<<3);
	putValue(P_FSG_41_0_0_34_1,thisval);
}

on envVar P_FSG_41_0_0_34_1_29
{
	byte bitval;
	//thisval steht hier fuer den bitfield-wert, 
	//aus Generierungsgruenden hier keine einheitliche Bezeichnung moeglich.
	byte thisval[8]; // FctList
	bitval= getValue(this);
	getValue(P_FSG_41_0_0_34_1, thisval);
	thisval[3] = thisval[3]&~(1<<2)|(bitval<<2);
	putValue(P_FSG_41_0_0_34_1,thisval);
}

on envVar P_FSG_41_0_0_34_1_30
{
	byte bitval;
	//thisval steht hier fuer den bitfield-wert, 
	//aus Generierungsgruenden hier keine einheitliche Bezeichnung moeglich.
	byte thisval[8]; // FctList
	bitval= getValue(this);
	getValue(P_FSG_41_0_0_34_1, thisval);
	thisval[3] = thisval[3]&~(1<<1)|(bitval<<1);
	putValue(P_FSG_41_0_0_34_1,thisval);
}

on envVar P_FSG_41_0_0_34_1_31
{
	byte bitval;
	//thisval steht hier fuer den bitfield-wert, 
	//aus Generierungsgruenden hier keine einheitliche Bezeichnung moeglich.
	byte thisval[8]; // FctList
	bitval= getValue(this);
	getValue(P_FSG_41_0_0_34_1, thisval);
	thisval[3] = thisval[3]&~(1<<0)|(bitval<<0);
	putValue(P_FSG_41_0_0_34_1,thisval);
}

on envVar P_FSG_41_0_0_34_1_32
{
	byte bitval;
	//thisval steht hier fuer den bitfield-wert, 
	//aus Generierungsgruenden hier keine einheitliche Bezeichnung moeglich.
	byte thisval[8]; // FctList
	bitval= getValue(this);
	getValue(P_FSG_41_0_0_34_1, thisval);
	thisval[4] = thisval[4]&~(1<<7)|(bitval<<7);
	putValue(P_FSG_41_0_0_34_1,thisval);
}

on envVar P_FSG_41_0_0_34_1_33
{
	byte bitval;
	//thisval steht hier fuer den bitfield-wert, 
	//aus Generierungsgruenden hier keine einheitliche Bezeichnung moeglich.
	byte thisval[8]; // FctList
	bitval= getValue(this);
	getValue(P_FSG_41_0_0_34_1, thisval);
	thisval[4] = thisval[4]&~(1<<6)|(bitval<<6);
	putValue(P_FSG_41_0_0_34_1,thisval);
}

on envVar P_FSG_41_0_0_34_1_34
{
	byte bitval;
	//thisval steht hier fuer den bitfield-wert, 
	//aus Generierungsgruenden hier keine einheitliche Bezeichnung moeglich.
	byte thisval[8]; // FctList
	bitval= getValue(this);
	getValue(P_FSG_41_0_0_34_1, thisval);
	thisval[4] = thisval[4]&~(1<<5)|(bitval<<5);
	putValue(P_FSG_41_0_0_34_1,thisval);
}

on envVar P_FSG_41_0_0_34_1_35
{
	byte bitval;
	//thisval steht hier fuer den bitfield-wert, 
	//aus Generierungsgruenden hier keine einheitliche Bezeichnung moeglich.
	byte thisval[8]; // FctList
	bitval= getValue(this);
	getValue(P_FSG_41_0_0_34_1, thisval);
	thisval[4] = thisval[4]&~(1<<4)|(bitval<<4);
	putValue(P_FSG_41_0_0_34_1,thisval);
}

on envVar P_FSG_41_0_0_34_1_36
{
	byte bitval;
	//thisval steht hier fuer den bitfield-wert, 
	//aus Generierungsgruenden hier keine einheitliche Bezeichnung moeglich.
	byte thisval[8]; // FctList
	bitval= getValue(this);
	getValue(P_FSG_41_0_0_34_1, thisval);
	thisval[4] = thisval[4]&~(1<<3)|(bitval<<3);
	putValue(P_FSG_41_0_0_34_1,thisval);
}

on envVar P_FSG_41_0_0_34_1_37
{
	byte bitval;
	//thisval steht hier fuer den bitfield-wert, 
	//aus Generierungsgruenden hier keine einheitliche Bezeichnung moeglich.
	byte thisval[8]; // FctList
	bitval= getValue(this);
	getValue(P_FSG_41_0_0_34_1, thisval);
	thisval[4] = thisval[4]&~(1<<2)|(bitval<<2);
	putValue(P_FSG_41_0_0_34_1,thisval);
}

on envVar P_FSG_41_0_0_34_1_38
{
	byte bitval;
	//thisval steht hier fuer den bitfield-wert, 
	//aus Generierungsgruenden hier keine einheitliche Bezeichnung moeglich.
	byte thisval[8]; // FctList
	bitval= getValue(this);
	getValue(P_FSG_41_0_0_34_1, thisval);
	thisval[4] = thisval[4]&~(1<<1)|(bitval<<1);
	putValue(P_FSG_41_0_0_34_1,thisval);
}

on envVar P_FSG_41_0_0_34_1_39
{
	byte bitval;
	//thisval steht hier fuer den bitfield-wert, 
	//aus Generierungsgruenden hier keine einheitliche Bezeichnung moeglich.
	byte thisval[8]; // FctList
	bitval= getValue(this);
	getValue(P_FSG_41_0_0_34_1, thisval);
	thisval[4] = thisval[4]&~(1<<0)|(bitval<<0);
	putValue(P_FSG_41_0_0_34_1,thisval);
}

on envVar P_FSG_41_0_0_34_1_40
{
	byte bitval;
	//thisval steht hier fuer den bitfield-wert, 
	//aus Generierungsgruenden hier keine einheitliche Bezeichnung moeglich.
	byte thisval[8]; // FctList
	bitval= getValue(this);
	getValue(P_FSG_41_0_0_34_1, thisval);
	thisval[5] = thisval[5]&~(1<<7)|(bitval<<7);
	putValue(P_FSG_41_0_0_34_1,thisval);
}

on envVar P_FSG_41_0_0_34_1_41
{
	byte bitval;
	//thisval steht hier fuer den bitfield-wert, 
	//aus Generierungsgruenden hier keine einheitliche Bezeichnung moeglich.
	byte thisval[8]; // FctList
	bitval= getValue(this);
	getValue(P_FSG_41_0_0_34_1, thisval);
	thisval[5] = thisval[5]&~(1<<6)|(bitval<<6);
	putValue(P_FSG_41_0_0_34_1,thisval);
}

on envVar P_FSG_41_0_0_34_1_42
{
	byte bitval;
	//thisval steht hier fuer den bitfield-wert, 
	//aus Generierungsgruenden hier keine einheitliche Bezeichnung moeglich.
	byte thisval[8]; // FctList
	bitval= getValue(this);
	getValue(P_FSG_41_0_0_34_1, thisval);
	thisval[5] = thisval[5]&~(1<<5)|(bitval<<5);
	putValue(P_FSG_41_0_0_34_1,thisval);
}

on envVar P_FSG_41_0_0_34_1_43
{
	byte bitval;
	//thisval steht hier fuer den bitfield-wert, 
	//aus Generierungsgruenden hier keine einheitliche Bezeichnung moeglich.
	byte thisval[8]; // FctList
	bitval= getValue(this);
	getValue(P_FSG_41_0_0_34_1, thisval);
	thisval[5] = thisval[5]&~(1<<4)|(bitval<<4);
	putValue(P_FSG_41_0_0_34_1,thisval);
}

on envVar P_FSG_41_0_0_34_1_44
{
	byte bitval;
	//thisval steht hier fuer den bitfield-wert, 
	//aus Generierungsgruenden hier keine einheitliche Bezeichnung moeglich.
	byte thisval[8]; // FctList
	bitval= getValue(this);
	getValue(P_FSG_41_0_0_34_1, thisval);
	thisval[5] = thisval[5]&~(1<<3)|(bitval<<3);
	putValue(P_FSG_41_0_0_34_1,thisval);
}

on envVar P_FSG_41_0_0_34_1_45
{
	byte bitval;
	//thisval steht hier fuer den bitfield-wert, 
	//aus Generierungsgruenden hier keine einheitliche Bezeichnung moeglich.
	byte thisval[8]; // FctList
	bitval= getValue(this);
	getValue(P_FSG_41_0_0_34_1, thisval);
	thisval[5] = thisval[5]&~(1<<2)|(bitval<<2);
	putValue(P_FSG_41_0_0_34_1,thisval);
}

on envVar P_FSG_41_0_0_34_1_46
{
	byte bitval;
	//thisval steht hier fuer den bitfield-wert, 
	//aus Generierungsgruenden hier keine einheitliche Bezeichnung moeglich.
	byte thisval[8]; // FctList
	bitval= getValue(this);
	getValue(P_FSG_41_0_0_34_1, thisval);
	thisval[5] = thisval[5]&~(1<<1)|(bitval<<1);
	putValue(P_FSG_41_0_0_34_1,thisval);
}

on envVar P_FSG_41_0_0_34_1_47
{
	byte bitval;
	//thisval steht hier fuer den bitfield-wert, 
	//aus Generierungsgruenden hier keine einheitliche Bezeichnung moeglich.
	byte thisval[8]; // FctList
	bitval= getValue(this);
	getValue(P_FSG_41_0_0_34_1, thisval);
	thisval[5] = thisval[5]&~(1<<0)|(bitval<<0);
	putValue(P_FSG_41_0_0_34_1,thisval);
}

on envVar P_FSG_41_0_0_34_1_48
{
	byte bitval;
	//thisval steht hier fuer den bitfield-wert, 
	//aus Generierungsgruenden hier keine einheitliche Bezeichnung moeglich.
	byte thisval[8]; // FctList
	bitval= getValue(this);
	getValue(P_FSG_41_0_0_34_1, thisval);
	thisval[6] = thisval[6]&~(1<<7)|(bitval<<7);
	putValue(P_FSG_41_0_0_34_1,thisval);
}

on envVar P_FSG_41_0_0_34_1_49
{
	byte bitval;
	//thisval steht hier fuer den bitfield-wert, 
	//aus Generierungsgruenden hier keine einheitliche Bezeichnung moeglich.
	byte thisval[8]; // FctList
	bitval= getValue(this);
	getValue(P_FSG_41_0_0_34_1, thisval);
	thisval[6] = thisval[6]&~(1<<6)|(bitval<<6);
	putValue(P_FSG_41_0_0_34_1,thisval);
}

on envVar P_FSG_41_0_0_34_1_50
{
	byte bitval;
	//thisval steht hier fuer den bitfield-wert, 
	//aus Generierungsgruenden hier keine einheitliche Bezeichnung moeglich.
	byte thisval[8]; // FctList
	bitval= getValue(this);
	getValue(P_FSG_41_0_0_34_1, thisval);
	thisval[6] = thisval[6]&~(1<<5)|(bitval<<5);
	putValue(P_FSG_41_0_0_34_1,thisval);
}

on envVar P_FSG_41_0_0_34_1 // MobileServiceSupport3.FctList
{
	P_FSG_41_0_0_34_BuildFct();
}

// Ruecksetzen des Fehlerstatus durch manuelle Fehlereingabe
on envVar P_FSG_41_0_0_35_ErrCode
{
       if(gP_FSG_41_0_0_35_ErrCode) 
       {
           setControlBackColor(panel_name,"errfield_P_FSG_41_0_0_35", MakeRGB(255,255,255));
       }
       gP_FSG_41_0_0_35_ErrCode = 1;
}
on envVar P_FSG_41_0_0_35Status_BTN
{
	byte BAPTemp[50];
    if (P_FSG_41_0_0_35Status_BTN_already_pressed == 0)
    {
        putValue(P_FSG_41_0_0_35_ErrCode,0);
        SetControlBackColor(panel_name,"errField_P_FSG_41_0_0_35",MakeRGB(255,255,255));
        P_FSG_41_0_0_35Status_BTN_already_pressed = 1;
    }
    else
    {
		P_FSG_41_0_0_35_BuildFct();
        getValue(P_FSG_41_0_0_35, BAPTemp);
        Request_ByteSequence(LSGID, P_FSG_41_0_0_35_ID, Data_REQ, BAPTemp, getValueSize(P_FSG_41_0_0_35));
        if(getValue(P_FSG_41_0_0_35_IntTlgEn)) //getValue(IT))
        {
           intertelegram_err(P_FSG_41_0_0_35_ID);
        }
        if(getValue(P_FSG_41_0_0_35_SegmEn))   //getvalue(SG)
        {
           sequence_err(P_FSG_41_0_0_35_ID,elCount(BAPTemp));
        }
       P_FSG_41_0_0_35Status_BTN_already_pressed = 0;
    }
}
on envVar P_FSG_41_0_0_35_FctEn
{
    long data[3];
    data[0]=LSGID;
    data[1]=P_FSG_41_0_0_35_ID;
    data[2]=getValue(P_FSG_41_0_0_35_FctEn);
    ChangeConfig(0x0031,data);
}
// De-Aktivierung der Eingabefelder der FCTID P_FSG_41_0_0_35
on envVar P_FSG_41_0_0_35_FctLstItemEn
{
       if(getValue(this)) 
       {
           EnableControl(panel_name,"panel_FSG_41_0_0_35",1);
           EnableControl(panel_name,"errfield_P_FSG_41_0_0_35",1);
           EnableControl(panel_name,"panel_P_FSG_41_0_0_35",1);
           setControlForeColor(panel_name, "checkbox_P_FSG_41_0_0_35", MakeRGB(0,240,0));
       }
       else
       {
           EnableControl(panel_name,"panel_FSG_41_0_0_35",0);
           EnableControl(panel_name,"errfield_P_FSG_41_0_0_35",0);
           EnableControl(panel_name,"panel_P_FSG_41_0_0_35",0);
           setControlForeColor(panel_name, "checkbox_P_FSG_41_0_0_35", MakeRGB(250,0,0));
       }
}
// Man darf gleichzeitig nur Checkbox fuer SegmError oder IntertelegramError aktiviert werden
on envVar P_FSG_41_0_0_35_IntTlgEn
{
       if(getValue(this)) 
       {
           putValue(P_FSG_41_0_0_35_SegmEn,0);
           intertelegram_err(P_FSG_41_0_0_35_ID);
       }
       else
       {
           intertelegram_err_off(P_FSG_41_0_0_35_ID);
       }
}
// Man darf gleichzeitig nur Checkbox fuer SegmError oder IntertelegramError aktiviert werden
on envVar P_FSG_41_0_0_35_SegmEn
{
       if(getValue(this)) 
       {
           putValue(P_FSG_41_0_0_35_IntTlgEn,0);
           sequence_err(P_FSG_41_0_0_35_ID,getValueSize(P_FSG_41_0_0_35_SegmEn));
       }
       else
       {
              sequence_err_off(P_FSG_41_0_0_35_ID);
       }
}
on envVar P_FSG_41_0_0_35 // bus value of ActiveUser3 (35).
{
	// opcodes: Error-Status
	byte param1[50]; // UserName
	word len1;
	byte cnt1;
	// DATATYPE_BYTESEQUENCE / DATATYPE_FIXEDBYTESEQUENCE
	int i;
	byte superval[50];
	int currentPos;
	currentPos = 0;
	for( i = 0; i < 50; i++ ) {
		superval[i] = 0;
	}
	getValue(P_FSG_41_0_0_35, superval);
	///////// Start param1 - STRING /////////
	getValue(P_FSG_41_0_0_35_1_Hex, param1);
	if((superval[currentPos] & 0x80) > 0)
	{
		if(49>127) /* Max Fct-Katalog Laenge: 49*/
		{
			len1 = ( (superval[currentPos]&0x7F) <<8) + superval[currentPos+1];
			currentPos = currentPos + 2;
			cnt1 = 1;
		}
		else
		{
			len1 = 49;
			writelineEx(gBAP_Trace, 0, "Anzahl der Laengeninformation-Bytes in P_FSG_41_0_0_35 ueberschreitet die erlaubte 1 Byte vom Fct-Kalatog.");
		}
	}
	else
	{
		len1 = superval[currentPos]&0x7F;
		currentPos = currentPos + 1;
		cnt1 = 0;
	}
	
	if(len1 > 49)
	{
		writelineEx(gBAP_Trace, 0, "Laenge:%d bei der Byte Position:%d ueberschreitet die Maximale erlaubte Laenge von Fct-Kalatog", len1, currentPos);
		len1 = 49;
	
		if(len1 < 128) cnt1 = 0;
		else cnt1 = 1;
	}
	
	for(i = 0; i < len1; i++)
	{
		param1[i] = superval[currentPos++];
	}
	
	putValue(P_FSG_41_0_0_35_1_len, len1);
	putValue(P_FSG_41_0_0_35_1_cnt, cnt1);
	
	if(len1 > getValueSize(P_FSG_41_0_0_35_1_Hex))
		putValue(P_FSG_41_0_0_35_1_Hex, param1, len1);
	else
		putValue(P_FSG_41_0_0_35_1_Hex, param1, getValueSize(P_FSG_41_0_0_35_1_Hex));

}

// Updates the bus value field and other dependencies.
P_FSG_41_0_0_35_BuildFct()
{
	byte param1[50]; // UserName
	word len1;
	byte cnt1;

	int i;
	byte superval[50];
	int currentPos;
	currentPos = 0;
// gen_BuildFunc_SetSuperVals 
	getValue(P_FSG_41_0_0_35_1_Hex, param1);
	len1 = getValue(P_FSG_41_0_0_35_1_len);
	cnt1= getValue(P_FSG_41_0_0_35_1_cnt);
	
	/* check box aktiviert*/
	if (cnt1 == 1)
	{
		/* 0 bis 49 (MaxString - 1B oder 2B) */
		if(len1 >= 0 && len1 <= 49)
		{
			//writelineEx(gBAP_Trace, 0, "[Debug-1] Len1: %d", len1);
			superval[currentPos] = (len1&0x7f00) | 0x80;
			superval[currentPos+1] = len1 & 0x00ff;
		}
		else
		{
			writelineEx(gBAP_Trace, 0, "Eingegebene Laenge: %d von P_FSG_41_0_0_35_1 ist ungueltig. Die max. erlaubte Laenge ist %d.", len1, 49);
			return;
		}
	}
	else if(cnt1 == 0) /*check box deaktiviert*/
	{
		if(len1 >= 0 && len1 <= 127)
		{
			//writelineEx(gBAP_Trace, 0, "[Debug-1] Len1: %d", len1);
			superval[currentPos]= len1 & 0x00ff;
			putValue(P_FSG_41_0_0_35_1_len, len1);
		}
		else if(len1 > 127 && len1 <= 49)
		{
			superval[currentPos] = (len1&0x7f00) | 0x80;
			superval[currentPos+1] = len1 & 0x00ff;
			putValue(P_FSG_41_0_0_35_1_len, len1);
			putValue(P_FSG_41_0_0_35_1_cnt, 1);
		}
		else
		{
			writelineEx(gBAP_Trace, 0, "Eingegebene Laenge: %d von P_FSG_41_0_0_35_1 ist ungueltig. Die max. erlaubte Laenge ist %d.", len1, 49);
			return;
		}
	}
	currentPos += cnt1+1;
	for(i = 0; i < len1; i++)
	{
		superval[currentPos++]= param1[i];
	}

	putValue(P_FSG_41_0_0_35, superval, currentPos);
}



// Ueberwachung der CheckBox fuer String
on envVar  P_FSG_41_0_0_35_1_cnt
{
	word len;
	byte cnt;
	len = getValue(P_FSG_41_0_0_35_1_len);
	cnt = getValue(P_FSG_41_0_0_35_1_cnt);

	/* wird nur gerufen, wenn check box deaktiviert mit Length>127*/ 
	if( cnt == 0) 
	{
		if(len > 127 )
		{
			putValue(P_FSG_41_0_0_35_1_len, 127);
		}
	}

	P_FSG_41_0_0_35_BuildFct();
}



// Ueberwachung der Eingabefeld fuer String Data
on envVar P_FSG_41_0_0_35_1_len
{
	word len;
	len = getValue(this);
	/* Validierung der Eingabe*/
	if(len > 49)
	{
		writelineEx(gBAP_Trace, 0, "Eingegebene Laenge: %d von P_FSG_41_0_0_35_1 ist ungueltig. Die max. erlaubte Laenge ist %d. ", len, 49);
		putValue(this, 49);
	}
	P_FSG_41_0_0_35_BuildFct();
}


on envVar P_FSG_41_0_0_35_1 // ActiveUser3.UserName
{
	int j, offset;
  int temp;
  int string_length_org;
  int string_length_mod;
  byte string_buffer_org[255];
  byte string_buffer_mod[255];
  
  //Start-Länge
  string_length_org = getValueSize(this);
  string_length_mod = string_length_org;
  
  //Start-String in Buffer
  getvalue(this,string_buffer_org);
  
  //Buffer auf Sonderzeichen checken und ersetzen
  offset = 0;
  for (j=0;j<string_length_org;j++)
  {
    if ( string_buffer_org[j] >= 0x80 && string_buffer_org[j] <= 0xBF ) 
    {
      temp = string_buffer_org[j] + 0xC200;
      
      string_buffer_mod[j+offset] = temp>>8;
      string_buffer_mod[j+offset+1] = temp;
      offset++;
      string_length_mod++;
    }
    else if ( string_buffer_org[j] >= 0xC0 && string_buffer_org[j] <= 0xFF ) 
    {
      temp = string_buffer_org[j] + 0xC2C0;
      
      string_buffer_mod[j+offset] = temp>>8;
      string_buffer_mod[j+offset+1] = temp;
      offset++;
      string_length_mod++;
    }
    else
      string_buffer_mod[j+offset] = string_buffer_org[j];
  }
    
  //neuen String schreiben
  putvalue(P_FSG_41_0_0_35_1_Hex,string_buffer_mod,string_length_mod);
  putValue(P_FSG_41_0_0_35_1_len, string_length_mod);
}

// Ruecksetzen des Fehlerstatus durch manuelle Fehlereingabe
on envVar P_FSG_41_0_0_36_ErrCode
{
       if(gP_FSG_41_0_0_36_ErrCode) 
       {
           setControlBackColor(panel_name,"errfield_P_FSG_41_0_0_36", MakeRGB(255,255,255));
       }
       gP_FSG_41_0_0_36_ErrCode = 1;
}
on envVar P_FSG_41_0_0_36Status_BTN
{
	byte BAPTemp[3];
   if (P_FSG_41_0_0_36Status_BTN_already_pressed == 0)
   {
      putValue(P_FSG_41_0_0_36_ErrCode,0);
      SetControlBackColor(panel_name,"errField_P_FSG_41_0_0_36",MakeRGB(255,255,255));
      P_FSG_41_0_0_36Status_BTN_already_pressed = 1;
   }
   else
   {
      getValue(P_FSG_41_0_0_36, BAPTemp);
      Request_ByteSequence(LSGID, P_FSG_41_0_0_36_ID, Data_REQ, BAPTemp, getValueSize(P_FSG_41_0_0_36));
      P_FSG_41_0_0_36Status_BTN_already_pressed = 0;
   }
}
on envVar P_FSG_41_0_0_36_FctEn
{
    long data[3];
    data[0]=LSGID;
    data[1]=P_FSG_41_0_0_36_ID;
    data[2]=getValue(P_FSG_41_0_0_36_FctEn);
    ChangeConfig(0x0031,data);
}
// De-Aktivierung der Eingabefelder der FCTID P_FSG_41_0_0_36
on envVar P_FSG_41_0_0_36_FctLstItemEn
{
       if(getValue(this)) 
       {
           EnableControl(panel_name,"panel_FSG_41_0_0_36",1);
           EnableControl(panel_name,"errfield_P_FSG_41_0_0_36",1);
           EnableControl(panel_name,"panel_P_FSG_41_0_0_36",1);
           setControlForeColor(panel_name, "checkbox_P_FSG_41_0_0_36", MakeRGB(0,240,0));
       }
       else
       {
           EnableControl(panel_name,"panel_FSG_41_0_0_36",0);
           EnableControl(panel_name,"errfield_P_FSG_41_0_0_36",0);
           EnableControl(panel_name,"panel_P_FSG_41_0_0_36",0);
           setControlForeColor(panel_name, "checkbox_P_FSG_41_0_0_36", MakeRGB(250,0,0));
       }
}
on envVar P_FSG_41_0_0_36 // bus value of TelState3 (36).
{
	// opcodes: Error-Status
	byte param1; // Tel_State
	byte param2; // Extension_1
	byte param3; // Extension_2
	// DATATYPE_BYTESEQUENCE / DATATYPE_FIXEDBYTESEQUENCE
	int i;
	byte superval[3];
	int currentPos;
	currentPos = 0;
	for( i = 0; i < 3; i++ ) {
		superval[i] = 0;
	}
	getValue(P_FSG_41_0_0_36, superval);
	///////// Start param1 - UINT8 /////////
	param1 = superval[currentPos++];
	putValue(P_FSG_41_0_0_36_1, param1);
	///////// Start param2 - UINT8 /////////
	param2 = superval[currentPos++];
	putValue(P_FSG_41_0_0_36_2, round((param2 * 1.0) - (0) + (0), 1.0));
	///////// Start param3 - UINT8 /////////
	param3 = superval[currentPos++];
	putValue(P_FSG_41_0_0_36_3, round((param3 * 1.0) - (0) + (0), 1.0));
}

on envVar P_FSG_41_0_0_36_1 // TelState3.Tel_State
{
	byte superval[3];

	//Update Childvalue (Enum)
	byte thisval; // Tel_State
	thisval = getValue(this);

    // Update superval
	getValue(P_FSG_41_0_0_36, superval);
	superval[0]=thisval;
	putValue(P_FSG_41_0_0_36,superval);
}

// Ueberwachung der Darstellungsvariable der Range.
on envVar P_FSG_41_0_0_36_2_range // TelState3.Extension_1 
{
	@P_FSG_41_0_0_36_2 = @P_FSG_41_0_0_36_2_range - (0); // slider = range - min
}

on envVar P_FSG_41_0_0_36_2 // TelState3.Extension_1
{
	byte superval[3];

	//Update Childvalue (Number)
	byte thisval; // Extension_1
	float slider_value;

	slider_value = 0; // Konstanter Parameter.
	@P_FSG_41_0_0_36_2_range = slider_value + (0); // real value := slider value + range min.
	thisval = (byte)round((slider_value + (0) - (0)) / (1.0), 1); // bus value := (slider value + min - offset) / step.

    // Update superval
	getValue(P_FSG_41_0_0_36, superval);
	superval[1]=thisval;
	putValue(P_FSG_41_0_0_36,superval);
}

// Ueberwachung der Darstellungsvariable der Range.
on envVar P_FSG_41_0_0_36_3_range // TelState3.Extension_2 
{
	@P_FSG_41_0_0_36_3 = @P_FSG_41_0_0_36_3_range - (0); // slider = range - min
}

on envVar P_FSG_41_0_0_36_3 // TelState3.Extension_2
{
	byte superval[3];

	//Update Childvalue (Number)
	byte thisval; // Extension_2
	float slider_value;

	slider_value = 0; // Konstanter Parameter.
	@P_FSG_41_0_0_36_3_range = slider_value + (0); // real value := slider value + range min.
	thisval = (byte)round((slider_value + (0) - (0)) / (1.0), 1); // bus value := (slider value + min - offset) / step.

    // Update superval
	getValue(P_FSG_41_0_0_36, superval);
	superval[2]=thisval;
	putValue(P_FSG_41_0_0_36,superval);
}

// Ruecksetzen des Fehlerstatus durch manuelle Fehlereingabe
on envVar P_FSG_41_0_0_37_ErrCode
{
       if(gP_FSG_41_0_0_37_ErrCode) 
       {
           setControlBackColor(panel_name,"errfield_P_FSG_41_0_0_37", MakeRGB(255,255,255));
       }
       gP_FSG_41_0_0_37_ErrCode = 1;
}
on envVar P_FSG_41_0_0_37Status_BTN
{
	byte BAPTemp[5];
   if (P_FSG_41_0_0_37Status_BTN_already_pressed == 0)
   {
      putValue(P_FSG_41_0_0_37_ErrCode,0);
      SetControlBackColor(panel_name,"errField_P_FSG_41_0_0_37",MakeRGB(255,255,255));
      P_FSG_41_0_0_37Status_BTN_already_pressed = 1;
   }
   else
   {
      getValue(P_FSG_41_0_0_37, BAPTemp);
      Request_ByteSequence(LSGID, P_FSG_41_0_0_37_ID, Data_REQ, BAPTemp, getValueSize(P_FSG_41_0_0_37));
      P_FSG_41_0_0_37Status_BTN_already_pressed = 0;
   }
}
on envVar P_FSG_41_0_0_37_FctEn
{
    long data[3];
    data[0]=LSGID;
    data[1]=P_FSG_41_0_0_37_ID;
    data[2]=getValue(P_FSG_41_0_0_37_FctEn);
    ChangeConfig(0x0031,data);
}
// De-Aktivierung der Eingabefelder der FCTID P_FSG_41_0_0_37
on envVar P_FSG_41_0_0_37_FctLstItemEn
{
       if(getValue(this)) 
       {
           EnableControl(panel_name,"panel_FSG_41_0_0_37",1);
           EnableControl(panel_name,"errfield_P_FSG_41_0_0_37",1);
           EnableControl(panel_name,"panel_P_FSG_41_0_0_37",1);
           setControlForeColor(panel_name, "checkbox_P_FSG_41_0_0_37", MakeRGB(0,240,0));
       }
       else
       {
           EnableControl(panel_name,"panel_FSG_41_0_0_37",0);
           EnableControl(panel_name,"errfield_P_FSG_41_0_0_37",0);
           EnableControl(panel_name,"panel_P_FSG_41_0_0_37",0);
           setControlForeColor(panel_name, "checkbox_P_FSG_41_0_0_37", MakeRGB(250,0,0));
       }
}
on envVar P_FSG_41_0_0_37 // bus value of RegisterState3 (37).
{
	// opcodes: Error-Status
	byte param1; // RegisterState
	byte param2; // NetworkType
	byte param3; // PacketDataNetworkType
	byte param4; // Extension_1
	byte param5; // Extension_2
	// DATATYPE_BYTESEQUENCE / DATATYPE_FIXEDBYTESEQUENCE
	int i;
	byte superval[5];
	int currentPos;
	currentPos = 0;
	for( i = 0; i < 5; i++ ) {
		superval[i] = 0;
	}
	getValue(P_FSG_41_0_0_37, superval);
	///////// Start param1 - UINT8 /////////
	param1 = superval[currentPos++];
	putValue(P_FSG_41_0_0_37_1, param1);
	///////// Start param2 - UINT8 /////////
	param2 = superval[currentPos++];
	putValue(P_FSG_41_0_0_37_2, param2);
	///////// Start param3 - UINT8 /////////
	param3 = superval[currentPos++];
	putValue(P_FSG_41_0_0_37_3, param3);
	///////// Start param4 - UINT8 /////////
	param4 = superval[currentPos++];
	putValue(P_FSG_41_0_0_37_4, round((param4 * 1.0) - (0) + (0), 1.0));
	///////// Start param5 - UINT8 /////////
	param5 = superval[currentPos++];
	putValue(P_FSG_41_0_0_37_5, round((param5 * 1.0) - (0) + (0), 1.0));
}

on envVar P_FSG_41_0_0_37_1 // RegisterState3.RegisterState
{
	byte superval[5];

	//Update Childvalue (Enum)
	byte thisval; // RegisterState
	thisval = getValue(this);

    // Update superval
	getValue(P_FSG_41_0_0_37, superval);
	superval[0]=thisval;
	putValue(P_FSG_41_0_0_37,superval);
}

on envVar P_FSG_41_0_0_37_2 // RegisterState3.NetworkType
{
	byte superval[5];

	//Update Childvalue (Enum)
	byte thisval; // NetworkType
	thisval = getValue(this);

    // Update superval
	getValue(P_FSG_41_0_0_37, superval);
	superval[1]=thisval;
	putValue(P_FSG_41_0_0_37,superval);
}

on envVar P_FSG_41_0_0_37_3 // RegisterState3.PacketDataNetworkType
{
	byte superval[5];

	//Update Childvalue (Enum)
	byte thisval; // PacketDataNetworkType
	thisval = getValue(this);

    // Update superval
	getValue(P_FSG_41_0_0_37, superval);
	superval[2]=thisval;
	putValue(P_FSG_41_0_0_37,superval);
}

// Ueberwachung der Darstellungsvariable der Range.
on envVar P_FSG_41_0_0_37_4_range // RegisterState3.Extension_1 
{
	@P_FSG_41_0_0_37_4 = @P_FSG_41_0_0_37_4_range - (0); // slider = range - min
}

on envVar P_FSG_41_0_0_37_4 // RegisterState3.Extension_1
{
	byte superval[5];

	//Update Childvalue (Number)
	byte thisval; // Extension_1
	float slider_value;

	slider_value = 0; // Konstanter Parameter.
	@P_FSG_41_0_0_37_4_range = slider_value + (0); // real value := slider value + range min.
	thisval = (byte)round((slider_value + (0) - (0)) / (1.0), 1); // bus value := (slider value + min - offset) / step.

    // Update superval
	getValue(P_FSG_41_0_0_37, superval);
	superval[3]=thisval;
	putValue(P_FSG_41_0_0_37,superval);
}

// Ueberwachung der Darstellungsvariable der Range.
on envVar P_FSG_41_0_0_37_5_range // RegisterState3.Extension_2 
{
	@P_FSG_41_0_0_37_5 = @P_FSG_41_0_0_37_5_range - (0); // slider = range - min
}

on envVar P_FSG_41_0_0_37_5 // RegisterState3.Extension_2
{
	byte superval[5];

	//Update Childvalue (Number)
	byte thisval; // Extension_2
	float slider_value;

	slider_value = 0; // Konstanter Parameter.
	@P_FSG_41_0_0_37_5_range = slider_value + (0); // real value := slider value + range min.
	thisval = (byte)round((slider_value + (0) - (0)) / (1.0), 1); // bus value := (slider value + min - offset) / step.

    // Update superval
	getValue(P_FSG_41_0_0_37, superval);
	superval[4]=thisval;
	putValue(P_FSG_41_0_0_37,superval);
}

// Ruecksetzen des Fehlerstatus durch manuelle Fehlereingabe
on envVar P_FSG_41_0_0_38_ErrCode
{
       if(gP_FSG_41_0_0_38_ErrCode) 
       {
           setControlBackColor(panel_name,"errfield_P_FSG_41_0_0_38", MakeRGB(255,255,255));
       }
       gP_FSG_41_0_0_38_ErrCode = 1;
}
on envVar P_FSG_41_0_0_38Status_BTN
{
	byte BAPTemp[3];
   if (P_FSG_41_0_0_38Status_BTN_already_pressed == 0)
   {
      putValue(P_FSG_41_0_0_38_ErrCode,0);
      SetControlBackColor(panel_name,"errField_P_FSG_41_0_0_38",MakeRGB(255,255,255));
      P_FSG_41_0_0_38Status_BTN_already_pressed = 1;
   }
   else
   {
      getValue(P_FSG_41_0_0_38, BAPTemp);
      Request_ByteSequence(LSGID, P_FSG_41_0_0_38_ID, Data_REQ, BAPTemp, getValueSize(P_FSG_41_0_0_38));
      P_FSG_41_0_0_38Status_BTN_already_pressed = 0;
   }
}
on envVar P_FSG_41_0_0_38_FctEn
{
    long data[3];
    data[0]=LSGID;
    data[1]=P_FSG_41_0_0_38_ID;
    data[2]=getValue(P_FSG_41_0_0_38_FctEn);
    ChangeConfig(0x0031,data);
}
// De-Aktivierung der Eingabefelder der FCTID P_FSG_41_0_0_38
on envVar P_FSG_41_0_0_38_FctLstItemEn
{
       if(getValue(this)) 
       {
           EnableControl(panel_name,"panel_FSG_41_0_0_38",1);
           EnableControl(panel_name,"errfield_P_FSG_41_0_0_38",1);
           EnableControl(panel_name,"panel_P_FSG_41_0_0_38",1);
           setControlForeColor(panel_name, "checkbox_P_FSG_41_0_0_38", MakeRGB(0,240,0));
       }
       else
       {
           EnableControl(panel_name,"panel_FSG_41_0_0_38",0);
           EnableControl(panel_name,"errfield_P_FSG_41_0_0_38",0);
           EnableControl(panel_name,"panel_P_FSG_41_0_0_38",0);
           setControlForeColor(panel_name, "checkbox_P_FSG_41_0_0_38", MakeRGB(250,0,0));
       }
}
on envVar P_FSG_41_0_0_38 // bus value of LockState3 (38).
{
	// opcodes: Error-Status
	byte param1; // LockState
	byte param2; // Extension_1
	byte param3; // Extension_2
	// DATATYPE_BYTESEQUENCE / DATATYPE_FIXEDBYTESEQUENCE
	int i;
	byte superval[3];
	int currentPos;
	currentPos = 0;
	for( i = 0; i < 3; i++ ) {
		superval[i] = 0;
	}
	getValue(P_FSG_41_0_0_38, superval);
	///////// Start param1 - UINT8 /////////
	param1 = superval[currentPos++];
	putValue(P_FSG_41_0_0_38_1, param1);
	///////// Start param2 - UINT8 /////////
	param2 = superval[currentPos++];
	putValue(P_FSG_41_0_0_38_2, round((param2 * 1.0) - (0) + (0), 1.0));
	///////// Start param3 - UINT8 /////////
	param3 = superval[currentPos++];
	putValue(P_FSG_41_0_0_38_3, round((param3 * 1.0) - (0) + (0), 1.0));
}

on envVar P_FSG_41_0_0_38_1 // LockState3.LockState
{
	byte superval[3];

	//Update Childvalue (Enum)
	byte thisval; // LockState
	thisval = getValue(this);

    // Update superval
	getValue(P_FSG_41_0_0_38, superval);
	superval[0]=thisval;
	putValue(P_FSG_41_0_0_38,superval);
}

// Ueberwachung der Darstellungsvariable der Range.
on envVar P_FSG_41_0_0_38_2_range // LockState3.Extension_1 
{
	@P_FSG_41_0_0_38_2 = @P_FSG_41_0_0_38_2_range - (0); // slider = range - min
}

on envVar P_FSG_41_0_0_38_2 // LockState3.Extension_1
{
	byte superval[3];

	//Update Childvalue (Number)
	byte thisval; // Extension_1
	float slider_value;

	slider_value = 0; // Konstanter Parameter.
	@P_FSG_41_0_0_38_2_range = slider_value + (0); // real value := slider value + range min.
	thisval = (byte)round((slider_value + (0) - (0)) / (1.0), 1); // bus value := (slider value + min - offset) / step.

    // Update superval
	getValue(P_FSG_41_0_0_38, superval);
	superval[1]=thisval;
	putValue(P_FSG_41_0_0_38,superval);
}

// Ueberwachung der Darstellungsvariable der Range.
on envVar P_FSG_41_0_0_38_3_range // LockState3.Extension_2 
{
	@P_FSG_41_0_0_38_3 = @P_FSG_41_0_0_38_3_range - (0); // slider = range - min
}

on envVar P_FSG_41_0_0_38_3 // LockState3.Extension_2
{
	byte superval[3];

	//Update Childvalue (Number)
	byte thisval; // Extension_2
	float slider_value;

	slider_value = 0; // Konstanter Parameter.
	@P_FSG_41_0_0_38_3_range = slider_value + (0); // real value := slider value + range min.
	thisval = (byte)round((slider_value + (0) - (0)) / (1.0), 1); // bus value := (slider value + min - offset) / step.

    // Update superval
	getValue(P_FSG_41_0_0_38, superval);
	superval[2]=thisval;
	putValue(P_FSG_41_0_0_38,superval);
}

// Ruecksetzen des Fehlerstatus durch manuelle Fehlereingabe
on envVar P_FSG_41_0_0_39_ErrCode
{
       if(gP_FSG_41_0_0_39_ErrCode) 
       {
           setControlBackColor(panel_name,"errfield_P_FSG_41_0_0_39", MakeRGB(255,255,255));
       }
       gP_FSG_41_0_0_39_ErrCode = 1;
}
on envVar P_FSG_41_0_0_39Status_BTN
{
	byte BAPTemp[82];
    if (P_FSG_41_0_0_39Status_BTN_already_pressed == 0)
    {
        putValue(P_FSG_41_0_0_39_ErrCode,0);
        SetControlBackColor(panel_name,"errField_P_FSG_41_0_0_39",MakeRGB(255,255,255));
        P_FSG_41_0_0_39Status_BTN_already_pressed = 1;
    }
    else
    {
		P_FSG_41_0_0_39_BuildFct();
        getValue(P_FSG_41_0_0_39, BAPTemp);
        Request_ByteSequence(LSGID, P_FSG_41_0_0_39_ID, Data_REQ, BAPTemp, getValueSize(P_FSG_41_0_0_39));
        if(getValue(P_FSG_41_0_0_39_IntTlgEn)) //getValue(IT))
        {
           intertelegram_err(P_FSG_41_0_0_39_ID);
        }
        if(getValue(P_FSG_41_0_0_39_SegmEn))   //getvalue(SG)
        {
           sequence_err(P_FSG_41_0_0_39_ID,elCount(BAPTemp));
        }
       P_FSG_41_0_0_39Status_BTN_already_pressed = 0;
    }
}
on envVar P_FSG_41_0_0_39_FctEn
{
    long data[3];
    data[0]=LSGID;
    data[1]=P_FSG_41_0_0_39_ID;
    data[2]=getValue(P_FSG_41_0_0_39_FctEn);
    ChangeConfig(0x0031,data);
}
// De-Aktivierung der Eingabefelder der FCTID P_FSG_41_0_0_39
on envVar P_FSG_41_0_0_39_FctLstItemEn
{
       if(getValue(this)) 
       {
           EnableControl(panel_name,"panel_FSG_41_0_0_39",1);
           EnableControl(panel_name,"errfield_P_FSG_41_0_0_39",1);
           EnableControl(panel_name,"panel_P_FSG_41_0_0_39",1);
           setControlForeColor(panel_name, "checkbox_P_FSG_41_0_0_39", MakeRGB(0,240,0));
       }
       else
       {
           EnableControl(panel_name,"panel_FSG_41_0_0_39",0);
           EnableControl(panel_name,"errfield_P_FSG_41_0_0_39",0);
           EnableControl(panel_name,"panel_P_FSG_41_0_0_39",0);
           setControlForeColor(panel_name, "checkbox_P_FSG_41_0_0_39", MakeRGB(250,0,0));
       }
}
// Man darf gleichzeitig nur Checkbox fuer SegmError oder IntertelegramError aktiviert werden
on envVar P_FSG_41_0_0_39_IntTlgEn
{
       if(getValue(this)) 
       {
           putValue(P_FSG_41_0_0_39_SegmEn,0);
           intertelegram_err(P_FSG_41_0_0_39_ID);
       }
       else
       {
           intertelegram_err_off(P_FSG_41_0_0_39_ID);
       }
}
// Man darf gleichzeitig nur Checkbox fuer SegmError oder IntertelegramError aktiviert werden
on envVar P_FSG_41_0_0_39_SegmEn
{
       if(getValue(this)) 
       {
           putValue(P_FSG_41_0_0_39_IntTlgEn,0);
           sequence_err(P_FSG_41_0_0_39_ID,getValueSize(P_FSG_41_0_0_39_SegmEn));
       }
       else
       {
              sequence_err_off(P_FSG_41_0_0_39_ID);
       }
}
on envVar P_FSG_41_0_0_39 // bus value of NetworkProvider3 (39).
{
	// opcodes: Error-Status
	byte param1; // NetworkProviderState
	byte param2[40]; // NetworkProviderName
	word len2;
	byte cnt2;
	byte param3; // ServiceProviderState
	byte param4[40]; // ServiceProviderName
	word len4;
	byte cnt4;
	// DATATYPE_BYTESEQUENCE / DATATYPE_FIXEDBYTESEQUENCE
	int i;
	byte superval[82];
	int currentPos;
	currentPos = 0;
	for( i = 0; i < 82; i++ ) {
		superval[i] = 0;
	}
	getValue(P_FSG_41_0_0_39, superval);
	///////// Start param1 - UINT8 /////////
	param1 = superval[currentPos++];
	putValue(P_FSG_41_0_0_39_1, param1);
	///////// Start param2 - STRING /////////
	getValue(P_FSG_41_0_0_39_2_Hex, param2);
	if((superval[currentPos] & 0x80) > 0)
	{
		if(39>127) /* Max Fct-Katalog Laenge: 39*/
		{
			len2 = ( (superval[currentPos]&0x7F) <<8) + superval[currentPos+1];
			currentPos = currentPos + 2;
			cnt2 = 1;
		}
		else
		{
			len2 = 39;
			writelineEx(gBAP_Trace, 0, "Anzahl der Laengeninformation-Bytes in P_FSG_41_0_0_39 ueberschreitet die erlaubte 1 Byte vom Fct-Kalatog.");
		}
	}
	else
	{
		len2 = superval[currentPos]&0x7F;
		currentPos = currentPos + 1;
		cnt2 = 0;
	}
	
	if(len2 > 39)
	{
		writelineEx(gBAP_Trace, 0, "Laenge:%d bei der Byte Position:%d ueberschreitet die Maximale erlaubte Laenge von Fct-Kalatog", len2, currentPos);
		len2 = 39;
	
		if(len2 < 128) cnt2 = 0;
		else cnt2 = 1;
	}
	
	for(i = 0; i < len2; i++)
	{
		param2[i] = superval[currentPos++];
	}
	
	putValue(P_FSG_41_0_0_39_2_len, len2);
	putValue(P_FSG_41_0_0_39_2_cnt, cnt2);
	
	if(len2 > getValueSize(P_FSG_41_0_0_39_2_Hex))
		putValue(P_FSG_41_0_0_39_2_Hex, param2, len2);
	else
		putValue(P_FSG_41_0_0_39_2_Hex, param2, getValueSize(P_FSG_41_0_0_39_2_Hex));

	///////// Start param3 - UINT8 /////////
	param3 = superval[currentPos++];
	putValue(P_FSG_41_0_0_39_3, param3);
	///////// Start param4 - STRING /////////
	getValue(P_FSG_41_0_0_39_4_Hex, param4);
	if((superval[currentPos] & 0x80) > 0)
	{
		if(39>127) /* Max Fct-Katalog Laenge: 39*/
		{
			len4 = ( (superval[currentPos]&0x7F) <<8) + superval[currentPos+1];
			currentPos = currentPos + 2;
			cnt4 = 1;
		}
		else
		{
			len4 = 39;
			writelineEx(gBAP_Trace, 0, "Anzahl der Laengeninformation-Bytes in P_FSG_41_0_0_39 ueberschreitet die erlaubte 1 Byte vom Fct-Kalatog.");
		}
	}
	else
	{
		len4 = superval[currentPos]&0x7F;
		currentPos = currentPos + 1;
		cnt4 = 0;
	}
	
	if(len4 > 39)
	{
		writelineEx(gBAP_Trace, 0, "Laenge:%d bei der Byte Position:%d ueberschreitet die Maximale erlaubte Laenge von Fct-Kalatog", len4, currentPos);
		len4 = 39;
	
		if(len4 < 128) cnt4 = 0;
		else cnt4 = 1;
	}
	
	for(i = 0; i < len4; i++)
	{
		param4[i] = superval[currentPos++];
	}
	
	putValue(P_FSG_41_0_0_39_4_len, len4);
	putValue(P_FSG_41_0_0_39_4_cnt, cnt4);
	
	if(len4 > getValueSize(P_FSG_41_0_0_39_4_Hex))
		putValue(P_FSG_41_0_0_39_4_Hex, param4, len4);
	else
		putValue(P_FSG_41_0_0_39_4_Hex, param4, getValueSize(P_FSG_41_0_0_39_4_Hex));

}

// Updates the bus value field and other dependencies.
P_FSG_41_0_0_39_BuildFct()
{
	byte param1; // NetworkProviderState
	byte param2[40]; // NetworkProviderName
	word len2;
	byte cnt2;
	byte param3; // ServiceProviderState
	byte param4[40]; // ServiceProviderName
	word len4;
	byte cnt4;

	int i;
	byte superval[82];
	int currentPos;
	currentPos = 0;
// gen_BuildFunc_SetSuperVals 
	param1 = getValue(P_FSG_41_0_0_39_1);
	superval[currentPos++]=param1;
// gen_BuildFunc_SetSuperVals 
	getValue(P_FSG_41_0_0_39_2_Hex, param2);
	len2 = getValue(P_FSG_41_0_0_39_2_len);
	cnt2= getValue(P_FSG_41_0_0_39_2_cnt);
	
	/* check box aktiviert*/
	if (cnt2 == 1)
	{
		/* 0 bis 39 (MaxString - 1B oder 2B) */
		if(len2 >= 0 && len2 <= 39)
		{
			//writelineEx(gBAP_Trace, 0, "[Debug-1] Len2: %d", len2);
			superval[currentPos] = (len2&0x7f00) | 0x80;
			superval[currentPos+1] = len2 & 0x00ff;
		}
		else
		{
			writelineEx(gBAP_Trace, 0, "Eingegebene Laenge: %d von P_FSG_41_0_0_39_2 ist ungueltig. Die max. erlaubte Laenge ist %d.", len2, 39);
			return;
		}
	}
	else if(cnt2 == 0) /*check box deaktiviert*/
	{
		if(len2 >= 0 && len2 <= 127)
		{
			//writelineEx(gBAP_Trace, 0, "[Debug-1] Len2: %d", len2);
			superval[currentPos]= len2 & 0x00ff;
			putValue(P_FSG_41_0_0_39_2_len, len2);
		}
		else if(len2 > 127 && len2 <= 39)
		{
			superval[currentPos] = (len2&0x7f00) | 0x80;
			superval[currentPos+1] = len2 & 0x00ff;
			putValue(P_FSG_41_0_0_39_2_len, len2);
			putValue(P_FSG_41_0_0_39_2_cnt, 1);
		}
		else
		{
			writelineEx(gBAP_Trace, 0, "Eingegebene Laenge: %d von P_FSG_41_0_0_39_2 ist ungueltig. Die max. erlaubte Laenge ist %d.", len2, 39);
			return;
		}
	}
	currentPos += cnt2+1;
	for(i = 0; i < len2; i++)
	{
		superval[currentPos++]= param2[i];
	}

// gen_BuildFunc_SetSuperVals 
	param3 = getValue(P_FSG_41_0_0_39_3);
	superval[currentPos++]=param3;
// gen_BuildFunc_SetSuperVals 
	getValue(P_FSG_41_0_0_39_4, param4);
	len4 = getValue(P_FSG_41_0_0_39_4_len);
	cnt4= getValue(P_FSG_41_0_0_39_4_cnt);
	
	/* check box aktiviert*/
	if (cnt4 == 1)
	{
		/* 0 bis 39 (MaxString - 1B oder 2B) */
		if(len4 >= 0 && len4 <= 39)
		{
			//writelineEx(gBAP_Trace, 0, "[Debug-1] Len4: %d", len4);
			superval[currentPos] = (len4&0x7f00) | 0x80;
			superval[currentPos+1] = len4 & 0x00ff;
		}
		else
		{
			writelineEx(gBAP_Trace, 0, "Eingegebene Laenge: %d von P_FSG_41_0_0_39_4 ist ungueltig. Die max. erlaubte Laenge ist %d.", len4, 39);
			return;
		}
	}
	else if(cnt4 == 0) /*check box deaktiviert*/
	{
		if(len4 >= 0 && len4 <= 127)
		{
			//writelineEx(gBAP_Trace, 0, "[Debug-1] Len4: %d", len4);
			superval[currentPos]= len4 & 0x00ff;
			putValue(P_FSG_41_0_0_39_4_len, len4);
		}
		else if(len4 > 127 && len4 <= 39)
		{
			superval[currentPos] = (len4&0x7f00) | 0x80;
			superval[currentPos+1] = len4 & 0x00ff;
			putValue(P_FSG_41_0_0_39_4_len, len4);
			putValue(P_FSG_41_0_0_39_4_cnt, 1);
		}
		else
		{
			writelineEx(gBAP_Trace, 0, "Eingegebene Laenge: %d von P_FSG_41_0_0_39_4 ist ungueltig. Die max. erlaubte Laenge ist %d.", len4, 39);
			return;
		}
	}
	currentPos += cnt4+1;
	for(i = 0; i < len4; i++)
	{
		superval[currentPos++]= param4[i];
	}

	putValue(P_FSG_41_0_0_39, superval, currentPos);
}


on envVar P_FSG_41_0_0_39_1 // NetworkProvider3.NetworkProviderState
{
	P_FSG_41_0_0_39_BuildFct();
}


// Ueberwachung der CheckBox fuer String
on envVar  P_FSG_41_0_0_39_2_cnt
{
	word len;
	byte cnt;
	len = getValue(P_FSG_41_0_0_39_2_len);
	cnt = getValue(P_FSG_41_0_0_39_2_cnt);

	/* wird nur gerufen, wenn check box deaktiviert mit Length>127*/ 
	if( cnt == 0) 
	{
		if(len > 127 )
		{
			putValue(P_FSG_41_0_0_39_2_len, 127);
		}
	}

	P_FSG_41_0_0_39_BuildFct();
}



// Ueberwachung der Eingabefeld fuer String Data
on envVar P_FSG_41_0_0_39_2_len
{
	word len;
	len = getValue(this);
	/* Validierung der Eingabe*/
	if(len > 39)
	{
		writelineEx(gBAP_Trace, 0, "Eingegebene Laenge: %d von P_FSG_41_0_0_39_2 ist ungueltig. Die max. erlaubte Laenge ist %d. ", len, 39);
		putValue(this, 39);
	}
	P_FSG_41_0_0_39_BuildFct();
}


on envVar P_FSG_41_0_0_39_2 // NetworkProvider3.NetworkProviderName
{
	int j, offset;
  int temp;
  int string_length_org;
  int string_length_mod;
  byte string_buffer_org[255];
  byte string_buffer_mod[255];
  
  //Start-Länge
  string_length_org = getValueSize(this);
  string_length_mod = string_length_org;
  
  //Start-String in Buffer
  getvalue(this,string_buffer_org);
  
  //Buffer auf Sonderzeichen checken und ersetzen
  offset = 0;
  for (j=0;j<string_length_org;j++)
  {
    if ( string_buffer_org[j] >= 0x80 && string_buffer_org[j] <= 0xBF ) 
    {
      temp = string_buffer_org[j] + 0xC200;
      
      string_buffer_mod[j+offset] = temp>>8;
      string_buffer_mod[j+offset+1] = temp;
      offset++;
      string_length_mod++;
    }
    else if ( string_buffer_org[j] >= 0xC0 && string_buffer_org[j] <= 0xFF ) 
    {
      temp = string_buffer_org[j] + 0xC2C0;
      
      string_buffer_mod[j+offset] = temp>>8;
      string_buffer_mod[j+offset+1] = temp;
      offset++;
      string_length_mod++;
    }
    else
      string_buffer_mod[j+offset] = string_buffer_org[j];
  }
    
  //neuen String schreiben
  putvalue(P_FSG_41_0_0_39_2_Hex,string_buffer_mod,string_length_mod);
  putValue(P_FSG_41_0_0_39_2_len, string_length_mod);
}

on envVar P_FSG_41_0_0_39_3 // NetworkProvider3.ServiceProviderState
{
	P_FSG_41_0_0_39_BuildFct();
}


// Ueberwachung der CheckBox fuer String
on envVar  P_FSG_41_0_0_39_4_cnt
{
	word len;
	byte cnt;
	len = getValue(P_FSG_41_0_0_39_4_len);
	cnt = getValue(P_FSG_41_0_0_39_4_cnt);

	/* wird nur gerufen, wenn check box deaktiviert mit Length>127*/ 
	if( cnt == 0) 
	{
		if(len > 127 )
		{
			putValue(P_FSG_41_0_0_39_4_len, 127);
		}
	}

	P_FSG_41_0_0_39_BuildFct();
}



// Ueberwachung der Eingabefeld fuer String Data
on envVar P_FSG_41_0_0_39_4_len
{
	word len;
	len = getValue(this);
	/* Validierung der Eingabe*/
	if(len > 39)
	{
		writelineEx(gBAP_Trace, 0, "Eingegebene Laenge: %d von P_FSG_41_0_0_39_4 ist ungueltig. Die max. erlaubte Laenge ist %d. ", len, 39);
		putValue(this, 39);
	}
	P_FSG_41_0_0_39_BuildFct();
}


on envVar P_FSG_41_0_0_39_4 // NetworkProvider3.ServiceProviderName
{
	int j, offset;
  int temp;
  int string_length_org;
  int string_length_mod;
  byte string_buffer_org[255];
  byte string_buffer_mod[255];
  
  //Start-Länge
  string_length_org = getValueSize(this);
  string_length_mod = string_length_org;
  
  //Start-String in Buffer
  getvalue(this,string_buffer_org);
  
  //Buffer auf Sonderzeichen checken und ersetzen
  offset = 0;
  for (j=0;j<string_length_org;j++)
  {
    if ( string_buffer_org[j] >= 0x80 && string_buffer_org[j] <= 0xBF ) 
    {
      temp = string_buffer_org[j] + 0xC200;
      
      string_buffer_mod[j+offset] = temp>>8;
      string_buffer_mod[j+offset+1] = temp;
      offset++;
      string_length_mod++;
    }
    else if ( string_buffer_org[j] >= 0xC0 && string_buffer_org[j] <= 0xFF ) 
    {
      temp = string_buffer_org[j] + 0xC2C0;
      
      string_buffer_mod[j+offset] = temp>>8;
      string_buffer_mod[j+offset+1] = temp;
      offset++;
      string_length_mod++;
    }
    else
      string_buffer_mod[j+offset] = string_buffer_org[j];
  }
    
  //neuen String schreiben
  putvalue(P_FSG_41_0_0_39_4_Hex,string_buffer_mod,string_length_mod);
  putValue(P_FSG_41_0_0_39_4_len, string_length_mod);
}

// Ruecksetzen des Fehlerstatus durch manuelle Fehlereingabe
on envVar P_FSG_41_0_0_40_ErrCode
{
       if(gP_FSG_41_0_0_40_ErrCode) 
       {
           setControlBackColor(panel_name,"errfield_P_FSG_41_0_0_40", MakeRGB(255,255,255));
       }
       gP_FSG_41_0_0_40_ErrCode = 1;
}
on envVar P_FSG_41_0_0_40Status_BTN
{
	byte BAPTemp[3];
   if (P_FSG_41_0_0_40Status_BTN_already_pressed == 0)
   {
      putValue(P_FSG_41_0_0_40_ErrCode,0);
      SetControlBackColor(panel_name,"errField_P_FSG_41_0_0_40",MakeRGB(255,255,255));
      P_FSG_41_0_0_40Status_BTN_already_pressed = 1;
   }
   else
   {
      getValue(P_FSG_41_0_0_40, BAPTemp);
      Request_ByteSequence(LSGID, P_FSG_41_0_0_40_ID, Data_REQ, BAPTemp, getValueSize(P_FSG_41_0_0_40));
      P_FSG_41_0_0_40Status_BTN_already_pressed = 0;
   }
}
on envVar P_FSG_41_0_0_40_FctEn
{
    long data[3];
    data[0]=LSGID;
    data[1]=P_FSG_41_0_0_40_ID;
    data[2]=getValue(P_FSG_41_0_0_40_FctEn);
    ChangeConfig(0x0031,data);
}
// De-Aktivierung der Eingabefelder der FCTID P_FSG_41_0_0_40
on envVar P_FSG_41_0_0_40_FctLstItemEn
{
       if(getValue(this)) 
       {
           EnableControl(panel_name,"panel_FSG_41_0_0_40",1);
           EnableControl(panel_name,"errfield_P_FSG_41_0_0_40",1);
           EnableControl(panel_name,"panel_P_FSG_41_0_0_40",1);
           setControlForeColor(panel_name, "checkbox_P_FSG_41_0_0_40", MakeRGB(0,240,0));
       }
       else
       {
           EnableControl(panel_name,"panel_FSG_41_0_0_40",0);
           EnableControl(panel_name,"errfield_P_FSG_41_0_0_40",0);
           EnableControl(panel_name,"panel_P_FSG_41_0_0_40",0);
           setControlForeColor(panel_name, "checkbox_P_FSG_41_0_0_40", MakeRGB(250,0,0));
       }
}
on envVar P_FSG_41_0_0_40 // bus value of SignalQuality3 (40).
{
	// opcodes: Error-Status
	byte param1; // Quality
	byte param2; // Extension_1
	byte param3; // Extension_2
	// DATATYPE_BYTESEQUENCE / DATATYPE_FIXEDBYTESEQUENCE
	int i;
	byte superval[3];
	int currentPos;
	currentPos = 0;
	for( i = 0; i < 3; i++ ) {
		superval[i] = 0;
	}
	getValue(P_FSG_41_0_0_40, superval);
	///////// Start param1 - UINT8 /////////
	param1 = superval[currentPos++];
	putValue(P_FSG_41_0_0_40_1, round((param1 * 1.0) - (0) + (0), 1.0));
	///////// Start param2 - UINT8 /////////
	param2 = superval[currentPos++];
	putValue(P_FSG_41_0_0_40_2, round((param2 * 1.0) - (0) + (0), 1.0));
	///////// Start param3 - UINT8 /////////
	param3 = superval[currentPos++];
	putValue(P_FSG_41_0_0_40_3, round((param3 * 1.0) - (0) + (0), 1.0));
}

// Ueberwachung der Darstellungsvariable der Range.
on envVar P_FSG_41_0_0_40_1_range // SignalQuality3.Quality 
{
	@P_FSG_41_0_0_40_1 = @P_FSG_41_0_0_40_1_range - (0); // slider = range - min
}

on envVar P_FSG_41_0_0_40_1 // SignalQuality3.Quality
{
	byte superval[3];

	//Update Childvalue (Number)
	byte thisval; // Quality
	float slider_value;

	slider_value = round(@P_FSG_41_0_0_40_1, 1.0);
	@P_FSG_41_0_0_40_1_range = slider_value + (0); // real value := slider value + range min.
	thisval = (byte)round((slider_value + (0) - (0)) / (1.0), 1); // bus value := (slider value + min - offset) / step.

    // Update superval
	getValue(P_FSG_41_0_0_40, superval);
	superval[0]=thisval;
	putValue(P_FSG_41_0_0_40,superval);
}

// Ueberwachung der Darstellungsvariable der Range.
on envVar P_FSG_41_0_0_40_2_range // SignalQuality3.Extension_1 
{
	@P_FSG_41_0_0_40_2 = @P_FSG_41_0_0_40_2_range - (0); // slider = range - min
}

on envVar P_FSG_41_0_0_40_2 // SignalQuality3.Extension_1
{
	byte superval[3];

	//Update Childvalue (Number)
	byte thisval; // Extension_1
	float slider_value;

	slider_value = 0; // Konstanter Parameter.
	@P_FSG_41_0_0_40_2_range = slider_value + (0); // real value := slider value + range min.
	thisval = (byte)round((slider_value + (0) - (0)) / (1.0), 1); // bus value := (slider value + min - offset) / step.

    // Update superval
	getValue(P_FSG_41_0_0_40, superval);
	superval[1]=thisval;
	putValue(P_FSG_41_0_0_40,superval);
}

// Ueberwachung der Darstellungsvariable der Range.
on envVar P_FSG_41_0_0_40_3_range // SignalQuality3.Extension_2 
{
	@P_FSG_41_0_0_40_3 = @P_FSG_41_0_0_40_3_range - (0); // slider = range - min
}

on envVar P_FSG_41_0_0_40_3 // SignalQuality3.Extension_2
{
	byte superval[3];

	//Update Childvalue (Number)
	byte thisval; // Extension_2
	float slider_value;

	slider_value = 0; // Konstanter Parameter.
	@P_FSG_41_0_0_40_3_range = slider_value + (0); // real value := slider value + range min.
	thisval = (byte)round((slider_value + (0) - (0)) / (1.0), 1); // bus value := (slider value + min - offset) / step.

    // Update superval
	getValue(P_FSG_41_0_0_40, superval);
	superval[2]=thisval;
	putValue(P_FSG_41_0_0_40,superval);
}

// Ruecksetzen des Fehlerstatus durch manuelle Fehlereingabe
on envVar P_FSG_41_0_0_41_ErrCode
{
       if(gP_FSG_41_0_0_41_ErrCode) 
       {
           setControlBackColor(panel_name,"errfield_P_FSG_41_0_0_41", MakeRGB(255,255,255));
       }
       gP_FSG_41_0_0_41_ErrCode = 1;
}
on envVar P_FSG_41_0_0_41Status_BTN
{
	byte BAPTemp[10];
    if (P_FSG_41_0_0_41Status_BTN_already_pressed == 0)
    {
        putValue(P_FSG_41_0_0_41_ErrCode,0);
        SetControlBackColor(panel_name,"errField_P_FSG_41_0_0_41",MakeRGB(255,255,255));
        P_FSG_41_0_0_41Status_BTN_already_pressed = 1;
    }
    else
    {
		P_FSG_41_0_0_41_BuildFct();
        getValue(P_FSG_41_0_0_41, BAPTemp);
        Request_ByteSequence(LSGID, P_FSG_41_0_0_41_ID, Data_REQ, BAPTemp, getValueSize(P_FSG_41_0_0_41));
        if(getValue(P_FSG_41_0_0_41_IntTlgEn)) //getValue(IT))
        {
           intertelegram_err(P_FSG_41_0_0_41_ID);
        }
        if(getValue(P_FSG_41_0_0_41_SegmEn))   //getvalue(SG)
        {
           sequence_err(P_FSG_41_0_0_41_ID,elCount(BAPTemp));
        }
       P_FSG_41_0_0_41Status_BTN_already_pressed = 0;
    }
}
on envVar P_FSG_41_0_0_41_FctEn
{
    long data[3];
    data[0]=LSGID;
    data[1]=P_FSG_41_0_0_41_ID;
    data[2]=getValue(P_FSG_41_0_0_41_FctEn);
    ChangeConfig(0x0031,data);
}
// De-Aktivierung der Eingabefelder der FCTID P_FSG_41_0_0_41
on envVar P_FSG_41_0_0_41_FctLstItemEn
{
       if(getValue(this)) 
       {
           EnableControl(panel_name,"panel_FSG_41_0_0_41",1);
           EnableControl(panel_name,"errfield_P_FSG_41_0_0_41",1);
           EnableControl(panel_name,"panel_P_FSG_41_0_0_41",1);
           setControlForeColor(panel_name, "checkbox_P_FSG_41_0_0_41", MakeRGB(0,240,0));
       }
       else
       {
           EnableControl(panel_name,"panel_FSG_41_0_0_41",0);
           EnableControl(panel_name,"errfield_P_FSG_41_0_0_41",0);
           EnableControl(panel_name,"panel_P_FSG_41_0_0_41",0);
           setControlForeColor(panel_name, "checkbox_P_FSG_41_0_0_41", MakeRGB(250,0,0));
       }
}
// Man darf gleichzeitig nur Checkbox fuer SegmError oder IntertelegramError aktiviert werden
on envVar P_FSG_41_0_0_41_IntTlgEn
{
       if(getValue(this)) 
       {
           putValue(P_FSG_41_0_0_41_SegmEn,0);
           intertelegram_err(P_FSG_41_0_0_41_ID);
       }
       else
       {
           intertelegram_err_off(P_FSG_41_0_0_41_ID);
       }
}
// Man darf gleichzeitig nur Checkbox fuer SegmError oder IntertelegramError aktiviert werden
on envVar P_FSG_41_0_0_41_SegmEn
{
       if(getValue(this)) 
       {
           putValue(P_FSG_41_0_0_41_IntTlgEn,0);
           sequence_err(P_FSG_41_0_0_41_ID,getValueSize(P_FSG_41_0_0_41_SegmEn));
       }
       else
       {
              sequence_err_off(P_FSG_41_0_0_41_ID);
       }
}
on envVar P_FSG_41_0_0_41 // bus value of DataConnectionIndication3 (41).
{
	// opcodes: Error-Status
	byte param1; // ConnectionIndication
	dword param2; // DataVolumeUplink
	dword param3; // DataVolumeDownlink
	byte param4; // Extension_1
	// DATATYPE_BYTESEQUENCE / DATATYPE_FIXEDBYTESEQUENCE
	int i;
	byte superval[10];
	int currentPos;
	currentPos = 0;
	for( i = 0; i < 10; i++ ) {
		superval[i] = 0;
	}
	getValue(P_FSG_41_0_0_41, superval);
	///////// Start param1 - UINT8 /////////
	param1 = superval[currentPos++];
	putValue(P_FSG_41_0_0_41_1, param1);
	///////// Start param2 - UINT32 /////////
	param2 = superval[currentPos++]|(superval[currentPos++]<<8)|(superval[currentPos++]<<16)|(superval[currentPos++]<<24);
	putValue(P_FSG_41_0_0_41_2, round((param2 * 1.0) - (0) + (0), 1.0));
	///////// Start param3 - UINT32 /////////
	param3 = superval[currentPos++]|(superval[currentPos++]<<8)|(superval[currentPos++]<<16)|(superval[currentPos++]<<24);
	putValue(P_FSG_41_0_0_41_3, round((param3 * 1.0) - (0) + (0), 1.0));
	///////// Start param4 - UINT8 /////////
	param4 = superval[currentPos++];
	putValue(P_FSG_41_0_0_41_4, round((param4 * 1.0) - (0) + (0), 1.0));
}

// Updates the bus value field and other dependencies.
P_FSG_41_0_0_41_BuildFct()
{
	byte param1; // ConnectionIndication
	dword param2; // DataVolumeUplink
	dword param3; // DataVolumeDownlink
	byte param4; // Extension_1

	int i;
	byte superval[10];
	int currentPos;
	currentPos = 0;
// gen_BuildFunc_SetSuperVals 
	param1 = getValue(P_FSG_41_0_0_41_1);
	superval[currentPos++]=param1;
// gen_BuildFunc_SetSuperVals 
	@P_FSG_41_0_0_41_2_range = round(@P_FSG_41_0_0_41_2 + (0), 1.0); // slider value + min = real value
	param2 = round( (@P_FSG_41_0_0_41_2 + (0) - (0)) / (1.0), 1.0); // (slider value + min - offset) / step = busvalue
	superval[currentPos++]= param2&0x000000ff;
	superval[currentPos++]=(param2&0x0000ff00)>>8;
	superval[currentPos++]=(param2&0x00ff0000)>>16;
	superval[currentPos++]=(param2&0xff000000)>>24;
// gen_BuildFunc_SetSuperVals 
	@P_FSG_41_0_0_41_3_range = round(@P_FSG_41_0_0_41_3 + (0), 1.0); // slider value + min = real value
	param3 = round( (@P_FSG_41_0_0_41_3 + (0) - (0)) / (1.0), 1.0); // (slider value + min - offset) / step = busvalue
	superval[currentPos++]= param3&0x000000ff;
	superval[currentPos++]=(param3&0x0000ff00)>>8;
	superval[currentPos++]=(param3&0x00ff0000)>>16;
	superval[currentPos++]=(param3&0xff000000)>>24;
// gen_BuildFunc_SetSuperVals 
	@P_FSG_41_0_0_41_4_range = round(@P_FSG_41_0_0_41_4 + (0), 1.0); // slider value + min = real value
	param4 = 0; // underlying parameter has constant value 0.
	superval[currentPos++]=param4;
	putValue(P_FSG_41_0_0_41, superval, currentPos);
}


on envVar P_FSG_41_0_0_41_1 // DataConnectionIndication3.ConnectionIndication
{
	P_FSG_41_0_0_41_BuildFct();
}

// Ueberwachung der Darstellungsvariable der Range.
on envVar P_FSG_41_0_0_41_2_range // DataConnectionIndication3.DataVolumeUplink 
{
	@P_FSG_41_0_0_41_2 = @P_FSG_41_0_0_41_2_range - (0); // slider = range - min
}

on envVar P_FSG_41_0_0_41_2 // DataConnectionIndication3.DataVolumeUplink
{
	P_FSG_41_0_0_41_BuildFct();
}

// Ueberwachung der Darstellungsvariable der Range.
on envVar P_FSG_41_0_0_41_3_range // DataConnectionIndication3.DataVolumeDownlink 
{
	@P_FSG_41_0_0_41_3 = @P_FSG_41_0_0_41_3_range - (0); // slider = range - min
}

on envVar P_FSG_41_0_0_41_3 // DataConnectionIndication3.DataVolumeDownlink
{
	P_FSG_41_0_0_41_BuildFct();
}

// Ueberwachung der Darstellungsvariable der Range.
on envVar P_FSG_41_0_0_41_4_range // DataConnectionIndication3.Extension_1 
{
	@P_FSG_41_0_0_41_4 = @P_FSG_41_0_0_41_4_range - (0); // slider = range - min
}

on envVar P_FSG_41_0_0_41_4 // DataConnectionIndication3.Extension_1
{
	P_FSG_41_0_0_41_BuildFct();
}

// Ruecksetzen des Fehlerstatus durch manuelle Fehlereingabe
on envVar P_FSG_41_0_0_42_ErrCode
{
       if(gP_FSG_41_0_0_42_ErrCode) 
       {
           setControlBackColor(panel_name,"errfield_P_FSG_41_0_0_42", MakeRGB(255,255,255));
       }
       gP_FSG_41_0_0_42_ErrCode = 1;
}
on envVar P_FSG_41_0_0_42Status_BTN
{
	byte BAPTemp[3];
   if (P_FSG_41_0_0_42Status_BTN_already_pressed == 0)
   {
      putValue(P_FSG_41_0_0_42_ErrCode,0);
      SetControlBackColor(panel_name,"errField_P_FSG_41_0_0_42",MakeRGB(255,255,255));
      P_FSG_41_0_0_42Status_BTN_already_pressed = 1;
   }
   else
   {
      getValue(P_FSG_41_0_0_42, BAPTemp);
      Request_ByteSequence(LSGID, P_FSG_41_0_0_42_ID, Data_REQ, BAPTemp, getValueSize(P_FSG_41_0_0_42));
      P_FSG_41_0_0_42Status_BTN_already_pressed = 0;
   }
}
on envVar P_FSG_41_0_0_42_FctEn
{
    long data[3];
    data[0]=LSGID;
    data[1]=P_FSG_41_0_0_42_ID;
    data[2]=getValue(P_FSG_41_0_0_42_FctEn);
    ChangeConfig(0x0031,data);
}
// De-Aktivierung der Eingabefelder der FCTID P_FSG_41_0_0_42
on envVar P_FSG_41_0_0_42_FctLstItemEn
{
       if(getValue(this)) 
       {
           EnableControl(panel_name,"panel_FSG_41_0_0_42",1);
           EnableControl(panel_name,"errfield_P_FSG_41_0_0_42",1);
           EnableControl(panel_name,"panel_P_FSG_41_0_0_42",1);
           setControlForeColor(panel_name, "checkbox_P_FSG_41_0_0_42", MakeRGB(0,240,0));
       }
       else
       {
           EnableControl(panel_name,"panel_FSG_41_0_0_42",0);
           EnableControl(panel_name,"errfield_P_FSG_41_0_0_42",0);
           EnableControl(panel_name,"panel_P_FSG_41_0_0_42",0);
           setControlForeColor(panel_name, "checkbox_P_FSG_41_0_0_42", MakeRGB(250,0,0));
       }
}
on envVar P_FSG_41_0_0_42 // bus value of DisconnectReason3 (42).
{
	// opcodes: Error-Status
	byte param1; // DisconnectReason
	byte param2; // Extension_1
	byte param3; // Extension_2
	// DATATYPE_BYTESEQUENCE / DATATYPE_FIXEDBYTESEQUENCE
	int i;
	byte superval[3];
	int currentPos;
	currentPos = 0;
	for( i = 0; i < 3; i++ ) {
		superval[i] = 0;
	}
	getValue(P_FSG_41_0_0_42, superval);
	///////// Start param1 - UINT8 /////////
	param1 = superval[currentPos++];
	putValue(P_FSG_41_0_0_42_1, param1);
	///////// Start param2 - UINT8 /////////
	param2 = superval[currentPos++];
	putValue(P_FSG_41_0_0_42_2, round((param2 * 1.0) - (0) + (0), 1.0));
	///////// Start param3 - UINT8 /////////
	param3 = superval[currentPos++];
	putValue(P_FSG_41_0_0_42_3, round((param3 * 1.0) - (0) + (0), 1.0));
}

on envVar P_FSG_41_0_0_42_1 // DisconnectReason3.DisconnectReason
{
	byte superval[3];

	//Update Childvalue (Enum)
	byte thisval; // DisconnectReason
	thisval = getValue(this);

    // Update superval
	getValue(P_FSG_41_0_0_42, superval);
	superval[0]=thisval;
	putValue(P_FSG_41_0_0_42,superval);
}

// Ueberwachung der Darstellungsvariable der Range.
on envVar P_FSG_41_0_0_42_2_range // DisconnectReason3.Extension_1 
{
	@P_FSG_41_0_0_42_2 = @P_FSG_41_0_0_42_2_range - (0); // slider = range - min
}

on envVar P_FSG_41_0_0_42_2 // DisconnectReason3.Extension_1
{
	byte superval[3];

	//Update Childvalue (Number)
	byte thisval; // Extension_1
	float slider_value;

	slider_value = 0; // Konstanter Parameter.
	@P_FSG_41_0_0_42_2_range = slider_value + (0); // real value := slider value + range min.
	thisval = (byte)round((slider_value + (0) - (0)) / (1.0), 1); // bus value := (slider value + min - offset) / step.

    // Update superval
	getValue(P_FSG_41_0_0_42, superval);
	superval[1]=thisval;
	putValue(P_FSG_41_0_0_42,superval);
}

// Ueberwachung der Darstellungsvariable der Range.
on envVar P_FSG_41_0_0_42_3_range // DisconnectReason3.Extension_2 
{
	@P_FSG_41_0_0_42_3 = @P_FSG_41_0_0_42_3_range - (0); // slider = range - min
}

on envVar P_FSG_41_0_0_42_3 // DisconnectReason3.Extension_2
{
	byte superval[3];

	//Update Childvalue (Number)
	byte thisval; // Extension_2
	float slider_value;

	slider_value = 0; // Konstanter Parameter.
	@P_FSG_41_0_0_42_3_range = slider_value + (0); // real value := slider value + range min.
	thisval = (byte)round((slider_value + (0) - (0)) / (1.0), 1); // bus value := (slider value + min - offset) / step.

    // Update superval
	getValue(P_FSG_41_0_0_42, superval);
	superval[2]=thisval;
	putValue(P_FSG_41_0_0_42,superval);
}

// Ruecksetzen des Fehlerstatus durch manuelle Fehlereingabe
on envVar P_FSG_41_0_0_43_ErrCode
{
       if(gP_FSG_41_0_0_43_ErrCode) 
       {
           setControlBackColor(panel_name,"errfield_P_FSG_41_0_0_43", MakeRGB(255,255,255));
       }
       gP_FSG_41_0_0_43_ErrCode = 1;
}
on envVar P_FSG_41_0_0_43Status_BTN
{
	byte BAPTemp[16];
    if (P_FSG_41_0_0_43Status_BTN_already_pressed == 0)
    {
        putValue(P_FSG_41_0_0_43_ErrCode,0);
        SetControlBackColor(panel_name,"errField_P_FSG_41_0_0_43",MakeRGB(255,255,255));
        P_FSG_41_0_0_43Status_BTN_already_pressed = 1;
    }
    else
    {
	updateCallState3();
		P_FSG_41_0_0_43_BuildFct();
        getValue(P_FSG_41_0_0_43, BAPTemp);
        Request_ByteSequence(LSGID, P_FSG_41_0_0_43_ID, Data_REQ, BAPTemp, getValueSize(P_FSG_41_0_0_43));
        if(getValue(P_FSG_41_0_0_43_IntTlgEn)) //getValue(IT))
        {
           intertelegram_err(P_FSG_41_0_0_43_ID);
        }
        if(getValue(P_FSG_41_0_0_43_SegmEn))   //getvalue(SG)
        {
           sequence_err(P_FSG_41_0_0_43_ID,elCount(BAPTemp));
        }
       P_FSG_41_0_0_43Status_BTN_already_pressed = 0;
    }
}
on envVar P_FSG_41_0_0_43_FctEn
{
    long data[3];
    data[0]=LSGID;
    data[1]=P_FSG_41_0_0_43_ID;
    data[2]=getValue(P_FSG_41_0_0_43_FctEn);
    ChangeConfig(0x0031,data);
}
// De-Aktivierung der Eingabefelder der FCTID P_FSG_41_0_0_43
on envVar P_FSG_41_0_0_43_FctLstItemEn
{
       if(getValue(this)) 
       {
           EnableControl(panel_name,"panel_FSG_41_0_0_43",1);
           EnableControl(panel_name,"errfield_P_FSG_41_0_0_43",1);
           EnableControl(panel_name,"panel_P_FSG_41_0_0_43",1);
           setControlForeColor(panel_name, "checkbox_P_FSG_41_0_0_43", MakeRGB(0,240,0));
       }
       else
       {
           EnableControl(panel_name,"panel_FSG_41_0_0_43",0);
           EnableControl(panel_name,"errfield_P_FSG_41_0_0_43",0);
           EnableControl(panel_name,"panel_P_FSG_41_0_0_43",0);
           setControlForeColor(panel_name, "checkbox_P_FSG_41_0_0_43", MakeRGB(250,0,0));
       }
}
// Man darf gleichzeitig nur Checkbox fuer SegmError oder IntertelegramError aktiviert werden
on envVar P_FSG_41_0_0_43_IntTlgEn
{
       if(getValue(this)) 
       {
           putValue(P_FSG_41_0_0_43_SegmEn,0);
           intertelegram_err(P_FSG_41_0_0_43_ID);
       }
       else
       {
           intertelegram_err_off(P_FSG_41_0_0_43_ID);
       }
}
// Man darf gleichzeitig nur Checkbox fuer SegmError oder IntertelegramError aktiviert werden
on envVar P_FSG_41_0_0_43_SegmEn
{
       if(getValue(this)) 
       {
           putValue(P_FSG_41_0_0_43_IntTlgEn,0);
           sequence_err(P_FSG_41_0_0_43_ID,getValueSize(P_FSG_41_0_0_43_SegmEn));
       }
       else
       {
              sequence_err_off(P_FSG_41_0_0_43_ID);
       }
}
on envVar P_FSG_41_0_0_43 // bus value of CallState3 (43).
{
	// opcodes: Error-Status
	byte param1; // CallState0
	byte param2; // CallType0
	byte param3; // CallOptions0
	byte param4; // CallState1
	byte param5; // CallType1
	byte param6; // CallOptions1
	byte param7; // CallState2
	byte param8; // CallType2
	byte param9; // CallOptions2
	byte param10; // CallState3
	byte param11; // CallType3
	byte param12; // CallOptions3
	byte param13; // CallState4
	byte param14; // CallType4
	byte param15; // CallOptions4
	byte param16; // CallState5
	byte param17; // CallType5
	byte param18; // CallOptions5
	byte param19; // CallState6
	byte param20; // CallType6
	byte param21; // CallOptions6
	byte param22; // CallIncomingDiverted
	byte param23; // CallOutgoingDiverted_eCallConfirmationPending
	// DATATYPE_BYTESEQUENCE / DATATYPE_FIXEDBYTESEQUENCE
	int i;
	byte superval[16];
	int currentPos;
	currentPos = 0;
	for( i = 0; i < 16; i++ ) {
		superval[i] = 0;
	}
	getValue(P_FSG_41_0_0_43, superval);
	///////// Start param1 - NIBBLE /////////
	param1 = (superval[currentPos] & 0xf0)>>4;
	putValue(P_FSG_41_0_0_43_1, param1);
	///////// Start param2 - NIBBLE /////////
	param2 = superval[currentPos++] & 0x0f;
	putValue(P_FSG_41_0_0_43_2, param2);
	///////// Start param3 - UINT8 /////////
	param3 = superval[currentPos++];
	putValue(P_FSG_41_0_0_43_3, param3);
	///////// Start param4 - NIBBLE /////////
	param4 = (superval[currentPos] & 0xf0)>>4;
	putValue(P_FSG_41_0_0_43_4, param4);
	///////// Start param5 - NIBBLE /////////
	param5 = superval[currentPos++] & 0x0f;
	putValue(P_FSG_41_0_0_43_5, param5);
	///////// Start param6 - UINT8 /////////
	param6 = superval[currentPos++];
	putValue(P_FSG_41_0_0_43_6, param6);
	///////// Start param7 - NIBBLE /////////
	param7 = (superval[currentPos] & 0xf0)>>4;
	putValue(P_FSG_41_0_0_43_7, param7);
	///////// Start param8 - NIBBLE /////////
	param8 = superval[currentPos++] & 0x0f;
	putValue(P_FSG_41_0_0_43_8, param8);
	///////// Start param9 - UINT8 /////////
	param9 = superval[currentPos++];
	putValue(P_FSG_41_0_0_43_9, param9);
	///////// Start param10 - NIBBLE /////////
	param10 = (superval[currentPos] & 0xf0)>>4;
	putValue(P_FSG_41_0_0_43_10, param10);
	///////// Start param11 - NIBBLE /////////
	param11 = superval[currentPos++] & 0x0f;
	putValue(P_FSG_41_0_0_43_11, param11);
	///////// Start param12 - UINT8 /////////
	param12 = superval[currentPos++];
	putValue(P_FSG_41_0_0_43_12, param12);
	///////// Start param13 - NIBBLE /////////
	param13 = (superval[currentPos] & 0xf0)>>4;
	putValue(P_FSG_41_0_0_43_13, param13);
	///////// Start param14 - NIBBLE /////////
	param14 = superval[currentPos++] & 0x0f;
	putValue(P_FSG_41_0_0_43_14, param14);
	///////// Start param15 - UINT8 /////////
	param15 = superval[currentPos++];
	putValue(P_FSG_41_0_0_43_15, param15);
	///////// Start param16 - NIBBLE /////////
	param16 = (superval[currentPos] & 0xf0)>>4;
	putValue(P_FSG_41_0_0_43_16, param16);
	///////// Start param17 - NIBBLE /////////
	param17 = superval[currentPos++] & 0x0f;
	putValue(P_FSG_41_0_0_43_17, param17);
	///////// Start param18 - UINT8 /////////
	param18 = superval[currentPos++];
	putValue(P_FSG_41_0_0_43_18, param18);
	///////// Start param19 - NIBBLE /////////
	param19 = (superval[currentPos] & 0xf0)>>4;
	putValue(P_FSG_41_0_0_43_19, param19);
	///////// Start param20 - NIBBLE /////////
	param20 = superval[currentPos++] & 0x0f;
	putValue(P_FSG_41_0_0_43_20, param20);
	///////// Start param21 - UINT8 /////////
	param21 = superval[currentPos++];
	putValue(P_FSG_41_0_0_43_21, param21);
	///////// Start param22 - UINT8 /////////
	param22 = superval[currentPos++];
	putValue(P_FSG_41_0_0_43_22, param22);
	///////// Start param23 - UINT8 /////////
	param23 = superval[currentPos++];
	putValue(P_FSG_41_0_0_43_23, param23);
}

// Updates the bus value field and other dependencies.
P_FSG_41_0_0_43_BuildFct()
{
	byte param1; // CallState0
	byte param2; // CallType0
	byte param3; // CallOptions0
	byte param4; // CallState1
	byte param5; // CallType1
	byte param6; // CallOptions1
	byte param7; // CallState2
	byte param8; // CallType2
	byte param9; // CallOptions2
	byte param10; // CallState3
	byte param11; // CallType3
	byte param12; // CallOptions3
	byte param13; // CallState4
	byte param14; // CallType4
	byte param15; // CallOptions4
	byte param16; // CallState5
	byte param17; // CallType5
	byte param18; // CallOptions5
	byte param19; // CallState6
	byte param20; // CallType6
	byte param21; // CallOptions6
	byte param22; // CallIncomingDiverted
	byte param23; // CallOutgoingDiverted_eCallConfirmationPending

	int i;
	byte superval[16];
	int currentPos;
	currentPos = 0;
// gen_BuildFunc_SetSuperVals 
	param1 = getValue(P_FSG_41_0_0_43_1);
	param1 = param1 & 0x0f;
	superval[currentPos]= superval[currentPos]&0x0f;
	superval[currentPos]= superval[currentPos]|(param1<<4);
// gen_BuildFunc_SetSuperVals 
	param2 = getValue(P_FSG_41_0_0_43_2);
	param2 = param2 & 0x0f;
	superval[currentPos]= superval[currentPos]&0xf0;
	superval[currentPos]= superval[currentPos]|param2;
	currentPos++;
// gen_BuildFunc_SetSuperVals 
	param3 = getValue(P_FSG_41_0_0_43_3);
	@P_FSG_41_0_0_43_3_0 = (param3 & 1) > 0;
	@P_FSG_41_0_0_43_3_1 = (param3 & 2) > 0;
	@P_FSG_41_0_0_43_3_2 = (param3 & 4) > 0;
	@P_FSG_41_0_0_43_3_3 = (param3 & 8) > 0;
	@P_FSG_41_0_0_43_3_4 = (param3 & 16) > 0;
	@P_FSG_41_0_0_43_3_5 = (param3 & 32) > 0;
	@P_FSG_41_0_0_43_3_6 = (param3 & 64) > 0;
	@P_FSG_41_0_0_43_3_7 = (param3 & 128) > 0;
	superval[currentPos++]=param3;
// gen_BuildFunc_SetSuperVals 
	param4 = getValue(P_FSG_41_0_0_43_4);
	param4 = param4 & 0x0f;
	superval[currentPos]= superval[currentPos]&0x0f;
	superval[currentPos]= superval[currentPos]|(param4<<4);
// gen_BuildFunc_SetSuperVals 
	param5 = getValue(P_FSG_41_0_0_43_5);
	param5 = param5 & 0x0f;
	superval[currentPos]= superval[currentPos]&0xf0;
	superval[currentPos]= superval[currentPos]|param5;
	currentPos++;
// gen_BuildFunc_SetSuperVals 
	param6 = getValue(P_FSG_41_0_0_43_6);
	@P_FSG_41_0_0_43_6_0 = (param6 & 1) > 0;
	@P_FSG_41_0_0_43_6_1 = (param6 & 2) > 0;
	@P_FSG_41_0_0_43_6_2 = (param6 & 4) > 0;
	@P_FSG_41_0_0_43_6_3 = (param6 & 8) > 0;
	@P_FSG_41_0_0_43_6_4 = (param6 & 16) > 0;
	@P_FSG_41_0_0_43_6_5 = (param6 & 32) > 0;
	@P_FSG_41_0_0_43_6_6 = (param6 & 64) > 0;
	@P_FSG_41_0_0_43_6_7 = (param6 & 128) > 0;
	superval[currentPos++]=param6;
// gen_BuildFunc_SetSuperVals 
	param7 = getValue(P_FSG_41_0_0_43_7);
	param7 = param7 & 0x0f;
	superval[currentPos]= superval[currentPos]&0x0f;
	superval[currentPos]= superval[currentPos]|(param7<<4);
// gen_BuildFunc_SetSuperVals 
	param8 = getValue(P_FSG_41_0_0_43_8);
	param8 = param8 & 0x0f;
	superval[currentPos]= superval[currentPos]&0xf0;
	superval[currentPos]= superval[currentPos]|param8;
	currentPos++;
// gen_BuildFunc_SetSuperVals 
	param9 = getValue(P_FSG_41_0_0_43_9);
	@P_FSG_41_0_0_43_9_0 = (param9 & 1) > 0;
	@P_FSG_41_0_0_43_9_1 = (param9 & 2) > 0;
	@P_FSG_41_0_0_43_9_2 = (param9 & 4) > 0;
	@P_FSG_41_0_0_43_9_3 = (param9 & 8) > 0;
	@P_FSG_41_0_0_43_9_4 = (param9 & 16) > 0;
	@P_FSG_41_0_0_43_9_5 = (param9 & 32) > 0;
	@P_FSG_41_0_0_43_9_6 = (param9 & 64) > 0;
	@P_FSG_41_0_0_43_9_7 = (param9 & 128) > 0;
	superval[currentPos++]=param9;
// gen_BuildFunc_SetSuperVals 
	param10 = getValue(P_FSG_41_0_0_43_10);
	param10 = param10 & 0x0f;
	superval[currentPos]= superval[currentPos]&0x0f;
	superval[currentPos]= superval[currentPos]|(param10<<4);
// gen_BuildFunc_SetSuperVals 
	param11 = getValue(P_FSG_41_0_0_43_11);
	param11 = param11 & 0x0f;
	superval[currentPos]= superval[currentPos]&0xf0;
	superval[currentPos]= superval[currentPos]|param11;
	currentPos++;
// gen_BuildFunc_SetSuperVals 
	param12 = getValue(P_FSG_41_0_0_43_12);
	@P_FSG_41_0_0_43_12_0 = (param12 & 1) > 0;
	@P_FSG_41_0_0_43_12_1 = (param12 & 2) > 0;
	@P_FSG_41_0_0_43_12_2 = (param12 & 4) > 0;
	@P_FSG_41_0_0_43_12_3 = (param12 & 8) > 0;
	@P_FSG_41_0_0_43_12_4 = (param12 & 16) > 0;
	@P_FSG_41_0_0_43_12_5 = (param12 & 32) > 0;
	@P_FSG_41_0_0_43_12_6 = (param12 & 64) > 0;
	@P_FSG_41_0_0_43_12_7 = (param12 & 128) > 0;
	superval[currentPos++]=param12;
// gen_BuildFunc_SetSuperVals 
	param13 = getValue(P_FSG_41_0_0_43_13);
	param13 = param13 & 0x0f;
	superval[currentPos]= superval[currentPos]&0x0f;
	superval[currentPos]= superval[currentPos]|(param13<<4);
// gen_BuildFunc_SetSuperVals 
	param14 = getValue(P_FSG_41_0_0_43_14);
	param14 = param14 & 0x0f;
	superval[currentPos]= superval[currentPos]&0xf0;
	superval[currentPos]= superval[currentPos]|param14;
	currentPos++;
// gen_BuildFunc_SetSuperVals 
	param15 = getValue(P_FSG_41_0_0_43_15);
	@P_FSG_41_0_0_43_15_0 = (param15 & 1) > 0;
	@P_FSG_41_0_0_43_15_1 = (param15 & 2) > 0;
	@P_FSG_41_0_0_43_15_2 = (param15 & 4) > 0;
	@P_FSG_41_0_0_43_15_3 = (param15 & 8) > 0;
	@P_FSG_41_0_0_43_15_4 = (param15 & 16) > 0;
	@P_FSG_41_0_0_43_15_5 = (param15 & 32) > 0;
	@P_FSG_41_0_0_43_15_6 = (param15 & 64) > 0;
	@P_FSG_41_0_0_43_15_7 = (param15 & 128) > 0;
	superval[currentPos++]=param15;
// gen_BuildFunc_SetSuperVals 
	param16 = getValue(P_FSG_41_0_0_43_16);
	param16 = param16 & 0x0f;
	superval[currentPos]= superval[currentPos]&0x0f;
	superval[currentPos]= superval[currentPos]|(param16<<4);
// gen_BuildFunc_SetSuperVals 
	param17 = getValue(P_FSG_41_0_0_43_17);
	param17 = param17 & 0x0f;
	superval[currentPos]= superval[currentPos]&0xf0;
	superval[currentPos]= superval[currentPos]|param17;
	currentPos++;
// gen_BuildFunc_SetSuperVals 
	param18 = getValue(P_FSG_41_0_0_43_18);
	@P_FSG_41_0_0_43_18_0 = (param18 & 1) > 0;
	@P_FSG_41_0_0_43_18_1 = (param18 & 2) > 0;
	@P_FSG_41_0_0_43_18_2 = (param18 & 4) > 0;
	@P_FSG_41_0_0_43_18_3 = (param18 & 8) > 0;
	@P_FSG_41_0_0_43_18_4 = (param18 & 16) > 0;
	@P_FSG_41_0_0_43_18_5 = (param18 & 32) > 0;
	@P_FSG_41_0_0_43_18_6 = (param18 & 64) > 0;
	@P_FSG_41_0_0_43_18_7 = (param18 & 128) > 0;
	superval[currentPos++]=param18;
// gen_BuildFunc_SetSuperVals 
	param19 = getValue(P_FSG_41_0_0_43_19);
	param19 = param19 & 0x0f;
	superval[currentPos]= superval[currentPos]&0x0f;
	superval[currentPos]= superval[currentPos]|(param19<<4);
// gen_BuildFunc_SetSuperVals 
	param20 = getValue(P_FSG_41_0_0_43_20);
	param20 = param20 & 0x0f;
	superval[currentPos]= superval[currentPos]&0xf0;
	superval[currentPos]= superval[currentPos]|param20;
	currentPos++;
// gen_BuildFunc_SetSuperVals 
	param21 = getValue(P_FSG_41_0_0_43_21);
	@P_FSG_41_0_0_43_21_0 = (param21 & 1) > 0;
	@P_FSG_41_0_0_43_21_1 = (param21 & 2) > 0;
	@P_FSG_41_0_0_43_21_2 = (param21 & 4) > 0;
	@P_FSG_41_0_0_43_21_3 = (param21 & 8) > 0;
	@P_FSG_41_0_0_43_21_4 = (param21 & 16) > 0;
	@P_FSG_41_0_0_43_21_5 = (param21 & 32) > 0;
	@P_FSG_41_0_0_43_21_6 = (param21 & 64) > 0;
	@P_FSG_41_0_0_43_21_7 = (param21 & 128) > 0;
	superval[currentPos++]=param21;
// gen_BuildFunc_SetSuperVals 
	param22 = getValue(P_FSG_41_0_0_43_22);
	@P_FSG_41_0_0_43_22_0 = (param22 & 1) > 0;
	@P_FSG_41_0_0_43_22_1 = (param22 & 2) > 0;
	@P_FSG_41_0_0_43_22_2 = (param22 & 4) > 0;
	@P_FSG_41_0_0_43_22_3 = (param22 & 8) > 0;
	@P_FSG_41_0_0_43_22_4 = (param22 & 16) > 0;
	@P_FSG_41_0_0_43_22_5 = (param22 & 32) > 0;
	@P_FSG_41_0_0_43_22_6 = (param22 & 64) > 0;
	superval[currentPos++]=param22;
// gen_BuildFunc_SetSuperVals 
	param23 = getValue(P_FSG_41_0_0_43_23);
	@P_FSG_41_0_0_43_23_0 = (param23 & 1) > 0;
	@P_FSG_41_0_0_43_23_1 = (param23 & 2) > 0;
	@P_FSG_41_0_0_43_23_2 = (param23 & 4) > 0;
	@P_FSG_41_0_0_43_23_3 = (param23 & 8) > 0;
	@P_FSG_41_0_0_43_23_4 = (param23 & 16) > 0;
	@P_FSG_41_0_0_43_23_5 = (param23 & 32) > 0;
	@P_FSG_41_0_0_43_23_6 = (param23 & 64) > 0;
	@P_FSG_41_0_0_43_23_7 = (param23 & 128) > 0;
	superval[currentPos++]=param23;
	putValue(P_FSG_41_0_0_43, superval, currentPos);
}


on envVar P_FSG_41_0_0_43_1 // CallState3.CallState0
{
	P_FSG_41_0_0_43_BuildFct();
}

on envVar P_FSG_41_0_0_43_2 // CallState3.CallType0
{
	P_FSG_41_0_0_43_BuildFct();
}

on envVar P_FSG_41_0_0_43_3_0
{
	byte bitval;
	//thisval steht hier fuer den bitfield-wert, 
	//aus Generierungsgruenden hier keine einheitliche Bezeichnung moeglich.
	byte thisval; // CallOptions0
	bitval= getValue(this);
	thisval = getValue(P_FSG_41_0_0_43_3);
	thisval = thisval&~(1<<0)|(bitval<<0);
	putValue(P_FSG_41_0_0_43_3,thisval);
}

on envVar P_FSG_41_0_0_43_3_1
{
	byte bitval;
	//thisval steht hier fuer den bitfield-wert, 
	//aus Generierungsgruenden hier keine einheitliche Bezeichnung moeglich.
	byte thisval; // CallOptions0
	bitval= getValue(this);
	thisval = getValue(P_FSG_41_0_0_43_3);
	thisval = thisval&~(1<<1)|(bitval<<1);
	putValue(P_FSG_41_0_0_43_3,thisval);
}

on envVar P_FSG_41_0_0_43_3_2
{
	byte bitval;
	//thisval steht hier fuer den bitfield-wert, 
	//aus Generierungsgruenden hier keine einheitliche Bezeichnung moeglich.
	byte thisval; // CallOptions0
	bitval= getValue(this);
	thisval = getValue(P_FSG_41_0_0_43_3);
	thisval = thisval&~(1<<2)|(bitval<<2);
	putValue(P_FSG_41_0_0_43_3,thisval);
}

on envVar P_FSG_41_0_0_43_3_3
{
	byte bitval;
	//thisval steht hier fuer den bitfield-wert, 
	//aus Generierungsgruenden hier keine einheitliche Bezeichnung moeglich.
	byte thisval; // CallOptions0
	bitval= getValue(this);
	thisval = getValue(P_FSG_41_0_0_43_3);
	thisval = thisval&~(1<<3)|(bitval<<3);
	putValue(P_FSG_41_0_0_43_3,thisval);
}

on envVar P_FSG_41_0_0_43_3_4
{
	byte bitval;
	//thisval steht hier fuer den bitfield-wert, 
	//aus Generierungsgruenden hier keine einheitliche Bezeichnung moeglich.
	byte thisval; // CallOptions0
	bitval= getValue(this);
	thisval = getValue(P_FSG_41_0_0_43_3);
	thisval = thisval&~(1<<4)|(bitval<<4);
	putValue(P_FSG_41_0_0_43_3,thisval);
}

on envVar P_FSG_41_0_0_43_3_5
{
	byte bitval;
	//thisval steht hier fuer den bitfield-wert, 
	//aus Generierungsgruenden hier keine einheitliche Bezeichnung moeglich.
	byte thisval; // CallOptions0
	bitval= getValue(this);
	thisval = getValue(P_FSG_41_0_0_43_3);
	thisval = thisval&~(1<<5)|(bitval<<5);
	putValue(P_FSG_41_0_0_43_3,thisval);
}

on envVar P_FSG_41_0_0_43_3_6
{
	byte bitval;
	//thisval steht hier fuer den bitfield-wert, 
	//aus Generierungsgruenden hier keine einheitliche Bezeichnung moeglich.
	byte thisval; // CallOptions0
	bitval= getValue(this);
	thisval = getValue(P_FSG_41_0_0_43_3);
	thisval = thisval&~(1<<6)|(bitval<<6);
	putValue(P_FSG_41_0_0_43_3,thisval);
}

on envVar P_FSG_41_0_0_43_3_7
{
	byte bitval;
	//thisval steht hier fuer den bitfield-wert, 
	//aus Generierungsgruenden hier keine einheitliche Bezeichnung moeglich.
	byte thisval; // CallOptions0
	bitval= getValue(this);
	thisval = getValue(P_FSG_41_0_0_43_3);
	thisval = thisval&~(1<<7)|(bitval<<7);
	putValue(P_FSG_41_0_0_43_3,thisval);
}

on envVar P_FSG_41_0_0_43_3 // CallState3.CallOptions0
{
	P_FSG_41_0_0_43_BuildFct();
}

on envVar P_FSG_41_0_0_43_4 // CallState3.CallState1
{
	P_FSG_41_0_0_43_BuildFct();
}

on envVar P_FSG_41_0_0_43_5 // CallState3.CallType1
{
	P_FSG_41_0_0_43_BuildFct();
}

on envVar P_FSG_41_0_0_43_6_0
{
	byte bitval;
	//thisval steht hier fuer den bitfield-wert, 
	//aus Generierungsgruenden hier keine einheitliche Bezeichnung moeglich.
	byte thisval; // CallOptions1
	bitval= getValue(this);
	thisval = getValue(P_FSG_41_0_0_43_6);
	thisval = thisval&~(1<<0)|(bitval<<0);
	putValue(P_FSG_41_0_0_43_6,thisval);
}

on envVar P_FSG_41_0_0_43_6_1
{
	byte bitval;
	//thisval steht hier fuer den bitfield-wert, 
	//aus Generierungsgruenden hier keine einheitliche Bezeichnung moeglich.
	byte thisval; // CallOptions1
	bitval= getValue(this);
	thisval = getValue(P_FSG_41_0_0_43_6);
	thisval = thisval&~(1<<1)|(bitval<<1);
	putValue(P_FSG_41_0_0_43_6,thisval);
}

on envVar P_FSG_41_0_0_43_6_2
{
	byte bitval;
	//thisval steht hier fuer den bitfield-wert, 
	//aus Generierungsgruenden hier keine einheitliche Bezeichnung moeglich.
	byte thisval; // CallOptions1
	bitval= getValue(this);
	thisval = getValue(P_FSG_41_0_0_43_6);
	thisval = thisval&~(1<<2)|(bitval<<2);
	putValue(P_FSG_41_0_0_43_6,thisval);
}

on envVar P_FSG_41_0_0_43_6_3
{
	byte bitval;
	//thisval steht hier fuer den bitfield-wert, 
	//aus Generierungsgruenden hier keine einheitliche Bezeichnung moeglich.
	byte thisval; // CallOptions1
	bitval= getValue(this);
	thisval = getValue(P_FSG_41_0_0_43_6);
	thisval = thisval&~(1<<3)|(bitval<<3);
	putValue(P_FSG_41_0_0_43_6,thisval);
}

on envVar P_FSG_41_0_0_43_6_4
{
	byte bitval;
	//thisval steht hier fuer den bitfield-wert, 
	//aus Generierungsgruenden hier keine einheitliche Bezeichnung moeglich.
	byte thisval; // CallOptions1
	bitval= getValue(this);
	thisval = getValue(P_FSG_41_0_0_43_6);
	thisval = thisval&~(1<<4)|(bitval<<4);
	putValue(P_FSG_41_0_0_43_6,thisval);
}

on envVar P_FSG_41_0_0_43_6_5
{
	byte bitval;
	//thisval steht hier fuer den bitfield-wert, 
	//aus Generierungsgruenden hier keine einheitliche Bezeichnung moeglich.
	byte thisval; // CallOptions1
	bitval= getValue(this);
	thisval = getValue(P_FSG_41_0_0_43_6);
	thisval = thisval&~(1<<5)|(bitval<<5);
	putValue(P_FSG_41_0_0_43_6,thisval);
}

on envVar P_FSG_41_0_0_43_6_6
{
	byte bitval;
	//thisval steht hier fuer den bitfield-wert, 
	//aus Generierungsgruenden hier keine einheitliche Bezeichnung moeglich.
	byte thisval; // CallOptions1
	bitval= getValue(this);
	thisval = getValue(P_FSG_41_0_0_43_6);
	thisval = thisval&~(1<<6)|(bitval<<6);
	putValue(P_FSG_41_0_0_43_6,thisval);
}

on envVar P_FSG_41_0_0_43_6_7
{
	byte bitval;
	//thisval steht hier fuer den bitfield-wert, 
	//aus Generierungsgruenden hier keine einheitliche Bezeichnung moeglich.
	byte thisval; // CallOptions1
	bitval= getValue(this);
	thisval = getValue(P_FSG_41_0_0_43_6);
	thisval = thisval&~(1<<7)|(bitval<<7);
	putValue(P_FSG_41_0_0_43_6,thisval);
}

on envVar P_FSG_41_0_0_43_6 // CallState3.CallOptions1
{
	P_FSG_41_0_0_43_BuildFct();
}

on envVar P_FSG_41_0_0_43_7 // CallState3.CallState2
{
	P_FSG_41_0_0_43_BuildFct();
}

on envVar P_FSG_41_0_0_43_8 // CallState3.CallType2
{
	P_FSG_41_0_0_43_BuildFct();
}

on envVar P_FSG_41_0_0_43_9_0
{
	byte bitval;
	//thisval steht hier fuer den bitfield-wert, 
	//aus Generierungsgruenden hier keine einheitliche Bezeichnung moeglich.
	byte thisval; // CallOptions2
	bitval= getValue(this);
	thisval = getValue(P_FSG_41_0_0_43_9);
	thisval = thisval&~(1<<0)|(bitval<<0);
	putValue(P_FSG_41_0_0_43_9,thisval);
}

on envVar P_FSG_41_0_0_43_9_1
{
	byte bitval;
	//thisval steht hier fuer den bitfield-wert, 
	//aus Generierungsgruenden hier keine einheitliche Bezeichnung moeglich.
	byte thisval; // CallOptions2
	bitval= getValue(this);
	thisval = getValue(P_FSG_41_0_0_43_9);
	thisval = thisval&~(1<<1)|(bitval<<1);
	putValue(P_FSG_41_0_0_43_9,thisval);
}

on envVar P_FSG_41_0_0_43_9_2
{
	byte bitval;
	//thisval steht hier fuer den bitfield-wert, 
	//aus Generierungsgruenden hier keine einheitliche Bezeichnung moeglich.
	byte thisval; // CallOptions2
	bitval= getValue(this);
	thisval = getValue(P_FSG_41_0_0_43_9);
	thisval = thisval&~(1<<2)|(bitval<<2);
	putValue(P_FSG_41_0_0_43_9,thisval);
}

on envVar P_FSG_41_0_0_43_9_3
{
	byte bitval;
	//thisval steht hier fuer den bitfield-wert, 
	//aus Generierungsgruenden hier keine einheitliche Bezeichnung moeglich.
	byte thisval; // CallOptions2
	bitval= getValue(this);
	thisval = getValue(P_FSG_41_0_0_43_9);
	thisval = thisval&~(1<<3)|(bitval<<3);
	putValue(P_FSG_41_0_0_43_9,thisval);
}

on envVar P_FSG_41_0_0_43_9_4
{
	byte bitval;
	//thisval steht hier fuer den bitfield-wert, 
	//aus Generierungsgruenden hier keine einheitliche Bezeichnung moeglich.
	byte thisval; // CallOptions2
	bitval= getValue(this);
	thisval = getValue(P_FSG_41_0_0_43_9);
	thisval = thisval&~(1<<4)|(bitval<<4);
	putValue(P_FSG_41_0_0_43_9,thisval);
}

on envVar P_FSG_41_0_0_43_9_5
{
	byte bitval;
	//thisval steht hier fuer den bitfield-wert, 
	//aus Generierungsgruenden hier keine einheitliche Bezeichnung moeglich.
	byte thisval; // CallOptions2
	bitval= getValue(this);
	thisval = getValue(P_FSG_41_0_0_43_9);
	thisval = thisval&~(1<<5)|(bitval<<5);
	putValue(P_FSG_41_0_0_43_9,thisval);
}

on envVar P_FSG_41_0_0_43_9_6
{
	byte bitval;
	//thisval steht hier fuer den bitfield-wert, 
	//aus Generierungsgruenden hier keine einheitliche Bezeichnung moeglich.
	byte thisval; // CallOptions2
	bitval= getValue(this);
	thisval = getValue(P_FSG_41_0_0_43_9);
	thisval = thisval&~(1<<6)|(bitval<<6);
	putValue(P_FSG_41_0_0_43_9,thisval);
}

on envVar P_FSG_41_0_0_43_9_7
{
	byte bitval;
	//thisval steht hier fuer den bitfield-wert, 
	//aus Generierungsgruenden hier keine einheitliche Bezeichnung moeglich.
	byte thisval; // CallOptions2
	bitval= getValue(this);
	thisval = getValue(P_FSG_41_0_0_43_9);
	thisval = thisval&~(1<<7)|(bitval<<7);
	putValue(P_FSG_41_0_0_43_9,thisval);
}

on envVar P_FSG_41_0_0_43_9 // CallState3.CallOptions2
{
	P_FSG_41_0_0_43_BuildFct();
}

on envVar P_FSG_41_0_0_43_10 // CallState3.CallState3
{
	P_FSG_41_0_0_43_BuildFct();
}

on envVar P_FSG_41_0_0_43_11 // CallState3.CallType3
{
	P_FSG_41_0_0_43_BuildFct();
}

on envVar P_FSG_41_0_0_43_12_0
{
	byte bitval;
	//thisval steht hier fuer den bitfield-wert, 
	//aus Generierungsgruenden hier keine einheitliche Bezeichnung moeglich.
	byte thisval; // CallOptions3
	bitval= getValue(this);
	thisval = getValue(P_FSG_41_0_0_43_12);
	thisval = thisval&~(1<<0)|(bitval<<0);
	putValue(P_FSG_41_0_0_43_12,thisval);
}

on envVar P_FSG_41_0_0_43_12_1
{
	byte bitval;
	//thisval steht hier fuer den bitfield-wert, 
	//aus Generierungsgruenden hier keine einheitliche Bezeichnung moeglich.
	byte thisval; // CallOptions3
	bitval= getValue(this);
	thisval = getValue(P_FSG_41_0_0_43_12);
	thisval = thisval&~(1<<1)|(bitval<<1);
	putValue(P_FSG_41_0_0_43_12,thisval);
}

on envVar P_FSG_41_0_0_43_12_2
{
	byte bitval;
	//thisval steht hier fuer den bitfield-wert, 
	//aus Generierungsgruenden hier keine einheitliche Bezeichnung moeglich.
	byte thisval; // CallOptions3
	bitval= getValue(this);
	thisval = getValue(P_FSG_41_0_0_43_12);
	thisval = thisval&~(1<<2)|(bitval<<2);
	putValue(P_FSG_41_0_0_43_12,thisval);
}

on envVar P_FSG_41_0_0_43_12_3
{
	byte bitval;
	//thisval steht hier fuer den bitfield-wert, 
	//aus Generierungsgruenden hier keine einheitliche Bezeichnung moeglich.
	byte thisval; // CallOptions3
	bitval= getValue(this);
	thisval = getValue(P_FSG_41_0_0_43_12);
	thisval = thisval&~(1<<3)|(bitval<<3);
	putValue(P_FSG_41_0_0_43_12,thisval);
}

on envVar P_FSG_41_0_0_43_12_4
{
	byte bitval;
	//thisval steht hier fuer den bitfield-wert, 
	//aus Generierungsgruenden hier keine einheitliche Bezeichnung moeglich.
	byte thisval; // CallOptions3
	bitval= getValue(this);
	thisval = getValue(P_FSG_41_0_0_43_12);
	thisval = thisval&~(1<<4)|(bitval<<4);
	putValue(P_FSG_41_0_0_43_12,thisval);
}

on envVar P_FSG_41_0_0_43_12_5
{
	byte bitval;
	//thisval steht hier fuer den bitfield-wert, 
	//aus Generierungsgruenden hier keine einheitliche Bezeichnung moeglich.
	byte thisval; // CallOptions3
	bitval= getValue(this);
	thisval = getValue(P_FSG_41_0_0_43_12);
	thisval = thisval&~(1<<5)|(bitval<<5);
	putValue(P_FSG_41_0_0_43_12,thisval);
}

on envVar P_FSG_41_0_0_43_12_6
{
	byte bitval;
	//thisval steht hier fuer den bitfield-wert, 
	//aus Generierungsgruenden hier keine einheitliche Bezeichnung moeglich.
	byte thisval; // CallOptions3
	bitval= getValue(this);
	thisval = getValue(P_FSG_41_0_0_43_12);
	thisval = thisval&~(1<<6)|(bitval<<6);
	putValue(P_FSG_41_0_0_43_12,thisval);
}

on envVar P_FSG_41_0_0_43_12_7
{
	byte bitval;
	//thisval steht hier fuer den bitfield-wert, 
	//aus Generierungsgruenden hier keine einheitliche Bezeichnung moeglich.
	byte thisval; // CallOptions3
	bitval= getValue(this);
	thisval = getValue(P_FSG_41_0_0_43_12);
	thisval = thisval&~(1<<7)|(bitval<<7);
	putValue(P_FSG_41_0_0_43_12,thisval);
}

on envVar P_FSG_41_0_0_43_12 // CallState3.CallOptions3
{
	P_FSG_41_0_0_43_BuildFct();
}

on envVar P_FSG_41_0_0_43_13 // CallState3.CallState4
{
	P_FSG_41_0_0_43_BuildFct();
}

on envVar P_FSG_41_0_0_43_14 // CallState3.CallType4
{
	P_FSG_41_0_0_43_BuildFct();
}

on envVar P_FSG_41_0_0_43_15_0
{
	byte bitval;
	//thisval steht hier fuer den bitfield-wert, 
	//aus Generierungsgruenden hier keine einheitliche Bezeichnung moeglich.
	byte thisval; // CallOptions4
	bitval= getValue(this);
	thisval = getValue(P_FSG_41_0_0_43_15);
	thisval = thisval&~(1<<0)|(bitval<<0);
	putValue(P_FSG_41_0_0_43_15,thisval);
}

on envVar P_FSG_41_0_0_43_15_1
{
	byte bitval;
	//thisval steht hier fuer den bitfield-wert, 
	//aus Generierungsgruenden hier keine einheitliche Bezeichnung moeglich.
	byte thisval; // CallOptions4
	bitval= getValue(this);
	thisval = getValue(P_FSG_41_0_0_43_15);
	thisval = thisval&~(1<<1)|(bitval<<1);
	putValue(P_FSG_41_0_0_43_15,thisval);
}

on envVar P_FSG_41_0_0_43_15_2
{
	byte bitval;
	//thisval steht hier fuer den bitfield-wert, 
	//aus Generierungsgruenden hier keine einheitliche Bezeichnung moeglich.
	byte thisval; // CallOptions4
	bitval= getValue(this);
	thisval = getValue(P_FSG_41_0_0_43_15);
	thisval = thisval&~(1<<2)|(bitval<<2);
	putValue(P_FSG_41_0_0_43_15,thisval);
}

on envVar P_FSG_41_0_0_43_15_3
{
	byte bitval;
	//thisval steht hier fuer den bitfield-wert, 
	//aus Generierungsgruenden hier keine einheitliche Bezeichnung moeglich.
	byte thisval; // CallOptions4
	bitval= getValue(this);
	thisval = getValue(P_FSG_41_0_0_43_15);
	thisval = thisval&~(1<<3)|(bitval<<3);
	putValue(P_FSG_41_0_0_43_15,thisval);
}

on envVar P_FSG_41_0_0_43_15_4
{
	byte bitval;
	//thisval steht hier fuer den bitfield-wert, 
	//aus Generierungsgruenden hier keine einheitliche Bezeichnung moeglich.
	byte thisval; // CallOptions4
	bitval= getValue(this);
	thisval = getValue(P_FSG_41_0_0_43_15);
	thisval = thisval&~(1<<4)|(bitval<<4);
	putValue(P_FSG_41_0_0_43_15,thisval);
}

on envVar P_FSG_41_0_0_43_15_5
{
	byte bitval;
	//thisval steht hier fuer den bitfield-wert, 
	//aus Generierungsgruenden hier keine einheitliche Bezeichnung moeglich.
	byte thisval; // CallOptions4
	bitval= getValue(this);
	thisval = getValue(P_FSG_41_0_0_43_15);
	thisval = thisval&~(1<<5)|(bitval<<5);
	putValue(P_FSG_41_0_0_43_15,thisval);
}

on envVar P_FSG_41_0_0_43_15_6
{
	byte bitval;
	//thisval steht hier fuer den bitfield-wert, 
	//aus Generierungsgruenden hier keine einheitliche Bezeichnung moeglich.
	byte thisval; // CallOptions4
	bitval= getValue(this);
	thisval = getValue(P_FSG_41_0_0_43_15);
	thisval = thisval&~(1<<6)|(bitval<<6);
	putValue(P_FSG_41_0_0_43_15,thisval);
}

on envVar P_FSG_41_0_0_43_15_7
{
	byte bitval;
	//thisval steht hier fuer den bitfield-wert, 
	//aus Generierungsgruenden hier keine einheitliche Bezeichnung moeglich.
	byte thisval; // CallOptions4
	bitval= getValue(this);
	thisval = getValue(P_FSG_41_0_0_43_15);
	thisval = thisval&~(1<<7)|(bitval<<7);
	putValue(P_FSG_41_0_0_43_15,thisval);
}

on envVar P_FSG_41_0_0_43_15 // CallState3.CallOptions4
{
	P_FSG_41_0_0_43_BuildFct();
}

on envVar P_FSG_41_0_0_43_16 // CallState3.CallState5
{
	P_FSG_41_0_0_43_BuildFct();
}

on envVar P_FSG_41_0_0_43_17 // CallState3.CallType5
{
	P_FSG_41_0_0_43_BuildFct();
}

on envVar P_FSG_41_0_0_43_18_0
{
	byte bitval;
	//thisval steht hier fuer den bitfield-wert, 
	//aus Generierungsgruenden hier keine einheitliche Bezeichnung moeglich.
	byte thisval; // CallOptions5
	bitval= getValue(this);
	thisval = getValue(P_FSG_41_0_0_43_18);
	thisval = thisval&~(1<<0)|(bitval<<0);
	putValue(P_FSG_41_0_0_43_18,thisval);
}

on envVar P_FSG_41_0_0_43_18_1
{
	byte bitval;
	//thisval steht hier fuer den bitfield-wert, 
	//aus Generierungsgruenden hier keine einheitliche Bezeichnung moeglich.
	byte thisval; // CallOptions5
	bitval= getValue(this);
	thisval = getValue(P_FSG_41_0_0_43_18);
	thisval = thisval&~(1<<1)|(bitval<<1);
	putValue(P_FSG_41_0_0_43_18,thisval);
}

on envVar P_FSG_41_0_0_43_18_2
{
	byte bitval;
	//thisval steht hier fuer den bitfield-wert, 
	//aus Generierungsgruenden hier keine einheitliche Bezeichnung moeglich.
	byte thisval; // CallOptions5
	bitval= getValue(this);
	thisval = getValue(P_FSG_41_0_0_43_18);
	thisval = thisval&~(1<<2)|(bitval<<2);
	putValue(P_FSG_41_0_0_43_18,thisval);
}

on envVar P_FSG_41_0_0_43_18_3
{
	byte bitval;
	//thisval steht hier fuer den bitfield-wert, 
	//aus Generierungsgruenden hier keine einheitliche Bezeichnung moeglich.
	byte thisval; // CallOptions5
	bitval= getValue(this);
	thisval = getValue(P_FSG_41_0_0_43_18);
	thisval = thisval&~(1<<3)|(bitval<<3);
	putValue(P_FSG_41_0_0_43_18,thisval);
}

on envVar P_FSG_41_0_0_43_18_4
{
	byte bitval;
	//thisval steht hier fuer den bitfield-wert, 
	//aus Generierungsgruenden hier keine einheitliche Bezeichnung moeglich.
	byte thisval; // CallOptions5
	bitval= getValue(this);
	thisval = getValue(P_FSG_41_0_0_43_18);
	thisval = thisval&~(1<<4)|(bitval<<4);
	putValue(P_FSG_41_0_0_43_18,thisval);
}

on envVar P_FSG_41_0_0_43_18_5
{
	byte bitval;
	//thisval steht hier fuer den bitfield-wert, 
	//aus Generierungsgruenden hier keine einheitliche Bezeichnung moeglich.
	byte thisval; // CallOptions5
	bitval= getValue(this);
	thisval = getValue(P_FSG_41_0_0_43_18);
	thisval = thisval&~(1<<5)|(bitval<<5);
	putValue(P_FSG_41_0_0_43_18,thisval);
}

on envVar P_FSG_41_0_0_43_18_6
{
	byte bitval;
	//thisval steht hier fuer den bitfield-wert, 
	//aus Generierungsgruenden hier keine einheitliche Bezeichnung moeglich.
	byte thisval; // CallOptions5
	bitval= getValue(this);
	thisval = getValue(P_FSG_41_0_0_43_18);
	thisval = thisval&~(1<<6)|(bitval<<6);
	putValue(P_FSG_41_0_0_43_18,thisval);
}

on envVar P_FSG_41_0_0_43_18_7
{
	byte bitval;
	//thisval steht hier fuer den bitfield-wert, 
	//aus Generierungsgruenden hier keine einheitliche Bezeichnung moeglich.
	byte thisval; // CallOptions5
	bitval= getValue(this);
	thisval = getValue(P_FSG_41_0_0_43_18);
	thisval = thisval&~(1<<7)|(bitval<<7);
	putValue(P_FSG_41_0_0_43_18,thisval);
}

on envVar P_FSG_41_0_0_43_18 // CallState3.CallOptions5
{
	P_FSG_41_0_0_43_BuildFct();
}

on envVar P_FSG_41_0_0_43_19 // CallState3.CallState6
{
	P_FSG_41_0_0_43_BuildFct();
}

on envVar P_FSG_41_0_0_43_20 // CallState3.CallType6
{
	P_FSG_41_0_0_43_BuildFct();
}

on envVar P_FSG_41_0_0_43_21_0
{
	byte bitval;
	//thisval steht hier fuer den bitfield-wert, 
	//aus Generierungsgruenden hier keine einheitliche Bezeichnung moeglich.
	byte thisval; // CallOptions6
	bitval= getValue(this);
	thisval = getValue(P_FSG_41_0_0_43_21);
	thisval = thisval&~(1<<0)|(bitval<<0);
	putValue(P_FSG_41_0_0_43_21,thisval);
}

on envVar P_FSG_41_0_0_43_21_1
{
	byte bitval;
	//thisval steht hier fuer den bitfield-wert, 
	//aus Generierungsgruenden hier keine einheitliche Bezeichnung moeglich.
	byte thisval; // CallOptions6
	bitval= getValue(this);
	thisval = getValue(P_FSG_41_0_0_43_21);
	thisval = thisval&~(1<<1)|(bitval<<1);
	putValue(P_FSG_41_0_0_43_21,thisval);
}

on envVar P_FSG_41_0_0_43_21_2
{
	byte bitval;
	//thisval steht hier fuer den bitfield-wert, 
	//aus Generierungsgruenden hier keine einheitliche Bezeichnung moeglich.
	byte thisval; // CallOptions6
	bitval= getValue(this);
	thisval = getValue(P_FSG_41_0_0_43_21);
	thisval = thisval&~(1<<2)|(bitval<<2);
	putValue(P_FSG_41_0_0_43_21,thisval);
}

on envVar P_FSG_41_0_0_43_21_3
{
	byte bitval;
	//thisval steht hier fuer den bitfield-wert, 
	//aus Generierungsgruenden hier keine einheitliche Bezeichnung moeglich.
	byte thisval; // CallOptions6
	bitval= getValue(this);
	thisval = getValue(P_FSG_41_0_0_43_21);
	thisval = thisval&~(1<<3)|(bitval<<3);
	putValue(P_FSG_41_0_0_43_21,thisval);
}

on envVar P_FSG_41_0_0_43_21_4
{
	byte bitval;
	//thisval steht hier fuer den bitfield-wert, 
	//aus Generierungsgruenden hier keine einheitliche Bezeichnung moeglich.
	byte thisval; // CallOptions6
	bitval= getValue(this);
	thisval = getValue(P_FSG_41_0_0_43_21);
	thisval = thisval&~(1<<4)|(bitval<<4);
	putValue(P_FSG_41_0_0_43_21,thisval);
}

on envVar P_FSG_41_0_0_43_21_5
{
	byte bitval;
	//thisval steht hier fuer den bitfield-wert, 
	//aus Generierungsgruenden hier keine einheitliche Bezeichnung moeglich.
	byte thisval; // CallOptions6
	bitval= getValue(this);
	thisval = getValue(P_FSG_41_0_0_43_21);
	thisval = thisval&~(1<<5)|(bitval<<5);
	putValue(P_FSG_41_0_0_43_21,thisval);
}

on envVar P_FSG_41_0_0_43_21_6
{
	byte bitval;
	//thisval steht hier fuer den bitfield-wert, 
	//aus Generierungsgruenden hier keine einheitliche Bezeichnung moeglich.
	byte thisval; // CallOptions6
	bitval= getValue(this);
	thisval = getValue(P_FSG_41_0_0_43_21);
	thisval = thisval&~(1<<6)|(bitval<<6);
	putValue(P_FSG_41_0_0_43_21,thisval);
}

on envVar P_FSG_41_0_0_43_21_7
{
	byte bitval;
	//thisval steht hier fuer den bitfield-wert, 
	//aus Generierungsgruenden hier keine einheitliche Bezeichnung moeglich.
	byte thisval; // CallOptions6
	bitval= getValue(this);
	thisval = getValue(P_FSG_41_0_0_43_21);
	thisval = thisval&~(1<<7)|(bitval<<7);
	putValue(P_FSG_41_0_0_43_21,thisval);
}

on envVar P_FSG_41_0_0_43_21 // CallState3.CallOptions6
{
	P_FSG_41_0_0_43_BuildFct();
}

on envVar P_FSG_41_0_0_43_22_0
{
	byte bitval;
	//thisval steht hier fuer den bitfield-wert, 
	//aus Generierungsgruenden hier keine einheitliche Bezeichnung moeglich.
	byte thisval; // CallIncomingDiverted
	bitval= getValue(this);
	thisval = getValue(P_FSG_41_0_0_43_22);
	thisval = thisval&~(1<<0)|(bitval<<0);
	putValue(P_FSG_41_0_0_43_22,thisval);
}

on envVar P_FSG_41_0_0_43_22_1
{
	byte bitval;
	//thisval steht hier fuer den bitfield-wert, 
	//aus Generierungsgruenden hier keine einheitliche Bezeichnung moeglich.
	byte thisval; // CallIncomingDiverted
	bitval= getValue(this);
	thisval = getValue(P_FSG_41_0_0_43_22);
	thisval = thisval&~(1<<1)|(bitval<<1);
	putValue(P_FSG_41_0_0_43_22,thisval);
}

on envVar P_FSG_41_0_0_43_22_2
{
	byte bitval;
	//thisval steht hier fuer den bitfield-wert, 
	//aus Generierungsgruenden hier keine einheitliche Bezeichnung moeglich.
	byte thisval; // CallIncomingDiverted
	bitval= getValue(this);
	thisval = getValue(P_FSG_41_0_0_43_22);
	thisval = thisval&~(1<<2)|(bitval<<2);
	putValue(P_FSG_41_0_0_43_22,thisval);
}

on envVar P_FSG_41_0_0_43_22_3
{
	byte bitval;
	//thisval steht hier fuer den bitfield-wert, 
	//aus Generierungsgruenden hier keine einheitliche Bezeichnung moeglich.
	byte thisval; // CallIncomingDiverted
	bitval= getValue(this);
	thisval = getValue(P_FSG_41_0_0_43_22);
	thisval = thisval&~(1<<3)|(bitval<<3);
	putValue(P_FSG_41_0_0_43_22,thisval);
}

on envVar P_FSG_41_0_0_43_22_4
{
	byte bitval;
	//thisval steht hier fuer den bitfield-wert, 
	//aus Generierungsgruenden hier keine einheitliche Bezeichnung moeglich.
	byte thisval; // CallIncomingDiverted
	bitval= getValue(this);
	thisval = getValue(P_FSG_41_0_0_43_22);
	thisval = thisval&~(1<<4)|(bitval<<4);
	putValue(P_FSG_41_0_0_43_22,thisval);
}

on envVar P_FSG_41_0_0_43_22_5
{
	byte bitval;
	//thisval steht hier fuer den bitfield-wert, 
	//aus Generierungsgruenden hier keine einheitliche Bezeichnung moeglich.
	byte thisval; // CallIncomingDiverted
	bitval= getValue(this);
	thisval = getValue(P_FSG_41_0_0_43_22);
	thisval = thisval&~(1<<5)|(bitval<<5);
	putValue(P_FSG_41_0_0_43_22,thisval);
}

on envVar P_FSG_41_0_0_43_22_6
{
	byte bitval;
	//thisval steht hier fuer den bitfield-wert, 
	//aus Generierungsgruenden hier keine einheitliche Bezeichnung moeglich.
	byte thisval; // CallIncomingDiverted
	bitval= getValue(this);
	thisval = getValue(P_FSG_41_0_0_43_22);
	thisval = thisval&~(1<<6)|(bitval<<6);
	putValue(P_FSG_41_0_0_43_22,thisval);
}

on envVar P_FSG_41_0_0_43_22 // CallState3.CallIncomingDiverted
{
	P_FSG_41_0_0_43_BuildFct();
}

on envVar P_FSG_41_0_0_43_23_0
{
	byte bitval;
	//thisval steht hier fuer den bitfield-wert, 
	//aus Generierungsgruenden hier keine einheitliche Bezeichnung moeglich.
	byte thisval; // CallOutgoingDiverted_eCallConfirmationPending
	bitval= getValue(this);
	thisval = getValue(P_FSG_41_0_0_43_23);
	thisval = thisval&~(1<<0)|(bitval<<0);
	putValue(P_FSG_41_0_0_43_23,thisval);
}

on envVar P_FSG_41_0_0_43_23_1
{
	byte bitval;
	//thisval steht hier fuer den bitfield-wert, 
	//aus Generierungsgruenden hier keine einheitliche Bezeichnung moeglich.
	byte thisval; // CallOutgoingDiverted_eCallConfirmationPending
	bitval= getValue(this);
	thisval = getValue(P_FSG_41_0_0_43_23);
	thisval = thisval&~(1<<1)|(bitval<<1);
	putValue(P_FSG_41_0_0_43_23,thisval);
}

on envVar P_FSG_41_0_0_43_23_2
{
	byte bitval;
	//thisval steht hier fuer den bitfield-wert, 
	//aus Generierungsgruenden hier keine einheitliche Bezeichnung moeglich.
	byte thisval; // CallOutgoingDiverted_eCallConfirmationPending
	bitval= getValue(this);
	thisval = getValue(P_FSG_41_0_0_43_23);
	thisval = thisval&~(1<<2)|(bitval<<2);
	putValue(P_FSG_41_0_0_43_23,thisval);
}

on envVar P_FSG_41_0_0_43_23_3
{
	byte bitval;
	//thisval steht hier fuer den bitfield-wert, 
	//aus Generierungsgruenden hier keine einheitliche Bezeichnung moeglich.
	byte thisval; // CallOutgoingDiverted_eCallConfirmationPending
	bitval= getValue(this);
	thisval = getValue(P_FSG_41_0_0_43_23);
	thisval = thisval&~(1<<3)|(bitval<<3);
	putValue(P_FSG_41_0_0_43_23,thisval);
}

on envVar P_FSG_41_0_0_43_23_4
{
	byte bitval;
	//thisval steht hier fuer den bitfield-wert, 
	//aus Generierungsgruenden hier keine einheitliche Bezeichnung moeglich.
	byte thisval; // CallOutgoingDiverted_eCallConfirmationPending
	bitval= getValue(this);
	thisval = getValue(P_FSG_41_0_0_43_23);
	thisval = thisval&~(1<<4)|(bitval<<4);
	putValue(P_FSG_41_0_0_43_23,thisval);
}

on envVar P_FSG_41_0_0_43_23_5
{
	byte bitval;
	//thisval steht hier fuer den bitfield-wert, 
	//aus Generierungsgruenden hier keine einheitliche Bezeichnung moeglich.
	byte thisval; // CallOutgoingDiverted_eCallConfirmationPending
	bitval= getValue(this);
	thisval = getValue(P_FSG_41_0_0_43_23);
	thisval = thisval&~(1<<5)|(bitval<<5);
	putValue(P_FSG_41_0_0_43_23,thisval);
}

on envVar P_FSG_41_0_0_43_23_6
{
	byte bitval;
	//thisval steht hier fuer den bitfield-wert, 
	//aus Generierungsgruenden hier keine einheitliche Bezeichnung moeglich.
	byte thisval; // CallOutgoingDiverted_eCallConfirmationPending
	bitval= getValue(this);
	thisval = getValue(P_FSG_41_0_0_43_23);
	thisval = thisval&~(1<<6)|(bitval<<6);
	putValue(P_FSG_41_0_0_43_23,thisval);
}

on envVar P_FSG_41_0_0_43_23_7
{
	byte bitval;
	//thisval steht hier fuer den bitfield-wert, 
	//aus Generierungsgruenden hier keine einheitliche Bezeichnung moeglich.
	byte thisval; // CallOutgoingDiverted_eCallConfirmationPending
	bitval= getValue(this);
	thisval = getValue(P_FSG_41_0_0_43_23);
	thisval = thisval&~(1<<7)|(bitval<<7);
	putValue(P_FSG_41_0_0_43_23,thisval);
}

on envVar P_FSG_41_0_0_43_23 // CallState3.CallOutgoingDiverted_eCallConfirmationPending
{
	P_FSG_41_0_0_43_BuildFct();
}

// Ruecksetzen des Fehlerstatus durch manuelle Fehlereingabe
on envVar P_FSG_41_0_0_44_ErrCode
{
       if(gP_FSG_41_0_0_44_ErrCode) 
       {
           setControlBackColor(panel_name,"errfield_P_FSG_41_0_0_44", MakeRGB(255,255,255));
       }
       gP_FSG_41_0_0_44_ErrCode = 1;
}
on envVar P_FSG_41_0_0_44Status_BTN
{
	byte BAPTemp[994];
    if (P_FSG_41_0_0_44Status_BTN_already_pressed == 0)
    {
        putValue(P_FSG_41_0_0_44_ErrCode,0);
        SetControlBackColor(panel_name,"errField_P_FSG_41_0_0_44",MakeRGB(255,255,255));
        P_FSG_41_0_0_44Status_BTN_already_pressed = 1;
    }
    else
    {
		P_FSG_41_0_0_44_BuildFct();
        getValue(P_FSG_41_0_0_44, BAPTemp);
        Request_ByteSequence(LSGID, P_FSG_41_0_0_44_ID, Data_REQ, BAPTemp, getValueSize(P_FSG_41_0_0_44));
        if(getValue(P_FSG_41_0_0_44_IntTlgEn)) //getValue(IT))
        {
           intertelegram_err(P_FSG_41_0_0_44_ID);
        }
        if(getValue(P_FSG_41_0_0_44_SegmEn))   //getvalue(SG)
        {
           sequence_err(P_FSG_41_0_0_44_ID,elCount(BAPTemp));
        }
       P_FSG_41_0_0_44Status_BTN_already_pressed = 0;
    }
}
on envVar P_FSG_41_0_0_44_FctEn
{
    long data[3];
    data[0]=LSGID;
    data[1]=P_FSG_41_0_0_44_ID;
    data[2]=getValue(P_FSG_41_0_0_44_FctEn);
    ChangeConfig(0x0031,data);
}
// De-Aktivierung der Eingabefelder der FCTID P_FSG_41_0_0_44
on envVar P_FSG_41_0_0_44_FctLstItemEn
{
       if(getValue(this)) 
       {
           EnableControl(panel_name,"panel_FSG_41_0_0_44",1);
           EnableControl(panel_name,"errfield_P_FSG_41_0_0_44",1);
           EnableControl(panel_name,"panel_P_FSG_41_0_0_44",1);
           setControlForeColor(panel_name, "checkbox_P_FSG_41_0_0_44", MakeRGB(0,240,0));
       }
       else
       {
           EnableControl(panel_name,"panel_FSG_41_0_0_44",0);
           EnableControl(panel_name,"errfield_P_FSG_41_0_0_44",0);
           EnableControl(panel_name,"panel_P_FSG_41_0_0_44",0);
           setControlForeColor(panel_name, "checkbox_P_FSG_41_0_0_44", MakeRGB(250,0,0));
       }
}
// Man darf gleichzeitig nur Checkbox fuer SegmError oder IntertelegramError aktiviert werden
on envVar P_FSG_41_0_0_44_IntTlgEn
{
       if(getValue(this)) 
       {
           putValue(P_FSG_41_0_0_44_SegmEn,0);
           intertelegram_err(P_FSG_41_0_0_44_ID);
       }
       else
       {
           intertelegram_err_off(P_FSG_41_0_0_44_ID);
       }
}
// Man darf gleichzeitig nur Checkbox fuer SegmError oder IntertelegramError aktiviert werden
on envVar P_FSG_41_0_0_44_SegmEn
{
       if(getValue(this)) 
       {
           putValue(P_FSG_41_0_0_44_IntTlgEn,0);
           sequence_err(P_FSG_41_0_0_44_ID,getValueSize(P_FSG_41_0_0_44_SegmEn));
       }
       else
       {
              sequence_err_off(P_FSG_41_0_0_44_ID);
       }
}
on envVar P_FSG_41_0_0_44 // bus value of CallInfo3 (44).
{
	// opcodes: Error-Status
	byte param1[100]; // PbName0
	word len1;
	byte cnt1;
	byte param2[41]; // TelNumber0
	word len2;
	byte cnt2;
	byte param3; // Category0
	byte param4[100]; // PbName1
	word len4;
	byte cnt4;
	byte param5[41]; // TelNumber1
	word len5;
	byte cnt5;
	byte param6; // Category1
	byte param7[100]; // PbName2
	word len7;
	byte cnt7;
	byte param8[41]; // TelNumber2
	word len8;
	byte cnt8;
	byte param9; // Category2
	byte param10[100]; // PbName3
	word len10;
	byte cnt10;
	byte param11[41]; // TelNumber3
	word len11;
	byte cnt11;
	byte param12; // Category3
	byte param13[100]; // PbName4
	word len13;
	byte cnt13;
	byte param14[41]; // TelNumber4
	word len14;
	byte cnt14;
	byte param15; // Category4
	byte param16[100]; // PbName5
	word len16;
	byte cnt16;
	byte param17[41]; // TelNumber5
	word len17;
	byte cnt17;
	byte param18; // Category5
	byte param19[100]; // PbName6
	word len19;
	byte cnt19;
	byte param20[41]; // TelNumber6
	word len20;
	byte cnt20;
	byte param21; // Category6
	// DATATYPE_BYTESEQUENCE / DATATYPE_FIXEDBYTESEQUENCE
	int i;
	byte superval[994];
	int currentPos;
	currentPos = 0;
	for( i = 0; i < 994; i++ ) {
		superval[i] = 0;
	}
	getValue(P_FSG_41_0_0_44, superval);
	///////// Start param1 - STRING /////////
	getValue(P_FSG_41_0_0_44_1_Hex, param1);
	if((superval[currentPos] & 0x80) > 0)
	{
		if(99>127) /* Max Fct-Katalog Laenge: 99*/
		{
			len1 = ( (superval[currentPos]&0x7F) <<8) + superval[currentPos+1];
			currentPos = currentPos + 2;
			cnt1 = 1;
		}
		else
		{
			len1 = 99;
			writelineEx(gBAP_Trace, 0, "Anzahl der Laengeninformation-Bytes in P_FSG_41_0_0_44 ueberschreitet die erlaubte 1 Byte vom Fct-Kalatog.");
		}
	}
	else
	{
		len1 = superval[currentPos]&0x7F;
		currentPos = currentPos + 1;
		cnt1 = 0;
	}
	
	if(len1 > 99)
	{
		writelineEx(gBAP_Trace, 0, "Laenge:%d bei der Byte Position:%d ueberschreitet die Maximale erlaubte Laenge von Fct-Kalatog", len1, currentPos);
		len1 = 99;
	
		if(len1 < 128) cnt1 = 0;
		else cnt1 = 1;
	}
	
	for(i = 0; i < len1; i++)
	{
		param1[i] = superval[currentPos++];
	}
	
	putValue(P_FSG_41_0_0_44_1_len, len1);
	putValue(P_FSG_41_0_0_44_1_cnt, cnt1);
	
	if(len1 > getValueSize(P_FSG_41_0_0_44_1_Hex))
		putValue(P_FSG_41_0_0_44_1_Hex, param1, len1);
	else
		putValue(P_FSG_41_0_0_44_1_Hex, param1, getValueSize(P_FSG_41_0_0_44_1_Hex));

	///////// Start param2 - STRING /////////
	getValue(P_FSG_41_0_0_44_2_Hex, param2);
	if((superval[currentPos] & 0x80) > 0)
	{
		if(40>127) /* Max Fct-Katalog Laenge: 40*/
		{
			len2 = ( (superval[currentPos]&0x7F) <<8) + superval[currentPos+1];
			currentPos = currentPos + 2;
			cnt2 = 1;
		}
		else
		{
			len2 = 40;
			writelineEx(gBAP_Trace, 0, "Anzahl der Laengeninformation-Bytes in P_FSG_41_0_0_44 ueberschreitet die erlaubte 1 Byte vom Fct-Kalatog.");
		}
	}
	else
	{
		len2 = superval[currentPos]&0x7F;
		currentPos = currentPos + 1;
		cnt2 = 0;
	}
	
	if(len2 > 40)
	{
		writelineEx(gBAP_Trace, 0, "Laenge:%d bei der Byte Position:%d ueberschreitet die Maximale erlaubte Laenge von Fct-Kalatog", len2, currentPos);
		len2 = 40;
	
		if(len2 < 128) cnt2 = 0;
		else cnt2 = 1;
	}
	
	for(i = 0; i < len2; i++)
	{
		param2[i] = superval[currentPos++];
	}
	
	putValue(P_FSG_41_0_0_44_2_len, len2);
	putValue(P_FSG_41_0_0_44_2_cnt, cnt2);
	
	if(len2 > getValueSize(P_FSG_41_0_0_44_2_Hex))
		putValue(P_FSG_41_0_0_44_2_Hex, param2, len2);
	else
		putValue(P_FSG_41_0_0_44_2_Hex, param2, getValueSize(P_FSG_41_0_0_44_2_Hex));

	///////// Start param3 - UINT8 /////////
	param3 = superval[currentPos++];
	putValue(P_FSG_41_0_0_44_3, param3);
	///////// Start param4 - STRING /////////
	getValue(P_FSG_41_0_0_44_4_Hex, param4);
	if((superval[currentPos] & 0x80) > 0)
	{
		if(99>127) /* Max Fct-Katalog Laenge: 99*/
		{
			len4 = ( (superval[currentPos]&0x7F) <<8) + superval[currentPos+1];
			currentPos = currentPos + 2;
			cnt4 = 1;
		}
		else
		{
			len4 = 99;
			writelineEx(gBAP_Trace, 0, "Anzahl der Laengeninformation-Bytes in P_FSG_41_0_0_44 ueberschreitet die erlaubte 1 Byte vom Fct-Kalatog.");
		}
	}
	else
	{
		len4 = superval[currentPos]&0x7F;
		currentPos = currentPos + 1;
		cnt4 = 0;
	}
	
	if(len4 > 99)
	{
		writelineEx(gBAP_Trace, 0, "Laenge:%d bei der Byte Position:%d ueberschreitet die Maximale erlaubte Laenge von Fct-Kalatog", len4, currentPos);
		len4 = 99;
	
		if(len4 < 128) cnt4 = 0;
		else cnt4 = 1;
	}
	
	for(i = 0; i < len4; i++)
	{
		param4[i] = superval[currentPos++];
	}
	
	putValue(P_FSG_41_0_0_44_4_len, len4);
	putValue(P_FSG_41_0_0_44_4_cnt, cnt4);
	
	if(len4 > getValueSize(P_FSG_41_0_0_44_4_Hex))
		putValue(P_FSG_41_0_0_44_4_Hex, param4, len4);
	else
		putValue(P_FSG_41_0_0_44_4_Hex, param4, getValueSize(P_FSG_41_0_0_44_4_Hex));

	///////// Start param5 - STRING /////////
	getValue(P_FSG_41_0_0_44_5_Hex, param5);
	if((superval[currentPos] & 0x80) > 0)
	{
		if(40>127) /* Max Fct-Katalog Laenge: 40*/
		{
			len5 = ( (superval[currentPos]&0x7F) <<8) + superval[currentPos+1];
			currentPos = currentPos + 2;
			cnt5 = 1;
		}
		else
		{
			len5 = 40;
			writelineEx(gBAP_Trace, 0, "Anzahl der Laengeninformation-Bytes in P_FSG_41_0_0_44 ueberschreitet die erlaubte 1 Byte vom Fct-Kalatog.");
		}
	}
	else
	{
		len5 = superval[currentPos]&0x7F;
		currentPos = currentPos + 1;
		cnt5 = 0;
	}
	
	if(len5 > 40)
	{
		writelineEx(gBAP_Trace, 0, "Laenge:%d bei der Byte Position:%d ueberschreitet die Maximale erlaubte Laenge von Fct-Kalatog", len5, currentPos);
		len5 = 40;
	
		if(len5 < 128) cnt5 = 0;
		else cnt5 = 1;
	}
	
	for(i = 0; i < len5; i++)
	{
		param5[i] = superval[currentPos++];
	}
	
	putValue(P_FSG_41_0_0_44_5_len, len5);
	putValue(P_FSG_41_0_0_44_5_cnt, cnt5);
	
	if(len5 > getValueSize(P_FSG_41_0_0_44_5_Hex))
		putValue(P_FSG_41_0_0_44_5_Hex, param5, len5);
	else
		putValue(P_FSG_41_0_0_44_5_Hex, param5, getValueSize(P_FSG_41_0_0_44_5_Hex));

	///////// Start param6 - UINT8 /////////
	param6 = superval[currentPos++];
	putValue(P_FSG_41_0_0_44_6, param6);
	///////// Start param7 - STRING /////////
	getValue(P_FSG_41_0_0_44_7_Hex, param7);
	if((superval[currentPos] & 0x80) > 0)
	{
		if(99>127) /* Max Fct-Katalog Laenge: 99*/
		{
			len7 = ( (superval[currentPos]&0x7F) <<8) + superval[currentPos+1];
			currentPos = currentPos + 2;
			cnt7 = 1;
		}
		else
		{
			len7 = 99;
			writelineEx(gBAP_Trace, 0, "Anzahl der Laengeninformation-Bytes in P_FSG_41_0_0_44 ueberschreitet die erlaubte 1 Byte vom Fct-Kalatog.");
		}
	}
	else
	{
		len7 = superval[currentPos]&0x7F;
		currentPos = currentPos + 1;
		cnt7 = 0;
	}
	
	if(len7 > 99)
	{
		writelineEx(gBAP_Trace, 0, "Laenge:%d bei der Byte Position:%d ueberschreitet die Maximale erlaubte Laenge von Fct-Kalatog", len7, currentPos);
		len7 = 99;
	
		if(len7 < 128) cnt7 = 0;
		else cnt7 = 1;
	}
	
	for(i = 0; i < len7; i++)
	{
		param7[i] = superval[currentPos++];
	}
	
	putValue(P_FSG_41_0_0_44_7_len, len7);
	putValue(P_FSG_41_0_0_44_7_cnt, cnt7);
	
	if(len7 > getValueSize(P_FSG_41_0_0_44_7_Hex))
		putValue(P_FSG_41_0_0_44_7_Hex, param7, len7);
	else
		putValue(P_FSG_41_0_0_44_7_Hex, param7, getValueSize(P_FSG_41_0_0_44_7_Hex));

	///////// Start param8 - STRING /////////
	getValue(P_FSG_41_0_0_44_8_Hex, param8);
	if((superval[currentPos] & 0x80) > 0)
	{
		if(40>127) /* Max Fct-Katalog Laenge: 40*/
		{
			len8 = ( (superval[currentPos]&0x7F) <<8) + superval[currentPos+1];
			currentPos = currentPos + 2;
			cnt8 = 1;
		}
		else
		{
			len8 = 40;
			writelineEx(gBAP_Trace, 0, "Anzahl der Laengeninformation-Bytes in P_FSG_41_0_0_44 ueberschreitet die erlaubte 1 Byte vom Fct-Kalatog.");
		}
	}
	else
	{
		len8 = superval[currentPos]&0x7F;
		currentPos = currentPos + 1;
		cnt8 = 0;
	}
	
	if(len8 > 40)
	{
		writelineEx(gBAP_Trace, 0, "Laenge:%d bei der Byte Position:%d ueberschreitet die Maximale erlaubte Laenge von Fct-Kalatog", len8, currentPos);
		len8 = 40;
	
		if(len8 < 128) cnt8 = 0;
		else cnt8 = 1;
	}
	
	for(i = 0; i < len8; i++)
	{
		param8[i] = superval[currentPos++];
	}
	
	putValue(P_FSG_41_0_0_44_8_len, len8);
	putValue(P_FSG_41_0_0_44_8_cnt, cnt8);
	
	if(len8 > getValueSize(P_FSG_41_0_0_44_8_Hex))
		putValue(P_FSG_41_0_0_44_8_Hex, param8, len8);
	else
		putValue(P_FSG_41_0_0_44_8_Hex, param8, getValueSize(P_FSG_41_0_0_44_8_Hex));

	///////// Start param9 - UINT8 /////////
	param9 = superval[currentPos++];
	putValue(P_FSG_41_0_0_44_9, param9);
	///////// Start param10 - STRING /////////
	getValue(P_FSG_41_0_0_44_10_Hex, param10);
	if((superval[currentPos] & 0x80) > 0)
	{
		if(99>127) /* Max Fct-Katalog Laenge: 99*/
		{
			len10 = ( (superval[currentPos]&0x7F) <<8) + superval[currentPos+1];
			currentPos = currentPos + 2;
			cnt10 = 1;
		}
		else
		{
			len10 = 99;
			writelineEx(gBAP_Trace, 0, "Anzahl der Laengeninformation-Bytes in P_FSG_41_0_0_44 ueberschreitet die erlaubte 1 Byte vom Fct-Kalatog.");
		}
	}
	else
	{
		len10 = superval[currentPos]&0x7F;
		currentPos = currentPos + 1;
		cnt10 = 0;
	}
	
	if(len10 > 99)
	{
		writelineEx(gBAP_Trace, 0, "Laenge:%d bei der Byte Position:%d ueberschreitet die Maximale erlaubte Laenge von Fct-Kalatog", len10, currentPos);
		len10 = 99;
	
		if(len10 < 128) cnt10 = 0;
		else cnt10 = 1;
	}
	
	for(i = 0; i < len10; i++)
	{
		param10[i] = superval[currentPos++];
	}
	
	putValue(P_FSG_41_0_0_44_10_len, len10);
	putValue(P_FSG_41_0_0_44_10_cnt, cnt10);
	
	if(len10 > getValueSize(P_FSG_41_0_0_44_10_Hex))
		putValue(P_FSG_41_0_0_44_10_Hex, param10, len10);
	else
		putValue(P_FSG_41_0_0_44_10_Hex, param10, getValueSize(P_FSG_41_0_0_44_10_Hex));

	///////// Start param11 - STRING /////////
	getValue(P_FSG_41_0_0_44_11_Hex, param11);
	if((superval[currentPos] & 0x80) > 0)
	{
		if(40>127) /* Max Fct-Katalog Laenge: 40*/
		{
			len11 = ( (superval[currentPos]&0x7F) <<8) + superval[currentPos+1];
			currentPos = currentPos + 2;
			cnt11 = 1;
		}
		else
		{
			len11 = 40;
			writelineEx(gBAP_Trace, 0, "Anzahl der Laengeninformation-Bytes in P_FSG_41_0_0_44 ueberschreitet die erlaubte 1 Byte vom Fct-Kalatog.");
		}
	}
	else
	{
		len11 = superval[currentPos]&0x7F;
		currentPos = currentPos + 1;
		cnt11 = 0;
	}
	
	if(len11 > 40)
	{
		writelineEx(gBAP_Trace, 0, "Laenge:%d bei der Byte Position:%d ueberschreitet die Maximale erlaubte Laenge von Fct-Kalatog", len11, currentPos);
		len11 = 40;
	
		if(len11 < 128) cnt11 = 0;
		else cnt11 = 1;
	}
	
	for(i = 0; i < len11; i++)
	{
		param11[i] = superval[currentPos++];
	}
	
	putValue(P_FSG_41_0_0_44_11_len, len11);
	putValue(P_FSG_41_0_0_44_11_cnt, cnt11);
	
	if(len11 > getValueSize(P_FSG_41_0_0_44_11_Hex))
		putValue(P_FSG_41_0_0_44_11_Hex, param11, len11);
	else
		putValue(P_FSG_41_0_0_44_11_Hex, param11, getValueSize(P_FSG_41_0_0_44_11_Hex));

	///////// Start param12 - UINT8 /////////
	param12 = superval[currentPos++];
	putValue(P_FSG_41_0_0_44_12, param12);
	///////// Start param13 - STRING /////////
	getValue(P_FSG_41_0_0_44_13_Hex, param13);
	if((superval[currentPos] & 0x80) > 0)
	{
		if(99>127) /* Max Fct-Katalog Laenge: 99*/
		{
			len13 = ( (superval[currentPos]&0x7F) <<8) + superval[currentPos+1];
			currentPos = currentPos + 2;
			cnt13 = 1;
		}
		else
		{
			len13 = 99;
			writelineEx(gBAP_Trace, 0, "Anzahl der Laengeninformation-Bytes in P_FSG_41_0_0_44 ueberschreitet die erlaubte 1 Byte vom Fct-Kalatog.");
		}
	}
	else
	{
		len13 = superval[currentPos]&0x7F;
		currentPos = currentPos + 1;
		cnt13 = 0;
	}
	
	if(len13 > 99)
	{
		writelineEx(gBAP_Trace, 0, "Laenge:%d bei der Byte Position:%d ueberschreitet die Maximale erlaubte Laenge von Fct-Kalatog", len13, currentPos);
		len13 = 99;
	
		if(len13 < 128) cnt13 = 0;
		else cnt13 = 1;
	}
	
	for(i = 0; i < len13; i++)
	{
		param13[i] = superval[currentPos++];
	}
	
	putValue(P_FSG_41_0_0_44_13_len, len13);
	putValue(P_FSG_41_0_0_44_13_cnt, cnt13);
	
	if(len13 > getValueSize(P_FSG_41_0_0_44_13_Hex))
		putValue(P_FSG_41_0_0_44_13_Hex, param13, len13);
	else
		putValue(P_FSG_41_0_0_44_13_Hex, param13, getValueSize(P_FSG_41_0_0_44_13_Hex));

	///////// Start param14 - STRING /////////
	getValue(P_FSG_41_0_0_44_14_Hex, param14);
	if((superval[currentPos] & 0x80) > 0)
	{
		if(40>127) /* Max Fct-Katalog Laenge: 40*/
		{
			len14 = ( (superval[currentPos]&0x7F) <<8) + superval[currentPos+1];
			currentPos = currentPos + 2;
			cnt14 = 1;
		}
		else
		{
			len14 = 40;
			writelineEx(gBAP_Trace, 0, "Anzahl der Laengeninformation-Bytes in P_FSG_41_0_0_44 ueberschreitet die erlaubte 1 Byte vom Fct-Kalatog.");
		}
	}
	else
	{
		len14 = superval[currentPos]&0x7F;
		currentPos = currentPos + 1;
		cnt14 = 0;
	}
	
	if(len14 > 40)
	{
		writelineEx(gBAP_Trace, 0, "Laenge:%d bei der Byte Position:%d ueberschreitet die Maximale erlaubte Laenge von Fct-Kalatog", len14, currentPos);
		len14 = 40;
	
		if(len14 < 128) cnt14 = 0;
		else cnt14 = 1;
	}
	
	for(i = 0; i < len14; i++)
	{
		param14[i] = superval[currentPos++];
	}
	
	putValue(P_FSG_41_0_0_44_14_len, len14);
	putValue(P_FSG_41_0_0_44_14_cnt, cnt14);
	
	if(len14 > getValueSize(P_FSG_41_0_0_44_14_Hex))
		putValue(P_FSG_41_0_0_44_14_Hex, param14, len14);
	else
		putValue(P_FSG_41_0_0_44_14_Hex, param14, getValueSize(P_FSG_41_0_0_44_14_Hex));

	///////// Start param15 - UINT8 /////////
	param15 = superval[currentPos++];
	putValue(P_FSG_41_0_0_44_15, param15);
	///////// Start param16 - STRING /////////
	getValue(P_FSG_41_0_0_44_16_Hex, param16);
	if((superval[currentPos] & 0x80) > 0)
	{
		if(99>127) /* Max Fct-Katalog Laenge: 99*/
		{
			len16 = ( (superval[currentPos]&0x7F) <<8) + superval[currentPos+1];
			currentPos = currentPos + 2;
			cnt16 = 1;
		}
		else
		{
			len16 = 99;
			writelineEx(gBAP_Trace, 0, "Anzahl der Laengeninformation-Bytes in P_FSG_41_0_0_44 ueberschreitet die erlaubte 1 Byte vom Fct-Kalatog.");
		}
	}
	else
	{
		len16 = superval[currentPos]&0x7F;
		currentPos = currentPos + 1;
		cnt16 = 0;
	}
	
	if(len16 > 99)
	{
		writelineEx(gBAP_Trace, 0, "Laenge:%d bei der Byte Position:%d ueberschreitet die Maximale erlaubte Laenge von Fct-Kalatog", len16, currentPos);
		len16 = 99;
	
		if(len16 < 128) cnt16 = 0;
		else cnt16 = 1;
	}
	
	for(i = 0; i < len16; i++)
	{
		param16[i] = superval[currentPos++];
	}
	
	putValue(P_FSG_41_0_0_44_16_len, len16);
	putValue(P_FSG_41_0_0_44_16_cnt, cnt16);
	
	if(len16 > getValueSize(P_FSG_41_0_0_44_16_Hex))
		putValue(P_FSG_41_0_0_44_16_Hex, param16, len16);
	else
		putValue(P_FSG_41_0_0_44_16_Hex, param16, getValueSize(P_FSG_41_0_0_44_16_Hex));

	///////// Start param17 - STRING /////////
	getValue(P_FSG_41_0_0_44_17_Hex, param17);
	if((superval[currentPos] & 0x80) > 0)
	{
		if(40>127) /* Max Fct-Katalog Laenge: 40*/
		{
			len17 = ( (superval[currentPos]&0x7F) <<8) + superval[currentPos+1];
			currentPos = currentPos + 2;
			cnt17 = 1;
		}
		else
		{
			len17 = 40;
			writelineEx(gBAP_Trace, 0, "Anzahl der Laengeninformation-Bytes in P_FSG_41_0_0_44 ueberschreitet die erlaubte 1 Byte vom Fct-Kalatog.");
		}
	}
	else
	{
		len17 = superval[currentPos]&0x7F;
		currentPos = currentPos + 1;
		cnt17 = 0;
	}
	
	if(len17 > 40)
	{
		writelineEx(gBAP_Trace, 0, "Laenge:%d bei der Byte Position:%d ueberschreitet die Maximale erlaubte Laenge von Fct-Kalatog", len17, currentPos);
		len17 = 40;
	
		if(len17 < 128) cnt17 = 0;
		else cnt17 = 1;
	}
	
	for(i = 0; i < len17; i++)
	{
		param17[i] = superval[currentPos++];
	}
	
	putValue(P_FSG_41_0_0_44_17_len, len17);
	putValue(P_FSG_41_0_0_44_17_cnt, cnt17);
	
	if(len17 > getValueSize(P_FSG_41_0_0_44_17_Hex))
		putValue(P_FSG_41_0_0_44_17_Hex, param17, len17);
	else
		putValue(P_FSG_41_0_0_44_17_Hex, param17, getValueSize(P_FSG_41_0_0_44_17_Hex));

	///////// Start param18 - UINT8 /////////
	param18 = superval[currentPos++];
	putValue(P_FSG_41_0_0_44_18, param18);
	///////// Start param19 - STRING /////////
	getValue(P_FSG_41_0_0_44_19_Hex, param19);
	if((superval[currentPos] & 0x80) > 0)
	{
		if(99>127) /* Max Fct-Katalog Laenge: 99*/
		{
			len19 = ( (superval[currentPos]&0x7F) <<8) + superval[currentPos+1];
			currentPos = currentPos + 2;
			cnt19 = 1;
		}
		else
		{
			len19 = 99;
			writelineEx(gBAP_Trace, 0, "Anzahl der Laengeninformation-Bytes in P_FSG_41_0_0_44 ueberschreitet die erlaubte 1 Byte vom Fct-Kalatog.");
		}
	}
	else
	{
		len19 = superval[currentPos]&0x7F;
		currentPos = currentPos + 1;
		cnt19 = 0;
	}
	
	if(len19 > 99)
	{
		writelineEx(gBAP_Trace, 0, "Laenge:%d bei der Byte Position:%d ueberschreitet die Maximale erlaubte Laenge von Fct-Kalatog", len19, currentPos);
		len19 = 99;
	
		if(len19 < 128) cnt19 = 0;
		else cnt19 = 1;
	}
	
	for(i = 0; i < len19; i++)
	{
		param19[i] = superval[currentPos++];
	}
	
	putValue(P_FSG_41_0_0_44_19_len, len19);
	putValue(P_FSG_41_0_0_44_19_cnt, cnt19);
	
	if(len19 > getValueSize(P_FSG_41_0_0_44_19_Hex))
		putValue(P_FSG_41_0_0_44_19_Hex, param19, len19);
	else
		putValue(P_FSG_41_0_0_44_19_Hex, param19, getValueSize(P_FSG_41_0_0_44_19_Hex));

	///////// Start param20 - STRING /////////
	getValue(P_FSG_41_0_0_44_20_Hex, param20);
	if((superval[currentPos] & 0x80) > 0)
	{
		if(40>127) /* Max Fct-Katalog Laenge: 40*/
		{
			len20 = ( (superval[currentPos]&0x7F) <<8) + superval[currentPos+1];
			currentPos = currentPos + 2;
			cnt20 = 1;
		}
		else
		{
			len20 = 40;
			writelineEx(gBAP_Trace, 0, "Anzahl der Laengeninformation-Bytes in P_FSG_41_0_0_44 ueberschreitet die erlaubte 1 Byte vom Fct-Kalatog.");
		}
	}
	else
	{
		len20 = superval[currentPos]&0x7F;
		currentPos = currentPos + 1;
		cnt20 = 0;
	}
	
	if(len20 > 40)
	{
		writelineEx(gBAP_Trace, 0, "Laenge:%d bei der Byte Position:%d ueberschreitet die Maximale erlaubte Laenge von Fct-Kalatog", len20, currentPos);
		len20 = 40;
	
		if(len20 < 128) cnt20 = 0;
		else cnt20 = 1;
	}
	
	for(i = 0; i < len20; i++)
	{
		param20[i] = superval[currentPos++];
	}
	
	putValue(P_FSG_41_0_0_44_20_len, len20);
	putValue(P_FSG_41_0_0_44_20_cnt, cnt20);
	
	if(len20 > getValueSize(P_FSG_41_0_0_44_20_Hex))
		putValue(P_FSG_41_0_0_44_20_Hex, param20, len20);
	else
		putValue(P_FSG_41_0_0_44_20_Hex, param20, getValueSize(P_FSG_41_0_0_44_20_Hex));

	///////// Start param21 - UINT8 /////////
	param21 = superval[currentPos++];
	putValue(P_FSG_41_0_0_44_21, param21);
}

// Updates the bus value field and other dependencies.
P_FSG_41_0_0_44_BuildFct()
{
	byte param1[100]; // PbName0
	word len1;
	byte cnt1;
	byte param2[41]; // TelNumber0
	word len2;
	byte cnt2;
	byte param3; // Category0
	byte param4[100]; // PbName1
	word len4;
	byte cnt4;
	byte param5[41]; // TelNumber1
	word len5;
	byte cnt5;
	byte param6; // Category1
	byte param7[100]; // PbName2
	word len7;
	byte cnt7;
	byte param8[41]; // TelNumber2
	word len8;
	byte cnt8;
	byte param9; // Category2
	byte param10[100]; // PbName3
	word len10;
	byte cnt10;
	byte param11[41]; // TelNumber3
	word len11;
	byte cnt11;
	byte param12; // Category3
	byte param13[100]; // PbName4
	word len13;
	byte cnt13;
	byte param14[41]; // TelNumber4
	word len14;
	byte cnt14;
	byte param15; // Category4
	byte param16[100]; // PbName5
	word len16;
	byte cnt16;
	byte param17[41]; // TelNumber5
	word len17;
	byte cnt17;
	byte param18; // Category5
	byte param19[100]; // PbName6
	word len19;
	byte cnt19;
	byte param20[41]; // TelNumber6
	word len20;
	byte cnt20;
	byte param21; // Category6

	int i;
	byte superval[994];
	int currentPos;
	currentPos = 0;
// gen_BuildFunc_SetSuperVals 
	getValue(P_FSG_41_0_0_44_1_Hex, param1);
	len1 = getValue(P_FSG_41_0_0_44_1_len);
	cnt1= getValue(P_FSG_41_0_0_44_1_cnt);
	
	/* check box aktiviert*/
	if (cnt1 == 1)
	{
		/* 0 bis 99 (MaxString - 1B oder 2B) */
		if(len1 >= 0 && len1 <= 99)
		{
			//writelineEx(gBAP_Trace, 0, "[Debug-1] Len1: %d", len1);
			superval[currentPos] = (len1&0x7f00) | 0x80;
			superval[currentPos+1] = len1 & 0x00ff;
		}
		else
		{
			writelineEx(gBAP_Trace, 0, "Eingegebene Laenge: %d von P_FSG_41_0_0_44_1 ist ungueltig. Die max. erlaubte Laenge ist %d.", len1, 99);
			return;
		}
	}
	else if(cnt1 == 0) /*check box deaktiviert*/
	{
		if(len1 >= 0 && len1 <= 127)
		{
			//writelineEx(gBAP_Trace, 0, "[Debug-1] Len1: %d", len1);
			superval[currentPos]= len1 & 0x00ff;
			putValue(P_FSG_41_0_0_44_1_len, len1);
		}
		else if(len1 > 127 && len1 <= 99)
		{
			superval[currentPos] = (len1&0x7f00) | 0x80;
			superval[currentPos+1] = len1 & 0x00ff;
			putValue(P_FSG_41_0_0_44_1_len, len1);
			putValue(P_FSG_41_0_0_44_1_cnt, 1);
		}
		else
		{
			writelineEx(gBAP_Trace, 0, "Eingegebene Laenge: %d von P_FSG_41_0_0_44_1 ist ungueltig. Die max. erlaubte Laenge ist %d.", len1, 99);
			return;
		}
	}
	currentPos += cnt1+1;
	for(i = 0; i < len1; i++)
	{
		superval[currentPos++]= param1[i];
	}

// gen_BuildFunc_SetSuperVals 
	getValue(P_FSG_41_0_0_44_2_Hex, param2);
	len2 = getValue(P_FSG_41_0_0_44_2_len);
	cnt2= getValue(P_FSG_41_0_0_44_2_cnt);
	
	/* check box aktiviert*/
	if (cnt2 == 1)
	{
		/* 0 bis 40 (MaxString - 1B oder 2B) */
		if(len2 >= 0 && len2 <= 40)
		{
			//writelineEx(gBAP_Trace, 0, "[Debug-1] Len2: %d", len2);
			superval[currentPos] = (len2&0x7f00) | 0x80;
			superval[currentPos+1] = len2 & 0x00ff;
		}
		else
		{
			writelineEx(gBAP_Trace, 0, "Eingegebene Laenge: %d von P_FSG_41_0_0_44_2 ist ungueltig. Die max. erlaubte Laenge ist %d.", len2, 40);
			return;
		}
	}
	else if(cnt2 == 0) /*check box deaktiviert*/
	{
		if(len2 >= 0 && len2 <= 127)
		{
			//writelineEx(gBAP_Trace, 0, "[Debug-1] Len2: %d", len2);
			superval[currentPos]= len2 & 0x00ff;
			putValue(P_FSG_41_0_0_44_2_len, len2);
		}
		else if(len2 > 127 && len2 <= 40)
		{
			superval[currentPos] = (len2&0x7f00) | 0x80;
			superval[currentPos+1] = len2 & 0x00ff;
			putValue(P_FSG_41_0_0_44_2_len, len2);
			putValue(P_FSG_41_0_0_44_2_cnt, 1);
		}
		else
		{
			writelineEx(gBAP_Trace, 0, "Eingegebene Laenge: %d von P_FSG_41_0_0_44_2 ist ungueltig. Die max. erlaubte Laenge ist %d.", len2, 40);
			return;
		}
	}
	currentPos += cnt2+1;
	for(i = 0; i < len2; i++)
	{
		superval[currentPos++]= param2[i];
	}

// gen_BuildFunc_SetSuperVals 
	param3 = getValue(P_FSG_41_0_0_44_3);
	superval[currentPos++]=param3;
// gen_BuildFunc_SetSuperVals 
	getValue(P_FSG_41_0_0_44_4_Hex, param4);
	len4 = getValue(P_FSG_41_0_0_44_4_len);
	cnt4= getValue(P_FSG_41_0_0_44_4_cnt);
	
	/* check box aktiviert*/
	if (cnt4 == 1)
	{
		/* 0 bis 99 (MaxString - 1B oder 2B) */
		if(len4 >= 0 && len4 <= 99)
		{
			//writelineEx(gBAP_Trace, 0, "[Debug-1] Len4: %d", len4);
			superval[currentPos] = (len4&0x7f00) | 0x80;
			superval[currentPos+1] = len4 & 0x00ff;
		}
		else
		{
			writelineEx(gBAP_Trace, 0, "Eingegebene Laenge: %d von P_FSG_41_0_0_44_4 ist ungueltig. Die max. erlaubte Laenge ist %d.", len4, 99);
			return;
		}
	}
	else if(cnt4 == 0) /*check box deaktiviert*/
	{
		if(len4 >= 0 && len4 <= 127)
		{
			//writelineEx(gBAP_Trace, 0, "[Debug-1] Len4: %d", len4);
			superval[currentPos]= len4 & 0x00ff;
			putValue(P_FSG_41_0_0_44_4_len, len4);
		}
		else if(len4 > 127 && len4 <= 99)
		{
			superval[currentPos] = (len4&0x7f00) | 0x80;
			superval[currentPos+1] = len4 & 0x00ff;
			putValue(P_FSG_41_0_0_44_4_len, len4);
			putValue(P_FSG_41_0_0_44_4_cnt, 1);
		}
		else
		{
			writelineEx(gBAP_Trace, 0, "Eingegebene Laenge: %d von P_FSG_41_0_0_44_4 ist ungueltig. Die max. erlaubte Laenge ist %d.", len4, 99);
			return;
		}
	}
	currentPos += cnt4+1;
	for(i = 0; i < len4; i++)
	{
		superval[currentPos++]= param4[i];
	}

// gen_BuildFunc_SetSuperVals 
	getValue(P_FSG_41_0_0_44_5_Hex, param5);
	len5 = getValue(P_FSG_41_0_0_44_5_len);
	cnt5= getValue(P_FSG_41_0_0_44_5_cnt);
	
	/* check box aktiviert*/
	if (cnt5 == 1)
	{
		/* 0 bis 40 (MaxString - 1B oder 2B) */
		if(len5 >= 0 && len5 <= 40)
		{
			//writelineEx(gBAP_Trace, 0, "[Debug-1] Len5: %d", len5);
			superval[currentPos] = (len5&0x7f00) | 0x80;
			superval[currentPos+1] = len5 & 0x00ff;
		}
		else
		{
			writelineEx(gBAP_Trace, 0, "Eingegebene Laenge: %d von P_FSG_41_0_0_44_5 ist ungueltig. Die max. erlaubte Laenge ist %d.", len5, 40);
			return;
		}
	}
	else if(cnt5 == 0) /*check box deaktiviert*/
	{
		if(len5 >= 0 && len5 <= 127)
		{
			//writelineEx(gBAP_Trace, 0, "[Debug-1] Len5: %d", len5);
			superval[currentPos]= len5 & 0x00ff;
			putValue(P_FSG_41_0_0_44_5_len, len5);
		}
		else if(len5 > 127 && len5 <= 40)
		{
			superval[currentPos] = (len5&0x7f00) | 0x80;
			superval[currentPos+1] = len5 & 0x00ff;
			putValue(P_FSG_41_0_0_44_5_len, len5);
			putValue(P_FSG_41_0_0_44_5_cnt, 1);
		}
		else
		{
			writelineEx(gBAP_Trace, 0, "Eingegebene Laenge: %d von P_FSG_41_0_0_44_5 ist ungueltig. Die max. erlaubte Laenge ist %d.", len5, 40);
			return;
		}
	}
	currentPos += cnt5+1;
	for(i = 0; i < len5; i++)
	{
		superval[currentPos++]= param5[i];
	}

// gen_BuildFunc_SetSuperVals 
	param6 = getValue(P_FSG_41_0_0_44_6);
	superval[currentPos++]=param6;
// gen_BuildFunc_SetSuperVals 
	getValue(P_FSG_41_0_0_44_7_Hex, param7);
	len7 = getValue(P_FSG_41_0_0_44_7_len);
	cnt7= getValue(P_FSG_41_0_0_44_7_cnt);
	
	/* check box aktiviert*/
	if (cnt7 == 1)
	{
		/* 0 bis 99 (MaxString - 1B oder 2B) */
		if(len7 >= 0 && len7 <= 99)
		{
			//writelineEx(gBAP_Trace, 0, "[Debug-1] Len7: %d", len7);
			superval[currentPos] = (len7&0x7f00) | 0x80;
			superval[currentPos+1] = len7 & 0x00ff;
		}
		else
		{
			writelineEx(gBAP_Trace, 0, "Eingegebene Laenge: %d von P_FSG_41_0_0_44_7 ist ungueltig. Die max. erlaubte Laenge ist %d.", len7, 99);
			return;
		}
	}
	else if(cnt7 == 0) /*check box deaktiviert*/
	{
		if(len7 >= 0 && len7 <= 127)
		{
			//writelineEx(gBAP_Trace, 0, "[Debug-1] Len7: %d", len7);
			superval[currentPos]= len7 & 0x00ff;
			putValue(P_FSG_41_0_0_44_7_len, len7);
		}
		else if(len7 > 127 && len7 <= 99)
		{
			superval[currentPos] = (len7&0x7f00) | 0x80;
			superval[currentPos+1] = len7 & 0x00ff;
			putValue(P_FSG_41_0_0_44_7_len, len7);
			putValue(P_FSG_41_0_0_44_7_cnt, 1);
		}
		else
		{
			writelineEx(gBAP_Trace, 0, "Eingegebene Laenge: %d von P_FSG_41_0_0_44_7 ist ungueltig. Die max. erlaubte Laenge ist %d.", len7, 99);
			return;
		}
	}
	currentPos += cnt7+1;
	for(i = 0; i < len7; i++)
	{
		superval[currentPos++]= param7[i];
	}

// gen_BuildFunc_SetSuperVals 
	getValue(P_FSG_41_0_0_44_8_Hex, param8);
	len8 = getValue(P_FSG_41_0_0_44_8_len);
	cnt8= getValue(P_FSG_41_0_0_44_8_cnt);
	
	/* check box aktiviert*/
	if (cnt8 == 1)
	{
		/* 0 bis 40 (MaxString - 1B oder 2B) */
		if(len8 >= 0 && len8 <= 40)
		{
			//writelineEx(gBAP_Trace, 0, "[Debug-1] Len8: %d", len8);
			superval[currentPos] = (len8&0x7f00) | 0x80;
			superval[currentPos+1] = len8 & 0x00ff;
		}
		else
		{
			writelineEx(gBAP_Trace, 0, "Eingegebene Laenge: %d von P_FSG_41_0_0_44_8 ist ungueltig. Die max. erlaubte Laenge ist %d.", len8, 40);
			return;
		}
	}
	else if(cnt8 == 0) /*check box deaktiviert*/
	{
		if(len8 >= 0 && len8 <= 127)
		{
			//writelineEx(gBAP_Trace, 0, "[Debug-1] Len8: %d", len8);
			superval[currentPos]= len8 & 0x00ff;
			putValue(P_FSG_41_0_0_44_8_len, len8);
		}
		else if(len8 > 127 && len8 <= 40)
		{
			superval[currentPos] = (len8&0x7f00) | 0x80;
			superval[currentPos+1] = len8 & 0x00ff;
			putValue(P_FSG_41_0_0_44_8_len, len8);
			putValue(P_FSG_41_0_0_44_8_cnt, 1);
		}
		else
		{
			writelineEx(gBAP_Trace, 0, "Eingegebene Laenge: %d von P_FSG_41_0_0_44_8 ist ungueltig. Die max. erlaubte Laenge ist %d.", len8, 40);
			return;
		}
	}
	currentPos += cnt8+1;
	for(i = 0; i < len8; i++)
	{
		superval[currentPos++]= param8[i];
	}

// gen_BuildFunc_SetSuperVals 
	param9 = getValue(P_FSG_41_0_0_44_9);
	superval[currentPos++]=param9;
// gen_BuildFunc_SetSuperVals 
	getValue(P_FSG_41_0_0_44_10_Hex, param10);
	len10 = getValue(P_FSG_41_0_0_44_10_len);
	cnt10= getValue(P_FSG_41_0_0_44_10_cnt);
	
	/* check box aktiviert*/
	if (cnt10 == 1)
	{
		/* 0 bis 99 (MaxString - 1B oder 2B) */
		if(len10 >= 0 && len10 <= 99)
		{
			//writelineEx(gBAP_Trace, 0, "[Debug-1] Len10: %d", len10);
			superval[currentPos] = (len10&0x7f00) | 0x80;
			superval[currentPos+1] = len10 & 0x00ff;
		}
		else
		{
			writelineEx(gBAP_Trace, 0, "Eingegebene Laenge: %d von P_FSG_41_0_0_44_10 ist ungueltig. Die max. erlaubte Laenge ist %d.", len10, 99);
			return;
		}
	}
	else if(cnt10 == 0) /*check box deaktiviert*/
	{
		if(len10 >= 0 && len10 <= 127)
		{
			//writelineEx(gBAP_Trace, 0, "[Debug-1] Len10: %d", len10);
			superval[currentPos]= len10 & 0x00ff;
			putValue(P_FSG_41_0_0_44_10_len, len10);
		}
		else if(len10 > 127 && len10 <= 99)
		{
			superval[currentPos] = (len10&0x7f00) | 0x80;
			superval[currentPos+1] = len10 & 0x00ff;
			putValue(P_FSG_41_0_0_44_10_len, len10);
			putValue(P_FSG_41_0_0_44_10_cnt, 1);
		}
		else
		{
			writelineEx(gBAP_Trace, 0, "Eingegebene Laenge: %d von P_FSG_41_0_0_44_10 ist ungueltig. Die max. erlaubte Laenge ist %d.", len10, 99);
			return;
		}
	}
	currentPos += cnt10+1;
	for(i = 0; i < len10; i++)
	{
		superval[currentPos++]= param10[i];
	}

// gen_BuildFunc_SetSuperVals 
	getValue(P_FSG_41_0_0_44_11_Hex, param11);
	len11 = getValue(P_FSG_41_0_0_44_11_len);
	cnt11= getValue(P_FSG_41_0_0_44_11_cnt);
	
	/* check box aktiviert*/
	if (cnt11 == 1)
	{
		/* 0 bis 40 (MaxString - 1B oder 2B) */
		if(len11 >= 0 && len11 <= 40)
		{
			//writelineEx(gBAP_Trace, 0, "[Debug-1] Len11: %d", len11);
			superval[currentPos] = (len11&0x7f00) | 0x80;
			superval[currentPos+1] = len11 & 0x00ff;
		}
		else
		{
			writelineEx(gBAP_Trace, 0, "Eingegebene Laenge: %d von P_FSG_41_0_0_44_11 ist ungueltig. Die max. erlaubte Laenge ist %d.", len11, 40);
			return;
		}
	}
	else if(cnt11 == 0) /*check box deaktiviert*/
	{
		if(len11 >= 0 && len11 <= 127)
		{
			//writelineEx(gBAP_Trace, 0, "[Debug-1] Len11: %d", len11);
			superval[currentPos]= len11 & 0x00ff;
			putValue(P_FSG_41_0_0_44_11_len, len11);
		}
		else if(len11 > 127 && len11 <= 40)
		{
			superval[currentPos] = (len11&0x7f00) | 0x80;
			superval[currentPos+1] = len11 & 0x00ff;
			putValue(P_FSG_41_0_0_44_11_len, len11);
			putValue(P_FSG_41_0_0_44_11_cnt, 1);
		}
		else
		{
			writelineEx(gBAP_Trace, 0, "Eingegebene Laenge: %d von P_FSG_41_0_0_44_11 ist ungueltig. Die max. erlaubte Laenge ist %d.", len11, 40);
			return;
		}
	}
	currentPos += cnt11+1;
	for(i = 0; i < len11; i++)
	{
		superval[currentPos++]= param11[i];
	}

// gen_BuildFunc_SetSuperVals 
	param12 = getValue(P_FSG_41_0_0_44_12);
	superval[currentPos++]=param12;
// gen_BuildFunc_SetSuperVals 
	getValue(P_FSG_41_0_0_44_13_Hex, param13);
	len13 = getValue(P_FSG_41_0_0_44_13_len);
	cnt13= getValue(P_FSG_41_0_0_44_13_cnt);
	
	/* check box aktiviert*/
	if (cnt13 == 1)
	{
		/* 0 bis 99 (MaxString - 1B oder 2B) */
		if(len13 >= 0 && len13 <= 99)
		{
			//writelineEx(gBAP_Trace, 0, "[Debug-1] Len13: %d", len13);
			superval[currentPos] = (len13&0x7f00) | 0x80;
			superval[currentPos+1] = len13 & 0x00ff;
		}
		else
		{
			writelineEx(gBAP_Trace, 0, "Eingegebene Laenge: %d von P_FSG_41_0_0_44_13 ist ungueltig. Die max. erlaubte Laenge ist %d.", len13, 99);
			return;
		}
	}
	else if(cnt13 == 0) /*check box deaktiviert*/
	{
		if(len13 >= 0 && len13 <= 127)
		{
			//writelineEx(gBAP_Trace, 0, "[Debug-1] Len13: %d", len13);
			superval[currentPos]= len13 & 0x00ff;
			putValue(P_FSG_41_0_0_44_13_len, len13);
		}
		else if(len13 > 127 && len13 <= 99)
		{
			superval[currentPos] = (len13&0x7f00) | 0x80;
			superval[currentPos+1] = len13 & 0x00ff;
			putValue(P_FSG_41_0_0_44_13_len, len13);
			putValue(P_FSG_41_0_0_44_13_cnt, 1);
		}
		else
		{
			writelineEx(gBAP_Trace, 0, "Eingegebene Laenge: %d von P_FSG_41_0_0_44_13 ist ungueltig. Die max. erlaubte Laenge ist %d.", len13, 99);
			return;
		}
	}
	currentPos += cnt13+1;
	for(i = 0; i < len13; i++)
	{
		superval[currentPos++]= param13[i];
	}

// gen_BuildFunc_SetSuperVals 
	getValue(P_FSG_41_0_0_44_14_Hex, param14);
	len14 = getValue(P_FSG_41_0_0_44_14_len);
	cnt14= getValue(P_FSG_41_0_0_44_14_cnt);
	
	/* check box aktiviert*/
	if (cnt14 == 1)
	{
		/* 0 bis 40 (MaxString - 1B oder 2B) */
		if(len14 >= 0 && len14 <= 40)
		{
			//writelineEx(gBAP_Trace, 0, "[Debug-1] Len14: %d", len14);
			superval[currentPos] = (len14&0x7f00) | 0x80;
			superval[currentPos+1] = len14 & 0x00ff;
		}
		else
		{
			writelineEx(gBAP_Trace, 0, "Eingegebene Laenge: %d von P_FSG_41_0_0_44_14 ist ungueltig. Die max. erlaubte Laenge ist %d.", len14, 40);
			return;
		}
	}
	else if(cnt14 == 0) /*check box deaktiviert*/
	{
		if(len14 >= 0 && len14 <= 127)
		{
			//writelineEx(gBAP_Trace, 0, "[Debug-1] Len14: %d", len14);
			superval[currentPos]= len14 & 0x00ff;
			putValue(P_FSG_41_0_0_44_14_len, len14);
		}
		else if(len14 > 127 && len14 <= 40)
		{
			superval[currentPos] = (len14&0x7f00) | 0x80;
			superval[currentPos+1] = len14 & 0x00ff;
			putValue(P_FSG_41_0_0_44_14_len, len14);
			putValue(P_FSG_41_0_0_44_14_cnt, 1);
		}
		else
		{
			writelineEx(gBAP_Trace, 0, "Eingegebene Laenge: %d von P_FSG_41_0_0_44_14 ist ungueltig. Die max. erlaubte Laenge ist %d.", len14, 40);
			return;
		}
	}
	currentPos += cnt14+1;
	for(i = 0; i < len14; i++)
	{
		superval[currentPos++]= param14[i];
	}

// gen_BuildFunc_SetSuperVals 
	param15 = getValue(P_FSG_41_0_0_44_15);
	superval[currentPos++]=param15;
// gen_BuildFunc_SetSuperVals 
	getValue(P_FSG_41_0_0_44_16_Hex, param16);
	len16 = getValue(P_FSG_41_0_0_44_16_len);
	cnt16= getValue(P_FSG_41_0_0_44_16_cnt);
	
	/* check box aktiviert*/
	if (cnt16 == 1)
	{
		/* 0 bis 99 (MaxString - 1B oder 2B) */
		if(len16 >= 0 && len16 <= 99)
		{
			//writelineEx(gBAP_Trace, 0, "[Debug-1] Len16: %d", len16);
			superval[currentPos] = (len16&0x7f00) | 0x80;
			superval[currentPos+1] = len16 & 0x00ff;
		}
		else
		{
			writelineEx(gBAP_Trace, 0, "Eingegebene Laenge: %d von P_FSG_41_0_0_44_16 ist ungueltig. Die max. erlaubte Laenge ist %d.", len16, 99);
			return;
		}
	}
	else if(cnt16 == 0) /*check box deaktiviert*/
	{
		if(len16 >= 0 && len16 <= 127)
		{
			//writelineEx(gBAP_Trace, 0, "[Debug-1] Len16: %d", len16);
			superval[currentPos]= len16 & 0x00ff;
			putValue(P_FSG_41_0_0_44_16_len, len16);
		}
		else if(len16 > 127 && len16 <= 99)
		{
			superval[currentPos] = (len16&0x7f00) | 0x80;
			superval[currentPos+1] = len16 & 0x00ff;
			putValue(P_FSG_41_0_0_44_16_len, len16);
			putValue(P_FSG_41_0_0_44_16_cnt, 1);
		}
		else
		{
			writelineEx(gBAP_Trace, 0, "Eingegebene Laenge: %d von P_FSG_41_0_0_44_16 ist ungueltig. Die max. erlaubte Laenge ist %d.", len16, 99);
			return;
		}
	}
	currentPos += cnt16+1;
	for(i = 0; i < len16; i++)
	{
		superval[currentPos++]= param16[i];
	}

// gen_BuildFunc_SetSuperVals 
	getValue(P_FSG_41_0_0_44_17_Hex, param17);
	len17 = getValue(P_FSG_41_0_0_44_17_len);
	cnt17= getValue(P_FSG_41_0_0_44_17_cnt);
	
	/* check box aktiviert*/
	if (cnt17 == 1)
	{
		/* 0 bis 40 (MaxString - 1B oder 2B) */
		if(len17 >= 0 && len17 <= 40)
		{
			//writelineEx(gBAP_Trace, 0, "[Debug-1] Len17: %d", len17);
			superval[currentPos] = (len17&0x7f00) | 0x80;
			superval[currentPos+1] = len17 & 0x00ff;
		}
		else
		{
			writelineEx(gBAP_Trace, 0, "Eingegebene Laenge: %d von P_FSG_41_0_0_44_17 ist ungueltig. Die max. erlaubte Laenge ist %d.", len17, 40);
			return;
		}
	}
	else if(cnt17 == 0) /*check box deaktiviert*/
	{
		if(len17 >= 0 && len17 <= 127)
		{
			//writelineEx(gBAP_Trace, 0, "[Debug-1] Len17: %d", len17);
			superval[currentPos]= len17 & 0x00ff;
			putValue(P_FSG_41_0_0_44_17_len, len17);
		}
		else if(len17 > 127 && len17 <= 40)
		{
			superval[currentPos] = (len17&0x7f00) | 0x80;
			superval[currentPos+1] = len17 & 0x00ff;
			putValue(P_FSG_41_0_0_44_17_len, len17);
			putValue(P_FSG_41_0_0_44_17_cnt, 1);
		}
		else
		{
			writelineEx(gBAP_Trace, 0, "Eingegebene Laenge: %d von P_FSG_41_0_0_44_17 ist ungueltig. Die max. erlaubte Laenge ist %d.", len17, 40);
			return;
		}
	}
	currentPos += cnt17+1;
	for(i = 0; i < len17; i++)
	{
		superval[currentPos++]= param17[i];
	}

// gen_BuildFunc_SetSuperVals 
	param18 = getValue(P_FSG_41_0_0_44_18);
	superval[currentPos++]=param18;
// gen_BuildFunc_SetSuperVals 
	getValue(P_FSG_41_0_0_44_19_Hex, param19);
	len19 = getValue(P_FSG_41_0_0_44_19_len);
	cnt19= getValue(P_FSG_41_0_0_44_19_cnt);
	
	/* check box aktiviert*/
	if (cnt19 == 1)
	{
		/* 0 bis 99 (MaxString - 1B oder 2B) */
		if(len19 >= 0 && len19 <= 99)
		{
			//writelineEx(gBAP_Trace, 0, "[Debug-1] Len19: %d", len19);
			superval[currentPos] = (len19&0x7f00) | 0x80;
			superval[currentPos+1] = len19 & 0x00ff;
		}
		else
		{
			writelineEx(gBAP_Trace, 0, "Eingegebene Laenge: %d von P_FSG_41_0_0_44_19 ist ungueltig. Die max. erlaubte Laenge ist %d.", len19, 99);
			return;
		}
	}
	else if(cnt19 == 0) /*check box deaktiviert*/
	{
		if(len19 >= 0 && len19 <= 127)
		{
			//writelineEx(gBAP_Trace, 0, "[Debug-1] Len19: %d", len19);
			superval[currentPos]= len19 & 0x00ff;
			putValue(P_FSG_41_0_0_44_19_len, len19);
		}
		else if(len19 > 127 && len19 <= 99)
		{
			superval[currentPos] = (len19&0x7f00) | 0x80;
			superval[currentPos+1] = len19 & 0x00ff;
			putValue(P_FSG_41_0_0_44_19_len, len19);
			putValue(P_FSG_41_0_0_44_19_cnt, 1);
		}
		else
		{
			writelineEx(gBAP_Trace, 0, "Eingegebene Laenge: %d von P_FSG_41_0_0_44_19 ist ungueltig. Die max. erlaubte Laenge ist %d.", len19, 99);
			return;
		}
	}
	currentPos += cnt19+1;
	for(i = 0; i < len19; i++)
	{
		superval[currentPos++]= param19[i];
	}

// gen_BuildFunc_SetSuperVals 
	getValue(P_FSG_41_0_0_44_20_Hex, param20);
	len20 = getValue(P_FSG_41_0_0_44_20_len);
	cnt20= getValue(P_FSG_41_0_0_44_20_cnt);
	
	/* check box aktiviert*/
	if (cnt20 == 1)
	{
		/* 0 bis 40 (MaxString - 1B oder 2B) */
		if(len20 >= 0 && len20 <= 40)
		{
			//writelineEx(gBAP_Trace, 0, "[Debug-1] Len20: %d", len20);
			superval[currentPos] = (len20&0x7f00) | 0x80;
			superval[currentPos+1] = len20 & 0x00ff;
		}
		else
		{
			writelineEx(gBAP_Trace, 0, "Eingegebene Laenge: %d von P_FSG_41_0_0_44_20 ist ungueltig. Die max. erlaubte Laenge ist %d.", len20, 40);
			return;
		}
	}
	else if(cnt20 == 0) /*check box deaktiviert*/
	{
		if(len20 >= 0 && len20 <= 127)
		{
			//writelineEx(gBAP_Trace, 0, "[Debug-1] Len20: %d", len20);
			superval[currentPos]= len20 & 0x00ff;
			putValue(P_FSG_41_0_0_44_20_len, len20);
		}
		else if(len20 > 127 && len20 <= 40)
		{
			superval[currentPos] = (len20&0x7f00) | 0x80;
			superval[currentPos+1] = len20 & 0x00ff;
			putValue(P_FSG_41_0_0_44_20_len, len20);
			putValue(P_FSG_41_0_0_44_20_cnt, 1);
		}
		else
		{
			writelineEx(gBAP_Trace, 0, "Eingegebene Laenge: %d von P_FSG_41_0_0_44_20 ist ungueltig. Die max. erlaubte Laenge ist %d.", len20, 40);
			return;
		}
	}
	currentPos += cnt20+1;
	for(i = 0; i < len20; i++)
	{
		superval[currentPos++]= param20[i];
	}

// gen_BuildFunc_SetSuperVals 
	param21 = getValue(P_FSG_41_0_0_44_21);
	superval[currentPos++]=param21;
	putValue(P_FSG_41_0_0_44, superval, currentPos);
}



// Ueberwachung der CheckBox fuer String
on envVar  P_FSG_41_0_0_44_1_cnt
{
	word len;
	byte cnt;
	len = getValue(P_FSG_41_0_0_44_1_len);
	cnt = getValue(P_FSG_41_0_0_44_1_cnt);

	/* wird nur gerufen, wenn check box deaktiviert mit Length>127*/ 
	if( cnt == 0) 
	{
		if(len > 127 )
		{
			putValue(P_FSG_41_0_0_44_1_len, 127);
		}
	}

	P_FSG_41_0_0_44_BuildFct();
}



// Ueberwachung der Eingabefeld fuer String Data
on envVar P_FSG_41_0_0_44_1_len
{
	word len;
	len = getValue(this);
	/* Validierung der Eingabe*/
	if(len > 99)
	{
		writelineEx(gBAP_Trace, 0, "Eingegebene Laenge: %d von P_FSG_41_0_0_44_1 ist ungueltig. Die max. erlaubte Laenge ist %d. ", len, 99);
		putValue(this, 99);
	}
	P_FSG_41_0_0_44_BuildFct();
}


on envVar P_FSG_41_0_0_44_1 // CallInfo3.PbName0
{
	int j, offset;
  int temp;
  int string_length_org;
  int string_length_mod;
  byte string_buffer_org[255];
  byte string_buffer_mod[255];
  
  //Start-Länge
  string_length_org = getValueSize(this);
  string_length_mod = string_length_org;
  
  //Start-String in Buffer
  getvalue(this,string_buffer_org);
  
  //Buffer auf Sonderzeichen checken und ersetzen
  offset = 0;
  for (j=0;j<string_length_org;j++)
  {
    if ( string_buffer_org[j] >= 0x80 && string_buffer_org[j] <= 0xBF ) 
    {
      temp = string_buffer_org[j] + 0xC200;
      
      string_buffer_mod[j+offset] = temp>>8;
      string_buffer_mod[j+offset+1] = temp;
      offset++;
      string_length_mod++;
    }
    else if ( string_buffer_org[j] >= 0xC0 && string_buffer_org[j] <= 0xFF ) 
    {
      temp = string_buffer_org[j] + 0xC2C0;
      
      string_buffer_mod[j+offset] = temp>>8;
      string_buffer_mod[j+offset+1] = temp;
      offset++;
      string_length_mod++;
    }
    else
      string_buffer_mod[j+offset] = string_buffer_org[j];
  }
    
  //neuen String schreiben
  putvalue(P_FSG_41_0_0_44_1_Hex,string_buffer_mod,string_length_mod);
  putValue(P_FSG_41_0_0_44_1_len, string_length_mod);
}


// Ueberwachung der CheckBox fuer String
on envVar  P_FSG_41_0_0_44_2_cnt
{
	word len;
	byte cnt;
	len = getValue(P_FSG_41_0_0_44_2_len);
	cnt = getValue(P_FSG_41_0_0_44_2_cnt);

	/* wird nur gerufen, wenn check box deaktiviert mit Length>127*/ 
	if( cnt == 0) 
	{
		if(len > 127 )
		{
			putValue(P_FSG_41_0_0_44_2_len, 127);
		}
	}

	P_FSG_41_0_0_44_BuildFct();
}



// Ueberwachung der Eingabefeld fuer String Data
on envVar P_FSG_41_0_0_44_2_len
{
	word len;
	len = getValue(this);
	/* Validierung der Eingabe*/
	if(len > 40)
	{
		writelineEx(gBAP_Trace, 0, "Eingegebene Laenge: %d von P_FSG_41_0_0_44_2 ist ungueltig. Die max. erlaubte Laenge ist %d. ", len, 40);
		putValue(this, 40);
	}
	P_FSG_41_0_0_44_BuildFct();
}


on envVar P_FSG_41_0_0_44_2 // CallInfo3.TelNumber0
{
	int j, offset;
  int temp;
  int string_length_org;
  int string_length_mod;
  byte string_buffer_org[255];
  byte string_buffer_mod[255];
  
  //Start-Länge
  string_length_org = getValueSize(this);
  string_length_mod = string_length_org;
  
  //Start-String in Buffer
  getvalue(this,string_buffer_org);
  
  //Buffer auf Sonderzeichen checken und ersetzen
  offset = 0;
  for (j=0;j<string_length_org;j++)
  {
    if ( string_buffer_org[j] >= 0x80 && string_buffer_org[j] <= 0xBF ) 
    {
      temp = string_buffer_org[j] + 0xC200;
      
      string_buffer_mod[j+offset] = temp>>8;
      string_buffer_mod[j+offset+1] = temp;
      offset++;
      string_length_mod++;
    }
    else if ( string_buffer_org[j] >= 0xC0 && string_buffer_org[j] <= 0xFF ) 
    {
      temp = string_buffer_org[j] + 0xC2C0;
      
      string_buffer_mod[j+offset] = temp>>8;
      string_buffer_mod[j+offset+1] = temp;
      offset++;
      string_length_mod++;
    }
    else
      string_buffer_mod[j+offset] = string_buffer_org[j];
  }
    
  //neuen String schreiben
  putvalue(P_FSG_41_0_0_44_2_Hex,string_buffer_mod,string_length_mod);
  putValue(P_FSG_41_0_0_44_2_len, string_length_mod);
}

on envVar P_FSG_41_0_0_44_3 // CallInfo3.Category0
{
	P_FSG_41_0_0_44_BuildFct();
}


// Ueberwachung der CheckBox fuer String
on envVar  P_FSG_41_0_0_44_4_cnt
{
	word len;
	byte cnt;
	len = getValue(P_FSG_41_0_0_44_4_len);
	cnt = getValue(P_FSG_41_0_0_44_4_cnt);

	/* wird nur gerufen, wenn check box deaktiviert mit Length>127*/ 
	if( cnt == 0) 
	{
		if(len > 127 )
		{
			putValue(P_FSG_41_0_0_44_4_len, 127);
		}
	}

	P_FSG_41_0_0_44_BuildFct();
}



// Ueberwachung der Eingabefeld fuer String Data
on envVar P_FSG_41_0_0_44_4_len
{
	word len;
	len = getValue(this);
	/* Validierung der Eingabe*/
	if(len > 99)
	{
		writelineEx(gBAP_Trace, 0, "Eingegebene Laenge: %d von P_FSG_41_0_0_44_4 ist ungueltig. Die max. erlaubte Laenge ist %d. ", len, 99);
		putValue(this, 99);
	}
	P_FSG_41_0_0_44_BuildFct();
}


on envVar P_FSG_41_0_0_44_4 // CallInfo3.PbName1
{
	int j, offset;
  int temp;
  int string_length_org;
  int string_length_mod;
  byte string_buffer_org[255];
  byte string_buffer_mod[255];
  
  //Start-Länge
  string_length_org = getValueSize(this);
  string_length_mod = string_length_org;
  
  //Start-String in Buffer
  getvalue(this,string_buffer_org);
  
  //Buffer auf Sonderzeichen checken und ersetzen
  offset = 0;
  for (j=0;j<string_length_org;j++)
  {
    if ( string_buffer_org[j] >= 0x80 && string_buffer_org[j] <= 0xBF ) 
    {
      temp = string_buffer_org[j] + 0xC200;
      
      string_buffer_mod[j+offset] = temp>>8;
      string_buffer_mod[j+offset+1] = temp;
      offset++;
      string_length_mod++;
    }
    else if ( string_buffer_org[j] >= 0xC0 && string_buffer_org[j] <= 0xFF ) 
    {
      temp = string_buffer_org[j] + 0xC2C0;
      
      string_buffer_mod[j+offset] = temp>>8;
      string_buffer_mod[j+offset+1] = temp;
      offset++;
      string_length_mod++;
    }
    else
      string_buffer_mod[j+offset] = string_buffer_org[j];
  }
    
  //neuen String schreiben
  putvalue(P_FSG_41_0_0_44_4_Hex,string_buffer_mod,string_length_mod);
  putValue(P_FSG_41_0_0_44_4_len, string_length_mod);
}


// Ueberwachung der CheckBox fuer String
on envVar  P_FSG_41_0_0_44_5_cnt
{
	word len;
	byte cnt;
	len = getValue(P_FSG_41_0_0_44_5_len);
	cnt = getValue(P_FSG_41_0_0_44_5_cnt);

	/* wird nur gerufen, wenn check box deaktiviert mit Length>127*/ 
	if( cnt == 0) 
	{
		if(len > 127 )
		{
			putValue(P_FSG_41_0_0_44_5_len, 127);
		}
	}

	P_FSG_41_0_0_44_BuildFct();
}



// Ueberwachung der Eingabefeld fuer String Data
on envVar P_FSG_41_0_0_44_5_len
{
	word len;
	len = getValue(this);
	/* Validierung der Eingabe*/
	if(len > 40)
	{
		writelineEx(gBAP_Trace, 0, "Eingegebene Laenge: %d von P_FSG_41_0_0_44_5 ist ungueltig. Die max. erlaubte Laenge ist %d. ", len, 40);
		putValue(this, 40);
	}
	P_FSG_41_0_0_44_BuildFct();
}


on envVar P_FSG_41_0_0_44_5 // CallInfo3.TelNumber1
{
	int j, offset;
  int temp;
  int string_length_org;
  int string_length_mod;
  byte string_buffer_org[255];
  byte string_buffer_mod[255];
  
  //Start-Länge
  string_length_org = getValueSize(this);
  string_length_mod = string_length_org;
  
  //Start-String in Buffer
  getvalue(this,string_buffer_org);
  
  //Buffer auf Sonderzeichen checken und ersetzen
  offset = 0;
  for (j=0;j<string_length_org;j++)
  {
    if ( string_buffer_org[j] >= 0x80 && string_buffer_org[j] <= 0xBF ) 
    {
      temp = string_buffer_org[j] + 0xC200;
      
      string_buffer_mod[j+offset] = temp>>8;
      string_buffer_mod[j+offset+1] = temp;
      offset++;
      string_length_mod++;
    }
    else if ( string_buffer_org[j] >= 0xC0 && string_buffer_org[j] <= 0xFF ) 
    {
      temp = string_buffer_org[j] + 0xC2C0;
      
      string_buffer_mod[j+offset] = temp>>8;
      string_buffer_mod[j+offset+1] = temp;
      offset++;
      string_length_mod++;
    }
    else
      string_buffer_mod[j+offset] = string_buffer_org[j];
  }
    
  //neuen String schreiben
  putvalue(P_FSG_41_0_0_44_5_Hex,string_buffer_mod,string_length_mod);
  putValue(P_FSG_41_0_0_44_5_len, string_length_mod);
}

on envVar P_FSG_41_0_0_44_6 // CallInfo3.Category1
{
	P_FSG_41_0_0_44_BuildFct();
}


// Ueberwachung der CheckBox fuer String
on envVar  P_FSG_41_0_0_44_7_cnt
{
	word len;
	byte cnt;
	len = getValue(P_FSG_41_0_0_44_7_len);
	cnt = getValue(P_FSG_41_0_0_44_7_cnt);

	/* wird nur gerufen, wenn check box deaktiviert mit Length>127*/ 
	if( cnt == 0) 
	{
		if(len > 127 )
		{
			putValue(P_FSG_41_0_0_44_7_len, 127);
		}
	}

	P_FSG_41_0_0_44_BuildFct();
}



// Ueberwachung der Eingabefeld fuer String Data
on envVar P_FSG_41_0_0_44_7_len
{
	word len;
	len = getValue(this);
	/* Validierung der Eingabe*/
	if(len > 99)
	{
		writelineEx(gBAP_Trace, 0, "Eingegebene Laenge: %d von P_FSG_41_0_0_44_7 ist ungueltig. Die max. erlaubte Laenge ist %d. ", len, 99);
		putValue(this, 99);
	}
	P_FSG_41_0_0_44_BuildFct();
}


on envVar P_FSG_41_0_0_44_7 // CallInfo3.PbName2
{
	int j, offset;
  int temp;
  int string_length_org;
  int string_length_mod;
  byte string_buffer_org[255];
  byte string_buffer_mod[255];
  
  //Start-Länge
  string_length_org = getValueSize(this);
  string_length_mod = string_length_org;
  
  //Start-String in Buffer
  getvalue(this,string_buffer_org);
  
  //Buffer auf Sonderzeichen checken und ersetzen
  offset = 0;
  for (j=0;j<string_length_org;j++)
  {
    if ( string_buffer_org[j] >= 0x80 && string_buffer_org[j] <= 0xBF ) 
    {
      temp = string_buffer_org[j] + 0xC200;
      
      string_buffer_mod[j+offset] = temp>>8;
      string_buffer_mod[j+offset+1] = temp;
      offset++;
      string_length_mod++;
    }
    else if ( string_buffer_org[j] >= 0xC0 && string_buffer_org[j] <= 0xFF ) 
    {
      temp = string_buffer_org[j] + 0xC2C0;
      
      string_buffer_mod[j+offset] = temp>>8;
      string_buffer_mod[j+offset+1] = temp;
      offset++;
      string_length_mod++;
    }
    else
      string_buffer_mod[j+offset] = string_buffer_org[j];
  }
    
  //neuen String schreiben
  putvalue(P_FSG_41_0_0_44_7_Hex,string_buffer_mod,string_length_mod);
  putValue(P_FSG_41_0_0_44_7_len, string_length_mod);
}


// Ueberwachung der CheckBox fuer String
on envVar  P_FSG_41_0_0_44_8_cnt
{
	word len;
	byte cnt;
	len = getValue(P_FSG_41_0_0_44_8_len);
	cnt = getValue(P_FSG_41_0_0_44_8_cnt);

	/* wird nur gerufen, wenn check box deaktiviert mit Length>127*/ 
	if( cnt == 0) 
	{
		if(len > 127 )
		{
			putValue(P_FSG_41_0_0_44_8_len, 127);
		}
	}

	P_FSG_41_0_0_44_BuildFct();
}



// Ueberwachung der Eingabefeld fuer String Data
on envVar P_FSG_41_0_0_44_8_len
{
	word len;
	len = getValue(this);
	/* Validierung der Eingabe*/
	if(len > 40)
	{
		writelineEx(gBAP_Trace, 0, "Eingegebene Laenge: %d von P_FSG_41_0_0_44_8 ist ungueltig. Die max. erlaubte Laenge ist %d. ", len, 40);
		putValue(this, 40);
	}
	P_FSG_41_0_0_44_BuildFct();
}


on envVar P_FSG_41_0_0_44_8 // CallInfo3.TelNumber2
{
	int j, offset;
  int temp;
  int string_length_org;
  int string_length_mod;
  byte string_buffer_org[255];
  byte string_buffer_mod[255];
  
  //Start-Länge
  string_length_org = getValueSize(this);
  string_length_mod = string_length_org;
  
  //Start-String in Buffer
  getvalue(this,string_buffer_org);
  
  //Buffer auf Sonderzeichen checken und ersetzen
  offset = 0;
  for (j=0;j<string_length_org;j++)
  {
    if ( string_buffer_org[j] >= 0x80 && string_buffer_org[j] <= 0xBF ) 
    {
      temp = string_buffer_org[j] + 0xC200;
      
      string_buffer_mod[j+offset] = temp>>8;
      string_buffer_mod[j+offset+1] = temp;
      offset++;
      string_length_mod++;
    }
    else if ( string_buffer_org[j] >= 0xC0 && string_buffer_org[j] <= 0xFF ) 
    {
      temp = string_buffer_org[j] + 0xC2C0;
      
      string_buffer_mod[j+offset] = temp>>8;
      string_buffer_mod[j+offset+1] = temp;
      offset++;
      string_length_mod++;
    }
    else
      string_buffer_mod[j+offset] = string_buffer_org[j];
  }
    
  //neuen String schreiben
  putvalue(P_FSG_41_0_0_44_8_Hex,string_buffer_mod,string_length_mod);
  putValue(P_FSG_41_0_0_44_8_len, string_length_mod);
}

on envVar P_FSG_41_0_0_44_9 // CallInfo3.Category2
{
	P_FSG_41_0_0_44_BuildFct();
}


// Ueberwachung der CheckBox fuer String
on envVar  P_FSG_41_0_0_44_10_cnt
{
	word len;
	byte cnt;
	len = getValue(P_FSG_41_0_0_44_10_len);
	cnt = getValue(P_FSG_41_0_0_44_10_cnt);

	/* wird nur gerufen, wenn check box deaktiviert mit Length>127*/ 
	if( cnt == 0) 
	{
		if(len > 127 )
		{
			putValue(P_FSG_41_0_0_44_10_len, 127);
		}
	}

	P_FSG_41_0_0_44_BuildFct();
}



// Ueberwachung der Eingabefeld fuer String Data
on envVar P_FSG_41_0_0_44_10_len
{
	word len;
	len = getValue(this);
	/* Validierung der Eingabe*/
	if(len > 99)
	{
		writelineEx(gBAP_Trace, 0, "Eingegebene Laenge: %d von P_FSG_41_0_0_44_10 ist ungueltig. Die max. erlaubte Laenge ist %d. ", len, 99);
		putValue(this, 99);
	}
	P_FSG_41_0_0_44_BuildFct();
}


on envVar P_FSG_41_0_0_44_10 // CallInfo3.PbName3
{
	int j, offset;
  int temp;
  int string_length_org;
  int string_length_mod;
  byte string_buffer_org[255];
  byte string_buffer_mod[255];
  
  //Start-Länge
  string_length_org = getValueSize(this);
  string_length_mod = string_length_org;
  
  //Start-String in Buffer
  getvalue(this,string_buffer_org);
  
  //Buffer auf Sonderzeichen checken und ersetzen
  offset = 0;
  for (j=0;j<string_length_org;j++)
  {
    if ( string_buffer_org[j] >= 0x80 && string_buffer_org[j] <= 0xBF ) 
    {
      temp = string_buffer_org[j] + 0xC200;
      
      string_buffer_mod[j+offset] = temp>>8;
      string_buffer_mod[j+offset+1] = temp;
      offset++;
      string_length_mod++;
    }
    else if ( string_buffer_org[j] >= 0xC0 && string_buffer_org[j] <= 0xFF ) 
    {
      temp = string_buffer_org[j] + 0xC2C0;
      
      string_buffer_mod[j+offset] = temp>>8;
      string_buffer_mod[j+offset+1] = temp;
      offset++;
      string_length_mod++;
    }
    else
      string_buffer_mod[j+offset] = string_buffer_org[j];
  }
    
  //neuen String schreiben
  putvalue(P_FSG_41_0_0_44_10_Hex,string_buffer_mod,string_length_mod);
  putValue(P_FSG_41_0_0_44_10_len, string_length_mod);
}


// Ueberwachung der CheckBox fuer String
on envVar  P_FSG_41_0_0_44_11_cnt
{
	word len;
	byte cnt;
	len = getValue(P_FSG_41_0_0_44_11_len);
	cnt = getValue(P_FSG_41_0_0_44_11_cnt);

	/* wird nur gerufen, wenn check box deaktiviert mit Length>127*/ 
	if( cnt == 0) 
	{
		if(len > 127 )
		{
			putValue(P_FSG_41_0_0_44_11_len, 127);
		}
	}

	P_FSG_41_0_0_44_BuildFct();
}



// Ueberwachung der Eingabefeld fuer String Data
on envVar P_FSG_41_0_0_44_11_len
{
	word len;
	len = getValue(this);
	/* Validierung der Eingabe*/
	if(len > 40)
	{
		writelineEx(gBAP_Trace, 0, "Eingegebene Laenge: %d von P_FSG_41_0_0_44_11 ist ungueltig. Die max. erlaubte Laenge ist %d. ", len, 40);
		putValue(this, 40);
	}
	P_FSG_41_0_0_44_BuildFct();
}


on envVar P_FSG_41_0_0_44_11 // CallInfo3.TelNumber3
{
	int j, offset;
  int temp;
  int string_length_org;
  int string_length_mod;
  byte string_buffer_org[255];
  byte string_buffer_mod[255];
  
  //Start-Länge
  string_length_org = getValueSize(this);
  string_length_mod = string_length_org;
  
  //Start-String in Buffer
  getvalue(this,string_buffer_org);
  
  //Buffer auf Sonderzeichen checken und ersetzen
  offset = 0;
  for (j=0;j<string_length_org;j++)
  {
    if ( string_buffer_org[j] >= 0x80 && string_buffer_org[j] <= 0xBF ) 
    {
      temp = string_buffer_org[j] + 0xC200;
      
      string_buffer_mod[j+offset] = temp>>8;
      string_buffer_mod[j+offset+1] = temp;
      offset++;
      string_length_mod++;
    }
    else if ( string_buffer_org[j] >= 0xC0 && string_buffer_org[j] <= 0xFF ) 
    {
      temp = string_buffer_org[j] + 0xC2C0;
      
      string_buffer_mod[j+offset] = temp>>8;
      string_buffer_mod[j+offset+1] = temp;
      offset++;
      string_length_mod++;
    }
    else
      string_buffer_mod[j+offset] = string_buffer_org[j];
  }
    
  //neuen String schreiben
  putvalue(P_FSG_41_0_0_44_11_Hex,string_buffer_mod,string_length_mod);
  putValue(P_FSG_41_0_0_44_11_len, string_length_mod);
}

on envVar P_FSG_41_0_0_44_12 // CallInfo3.Category3
{
	P_FSG_41_0_0_44_BuildFct();
}


// Ueberwachung der CheckBox fuer String
on envVar  P_FSG_41_0_0_44_13_cnt
{
	word len;
	byte cnt;
	len = getValue(P_FSG_41_0_0_44_13_len);
	cnt = getValue(P_FSG_41_0_0_44_13_cnt);

	/* wird nur gerufen, wenn check box deaktiviert mit Length>127*/ 
	if( cnt == 0) 
	{
		if(len > 127 )
		{
			putValue(P_FSG_41_0_0_44_13_len, 127);
		}
	}

	P_FSG_41_0_0_44_BuildFct();
}



// Ueberwachung der Eingabefeld fuer String Data
on envVar P_FSG_41_0_0_44_13_len
{
	word len;
	len = getValue(this);
	/* Validierung der Eingabe*/
	if(len > 99)
	{
		writelineEx(gBAP_Trace, 0, "Eingegebene Laenge: %d von P_FSG_41_0_0_44_13 ist ungueltig. Die max. erlaubte Laenge ist %d. ", len, 99);
		putValue(this, 99);
	}
	P_FSG_41_0_0_44_BuildFct();
}


on envVar P_FSG_41_0_0_44_13 // CallInfo3.PbName4
{
	int j, offset;
  int temp;
  int string_length_org;
  int string_length_mod;
  byte string_buffer_org[255];
  byte string_buffer_mod[255];
  
  //Start-Länge
  string_length_org = getValueSize(this);
  string_length_mod = string_length_org;
  
  //Start-String in Buffer
  getvalue(this,string_buffer_org);
  
  //Buffer auf Sonderzeichen checken und ersetzen
  offset = 0;
  for (j=0;j<string_length_org;j++)
  {
    if ( string_buffer_org[j] >= 0x80 && string_buffer_org[j] <= 0xBF ) 
    {
      temp = string_buffer_org[j] + 0xC200;
      
      string_buffer_mod[j+offset] = temp>>8;
      string_buffer_mod[j+offset+1] = temp;
      offset++;
      string_length_mod++;
    }
    else if ( string_buffer_org[j] >= 0xC0 && string_buffer_org[j] <= 0xFF ) 
    {
      temp = string_buffer_org[j] + 0xC2C0;
      
      string_buffer_mod[j+offset] = temp>>8;
      string_buffer_mod[j+offset+1] = temp;
      offset++;
      string_length_mod++;
    }
    else
      string_buffer_mod[j+offset] = string_buffer_org[j];
  }
    
  //neuen String schreiben
  putvalue(P_FSG_41_0_0_44_13_Hex,string_buffer_mod,string_length_mod);
  putValue(P_FSG_41_0_0_44_13_len, string_length_mod);
}


// Ueberwachung der CheckBox fuer String
on envVar  P_FSG_41_0_0_44_14_cnt
{
	word len;
	byte cnt;
	len = getValue(P_FSG_41_0_0_44_14_len);
	cnt = getValue(P_FSG_41_0_0_44_14_cnt);

	/* wird nur gerufen, wenn check box deaktiviert mit Length>127*/ 
	if( cnt == 0) 
	{
		if(len > 127 )
		{
			putValue(P_FSG_41_0_0_44_14_len, 127);
		}
	}

	P_FSG_41_0_0_44_BuildFct();
}



// Ueberwachung der Eingabefeld fuer String Data
on envVar P_FSG_41_0_0_44_14_len
{
	word len;
	len = getValue(this);
	/* Validierung der Eingabe*/
	if(len > 40)
	{
		writelineEx(gBAP_Trace, 0, "Eingegebene Laenge: %d von P_FSG_41_0_0_44_14 ist ungueltig. Die max. erlaubte Laenge ist %d. ", len, 40);
		putValue(this, 40);
	}
	P_FSG_41_0_0_44_BuildFct();
}


on envVar P_FSG_41_0_0_44_14 // CallInfo3.TelNumber4
{
	int j, offset;
  int temp;
  int string_length_org;
  int string_length_mod;
  byte string_buffer_org[255];
  byte string_buffer_mod[255];
  
  //Start-Länge
  string_length_org = getValueSize(this);
  string_length_mod = string_length_org;
  
  //Start-String in Buffer
  getvalue(this,string_buffer_org);
  
  //Buffer auf Sonderzeichen checken und ersetzen
  offset = 0;
  for (j=0;j<string_length_org;j++)
  {
    if ( string_buffer_org[j] >= 0x80 && string_buffer_org[j] <= 0xBF ) 
    {
      temp = string_buffer_org[j] + 0xC200;
      
      string_buffer_mod[j+offset] = temp>>8;
      string_buffer_mod[j+offset+1] = temp;
      offset++;
      string_length_mod++;
    }
    else if ( string_buffer_org[j] >= 0xC0 && string_buffer_org[j] <= 0xFF ) 
    {
      temp = string_buffer_org[j] + 0xC2C0;
      
      string_buffer_mod[j+offset] = temp>>8;
      string_buffer_mod[j+offset+1] = temp;
      offset++;
      string_length_mod++;
    }
    else
      string_buffer_mod[j+offset] = string_buffer_org[j];
  }
    
  //neuen String schreiben
  putvalue(P_FSG_41_0_0_44_14_Hex,string_buffer_mod,string_length_mod);
  putValue(P_FSG_41_0_0_44_14_len, string_length_mod);
}

on envVar P_FSG_41_0_0_44_15 // CallInfo3.Category4
{
	P_FSG_41_0_0_44_BuildFct();
}


// Ueberwachung der CheckBox fuer String
on envVar  P_FSG_41_0_0_44_16_cnt
{
	word len;
	byte cnt;
	len = getValue(P_FSG_41_0_0_44_16_len);
	cnt = getValue(P_FSG_41_0_0_44_16_cnt);

	/* wird nur gerufen, wenn check box deaktiviert mit Length>127*/ 
	if( cnt == 0) 
	{
		if(len > 127 )
		{
			putValue(P_FSG_41_0_0_44_16_len, 127);
		}
	}

	P_FSG_41_0_0_44_BuildFct();
}



// Ueberwachung der Eingabefeld fuer String Data
on envVar P_FSG_41_0_0_44_16_len
{
	word len;
	len = getValue(this);
	/* Validierung der Eingabe*/
	if(len > 99)
	{
		writelineEx(gBAP_Trace, 0, "Eingegebene Laenge: %d von P_FSG_41_0_0_44_16 ist ungueltig. Die max. erlaubte Laenge ist %d. ", len, 99);
		putValue(this, 99);
	}
	P_FSG_41_0_0_44_BuildFct();
}


on envVar P_FSG_41_0_0_44_16 // CallInfo3.PbName5
{
	int j, offset;
  int temp;
  int string_length_org;
  int string_length_mod;
  byte string_buffer_org[255];
  byte string_buffer_mod[255];
  
  //Start-Länge
  string_length_org = getValueSize(this);
  string_length_mod = string_length_org;
  
  //Start-String in Buffer
  getvalue(this,string_buffer_org);
  
  //Buffer auf Sonderzeichen checken und ersetzen
  offset = 0;
  for (j=0;j<string_length_org;j++)
  {
    if ( string_buffer_org[j] >= 0x80 && string_buffer_org[j] <= 0xBF ) 
    {
      temp = string_buffer_org[j] + 0xC200;
      
      string_buffer_mod[j+offset] = temp>>8;
      string_buffer_mod[j+offset+1] = temp;
      offset++;
      string_length_mod++;
    }
    else if ( string_buffer_org[j] >= 0xC0 && string_buffer_org[j] <= 0xFF ) 
    {
      temp = string_buffer_org[j] + 0xC2C0;
      
      string_buffer_mod[j+offset] = temp>>8;
      string_buffer_mod[j+offset+1] = temp;
      offset++;
      string_length_mod++;
    }
    else
      string_buffer_mod[j+offset] = string_buffer_org[j];
  }
    
  //neuen String schreiben
  putvalue(P_FSG_41_0_0_44_16_Hex,string_buffer_mod,string_length_mod);
  putValue(P_FSG_41_0_0_44_16_len, string_length_mod);
}


// Ueberwachung der CheckBox fuer String
on envVar  P_FSG_41_0_0_44_17_cnt
{
	word len;
	byte cnt;
	len = getValue(P_FSG_41_0_0_44_17_len);
	cnt = getValue(P_FSG_41_0_0_44_17_cnt);

	/* wird nur gerufen, wenn check box deaktiviert mit Length>127*/ 
	if( cnt == 0) 
	{
		if(len > 127 )
		{
			putValue(P_FSG_41_0_0_44_17_len, 127);
		}
	}

	P_FSG_41_0_0_44_BuildFct();
}



// Ueberwachung der Eingabefeld fuer String Data
on envVar P_FSG_41_0_0_44_17_len
{
	word len;
	len = getValue(this);
	/* Validierung der Eingabe*/
	if(len > 40)
	{
		writelineEx(gBAP_Trace, 0, "Eingegebene Laenge: %d von P_FSG_41_0_0_44_17 ist ungueltig. Die max. erlaubte Laenge ist %d. ", len, 40);
		putValue(this, 40);
	}
	P_FSG_41_0_0_44_BuildFct();
}


on envVar P_FSG_41_0_0_44_17 // CallInfo3.TelNumber5
{
	int j, offset;
  int temp;
  int string_length_org;
  int string_length_mod;
  byte string_buffer_org[255];
  byte string_buffer_mod[255];
  
  //Start-Länge
  string_length_org = getValueSize(this);
  string_length_mod = string_length_org;
  
  //Start-String in Buffer
  getvalue(this,string_buffer_org);
  
  //Buffer auf Sonderzeichen checken und ersetzen
  offset = 0;
  for (j=0;j<string_length_org;j++)
  {
    if ( string_buffer_org[j] >= 0x80 && string_buffer_org[j] <= 0xBF ) 
    {
      temp = string_buffer_org[j] + 0xC200;
      
      string_buffer_mod[j+offset] = temp>>8;
      string_buffer_mod[j+offset+1] = temp;
      offset++;
      string_length_mod++;
    }
    else if ( string_buffer_org[j] >= 0xC0 && string_buffer_org[j] <= 0xFF ) 
    {
      temp = string_buffer_org[j] + 0xC2C0;
      
      string_buffer_mod[j+offset] = temp>>8;
      string_buffer_mod[j+offset+1] = temp;
      offset++;
      string_length_mod++;
    }
    else
      string_buffer_mod[j+offset] = string_buffer_org[j];
  }
    
  //neuen String schreiben
  putvalue(P_FSG_41_0_0_44_17_Hex,string_buffer_mod,string_length_mod);
  putValue(P_FSG_41_0_0_44_17_len, string_length_mod);
}

on envVar P_FSG_41_0_0_44_18 // CallInfo3.Category5
{
	P_FSG_41_0_0_44_BuildFct();
}


// Ueberwachung der CheckBox fuer String
on envVar  P_FSG_41_0_0_44_19_cnt
{
	word len;
	byte cnt;
	len = getValue(P_FSG_41_0_0_44_19_len);
	cnt = getValue(P_FSG_41_0_0_44_19_cnt);

	/* wird nur gerufen, wenn check box deaktiviert mit Length>127*/ 
	if( cnt == 0) 
	{
		if(len > 127 )
		{
			putValue(P_FSG_41_0_0_44_19_len, 127);
		}
	}

	P_FSG_41_0_0_44_BuildFct();
}



// Ueberwachung der Eingabefeld fuer String Data
on envVar P_FSG_41_0_0_44_19_len
{
	word len;
	len = getValue(this);
	/* Validierung der Eingabe*/
	if(len > 99)
	{
		writelineEx(gBAP_Trace, 0, "Eingegebene Laenge: %d von P_FSG_41_0_0_44_19 ist ungueltig. Die max. erlaubte Laenge ist %d. ", len, 99);
		putValue(this, 99);
	}
	P_FSG_41_0_0_44_BuildFct();
}


on envVar P_FSG_41_0_0_44_19 // CallInfo3.PbName6
{
	int j, offset;
  int temp;
  int string_length_org;
  int string_length_mod;
  byte string_buffer_org[255];
  byte string_buffer_mod[255];
  
  //Start-Länge
  string_length_org = getValueSize(this);
  string_length_mod = string_length_org;
  
  //Start-String in Buffer
  getvalue(this,string_buffer_org);
  
  //Buffer auf Sonderzeichen checken und ersetzen
  offset = 0;
  for (j=0;j<string_length_org;j++)
  {
    if ( string_buffer_org[j] >= 0x80 && string_buffer_org[j] <= 0xBF ) 
    {
      temp = string_buffer_org[j] + 0xC200;
      
      string_buffer_mod[j+offset] = temp>>8;
      string_buffer_mod[j+offset+1] = temp;
      offset++;
      string_length_mod++;
    }
    else if ( string_buffer_org[j] >= 0xC0 && string_buffer_org[j] <= 0xFF ) 
    {
      temp = string_buffer_org[j] + 0xC2C0;
      
      string_buffer_mod[j+offset] = temp>>8;
      string_buffer_mod[j+offset+1] = temp;
      offset++;
      string_length_mod++;
    }
    else
      string_buffer_mod[j+offset] = string_buffer_org[j];
  }
    
  //neuen String schreiben
  putvalue(P_FSG_41_0_0_44_19_Hex,string_buffer_mod,string_length_mod);
  putValue(P_FSG_41_0_0_44_19_len, string_length_mod);
}


// Ueberwachung der CheckBox fuer String
on envVar  P_FSG_41_0_0_44_20_cnt
{
	word len;
	byte cnt;
	len = getValue(P_FSG_41_0_0_44_20_len);
	cnt = getValue(P_FSG_41_0_0_44_20_cnt);

	/* wird nur gerufen, wenn check box deaktiviert mit Length>127*/ 
	if( cnt == 0) 
	{
		if(len > 127 )
		{
			putValue(P_FSG_41_0_0_44_20_len, 127);
		}
	}

	P_FSG_41_0_0_44_BuildFct();
}



// Ueberwachung der Eingabefeld fuer String Data
on envVar P_FSG_41_0_0_44_20_len
{
	word len;
	len = getValue(this);
	/* Validierung der Eingabe*/
	if(len > 40)
	{
		writelineEx(gBAP_Trace, 0, "Eingegebene Laenge: %d von P_FSG_41_0_0_44_20 ist ungueltig. Die max. erlaubte Laenge ist %d. ", len, 40);
		putValue(this, 40);
	}
	P_FSG_41_0_0_44_BuildFct();
}


on envVar P_FSG_41_0_0_44_20 // CallInfo3.TelNumber6
{
	int j, offset;
  int temp;
  int string_length_org;
  int string_length_mod;
  byte string_buffer_org[255];
  byte string_buffer_mod[255];
  
  //Start-Länge
  string_length_org = getValueSize(this);
  string_length_mod = string_length_org;
  
  //Start-String in Buffer
  getvalue(this,string_buffer_org);
  
  //Buffer auf Sonderzeichen checken und ersetzen
  offset = 0;
  for (j=0;j<string_length_org;j++)
  {
    if ( string_buffer_org[j] >= 0x80 && string_buffer_org[j] <= 0xBF ) 
    {
      temp = string_buffer_org[j] + 0xC200;
      
      string_buffer_mod[j+offset] = temp>>8;
      string_buffer_mod[j+offset+1] = temp;
      offset++;
      string_length_mod++;
    }
    else if ( string_buffer_org[j] >= 0xC0 && string_buffer_org[j] <= 0xFF ) 
    {
      temp = string_buffer_org[j] + 0xC2C0;
      
      string_buffer_mod[j+offset] = temp>>8;
      string_buffer_mod[j+offset+1] = temp;
      offset++;
      string_length_mod++;
    }
    else
      string_buffer_mod[j+offset] = string_buffer_org[j];
  }
    
  //neuen String schreiben
  putvalue(P_FSG_41_0_0_44_20_Hex,string_buffer_mod,string_length_mod);
  putValue(P_FSG_41_0_0_44_20_len, string_length_mod);
}

on envVar P_FSG_41_0_0_44_21 // CallInfo3.Category6
{
	P_FSG_41_0_0_44_BuildFct();
}

// Ruecksetzen des Fehlerstatus durch manuelle Fehlereingabe
on envVar P_FSG_41_0_0_45_ErrCode
{
       if(gP_FSG_41_0_0_45_ErrCode) 
       {
           setControlBackColor(panel_name,"errfield_P_FSG_41_0_0_45", MakeRGB(255,255,255));
       }
       gP_FSG_41_0_0_45_ErrCode = 1;
}
on envVar P_FSG_41_0_0_45Status_BTN
{
	byte BAPTemp[10];
    if (P_FSG_41_0_0_45Status_BTN_already_pressed == 0)
    {
        putValue(P_FSG_41_0_0_45_ErrCode,0);
        SetControlBackColor(panel_name,"errField_P_FSG_41_0_0_45",MakeRGB(255,255,255));
        P_FSG_41_0_0_45Status_BTN_already_pressed = 1;
    }
    else
    {
		P_FSG_41_0_0_45_BuildFct();
        getValue(P_FSG_41_0_0_45, BAPTemp);
        Request_ByteSequence(LSGID, P_FSG_41_0_0_45_ID, Data_REQ, BAPTemp, getValueSize(P_FSG_41_0_0_45));
        if(getValue(P_FSG_41_0_0_45_IntTlgEn)) //getValue(IT))
        {
           intertelegram_err(P_FSG_41_0_0_45_ID);
        }
        if(getValue(P_FSG_41_0_0_45_SegmEn))   //getvalue(SG)
        {
           sequence_err(P_FSG_41_0_0_45_ID,elCount(BAPTemp));
        }
       P_FSG_41_0_0_45Status_BTN_already_pressed = 0;
    }
}
on envVar P_FSG_41_0_0_45_FctEn
{
    long data[3];
    data[0]=LSGID;
    data[1]=P_FSG_41_0_0_45_ID;
    data[2]=getValue(P_FSG_41_0_0_45_FctEn);
    ChangeConfig(0x0031,data);
}
// De-Aktivierung der Eingabefelder der FCTID P_FSG_41_0_0_45
on envVar P_FSG_41_0_0_45_FctLstItemEn
{
       if(getValue(this)) 
       {
           EnableControl(panel_name,"panel_FSG_41_0_0_45",1);
           EnableControl(panel_name,"errfield_P_FSG_41_0_0_45",1);
           EnableControl(panel_name,"panel_P_FSG_41_0_0_45",1);
           setControlForeColor(panel_name, "checkbox_P_FSG_41_0_0_45", MakeRGB(0,240,0));
       }
       else
       {
           EnableControl(panel_name,"panel_FSG_41_0_0_45",0);
           EnableControl(panel_name,"errfield_P_FSG_41_0_0_45",0);
           EnableControl(panel_name,"panel_P_FSG_41_0_0_45",0);
           setControlForeColor(panel_name, "checkbox_P_FSG_41_0_0_45", MakeRGB(250,0,0));
       }
}
// Man darf gleichzeitig nur Checkbox fuer SegmError oder IntertelegramError aktiviert werden
on envVar P_FSG_41_0_0_45_IntTlgEn
{
       if(getValue(this)) 
       {
           putValue(P_FSG_41_0_0_45_SegmEn,0);
           intertelegram_err(P_FSG_41_0_0_45_ID);
       }
       else
       {
           intertelegram_err_off(P_FSG_41_0_0_45_ID);
       }
}
// Man darf gleichzeitig nur Checkbox fuer SegmError oder IntertelegramError aktiviert werden
on envVar P_FSG_41_0_0_45_SegmEn
{
       if(getValue(this)) 
       {
           putValue(P_FSG_41_0_0_45_IntTlgEn,0);
           sequence_err(P_FSG_41_0_0_45_ID,getValueSize(P_FSG_41_0_0_45_SegmEn));
       }
       else
       {
              sequence_err_off(P_FSG_41_0_0_45_ID);
       }
}
on envVar P_FSG_41_0_0_45 // bus value of CallOptions_Extended3 (45).
{
	// opcodes: Error-Status
	byte param1; // CallOptions_Extended0
	byte param2; // CallOptions_Extended1
	byte param3; // CallOptions_Extended2
	byte param4; // CallOptions_Extended3
	byte param5; // CallOptions_Extended4
	byte param6; // CallOptions_Extended5
	byte param7; // CallOptions_Extended6
	byte param8; // CurrentAudioSink
	word param9; // AvailableAudioSinks
	// DATATYPE_BYTESEQUENCE / DATATYPE_FIXEDBYTESEQUENCE
	int i;
	byte superval[10];
	int currentPos;
	currentPos = 0;
	for( i = 0; i < 10; i++ ) {
		superval[i] = 0;
	}
	getValue(P_FSG_41_0_0_45, superval);
	///////// Start param1 - UINT8 /////////
	param1 = superval[currentPos++];
	putValue(P_FSG_41_0_0_45_1, param1);
	///////// Start param2 - UINT8 /////////
	param2 = superval[currentPos++];
	putValue(P_FSG_41_0_0_45_2, param2);
	///////// Start param3 - UINT8 /////////
	param3 = superval[currentPos++];
	putValue(P_FSG_41_0_0_45_3, param3);
	///////// Start param4 - UINT8 /////////
	param4 = superval[currentPos++];
	putValue(P_FSG_41_0_0_45_4, param4);
	///////// Start param5 - UINT8 /////////
	param5 = superval[currentPos++];
	putValue(P_FSG_41_0_0_45_5, param5);
	///////// Start param6 - UINT8 /////////
	param6 = superval[currentPos++];
	putValue(P_FSG_41_0_0_45_6, param6);
	///////// Start param7 - UINT8 /////////
	param7 = superval[currentPos++];
	putValue(P_FSG_41_0_0_45_7, param7);
	///////// Start param8 - UINT8 /////////
	param8 = superval[currentPos++];
	putValue(P_FSG_41_0_0_45_8, param8);
	///////// Start param9 - UINT16 /////////
	param9 = superval[currentPos++]|(superval[currentPos++]<<8);
	putValue(P_FSG_41_0_0_45_9, param9);
}

// Updates the bus value field and other dependencies.
P_FSG_41_0_0_45_BuildFct()
{
	byte param1; // CallOptions_Extended0
	byte param2; // CallOptions_Extended1
	byte param3; // CallOptions_Extended2
	byte param4; // CallOptions_Extended3
	byte param5; // CallOptions_Extended4
	byte param6; // CallOptions_Extended5
	byte param7; // CallOptions_Extended6
	byte param8; // CurrentAudioSink
	word param9; // AvailableAudioSinks

	int i;
	byte superval[10];
	int currentPos;
	currentPos = 0;
// gen_BuildFunc_SetSuperVals 
	param1 = getValue(P_FSG_41_0_0_45_1);
	@P_FSG_41_0_0_45_1_0 = (param1 & 1) > 0;
	superval[currentPos++]=param1;
// gen_BuildFunc_SetSuperVals 
	param2 = getValue(P_FSG_41_0_0_45_2);
	@P_FSG_41_0_0_45_2_0 = (param2 & 1) > 0;
	superval[currentPos++]=param2;
// gen_BuildFunc_SetSuperVals 
	param3 = getValue(P_FSG_41_0_0_45_3);
	@P_FSG_41_0_0_45_3_0 = (param3 & 1) > 0;
	superval[currentPos++]=param3;
// gen_BuildFunc_SetSuperVals 
	param4 = getValue(P_FSG_41_0_0_45_4);
	@P_FSG_41_0_0_45_4_0 = (param4 & 1) > 0;
	superval[currentPos++]=param4;
// gen_BuildFunc_SetSuperVals 
	param5 = getValue(P_FSG_41_0_0_45_5);
	@P_FSG_41_0_0_45_5_0 = (param5 & 1) > 0;
	superval[currentPos++]=param5;
// gen_BuildFunc_SetSuperVals 
	param6 = getValue(P_FSG_41_0_0_45_6);
	@P_FSG_41_0_0_45_6_0 = (param6 & 1) > 0;
	superval[currentPos++]=param6;
// gen_BuildFunc_SetSuperVals 
	param7 = getValue(P_FSG_41_0_0_45_7);
	@P_FSG_41_0_0_45_7_0 = (param7 & 1) > 0;
	superval[currentPos++]=param7;
// gen_BuildFunc_SetSuperVals 
	param8 = getValue(P_FSG_41_0_0_45_8);
	superval[currentPos++]=param8;
// gen_BuildFunc_SetSuperVals 
	param9 = getValue(P_FSG_41_0_0_45_9);
	@P_FSG_41_0_0_45_9_0 = (param9 & 1) > 0;
	@P_FSG_41_0_0_45_9_1 = (param9 & 2) > 0;
	@P_FSG_41_0_0_45_9_2 = (param9 & 4) > 0;
	@P_FSG_41_0_0_45_9_3 = (param9 & 8) > 0;
	@P_FSG_41_0_0_45_9_4 = (param9 & 16) > 0;
	@P_FSG_41_0_0_45_9_5 = (param9 & 32) > 0;
	@P_FSG_41_0_0_45_9_6 = (param9 & 64) > 0;
	@P_FSG_41_0_0_45_9_7 = (param9 & 128) > 0;
	@P_FSG_41_0_0_45_9_8 = (param9 & 256) > 0;
	superval[currentPos++]=param9&0x00ff;
	superval[currentPos++]=(param9&0xff00)>>8;
	putValue(P_FSG_41_0_0_45, superval, currentPos);
}


on envVar P_FSG_41_0_0_45_1_0
{
	byte bitval;
	//thisval steht hier fuer den bitfield-wert, 
	//aus Generierungsgruenden hier keine einheitliche Bezeichnung moeglich.
	byte thisval; // CallOptions_Extended0
	bitval= getValue(this);
	thisval = getValue(P_FSG_41_0_0_45_1);
	thisval = thisval&~(1<<0)|(bitval<<0);
	putValue(P_FSG_41_0_0_45_1,thisval);
}

on envVar P_FSG_41_0_0_45_1 // CallOptions_Extended3.CallOptions_Extended0
{
	P_FSG_41_0_0_45_BuildFct();
}

on envVar P_FSG_41_0_0_45_2_0
{
	byte bitval;
	//thisval steht hier fuer den bitfield-wert, 
	//aus Generierungsgruenden hier keine einheitliche Bezeichnung moeglich.
	byte thisval; // CallOptions_Extended1
	bitval= getValue(this);
	thisval = getValue(P_FSG_41_0_0_45_2);
	thisval = thisval&~(1<<0)|(bitval<<0);
	putValue(P_FSG_41_0_0_45_2,thisval);
}

on envVar P_FSG_41_0_0_45_2 // CallOptions_Extended3.CallOptions_Extended1
{
	P_FSG_41_0_0_45_BuildFct();
}

on envVar P_FSG_41_0_0_45_3_0
{
	byte bitval;
	//thisval steht hier fuer den bitfield-wert, 
	//aus Generierungsgruenden hier keine einheitliche Bezeichnung moeglich.
	byte thisval; // CallOptions_Extended2
	bitval= getValue(this);
	thisval = getValue(P_FSG_41_0_0_45_3);
	thisval = thisval&~(1<<0)|(bitval<<0);
	putValue(P_FSG_41_0_0_45_3,thisval);
}

on envVar P_FSG_41_0_0_45_3 // CallOptions_Extended3.CallOptions_Extended2
{
	P_FSG_41_0_0_45_BuildFct();
}

on envVar P_FSG_41_0_0_45_4_0
{
	byte bitval;
	//thisval steht hier fuer den bitfield-wert, 
	//aus Generierungsgruenden hier keine einheitliche Bezeichnung moeglich.
	byte thisval; // CallOptions_Extended3
	bitval= getValue(this);
	thisval = getValue(P_FSG_41_0_0_45_4);
	thisval = thisval&~(1<<0)|(bitval<<0);
	putValue(P_FSG_41_0_0_45_4,thisval);
}

on envVar P_FSG_41_0_0_45_4 // CallOptions_Extended3.CallOptions_Extended3
{
	P_FSG_41_0_0_45_BuildFct();
}

on envVar P_FSG_41_0_0_45_5_0
{
	byte bitval;
	//thisval steht hier fuer den bitfield-wert, 
	//aus Generierungsgruenden hier keine einheitliche Bezeichnung moeglich.
	byte thisval; // CallOptions_Extended4
	bitval= getValue(this);
	thisval = getValue(P_FSG_41_0_0_45_5);
	thisval = thisval&~(1<<0)|(bitval<<0);
	putValue(P_FSG_41_0_0_45_5,thisval);
}

on envVar P_FSG_41_0_0_45_5 // CallOptions_Extended3.CallOptions_Extended4
{
	P_FSG_41_0_0_45_BuildFct();
}

on envVar P_FSG_41_0_0_45_6_0
{
	byte bitval;
	//thisval steht hier fuer den bitfield-wert, 
	//aus Generierungsgruenden hier keine einheitliche Bezeichnung moeglich.
	byte thisval; // CallOptions_Extended5
	bitval= getValue(this);
	thisval = getValue(P_FSG_41_0_0_45_6);
	thisval = thisval&~(1<<0)|(bitval<<0);
	putValue(P_FSG_41_0_0_45_6,thisval);
}

on envVar P_FSG_41_0_0_45_6 // CallOptions_Extended3.CallOptions_Extended5
{
	P_FSG_41_0_0_45_BuildFct();
}

on envVar P_FSG_41_0_0_45_7_0
{
	byte bitval;
	//thisval steht hier fuer den bitfield-wert, 
	//aus Generierungsgruenden hier keine einheitliche Bezeichnung moeglich.
	byte thisval; // CallOptions_Extended6
	bitval= getValue(this);
	thisval = getValue(P_FSG_41_0_0_45_7);
	thisval = thisval&~(1<<0)|(bitval<<0);
	putValue(P_FSG_41_0_0_45_7,thisval);
}

on envVar P_FSG_41_0_0_45_7 // CallOptions_Extended3.CallOptions_Extended6
{
	P_FSG_41_0_0_45_BuildFct();
}

on envVar P_FSG_41_0_0_45_8 // CallOptions_Extended3.CurrentAudioSink
{
	P_FSG_41_0_0_45_BuildFct();
}

on envVar P_FSG_41_0_0_45_9_0
{
	byte bitval;
	//thisval steht hier fuer den bitfield-wert, 
	//aus Generierungsgruenden hier keine einheitliche Bezeichnung moeglich.
	word thisval; // AvailableAudioSinks
	bitval= getValue(this);
	thisval = getValue(P_FSG_41_0_0_45_9);
	thisval = thisval&~(1<<0)|(bitval<<0);
	putValue(P_FSG_41_0_0_45_9,thisval);
}

on envVar P_FSG_41_0_0_45_9_1
{
	byte bitval;
	//thisval steht hier fuer den bitfield-wert, 
	//aus Generierungsgruenden hier keine einheitliche Bezeichnung moeglich.
	word thisval; // AvailableAudioSinks
	bitval= getValue(this);
	thisval = getValue(P_FSG_41_0_0_45_9);
	thisval = thisval&~(1<<1)|(bitval<<1);
	putValue(P_FSG_41_0_0_45_9,thisval);
}

on envVar P_FSG_41_0_0_45_9_2
{
	byte bitval;
	//thisval steht hier fuer den bitfield-wert, 
	//aus Generierungsgruenden hier keine einheitliche Bezeichnung moeglich.
	word thisval; // AvailableAudioSinks
	bitval= getValue(this);
	thisval = getValue(P_FSG_41_0_0_45_9);
	thisval = thisval&~(1<<2)|(bitval<<2);
	putValue(P_FSG_41_0_0_45_9,thisval);
}

on envVar P_FSG_41_0_0_45_9_3
{
	byte bitval;
	//thisval steht hier fuer den bitfield-wert, 
	//aus Generierungsgruenden hier keine einheitliche Bezeichnung moeglich.
	word thisval; // AvailableAudioSinks
	bitval= getValue(this);
	thisval = getValue(P_FSG_41_0_0_45_9);
	thisval = thisval&~(1<<3)|(bitval<<3);
	putValue(P_FSG_41_0_0_45_9,thisval);
}

on envVar P_FSG_41_0_0_45_9_4
{
	byte bitval;
	//thisval steht hier fuer den bitfield-wert, 
	//aus Generierungsgruenden hier keine einheitliche Bezeichnung moeglich.
	word thisval; // AvailableAudioSinks
	bitval= getValue(this);
	thisval = getValue(P_FSG_41_0_0_45_9);
	thisval = thisval&~(1<<4)|(bitval<<4);
	putValue(P_FSG_41_0_0_45_9,thisval);
}

on envVar P_FSG_41_0_0_45_9_5
{
	byte bitval;
	//thisval steht hier fuer den bitfield-wert, 
	//aus Generierungsgruenden hier keine einheitliche Bezeichnung moeglich.
	word thisval; // AvailableAudioSinks
	bitval= getValue(this);
	thisval = getValue(P_FSG_41_0_0_45_9);
	thisval = thisval&~(1<<5)|(bitval<<5);
	putValue(P_FSG_41_0_0_45_9,thisval);
}

on envVar P_FSG_41_0_0_45_9_6
{
	byte bitval;
	//thisval steht hier fuer den bitfield-wert, 
	//aus Generierungsgruenden hier keine einheitliche Bezeichnung moeglich.
	word thisval; // AvailableAudioSinks
	bitval= getValue(this);
	thisval = getValue(P_FSG_41_0_0_45_9);
	thisval = thisval&~(1<<6)|(bitval<<6);
	putValue(P_FSG_41_0_0_45_9,thisval);
}

on envVar P_FSG_41_0_0_45_9_7
{
	byte bitval;
	//thisval steht hier fuer den bitfield-wert, 
	//aus Generierungsgruenden hier keine einheitliche Bezeichnung moeglich.
	word thisval; // AvailableAudioSinks
	bitval= getValue(this);
	thisval = getValue(P_FSG_41_0_0_45_9);
	thisval = thisval&~(1<<7)|(bitval<<7);
	putValue(P_FSG_41_0_0_45_9,thisval);
}

on envVar P_FSG_41_0_0_45_9_8
{
	byte bitval;
	//thisval steht hier fuer den bitfield-wert, 
	//aus Generierungsgruenden hier keine einheitliche Bezeichnung moeglich.
	word thisval; // AvailableAudioSinks
	bitval= getValue(this);
	thisval = getValue(P_FSG_41_0_0_45_9);
	thisval = thisval&~(1<<8)|(bitval<<8);
	putValue(P_FSG_41_0_0_45_9,thisval);
}

on envVar P_FSG_41_0_0_45_9 // CallOptions_Extended3.AvailableAudioSinks
{
	P_FSG_41_0_0_45_BuildFct();
}

// Ruecksetzen des Fehlerstatus durch manuelle Fehlereingabe
on envVar M_FSG_41_0_0_46_ErrCode
{
       if(gM_FSG_41_0_0_46_ErrCode) 
       {
           setControlBackColor(panel_name,"errfield_M_FSG_41_0_0_46", MakeRGB(255,255,255));
       }
       gM_FSG_41_0_0_46_ErrCode = 1;
}
on envVar M_FSG_41_0_0_46Result_BTN
{
    byte temp[2];
    if (M_FSG_41_0_0_46Result_BTN_already_pressed == 0)
    {
        putValue(M_FSG_41_0_0_46_ErrCode,0);
        SetControlBackColor(panel_name,"errField_M_FSG_41_0_0_46",MakeRGB(255,255,255));
        M_FSG_41_0_0_46Result_BTN_already_pressed = 1;
    }
    else
    {
        putValue(M_FSG_41_0_0_46_State, "Result");
        getValue(M_FSG_41_0_0_46_Result, temp);
        Request_ByteSequence(LSGID, M_FSG_41_0_0_46_ID, Result_REQ, temp, getValueSize(M_FSG_41_0_0_46_Result));
        M_FSG_41_0_0_46Result_BTN_already_pressed = 0;
    }
}
on envVar M_FSG_41_0_0_46_FctEn
{
    long data[3];
    data[0]=LSGID;
    data[1]=M_FSG_41_0_0_46_ID;
    data[2]=getValue(M_FSG_41_0_0_46_FctEn);
    ChangeConfig(0x0031,data);
}
// De-Aktivierung der Eingabefelder der FCTID M_FSG_41_0_0_46
on envVar M_FSG_41_0_0_46_FctLstItemEn
{
       if(getValue(this)) 
       {
           EnableControl(panel_name,"panel_FSG_41_0_0_46",1);
           EnableControl(panel_name,"errfield_M_FSG_41_0_0_46",1);
           EnableControl(panel_name,"panel_M_FSG_41_0_0_46",1);
           EnableControl(panel_name,"panel_M_FSG_41_0_0_46_Processing",1);
           EnableControl(panel_name,"panel_M_FSG_41_0_0_46_Start",1);
           setControlForeColor(panel_name, "checkbox_M_FSG_41_0_0_46", MakeRGB(0,240,0));
       }
       else
       {
           EnableControl(panel_name,"panel_FSG_41_0_0_46",0);
           EnableControl(panel_name,"errfield_M_FSG_41_0_0_46",0);
           EnableControl(panel_name,"panel_M_FSG_41_0_0_46",0);
           EnableControl(panel_name,"panel_M_FSG_41_0_0_46_Processing",0);
           EnableControl(panel_name,"panel_M_FSG_41_0_0_46_Start",0);
           setControlForeColor(panel_name, "checkbox_M_FSG_41_0_0_46", MakeRGB(250,0,0));
       }
}
on envVar M_FSG_41_0_0_46_Result // bus value of CallFunctions3 (46).
{
	// opcodes: Error-Processing-Result
	byte param1; // CallFunction
	byte param2; // CallFunctions_Result
	// DATATYPE_BYTESEQUENCE / DATATYPE_FIXEDBYTESEQUENCE
	int i;
	byte superval[2];
	int currentPos;
	currentPos = 0;
	for( i = 0; i < 2; i++ ) {
		superval[i] = 0;
	}
	getValue(M_FSG_41_0_0_46_Result, superval);
	///////// Start param1 - UINT8 /////////
	param1 = superval[currentPos++];
	putValue(M_FSG_41_0_0_46_Result_1, param1);
	///////// Start param2 - UINT8 /////////
	param2 = superval[currentPos++];
	putValue(M_FSG_41_0_0_46_Result_2, param2);
}

on envVar M_FSG_41_0_0_46_Result_1 // CallFunctions3.CallFunction
{
	byte superval[2];

	//Update Childvalue (Enum)
	byte thisval; // CallFunction
	thisval = getValue(this);

    // Update superval
	getValue(M_FSG_41_0_0_46_Result, superval);
	superval[0]=thisval;
	putValue(M_FSG_41_0_0_46_Result,superval);
}

on envVar M_FSG_41_0_0_46_Result_2 // CallFunctions3.CallFunctions_Result
{
	byte superval[2];

	//Update Childvalue (Enum)
	byte thisval; // CallFunctions_Result
	thisval = getValue(this);

    // Update superval
	getValue(M_FSG_41_0_0_46_Result, superval);
	superval[1]=thisval;
	putValue(M_FSG_41_0_0_46_Result,superval);
}

on envVar M_FSG_41_0_0_46_Processing // bus value of CallFunctions3 (46).
{
	// opcodes: Error-Processing-Result
	byte param1; // CallFunction
	byte param2; // Reserve1
	// DATATYPE_BYTESEQUENCE / DATATYPE_FIXEDBYTESEQUENCE
	int i;
	byte superval[2];
	int currentPos;
	currentPos = 0;
	for( i = 0; i < 2; i++ ) {
		superval[i] = 0;
	}
	getValue(M_FSG_41_0_0_46_Processing, superval);
	///////// Start param1 - UINT8 /////////
	param1 = superval[currentPos++];
	putValue(M_FSG_41_0_0_46_Processing_1, param1);
	///////// Start param2 - UINT8 /////////
	param2 = superval[currentPos++];
	putValue(M_FSG_41_0_0_46_Processing_2, round((param2 * 1.0) - (0) + (0), 1.0));
}

on envVar M_FSG_41_0_0_46_Processing_1 // CallFunctions3.CallFunction
{
	byte superval[2];

	//Update Childvalue (Enum)
	byte thisval; // CallFunction
	thisval = getValue(this);

    // Update superval
	getValue(M_FSG_41_0_0_46_Processing, superval);
	superval[0]=thisval;
	putValue(M_FSG_41_0_0_46_Processing,superval);
}

// Ueberwachung der Darstellungsvariable der Range.
on envVar M_FSG_41_0_0_46_Processing_2_range // CallFunctions3.Reserve1 
{
	@M_FSG_41_0_0_46_Processing_2 = @M_FSG_41_0_0_46_Processing_2_range - (0); // slider = range - min
}

on envVar M_FSG_41_0_0_46_Processing_2 // CallFunctions3.Reserve1
{
	byte superval[2];

	//Update Childvalue (Number)
	byte thisval; // Reserve1
	float slider_value;

	slider_value = 0; // Konstanter Parameter.
	@M_FSG_41_0_0_46_Processing_2_range = slider_value + (0); // real value := slider value + range min.
	thisval = (byte)round((slider_value + (0) - (0)) / (1.0), 1); // bus value := (slider value + min - offset) / step.

    // Update superval
	getValue(M_FSG_41_0_0_46_Processing, superval);
	superval[1]=thisval;
	putValue(M_FSG_41_0_0_46_Processing,superval);
}

on envVar M_FSG_41_0_0_46_Start // bus value of CallFunctions3 (46).
{
	// opcodes: AbortResult-StartResult
	byte param1; // CallFunction
	byte param2; // CallID
	byte param3; // MessageID
	byte param4; // ServiceType
	byte param5; // Control
	byte param6; // SelectedAudioSink
	byte param7[41]; // TelNumber
	word len7;
	byte cnt7;
	byte param8[150]; // Name
	word len8;
	byte cnt8;
	// DATATYPE_BYTESEQUENCE / DATATYPE_FIXEDBYTESEQUENCE
	int i;
	byte superval[195];
	int currentPos;
	currentPos = 0;
	for( i = 0; i < 195; i++ ) {
		superval[i] = 0;
	}
	getValue(M_FSG_41_0_0_46_Start, superval);
	///////// Start param1 - UINT8 /////////
	param1 = superval[currentPos++];
	putValue(M_FSG_41_0_0_46_Start_1, param1);
	///////// Start param2 - NIBBLE /////////
	param2 = (superval[currentPos] & 0xf0)>>4;
	putValue(M_FSG_41_0_0_46_Start_2, param2);
	///////// Start param3 - NIBBLE /////////
	param3 = superval[currentPos++] & 0x0f;
	putValue(M_FSG_41_0_0_46_Start_3, param3);
	///////// Start param4 - NIBBLE /////////
	param4 = (superval[currentPos] & 0xf0)>>4;
	putValue(M_FSG_41_0_0_46_Start_4, param4);
	///////// Start param5 - NIBBLE /////////
	param5 = superval[currentPos++] & 0x0f;
	putValue(M_FSG_41_0_0_46_Start_5, param5);
	///////// Start param6 - UINT8 /////////
	param6 = superval[currentPos++];
	putValue(M_FSG_41_0_0_46_Start_6, param6);
	///////// Start param7 - STRING /////////
	getValue(M_FSG_41_0_0_46_Start_7_Hex, param7);
	if((superval[currentPos] & 0x80) > 0)
	{
		if(40>127) /* Max Fct-Katalog Laenge: 40*/
		{
			len7 = ( (superval[currentPos]&0x7F) <<8) + superval[currentPos+1];
			currentPos = currentPos + 2;
			cnt7 = 1;
		}
		else
		{
			len7 = 40;
			writelineEx(gBAP_Trace, 0, "Anzahl der Laengeninformation-Bytes in M_FSG_41_0_0_46_Start ueberschreitet die erlaubte 1 Byte vom Fct-Kalatog.");
		}
	}
	else
	{
		len7 = superval[currentPos]&0x7F;
		currentPos = currentPos + 1;
		cnt7 = 0;
	}
	
	if(len7 > 40)
	{
		writelineEx(gBAP_Trace, 0, "Laenge:%d bei der Byte Position:%d ueberschreitet die Maximale erlaubte Laenge von Fct-Kalatog", len7, currentPos);
		len7 = 40;
	
		if(len7 < 128) cnt7 = 0;
		else cnt7 = 1;
	}
	
	for(i = 0; i < len7; i++)
	{
		param7[i] = superval[currentPos++];
	}
	
	putValue(M_FSG_41_0_0_46_Start_7_len, len7);
	putValue(M_FSG_41_0_0_46_Start_7_cnt, cnt7);
	
	if(len7 > getValueSize(M_FSG_41_0_0_46_Start_7_Hex))
		putValue(M_FSG_41_0_0_46_Start_7_Hex, param7, len7);
	else
		putValue(M_FSG_41_0_0_46_Start_7_Hex, param7, getValueSize(M_FSG_41_0_0_46_Start_7_Hex));

	///////// Start param8 - STRING /////////
	getValue(M_FSG_41_0_0_46_Start_8_Hex, param8);
	if((superval[currentPos] & 0x80) > 0)
	{
		if(148>127) /* Max Fct-Katalog Laenge: 148*/
		{
			len8 = ( (superval[currentPos]&0x7F) <<8) + superval[currentPos+1];
			currentPos = currentPos + 2;
			cnt8 = 1;
		}
		else
		{
			len8 = 148;
			writelineEx(gBAP_Trace, 0, "Anzahl der Laengeninformation-Bytes in M_FSG_41_0_0_46_Start ueberschreitet die erlaubte 1 Byte vom Fct-Kalatog.");
		}
	}
	else
	{
		len8 = superval[currentPos]&0x7F;
		currentPos = currentPos + 1;
		cnt8 = 0;
	}
	
	if(len8 > 148)
	{
		writelineEx(gBAP_Trace, 0, "Laenge:%d bei der Byte Position:%d ueberschreitet die Maximale erlaubte Laenge von Fct-Kalatog", len8, currentPos);
		len8 = 148;
	
		if(len8 < 128) cnt8 = 0;
		else cnt8 = 1;
	}
	
	for(i = 0; i < len8; i++)
	{
		param8[i] = superval[currentPos++];
	}
	
	putValue(M_FSG_41_0_0_46_Start_8_len, len8);
	putValue(M_FSG_41_0_0_46_Start_8_cnt, cnt8);
	
	if(len8 > getValueSize(M_FSG_41_0_0_46_Start_8_Hex))
		putValue(M_FSG_41_0_0_46_Start_8_Hex, param8, len8);
	else
		putValue(M_FSG_41_0_0_46_Start_8_Hex, param8, getValueSize(M_FSG_41_0_0_46_Start_8_Hex));

}

// Updates the bus value field and other dependencies.
M_FSG_41_0_0_46_Start_BuildFct()
{
	byte param1; // CallFunction
	byte param2; // CallID
	byte param3; // MessageID
	byte param4; // ServiceType
	byte param5; // Control
	byte param6; // SelectedAudioSink
	byte param7[41]; // TelNumber
	word len7;
	byte cnt7;
	byte param8[150]; // Name
	word len8;
	byte cnt8;

	int i;
	byte superval[195];
	int currentPos;
	currentPos = 0;
// gen_BuildFunc_SetSuperVals 
	param1 = getValue(M_FSG_41_0_0_46_Start_1);
	superval[currentPos++]=param1;
// gen_BuildFunc_SetSuperVals 
	param2 = getValue(M_FSG_41_0_0_46_Start_2);
	param2 = param2 & 0x0f;
	superval[currentPos]= superval[currentPos]&0x0f;
	superval[currentPos]= superval[currentPos]|(param2<<4);
// gen_BuildFunc_SetSuperVals 
	param3 = getValue(M_FSG_41_0_0_46_Start_3);
	param3 = param3 & 0x0f;
	superval[currentPos]= superval[currentPos]&0xf0;
	superval[currentPos]= superval[currentPos]|param3;
	currentPos++;
// gen_BuildFunc_SetSuperVals 
	param4 = getValue(M_FSG_41_0_0_46_Start_4);
	param4 = param4 & 0x0f;
	superval[currentPos]= superval[currentPos]&0x0f;
	superval[currentPos]= superval[currentPos]|(param4<<4);
// gen_BuildFunc_SetSuperVals 
	param5 = getValue(M_FSG_41_0_0_46_Start_5);
	param5 = param5 & 0x0f;
	superval[currentPos]= superval[currentPos]&0xf0;
	superval[currentPos]= superval[currentPos]|param5;
	currentPos++;
// gen_BuildFunc_SetSuperVals 
	param6 = getValue(M_FSG_41_0_0_46_Start_6);
	superval[currentPos++]=param6;
// gen_BuildFunc_SetSuperVals 
	getValue(M_FSG_41_0_0_46_Start_7_Hex, param7);
	len7 = getValue(M_FSG_41_0_0_46_Start_7_len);
	cnt7= getValue(M_FSG_41_0_0_46_Start_7_cnt);
	
	/* check box aktiviert*/
	if (cnt7 == 1)
	{
		/* 0 bis 40 (MaxString - 1B oder 2B) */
		if(len7 >= 0 && len7 <= 40)
		{
			//writelineEx(gBAP_Trace, 0, "[Debug-1] Len7: %d", len7);
			superval[currentPos] = (len7&0x7f00) | 0x80;
			superval[currentPos+1] = len7 & 0x00ff;
		}
		else
		{
			writelineEx(gBAP_Trace, 0, "Eingegebene Laenge: %d von M_FSG_41_0_0_46_Start_7 ist ungueltig. Die max. erlaubte Laenge ist %d.", len7, 40);
			return;
		}
	}
	else if(cnt7 == 0) /*check box deaktiviert*/
	{
		if(len7 >= 0 && len7 <= 127)
		{
			//writelineEx(gBAP_Trace, 0, "[Debug-1] Len7: %d", len7);
			superval[currentPos]= len7 & 0x00ff;
			putValue(M_FSG_41_0_0_46_Start_7_len, len7);
		}
		else if(len7 > 127 && len7 <= 40)
		{
			superval[currentPos] = (len7&0x7f00) | 0x80;
			superval[currentPos+1] = len7 & 0x00ff;
			putValue(M_FSG_41_0_0_46_Start_7_len, len7);
			putValue(M_FSG_41_0_0_46_Start_7_cnt, 1);
		}
		else
		{
			writelineEx(gBAP_Trace, 0, "Eingegebene Laenge: %d von M_FSG_41_0_0_46_Start_7 ist ungueltig. Die max. erlaubte Laenge ist %d.", len7, 40);
			return;
		}
	}
	currentPos += cnt7+1;
	for(i = 0; i < len7; i++)
	{
		superval[currentPos++]= param7[i];
	}

// gen_BuildFunc_SetSuperVals 
	getValue(M_FSG_41_0_0_46_Start_8_Hex, param8);
	len8 = getValue(M_FSG_41_0_0_46_Start_8_len);
	cnt8= getValue(M_FSG_41_0_0_46_Start_8_cnt);
	
	/* check box aktiviert*/
	if (cnt8 == 1)
	{
		/* 0 bis 148 (MaxString - 1B oder 2B) */
		if(len8 >= 0 && len8 <= 148)
		{
			//writelineEx(gBAP_Trace, 0, "[Debug-1] Len8: %d", len8);
			superval[currentPos] = (len8&0x7f00) | 0x80;
			superval[currentPos+1] = len8 & 0x00ff;
		}
		else
		{
			writelineEx(gBAP_Trace, 0, "Eingegebene Laenge: %d von M_FSG_41_0_0_46_Start_8 ist ungueltig. Die max. erlaubte Laenge ist %d.", len8, 148);
			return;
		}
	}
	else if(cnt8 == 0) /*check box deaktiviert*/
	{
		if(len8 >= 0 && len8 <= 127)
		{
			//writelineEx(gBAP_Trace, 0, "[Debug-1] Len8: %d", len8);
			superval[currentPos]= len8 & 0x00ff;
			putValue(M_FSG_41_0_0_46_Start_8_len, len8);
		}
		else if(len8 > 127 && len8 <= 148)
		{
			superval[currentPos] = (len8&0x7f00) | 0x80;
			superval[currentPos+1] = len8 & 0x00ff;
			putValue(M_FSG_41_0_0_46_Start_8_len, len8);
			putValue(M_FSG_41_0_0_46_Start_8_cnt, 1);
		}
		else
		{
			writelineEx(gBAP_Trace, 0, "Eingegebene Laenge: %d von M_FSG_41_0_0_46_Start_8 ist ungueltig. Die max. erlaubte Laenge ist %d.", len8, 148);
			return;
		}
	}
	currentPos += cnt8+1;
	for(i = 0; i < len8; i++)
	{
		superval[currentPos++]= param8[i];
	}

	putValue(M_FSG_41_0_0_46_Start, superval, currentPos);
}


on envVar M_FSG_41_0_0_46_Start_1 // CallFunctions3.CallFunction
{
	M_FSG_41_0_0_46_Start_BuildFct();
}

on envVar M_FSG_41_0_0_46_Start_2 // CallFunctions3.CallID
{
	M_FSG_41_0_0_46_Start_BuildFct();
}

on envVar M_FSG_41_0_0_46_Start_3 // CallFunctions3.MessageID
{
	M_FSG_41_0_0_46_Start_BuildFct();
}

on envVar M_FSG_41_0_0_46_Start_4 // CallFunctions3.ServiceType
{
	M_FSG_41_0_0_46_Start_BuildFct();
}

on envVar M_FSG_41_0_0_46_Start_5 // CallFunctions3.Control
{
	M_FSG_41_0_0_46_Start_BuildFct();
}

on envVar M_FSG_41_0_0_46_Start_6 // CallFunctions3.SelectedAudioSink
{
	M_FSG_41_0_0_46_Start_BuildFct();
}


// Ueberwachung der CheckBox fuer String
on envVar  M_FSG_41_0_0_46_Start_7_cnt
{
	word len;
	byte cnt;
	len = getValue(M_FSG_41_0_0_46_Start_7_len);
	cnt = getValue(M_FSG_41_0_0_46_Start_7_cnt);

	/* wird nur gerufen, wenn check box deaktiviert mit Length>127*/ 
	if( cnt == 0) 
	{
		if(len > 127 )
		{
			putValue(M_FSG_41_0_0_46_Start_7_len, 127);
		}
	}

	M_FSG_41_0_0_46_Start_BuildFct();
}



// Ueberwachung der Eingabefeld fuer String Data
on envVar M_FSG_41_0_0_46_Start_7_len
{
	word len;
	len = getValue(this);
	/* Validierung der Eingabe*/
	if(len > 40)
	{
		writelineEx(gBAP_Trace, 0, "Eingegebene Laenge: %d von M_FSG_41_0_0_46_Start_7 ist ungueltig. Die max. erlaubte Laenge ist %d. ", len, 40);
		putValue(this, 40);
	}
	M_FSG_41_0_0_46_Start_BuildFct();
}


on envVar M_FSG_41_0_0_46_Start_7 // CallFunctions3.TelNumber
{
	int j, offset;
  int temp;
  int string_length_org;
  int string_length_mod;
  byte string_buffer_org[255];
  byte string_buffer_mod[255];
  
  //Start-Länge
  string_length_org = getValueSize(this);
  string_length_mod = string_length_org;
  
  //Start-String in Buffer
  getvalue(this,string_buffer_org);
  
  //Buffer auf Sonderzeichen checken und ersetzen
  offset = 0;
  for (j=0;j<string_length_org;j++)
  {
    if ( string_buffer_org[j] >= 0x80 && string_buffer_org[j] <= 0xBF ) 
    {
      temp = string_buffer_org[j] + 0xC200;
      
      string_buffer_mod[j+offset] = temp>>8;
      string_buffer_mod[j+offset+1] = temp;
      offset++;
      string_length_mod++;
    }
    else if ( string_buffer_org[j] >= 0xC0 && string_buffer_org[j] <= 0xFF ) 
    {
      temp = string_buffer_org[j] + 0xC2C0;
      
      string_buffer_mod[j+offset] = temp>>8;
      string_buffer_mod[j+offset+1] = temp;
      offset++;
      string_length_mod++;
    }
    else
      string_buffer_mod[j+offset] = string_buffer_org[j];
  }
    
  //neuen String schreiben
  putvalue(M_FSG_41_0_0_46_Start_7_Hex,string_buffer_mod,string_length_mod);
  putValue(M_FSG_41_0_0_46_Start_7_len, string_length_mod);
}


// Ueberwachung der CheckBox fuer String
on envVar  M_FSG_41_0_0_46_Start_8_cnt
{
	word len;
	byte cnt;
	len = getValue(M_FSG_41_0_0_46_Start_8_len);
	cnt = getValue(M_FSG_41_0_0_46_Start_8_cnt);

	/* wird nur gerufen, wenn check box deaktiviert mit Length>127*/ 
	if( cnt == 0) 
	{
		if(len > 127 )
		{
			putValue(M_FSG_41_0_0_46_Start_8_len, 127);
		}
	}

	M_FSG_41_0_0_46_Start_BuildFct();
}



// Ueberwachung der Eingabefeld fuer String Data
on envVar M_FSG_41_0_0_46_Start_8_len
{
	word len;
	len = getValue(this);
	/* Validierung der Eingabe*/
	if(len > 148)
	{
		writelineEx(gBAP_Trace, 0, "Eingegebene Laenge: %d von M_FSG_41_0_0_46_Start_8 ist ungueltig. Die max. erlaubte Laenge ist %d. ", len, 148);
		putValue(this, 148);
	}
	M_FSG_41_0_0_46_Start_BuildFct();
}


on envVar M_FSG_41_0_0_46_Start_8 // CallFunctions3.Name
{
	int j, offset;
  int temp;
  int string_length_org;
  int string_length_mod;
  byte string_buffer_org[255];
  byte string_buffer_mod[255];
  
  //Start-Länge
  string_length_org = getValueSize(this);
  string_length_mod = string_length_org;
  
  //Start-String in Buffer
  getvalue(this,string_buffer_org);
  
  //Buffer auf Sonderzeichen checken und ersetzen
  offset = 0;
  for (j=0;j<string_length_org;j++)
  {
    if ( string_buffer_org[j] >= 0x80 && string_buffer_org[j] <= 0xBF ) 
    {
      temp = string_buffer_org[j] + 0xC200;
      
      string_buffer_mod[j+offset] = temp>>8;
      string_buffer_mod[j+offset+1] = temp;
      offset++;
      string_length_mod++;
    }
    else if ( string_buffer_org[j] >= 0xC0 && string_buffer_org[j] <= 0xFF ) 
    {
      temp = string_buffer_org[j] + 0xC2C0;
      
      string_buffer_mod[j+offset] = temp>>8;
      string_buffer_mod[j+offset+1] = temp;
      offset++;
      string_length_mod++;
    }
    else
      string_buffer_mod[j+offset] = string_buffer_org[j];
  }
    
  //neuen String schreiben
  putvalue(M_FSG_41_0_0_46_Start_8_Hex,string_buffer_mod,string_length_mod);
  putValue(M_FSG_41_0_0_46_Start_8_len, string_length_mod);
}

// Ruecksetzen des Fehlerstatus durch manuelle Fehlereingabe
on envVar P_FSG_41_0_0_47_ErrCode
{
       if(gP_FSG_41_0_0_47_ErrCode) 
       {
           setControlBackColor(panel_name,"errfield_P_FSG_41_0_0_47", MakeRGB(255,255,255));
       }
       gP_FSG_41_0_0_47_ErrCode = 1;
}
on envVar P_FSG_41_0_0_47Status_BTN
{
	byte BAPTemp[4];
   if (P_FSG_41_0_0_47Status_BTN_already_pressed == 0)
   {
      putValue(P_FSG_41_0_0_47_ErrCode,0);
      SetControlBackColor(panel_name,"errField_P_FSG_41_0_0_47",MakeRGB(255,255,255));
      P_FSG_41_0_0_47Status_BTN_already_pressed = 1;
   }
   else
   {
      getValue(P_FSG_41_0_0_47, BAPTemp);
      Request_ByteSequence(LSGID, P_FSG_41_0_0_47_ID, Data_REQ, BAPTemp, getValueSize(P_FSG_41_0_0_47));
      P_FSG_41_0_0_47Status_BTN_already_pressed = 0;
   }
}
on envVar P_FSG_41_0_0_47_FctEn
{
    long data[3];
    data[0]=LSGID;
    data[1]=P_FSG_41_0_0_47_ID;
    data[2]=getValue(P_FSG_41_0_0_47_FctEn);
    ChangeConfig(0x0031,data);
}
// De-Aktivierung der Eingabefelder der FCTID P_FSG_41_0_0_47
on envVar P_FSG_41_0_0_47_FctLstItemEn
{
       if(getValue(this)) 
       {
           EnableControl(panel_name,"panel_FSG_41_0_0_47",1);
           EnableControl(panel_name,"errfield_P_FSG_41_0_0_47",1);
           EnableControl(panel_name,"panel_P_FSG_41_0_0_47",1);
           setControlForeColor(panel_name, "checkbox_P_FSG_41_0_0_47", MakeRGB(0,240,0));
       }
       else
       {
           EnableControl(panel_name,"panel_FSG_41_0_0_47",0);
           EnableControl(panel_name,"errfield_P_FSG_41_0_0_47",0);
           EnableControl(panel_name,"panel_P_FSG_41_0_0_47",0);
           setControlForeColor(panel_name, "checkbox_P_FSG_41_0_0_47", MakeRGB(250,0,0));
       }
}
on envVar P_FSG_41_0_0_47 // bus value of ActivePhone (47).
{
	// opcodes: Error-Status
	byte param1; // ActivePhoneID
	byte param2; // DisplayedPhoneID
	byte param3; // AvailablePhones
	byte param4; // Extension_1
	byte param5; // Extension_2
	// DATATYPE_BYTESEQUENCE / DATATYPE_FIXEDBYTESEQUENCE
	int i;
	byte superval[4];
	int currentPos;
	currentPos = 0;
	for( i = 0; i < 4; i++ ) {
		superval[i] = 0;
	}
	getValue(P_FSG_41_0_0_47, superval);
	///////// Start param1 - NIBBLE /////////
	param1 = (superval[currentPos] & 0xf0)>>4;
	putValue(P_FSG_41_0_0_47_1, param1);
	///////// Start param2 - NIBBLE /////////
	param2 = superval[currentPos++] & 0x0f;
	putValue(P_FSG_41_0_0_47_2, param2);
	///////// Start param3 - UINT8 /////////
	param3 = superval[currentPos++];
	putValue(P_FSG_41_0_0_47_3, param3);
	///////// Start param4 - UINT8 /////////
	param4 = superval[currentPos++];
	putValue(P_FSG_41_0_0_47_4, round((param4 * 1.0) - (0) + (0), 1.0));
	///////// Start param5 - UINT8 /////////
	param5 = superval[currentPos++];
	putValue(P_FSG_41_0_0_47_5, round((param5 * 1.0) - (0) + (0), 1.0));
}

on envVar P_FSG_41_0_0_47_1 // ActivePhone.ActivePhoneID
{
	byte superval[4];

	//Update Childvalue (Enum)
	byte thisval; // ActivePhoneID
	thisval = 0x0f & getValue(this);

    // Update superval
	getValue(P_FSG_41_0_0_47, superval);
	superval[0]= superval[0]&0x0f;
	superval[0]= superval[0]|(thisval<<4);
	putValue(P_FSG_41_0_0_47,superval);
}

on envVar P_FSG_41_0_0_47_2 // ActivePhone.DisplayedPhoneID
{
	byte superval[4];

	//Update Childvalue (Enum)
	byte thisval; // DisplayedPhoneID
	thisval = 0x0f & getValue(this);

    // Update superval
	getValue(P_FSG_41_0_0_47, superval);
	superval[0]= superval[0]&0xf0;
	superval[0]= superval[0]|thisval;
	putValue(P_FSG_41_0_0_47,superval);
}

on envVar P_FSG_41_0_0_47_3_0
{
	byte bitval;
	//thisval steht hier fuer den bitfield-wert, 
	//aus Generierungsgruenden hier keine einheitliche Bezeichnung moeglich.
	byte thisval; // AvailablePhones
	bitval= getValue(this);
	thisval = getValue(P_FSG_41_0_0_47_3);
	thisval = thisval&~(1<<0)|(bitval<<0);
	putValue(P_FSG_41_0_0_47_3,thisval);
}

on envVar P_FSG_41_0_0_47_3_1
{
	byte bitval;
	//thisval steht hier fuer den bitfield-wert, 
	//aus Generierungsgruenden hier keine einheitliche Bezeichnung moeglich.
	byte thisval; // AvailablePhones
	bitval= getValue(this);
	thisval = getValue(P_FSG_41_0_0_47_3);
	thisval = thisval&~(1<<1)|(bitval<<1);
	putValue(P_FSG_41_0_0_47_3,thisval);
}

on envVar P_FSG_41_0_0_47_3_2
{
	byte bitval;
	//thisval steht hier fuer den bitfield-wert, 
	//aus Generierungsgruenden hier keine einheitliche Bezeichnung moeglich.
	byte thisval; // AvailablePhones
	bitval= getValue(this);
	thisval = getValue(P_FSG_41_0_0_47_3);
	thisval = thisval&~(1<<2)|(bitval<<2);
	putValue(P_FSG_41_0_0_47_3,thisval);
}

on envVar P_FSG_41_0_0_47_3 // ActivePhone.AvailablePhones
{
	byte superval[4];

	//Update Childvalue (BitField)
	byte mask=0x01;
	int i = 0;
	byte thisval; // AvailablePhones
	thisval = getValue(this);
	if(thisval&(mask<<0))
		putValue(P_FSG_41_0_0_47_3_0, 1);
	else
		putValue(P_FSG_41_0_0_47_3_0, 0);
	if(thisval&(mask<<1))
		putValue(P_FSG_41_0_0_47_3_1, 1);
	else
		putValue(P_FSG_41_0_0_47_3_1, 0);
	if(thisval&(mask<<2))
		putValue(P_FSG_41_0_0_47_3_2, 1);
	else
		putValue(P_FSG_41_0_0_47_3_2, 0);

    // Update superval
	getValue(P_FSG_41_0_0_47, superval);
	superval[1]=thisval;
	putValue(P_FSG_41_0_0_47,superval);
}

// Ueberwachung der Darstellungsvariable der Range.
on envVar P_FSG_41_0_0_47_4_range // ActivePhone.Extension_1 
{
	@P_FSG_41_0_0_47_4 = @P_FSG_41_0_0_47_4_range - (0); // slider = range - min
}

on envVar P_FSG_41_0_0_47_4 // ActivePhone.Extension_1
{
	byte superval[4];

	//Update Childvalue (Number)
	byte thisval; // Extension_1
	float slider_value;

	slider_value = 0; // Konstanter Parameter.
	@P_FSG_41_0_0_47_4_range = slider_value + (0); // real value := slider value + range min.
	thisval = (byte)round((slider_value + (0) - (0)) / (1.0), 1); // bus value := (slider value + min - offset) / step.

    // Update superval
	getValue(P_FSG_41_0_0_47, superval);
	superval[2]=thisval;
	putValue(P_FSG_41_0_0_47,superval);
}

// Ueberwachung der Darstellungsvariable der Range.
on envVar P_FSG_41_0_0_47_5_range // ActivePhone.Extension_2 
{
	@P_FSG_41_0_0_47_5 = @P_FSG_41_0_0_47_5_range - (0); // slider = range - min
}

on envVar P_FSG_41_0_0_47_5 // ActivePhone.Extension_2
{
	byte superval[4];

	//Update Childvalue (Number)
	byte thisval; // Extension_2
	float slider_value;

	slider_value = 0; // Konstanter Parameter.
	@P_FSG_41_0_0_47_5_range = slider_value + (0); // real value := slider value + range min.
	thisval = (byte)round((slider_value + (0) - (0)) / (1.0), 1); // bus value := (slider value + min - offset) / step.

    // Update superval
	getValue(P_FSG_41_0_0_47, superval);
	superval[3]=thisval;
	putValue(P_FSG_41_0_0_47,superval);
}

// Ruecksetzen des Fehlerstatus durch manuelle Fehlereingabe
on envVar M_FSG_41_0_0_48_ErrCode
{
       if(gM_FSG_41_0_0_48_ErrCode) 
       {
           setControlBackColor(panel_name,"errfield_M_FSG_41_0_0_48", MakeRGB(255,255,255));
       }
       gM_FSG_41_0_0_48_ErrCode = 1;
}
on envVar M_FSG_41_0_0_48Result_BTN
{
    byte temp[2];
    if (M_FSG_41_0_0_48Result_BTN_already_pressed == 0)
    {
        putValue(M_FSG_41_0_0_48_ErrCode,0);
        SetControlBackColor(panel_name,"errField_M_FSG_41_0_0_48",MakeRGB(255,255,255));
        M_FSG_41_0_0_48Result_BTN_already_pressed = 1;
    }
    else
    {
        putValue(M_FSG_41_0_0_48_State, "Result");
        getValue(M_FSG_41_0_0_48_Result, temp);
        Request_ByteSequence(LSGID, M_FSG_41_0_0_48_ID, Result_REQ, temp, getValueSize(M_FSG_41_0_0_48_Result));
        M_FSG_41_0_0_48Result_BTN_already_pressed = 0;
    }
}
on envVar M_FSG_41_0_0_48_FctEn
{
    long data[3];
    data[0]=LSGID;
    data[1]=M_FSG_41_0_0_48_ID;
    data[2]=getValue(M_FSG_41_0_0_48_FctEn);
    ChangeConfig(0x0031,data);
}
// De-Aktivierung der Eingabefelder der FCTID M_FSG_41_0_0_48
on envVar M_FSG_41_0_0_48_FctLstItemEn
{
       if(getValue(this)) 
       {
           EnableControl(panel_name,"panel_FSG_41_0_0_48",1);
           EnableControl(panel_name,"errfield_M_FSG_41_0_0_48",1);
           EnableControl(panel_name,"panel_M_FSG_41_0_0_48",1);
           EnableControl(panel_name,"panel_M_FSG_41_0_0_48_Processing",1);
           EnableControl(panel_name,"panel_M_FSG_41_0_0_48_Start",1);
           setControlForeColor(panel_name, "checkbox_M_FSG_41_0_0_48", MakeRGB(0,240,0));
       }
       else
       {
           EnableControl(panel_name,"panel_FSG_41_0_0_48",0);
           EnableControl(panel_name,"errfield_M_FSG_41_0_0_48",0);
           EnableControl(panel_name,"panel_M_FSG_41_0_0_48",0);
           EnableControl(panel_name,"panel_M_FSG_41_0_0_48_Processing",0);
           EnableControl(panel_name,"panel_M_FSG_41_0_0_48_Start",0);
           setControlForeColor(panel_name, "checkbox_M_FSG_41_0_0_48", MakeRGB(250,0,0));
       }
}
on envVar M_FSG_41_0_0_48_Result // bus value of SelectPhone (48).
{
	// opcodes: Error-Processing-Result
	byte param1; // PhoneID
	byte param2; // SelectPhone_Result
	// DATATYPE_BYTESEQUENCE / DATATYPE_FIXEDBYTESEQUENCE
	int i;
	byte superval[2];
	int currentPos;
	currentPos = 0;
	for( i = 0; i < 2; i++ ) {
		superval[i] = 0;
	}
	getValue(M_FSG_41_0_0_48_Result, superval);
	///////// Start param1 - UINT8 /////////
	param1 = superval[currentPos++];
	putValue(M_FSG_41_0_0_48_Result_1, param1);
	///////// Start param2 - UINT8 /////////
	param2 = superval[currentPos++];
	putValue(M_FSG_41_0_0_48_Result_2, param2);
}

on envVar M_FSG_41_0_0_48_Result_1 // SelectPhone.PhoneID
{
	byte superval[2];

	//Update Childvalue (Enum)
	byte thisval; // PhoneID
	thisval = getValue(this);

    // Update superval
	getValue(M_FSG_41_0_0_48_Result, superval);
	superval[0]=thisval;
	putValue(M_FSG_41_0_0_48_Result,superval);
}

on envVar M_FSG_41_0_0_48_Result_2 // SelectPhone.SelectPhone_Result
{
	byte superval[2];

	//Update Childvalue (Enum)
	byte thisval; // SelectPhone_Result
	thisval = getValue(this);

    // Update superval
	getValue(M_FSG_41_0_0_48_Result, superval);
	superval[1]=thisval;
	putValue(M_FSG_41_0_0_48_Result,superval);
}

on envVar M_FSG_41_0_0_48_Processing // bus value of SelectPhone (48).
{
	// opcodes: Error-Processing-Result
	byte param1; // Reserve1
	byte param2; // Reserve2
	// DATATYPE_BYTESEQUENCE / DATATYPE_FIXEDBYTESEQUENCE
	int i;
	byte superval[2];
	int currentPos;
	currentPos = 0;
	for( i = 0; i < 2; i++ ) {
		superval[i] = 0;
	}
	getValue(M_FSG_41_0_0_48_Processing, superval);
	///////// Start param1 - UINT8 /////////
	param1 = superval[currentPos++];
	putValue(M_FSG_41_0_0_48_Processing_1, round((param1 * 1.0) - (0) + (0), 1.0));
	///////// Start param2 - UINT8 /////////
	param2 = superval[currentPos++];
	putValue(M_FSG_41_0_0_48_Processing_2, round((param2 * 1.0) - (0) + (0), 1.0));
}

// Ueberwachung der Darstellungsvariable der Range.
on envVar M_FSG_41_0_0_48_Processing_1_range // SelectPhone.Reserve1 
{
	@M_FSG_41_0_0_48_Processing_1 = @M_FSG_41_0_0_48_Processing_1_range - (0); // slider = range - min
}

on envVar M_FSG_41_0_0_48_Processing_1 // SelectPhone.Reserve1
{
	byte superval[2];

	//Update Childvalue (Number)
	byte thisval; // Reserve1
	float slider_value;

	slider_value = 0; // Konstanter Parameter.
	@M_FSG_41_0_0_48_Processing_1_range = slider_value + (0); // real value := slider value + range min.
	thisval = (byte)round((slider_value + (0) - (0)) / (1.0), 1); // bus value := (slider value + min - offset) / step.

    // Update superval
	getValue(M_FSG_41_0_0_48_Processing, superval);
	superval[0]=thisval;
	putValue(M_FSG_41_0_0_48_Processing,superval);
}

// Ueberwachung der Darstellungsvariable der Range.
on envVar M_FSG_41_0_0_48_Processing_2_range // SelectPhone.Reserve2 
{
	@M_FSG_41_0_0_48_Processing_2 = @M_FSG_41_0_0_48_Processing_2_range - (0); // slider = range - min
}

on envVar M_FSG_41_0_0_48_Processing_2 // SelectPhone.Reserve2
{
	byte superval[2];

	//Update Childvalue (Number)
	byte thisval; // Reserve2
	float slider_value;

	slider_value = 0; // Konstanter Parameter.
	@M_FSG_41_0_0_48_Processing_2_range = slider_value + (0); // real value := slider value + range min.
	thisval = (byte)round((slider_value + (0) - (0)) / (1.0), 1); // bus value := (slider value + min - offset) / step.

    // Update superval
	getValue(M_FSG_41_0_0_48_Processing, superval);
	superval[1]=thisval;
	putValue(M_FSG_41_0_0_48_Processing,superval);
}

on envVar M_FSG_41_0_0_48_Start // bus value of SelectPhone (48).
{
	// opcodes: AbortResult-StartResult
	byte param1; // PhoneID
	// DATATYPE_UINTXX
	param1 = getValue(M_FSG_41_0_0_48_Start);
	putValue(M_FSG_41_0_0_48_Start_1, param1);
}

on envVar M_FSG_41_0_0_48_Start_1 // SelectPhone.PhoneID
{
	byte superval;

	//Update Childvalue (Enum)
	byte thisval; // PhoneID
	thisval = getValue(this);

    // Update superval
	superval = getValue(M_FSG_41_0_0_48_Start);
	superval = thisval;
	putValue(M_FSG_41_0_0_48_Start,superval);
}

// Ruecksetzen des Fehlerstatus durch manuelle Fehlereingabe
on envVar P_FSG_41_0_0_49_ErrCode
{
       if(gP_FSG_41_0_0_49_ErrCode) 
       {
           setControlBackColor(panel_name,"errfield_P_FSG_41_0_0_49", MakeRGB(255,255,255));
       }
       gP_FSG_41_0_0_49_ErrCode = 1;
}
on envVar P_FSG_41_0_0_49Status_BTN
{
	byte BAPTemp[8];
    if (P_FSG_41_0_0_49Status_BTN_already_pressed == 0)
    {
        putValue(P_FSG_41_0_0_49_ErrCode,0);
        SetControlBackColor(panel_name,"errField_P_FSG_41_0_0_49",MakeRGB(255,255,255));
        P_FSG_41_0_0_49Status_BTN_already_pressed = 1;
    }
    else
    {
		P_FSG_41_0_0_49_BuildFct();
        getValue(P_FSG_41_0_0_49, BAPTemp);
        Request_ByteSequence(LSGID, P_FSG_41_0_0_49_ID, Data_REQ, BAPTemp, getValueSize(P_FSG_41_0_0_49));
        if(getValue(P_FSG_41_0_0_49_IntTlgEn)) //getValue(IT))
        {
           intertelegram_err(P_FSG_41_0_0_49_ID);
        }
        if(getValue(P_FSG_41_0_0_49_SegmEn))   //getvalue(SG)
        {
           sequence_err(P_FSG_41_0_0_49_ID,elCount(BAPTemp));
        }
       P_FSG_41_0_0_49Status_BTN_already_pressed = 0;
    }
}
on envVar P_FSG_41_0_0_49_FctEn
{
    long data[3];
    data[0]=LSGID;
    data[1]=P_FSG_41_0_0_49_ID;
    data[2]=getValue(P_FSG_41_0_0_49_FctEn);
    ChangeConfig(0x0031,data);
}
// De-Aktivierung der Eingabefelder der FCTID P_FSG_41_0_0_49
on envVar P_FSG_41_0_0_49_FctLstItemEn
{
       if(getValue(this)) 
       {
           EnableControl(panel_name,"panel_FSG_41_0_0_49",1);
           EnableControl(panel_name,"errfield_P_FSG_41_0_0_49",1);
           EnableControl(panel_name,"panel_P_FSG_41_0_0_49",1);
           setControlForeColor(panel_name, "checkbox_P_FSG_41_0_0_49", MakeRGB(0,240,0));
       }
       else
       {
           EnableControl(panel_name,"panel_FSG_41_0_0_49",0);
           EnableControl(panel_name,"errfield_P_FSG_41_0_0_49",0);
           EnableControl(panel_name,"panel_P_FSG_41_0_0_49",0);
           setControlForeColor(panel_name, "checkbox_P_FSG_41_0_0_49", MakeRGB(250,0,0));
       }
}
// Man darf gleichzeitig nur Checkbox fuer SegmError oder IntertelegramError aktiviert werden
on envVar P_FSG_41_0_0_49_IntTlgEn
{
       if(getValue(this)) 
       {
           putValue(P_FSG_41_0_0_49_SegmEn,0);
           intertelegram_err(P_FSG_41_0_0_49_ID);
       }
       else
       {
           intertelegram_err_off(P_FSG_41_0_0_49_ID);
       }
}
// Man darf gleichzeitig nur Checkbox fuer SegmError oder IntertelegramError aktiviert werden
on envVar P_FSG_41_0_0_49_SegmEn
{
       if(getValue(this)) 
       {
           putValue(P_FSG_41_0_0_49_IntTlgEn,0);
           sequence_err(P_FSG_41_0_0_49_ID,getValueSize(P_FSG_41_0_0_49_SegmEn));
       }
       else
       {
              sequence_err_off(P_FSG_41_0_0_49_ID);
       }
}
on envVar P_FSG_41_0_0_49 // bus value of FunctionSynchronisation (49).
{
	// opcodes: Error-Status
	byte param1[6]; // FctList_1
	byte param2; // FctList_2
	byte param3; // FctList_3
	// DATATYPE_BYTESEQUENCE / DATATYPE_FIXEDBYTESEQUENCE
	int i;
	byte superval[8];
	int currentPos;
	currentPos = 0;
	for( i = 0; i < 8; i++ ) {
		superval[i] = 0;
	}
	getValue(P_FSG_41_0_0_49, superval);
	///////// Start param1 - 6/8BSTRING /////////
	for( i = 0; i < 6; i++ )
	{
		param1[i] = superval[currentPos++];
	}
	putValue(P_FSG_41_0_0_49_1, param1);
	///////// Start param2 - UINT8 /////////
	param2 = superval[currentPos++];
	putValue(P_FSG_41_0_0_49_2, param2);
	///////// Start param3 - UINT8 /////////
	param3 = superval[currentPos++];
	putValue(P_FSG_41_0_0_49_3, param3);
}

// Updates the bus value field and other dependencies.
P_FSG_41_0_0_49_BuildFct()
{
	byte param1[6]; // FctList_1
	byte param2; // FctList_2
	byte param3; // FctList_3

	int i;
	byte superval[8];
	int currentPos;
	currentPos = 0;
// gen_BuildFunc_SetSuperVals 
	getValue(P_FSG_41_0_0_49_1, param1);
	@P_FSG_41_0_0_49_1_16 = (param1[2] & 128) > 0;
	@P_FSG_41_0_0_49_1_17 = (param1[2] & 64) > 0;
	@P_FSG_41_0_0_49_1_18 = (param1[2] & 32) > 0;
	@P_FSG_41_0_0_49_1_19 = (param1[2] & 16) > 0;
	@P_FSG_41_0_0_49_1_20 = (param1[2] & 8) > 0;
	@P_FSG_41_0_0_49_1_21 = (param1[2] & 4) > 0;
	@P_FSG_41_0_0_49_1_22 = (param1[2] & 2) > 0;
	@P_FSG_41_0_0_49_1_23 = (param1[2] & 1) > 0;
	@P_FSG_41_0_0_49_1_24 = (param1[3] & 128) > 0;
	@P_FSG_41_0_0_49_1_25 = (param1[3] & 64) > 0;
	@P_FSG_41_0_0_49_1_26 = (param1[3] & 32) > 0;
	@P_FSG_41_0_0_49_1_27 = (param1[3] & 16) > 0;
	@P_FSG_41_0_0_49_1_28 = (param1[3] & 8) > 0;
	@P_FSG_41_0_0_49_1_29 = (param1[3] & 4) > 0;
	@P_FSG_41_0_0_49_1_30 = (param1[3] & 2) > 0;
	@P_FSG_41_0_0_49_1_31 = (param1[3] & 1) > 0;
	@P_FSG_41_0_0_49_1_32 = (param1[4] & 128) > 0;
	@P_FSG_41_0_0_49_1_34 = (param1[4] & 32) > 0;
	@P_FSG_41_0_0_49_1_35 = (param1[4] & 16) > 0;
	@P_FSG_41_0_0_49_1_36 = (param1[4] & 8) > 0;
	@P_FSG_41_0_0_49_1_37 = (param1[4] & 4) > 0;
	@P_FSG_41_0_0_49_1_38 = (param1[4] & 2) > 0;
	@P_FSG_41_0_0_49_1_42 = (param1[5] & 32) > 0;
	@P_FSG_41_0_0_49_1_43 = (param1[5] & 16) > 0;
	@P_FSG_41_0_0_49_1_44 = (param1[5] & 8) > 0;
	@P_FSG_41_0_0_49_1_45 = (param1[5] & 4) > 0;
	@P_FSG_41_0_0_49_1_47 = (param1[5] & 1) > 0;
	for( i = 0; i < 6; i++)
	{
	 superval[currentPos++] = param1[i];
	}
// gen_BuildFunc_SetSuperVals 
	param2 = getValue(P_FSG_41_0_0_49_2);
	@P_FSG_41_0_0_49_2_2 = (param2 & 4) > 0;
	superval[currentPos++]=param2;
// gen_BuildFunc_SetSuperVals 
	param3 = getValue(P_FSG_41_0_0_49_3);
	superval[currentPos++]=param3;
	putValue(P_FSG_41_0_0_49, superval, currentPos);
}


on envVar P_FSG_41_0_0_49_1_16
{
	byte bitval;
	//thisval steht hier fuer den bitfield-wert, 
	//aus Generierungsgruenden hier keine einheitliche Bezeichnung moeglich.
	byte thisval[6]; // FctList_1
	bitval= getValue(this);
	getValue(P_FSG_41_0_0_49_1, thisval);
	thisval[2] = thisval[2]&~(1<<7)|(bitval<<7);
	putValue(P_FSG_41_0_0_49_1,thisval);
}

on envVar P_FSG_41_0_0_49_1_17
{
	byte bitval;
	//thisval steht hier fuer den bitfield-wert, 
	//aus Generierungsgruenden hier keine einheitliche Bezeichnung moeglich.
	byte thisval[6]; // FctList_1
	bitval= getValue(this);
	getValue(P_FSG_41_0_0_49_1, thisval);
	thisval[2] = thisval[2]&~(1<<6)|(bitval<<6);
	putValue(P_FSG_41_0_0_49_1,thisval);
}

on envVar P_FSG_41_0_0_49_1_18
{
	byte bitval;
	//thisval steht hier fuer den bitfield-wert, 
	//aus Generierungsgruenden hier keine einheitliche Bezeichnung moeglich.
	byte thisval[6]; // FctList_1
	bitval= getValue(this);
	getValue(P_FSG_41_0_0_49_1, thisval);
	thisval[2] = thisval[2]&~(1<<5)|(bitval<<5);
	putValue(P_FSG_41_0_0_49_1,thisval);
}

on envVar P_FSG_41_0_0_49_1_19
{
	byte bitval;
	//thisval steht hier fuer den bitfield-wert, 
	//aus Generierungsgruenden hier keine einheitliche Bezeichnung moeglich.
	byte thisval[6]; // FctList_1
	bitval= getValue(this);
	getValue(P_FSG_41_0_0_49_1, thisval);
	thisval[2] = thisval[2]&~(1<<4)|(bitval<<4);
	putValue(P_FSG_41_0_0_49_1,thisval);
}

on envVar P_FSG_41_0_0_49_1_20
{
	byte bitval;
	//thisval steht hier fuer den bitfield-wert, 
	//aus Generierungsgruenden hier keine einheitliche Bezeichnung moeglich.
	byte thisval[6]; // FctList_1
	bitval= getValue(this);
	getValue(P_FSG_41_0_0_49_1, thisval);
	thisval[2] = thisval[2]&~(1<<3)|(bitval<<3);
	putValue(P_FSG_41_0_0_49_1,thisval);
}

on envVar P_FSG_41_0_0_49_1_21
{
	byte bitval;
	//thisval steht hier fuer den bitfield-wert, 
	//aus Generierungsgruenden hier keine einheitliche Bezeichnung moeglich.
	byte thisval[6]; // FctList_1
	bitval= getValue(this);
	getValue(P_FSG_41_0_0_49_1, thisval);
	thisval[2] = thisval[2]&~(1<<2)|(bitval<<2);
	putValue(P_FSG_41_0_0_49_1,thisval);
}

on envVar P_FSG_41_0_0_49_1_22
{
	byte bitval;
	//thisval steht hier fuer den bitfield-wert, 
	//aus Generierungsgruenden hier keine einheitliche Bezeichnung moeglich.
	byte thisval[6]; // FctList_1
	bitval= getValue(this);
	getValue(P_FSG_41_0_0_49_1, thisval);
	thisval[2] = thisval[2]&~(1<<1)|(bitval<<1);
	putValue(P_FSG_41_0_0_49_1,thisval);
}

on envVar P_FSG_41_0_0_49_1_23
{
	byte bitval;
	//thisval steht hier fuer den bitfield-wert, 
	//aus Generierungsgruenden hier keine einheitliche Bezeichnung moeglich.
	byte thisval[6]; // FctList_1
	bitval= getValue(this);
	getValue(P_FSG_41_0_0_49_1, thisval);
	thisval[2] = thisval[2]&~(1<<0)|(bitval<<0);
	putValue(P_FSG_41_0_0_49_1,thisval);
}

on envVar P_FSG_41_0_0_49_1_24
{
	byte bitval;
	//thisval steht hier fuer den bitfield-wert, 
	//aus Generierungsgruenden hier keine einheitliche Bezeichnung moeglich.
	byte thisval[6]; // FctList_1
	bitval= getValue(this);
	getValue(P_FSG_41_0_0_49_1, thisval);
	thisval[3] = thisval[3]&~(1<<7)|(bitval<<7);
	putValue(P_FSG_41_0_0_49_1,thisval);
}

on envVar P_FSG_41_0_0_49_1_25
{
	byte bitval;
	//thisval steht hier fuer den bitfield-wert, 
	//aus Generierungsgruenden hier keine einheitliche Bezeichnung moeglich.
	byte thisval[6]; // FctList_1
	bitval= getValue(this);
	getValue(P_FSG_41_0_0_49_1, thisval);
	thisval[3] = thisval[3]&~(1<<6)|(bitval<<6);
	putValue(P_FSG_41_0_0_49_1,thisval);
}

on envVar P_FSG_41_0_0_49_1_26
{
	byte bitval;
	//thisval steht hier fuer den bitfield-wert, 
	//aus Generierungsgruenden hier keine einheitliche Bezeichnung moeglich.
	byte thisval[6]; // FctList_1
	bitval= getValue(this);
	getValue(P_FSG_41_0_0_49_1, thisval);
	thisval[3] = thisval[3]&~(1<<5)|(bitval<<5);
	putValue(P_FSG_41_0_0_49_1,thisval);
}

on envVar P_FSG_41_0_0_49_1_27
{
	byte bitval;
	//thisval steht hier fuer den bitfield-wert, 
	//aus Generierungsgruenden hier keine einheitliche Bezeichnung moeglich.
	byte thisval[6]; // FctList_1
	bitval= getValue(this);
	getValue(P_FSG_41_0_0_49_1, thisval);
	thisval[3] = thisval[3]&~(1<<4)|(bitval<<4);
	putValue(P_FSG_41_0_0_49_1,thisval);
}

on envVar P_FSG_41_0_0_49_1_28
{
	byte bitval;
	//thisval steht hier fuer den bitfield-wert, 
	//aus Generierungsgruenden hier keine einheitliche Bezeichnung moeglich.
	byte thisval[6]; // FctList_1
	bitval= getValue(this);
	getValue(P_FSG_41_0_0_49_1, thisval);
	thisval[3] = thisval[3]&~(1<<3)|(bitval<<3);
	putValue(P_FSG_41_0_0_49_1,thisval);
}

on envVar P_FSG_41_0_0_49_1_29
{
	byte bitval;
	//thisval steht hier fuer den bitfield-wert, 
	//aus Generierungsgruenden hier keine einheitliche Bezeichnung moeglich.
	byte thisval[6]; // FctList_1
	bitval= getValue(this);
	getValue(P_FSG_41_0_0_49_1, thisval);
	thisval[3] = thisval[3]&~(1<<2)|(bitval<<2);
	putValue(P_FSG_41_0_0_49_1,thisval);
}

on envVar P_FSG_41_0_0_49_1_30
{
	byte bitval;
	//thisval steht hier fuer den bitfield-wert, 
	//aus Generierungsgruenden hier keine einheitliche Bezeichnung moeglich.
	byte thisval[6]; // FctList_1
	bitval= getValue(this);
	getValue(P_FSG_41_0_0_49_1, thisval);
	thisval[3] = thisval[3]&~(1<<1)|(bitval<<1);
	putValue(P_FSG_41_0_0_49_1,thisval);
}

on envVar P_FSG_41_0_0_49_1_31
{
	byte bitval;
	//thisval steht hier fuer den bitfield-wert, 
	//aus Generierungsgruenden hier keine einheitliche Bezeichnung moeglich.
	byte thisval[6]; // FctList_1
	bitval= getValue(this);
	getValue(P_FSG_41_0_0_49_1, thisval);
	thisval[3] = thisval[3]&~(1<<0)|(bitval<<0);
	putValue(P_FSG_41_0_0_49_1,thisval);
}

on envVar P_FSG_41_0_0_49_1_32
{
	byte bitval;
	//thisval steht hier fuer den bitfield-wert, 
	//aus Generierungsgruenden hier keine einheitliche Bezeichnung moeglich.
	byte thisval[6]; // FctList_1
	bitval= getValue(this);
	getValue(P_FSG_41_0_0_49_1, thisval);
	thisval[4] = thisval[4]&~(1<<7)|(bitval<<7);
	putValue(P_FSG_41_0_0_49_1,thisval);
}

on envVar P_FSG_41_0_0_49_1_34
{
	byte bitval;
	//thisval steht hier fuer den bitfield-wert, 
	//aus Generierungsgruenden hier keine einheitliche Bezeichnung moeglich.
	byte thisval[6]; // FctList_1
	bitval= getValue(this);
	getValue(P_FSG_41_0_0_49_1, thisval);
	thisval[4] = thisval[4]&~(1<<5)|(bitval<<5);
	putValue(P_FSG_41_0_0_49_1,thisval);
}

on envVar P_FSG_41_0_0_49_1_35
{
	byte bitval;
	//thisval steht hier fuer den bitfield-wert, 
	//aus Generierungsgruenden hier keine einheitliche Bezeichnung moeglich.
	byte thisval[6]; // FctList_1
	bitval= getValue(this);
	getValue(P_FSG_41_0_0_49_1, thisval);
	thisval[4] = thisval[4]&~(1<<4)|(bitval<<4);
	putValue(P_FSG_41_0_0_49_1,thisval);
}

on envVar P_FSG_41_0_0_49_1_36
{
	byte bitval;
	//thisval steht hier fuer den bitfield-wert, 
	//aus Generierungsgruenden hier keine einheitliche Bezeichnung moeglich.
	byte thisval[6]; // FctList_1
	bitval= getValue(this);
	getValue(P_FSG_41_0_0_49_1, thisval);
	thisval[4] = thisval[4]&~(1<<3)|(bitval<<3);
	putValue(P_FSG_41_0_0_49_1,thisval);
}

on envVar P_FSG_41_0_0_49_1_37
{
	byte bitval;
	//thisval steht hier fuer den bitfield-wert, 
	//aus Generierungsgruenden hier keine einheitliche Bezeichnung moeglich.
	byte thisval[6]; // FctList_1
	bitval= getValue(this);
	getValue(P_FSG_41_0_0_49_1, thisval);
	thisval[4] = thisval[4]&~(1<<2)|(bitval<<2);
	putValue(P_FSG_41_0_0_49_1,thisval);
}

on envVar P_FSG_41_0_0_49_1_38
{
	byte bitval;
	//thisval steht hier fuer den bitfield-wert, 
	//aus Generierungsgruenden hier keine einheitliche Bezeichnung moeglich.
	byte thisval[6]; // FctList_1
	bitval= getValue(this);
	getValue(P_FSG_41_0_0_49_1, thisval);
	thisval[4] = thisval[4]&~(1<<1)|(bitval<<1);
	putValue(P_FSG_41_0_0_49_1,thisval);
}

on envVar P_FSG_41_0_0_49_1_42
{
	byte bitval;
	//thisval steht hier fuer den bitfield-wert, 
	//aus Generierungsgruenden hier keine einheitliche Bezeichnung moeglich.
	byte thisval[6]; // FctList_1
	bitval= getValue(this);
	getValue(P_FSG_41_0_0_49_1, thisval);
	thisval[5] = thisval[5]&~(1<<5)|(bitval<<5);
	putValue(P_FSG_41_0_0_49_1,thisval);
}

on envVar P_FSG_41_0_0_49_1_43
{
	byte bitval;
	//thisval steht hier fuer den bitfield-wert, 
	//aus Generierungsgruenden hier keine einheitliche Bezeichnung moeglich.
	byte thisval[6]; // FctList_1
	bitval= getValue(this);
	getValue(P_FSG_41_0_0_49_1, thisval);
	thisval[5] = thisval[5]&~(1<<4)|(bitval<<4);
	putValue(P_FSG_41_0_0_49_1,thisval);
}

on envVar P_FSG_41_0_0_49_1_44
{
	byte bitval;
	//thisval steht hier fuer den bitfield-wert, 
	//aus Generierungsgruenden hier keine einheitliche Bezeichnung moeglich.
	byte thisval[6]; // FctList_1
	bitval= getValue(this);
	getValue(P_FSG_41_0_0_49_1, thisval);
	thisval[5] = thisval[5]&~(1<<3)|(bitval<<3);
	putValue(P_FSG_41_0_0_49_1,thisval);
}

on envVar P_FSG_41_0_0_49_1_45
{
	byte bitval;
	//thisval steht hier fuer den bitfield-wert, 
	//aus Generierungsgruenden hier keine einheitliche Bezeichnung moeglich.
	byte thisval[6]; // FctList_1
	bitval= getValue(this);
	getValue(P_FSG_41_0_0_49_1, thisval);
	thisval[5] = thisval[5]&~(1<<2)|(bitval<<2);
	putValue(P_FSG_41_0_0_49_1,thisval);
}

on envVar P_FSG_41_0_0_49_1_47
{
	byte bitval;
	//thisval steht hier fuer den bitfield-wert, 
	//aus Generierungsgruenden hier keine einheitliche Bezeichnung moeglich.
	byte thisval[6]; // FctList_1
	bitval= getValue(this);
	getValue(P_FSG_41_0_0_49_1, thisval);
	thisval[5] = thisval[5]&~(1<<0)|(bitval<<0);
	putValue(P_FSG_41_0_0_49_1,thisval);
}

on envVar P_FSG_41_0_0_49_1 // FunctionSynchronisation.FctList_1
{
	P_FSG_41_0_0_49_BuildFct();
}

on envVar P_FSG_41_0_0_49_2_2
{
	byte bitval;
	//thisval steht hier fuer den bitfield-wert, 
	//aus Generierungsgruenden hier keine einheitliche Bezeichnung moeglich.
	byte thisval; // FctList_2
	bitval= getValue(this);
	thisval = getValue(P_FSG_41_0_0_49_2);
	thisval = thisval&~(1<<2)|(bitval<<2);
	putValue(P_FSG_41_0_0_49_2,thisval);
}

on envVar P_FSG_41_0_0_49_2 // FunctionSynchronisation.FctList_2
{
	P_FSG_41_0_0_49_BuildFct();
}

on envVar P_FSG_41_0_0_49_3 // FunctionSynchronisation.FctList_3
{
	P_FSG_41_0_0_49_BuildFct();
}

// Ruecksetzen des Fehlerstatus durch manuelle Fehlereingabe
on envVar P_FSG_41_0_0_50_ErrCode
{
       if(gP_FSG_41_0_0_50_ErrCode) 
       {
           setControlBackColor(panel_name,"errfield_P_FSG_41_0_0_50", MakeRGB(255,255,255));
       }
       gP_FSG_41_0_0_50_ErrCode = 1;
}
on envVar P_FSG_41_0_0_50Status_BTN
{
	byte BAPTemp[6];
   if (P_FSG_41_0_0_50Status_BTN_already_pressed == 0)
   {
      putValue(P_FSG_41_0_0_50_ErrCode,0);
      SetControlBackColor(panel_name,"errField_P_FSG_41_0_0_50",MakeRGB(255,255,255));
      P_FSG_41_0_0_50Status_BTN_already_pressed = 1;
   }
   else
   {
      getValue(P_FSG_41_0_0_50, BAPTemp);
      Request_ByteSequence(LSGID, P_FSG_41_0_0_50_ID, Data_REQ, BAPTemp, getValueSize(P_FSG_41_0_0_50));
      P_FSG_41_0_0_50Status_BTN_already_pressed = 0;
   }
}
on envVar P_FSG_41_0_0_50_FctEn
{
    long data[3];
    data[0]=LSGID;
    data[1]=P_FSG_41_0_0_50_ID;
    data[2]=getValue(P_FSG_41_0_0_50_FctEn);
    ChangeConfig(0x0031,data);
}
// De-Aktivierung der Eingabefelder der FCTID P_FSG_41_0_0_50
on envVar P_FSG_41_0_0_50_FctLstItemEn
{
       if(getValue(this)) 
       {
           EnableControl(panel_name,"panel_FSG_41_0_0_50",1);
           EnableControl(panel_name,"errfield_P_FSG_41_0_0_50",1);
           EnableControl(panel_name,"panel_P_FSG_41_0_0_50",1);
           setControlForeColor(panel_name, "checkbox_P_FSG_41_0_0_50", MakeRGB(0,240,0));
       }
       else
       {
           EnableControl(panel_name,"panel_FSG_41_0_0_50",0);
           EnableControl(panel_name,"errfield_P_FSG_41_0_0_50",0);
           EnableControl(panel_name,"panel_P_FSG_41_0_0_50",0);
           setControlForeColor(panel_name, "checkbox_P_FSG_41_0_0_50", MakeRGB(250,0,0));
       }
}
on envVar P_FSG_41_0_0_50 // bus value of ASG_Presentation (50).
{
	// opcodes: Error-Status
	byte param1; // FavoriteListType
	byte param2; // Extension_1
	byte param3; // Extension_2
	byte param4; // Extension_3
	byte param5; // Extension_4
	byte param6; // Extension_5
	byte param7; // Extension_6
	// DATATYPE_BYTESEQUENCE / DATATYPE_FIXEDBYTESEQUENCE
	int i;
	byte superval[6];
	int currentPos;
	currentPos = 0;
	for( i = 0; i < 6; i++ ) {
		superval[i] = 0;
	}
	getValue(P_FSG_41_0_0_50, superval);
	///////// Start param1 - NIBBLE /////////
	param1 = (superval[currentPos] & 0xf0)>>4;
	putValue(P_FSG_41_0_0_50_1, param1);
	///////// Start param2 - NIBBLE /////////
	param2 = superval[currentPos++] & 0x0f;
	putValue(P_FSG_41_0_0_50_2, round((param2 * 1.0) - (0) + (0), 1.0));
	///////// Start param3 - UINT8 /////////
	param3 = superval[currentPos++];
	putValue(P_FSG_41_0_0_50_3, round((param3 * 1.0) - (0) + (0), 1.0));
	///////// Start param4 - UINT8 /////////
	param4 = superval[currentPos++];
	putValue(P_FSG_41_0_0_50_4, round((param4 * 1.0) - (0) + (0), 1.0));
	///////// Start param5 - UINT8 /////////
	param5 = superval[currentPos++];
	putValue(P_FSG_41_0_0_50_5, round((param5 * 1.0) - (0) + (0), 1.0));
	///////// Start param6 - UINT8 /////////
	param6 = superval[currentPos++];
	putValue(P_FSG_41_0_0_50_6, round((param6 * 1.0) - (0) + (0), 1.0));
	///////// Start param7 - UINT8 /////////
	param7 = superval[currentPos++];
	putValue(P_FSG_41_0_0_50_7, round((param7 * 1.0) - (0) + (0), 1.0));
}

on envVar P_FSG_41_0_0_50_1 // ASG_Presentation.FavoriteListType
{
	byte superval[6];

	//Update Childvalue (Enum)
	byte thisval; // FavoriteListType
	thisval = 0x0f & getValue(this);

    // Update superval
	getValue(P_FSG_41_0_0_50, superval);
	superval[0]= superval[0]&0x0f;
	superval[0]= superval[0]|(thisval<<4);
	putValue(P_FSG_41_0_0_50,superval);
}

// Ueberwachung der Darstellungsvariable der Range.
on envVar P_FSG_41_0_0_50_2_range // ASG_Presentation.Extension_1 
{
	@P_FSG_41_0_0_50_2 = @P_FSG_41_0_0_50_2_range - (0); // slider = range - min
}

on envVar P_FSG_41_0_0_50_2 // ASG_Presentation.Extension_1
{
	byte superval[6];

	//Update Childvalue (Number)
	byte thisval; // Extension_1
	float slider_value;

	slider_value = 0; // Konstanter Parameter.
	@P_FSG_41_0_0_50_2_range = slider_value + (0); // real value := slider value + range min.
	thisval = (byte)round((slider_value + (0) - (0)) / (1.0), 1); // bus value := (slider value + min - offset) / step.

    // Update superval
	getValue(P_FSG_41_0_0_50, superval);
	superval[0]= superval[0]&0xf0;
	superval[0]= superval[0]|thisval;
	putValue(P_FSG_41_0_0_50,superval);
}

// Ueberwachung der Darstellungsvariable der Range.
on envVar P_FSG_41_0_0_50_3_range // ASG_Presentation.Extension_2 
{
	@P_FSG_41_0_0_50_3 = @P_FSG_41_0_0_50_3_range - (0); // slider = range - min
}

on envVar P_FSG_41_0_0_50_3 // ASG_Presentation.Extension_2
{
	byte superval[6];

	//Update Childvalue (Number)
	byte thisval; // Extension_2
	float slider_value;

	slider_value = 0; // Konstanter Parameter.
	@P_FSG_41_0_0_50_3_range = slider_value + (0); // real value := slider value + range min.
	thisval = (byte)round((slider_value + (0) - (0)) / (1.0), 1); // bus value := (slider value + min - offset) / step.

    // Update superval
	getValue(P_FSG_41_0_0_50, superval);
	superval[1]=thisval;
	putValue(P_FSG_41_0_0_50,superval);
}

// Ueberwachung der Darstellungsvariable der Range.
on envVar P_FSG_41_0_0_50_4_range // ASG_Presentation.Extension_3 
{
	@P_FSG_41_0_0_50_4 = @P_FSG_41_0_0_50_4_range - (0); // slider = range - min
}

on envVar P_FSG_41_0_0_50_4 // ASG_Presentation.Extension_3
{
	byte superval[6];

	//Update Childvalue (Number)
	byte thisval; // Extension_3
	float slider_value;

	slider_value = 0; // Konstanter Parameter.
	@P_FSG_41_0_0_50_4_range = slider_value + (0); // real value := slider value + range min.
	thisval = (byte)round((slider_value + (0) - (0)) / (1.0), 1); // bus value := (slider value + min - offset) / step.

    // Update superval
	getValue(P_FSG_41_0_0_50, superval);
	superval[2]=thisval;
	putValue(P_FSG_41_0_0_50,superval);
}

// Ueberwachung der Darstellungsvariable der Range.
on envVar P_FSG_41_0_0_50_5_range // ASG_Presentation.Extension_4 
{
	@P_FSG_41_0_0_50_5 = @P_FSG_41_0_0_50_5_range - (0); // slider = range - min
}

on envVar P_FSG_41_0_0_50_5 // ASG_Presentation.Extension_4
{
	byte superval[6];

	//Update Childvalue (Number)
	byte thisval; // Extension_4
	float slider_value;

	slider_value = 0; // Konstanter Parameter.
	@P_FSG_41_0_0_50_5_range = slider_value + (0); // real value := slider value + range min.
	thisval = (byte)round((slider_value + (0) - (0)) / (1.0), 1); // bus value := (slider value + min - offset) / step.

    // Update superval
	getValue(P_FSG_41_0_0_50, superval);
	superval[3]=thisval;
	putValue(P_FSG_41_0_0_50,superval);
}

// Ueberwachung der Darstellungsvariable der Range.
on envVar P_FSG_41_0_0_50_6_range // ASG_Presentation.Extension_5 
{
	@P_FSG_41_0_0_50_6 = @P_FSG_41_0_0_50_6_range - (0); // slider = range - min
}

on envVar P_FSG_41_0_0_50_6 // ASG_Presentation.Extension_5
{
	byte superval[6];

	//Update Childvalue (Number)
	byte thisval; // Extension_5
	float slider_value;

	slider_value = 0; // Konstanter Parameter.
	@P_FSG_41_0_0_50_6_range = slider_value + (0); // real value := slider value + range min.
	thisval = (byte)round((slider_value + (0) - (0)) / (1.0), 1); // bus value := (slider value + min - offset) / step.

    // Update superval
	getValue(P_FSG_41_0_0_50, superval);
	superval[4]=thisval;
	putValue(P_FSG_41_0_0_50,superval);
}

// Ueberwachung der Darstellungsvariable der Range.
on envVar P_FSG_41_0_0_50_7_range // ASG_Presentation.Extension_6 
{
	@P_FSG_41_0_0_50_7 = @P_FSG_41_0_0_50_7_range - (0); // slider = range - min
}

on envVar P_FSG_41_0_0_50_7 // ASG_Presentation.Extension_6
{
	byte superval[6];

	//Update Childvalue (Number)
	byte thisval; // Extension_6
	float slider_value;

	slider_value = 0; // Konstanter Parameter.
	@P_FSG_41_0_0_50_7_range = slider_value + (0); // real value := slider value + range min.
	thisval = (byte)round((slider_value + (0) - (0)) / (1.0), 1); // bus value := (slider value + min - offset) / step.

    // Update superval
	getValue(P_FSG_41_0_0_50, superval);
	superval[5]=thisval;
	putValue(P_FSG_41_0_0_50,superval);
}

// Ruecksetzen des Fehlerstatus durch manuelle Fehlereingabe
on envVar A_FSG_41_0_0_51_ErrCode
{
       if(gA_FSG_41_0_0_51_ErrCode) 
       {
           setControlBackColor(panel_name,"errfield_A_FSG_41_0_0_51", MakeRGB(255,255,255));
       }
       gA_FSG_41_0_0_51_ErrCode = 1;
}
on envVar A_FSG_41_0_0_51Changed_BTN
{
    byte data[1880]; 
    byte stringValue[1880];
    byte head[5];
    int i;
    int headLength;
    long tempValue;
    word currentPos;
    word startVal;
    word elementsVal;
  byte nibbleSetted;
    if (A_FSG_41_0_0_51Changed_BTN_already_pressed == 0)
    {
        putValue(A_FSG_41_0_0_51_ErrCode,0);
        SetControlBackColor(panel_name,"errField_A_FSG_41_0_0_51",MakeRGB(255,255,255));
        A_FSG_41_0_0_51Changed_BTN_already_pressed = 1;
    }
    else 
    {
        currentPos = 0;
        //head Parameter
        headLength = getValueSize(A_FSG_41_0_0_51_Changed);
        getValue(A_FSG_41_0_0_51_Changed,head);
        for(i=0; i< headLength; i++)
        {
            data[currentPos++] = head[i];
        }
    //data Parameter
     startVal = getValue(A_FSG_41_0_0_51_Changed_Start);
     elementsVal = getValue(A_FSG_41_0_0_51_Changed_Elements);
     nibbleSetted = 0;
    if( (head[0]&0x20) == 0)
    {
     if( (head[0] & 0x10) > 0)
     {
        startVal++;
     }
     for( i = startVal ; i < startVal + elementsVal ; i++)
     {
       if( i < 0 || i >= A_FSG_41_0_0_51_ArrayDataList_Length )
       {
         write("Array index ausserhalb der Grenzen, Fct: 51");
         break;
       }
      if(nibbleSetted == 1) currentPos++;
      nibbleSetted = 0;
    //sollte der letzte Parameter ein first nibble gewesen sein, muss noch 1 increment durchgefuehrt werden
    if( nibbleSetted==1) currentPos++;
    nibbleSetted = 0;
     }
    }
    else
    {
     if( (head[0] & 0x10) > 0)
     {
        if(startVal != 0) startVal--;
        else
        {
           startVal = A_FSG_41_0_0_51_ArrayDataList_Length -1;
        }
     }
     for( i = startVal ; i > startVal - elementsVal ; i--)
     {
       if( i < 0 || i >= A_FSG_41_0_0_51_ArrayDataList_Length )
       {
         write("Array index ausserhalb der Grenzen, Fct: 51");
         break;
       }
      if(nibbleSetted == 1) currentPos++;
      nibbleSetted = 0;
    //sollte der letzte Parameter ein first nibble gewesen sein, muss noch 1 increment durchgefuehrt werden
    if( nibbleSetted==1) currentPos++;
    nibbleSetted = 0;
     }
    }

       Request_ByteSequence(LSGID, A_FSG_41_0_0_51_ID, Changed_REQ, data, currentPos);
       if(getValue(A_FSG_41_0_0_51_IntTlgEn)) //getValue(IT))
       {
           intertelegram_err(A_FSG_41_0_0_51_ID);
       }
       if(getValue(A_FSG_41_0_0_51_SegmEn))   //getvalue(SG)
       {
             sequence_err(A_FSG_41_0_0_51_ID,getValueSize(A_FSG_41_0_0_51_Changed));
       }
        A_FSG_41_0_0_51Changed_BTN_already_pressed = 0;
    }
}
on envVar A_FSG_41_0_0_51Status_BTN
{
    byte data[1880 + 5]; // array header (3 or 5 bytes), followed by payload.
    byte stringValue[1880];
    byte head[5];
    int i = 0;
    int j = 0;
    long StringLength = 0;
    int headLength;
    long tempValue;
    word currentPos;

    word startVal;
    word elementsVal;
    byte nibbleSetted;
    if (A_FSG_41_0_0_51Status_BTN_already_pressed == 0)
    {
        putValue(A_FSG_41_0_0_51_ErrCode,0);
        SetControlBackColor(panel_name,"errField_A_FSG_41_0_0_51",MakeRGB(255,255,255));
        A_FSG_41_0_0_51Status_BTN_already_pressed = 1;
    }
    else
    {
        currentPos = 0;
        //Einzelparameter: ASG_ID
        tempValue = getValue(A_FSG_41_0_0_51_1);
    if(nibbleSetted == 1)
    {
        //voriger Parameter war ein Nibble, => second nibble, Pos incr und Flag zuruecksetzen
        data[currentPos] = (tempValue &0x0F) | (data[currentPos] &0xF0);
        currentPos++;
        nibbleSetted = 0;
    }
    else
    {
        //first nibble, kein increment, Flag setzen
        data[currentPos] = (tempValue<<4) &0xF0;
        nibbleSetted = 1;
    }
        //Einzelparameter: TAID
        tempValue = getValue(A_FSG_41_0_0_51_2);
    if(nibbleSetted == 1)
    {
        //voriger Parameter war ein Nibble, => second nibble, Pos incr und Flag zuruecksetzen
        data[currentPos] = (tempValue &0x0F) | (data[currentPos] &0xF0);
        currentPos++;
        nibbleSetted = 0;
    }
    else
    {
        //first nibble, kein increment, Flag setzen
        data[currentPos] = (tempValue<<4) &0xF0;
        nibbleSetted = 1;
    }
        //Einzelparameter: TotalNumListElements
        tempValue = getValue(A_FSG_41_0_0_51_3);
        //voriger Parameter war ein first nibble, bei 1 Byte Werten Position incr
        if(nibbleSetted == 1) currentPos++;
        nibbleSetted = 0;
        data[currentPos++] = tempValue;
        //head Parameter
        headLength = getValueSize(A_FSG_41_0_0_51);
        getValue(A_FSG_41_0_0_51,head);
        for(i=0; i< headLength; i++)
        {
            data[currentPos++] = head[i];
        }
    //data Parameter
     startVal = getValue(A_FSG_41_0_0_51_Start);
     elementsVal = getValue(A_FSG_41_0_0_51_Elements);
     nibbleSetted = 0;
    if( (head[0]&0x20) == 0)
    {
     if( (head[0] & 0x10) > 0)
     {
        startVal++;
     }
     for( i = startVal ; i < startVal + elementsVal ; i++)
     {
       if( i < 0 || i >= A_FSG_41_0_0_51_ArrayDataList_Length )
       {
         write("Array index ausserhalb der Grenzen, Fct: 51");
         break;
       }
      if(nibbleSetted == 1) currentPos++;
      nibbleSetted = 0;
     if( (head[0]&0x40) == 0){ /* Transmit_Pos = 0, keine Positionsdaten */ }
     else
     {
        if( (head[0]&0x80) == 0)
        {
           //IndexSize = 0, Pos als 1 Byte Wert
           data[currentPos++] = A_FSG_41_0_0_51_ArrayDataList[i].Param1 & 0xFF;
        }
        else
        {
           //IndexSize = 1, Pos als 2 Byte Wert
           data[currentPos++] = A_FSG_41_0_0_51_ArrayDataList[i].Param1 & 0xFF;
           data[currentPos++] = (A_FSG_41_0_0_51_ArrayDataList[i].Param1 >> 8) & 0xFF;
        }
     }
      // Check if the current value of RecAdr enables the variable InstanceID:
      if( 0 || 1 == getValue( A_FSG_41_0_0_51_RecAdr ) || 3 == getValue( A_FSG_41_0_0_51_RecAdr ) )
      {
        //Sollte vor einem 1 Byte Wert 1 Nibble kommen, muss der index um 1 incrementiert werden!
        if( nibbleSetted==1) currentPos++;
        nibbleSetted = 0;
        data[currentPos++] = (A_FSG_41_0_0_51_ArrayDataList[i].Param2 ) & 0xFF;
       }
      // Check if the current value of RecAdr enables the variable CallID:
      if( 0 || 1 == getValue( A_FSG_41_0_0_51_RecAdr ) || 2 == getValue( A_FSG_41_0_0_51_RecAdr ) || 3 == getValue( A_FSG_41_0_0_51_RecAdr ) )
      {
        //Sollte vor einem 1 Byte Wert 1 Nibble kommen, muss der index um 1 incrementiert werden!
        if( nibbleSetted==1) currentPos++;
        nibbleSetted = 0;
        data[currentPos++] = (A_FSG_41_0_0_51_ArrayDataList[i].Param3 ) & 0xFF;
       }
      // Check if the current value of RecAdr enables the variable PictureType:
      if( 0 || 1 == getValue( A_FSG_41_0_0_51_RecAdr ) || 2 == getValue( A_FSG_41_0_0_51_RecAdr ) || 3 == getValue( A_FSG_41_0_0_51_RecAdr ) )
      {
        //Sollte vor einem 1 Byte Wert 1 Nibble kommen, muss der index um 1 incrementiert werden!
        if( nibbleSetted==1) currentPos++;
        nibbleSetted = 0;
        data[currentPos++] = (A_FSG_41_0_0_51_ArrayDataList[i].Param4 ) & 0xFF;
       }
      // Check if the current value of RecAdr enables the variable IPv6_Address:
      if( 0 || 1 == getValue( A_FSG_41_0_0_51_RecAdr ) || 2 == getValue( A_FSG_41_0_0_51_RecAdr ) )
      {
        //Sollte vor einem String Wert 1 Nibble kommen, muss der index um 1 incrementiert werden!
        if( nibbleSetted==1) currentPos++;
        nibbleSetted = 0;
        StringLength =A_FSG_41_0_0_51_ArrayDataList[i].Param5_Length;
		/* Pruefung ob die Laenge-Checkbox aktiv ist */
		if (1 == A_FSG_41_0_0_51_Data_5_CntList[i] )
		{
			if(StringLength >= 0 && StringLength <= 32767 && StringLength <= 17-2)
			{
				data[currentPos++] = ( (StringLength >> 8) & 0x7F ) | 0x80; //2Byte Flag (Bit 8) setzen + HighByte (erste 7 bit)
				data[currentPos++] = StringLength &0xFF;
			}
			else
			{
				writelineEx(gBAP_Trace, 0, "Eingegebene Laenge: %d von A_FSG_41_0_0_51_Data_5 mit Record Nr. %d ist ungueltig. Die max. erlaubte Laenge ist %d.", StringLength, i, 17-2);
				return;
			}
		}
		else if(0 == A_FSG_41_0_0_51_Data_5_CntList[i] ) /*check box deaktiviert*/
		{
			if(StringLength >= 0 && StringLength <= 127 && StringLength <= 17-1)
			{
				data[currentPos++] = StringLength & 0x7F; //Bit 8 = 0
			}
			else
			{
				writelineEx(gBAP_Trace, 0, "Eingegebene Laenge: %d von A_FSG_41_0_0_51_Data_5 mit Record Nr. %d ist ungueltig. Die max. erlaubte Laenge ist %d. ", StringLength, i, 17-1);
				return;
			}
		}
        for(j=0; j < StringLength ; j++)
        {
            data[currentPos++] = A_FSG_41_0_0_51_ArrayDataList[i].Param5[j];
        }
       }
      // Check if the current value of RecAdr enables the variable TCP_Port:
      if( 0 || 1 == getValue( A_FSG_41_0_0_51_RecAdr ) || 2 == getValue( A_FSG_41_0_0_51_RecAdr ) )
      {
        //Sollte vor einem 2 Byte Wert 1 Nibble kommen, muss der index um 1 incrementiert werden!
        if( nibbleSetted==1) currentPos++;
        nibbleSetted = 0;
        data[currentPos++] = (A_FSG_41_0_0_51_ArrayDataList[i].Param6     ) & 0xFF;
        data[currentPos++] = (A_FSG_41_0_0_51_ArrayDataList[i].Param6 >> 8) & 0xFF;
       }
      // Check if the current value of RecAdr enables the variable URI:
      if( 0 || 1 == getValue( A_FSG_41_0_0_51_RecAdr ) || 2 == getValue( A_FSG_41_0_0_51_RecAdr ) || 3 == getValue( A_FSG_41_0_0_51_RecAdr ) )
      {
        //Sollte vor einem String Wert 1 Nibble kommen, muss der index um 1 incrementiert werden!
        if( nibbleSetted==1) currentPos++;
        nibbleSetted = 0;
        StringLength =A_FSG_41_0_0_51_ArrayDataList[i].Param7_Length;
		/* Pruefung ob die Laenge-Checkbox aktiv ist */
		if (1 == A_FSG_41_0_0_51_Data_7_CntList[i] )
		{
			if(StringLength >= 0 && StringLength <= 32767 && StringLength <= 602-2)
			{
				data[currentPos++] = ( (StringLength >> 8) & 0x7F ) | 0x80; //2Byte Flag (Bit 8) setzen + HighByte (erste 7 bit)
				data[currentPos++] = StringLength &0xFF;
			}
			else
			{
				writelineEx(gBAP_Trace, 0, "Eingegebene Laenge: %d von A_FSG_41_0_0_51_Data_7 mit Record Nr. %d ist ungueltig. Die max. erlaubte Laenge ist %d.", StringLength, i, 602-2);
				return;
			}
		}
		else if(0 == A_FSG_41_0_0_51_Data_7_CntList[i] ) /*check box deaktiviert*/
		{
			if(StringLength >= 0 && StringLength <= 127 && StringLength <= 602-1)
			{
				data[currentPos++] = StringLength & 0x7F; //Bit 8 = 0
			}
			else
			{
				writelineEx(gBAP_Trace, 0, "Eingegebene Laenge: %d von A_FSG_41_0_0_51_Data_7 mit Record Nr. %d ist ungueltig. Die max. erlaubte Laenge ist %d. ", StringLength, i, 602-1);
				return;
			}
		}
        for(j=0; j < StringLength ; j++)
        {
            data[currentPos++] = A_FSG_41_0_0_51_ArrayDataList[i].Param7[j];
        }
       }
    //sollte der letzte Parameter ein first nibble gewesen sein, muss noch 1 increment durchgefuehrt werden
    if( nibbleSetted==1) currentPos++;
    nibbleSetted = 0;
     }
    }
    else
    {
     if( (head[0] & 0x10) > 0)
     {
        if(startVal != 0) startVal--;
        else
        {
           startVal = A_FSG_41_0_0_51_ArrayDataList_Length -1;
        }
     }
     for( i = startVal ; i > startVal - elementsVal ; i--)
     {
       if( i < 0 || i >= A_FSG_41_0_0_51_ArrayDataList_Length )
       {
         write("Array index ausserhalb der Grenzen, Fct: 51");
         break;
       }
      if(nibbleSetted == 1) currentPos++;
      nibbleSetted = 0;
     if( (head[0]&0x40) == 0){ /* Transmit_Pos = 0, keine Positionsdaten */ }
     else
     {
        if( (head[0]&0x80) == 0)
        {
           //IndexSize = 0, Pos als 1 Byte Wert
           data[currentPos++] = A_FSG_41_0_0_51_ArrayDataList[i].Param1 & 0xFF;
        }
        else
        {
           //IndexSize = 1, Pos als 2 Byte Wert
           data[currentPos++] = A_FSG_41_0_0_51_ArrayDataList[i].Param1 & 0xFF;
           data[currentPos++] = (A_FSG_41_0_0_51_ArrayDataList[i].Param1 >> 8) & 0xFF;
        }
     }
      // Check if the current value of RecAdr enables the variable InstanceID:
      if( 0 || 1 == getValue( A_FSG_41_0_0_51_RecAdr ) || 3 == getValue( A_FSG_41_0_0_51_RecAdr ) )
      {
        //Sollte vor einem 1 Byte Wert 1 Nibble kommen, muss der index um 1 incrementiert werden!
        if( nibbleSetted==1) currentPos++;
        nibbleSetted = 0;
        data[currentPos++] = (A_FSG_41_0_0_51_ArrayDataList[i].Param2 ) & 0xFF;
       }
      // Check if the current value of RecAdr enables the variable CallID:
      if( 0 || 1 == getValue( A_FSG_41_0_0_51_RecAdr ) || 2 == getValue( A_FSG_41_0_0_51_RecAdr ) || 3 == getValue( A_FSG_41_0_0_51_RecAdr ) )
      {
        //Sollte vor einem 1 Byte Wert 1 Nibble kommen, muss der index um 1 incrementiert werden!
        if( nibbleSetted==1) currentPos++;
        nibbleSetted = 0;
        data[currentPos++] = (A_FSG_41_0_0_51_ArrayDataList[i].Param3 ) & 0xFF;
       }
      // Check if the current value of RecAdr enables the variable PictureType:
      if( 0 || 1 == getValue( A_FSG_41_0_0_51_RecAdr ) || 2 == getValue( A_FSG_41_0_0_51_RecAdr ) || 3 == getValue( A_FSG_41_0_0_51_RecAdr ) )
      {
        //Sollte vor einem 1 Byte Wert 1 Nibble kommen, muss der index um 1 incrementiert werden!
        if( nibbleSetted==1) currentPos++;
        nibbleSetted = 0;
        data[currentPos++] = (A_FSG_41_0_0_51_ArrayDataList[i].Param4 ) & 0xFF;
       }
      // Check if the current value of RecAdr enables the variable IPv6_Address:
      if( 0 || 1 == getValue( A_FSG_41_0_0_51_RecAdr ) || 2 == getValue( A_FSG_41_0_0_51_RecAdr ) )
      {
        //Sollte vor einem String Wert 1 Nibble kommen, muss der index um 1 incrementiert werden!
        if( nibbleSetted==1) currentPos++;
        nibbleSetted = 0;
        StringLength =A_FSG_41_0_0_51_ArrayDataList[i].Param5_Length;
		/* Pruefung ob die Laenge-Checkbox aktiv ist */
		if (1 == A_FSG_41_0_0_51_Data_5_CntList[i] )
		{
			if(StringLength >= 0 && StringLength <= 32767 && StringLength <= 17-2)
			{
				data[currentPos++] = ( (StringLength >> 8) & 0x7F ) | 0x80; //2Byte Flag (Bit 8) setzen + HighByte (erste 7 bit)
				data[currentPos++] = StringLength &0xFF;
			}
			else
			{
				writelineEx(gBAP_Trace, 0, "Eingegebene Laenge: %d von A_FSG_41_0_0_51_Data_5 mit Record Nr. %d ist ungueltig. Die max. erlaubte Laenge ist %d.", StringLength, i, 17-2);
				return;
			}
		}
		else if(0 == A_FSG_41_0_0_51_Data_5_CntList[i] ) /*check box deaktiviert*/
		{
			if(StringLength >= 0 && StringLength <= 127 && StringLength <= 17-1)
			{
				data[currentPos++] = StringLength & 0x7F; //Bit 8 = 0
			}
			else
			{
				writelineEx(gBAP_Trace, 0, "Eingegebene Laenge: %d von A_FSG_41_0_0_51_Data_5 mit Record Nr. %d ist ungueltig. Die max. erlaubte Laenge ist %d. ", StringLength, i, 17-1);
				return;
			}
		}
        for(j=0; j < StringLength ; j++)
        {
            data[currentPos++] = A_FSG_41_0_0_51_ArrayDataList[i].Param5[j];
        }
       }
      // Check if the current value of RecAdr enables the variable TCP_Port:
      if( 0 || 1 == getValue( A_FSG_41_0_0_51_RecAdr ) || 2 == getValue( A_FSG_41_0_0_51_RecAdr ) )
      {
        //Sollte vor einem 2 Byte Wert 1 Nibble kommen, muss der index um 1 incrementiert werden!
        if( nibbleSetted==1) currentPos++;
        nibbleSetted = 0;
        data[currentPos++] = (A_FSG_41_0_0_51_ArrayDataList[i].Param6     ) & 0xFF;
        data[currentPos++] = (A_FSG_41_0_0_51_ArrayDataList[i].Param6 >> 8) & 0xFF;
       }
      // Check if the current value of RecAdr enables the variable URI:
      if( 0 || 1 == getValue( A_FSG_41_0_0_51_RecAdr ) || 2 == getValue( A_FSG_41_0_0_51_RecAdr ) || 3 == getValue( A_FSG_41_0_0_51_RecAdr ) )
      {
        //Sollte vor einem String Wert 1 Nibble kommen, muss der index um 1 incrementiert werden!
        if( nibbleSetted==1) currentPos++;
        nibbleSetted = 0;
        StringLength =A_FSG_41_0_0_51_ArrayDataList[i].Param7_Length;
		/* Pruefung ob die Laenge-Checkbox aktiv ist */
		if (1 == A_FSG_41_0_0_51_Data_7_CntList[i] )
		{
			if(StringLength >= 0 && StringLength <= 32767 && StringLength <= 602-2)
			{
				data[currentPos++] = ( (StringLength >> 8) & 0x7F ) | 0x80; //2Byte Flag (Bit 8) setzen + HighByte (erste 7 bit)
				data[currentPos++] = StringLength &0xFF;
			}
			else
			{
				writelineEx(gBAP_Trace, 0, "Eingegebene Laenge: %d von A_FSG_41_0_0_51_Data_7 mit Record Nr. %d ist ungueltig. Die max. erlaubte Laenge ist %d.", StringLength, i, 602-2);
				return;
			}
		}
		else if(0 == A_FSG_41_0_0_51_Data_7_CntList[i] ) /*check box deaktiviert*/
		{
			if(StringLength >= 0 && StringLength <= 127 && StringLength <= 602-1)
			{
				data[currentPos++] = StringLength & 0x7F; //Bit 8 = 0
			}
			else
			{
				writelineEx(gBAP_Trace, 0, "Eingegebene Laenge: %d von A_FSG_41_0_0_51_Data_7 mit Record Nr. %d ist ungueltig. Die max. erlaubte Laenge ist %d. ", StringLength, i, 602-1);
				return;
			}
		}
        for(j=0; j < StringLength ; j++)
        {
            data[currentPos++] = A_FSG_41_0_0_51_ArrayDataList[i].Param7[j];
        }
       }
    //sollte der letzte Parameter ein first nibble gewesen sein, muss noch 1 increment durchgefuehrt werden
    if( nibbleSetted==1) currentPos++;
    nibbleSetted = 0;
     }
    }

        //getValue(A_FSG_41_0_0_51, data);
        Request_ByteSequence(LSGID, A_FSG_41_0_0_51_ID, Data_REQ, data,currentPos);
        if(getValue(A_FSG_41_0_0_51_IntTlgEn)) //getValue(IT))
        {
            intertelegram_err(A_FSG_41_0_0_51_ID);
        }
        if(getValue(A_FSG_41_0_0_51_SegmEn))   //getvalue(SG)
        {
            sequence_err(A_FSG_41_0_0_51_ID,getValueSize(A_FSG_41_0_0_51));
        }
        A_FSG_41_0_0_51Status_BTN_already_pressed = 0;
    }
}
A_FSG_41_0_0_51_SendStatus()
{
    word currentPos;
    word headLength;
    int i;
    int j;
    word StringLength;
    long tempValue;
    word startVal;
    word elementsVal;
    byte data[1880];
    byte stringValue[1880];
    byte head[5];
    byte nibbleSetted;
    nibbleSetted = 0;
        currentPos = 0;
        //Einzelparameter: ASG_ID
        tempValue = getValue(A_FSG_41_0_0_51_1);
    if(nibbleSetted == 1)
    {
        //voriger Parameter war ein Nibble, => second nibble, Pos incr und Flag zuruecksetzen
        data[currentPos] = (tempValue &0x0F) | (data[currentPos] &0xF0);
        currentPos++;
        nibbleSetted = 0;
    }
    else
    {
        //first nibble, kein increment, Flag setzen
        data[currentPos] = (tempValue<<4) &0xF0;
        nibbleSetted = 1;
    }
        //Einzelparameter: TAID
        tempValue = getValue(A_FSG_41_0_0_51_2);
    if(nibbleSetted == 1)
    {
        //voriger Parameter war ein Nibble, => second nibble, Pos incr und Flag zuruecksetzen
        data[currentPos] = (tempValue &0x0F) | (data[currentPos] &0xF0);
        currentPos++;
        nibbleSetted = 0;
    }
    else
    {
        //first nibble, kein increment, Flag setzen
        data[currentPos] = (tempValue<<4) &0xF0;
        nibbleSetted = 1;
    }
        //Einzelparameter: TotalNumListElements
        tempValue = getValue(A_FSG_41_0_0_51_3);
        //voriger Parameter war ein first nibble, bei 1 Byte Werten Position incr
        if(nibbleSetted == 1) currentPos++;
        nibbleSetted = 0;
        data[currentPos++] = tempValue;
        //head Parameter
        headLength = getValueSize(A_FSG_41_0_0_51);
        getValue(A_FSG_41_0_0_51,head);
        for(i=0; i< headLength; i++)
        {
            data[currentPos++] = head[i];
        }
    //data Parameter
     startVal = getValue(A_FSG_41_0_0_51_Start);
     elementsVal = getValue(A_FSG_41_0_0_51_Elements);
     nibbleSetted = 0;
    if( (head[0]&0x20) == 0)
    {
     if( (head[0] & 0x10) > 0)
     {
        startVal++;
     }
     for( i = startVal ; i < startVal + elementsVal ; i++)
     {
       if( i < 0 || i >= A_FSG_41_0_0_51_ArrayDataList_Length )
       {
         write("Array index ausserhalb der Grenzen, Fct: 51");
         break;
       }
      if(nibbleSetted == 1) currentPos++;
      nibbleSetted = 0;
     if( (head[0]&0x40) == 0){ /* Transmit_Pos = 0, keine Positionsdaten */ }
     else
     {
        if( (head[0]&0x80) == 0)
        {
           //IndexSize = 0, Pos als 1 Byte Wert
           data[currentPos++] = A_FSG_41_0_0_51_ArrayDataList[i].Param1 & 0xFF;
        }
        else
        {
           //IndexSize = 1, Pos als 2 Byte Wert
           data[currentPos++] = A_FSG_41_0_0_51_ArrayDataList[i].Param1 & 0xFF;
           data[currentPos++] = (A_FSG_41_0_0_51_ArrayDataList[i].Param1 >> 8) & 0xFF;
        }
     }
      // Check if the current value of RecAdr enables the variable InstanceID:
      if( 0 || 1 == getValue( A_FSG_41_0_0_51_RecAdr ) || 3 == getValue( A_FSG_41_0_0_51_RecAdr ) )
      {
        //Sollte vor einem 1 Byte Wert 1 Nibble kommen, muss der index um 1 incrementiert werden!
        if( nibbleSetted==1) currentPos++;
        nibbleSetted = 0;
        data[currentPos++] = (A_FSG_41_0_0_51_ArrayDataList[i].Param2 ) & 0xFF;
       }
      // Check if the current value of RecAdr enables the variable CallID:
      if( 0 || 1 == getValue( A_FSG_41_0_0_51_RecAdr ) || 2 == getValue( A_FSG_41_0_0_51_RecAdr ) || 3 == getValue( A_FSG_41_0_0_51_RecAdr ) )
      {
        //Sollte vor einem 1 Byte Wert 1 Nibble kommen, muss der index um 1 incrementiert werden!
        if( nibbleSetted==1) currentPos++;
        nibbleSetted = 0;
        data[currentPos++] = (A_FSG_41_0_0_51_ArrayDataList[i].Param3 ) & 0xFF;
       }
      // Check if the current value of RecAdr enables the variable PictureType:
      if( 0 || 1 == getValue( A_FSG_41_0_0_51_RecAdr ) || 2 == getValue( A_FSG_41_0_0_51_RecAdr ) || 3 == getValue( A_FSG_41_0_0_51_RecAdr ) )
      {
        //Sollte vor einem 1 Byte Wert 1 Nibble kommen, muss der index um 1 incrementiert werden!
        if( nibbleSetted==1) currentPos++;
        nibbleSetted = 0;
        data[currentPos++] = (A_FSG_41_0_0_51_ArrayDataList[i].Param4 ) & 0xFF;
       }
      // Check if the current value of RecAdr enables the variable IPv6_Address:
      if( 0 || 1 == getValue( A_FSG_41_0_0_51_RecAdr ) || 2 == getValue( A_FSG_41_0_0_51_RecAdr ) )
      {
        //Sollte vor einem String Wert 1 Nibble kommen, muss der index um 1 incrementiert werden!
        if( nibbleSetted==1) currentPos++;
        nibbleSetted = 0;
        StringLength =A_FSG_41_0_0_51_ArrayDataList[i].Param5_Length;
		/* Pruefung ob die Laenge-Checkbox aktiv ist */
		if (1 == A_FSG_41_0_0_51_Data_5_CntList[i] )
		{
			if(StringLength >= 0 && StringLength <= 32767 && StringLength <= 17-2)
			{
				data[currentPos++] = ( (StringLength >> 8) & 0x7F ) | 0x80; //2Byte Flag (Bit 8) setzen + HighByte (erste 7 bit)
				data[currentPos++] = StringLength &0xFF;
			}
			else
			{
				writelineEx(gBAP_Trace, 0, "Eingegebene Laenge: %d von A_FSG_41_0_0_51_Data_5 mit Record Nr. %d ist ungueltig. Die max. erlaubte Laenge ist %d.", StringLength, i, 17-2);
				return;
			}
		}
		else if(0 == A_FSG_41_0_0_51_Data_5_CntList[i] ) /*check box deaktiviert*/
		{
			if(StringLength >= 0 && StringLength <= 127 && StringLength <= 17-1)
			{
				data[currentPos++] = StringLength & 0x7F; //Bit 8 = 0
			}
			else
			{
				writelineEx(gBAP_Trace, 0, "Eingegebene Laenge: %d von A_FSG_41_0_0_51_Data_5 mit Record Nr. %d ist ungueltig. Die max. erlaubte Laenge ist %d. ", StringLength, i, 17-1);
				return;
			}
		}
        for(j=0; j < StringLength ; j++)
        {
            data[currentPos++] = A_FSG_41_0_0_51_ArrayDataList[i].Param5[j];
        }
       }
      // Check if the current value of RecAdr enables the variable TCP_Port:
      if( 0 || 1 == getValue( A_FSG_41_0_0_51_RecAdr ) || 2 == getValue( A_FSG_41_0_0_51_RecAdr ) )
      {
        //Sollte vor einem 2 Byte Wert 1 Nibble kommen, muss der index um 1 incrementiert werden!
        if( nibbleSetted==1) currentPos++;
        nibbleSetted = 0;
        data[currentPos++] = (A_FSG_41_0_0_51_ArrayDataList[i].Param6     ) & 0xFF;
        data[currentPos++] = (A_FSG_41_0_0_51_ArrayDataList[i].Param6 >> 8) & 0xFF;
       }
      // Check if the current value of RecAdr enables the variable URI:
      if( 0 || 1 == getValue( A_FSG_41_0_0_51_RecAdr ) || 2 == getValue( A_FSG_41_0_0_51_RecAdr ) || 3 == getValue( A_FSG_41_0_0_51_RecAdr ) )
      {
        //Sollte vor einem String Wert 1 Nibble kommen, muss der index um 1 incrementiert werden!
        if( nibbleSetted==1) currentPos++;
        nibbleSetted = 0;
        StringLength =A_FSG_41_0_0_51_ArrayDataList[i].Param7_Length;
		/* Pruefung ob die Laenge-Checkbox aktiv ist */
		if (1 == A_FSG_41_0_0_51_Data_7_CntList[i] )
		{
			if(StringLength >= 0 && StringLength <= 32767 && StringLength <= 602-2)
			{
				data[currentPos++] = ( (StringLength >> 8) & 0x7F ) | 0x80; //2Byte Flag (Bit 8) setzen + HighByte (erste 7 bit)
				data[currentPos++] = StringLength &0xFF;
			}
			else
			{
				writelineEx(gBAP_Trace, 0, "Eingegebene Laenge: %d von A_FSG_41_0_0_51_Data_7 mit Record Nr. %d ist ungueltig. Die max. erlaubte Laenge ist %d.", StringLength, i, 602-2);
				return;
			}
		}
		else if(0 == A_FSG_41_0_0_51_Data_7_CntList[i] ) /*check box deaktiviert*/
		{
			if(StringLength >= 0 && StringLength <= 127 && StringLength <= 602-1)
			{
				data[currentPos++] = StringLength & 0x7F; //Bit 8 = 0
			}
			else
			{
				writelineEx(gBAP_Trace, 0, "Eingegebene Laenge: %d von A_FSG_41_0_0_51_Data_7 mit Record Nr. %d ist ungueltig. Die max. erlaubte Laenge ist %d. ", StringLength, i, 602-1);
				return;
			}
		}
        for(j=0; j < StringLength ; j++)
        {
            data[currentPos++] = A_FSG_41_0_0_51_ArrayDataList[i].Param7[j];
        }
       }
    //sollte der letzte Parameter ein first nibble gewesen sein, muss noch 1 increment durchgefuehrt werden
    if( nibbleSetted==1) currentPos++;
    nibbleSetted = 0;
     }
    }
    else
    {
     if( (head[0] & 0x10) > 0)
     {
        if(startVal != 0) startVal--;
        else
        {
           startVal = A_FSG_41_0_0_51_ArrayDataList_Length -1;
        }
     }
     for( i = startVal ; i > startVal - elementsVal ; i--)
     {
       if( i < 0 || i >= A_FSG_41_0_0_51_ArrayDataList_Length )
       {
         write("Array index ausserhalb der Grenzen, Fct: 51");
         break;
       }
      if(nibbleSetted == 1) currentPos++;
      nibbleSetted = 0;
     if( (head[0]&0x40) == 0){ /* Transmit_Pos = 0, keine Positionsdaten */ }
     else
     {
        if( (head[0]&0x80) == 0)
        {
           //IndexSize = 0, Pos als 1 Byte Wert
           data[currentPos++] = A_FSG_41_0_0_51_ArrayDataList[i].Param1 & 0xFF;
        }
        else
        {
           //IndexSize = 1, Pos als 2 Byte Wert
           data[currentPos++] = A_FSG_41_0_0_51_ArrayDataList[i].Param1 & 0xFF;
           data[currentPos++] = (A_FSG_41_0_0_51_ArrayDataList[i].Param1 >> 8) & 0xFF;
        }
     }
      // Check if the current value of RecAdr enables the variable InstanceID:
      if( 0 || 1 == getValue( A_FSG_41_0_0_51_RecAdr ) || 3 == getValue( A_FSG_41_0_0_51_RecAdr ) )
      {
        //Sollte vor einem 1 Byte Wert 1 Nibble kommen, muss der index um 1 incrementiert werden!
        if( nibbleSetted==1) currentPos++;
        nibbleSetted = 0;
        data[currentPos++] = (A_FSG_41_0_0_51_ArrayDataList[i].Param2 ) & 0xFF;
       }
      // Check if the current value of RecAdr enables the variable CallID:
      if( 0 || 1 == getValue( A_FSG_41_0_0_51_RecAdr ) || 2 == getValue( A_FSG_41_0_0_51_RecAdr ) || 3 == getValue( A_FSG_41_0_0_51_RecAdr ) )
      {
        //Sollte vor einem 1 Byte Wert 1 Nibble kommen, muss der index um 1 incrementiert werden!
        if( nibbleSetted==1) currentPos++;
        nibbleSetted = 0;
        data[currentPos++] = (A_FSG_41_0_0_51_ArrayDataList[i].Param3 ) & 0xFF;
       }
      // Check if the current value of RecAdr enables the variable PictureType:
      if( 0 || 1 == getValue( A_FSG_41_0_0_51_RecAdr ) || 2 == getValue( A_FSG_41_0_0_51_RecAdr ) || 3 == getValue( A_FSG_41_0_0_51_RecAdr ) )
      {
        //Sollte vor einem 1 Byte Wert 1 Nibble kommen, muss der index um 1 incrementiert werden!
        if( nibbleSetted==1) currentPos++;
        nibbleSetted = 0;
        data[currentPos++] = (A_FSG_41_0_0_51_ArrayDataList[i].Param4 ) & 0xFF;
       }
      // Check if the current value of RecAdr enables the variable IPv6_Address:
      if( 0 || 1 == getValue( A_FSG_41_0_0_51_RecAdr ) || 2 == getValue( A_FSG_41_0_0_51_RecAdr ) )
      {
        //Sollte vor einem String Wert 1 Nibble kommen, muss der index um 1 incrementiert werden!
        if( nibbleSetted==1) currentPos++;
        nibbleSetted = 0;
        StringLength =A_FSG_41_0_0_51_ArrayDataList[i].Param5_Length;
		/* Pruefung ob die Laenge-Checkbox aktiv ist */
		if (1 == A_FSG_41_0_0_51_Data_5_CntList[i] )
		{
			if(StringLength >= 0 && StringLength <= 32767 && StringLength <= 17-2)
			{
				data[currentPos++] = ( (StringLength >> 8) & 0x7F ) | 0x80; //2Byte Flag (Bit 8) setzen + HighByte (erste 7 bit)
				data[currentPos++] = StringLength &0xFF;
			}
			else
			{
				writelineEx(gBAP_Trace, 0, "Eingegebene Laenge: %d von A_FSG_41_0_0_51_Data_5 mit Record Nr. %d ist ungueltig. Die max. erlaubte Laenge ist %d.", StringLength, i, 17-2);
				return;
			}
		}
		else if(0 == A_FSG_41_0_0_51_Data_5_CntList[i] ) /*check box deaktiviert*/
		{
			if(StringLength >= 0 && StringLength <= 127 && StringLength <= 17-1)
			{
				data[currentPos++] = StringLength & 0x7F; //Bit 8 = 0
			}
			else
			{
				writelineEx(gBAP_Trace, 0, "Eingegebene Laenge: %d von A_FSG_41_0_0_51_Data_5 mit Record Nr. %d ist ungueltig. Die max. erlaubte Laenge ist %d. ", StringLength, i, 17-1);
				return;
			}
		}
        for(j=0; j < StringLength ; j++)
        {
            data[currentPos++] = A_FSG_41_0_0_51_ArrayDataList[i].Param5[j];
        }
       }
      // Check if the current value of RecAdr enables the variable TCP_Port:
      if( 0 || 1 == getValue( A_FSG_41_0_0_51_RecAdr ) || 2 == getValue( A_FSG_41_0_0_51_RecAdr ) )
      {
        //Sollte vor einem 2 Byte Wert 1 Nibble kommen, muss der index um 1 incrementiert werden!
        if( nibbleSetted==1) currentPos++;
        nibbleSetted = 0;
        data[currentPos++] = (A_FSG_41_0_0_51_ArrayDataList[i].Param6     ) & 0xFF;
        data[currentPos++] = (A_FSG_41_0_0_51_ArrayDataList[i].Param6 >> 8) & 0xFF;
       }
      // Check if the current value of RecAdr enables the variable URI:
      if( 0 || 1 == getValue( A_FSG_41_0_0_51_RecAdr ) || 2 == getValue( A_FSG_41_0_0_51_RecAdr ) || 3 == getValue( A_FSG_41_0_0_51_RecAdr ) )
      {
        //Sollte vor einem String Wert 1 Nibble kommen, muss der index um 1 incrementiert werden!
        if( nibbleSetted==1) currentPos++;
        nibbleSetted = 0;
        StringLength =A_FSG_41_0_0_51_ArrayDataList[i].Param7_Length;
		/* Pruefung ob die Laenge-Checkbox aktiv ist */
		if (1 == A_FSG_41_0_0_51_Data_7_CntList[i] )
		{
			if(StringLength >= 0 && StringLength <= 32767 && StringLength <= 602-2)
			{
				data[currentPos++] = ( (StringLength >> 8) & 0x7F ) | 0x80; //2Byte Flag (Bit 8) setzen + HighByte (erste 7 bit)
				data[currentPos++] = StringLength &0xFF;
			}
			else
			{
				writelineEx(gBAP_Trace, 0, "Eingegebene Laenge: %d von A_FSG_41_0_0_51_Data_7 mit Record Nr. %d ist ungueltig. Die max. erlaubte Laenge ist %d.", StringLength, i, 602-2);
				return;
			}
		}
		else if(0 == A_FSG_41_0_0_51_Data_7_CntList[i] ) /*check box deaktiviert*/
		{
			if(StringLength >= 0 && StringLength <= 127 && StringLength <= 602-1)
			{
				data[currentPos++] = StringLength & 0x7F; //Bit 8 = 0
			}
			else
			{
				writelineEx(gBAP_Trace, 0, "Eingegebene Laenge: %d von A_FSG_41_0_0_51_Data_7 mit Record Nr. %d ist ungueltig. Die max. erlaubte Laenge ist %d. ", StringLength, i, 602-1);
				return;
			}
		}
        for(j=0; j < StringLength ; j++)
        {
            data[currentPos++] = A_FSG_41_0_0_51_ArrayDataList[i].Param7[j];
        }
       }
    //sollte der letzte Parameter ein first nibble gewesen sein, muss noch 1 increment durchgefuehrt werden
    if( nibbleSetted==1) currentPos++;
    nibbleSetted = 0;
     }
    }
    Request_byteSequence(LSGID, A_FSG_41_0_0_51_ID, Data_REQ, data, currentPos);
}
on envVar A_FSG_41_0_0_51
{
    byte temp[1880];
    getValue(A_FSG_41_0_0_51, temp);
    putValue(A_FSG_41_0_0_51_RecAdr, 0x0F & temp[0]); //Record Address = Bit 0-3 von Byte 0
    if ( (0x10 & temp[0]) >0)
        putValue(A_FSG_41_0_0_51_Shift, 1); //Shift = Bit 4 von Byte 0
    else
        putValue(A_FSG_41_0_0_51_Shift, 0); //Shift = Bit 4 von Byte 0
    if ( (0x20 & temp[0]) >0)
        putValue(A_FSG_41_0_0_51_Direction, 1); //Direction = Bit 5 von Byte 0
    else
        putValue(A_FSG_41_0_0_51_Direction, 0); //Direction = Bit 5 von Byte 0
    if ( (0x40 & temp[0]) >0)
        putValue(A_FSG_41_0_0_51_TransPos, 1); //Transmission Pos = Bit 6 von Byte 0
    else
        putValue(A_FSG_41_0_0_51_TransPos, 0); //Transmission Pos = Bit 6 von Byte 0
    if ( (0x80 & temp[0]) >0)
        putValue(A_FSG_41_0_0_51_IndexSize, 1); //IndexSize = Bit 7 von Byte 0
    else
        putValue(A_FSG_41_0_0_51_IndexSize, 0); //IndexSize = Bit 7 von Byte 0
    if(getValue(A_FSG_41_0_0_51_IndexSize))
    {
        putValue(A_FSG_41_0_0_51_Start, ((temp[2]<<8)| temp[1]) ); // Array Start index, 2 Byte.
        putValue(A_FSG_41_0_0_51_Elements, ((temp[4]<<8)| temp[3]) ); // Array element count, 2 Byte.
    }
    else
    {
        putValue(A_FSG_41_0_0_51_Start, temp[1]); // Array Start index, 1 Byte.
        putValue(A_FSG_41_0_0_51_Elements, temp[2]); // Array element count, 1 Byte.
    }
}
A_FSG_41_0_0_51_GenerateStatus()
{
    byte head[5];
    int i = 0;
    int headLength;
    long tempValue;
    int currentPos;
    //Record Address in Byte 0 Bit 0-3 kopieren - MAX Wert = 0x0F
    if(getValue(A_FSG_41_0_0_51_RecAdr) > 0x0F)
        putValue(A_FSG_41_0_0_51_RecAdr , 0x0F);
    head[0] = (head[0] & 0xF0) | getValue(A_FSG_41_0_0_51_RecAdr);
    //Shift Bit in Byte 0 Bit 4 kopieren
    if( getValue(A_FSG_41_0_0_51_Shift) > 0) head[0] = head[0] | 0x10;
    else head[0] = head[0] & 0xEF;
    // Direction Bit in Byte 0 Bit 5 kopieren
    if( getValue(A_FSG_41_0_0_51_Direction) > 0) head[0] = head[0] | 0x20;
    else head[0] = head[0] & 0xDF;
    // TransmissionPos Bit in Byte 0 Bit 6 kopieren
    if( getValue(A_FSG_41_0_0_51_TransPos) > 0) head[0] = head[0] | 0x40;
    else head[0] = head[0] & 0xBF;
    if( getValue(A_FSG_41_0_0_51_IndexSize) > 0)
    {
        // 5 Byte Header
        head[0] = head[0] | 0x80;
        head[1] =  getValue(A_FSG_41_0_0_51_Start) & 0xFF;
        head[2] = (getValue(A_FSG_41_0_0_51_Start) >> 8 ) & 0xFF;
        head[3] =  getValue(A_FSG_41_0_0_51_Elements) & 0xFF;
        head[4] = (getValue(A_FSG_41_0_0_51_Elements)  >> 8 ) & 0xFF;
        //ToDo: DATA - derzeit einfach laenge = 5
        headLength = 5;
    }
    else 
    {
        // 3 Byte Header
        head[0] = head[0] & 0x7F;
        head[1] = getValue(A_FSG_41_0_0_51_Start) & 0xFF;
        head[2] = getValue(A_FSG_41_0_0_51_Elements) & 0xFF;
        //ToDo: DATA - derzeit einfach laenge = 3
        headLength = 3;
    }

    currentPos = 0;

    putValue(A_FSG_41_0_0_51, head, headLength); 
}

on envVar A_FSG_41_0_0_51_RecAdr
{
    A_FSG_41_0_0_51_GenerateStatus();
}

on envVar A_FSG_41_0_0_51_Shift
{
    A_FSG_41_0_0_51_GenerateStatus();
}

on envVar A_FSG_41_0_0_51_Direction
{
    A_FSG_41_0_0_51_GenerateStatus();
}

on envVar A_FSG_41_0_0_51_Start
{
    A_FSG_41_0_0_51_GenerateStatus();
}

on envVar A_FSG_41_0_0_51_Elements
{
    A_FSG_41_0_0_51_GenerateStatus();
}

on envVar A_FSG_41_0_0_51_IndexSize
{
    A_FSG_41_0_0_51_GenerateStatus();
}
on envVar A_FSG_41_0_0_51_TransPos
{
    A_FSG_41_0_0_51_GenerateStatus();
}
A_FSG_41_0_0_51_Changed_GenerateChanged()
{
    byte head[5];
    //Record Address in Byte 0 Bit 0-3 kopieren - MAX Wert = 0x0F
    if(getValue(A_FSG_41_0_0_51_Changed_RecAdr) > 0x0F)
        putValue(A_FSG_41_0_0_51_Changed_RecAdr , 0x0F);
    head[0] = (head[0] & 0xF0) | getValue(A_FSG_41_0_0_51_Changed_RecAdr);
    //Shift Bit in Byte 0 Bit 4 kopieren
    if( getValue(A_FSG_41_0_0_51_Changed_Shift) > 0) head[0] = head[0] | 0x10;
    else head[0] = head[0] & 0xEF;
    // Direction Bit in Byte 0 Bit 5 kopieren
    if( getValue(A_FSG_41_0_0_51_Changed_Direction) > 0) head[0] = head[0] | 0x20;
    else head[0] = head[0] & 0xDF;
    // TransmissionPos Bit in Byte 0 Bit 6 kopieren
    if( getValue(A_FSG_41_0_0_51_Changed_TransPos) > 0) head[0] = head[0] | 0x40;
    else head[0] = head[0] & 0xBF;
    if( getValue(A_FSG_41_0_0_51_Changed_IndexSize) > 0)
    {
        // 5 Byte Header
        head[0] = head[0] | 0x80;
        head[1] =  getValue(A_FSG_41_0_0_51_Changed_Start) & 0xFF;
        head[2] = (getValue(A_FSG_41_0_0_51_Changed_Start) >> 8 ) & 0xFF;
        head[3] =  getValue(A_FSG_41_0_0_51_Changed_Elements) & 0xFF;
        head[4] = (getValue(A_FSG_41_0_0_51_Changed_Elements)  >> 8 ) & 0xFF;
        //ToDo: DATA - derzeit einfach laenge = 5
        putValue(A_FSG_41_0_0_51_Changed, head, 5); 
    }
    else 
    {
        // 3 Byte Header
        head[0] = head[0] & 0x7F;
        head[1] = getValue(A_FSG_41_0_0_51_Changed_Start) & 0xFF;
        head[2] = getValue(A_FSG_41_0_0_51_Changed_Elements) & 0xFF;
        //ToDo: DATA - derzeit einfach laenge = 3
        putValue(A_FSG_41_0_0_51_Changed, head, 3); 
    }
}

on envVar A_FSG_41_0_0_51_Changed_RecAdr
{
    A_FSG_41_0_0_51_Changed_GenerateChanged();
}

on envVar A_FSG_41_0_0_51_Changed_Shift
{
    A_FSG_41_0_0_51_Changed_GenerateChanged();
}

on envVar A_FSG_41_0_0_51_Changed_Direction
{
    A_FSG_41_0_0_51_Changed_GenerateChanged();
}

on envVar A_FSG_41_0_0_51_Changed_Start
{
    A_FSG_41_0_0_51_Changed_GenerateChanged();
}

on envVar A_FSG_41_0_0_51_Changed_Elements
{
    A_FSG_41_0_0_51_Changed_GenerateChanged();
}

on envVar A_FSG_41_0_0_51_Changed_IndexSize
{
    A_FSG_41_0_0_51_Changed_GenerateChanged();
}
on envVar A_FSG_41_0_0_51_Changed_TransPos
{
    A_FSG_41_0_0_51_Changed_GenerateChanged();
}
on envVar A_FSG_41_0_0_51_SetGet
{
    byte temp[630];
    getValue(A_FSG_41_0_0_51_SetGet, temp);
    putValue(A_FSG_41_0_0_51_SetGet_RecAdr, 0x0F & temp[0]); //Record Address = Bit 0-3 von Byte 0
    if ( (0x10 & temp[0]) >0)
        putValue(A_FSG_41_0_0_51_SetGet_Shift, 1); //Shift = Bit 4 von Byte 0
    else
        putValue(A_FSG_41_0_0_51_SetGet_Shift, 0); //Shift = Bit 4 von Byte 0
    if ( (0x20 & temp[0]) >0)
        putValue(A_FSG_41_0_0_51_SetGet_Direction, 1); //Direction = Bit 5 von Byte 0
    else
        putValue(A_FSG_41_0_0_51_SetGet_Direction, 0); //Direction = Bit 5 von Byte 0
    // Bit 6 von Byte 0 = reserved
    if ( (0x80 & temp[0]) >0)
        putValue(A_FSG_41_0_0_51_SetGet_IndexSize, 1); //IndexSize = Bit 7 von Byte 0
    else
        putValue(A_FSG_41_0_0_51_SetGet_IndexSize, 0); //IndexSize = Bit 7 von Byte 0
    if(getValue(A_FSG_41_0_0_51_SetGet_IndexSize))
    {
        putValue(A_FSG_41_0_0_51_SetGet_Start, ((temp[2]<<8)| temp[1]) ); //Start Wert, 2 Byte lang
        putValue(A_FSG_41_0_0_51_SetGet_Elements, ((temp[4]<<8)| temp[3]) ); //Elements Wert, 2 Byte lang
    }
    else
    {
        putValue(A_FSG_41_0_0_51_SetGet_Start, temp[1]); //Start Wert, 1 Byte lang
        putValue(A_FSG_41_0_0_51_SetGet_Elements, temp[2]); //Start Wert, 1 Byte lang
    }
}
A_FSG_41_0_0_51_LoadArray()
{
	/********* Statische Deklarationen ***********/
	dword CSVfileHandle;
	dword filePos;
	dword paramPos;
	dword Num_of_csv_byte;
	dword element;
	dword current_CSV_line;
	byte buffer_byte[0xFFFF];
	dword i;
	dword j;
	char CSV_filename[255];
  char CSV_filepath[255];
  byte pos;
  char gListPath[255] = "";

	/********* Param Puffer Deklarationen ***********/
	char temp1[25];
	char temp2[25];
	char temp3[25];
	char temp4[25];
	char temp6[25];

	/********* Initialisierungen ***********/
	CSVfileHandle = 0;
	filePos = 0;
	paramPos = 0;
	Num_of_csv_byte = 0;
	element = 1;
	current_CSV_line = 0;
	for(i = 0; i < A_FSG_41_0_0_51_ArrayDataList_Length; i++)
	{ /* Initialisierung von den Ziel-Strukturen */
		A_FSG_41_0_0_51_ArrayDataList[i].Param1 = 0;
		A_FSG_41_0_0_51_ArrayDataList[i].Param2 = 0;
		A_FSG_41_0_0_51_ArrayDataList[i].Param3 = 0;
		A_FSG_41_0_0_51_ArrayDataList[i].Param4 = 0;
		for(j=0; j<17; j++)
			A_FSG_41_0_0_51_ArrayDataList[i].Param5[j] = 0;
		A_FSG_41_0_0_51_ArrayDataList[i].Param5_Length = 0;
		A_FSG_41_0_0_51_Data_5_LenList[i] = 0;
		A_FSG_41_0_0_51_ArrayDataList[i].Param6 = 0;
		for(j=0; j<602; j++)
			A_FSG_41_0_0_51_ArrayDataList[i].Param7[j] = 0;
		A_FSG_41_0_0_51_ArrayDataList[i].Param7_Length = 0;
		A_FSG_41_0_0_51_Data_7_LenList[i] = 0;
	}

	/********* Laden der CSV-Datei ***********/
	getValue(A_FSG_41_0_0_51_fileSelector, gListPath);
  
  for(i = 0; i < strlen(gListPath); i++)
  {
    if (gListPath[i] == '\\' )
      pos = i;
  }
  
  // Strings löschen
  str_replace(CSV_filepath, CSV_filepath, "");
  str_replace(CSV_filename, CSV_filename, "");
 
  // Strings auftelien
  substr_cpy(CSV_filepath, gListPath, 0, pos, elcount(CSV_filepath)); 
  substr_cpy(CSV_filename, gListPath, (pos+1), -1, elcount(CSV_filename)); 
  
	setFilePath(CSV_filepath,0);
	CSVfileHandle = openFileRead(CSV_filename, 1); //open *.csv (binary-mode ->get the ASCII/UTF-8 code)

	if (CSVfileHandle!=0) //*.csv file access successful
	{
		writelineEx(gBAP_Trace, 0,"Dateizugriff auf '%s' erfolgreich", CSV_filename);    //output result
		//get data from *.csv and store the total number of byte in *.csv-file
		Num_of_csv_byte = fileGetBinaryBlock (buffer_byte, elcount(buffer_byte), CSVfileHandle);

		for (filePos = 0; filePos < Num_of_csv_byte; filePos++) //copy data into "LastDestList"
		{
			if (buffer_byte[filePos] != 0x3B) //read data if no ";" is detected
			{
				//nextline in *.csv (next "record element" in LastDestList) -> "LF" and "CR" detected -> copy (transform string -> long) data from help values in global values
				if(buffer_byte[filePos] == 0x0D && buffer_byte[filePos+1] == 0x0A)
				{
					if(current_CSV_line > 0 && current_CSV_line < 255) //ignore first line in *.csv file
					{
						A_FSG_41_0_0_51_ArrayDataList[current_CSV_line-1].Param1 = atol(temp1); //Pos
						A_FSG_41_0_0_51_ArrayDataList[current_CSV_line-1].Param2 = atol(temp2); //InstanceID
						A_FSG_41_0_0_51_ArrayDataList[current_CSV_line-1].Param3 = atol(temp3); //CallID
						A_FSG_41_0_0_51_ArrayDataList[current_CSV_line-1].Param4 = atol(temp4); //PictureType
						A_FSG_41_0_0_51_ArrayDataList[current_CSV_line-1].Param6 = atol(temp6); //TCP_Port
						for(i = 0; i < 25; i++)
						{ /* Temp-Puffer Initialisierung zur Vermeidung von Nebeneffekte */
							temp1[i]=0;
							temp2[i]=0;
							temp3[i]=0;
							temp4[i]=0;
							temp6[i]=0;
						}
					}
					current_CSV_line++; //next line in *.csv file
					element = 1; //start at 'POS' (first record element of "array data")
					paramPos = 0; //reset value
				}
 				//copy data from "buffer_byte" (data from *.csv file) in help values and "name" until end of line is not detected
				else if(current_CSV_line > 0 && current_CSV_line < 255)
				{
					//writelineEx(gBAP_Trace, 0, "Element %x  Index %x", element, j);
					switch (element)
					{
						case 1: //Pos
								if( paramPos >= elCount(temp1) ){
									writelineEx(gBAP_Trace, 0, "Param%x in Zeile %d in der Input CSV Datei, enthaelt mehr Zeichen als erlaubt. Bearbeitung abgebrochen!", element, current_CSV_line);
									return; //False
								}else{
									temp1[paramPos] = buffer_byte[filePos];
									paramPos++;
								}
							break;
						case 2: //InstanceID
								if( paramPos >= elCount(temp2) ){
									writelineEx(gBAP_Trace, 0, "Param%x in Zeile %d in der Input CSV Datei, enthaelt mehr Zeichen als erlaubt. Bearbeitung abgebrochen!", element, current_CSV_line);
									return; //False
								}else{
									temp2[paramPos] = buffer_byte[filePos];
									paramPos++;
								}
							break;
						case 3: //CallID
								if( paramPos >= elCount(temp3) ){
									writelineEx(gBAP_Trace, 0, "Param%x in Zeile %d in der Input CSV Datei, enthaelt mehr Zeichen als erlaubt. Bearbeitung abgebrochen!", element, current_CSV_line);
									return; //False
								}else{
									temp3[paramPos] = buffer_byte[filePos];
									paramPos++;
								}
							break;
						case 4: //PictureType
								if( paramPos >= elCount(temp4) ){
									writelineEx(gBAP_Trace, 0, "Param%x in Zeile %d in der Input CSV Datei, enthaelt mehr Zeichen als erlaubt. Bearbeitung abgebrochen!", element, current_CSV_line);
									return; //False
								}else{
									temp4[paramPos] = buffer_byte[filePos];
									paramPos++;
								}
							break;
						case 5: //IPv6_Address
								if(paramPos < 16)
								{
									A_FSG_41_0_0_51_ArrayDataList[current_CSV_line-1].Param5[paramPos] = buffer_byte[filePos];
									A_FSG_41_0_0_51_ArrayDataList[current_CSV_line-1].Param5_Length = paramPos +1;
								}
								paramPos++;
						break;
						case 6: //TCP_Port
								if( paramPos >= elCount(temp6) ){
									writelineEx(gBAP_Trace, 0, "Param%x in Zeile %d in der Input CSV Datei, enthaelt mehr Zeichen als erlaubt. Bearbeitung abgebrochen!", element, current_CSV_line);
									return; //False
								}else{
									temp6[paramPos] = buffer_byte[filePos];
									paramPos++;
								}
							break;
						case 7: //URI
								if(paramPos < 600)
								{
									A_FSG_41_0_0_51_ArrayDataList[current_CSV_line-1].Param7[paramPos] = buffer_byte[filePos];
									A_FSG_41_0_0_51_ArrayDataList[current_CSV_line-1].Param7_Length = paramPos +1;
								}
								paramPos++;
						break;
						default:
						break;
					}
				}
			}
			else  // ";" is detected ->next record element of "array data"
			{
				//writelineEx(gBAP_Trace, 0, "naechstes Element %d Bytes",element);
				element++;
				paramPos=0; //reset value
			}
		}

		if(fileClose (CSVfileHandle) !=0) //close *.csv file
			writelineEx(gBAP_Trace, 0,"Datei '%s' geschlossen", CSV_filename); //output result
		else
			writelineEx(gBAP_Trace, 0,"Fehler beim Schliessen der Datei '%s'", CSV_filename);//output result
	}
	else //*.csv file access not successful
	{
		writelineEx(gBAP_Trace, 0,"Fehler beim Dateizugriff auf '%s'",CSV_filename); //output result
	}
}

on envVar A_FSG_41_0_0_51_loadArray_Btn
{
	char filePath[255];
	if (A_FSG_41_0_0_51_generateData_Btn_already_pressed == 0)
	{
		A_FSG_41_0_0_51_generateData_Btn_already_pressed = 1;
	}
	else
	{
		A_FSG_41_0_0_51_generateData_Btn_already_pressed = 0;
		getValue(A_FSG_41_0_0_51_fileSelector, filePath);
		if(0 == strlen(filePath))
		{
			writelineEx(gBAP_Trace, 0, "Invalid file path!");
		}
		else
		{
			A_FSG_41_0_0_51_LoadArray();
			writelineEx(gBAP_Trace, 0, "Load array from CSV file: %s", filePath);
		}
	}
	putValue(A_FSG_41_0_0_51_Data_1, A_FSG_41_0_0_51_ArrayDataList[ getValue( A_FSG_41_0_0_51_DataIndex) ].Param1);
	putValue(A_FSG_41_0_0_51_Data_2, A_FSG_41_0_0_51_ArrayDataList[ getValue( A_FSG_41_0_0_51_DataIndex) ].Param2);
	putValue(A_FSG_41_0_0_51_Data_3, A_FSG_41_0_0_51_ArrayDataList[ getValue( A_FSG_41_0_0_51_DataIndex) ].Param3);
	putValue(A_FSG_41_0_0_51_Data_4, A_FSG_41_0_0_51_ArrayDataList[ getValue( A_FSG_41_0_0_51_DataIndex) ].Param4);
	putValue(A_FSG_41_0_0_51_Data_5, A_FSG_41_0_0_51_ArrayDataList[ getValue( A_FSG_41_0_0_51_DataIndex) ].Param5, A_FSG_41_0_0_51_ArrayDataList[getValue(A_FSG_41_0_0_51_DataIndex)].Param5_Length);
	putValue(A_FSG_41_0_0_51_Data_6, A_FSG_41_0_0_51_ArrayDataList[ getValue( A_FSG_41_0_0_51_DataIndex) ].Param6);
	putValue(A_FSG_41_0_0_51_Data_7, A_FSG_41_0_0_51_ArrayDataList[ getValue( A_FSG_41_0_0_51_DataIndex) ].Param7, A_FSG_41_0_0_51_ArrayDataList[getValue(A_FSG_41_0_0_51_DataIndex)].Param7_Length);
}


on envVar A_FSG_41_0_0_51_generateData_Btn
{
	word i;
	dword elementsArray[9] = {1, 1, 1, 1, 17, 2, 2, 602, 2};
	byte elementsTypeArray[9] = {0, 0, 0, 0, 0xE, 0xF, 0, 0xE, 0xF};
	dword elementsMaxSizeArray[9] = {255, 0xFF, 255, 0xFF, 0, 0, 65535, 0, 0};
	byte tempArray[159766];
	if (A_FSG_41_0_0_51_generateData_Btn_already_pressed == 0)
	{
		A_FSG_41_0_0_51_generateData_Btn_already_pressed = 1;
	}
	else
	{
		initStruct(tempArray, elementsArray, elementsTypeArray, elementsMaxSizeArray, 51, 254 );
		for(i = 0; i < 254; i++)
		{
			memcpy(A_FSG_41_0_0_51_ArrayDataList[i], tempArray, (i * 629) );
			if(A_FSG_41_0_0_51_ArrayDataList[i].Param5_Length > 127 )
				A_FSG_41_0_0_51_Data_5_CntList[i] = 1;
			if(A_FSG_41_0_0_51_ArrayDataList[i].Param7_Length > 127 )
				A_FSG_41_0_0_51_Data_7_CntList[i] = 1;
		}
		A_FSG_41_0_0_51_generateData_Btn_already_pressed = 0;
	}
	putValue(A_FSG_41_0_0_51_Data_1, A_FSG_41_0_0_51_ArrayDataList[ getValue( A_FSG_41_0_0_51_DataIndex) ].Param1);
	putValue(A_FSG_41_0_0_51_Data_2, A_FSG_41_0_0_51_ArrayDataList[ getValue( A_FSG_41_0_0_51_DataIndex) ].Param2);
	putValue(A_FSG_41_0_0_51_Data_3, A_FSG_41_0_0_51_ArrayDataList[ getValue( A_FSG_41_0_0_51_DataIndex) ].Param3);
	putValue(A_FSG_41_0_0_51_Data_4, A_FSG_41_0_0_51_ArrayDataList[ getValue( A_FSG_41_0_0_51_DataIndex) ].Param4);
	putValue(A_FSG_41_0_0_51_Data_5, A_FSG_41_0_0_51_ArrayDataList[ getValue( A_FSG_41_0_0_51_DataIndex) ].Param5, A_FSG_41_0_0_51_ArrayDataList[getValue(A_FSG_41_0_0_51_DataIndex)].Param5_Length);
	putValue(A_FSG_41_0_0_51_Data_6, A_FSG_41_0_0_51_ArrayDataList[ getValue( A_FSG_41_0_0_51_DataIndex) ].Param6);
	putValue(A_FSG_41_0_0_51_Data_7, A_FSG_41_0_0_51_ArrayDataList[ getValue( A_FSG_41_0_0_51_DataIndex) ].Param7, A_FSG_41_0_0_51_ArrayDataList[getValue(A_FSG_41_0_0_51_DataIndex)].Param7_Length);
}
// HME generateCaplOnEnv (3131)
on envVar A_FSG_41_0_0_51_DataIndex
{
    long index;
    long maxIndex = 254-1;
    index = getValue(this);
    if(index >= maxIndex) index = maxIndex;
    else if(index < 0) index = 0;
    putValue(this, index);
    putValue(A_FSG_41_0_0_51_Data_1, A_FSG_41_0_0_51_ArrayDataList[index].Param1);
    putValue(A_FSG_41_0_0_51_Data_2, A_FSG_41_0_0_51_ArrayDataList[index].Param2);
    putValue(A_FSG_41_0_0_51_Data_3, A_FSG_41_0_0_51_ArrayDataList[index].Param3);
    putValue(A_FSG_41_0_0_51_Data_4, A_FSG_41_0_0_51_ArrayDataList[index].Param4);
    putValue(A_FSG_41_0_0_51_Data_5_len, A_FSG_41_0_0_51_Data_5_LenList[index]);
    putValue(A_FSG_41_0_0_51_Data_5_cnt, A_FSG_41_0_0_51_Data_5_CntList[index]);
    putValue(A_FSG_41_0_0_51_Data_5, A_FSG_41_0_0_51_ArrayDataList[index].Param5, A_FSG_41_0_0_51_ArrayDataList[index].Param5_Length);
    putValue(A_FSG_41_0_0_51_Data_6, A_FSG_41_0_0_51_ArrayDataList[index].Param6);
    putValue(A_FSG_41_0_0_51_Data_7_len, A_FSG_41_0_0_51_Data_7_LenList[index]);
    putValue(A_FSG_41_0_0_51_Data_7_cnt, A_FSG_41_0_0_51_Data_7_CntList[index]);
    putValue(A_FSG_41_0_0_51_Data_7, A_FSG_41_0_0_51_ArrayDataList[index].Param7, A_FSG_41_0_0_51_ArrayDataList[index].Param7_Length);

}
on envVar A_FSG_41_0_0_51_DataIndex_Incr
{
    long index;
    if(A_FSG_41_0_0_51_DataIndex_Incr_already_pressed == 0)
    {
        A_FSG_41_0_0_51_DataIndex_Incr_already_pressed = 1;
    }
    else
    {
        index = getValue(A_FSG_41_0_0_51_DataIndex);
        index++;
        putValue(A_FSG_41_0_0_51_DataIndex, index);
        A_FSG_41_0_0_51_DataIndex_Incr_already_pressed = 0;
    }
}
on envVar A_FSG_41_0_0_51_DataIndex_Decr
{
    long index;
    if(A_FSG_41_0_0_51_DataIndex_Decr_already_pressed == 0)
    {
        A_FSG_41_0_0_51_DataIndex_Decr_already_pressed = 1;
    }
    else
    {
        index = getValue(A_FSG_41_0_0_51_DataIndex);
        index--;
        putValue(A_FSG_41_0_0_51_DataIndex, index);
        A_FSG_41_0_0_51_DataIndex_Decr_already_pressed = 0;
    }
}
on envVar A_FSG_41_0_0_51_FctEn
{
    long data[3];
    data[0]=LSGID;
    data[1]=A_FSG_41_0_0_51_ID;
    data[2]=getValue(A_FSG_41_0_0_51_FctEn);
    ChangeConfig(0x0031,data);
}
// De-Aktivierung der Eingabefelder der FCTID A_FSG_41_0_0_51
on envVar A_FSG_41_0_0_51_FctLstItemEn
{
       if(getValue(this)) 
       {
           EnableControl(panel_name,"panel_FSG_41_0_0_51",1);
           EnableControl(panel_name,"panel_A_FSG_41_0_0_51_Status",1);
           EnableControl(panel_name,"errfield_A_FSG_41_0_0_51",1);
           EnableControl(panel_name,"panel_A_FSG_41_0_0_51",1);
           EnableControl(panel_name,"panel_A_FSG_41_0_0_51_Changed",1);
           EnableControl(panel_name,"panel_A_FSG_41_0_0_51_SetGet",1);
           setControlForeColor(panel_name, "checkbox_A_FSG_41_0_0_51", MakeRGB(0,240,0));
       }
       else
       {
           EnableControl(panel_name,"panel_FSG_41_0_0_51",0);
           EnableControl(panel_name,"panel_A_FSG_41_0_0_51_Status",0);
           EnableControl(panel_name,"errfield_A_FSG_41_0_0_51",0);
           EnableControl(panel_name,"panel_A_FSG_41_0_0_51",0);
           EnableControl(panel_name,"panel_A_FSG_41_0_0_51_Changed",0);
           EnableControl(panel_name,"panel_A_FSG_41_0_0_51_SetGet",0);
           setControlForeColor(panel_name, "checkbox_A_FSG_41_0_0_51", MakeRGB(250,0,0));
       }
}
// Man darf gleichzeitig nur Checkbox fuer SegmError oder IntertelegramError aktiviert werden
on envVar A_FSG_41_0_0_51_IntTlgEn
{
       if(getValue(this)) 
       {
           putValue(A_FSG_41_0_0_51_SegmEn,0);
           intertelegram_err(A_FSG_41_0_0_51_ID);
       }
       else
       {
           intertelegram_err_off(A_FSG_41_0_0_51_ID);
       }
}
// Man darf gleichzeitig nur Checkbox fuer SegmError oder IntertelegramError aktiviert werden
on envVar A_FSG_41_0_0_51_SegmEn
{
       if(getValue(this)) 
       {
           putValue(A_FSG_41_0_0_51_IntTlgEn,0);
           sequence_err(A_FSG_41_0_0_51_ID,getValueSize(A_FSG_41_0_0_51_SegmEn));
       }
       else
       {
              sequence_err_off(A_FSG_41_0_0_51_ID);
       }
}

// [XL] Ueberwachung der CheckBox fuer AT
on envVar A_FSG_41_0_0_51_AT
{
	if(getValue(this))
	{
		EnableControl(panel_name,"panel_A_FSG_41_0_0_51_Status",0);
	}
	else
	{
   	EnableControl(panel_name,"panel_A_FSG_41_0_0_51_Status",1);
 	}
}



A_FSG_41_0_0_51_SetInd () { /* leere Function*/ }

A_FSG_41_0_0_51_SetGetInd () { /* leere Function*/ }

A_FSG_41_0_0_51_GetInd()
{
    int currentPos;
    byte head[5];
    byte stringTempValue[1880];
    int i;
    int j;
    int startVal;
    int elementsVal;
    byte recordAddressVal;
    byte transmitPosVal;
    long tempValue;
    long index;
    byte nibbleSetted;
    currentPos = 0;
    nibbleSetted = 0;
    //Einzelparameter: ASG_ID
    if(nibbleSetted == 1)
    {
        //voriger Parameter war ein Nibble, => second nibble, Pos incr und Flag zuruecksetzen
        tempValue = (gBAP_Indication_data[currentPos++] &0xF);
        nibbleSetted = 0;
    }
    else
    {
        //first nibble, kein increment, Flag setzen
        tempValue = ((gBAP_Indication_data[currentPos]>>4) &0xF);
        nibbleSetted = 1;
    }
    putValue(A_FSG_41_0_0_51_1_SetGet, tempValue);
    //Einzelparameter: TAID
    if(nibbleSetted == 1)
    {
        //voriger Parameter war ein Nibble, => second nibble, Pos incr und Flag zuruecksetzen
        tempValue = (gBAP_Indication_data[currentPos++] &0xF);
        nibbleSetted = 0;
    }
    else
    {
        //first nibble, kein increment, Flag setzen
        tempValue = ((gBAP_Indication_data[currentPos]>>4) &0xF);
        nibbleSetted = 1;
    }
    putValue(A_FSG_41_0_0_51_2_SetGet, tempValue);
    //head Parameter
    if(gBAP_Indication_header[4] >= (3+currentPos))
    {
        if( (gBAP_Indication_data[currentPos] & 0x80) > 0)
            if(gBAP_Indication_header[4] >= (5+currentPos))
            {
                for(i = 0; i < 5; i++) head[i] = gBAP_Indication_data[currentPos++];
                putValue(A_FSG_41_0_0_51_SetGet, head, 5);
                if(getValue(A_FSG_41_0_0_51_AT))
                {
                    putValue(A_FSG_41_0_0_51,head,5);
                }
                startVal = (head[2]<<8) | head[1];
                elementsVal = (head[4]<<8) | head[3];
            }
            else write("received Data Error");
        else
        {
            for(i = 0; i < 3; i++) head[i] = gBAP_Indication_data[currentPos++];
            putValue(A_FSG_41_0_0_51_SetGet, head, 3);
            if(getValue(A_FSG_41_0_0_51_AT))
            {
                putValue(A_FSG_41_0_0_51,head,3);
            }
                startVal = head[1];
                elementsVal = head[2];
        }
        recordAddressVal = head[0] & 0x0F;
        transmitPosVal = head[0] & 0x40;
        if(getValue(A_FSG_41_0_0_51_AT))
        {
            putValue(A_FSG_41_0_0_51_RecAdr,recordAddressVal);
            putValue(A_FSG_41_0_0_51_Start, startVal);
            putValue(A_FSG_41_0_0_51_Elements, elementsVal);
            putValue(A_FSG_41_0_0_51_TransPos, transmitPosVal);
        }
    }
}

on envVar A_FSG_41_0_0_51_1
{
	byte superval[1880];

	//Update Childvalue (Enum)
	byte thisval; // ASG_ID
	thisval = 0x0f & getValue(this);
}
// Ueberwachung der Darstellungsvariable der Range.
on envVar A_FSG_41_0_0_51_2_range // CallPicture.TAID 
{
	@A_FSG_41_0_0_51_2 = @A_FSG_41_0_0_51_2_range - (0); // slider = range - min
}

on envVar A_FSG_41_0_0_51_2
{
	byte superval[1880];

	//Update Childvalue (Number)
	byte thisval; // TAID
	float slider_value;

	slider_value = round(@A_FSG_41_0_0_51_2, 1.0);
	@A_FSG_41_0_0_51_2_range = slider_value + (0); // real value := slider value + range min.
	thisval = (byte)round((slider_value + (0) - (0)) / (1.0), 1); // bus value := (slider value + min - offset) / step.
}
// Ueberwachung der Darstellungsvariable der Range.
on envVar A_FSG_41_0_0_51_3_range // CallPicture.TotalNumListElements 
{
	@A_FSG_41_0_0_51_3 = @A_FSG_41_0_0_51_3_range - (0); // slider = range - min
}

on envVar A_FSG_41_0_0_51_3
{
	byte superval[1880];

	//Update Childvalue (Number)
	byte thisval; // TotalNumListElements
	float slider_value;

	slider_value = round(@A_FSG_41_0_0_51_3, 1.0);
	@A_FSG_41_0_0_51_3_range = slider_value + (0); // real value := slider value + range min.
	thisval = (byte)round((slider_value + (0) - (0)) / (1.0), 1); // bus value := (slider value + min - offset) / step.
}
// Ueberwachung der Darstellungsvariable der Range.
on envVar A_FSG_41_0_0_51_Data_1_range // CallPicture.Pos 
{
	@A_FSG_41_0_0_51_Data_1 = @A_FSG_41_0_0_51_Data_1_range - (0); // slider = range - min
}

on envVar A_FSG_41_0_0_51_Data_1
{
	byte superval[1880];

	//Update Childvalue (Number)
	byte thisval; // Pos
	float slider_value;

	slider_value = round(@A_FSG_41_0_0_51_Data_1, 1.0);
	@A_FSG_41_0_0_51_Data_1_range = slider_value + (0); // real value := slider value + range min.
	thisval = (byte)round((slider_value + (0) - (0)) / (1.0), 1); // bus value := (slider value + min - offset) / step.
    A_FSG_41_0_0_51_ArrayDataList[getValue(A_FSG_41_0_0_51_DataIndex)].Param1 = thisval;
}
on envVar A_FSG_41_0_0_51_Data_2
{
	byte superval[1880];

	//Update Childvalue (Enum)
	byte thisval; // InstanceID
	thisval = getValue(this);
    A_FSG_41_0_0_51_ArrayDataList[getValue(A_FSG_41_0_0_51_DataIndex)].Param2 = thisval;
}
// Ueberwachung der Darstellungsvariable der Range.
on envVar A_FSG_41_0_0_51_Data_3_range // CallPicture.CallID 
{
	@A_FSG_41_0_0_51_Data_3 = @A_FSG_41_0_0_51_Data_3_range - (0); // slider = range - min
}

on envVar A_FSG_41_0_0_51_Data_3
{
	byte superval[1880];

	//Update Childvalue (Number)
	byte thisval; // CallID
	float slider_value;

	slider_value = round(@A_FSG_41_0_0_51_Data_3, 1.0);
	@A_FSG_41_0_0_51_Data_3_range = slider_value + (0); // real value := slider value + range min.
	thisval = (byte)round((slider_value + (0) - (0)) / (1.0), 1); // bus value := (slider value + min - offset) / step.
    A_FSG_41_0_0_51_ArrayDataList[getValue(A_FSG_41_0_0_51_DataIndex)].Param3 = thisval;
}
on envVar A_FSG_41_0_0_51_Data_4
{
	byte superval[1880];

	//Update Childvalue (Enum)
	byte thisval; // PictureType
	thisval = getValue(this);
    A_FSG_41_0_0_51_ArrayDataList[getValue(A_FSG_41_0_0_51_DataIndex)].Param4 = thisval;
}

// Ueberwachung der CheckBox fuer String
on envVar  A_FSG_41_0_0_51_Data_5_cnt
{
	word len;
	byte cnt;
	len = getValue(A_FSG_41_0_0_51_Data_5_len);
	cnt = getValue(this);

    /* Cnt Wert im Array aktualisieren */
	 A_FSG_41_0_0_51_Data_5_CntList[ getValue(A_FSG_41_0_0_51_DataIndex) ] = cnt;

	/* wird nur gerufen, wenn check box deaktiviert mit Length>127*/ 
	if(cnt == 0) 
	{
		if(len > 127 )
		{
			putValue(A_FSG_41_0_0_51_Data_5_len, 127);
		}
	}

}


on envVar A_FSG_41_0_0_51_Data_5_len
{
	long thisval;
	byte cnt;
	thisval = getValue(this);
	cnt = getValue(A_FSG_41_0_0_51_Data_5_cnt);

	/* wenn die Laenge ausserhalb des erlaubten Bereich liegt, wird diese begrenzt */
	if(thisval > 16 || thisval < 0 )
	{
		writelineEx(gBAP_Trace, 0, "Eingegebene Laenge: %d von A_FSG_41_0_0_51_Data_5 ist ungueltig. Die max. erlaubte Laenge ist %d. ", thisval, 16);
		thisval = 16;
	}
	if( thisval >127)
	{
		putValue(A_FSG_41_0_0_51_Data_5_cnt, 1); /* Switch checkbox on */
	}

	A_FSG_41_0_0_51_ArrayDataList[getValue(A_FSG_41_0_0_51_DataIndex)].Param5_Length = thisval;
	A_FSG_41_0_0_51_Data_5_LenList[ getValue(A_FSG_41_0_0_51_DataIndex) ] = thisval;
	putValue(A_FSG_41_0_0_51_Data_5_len, thisval);

}

on envVar A_FSG_41_0_0_51_Data_5
{
	byte superval[1880];

	//Update Childvalue (String)
	word i;
	byte thisval[17];
	getValue(this, thisval);
    for(i = 0; i < getValueSize(this); i++)
        A_FSG_41_0_0_51_ArrayDataList[getValue(A_FSG_41_0_0_51_DataIndex)].Param5[i] = thisval[i];
    A_FSG_41_0_0_51_ArrayDataList[getValue(A_FSG_41_0_0_51_DataIndex)].Param5_Length = getValueSize(this);
    A_FSG_41_0_0_51_Data_5_LenList[getValue(A_FSG_41_0_0_51_DataIndex)]= getValueSize(this);
    putValue(A_FSG_41_0_0_51_Data_5_len, getValueSize(this));
}
// Ueberwachung der Darstellungsvariable der Range.
on envVar A_FSG_41_0_0_51_Data_6_range // CallPicture.TCP_Port 
{
	@A_FSG_41_0_0_51_Data_6 = @A_FSG_41_0_0_51_Data_6_range - (0); // slider = range - min
}

on envVar A_FSG_41_0_0_51_Data_6
{
	byte superval[1880];

	//Update Childvalue (Number)
	word thisval; // TCP_Port
	float slider_value;

	slider_value = round(@A_FSG_41_0_0_51_Data_6, 1.0);
	@A_FSG_41_0_0_51_Data_6_range = slider_value + (0); // real value := slider value + range min.
	thisval = (word)round((slider_value + (0) - (0)) / (1.0), 1); // bus value := (slider value + min - offset) / step.
    A_FSG_41_0_0_51_ArrayDataList[getValue(A_FSG_41_0_0_51_DataIndex)].Param6 = thisval;
}

// Ueberwachung der CheckBox fuer String
on envVar  A_FSG_41_0_0_51_Data_7_cnt
{
	word len;
	byte cnt;
	len = getValue(A_FSG_41_0_0_51_Data_7_len);
	cnt = getValue(this);

    /* Cnt Wert im Array aktualisieren */
	 A_FSG_41_0_0_51_Data_7_CntList[ getValue(A_FSG_41_0_0_51_DataIndex) ] = cnt;

	/* wird nur gerufen, wenn check box deaktiviert mit Length>127*/ 
	if(cnt == 0) 
	{
		if(len > 127 )
		{
			putValue(A_FSG_41_0_0_51_Data_7_len, 127);
		}
	}

}


on envVar A_FSG_41_0_0_51_Data_7_len
{
	long thisval;
	byte cnt;
	thisval = getValue(this);
	cnt = getValue(A_FSG_41_0_0_51_Data_7_cnt);

	/* wenn die Laenge ausserhalb des erlaubten Bereich liegt, wird diese begrenzt */
	if(thisval > 600 || thisval < 0 )
	{
		writelineEx(gBAP_Trace, 0, "Eingegebene Laenge: %d von A_FSG_41_0_0_51_Data_7 ist ungueltig. Die max. erlaubte Laenge ist %d. ", thisval, 600);
		thisval = 600;
	}
	if( thisval >127)
	{
		putValue(A_FSG_41_0_0_51_Data_7_cnt, 1); /* Switch checkbox on */
	}

	A_FSG_41_0_0_51_ArrayDataList[getValue(A_FSG_41_0_0_51_DataIndex)].Param7_Length = thisval;
	A_FSG_41_0_0_51_Data_7_LenList[ getValue(A_FSG_41_0_0_51_DataIndex) ] = thisval;
	putValue(A_FSG_41_0_0_51_Data_7_len, thisval);

}

on envVar A_FSG_41_0_0_51_Data_7
{
	byte superval[1880];

	//Update Childvalue (String)
	word i;
	byte thisval[602];
	getValue(this, thisval);
    for(i = 0; i < getValueSize(this); i++)
        A_FSG_41_0_0_51_ArrayDataList[getValue(A_FSG_41_0_0_51_DataIndex)].Param7[i] = thisval[i];
    A_FSG_41_0_0_51_ArrayDataList[getValue(A_FSG_41_0_0_51_DataIndex)].Param7_Length = getValueSize(this);
    A_FSG_41_0_0_51_Data_7_LenList[getValue(A_FSG_41_0_0_51_DataIndex)]= getValueSize(this);
    putValue(A_FSG_41_0_0_51_Data_7_len, getValueSize(this));
}
on envVar A_FSG_41_0_0_51_1_SetGet
{
	byte superval[4];

	//Update Childvalue (Enum)
	byte thisval; // ASG_ID
	thisval = 0x0f & getValue(this);
}
// Ueberwachung der Darstellungsvariable der Range.
on envVar A_FSG_41_0_0_51_2_SetGet_range // CallPicture.TAID 
{
	@A_FSG_41_0_0_51_2_SetGet = @A_FSG_41_0_0_51_2_SetGet_range - (0); // slider = range - min
}

on envVar A_FSG_41_0_0_51_2_SetGet
{
	byte superval[4];

	//Update Childvalue (Number)
	byte thisval; // TAID
	float slider_value;

	slider_value = round(@A_FSG_41_0_0_51_2_SetGet, 1.0);
	@A_FSG_41_0_0_51_2_SetGet_range = slider_value + (0); // real value := slider value + range min.
	thisval = (byte)round((slider_value + (0) - (0)) / (1.0), 1); // bus value := (slider value + min - offset) / step.
}


/**
*
* Template-Funktion zum automatischen befuellen der Array-Daten, die in einer Arrayfunktion genutzt werden.
* Die Funktion wird durch den von BAPSimGen generierten Code aufgerufen.
*
* Parameter:
* - structArray: Muss mindestens nMax * Arraygroesse Bytes Platz haben, wird vom BAPSimGen automatisch generiert
* - structElementsSizeArray: Enthaelt die Groesseangabe jedes Array-Elements. Die Arraygroesse entspricht der Elementanzahl im Array.
*       Byte & Nibble = 1; Word = 2; usw. Bei Strings wird die maximale Stringlaenge angegeben.
* - structElementsTypeArray: Gibt den Datentyp eines Array-Elements zurueck. Die Arraygroesse entspricht der Elmentanzahl im Array.
*                               0x0 = Zahlenwert, also ein Slider, Enum, Bitfield,...
*                               0xE = String (darauf folgt immer eine 2, mit der Angabe der benutzen Bytes im String)
*                               0xF = Laenge der Nutzdaten des Strings, nur return Wert
* - fctID: Kann zur Fallunterscheidung der Funktions-IDs verwendet werden.
* - nMax: Array-Index
*
* Die Funktion kann im Switch-Case beliebig erweitert werden. Der Switch-Case wertet den Parameter fctID aus.
*           
*                    
**/
initStruct(byte structArray[], dword structElementsSizeArray[], byte structElementsTypeArray[], dword structElementsMaxSizeArray[], word fctID, word nMax )
{
    byte rand8;
    word rand16;
    word randSize;
    word index;           //indexNr die an die String Parameter angehaengt wird.
    dword destArraySize;   //groesse von structArray
    dword destStructSize;  //groesse eines "Structs" also destArraySize / Anzahl Elemente (nMax))
    dword rand32;    
    dword i;
    dword pos;    //aktuelle Position im structArray
    dword elpos;  //aktuelle Position in den structElementsXXXArray's
    
    destArraySize = elCount(structArray);
    destStructSize = destArraySize / nMax;    

    Switch(fctID){

        //Idee ist, die Arrays je nach Funcion-ID speziell initalisieren zu koennen.
        //hierbei koennten die Daten z.B. aus einer Datei eingelesen werden,
        //oder auch ueber spezielle init Funktionen mit festen Werten initialisiert werden.
        //Der Default-Fall befuellt das Array mit Random-Werten und Strings mit einem vordefinierten Wort (hier test,)

        default :
        {
            pos = 0; 
            for(i = 1; i <= nMax; i++)
            {
                //walk through the array
                
                elpos = 0;
                while(pos < (destStructSize * i) )
                {   
                    //check Element type
                    if( structElementsTypeArray[elpos] == 0x0)          
                    { //Params like int, word, etc.
                        //check element length
                        Switch(structElementsSizeArray[elpos])
                        {
                            case(1) : //byte / nibble
                                rand8 = random(structElementsMaxSizeArray[elpos]);
                                structArray[pos] = rand8;
                                pos++;
                                break;

                            case(2) : //word / int
                                rand16 = random(structElementsMaxSizeArray[elpos]);
                                int2byte(structArray, pos, rand16);
                                pos += 2;
                                break;

                            case (4) : //dword / long
                                rand32 = random(structElementsMaxSizeArray[elpos]);
                                long2byte(structArray, pos, rand32);
                                pos += 4;
                                break;                        
                         }
                    }
                    else if(structElementsTypeArray[elpos] == 0xE)          
                    { //String Params like byte[]
                        randSize = random(structElementsSizeArray[elpos]);
                        if(randSize < 2) randSize = 2; 
                        index = i-1;
                        setRandomString(structArray ,pos ,structElementsSizeArray[elpos], randSize, index);
                        pos += structElementsSizeArray[elpos];
                    }
                    else if(structElementsTypeArray[elpos] == 0xF)          
                    {
                        int2byte(structArray, pos, randSize);
                        pos += 2;
                        //write("Pos: %d Strlth: %d Type: %d ",pos-1,randSize,structElementsTypeArray[elpos]);
                    
                    }
                    elpos++;
                }
            }   
        break;
        }            
    }
}

long2Byte(byte in[], dword pos, dword value)
{
    if( (elCount(in)-pos) < 4)
        write("Array out ouf bounds - too small!");
    in[pos] = value;
    in[++pos] = (value >> 8);
    in[++pos] = (value >> 16);
    in[++pos] = (value >> 24);
}

int2byte (byte in[],dword pos,word value)
{
    if( (elCount(in)-pos) < 2 )
        write("Array out of bounds - too small!");
    in[pos] = value;
    in[++pos] = (value >> 8);        
}

setRandomString (byte in[], dword pos, word strSize, word randSize, word count)
{
    word endPos, endString, j;
    byte testString[4]={'t','e','s','t'};
    
    endPos = pos + strSize;
    endString = pos + randSize;
    j=0;
    
    int2ascii(in, pos, count);
    pos += 2;
    
    for(pos; pos < endPos ;pos ++)
    {
        if(j > 3 )
            j = 0;
        if(pos < endString)
            in[pos] = testString[j++];
        else
            in[pos] = 0x0;
    }
}

int2ascii (byte in[], dword pos, word value)
{
    //Konvertiert nur die erste und zweite Dezimalstelle, also Zahlen zw. 0 und 99.
    
    //auf 2 Stellen kuerzen
    value = value%100;
    //10er schreiben
    in[pos] = (value/10) + 48;    //  0x30 hex = 48 dez = ascii null
    //1er schreiben
    in[pos+1] = (value%10) + 48;  //  0x30 hex = 48 dez = ascii null
}

//MR61529 
on envVar P_FSG_41_0_0_0_2_FctEn
{
    long data[3];
    data[0]=LSGID;
    data[1]=FctID_BAP_Config;
    data[2]=getValue(this);
    ChangeConfig(0x0031,data);
}

//MR61529 
on envVar C_FSG_41_0_0_0_1_SegmEn
{
       if(getValue(this)) 
       {
           putValue(C_FSG_41_0_0_0_1_IntTlgEn,0);
           sequence_err(FctID_GetAll,154);
       }
       else
       {
              sequence_err_off(FctID_GetAll);
       }
}

//MR61529 
on envVar C_FSG_41_0_0_0_1_IntTlgEn
{
       if(getValue(this)) 
       {
           putValue(C_FSG_41_0_0_0_1_SegmEn,0);
           intertelegram_err(FctID_GetAll);
       }
       else
       {
           intertelegram_err_off(FctID_GetAll);
       }
}

//MR61529 
on envVar C_FSG_41_0_0_0_1_ErrEn
{
if (getValue(this))
putValue(C_FSG_41_0_0_0_1_FctEn,0);
}

//MR61529 
on envVar C_FSG_41_0_0_0_1_FctEn
{
    long data[3];
    data[0]=LSGID;
    data[1]=FctID_GetAll;
    data[2]=getValue(this);
    ChangeConfig(0x0031,data);
}

//MR61529 
on envVar P_FSG_41_0_0_0_3_SegmEn
{
       if(getValue(this)) 
       {
           putValue(P_FSG_41_0_0_0_3_IntTlgEn,0);
           sequence_err(FctID_FunctionList,8);
       }
       else
       {
              sequence_err_off(FctID_FunctionList);
       }
}

//MR61529 
on envVar P_FSG_41_0_0_0_3_IntTlgEn
{
       if(getValue(this)) 
       {
           putValue(P_FSG_41_0_0_0_3_SegmEn,0);
           intertelegram_err(FctID_FunctionList);
       }
       else
       {
           intertelegram_err_off(FctID_FunctionList);
       }
}

//MR61529 
on envVar P_FSG_41_0_0_0_3_ErrEn
{
if (getValue(this))
putValue(P_FSG_41_0_0_0_3_FctEn,0);
}

//MR61529 
on envVar P_FSG_41_0_0_0_3_FctEn
{
    long data[3];
    data[0]=LSGID;
    data[1]=FctID_FunctionList;
    data[2]=getValue(this);
    ChangeConfig(0x0031,data);
}

//MR61529 	
//resending BAPconfig when this button is pressed
on envVar P_FSG_41_0_0_0_2Reset_BTN
{
   message 0x100 _mBAPconfig;	

    if (getValue(this))
    {
        //for BAPconfig Set/Reset button
         _mBAPconfig.CAN=1; 
		 _mBAPconfig.ID=0x97332910; 
		 _mBAPconfig.DLC=8; 
                	
         _mBAPconfig.byte(0) = 0x0A;
         _mBAPconfig.byte(1) = 0x42;
         _mBAPconfig.byte(2) = getValue(BAPCFG_FSG_41_0_0_ProtocolMajor);
         _mBAPconfig.byte(3) = getValue(BAPCFG_FSG_41_0_0_ProtocolMinor);
         _mBAPconfig.byte(4) = getValue(BAPCFG_FSG_41_0_0_LsgClassMajor);
         _mBAPconfig.byte(5) = getValue(BAPCFG_FSG_41_0_0_LsgClassMinor);
         _mBAPconfig.byte(6) = getValue(BAPCFG_FSG_41_0_0_DFMajor);
         _mBAPconfig.byte(7) = getValue(BAPCFG_FSG_41_0_0_DFMinor);
      
        output(_mBAPconfig);	
   }
}

// multiple call states handling

on timer MPswapTimer2
 {
   byte i;

//init lokal variables
	gcallID2=0xff;
//********************

	for(i=0;i<7;i++)
  {																//searching for active calls
      		if(gCallState2[i]==active)
        {
      			gcallID2=i;
      			setcallState2(gcallID2,onhold);											//set active call -> on hold
            sendCallStateStatus2();
        }
      		else if(gCallState2[i]==onhold || gCallState2[i]==INCOMING_ON_HOLD)
        {
      			gcallID2=i;
      			setcallState2(gcallID2,active);											//set on Hold call -> Active
            sendCallStateStatus2();
         }
  }
}


sendCallStateStatus2()
{ byte BAPTemp[994];

        P_FSG_41_0_0_30_BuildFct();
        getValue(P_FSG_41_0_0_30, BAPTemp);
        Request_ByteSequence(LSGID, P_FSG_41_0_0_30_ID, Data_REQ, BAPTemp, getValueSize(P_FSG_41_0_0_30));
}






// tel 3 added code

oN timer setcallInfo3
{
     setcallINFO3();
}

on timer setDIALcallState3
{
  setcallState3(gcallID3,3); // SET dial call state for gcallID
  sendCallStateStatus3();
}

on timer disconnectingTimer3
{
  byte BAPTemp[994];
   byte emptyString[1];
   int ID,i;
  
 for(i=0;i<7;i++)
 { 
   if(gCallState3[i]==disconnecting)
    { ID=i;
      setcallState3(ID,0); // set "idle " call state after "disconnecting" state -- Hang up Method
      sendCallStateStatus3();
      break;
    }  
 }
 
  cleancallINFO3(ID);
  cleancallType3(ID); 
}

void cleancallType3(int callID)   //env
{byte BAPTemp[994];
    
   if(callID == 0)
  {
    putValue(P_FSG_41_0_0_43_2,0); // clear call type  - ID 0
  }
   if(callID == 1)
  {
    putValue(P_FSG_41_0_0_43_5,0); //  clear call type - ID 1
  }
   if(callID == 2)
  {
    putValue(P_FSG_41_0_0_43_8,0); //  clear call type - ID 2
  }
   if(callID == 3)
  {
    putValue(P_FSG_41_0_0_43_11,0); //  clear call type - ID 3
  }
   if(callID == 4)
  {
    putValue(P_FSG_41_0_0_43_14,0); //  clear call type - ID 4
  }
   if(callID == 5)
  {
    putValue(P_FSG_41_0_0_43_17,0); //  clear call type - ID 5
  }
   if(callID == 6)
  {
    putValue(P_FSG_41_0_0_43_20,0); //  clear call type - ID 6
  }
  
}

void cleancallINFO3(int callID)  //env
{  
  byte BAPTemp[994];
  byte emptyString[1];
  
   if(callID == 0)
  {
  putvalue(P_FSG_41_0_0_44_2, emptyString,0);  // clear TelNumber0
  putvalue(P_FSG_41_0_0_44_2_len,0);
  putvalue(P_FSG_41_0_0_44_1,emptyString,0);   // clear PbName0
  putvalue(P_FSG_41_0_0_44_1_len,0);
 
  }
    if(callID == 1)
  {
  putvalue(P_FSG_41_0_0_44_5, emptyString,0); // clear TelNumber1
  putvalue(P_FSG_41_0_0_44_5_len,0);
  putvalue(P_FSG_41_0_0_44_4, emptyString,0); // clear PbName1
  putvalue(P_FSG_41_0_0_44_4_len,0);
  }
    if(callID == 2)
  {
  putvalue(P_FSG_41_0_0_44_8, emptyString,0); // clear TelNumber2
  putvalue(P_FSG_41_0_0_44_8_len,0);
  putvalue(P_FSG_41_0_0_44_7, emptyString,0); // clear PbName2
  putvalue(P_FSG_41_0_0_44_7_len,0);
  }
    if(callID == 3)
  {
  putvalue(P_FSG_41_0_0_44_11,emptyString,0); // clear TelNumber3
  putvalue(P_FSG_41_0_0_44_11_len,0);
  putvalue(P_FSG_41_0_0_44_10, emptyString,0);// clear PbName3
  putvalue(P_FSG_41_0_0_44_10_len,0);
  }
    if(callID == 4)
  {
  putvalue(P_FSG_41_0_0_44_14, emptyString,0); // clear TelNumber4
  putvalue(P_FSG_41_0_0_44_14_len,0);
  putvalue(P_FSG_41_0_0_44_13, emptyString,0); // clear PbName4
  putvalue(P_FSG_41_0_0_44_13_len,0);
 
  }
    if(callID == 5)
  {
  putvalue(P_FSG_41_0_0_44_17, emptyString,0); // clear TelNumber5
  putvalue(P_FSG_41_0_0_44_17_len,0);
  putvalue(P_FSG_41_0_0_44_16, emptyString,0); // clear PbName5
  putvalue(P_FSG_41_0_0_44_16_len,0);
  }
    if(callID == 6)
  {
  putvalue(P_FSG_41_0_0_44_20, emptyString,0); // clear TelNumber6
  putvalue(P_FSG_41_0_0_44_20_len,0);
  putvalue(P_FSG_41_0_0_44_19, emptyString,0); // clear PbName6
  putvalue(P_FSG_41_0_0_44_19_len,0);
  }
  
   
    P_FSG_41_0_0_44_BuildFct();
    getValue(P_FSG_41_0_0_44, BAPTemp);
    Request_ByteSequence(LSGID, P_FSG_41_0_0_44_ID, Data_REQ, BAPTemp, getValueSize(P_FSG_41_0_0_44));
}


void setcallINFO3()  // funct
 { byte BAPTemp[994];

     getValue(P_FSG_41_0_0_44, BAPTemp);
    Request_ByteSequence(LSGID, P_FSG_41_0_0_44_ID, Data_REQ, BAPTemp, getValueSize(P_FSG_41_0_0_44));
 }

void setcallState3(int callID, int callState) //env
{byte BAPTemp[994];
     
   if(callID == 0)
  {
    putValue(P_FSG_41_0_0_43_1,callState); // set call state - ID 0
  }
   if(callID == 1)
  {
    putValue(P_FSG_41_0_0_43_4,callState); //  set call state - ID 1
  }
   if(callID == 2)
  {
    putValue(P_FSG_41_0_0_43_7,callState); //  set call state - ID 2
  }
   if(callID == 3)
  {
    putValue(P_FSG_41_0_0_43_10,callState); //  set call state - ID 3
  }
   if(callID == 4)
  {
    putValue(P_FSG_41_0_0_43_13,callState); //  set call state - ID 4
  }
   if(callID == 5)
  {
    putValue(P_FSG_41_0_0_43_16,callState); //  set call state - ID 5
  }
   if(callID == 6)
  {
    putValue(P_FSG_41_0_0_43_19,callState); //  set call state - ID 6
  }
  
    updateCallState3();
    updateCallOptions3(callID, callState); 
   
}

void updateCallOptions3(int callID, int callState) //env
{ int i, activeCallFlag=0, onholdFlag=0; 
  	switch (callState)
					{
						case active:
            onholdFlag=0;
            for(i=0;i<7;i++)
                {	if(gCallState3[i]==onhold) onholdFlag = 1; }
                
				          if(callID == 0)
                  {
                    if( onholdFlag == 1 )
                    @P_FSG_41_0_0_43_3 = 96; //end call & microfon on/off options - by default -> call option MP Swap and CC join set by value 96 : bit 5 = 1 and bit 6 = 1
                    else
                    @P_FSG_41_0_0_43_3 = 8; //end call & microfon on/off options - by default -> call option on hold set by value 8 : bit 3 = 1                
                  }
                  if(callID == 1)
                  {
                   if( onholdFlag == 1 )
                    @P_FSG_41_0_0_43_6 = 96; //end call & microfon on/off options - by default -> call option MP Swap and CC join set by value 96 : bit 5 = 1 and bit 6 = 1
                    else
                    @P_FSG_41_0_0_43_6 = 8; //end call & microfon on/off options - by default -> call option on hold set by value 8 : bit 3 = 1                
                  }
                  if(callID == 2)
                  {
                    if( onholdFlag == 1 )
                    @P_FSG_41_0_0_43_9 = 96; //end call & microfon on/off options - by default -> call option MP Swap and CC join set by value 96 : bit 5 = 1 and bit 6 = 1
                    else
                    @P_FSG_41_0_0_43_9 = 8; //end call & microfon on/off options - by default -> call option on hold set by value 8 : bit 3 = 1                
                  }
                  if(callID == 3)
                  {
                    @P_FSG_41_0_0_43_12 = 8; //end call & microfon on/off options - by default -> call option on hold set by value 8 : bit 3 = 1
                  }
                  if(callID == 4)
                  {
                    if( onholdFlag == 1 )
                    @P_FSG_41_0_0_43_15 = 96; //end call & microfon on/off options - by default -> call option MP Swap and CC join set by value 96 : bit 5 = 1 and bit 6 = 1
                    else
                    @P_FSG_41_0_0_43_15 = 8; //end call & microfon on/off options - by default -> call option on hold set by value 8 : bit 3 = 1                
                  }
                  if(callID == 5)
                  {
                    if( onholdFlag == 1 )
                    @P_FSG_41_0_0_43_18 = 96; //end call & microfon on/off options - by default -> call option MP Swap and CC join set by value 96 : bit 5 = 1 and bit 6 = 1
                    else
                    @P_FSG_41_0_0_43_18 = 8; //end call & microfon on/off options - by default -> call option on hold set by value 8 : bit 3 = 1                
                  }
                  if(callID == 6)
                  {
                    if( onholdFlag == 1 )
                    @P_FSG_41_0_0_43_21 = 96; //end call & microfon on/off options - by default -> call option MP Swap and CC join set by value 96 : bit 5 = 1 and bit 6 = 1
                    else
                    @P_FSG_41_0_0_43_21 = 8; //end call & microfon on/off options - by default -> call option on hold set by value 8 : bit 3 = 1                
                  }
                   
							break;
                  
						case ringing_waiting:
                   activeCallFlag=0;
                   for(i=0;i<7;i++)
                        {	if(gCallState3[i]==active) activeCallFlag = 1; }
                        
                  if(callID == 0)
                  {
                    if( activeCallFlag == 1 )
                    @P_FSG_41_0_0_43_3 = 6; //end call & mute options - by default -> call option MPCallHoldAcceptWAitinCall & MP Release Active Call Accept Waiting call set by value 5 : bit 0 = 1 & bit 2 = 1
                    else     
                    @P_FSG_41_0_0_43_3 = 1; //end call & mute options - by default -> call option accept Call set by value 1 : bit 0 = 1               
                  }
                  if(callID == 1)
                  {
                    if( activeCallFlag == 1 )
                    @P_FSG_41_0_0_43_6 = 6; //end call & mute options - by default -> call option MPCallHoldAcceptWAitinCall & MP Release Active Call Accept Waiting call set by value 5 : bit 0 = 1 & bit 2 = 1
                    else
                    @P_FSG_41_0_0_43_6 = 1; //end call & mute options - by default -> call option accept Call set by value 1 : bit 0 = 1
                  }
                  if(callID == 2)
                  {
                    if( activeCallFlag == 1 )
                    @P_FSG_41_0_0_43_9 = 6; //end call & mute options - by default -> call option MPCallHoldAcceptWAitinCall & MP Release Active Call Accept Waiting call set by value 5 : bit 0 = 1 & bit 2 = 1
                    else
                    @P_FSG_41_0_0_43_9 = 1; //end call & mute options - by default -> call option accept Call set by value 1 : bit 0 = 1
                  }
                  if(callID == 3)
                  {
                     if( activeCallFlag == 1 )
                    @P_FSG_41_0_0_43_12 = 6; //end call & mute options - by default -> call option MPCallHoldAcceptWAitinCall & MP Release Active Call Accept Waiting call set by value 5 : bit 1 = 1 & bit 2 = 1
                    else
                    @P_FSG_41_0_0_43_12 = 1; //end call & mute options - by default -> call option accept Call set by value 1 : bit 0 = 1
                  }
                  if(callID == 4)
                  {
                    if( activeCallFlag == 1 )
                    @P_FSG_41_0_0_43_15 = 6; //end call & mute options - by default -> call option MPCallHoldAcceptWAitinCall & MP Release Active Call Accept Waiting call set by value 5 : bit 1 = 1 & bit 2 = 1
                    else
                    @P_FSG_41_0_0_43_15 = 1; //end call & mute options - by default -> call option accept Call set by value 1 : bit 0 = 1
                  }
                  if(callID == 5)
                  {
                     if( activeCallFlag == 1 )
                    @P_FSG_41_0_0_43_18 = 6; //end call & mute options - by default -> call option MPCallHoldAcceptWAitinCall & MP Release Active Call Accept Waiting call set by value 5 : bit 1 = 1 & bit 2 = 1
                    else
                    @P_FSG_41_0_0_43_18 = 1; //end call & mute options - by default -> call option accept Call set by value 1 : bit 0 = 1
                  }
                    if(callID == 6)
                  {
                     if( activeCallFlag == 1 )
                    @P_FSG_41_0_0_43_21 = 6; //end call & mute options - by default -> call option MPCallHoldAcceptWAitinCall & MP Release Active Call Accept Waiting call set by value 5 : bit 1 = 1 & bit 2 = 1
                    else
                    @P_FSG_41_0_0_43_21 = 1; //end call & mute options - by default -> call option accept Call set by value 1 : bit 0 = 1
                  }
        
							break;
        
						case onhold: 
                  if(callID == 0)
                  {
                     @P_FSG_41_0_0_43_3 = 16; //end call - by default -> call option Resume Call set by value 16 : bit 4 = 1               
                  }
                  if(callID == 1)
                  {
                     @P_FSG_41_0_0_43_6 = 16; //end call - by default -> call option Resume Call set by value 16 : bit 4 = 1 
                  }
                  if(callID == 2)
                  {
                     @P_FSG_41_0_0_43_9 = 16; //end call - by default -> call option Resume Call set by value 16 : bit 4 = 1 
                  }
                  if(callID == 3)
                  {
                    @P_FSG_41_0_0_43_12 = 16; //end call - by default -> call option Resume Call set by value 16 : bit 4 = 1 
                  }
                  if(callID == 4)
                  {
                    @P_FSG_41_0_0_43_15 = 16; //end call - by default -> call option Resume Call set by value 16 : bit 4 = 1 
                  }
                  if(callID == 5)
                  {
                    @P_FSG_41_0_0_43_18 = 16; //end call - by default -> call option Resume Call set by value 16 : bit 4 = 1 
                  }
                    if(callID == 6)
                  {
                    @P_FSG_41_0_0_43_21 = 16; //end call- by default -> call option Resume Call set by value 16 : bit 4 = 1 
                  }
        
							break;
        	
          }
          
              
}



void setcallType3(int callID, int calltype) //env
{byte BAPTemp[994];
    
   if(callID == 0)
  {
    putValue(P_FSG_41_0_0_43_2,calltype); // set call type - ID 0
  }
   if(callID == 1)
  {
    putValue(P_FSG_41_0_0_43_5,calltype); //  set call type - ID 1
  }
   if(callID == 2)
  {
    putValue(P_FSG_41_0_0_43_8,calltype); //  set call type - ID 2
  }
   if(callID == 3)
  {
    putValue(P_FSG_41_0_0_43_11,calltype); //  set call type - ID 3
  }
   if(callID == 4)
  {
    putValue(P_FSG_41_0_0_43_14,calltype); //  set call type - ID 4
  }
   if(callID == 5)
  {
    putValue(P_FSG_41_0_0_43_17,calltype); //  set call type - ID 5
  }
   if(callID == 6)
  {
    putValue(P_FSG_41_0_0_43_20,calltype); //  set call type - ID 6
  }
  
//    P_FSG_41_0_0_43_BuildFct();
//    getValue(P_FSG_41_0_0_43, BAPTemp);
//    Request_ByteSequence(LSGID, P_FSG_41_0_0_43_ID, Data_REQ, BAPTemp, getValueSize(P_FSG_41_0_0_43));                      
  
}


void searchandSetNameNr3(int callID)
{
  int i,j,t,length_name=0,length_number=0;
  byte BAPTemp[994];
  char tempTelNR[40]; 
  char tempName[6];
 
  
  for(i=0; i < Telefon_CombinedNumbers_Length ;i++)
  {  
    if(strstr(Telefon_CombinedNumbers[i].Param5,gDialTelNumber_string3)!=-1) // compare DialedNumber with number stored in combined
     { 
        for(t=0;t<elcount(gDialName_string3);t++) // if number matched clear variables for Name
            	{
                gDialName_string3 [t]=0;
              	gDialName_data3   [t]=0;
              }
       //     ********************
      
     
      for(j=0;j<A_FSG_40_0_0_49_ArrayDataList[i].Param2_length;j++) // if number matched get the Name 
              { //write("gDialName_string=%x",Telefon_CombinedNumbers[i].Param2[j]);
                gDialName_string3[j] = Telefon_CombinedNumbers[i].Param2[j];
////               gDialName_string[j] = Telefon_CombinedNumbers[i].Param2[j];
//             //  snprintf(tempName,elcount(tempName),"%s",Telefon_CombinedNumbers[i].Param2[j]);
//            //    write("tempname=%s",tempName);
                gDialName_data3[j] = A_FSG_40_0_0_49_ArrayDataList[i].Param2[j];
           //     write("gDialName_data=%x",gDialName_data[j]);
              }
      break;
      }
  }
  
 
// write("gDialName_string=%s",gDialName_string);
//  write("Namefound:%s",gDialName_string);
//   write("tempTelNR:%s",Telefon_CombinedNumbers[i].Param5);
//   write("gDialTelNumber:%s",gDialTelNumber_string);

  if(j==0) // if tel number not found get Name from Methods panel // if Name is empty - length == 0 --> set only tel Number
   length_name = strlen (gDialName_string3) ;
  else
  length_name=j;
  
   write("length_name:%d",length_name);
  length_number=strlen(gDialTelNumber_string3);
  write("length_number:%d",length_number);
  
   if(callID == 0)
  {
  putvalue(P_FSG_41_0_0_44_2, gDialTelNumber_data3,length_number); //TelNumber0
  putvalue(P_FSG_41_0_0_44_1, gDialName_data3,length_name); //PbName0
 
  }
    if(callID == 1)
  {
  putvalue(P_FSG_41_0_0_44_5, gDialTelNumber_data3,length_number); //TelNumber1
  putvalue(P_FSG_41_0_0_44_4, gDialName_data3,length_name); //PbName1 
  }
    if(callID == 2)
  {
  putvalue(P_FSG_41_0_0_44_8, gDialTelNumber_data3,length_number); //TelNumber2
  putvalue(P_FSG_41_0_0_44_7, gDialName_data3,length_name); //PbName2
  }
    if(callID == 3)
  {
  putvalue(P_FSG_41_0_0_44_11, gDialTelNumber_data3,length_number); //TelNumber3
  putvalue(P_FSG_41_0_0_44_10, gDialName_data3,length_name); //PbName3
  }
    if(callID == 4)
  {
  putvalue(P_FSG_41_0_0_44_14, gDialTelNumber_data3,length_number); //TelNumber4 
  putvalue(P_FSG_41_0_0_44_13, gDialName_data3,length_name); //PbName4
  }
    if(callID == 5)
  {
  putvalue(P_FSG_41_0_0_44_17, gDialTelNumber_data3,length_number); //TelNumber5
  putvalue(P_FSG_41_0_0_44_16, gDialName_data3,length_name); //PbName5
  }
    if(callID == 6)
  {
  putvalue(P_FSG_41_0_0_44_20, gDialTelNumber_data3,length_number); //TelNumber6
  putvalue(P_FSG_41_0_0_44_19, gDialName_data3,length_name); //PbName6
  }
  
   P_FSG_41_0_0_44_BuildFct();
   settimer(setcallInfo3,1);
  
  
}


void updateCallState3() //env
{
     gCallState3[0] = @P_FSG_41_0_0_43_1; //  call state - ID 0
     gCallState3[1] = @P_FSG_41_0_0_43_4; //  call state - ID 1
     gCallState3[2] = @P_FSG_41_0_0_43_7; //  call state - ID 2
     gCallState3[3] = @P_FSG_41_0_0_43_10; // call state - ID 3
     gCallState3[4] = @P_FSG_41_0_0_43_13; // call state - ID 4
     gCallState3[5] = @P_FSG_41_0_0_43_16; // call state - ID 5  
     gCallState3[6] = @P_FSG_41_0_0_43_19; // call state - ID 6
}


int searchFREEcallID3 (byte event)
{
  int i, finish, freecallstate;

  //init lokal variables
	finish=0;
	freecallstate=0xff;
//********************

 if (event == ringing_waiting)
{	  for(i=0;finish!=1;i++)
      {								//check status of each callID
					switch(gCallState3 [i])
          {
						case idle:
							if(freecallstate==0xff)
								freecallstate=i;
						break;
              
//            case active: // active allowed for short time  /// -update in ticket GVBA-11140
//              setcallState(i,onhold);
//              break;
              
            case ringing_waiting:
							freecallstate=0xff;						//no incoming call possible
							finish=1;								//loop finished
						break;
              
						case dialing:
							freecallstate=0xff;						//no incoming call possible
							finish=1;								//loop finished
						break;
              
						case disconnecting:
							freecallstate=0xff;						//no incoming call  possible
							finish=1;								//loop finished
						break;
              
						default:
						break;
					}
					if (i==6 && finish==0)							//last element is reached and loop in't finished yet
						finish=1;									//loop finished
				}
}


if(event == dialing)
{   for(i=0;finish!=1;i++)
      {								//check status of each callID
					switch(gCallState3 [i])
          {
						case idle:
							if(freecallstate==0xff)
								freecallstate=i;
						break;
              
						case onhold:
						break;
              
            case INCOMING_ON_HOLD:
            break;
              
            case active: // active allowed for short time
              setcallState3(i,onhold);
              sendCallStateStatus3();
              break;
              
              default:									//one callID status is "dialing/disconnecting" // active allowed for short time
							freecallstate=0xff;						//no dialing possible
							finish=1;								//loop finished
						break;
					}
					if (i==6 && finish==0)							//last element is reached and loop in't finished yet
						finish=1;									//loop finished
				}
}
 		
return(freecallstate);
		
}

byte check_hangup3 (byte call_id)	//check, if in this call state hang up is possible (0=impossible, 1=possible)
{
byte hangup;

//init lokal variables
	hangup=0;
//********************


	switch(gCallState3[call_id])
	{
				case ringing_waiting:
					hangup=TRUE;
				break;
				case active:
					hangup=TRUE;
				break;
				case dialing:
					hangup=TRUE;
				break;
				case onhold:
					hangup=TRUE;
				break;
        case INCOMING_ON_HOLD:
					hangup=TRUE;
				break;
				default:	//hangup is impossible in this state 
					hangup=0;
				break;
	}
			
	return(hangup);

}

on timer disconnectingTimer_Methods3
{
  byte BAPTemp[994];
  byte emptyString[1];
  int i;
  
  for(i=0; i<7 ; i++)
  {
    if(gCallState3[i]==disconnecting)
    {   gcallID3 = i;
        setcallState3(gcallID3,0); // set "idle " call state after "disconnecting" state -- Hang up Method
        sendCallStateStatus3();
        
        cleancallINFO3(gcallID3);
        cleancallType3(gcallID3); 
    }
  }
}

sendCallStateStatus3() //func
{ byte BAPTemp[994];

        P_FSG_41_0_0_43_BuildFct();
        getValue(P_FSG_41_0_0_43, BAPTemp);
        Request_ByteSequence(LSGID, P_FSG_41_0_0_43_ID, Data_REQ, BAPTemp, getValueSize(P_FSG_41_0_0_43));
}

// multiple call states handling

on timer MPswapTimer3
 {
   byte i;

//init lokal variables
	gcallID3=0xff;
//********************

	for(i=0;i<7;i++)
  {																//searching for active calls
      		if(gCallState3[i]==active)
        {
      			gcallID3=i;
      			setcallState3(gcallID3,onhold);											//set active call -> on hold
            sendCallStateStatus3();
        }
      		else if(gCallState3[i]==onhold || gCallState3[i]==INCOMING_ON_HOLD)
        {
      			gcallID3=i;
      			setcallState3(gcallID3,active);											//set on Hold call -> Active
            sendCallStateStatus3();
         }
  }
}

byte check_hangup2 (byte call_id)	//check, if in this call state hang up is possible (0=impossible, 1=possible)
{
byte hangup;

//init lokal variables
	hangup=0;
//********************


	switch(gCallState2[call_id])
	{
				case ringing_waiting:
					hangup=TRUE;
				break;
				case active:
					hangup=TRUE;
				break;
				case dialing:
					hangup=TRUE;
				break;
				case onhold:
					hangup=TRUE;
				break;
        case INCOMING_ON_HOLD:
					hangup=TRUE;
				break;
				default:	//hangup is impossible in this state 
					hangup=0;
				break;
	}
			
	return(hangup);

}

on timer disconnectingTimer_Methods2
{
  byte BAPTemp[994];
  byte emptyString[1];
  int i;
  
  for(i=0; i<7 ; i++)
  {
    if(gCallState2[i]==disconnecting)
    {   gcallID2 = i;
        setcallState2(gcallID2,0); // set "idle " call state after "disconnecting" state -- Hang up Method
        sendCallStateStatus2();
        
        cleancallINFO2(gcallID2);
        cleancallType2(gcallID2); 
    }
  }
}

// tel 2 added code

oN timer setcallInfo2
{
     setcallINFO2();
}

on timer setDIALcallState2
{
  setcallState2(gcallID2,3); // SET dial call state for gcallID
  sendCallStateStatus2();
}

on timer disconnectingTimer2
{
  byte BAPTemp[994];
   byte emptyString[1];
   int ID,i;
  
 for(i=0;i<7;i++)
 { 
   if(gCallState2[i]==disconnecting)
    { ID=i;
      setcallState2(ID,0); // set "idle " call state after "disconnecting" state -- Hang up Method
      sendCallStateStatus2();
      break;
    }  
 }
 
  cleancallINFO2(ID);
  cleancallType2(ID); 
}

void cleancallType2(int callID)   
{byte BAPTemp[994];
    
   if(callID == 0)
  {
    putValue(P_FSG_41_0_0_30_2,0); // clear call type  - ID 0
  }
   if(callID == 1)
  {
    putValue(P_FSG_41_0_0_30_5,0); //  clear call type - ID 1
  }
   if(callID == 2)
  {
    putValue(P_FSG_41_0_0_30_8,0); //  clear call type - ID 2
  }
   if(callID == 3)
  {
    putValue(P_FSG_41_0_0_30_11,0); //  clear call type - ID 3
  }
   if(callID == 4)
  {
    putValue(P_FSG_41_0_0_30_14,0); //  clear call type - ID 4
  }
   if(callID == 5)
  {
    putValue(P_FSG_41_0_0_30_17,0); //  clear call type - ID 5
  }
   if(callID == 6)
  {
    putValue(P_FSG_41_0_0_30_20,0); //  clear call type - ID 6
  }
  
}

void cleancallINFO2(int gcallID) 
{  
  byte BAPTemp[994];
  byte emptyString[1];
  
   if(gcallID == 0)
  {
  putvalue(P_FSG_41_0_0_31_2, emptyString,0);  // clear TelNumber0
  putvalue(P_FSG_41_0_0_31_2_len,0);
  putvalue(P_FSG_41_0_0_31_1,emptyString,0);   // clear PbName0
  putvalue(P_FSG_41_0_0_31_1_len,0);
 
  }
    if(gcallID == 1)
  {
  putvalue(P_FSG_41_0_0_31_5, emptyString,0); // clear TelNumber1
  putvalue(P_FSG_41_0_0_31_5_len,0);
  putvalue(P_FSG_41_0_0_31_4, emptyString,0); // clear PbName1
  putvalue(P_FSG_41_0_0_31_4_len,0);
  }
    if(gcallID == 2)
  {
  putvalue(P_FSG_41_0_0_31_8, emptyString,0); // clear TelNumber2
  putvalue(P_FSG_41_0_0_31_8_len,0);
  putvalue(P_FSG_41_0_0_31_7, emptyString,0); // clear PbName2
  putvalue(P_FSG_41_0_0_31_7_len,0);
  }
    if(gcallID == 3)
  {
  putvalue(P_FSG_41_0_0_31_11,emptyString,0); // clear TelNumber3
  putvalue(P_FSG_41_0_0_31_11_len,0);
  putvalue(P_FSG_41_0_0_31_10, emptyString,0);// clear PbName3
  putvalue(P_FSG_41_0_0_31_10_len,0);
  }
    if(gcallID == 4)
  {
  putvalue(P_FSG_41_0_0_31_14, emptyString,0); // clear TelNumber4
  putvalue(P_FSG_41_0_0_31_14_len,0);
  putvalue(P_FSG_41_0_0_31_13, emptyString,0); // clear PbName4
  putvalue(P_FSG_41_0_0_31_13_len,0);
 
  }
    if(gcallID == 5)
  {
  putvalue(P_FSG_41_0_0_31_17, emptyString,0); // clear TelNumber5
  putvalue(P_FSG_41_0_0_31_17_len,0);
  putvalue(P_FSG_41_0_0_31_16, emptyString,0); // clear PbName5
  putvalue(P_FSG_41_0_0_31_16_len,0);
  }
    if(gcallID == 6)
  {
  putvalue(P_FSG_41_0_0_31_20, emptyString,0); // clear TelNumber6
  putvalue(P_FSG_41_0_0_31_20_len,0);
  putvalue(P_FSG_41_0_0_31_19, emptyString,0); // clear PbName6
  putvalue(P_FSG_41_0_0_31_19_len,0);
  }
  
   
    P_FSG_41_0_0_31_BuildFct();
    getValue(P_FSG_41_0_0_31, BAPTemp);
    Request_ByteSequence(LSGID, P_FSG_41_0_0_31_ID, Data_REQ, BAPTemp, getValueSize(P_FSG_41_0_0_31));
}


void setcallINFO2()
 { byte BAPTemp[994];

     getValue(P_FSG_41_0_0_31, BAPTemp);
    Request_ByteSequence(LSGID, P_FSG_41_0_0_31_ID, Data_REQ, BAPTemp, getValueSize(P_FSG_41_0_0_31));
 }

void setcallState2(int callID, int callState) 
{byte BAPTemp[994];
     
   if(callID == 0)
  {
    putValue(P_FSG_41_0_0_30_1,callState); // set call state - ID 0
  }
   if(callID == 1)
  {
    putValue(P_FSG_41_0_0_30_4,callState); //  set call state - ID 1
  }
   if(callID == 2)
  {
    putValue(P_FSG_41_0_0_30_7,callState); //  set call state - ID 2
  }
   if(callID == 3)
  {
    putValue(P_FSG_41_0_0_30_10,callState); //  set call state - ID 3
  }
   if(callID == 4)
  {
    putValue(P_FSG_41_0_0_30_13,callState); //  set call state - ID 4
  }
   if(callID == 5)
  {
    putValue(P_FSG_41_0_0_30_16,callState); //  set call state - ID 5
  }
   if(callID == 6)
  {
    putValue(P_FSG_41_0_0_30_19,callState); //  set call state - ID 6
  }
  
    updateCallState2();
    updateCallOptions2(callID, callState); 
   
}

void updateCallOptions2(int callID, int callState) 
{ int i, activeCallFlag=0, onholdFlag=0; 
  	switch (callState)
					{
						case active:
            onholdFlag=0;
            for(i=0;i<7;i++)
                {	if(gCallState2[i]==onhold) onholdFlag = 1; }
                
				          if(callID == 0)
                  {
                    if( onholdFlag == 1 )
                    @P_FSG_41_0_0_30_3 = 96; //end call & microfon on/off options - by default -> call option MP Swap and CC join set by value 96 : bit 5 = 1 and bit 6 = 1
                    else
                    @P_FSG_41_0_0_30_3 = 8; //end call & microfon on/off options - by default -> call option on hold set by value 8 : bit 3 = 1                
                  }
                  if(callID == 1)
                  {
                   if( onholdFlag == 1 )
                    @P_FSG_41_0_0_30_6 = 96; //end call & microfon on/off options - by default -> call option MP Swap and CC join set by value 96 : bit 5 = 1 and bit 6 = 1
                    else
                    @P_FSG_41_0_0_30_6 = 8; //end call & microfon on/off options - by default -> call option on hold set by value 8 : bit 3 = 1                
                  }
                  if(callID == 2)
                  {
                    if( onholdFlag == 1 )
                    @P_FSG_41_0_0_30_9 = 96; //end call & microfon on/off options - by default -> call option MP Swap and CC join set by value 96 : bit 5 = 1 and bit 6 = 1
                    else
                    @P_FSG_41_0_0_30_9 = 8; //end call & microfon on/off options - by default -> call option on hold set by value 8 : bit 3 = 1                
                  }
                  if(callID == 3)
                  {
                    @P_FSG_41_0_0_30_12 = 8; //end call & microfon on/off options - by default -> call option on hold set by value 8 : bit 3 = 1
                  }
                  if(callID == 4)
                  {
                    if( onholdFlag == 1 )
                    @P_FSG_41_0_0_30_15 = 96; //end call & microfon on/off options - by default -> call option MP Swap and CC join set by value 96 : bit 5 = 1 and bit 6 = 1
                    else
                    @P_FSG_41_0_0_30_15 = 8; //end call & microfon on/off options - by default -> call option on hold set by value 8 : bit 3 = 1                
                  }
                  if(callID == 5)
                  {
                    if( onholdFlag == 1 )
                    @P_FSG_41_0_0_30_18 = 96; //end call & microfon on/off options - by default -> call option MP Swap and CC join set by value 96 : bit 5 = 1 and bit 6 = 1
                    else
                    @P_FSG_41_0_0_30_18 = 8; //end call & microfon on/off options - by default -> call option on hold set by value 8 : bit 3 = 1                
                  }
                  if(callID == 6)
                  {
                    if( onholdFlag == 1 )
                    @P_FSG_41_0_0_30_21 = 96; //end call & microfon on/off options - by default -> call option MP Swap and CC join set by value 96 : bit 5 = 1 and bit 6 = 1
                    else
                    @P_FSG_41_0_0_30_21 = 8; //end call & microfon on/off options - by default -> call option on hold set by value 8 : bit 3 = 1                
                  }
                   
							break;
                  
						case ringing_waiting:
                   activeCallFlag=0;
                   for(i=0;i<7;i++)
                        {	if(gCallState2[i]==active) activeCallFlag = 1; }
                        
                  if(callID == 0)
                  {
                    if( activeCallFlag == 1 )
                    @P_FSG_41_0_0_30_3 = 6; //end call & mute options - by default -> call option MPCallHoldAcceptWAitinCall & MP Release Active Call Accept Waiting call set by value 5 : bit 0 = 1 & bit 2 = 1
                    else     
                    @P_FSG_41_0_0_30_3 = 1; //end call & mute options - by default -> call option accept Call set by value 1 : bit 0 = 1               
                  }
                  if(callID == 1)
                  {
                    if( activeCallFlag == 1 )
                    @P_FSG_41_0_0_30_6 = 6; //end call & mute options - by default -> call option MPCallHoldAcceptWAitinCall & MP Release Active Call Accept Waiting call set by value 5 : bit 0 = 1 & bit 2 = 1
                    else
                    @P_FSG_41_0_0_30_6 = 1; //end call & mute options - by default -> call option accept Call set by value 1 : bit 0 = 1
                  }
                  if(callID == 2)
                  {
                    if( activeCallFlag == 1 )
                    @P_FSG_41_0_0_30_9 = 6; //end call & mute options - by default -> call option MPCallHoldAcceptWAitinCall & MP Release Active Call Accept Waiting call set by value 5 : bit 0 = 1 & bit 2 = 1
                    else
                    @P_FSG_41_0_0_30_9 = 1; //end call & mute options - by default -> call option accept Call set by value 1 : bit 0 = 1
                  }
                  if(callID == 3)
                  {
                     if( activeCallFlag == 1 )
                    @P_FSG_41_0_0_30_12 = 6; //end call & mute options - by default -> call option MPCallHoldAcceptWAitinCall & MP Release Active Call Accept Waiting call set by value 5 : bit 1 = 1 & bit 2 = 1
                    else
                    @P_FSG_41_0_0_30_12 = 1; //end call & mute options - by default -> call option accept Call set by value 1 : bit 0 = 1
                  }
                  if(callID == 4)
                  {
                    if( activeCallFlag == 1 )
                    @P_FSG_41_0_0_30_15 = 6; //end call & mute options - by default -> call option MPCallHoldAcceptWAitinCall & MP Release Active Call Accept Waiting call set by value 5 : bit 1 = 1 & bit 2 = 1
                    else
                    @P_FSG_41_0_0_30_15 = 1; //end call & mute options - by default -> call option accept Call set by value 1 : bit 0 = 1
                  }
                  if(callID == 5)
                  {
                     if( activeCallFlag == 1 )
                    @P_FSG_41_0_0_30_18 = 6; //end call & mute options - by default -> call option MPCallHoldAcceptWAitinCall & MP Release Active Call Accept Waiting call set by value 5 : bit 1 = 1 & bit 2 = 1
                    else
                    @P_FSG_41_0_0_30_18 = 1; //end call & mute options - by default -> call option accept Call set by value 1 : bit 0 = 1
                  }
                    if(callID == 6)
                  {
                     if( activeCallFlag == 1 )
                    @P_FSG_41_0_0_30_21 = 6; //end call & mute options - by default -> call option MPCallHoldAcceptWAitinCall & MP Release Active Call Accept Waiting call set by value 5 : bit 1 = 1 & bit 2 = 1
                    else
                    @P_FSG_41_0_0_30_21 = 1; //end call & mute options - by default -> call option accept Call set by value 1 : bit 0 = 1
                  }
        
							break;
        
						case onhold: 
                  if(callID == 0)
                  {
                     @P_FSG_41_0_0_30_3 = 16; //end call - by default -> call option Resume Call set by value 16 : bit 4 = 1               
                  }
                  if(callID == 1)
                  {
                     @P_FSG_41_0_0_30_6 = 16; //end call - by default -> call option Resume Call set by value 16 : bit 4 = 1 
                  }
                  if(callID == 2)
                  {
                     @P_FSG_41_0_0_30_9 = 16; //end call - by default -> call option Resume Call set by value 16 : bit 4 = 1 
                  }
                  if(callID == 3)
                  {
                    @P_FSG_41_0_0_30_12 = 16; //end call - by default -> call option Resume Call set by value 16 : bit 4 = 1 
                  }
                  if(callID == 4)
                  {
                    @P_FSG_41_0_0_30_15 = 16; //end call - by default -> call option Resume Call set by value 16 : bit 4 = 1 
                  }
                  if(callID == 5)
                  {
                    @P_FSG_41_0_0_30_18 = 16; //end call - by default -> call option Resume Call set by value 16 : bit 4 = 1 
                  }
                    if(callID == 6)
                  {
                    @P_FSG_41_0_0_30_21 = 16; //end call- by default -> call option Resume Call set by value 16 : bit 4 = 1 
                  }
        
							break;
        	
          }
          
              
}



void setcallType2(int callID, int calltype) 
{byte BAPTemp[994];
    
   if(callID == 0)
  {
    putValue(P_FSG_41_0_0_30_2,calltype); // set call type - ID 0
  }
   if(callID == 1)
  {
    putValue(P_FSG_41_0_0_30_5,calltype); //  set call type - ID 1
  }
   if(callID == 2)
  {
    putValue(P_FSG_41_0_0_30_8,calltype); //  set call type - ID 2
  }
   if(callID == 3)
  {
    putValue(P_FSG_41_0_0_30_11,calltype); //  set call type - ID 3
  }
   if(callID == 4)
  {
    putValue(P_FSG_41_0_0_30_14,calltype); //  set call type - ID 4
  }
   if(callID == 5)
  {
    putValue(P_FSG_41_0_0_30_17,calltype); //  set call type - ID 5
  }
   if(callID == 6)
  {
    putValue(P_FSG_41_0_0_30_20,calltype); //  set call type - ID 6
  }
  
//    P_FSG_41_0_0_30_BuildFct();
//    getValue(P_FSG_41_0_0_30, BAPTemp);
//    Request_ByteSequence(LSGID, P_FSG_41_0_0_30_ID, Data_REQ, BAPTemp, getValueSize(P_FSG_41_0_0_30));                      
  
}

//
void searchandSetNameNr2(int callID)
{
  int i,j,t,length_name=0,length_number=0;
  byte BAPTemp[994];
  char tempTelNR[40]; 
  char tempName[6];
 
  
  for(i=0; i < Telefon_CombinedNumbers_Length ;i++)
  {  
    if(strstr(Telefon_CombinedNumbers[i].Param5,gDialTelNumber_string2)!=-1) // compare DialedNumber with number stored in combined
     { 
        for(t=0;t<elcount(gDialName_string2);t++) // if number matched clear variables for Name
            	{
                gDialName_string2 [t]=0;
              	gDialName_data2   [t]=0;
              }
       //     ********************
      
     
      for(j=0;j<A_FSG_40_0_0_49_ArrayDataList[i].Param2_length;j++) // if number matched get the Name 
              { //write("gDialName_string=%x",Telefon_CombinedNumbers[i].Param2[j]);
                gDialName_string2[j] = Telefon_CombinedNumbers[i].Param2[j];
////               gDialName_string[j] = Telefon_CombinedNumbers[i].Param2[j];
//             //  snprintf(tempName,elcount(tempName),"%s",Telefon_CombinedNumbers[i].Param2[j]);
//            //    write("tempname=%s",tempName);
                gDialName_data2[j] = A_FSG_40_0_0_49_ArrayDataList[i].Param2[j];
           //     write("gDialName_data=%x",gDialName_data[j]);
              }
      break;
      }
  }
  
 
// write("gDialName_string=%s",gDialName_string);
//  write("Namefound:%s",gDialName_string);
//   write("tempTelNR:%s",Telefon_CombinedNumbers[i].Param5);
//   write("gDialTelNumber:%s",gDialTelNumber_string);

  if(j==0) // if tel number not found get Name from Methods panel // if Name is empty - length == 0 --> set only tel Number
   length_name = strlen (gDialName_string2) ;
  else
  length_name=j;
  
   write("length_name:%d",length_name);
  length_number=strlen(gDialTelNumber_string2);
  write("length_number:%d",length_number);
  
   if(callID == 0)
  {
  putvalue(P_FSG_41_0_0_31_2, gDialTelNumber_data2,length_number); //TelNumber0
  putvalue(P_FSG_41_0_0_31_1, gDialName_data2,length_name); //PbName0
 
  }
    if(callID == 1)
  {
  putvalue(P_FSG_41_0_0_31_5, gDialTelNumber_data2,length_number); //TelNumber1
  putvalue(P_FSG_41_0_0_31_4, gDialName_data2,length_name); //PbName1 
  }
    if(callID == 2)
  {
  putvalue(P_FSG_41_0_0_31_8, gDialTelNumber_data2,length_number); //TelNumber2
  putvalue(P_FSG_41_0_0_31_7, gDialName_data2,length_name); //PbName2
  }
    if(callID == 3)
  {
  putvalue(P_FSG_41_0_0_31_11, gDialTelNumber_data2,length_number); //TelNumber3
  putvalue(P_FSG_41_0_0_31_10, gDialName_data2,length_name); //PbName3
  }
    if(callID == 4)
  {
  putvalue(P_FSG_41_0_0_31_14, gDialTelNumber_data2,length_number); //TelNumber4 
  putvalue(P_FSG_41_0_0_31_13, gDialName_data2,length_name); //PbName4
  }
    if(callID == 5)
  {
  putvalue(P_FSG_41_0_0_31_17, gDialTelNumber_data2,length_number); //TelNumber5
  putvalue(P_FSG_41_0_0_31_16, gDialName_data2,length_name); //PbName5
  }
    if(callID == 6)
  {
  putvalue(P_FSG_41_0_0_31_20, gDialTelNumber_data2,length_number); //TelNumber6
  putvalue(P_FSG_41_0_0_31_19, gDialName_data2,length_name); //PbName6
  }
  
   P_FSG_41_0_0_31_BuildFct();
   settimer(setcallInfo2,1);
  
  
}


void updateCallState2() 
{
     gCallState2[0] = @P_FSG_41_0_0_30_1; //  call state - ID 0
     gCallState2[1] = @P_FSG_41_0_0_30_4; //  call state - ID 1
     gCallState2[2] = @P_FSG_41_0_0_30_7; //  call state - ID 2
     gCallState2[3] = @P_FSG_41_0_0_30_10; // call state - ID 3
     gCallState2[4] = @P_FSG_41_0_0_30_13; // call state - ID 4
     gCallState2[5] = @P_FSG_41_0_0_30_16; // call state - ID 5  
     gCallState2[6] = @P_FSG_41_0_0_30_19; // call state - ID 6
}

int tel_number_valid (char tel_number [], byte length)
{

  int valid, i;

  //init lokal variables
	i=0;
	valid=1;
  //********************

	for (i=0; i<length; ++i)
  {
		switch(tel_number [i])
    {
			case '0': break;
			case '1': break;
			case '2':	break;
			case '3': break;
			case '4': break;
			case '5':	break;
			case '6':	break;
			case '7':	break;
			case '8':	break;
			case '9':	break;
			case '+':
				if(i!=0)
					valid = 0;	
			  break;
			case '*':	break;
			case '#': break;
      case 'p': break;
      case 'w': break;
			default:
				valid = 0;
			  break;
		}
	}

	return valid;

}


int searchFREEcallID2 (byte event)
{
  int i, finish, freecallstate;

  //init lokal variables
	finish=0;
	freecallstate=0xff;
//********************

 if (event == ringing_waiting)
{	  for(i=0;finish!=1;i++)
      {								//check status of each callID
					switch(gCallState2 [i])
          {
						case idle:
							if(freecallstate==0xff)
								freecallstate=i;
						break;
              
//            case active: // active allowed for short time  /// -update in ticket GVBA-11140
//              setcallState(i,onhold);
//              break;
              
            case ringing_waiting:
							freecallstate=0xff;						//no incoming call possible
							finish=1;								//loop finished
						break;
              
						case dialing:
							freecallstate=0xff;						//no incoming call possible
							finish=1;								//loop finished
						break;
              
						case disconnecting:
							freecallstate=0xff;						//no incoming call  possible
							finish=1;								//loop finished
						break;
              
						default:
						break;
					}
					if (i==6 && finish==0)							//last element is reached and loop in't finished yet
						finish=1;									//loop finished
				}
}


if(event == dialing)
{   for(i=0;finish!=1;i++)
      {								//check status of each callID
					switch(gCallState2 [i])
          {
						case idle:
							if(freecallstate==0xff)
								freecallstate=i;
						break;
              
						case onhold:
						break;
              
            case INCOMING_ON_HOLD:
            break;
              
            case active: // active allowed for short time
              setcallState2(i,onhold);
              sendCallStateStatus2();
              break;
              
              default:									//one callID status is "dialing/disconnecting" // active allowed for short time
							freecallstate=0xff;						//no dialing possible
							finish=1;								//loop finished
						break;
					}
					if (i==6 && finish==0)							//last element is reached and loop in't finished yet
						finish=1;									//loop finished
				}
}
 		
return(freecallstate);
		
}

