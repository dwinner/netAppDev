/*@!Encoding:1252*/
/*
Copyright ( C ) Continental AG 2012



Based on Version  1.0, 12.05.10   from M.Dangelmeyr      IBD im Auftrag von EP/ESE   Daimler AG

Date of creation :  14.04.2011

Created by :                 Hans Jürgen Hipp


Version info

1.0	   10.2013	Inital versioning introduced
1.1	   10.2014	RoSi inserted commands for Sound

*/


variables
{
    timer KL15_ON_OFF;
    byte x = 0x00; 
    byte number;
    byte initial_white  = 0x00;
    byte initial_red    = 0x00;
    byte initial_OFF    = 0x00;
      
  
    const byte FALSE =     0;
    const byte TRUE =      1;
    const byte cInactiv =  0;
    const byte cActiv =    1;

// Project selector
    const byte cKI_W222 =  4;
    const byte cKI_W205 =  6;
    const byte cKI_W217 = 11;
    const byte cKI_W213_EL = 13;
    const byte cKI_W213_HL = 77; //64+13;
    const byte cKI_W447 = 38;
    const byte cKI_W253 = 39;
    
    const byte cKI_VS30_EL = 44;//BR907
    const byte cKI_VS30_HL = 45;//BR910

// Sequencer
    word wQueue[256];
    byte bQueueActPos = 1;
    byte bQueueLastCommand = 1;
    byte bQueueWaitForResponce;


    const byte SessionLevel0 =   1;
    const byte SessionLevel1 =   2;
    const byte SessionLevel2 =   3;
    const byte SessionLevel3 = 112;
    const byte SessionLevel4 = 113;

    const byte SecurityLevel0 =  1;
    const byte SecurityLevel1 =  3;
    const byte SecurityLevel2 =  7;
    const byte SecurityLevel3 = 97;

    char cGlobalFileName[256];
    char cGlobalFilePath[256];

//Grundeinstellungen
    const byte cFUNCTIONAL = 0;
    const byte cPHYSICAL   = 1;
    byte      ServicePhys   = 1;          // Send Service PHYSICAL (1) or FUNCTIONAL (0)
    byte      SessionPhys   = 1;          // Send Session PHYSICAL (1) or FUNCTIONAL (0)

    int       DiagnoseAktiv = 0;           // Diagnode Aktiv Ja(1) oder Nein (0)
    long    TempECU = 0; //Steuergerät zwischenspeichern

    msTimer tTesterPresentTimer;     // Timer für TesterPresent
    int     TesterPresentTime = 2000;
    int     FirstTesterPresentTime = 20;
    byte    TesterPresentPhysFkt = cFUNCTIONAL;

    msTimer TimeOutTimer;               // Timer für TimeOUT
    int     TimeOut     =  500;
    int     TimeOutMid  = 1500;
    int     TimeOutLong = 2500;

    msTimer tEMCTimer;               // Timer für EMC-Messungen
    Timer tLoggingTimer;               // Timer für Temperature logging
    int       AktuellerFehler = 0;
    int       AnzahlFehler;                    // Fehleranzahl aus Botschaft
    int       AnzahlGelesenerFehler;
    dword     errorDTC[256];
    byte      errorStatus[256];

    byte      rqBuf[1024] ;                    // Sende-Buffer (1024 Byte )
    byte      rsBuf[1024] ;                    // Empfangs-Buffer (1024 Byte )
    byte      cleardata[10];                    // Dummy, zum Löschen der Anzeige des Sende- und EmpfangsBuffers

    long      BufferAnzahl  = 0;          // Anzahl der Bytes zum Senden
    long      EmpfangAnzahl = 0;          // Menge der empfangenen Bytes
    word      DiagAktion = 0;               // DiagAktion auf 0 setzen
    int       DiagSchreibAktion;          // Aktion für S-lesen, I/O Contr. und Man Bef.
    long      hilf;                   // HilfsZeiger

    int ECUReqId[10] = {
        0x000,     // dummy ( kein Steuergerät gewählt )
        0x642, // HUD
        0x641, // IC
        0x643, // NV
        0x645, // ORC
        0x640, // RBTM_FL
        0x647, // RBTM_FR
        0x644, // RVC
        0x638, // TGW
        0x652  // TPM

    };
    int ECUResId[10] = {
        0x000,     // dummy ( kein Steuergerät gewählt )
        0x5C2, // HUD
        0x5C1, // IC
        0x5C3, // NV
        0x5C5, // ORC
        0x5C0, // RBTM_FL
        0x5C7, // RBTM_FR
        0x5C4, // RVC
        0x5B8, // TGW
        0x5D2  // TPM
    };

    //*****************************************************************************************
    // Diagnose für Empfangs- und Sende-Buffer aktivieren(1) und deaktivieren(0)

    byte    Buf_Diag = 0;                    // Diagnose der Buffer aktivieren
    byte    FuncEmpfang = 0;               // Funktionaler Empfang aktiv (1) oder deaktiv (0)
    byte    PortDataHi[1];
    byte    PortDataLo[1];
    Byte    PortDirHi[1];
    byte    PortDirLo[1];
    char    PortDirStrHi[8];
    char    PortDirStrLo_0[2];
    char    PortDirStrLo_1[2];
    char    PortDirStrLo_2[2];
    char    PortDirStrLo_3[2];
    char    PortDirStrLo_4[2];
    char    PortDirStrLo_5[2];
    char    PortDirStrLo_6[2];
    char    PortDirStrLo_7[2];
    char    PortDirStrHi_0[2];
    char    PortDirStrHi_1[2];
    char    PortDirStrHi_2[2];
    char    PortDirStrHi_3[2];
    char    PortDirStrHi_4[2];
    char    PortDirStrHi_5[2];
    char    PortDirStrHi_6[2];
    char    PortDirStrHi_7[2];
    long    aux[16];
    byte    DutyCycleHi[1];
    byte    DutyCycleLo[1];
    mstimer tGPIO_CyclicReadSwitch;
    byte    bGPIOCyclicCounter = 0;
    
    const byte bGPIO_Read   = 0;
    const byte bGPIO_Write  = 1;//not available
    const byte bADC_Read    = 2;
    const byte bADC_Write   = 3;//not used
    const byte bPWM_Read    = 4;
    const byte bPWM_Write   = 5;//not used
    
    const word cService_Routine_EnableNormalCom =                        2;
    const word cService_Routine_EnableNormalComFkt =                     3;
    const word cService_Routine_EnableNormalComPhys =                    4;
    const word cService_Routine_DisableNormalCom =                       5;
    const word cService_Routine_DisableNormalComFkt =                    6;
    const word cService_Routine_DisableNormalComPhys =                   7;
    const word cService_Routine_HardReset =                             26;
    const word cService_Routine_HardResetPhys =                         27;
    const word cService_Routine_HardResetFkt =                          28;

    const word cService_Routine_ClearDTC =                              30;
    const word cService_Routine_ReadDTC =                               31;
    const word cercvice_Routine_ClearPrivteDTC =                        32;
    const word cService_Routine_ReadActivePrivteDTCList =               33;
    const word cService_Routine_ReadPrivteDTC01 =                       34;
    const word cService_Routine_ReadPrivteDTC02 =                       35;
    const word cService_Routine_ReadPrivteDTC03 =                       36;
    const word cService_Routine_ReadPrivteDTC04 =                       37;
    const word cService_Routine_ReadPrivteDTC05 =                       38;
    const word cService_Routine_ReadPrivteDTC06 =                       39;
    const word cService_Routine_ReadPrivteDTC07 =                       40;
    const word cService_Routine_ReadPrivteDTC08 =                       41;
    const word cService_Routine_ReadPrivteDTC09 =                       42;
    const word cService_Routine_ReadPrivteDTC10 =                       43;
    const word cService_Routine_ReadPrivteDTC11 =                       44;
    const word cService_Routine_ReadPrivteDTC12 =                       45;
    const word cService_Routine_ReadPrivteDTC13 =                       46;
    const word cService_Routine_ReadPrivteDTC14 =                       47;
    const word cService_Routine_ReadPrivteDTC15 =                       48;
    const word cService_Routine_ReadPrivteDTC16 =                       49;
    const word cService_Routine_ReadPrivteDTC17 =                       50;
    const word cService_Routine_ReadPrivteDTC18 =                       51;
    const word cService_Routine_ReadPrivteDTC19 =                       52;
    const word cService_Routine_ReadPrivteDTC20 =                       53;
    const word cService_Routine_ReadPrivteDTC21 =                       54;
    const word cService_Routine_ReadPrivteDTC22 =                       55;
    const word cService_Routine_ReadPrivteDTC23 =                       56;
    const word cService_Routine_ReadPrivteDTC24 =                       57;
    const word cService_Routine_ReadPrivteDTC25 =                       58;
    const word cService_Routine_ClearDTC_MirrorMemory =                 59;
    msTimer                tDTC_ReadTimeOutTimer;
    msTimer                tDTC_ReadCyclicTimer;

    const word cService_Routine_WemResetWriteCounter =                  60;
    const word cService_Routine_WemStatusLesen =                        61;

    const word cService_Routine_SW_Vers_Info_Get =                     100;
    const word cService_Routine_BootLoader_Vers_Info_Get =             101;
    const word cService_Routine_ECU_ID_Info_Get =                      102;
    const word cService_Routine_Diag_Index_Info_Get =                  103;
    const word cService_Routine_HW_Vers_Info_Get =                     104;
    const word cService_Routine_AUTOsar_ID_Info_Get =                  105;
    const word cService_Routine_VDO_SAP_Nr_Info_Get =                  106;
    const word cService_Routine_VDO_Vers_Info_Get =                    107;
    const word cService_Routine_SW_Vers_BL_Info_Get =                  108;
    const word cService_Routine_BootLoader_Vers_BL_Info_Get =          109;
    const word cService_Routine_Diag_Index_BL_Info_Get =               110;
    const word cService_Routine_HW_Vers_BL_Info_Get =                  111;
    const word cService_Routine_FingerPrint_Get =                      112;
    const word cService_Routine_VDO_AC_BootLoader_Version_Get =        113;
    const word cService_Routine_VDO_GC_BootLoader_Version_Get =        114;
    const word cService_Routine_AC_SDF_SAP_Nr =                        115;
    const word cService_Routine_GC_HL_SDF_SAP_Nr =                     116;
    const word cService_Routine_GC_EL_SDF_SAP_Nr =                     117;
	const word cService_Routine_VehManufacturerSparePartNumber_Get =   118;
    msTimer                tID_Get_TimeOutTimer;

    const word cService_Routine_MRW_Read =                             600;
    const word cService_Routine_MRW_Write =                            601;
    const word cService_Routine_ReadEEP2File =                         602;                
    const word cService_Routine_WriteFile2EEP =                        603;
    const word cService_Routine_FormatFEE =                            605;
    msTimer                tMRW_TimeoutTimer;

    const word cService_Routine_Calibrate_KL30 =                       610;
    const word cService_Routine_Calibrate_KL30_Init =                  611;
    const word cService_Routine_Calibrate_KL30_GetValue =              612;
    const word cService_Routine_Calibrate_KL30_StoreCal =              613;
    msTimer                    tCalibrate_KL30TimeOutTimer;
    byte bCalKL30_Step = 0;
    const word cwLowerLimit_Y = 30;  // 3,0 Volt
    const word cwUpperLimit_Y = 300;  // 30,0 Volt
    const word cwLowerLimit_X = 0x70;  // 3,0 Volt
    const word cwUpperLimit_X = 0x460;  // 30,0 Volt
    word Kl30_x1, Kl30_x2, Kl30_x3, Kl30_y1, Kl30_y2, Kl30_y3 = 0xFFFF;
    byte bReadCAL_CurrentPosition = 0;
    byte bCal[11];


    const word cService_Routine_Calibrate_Clock =                      620;
    msTimer                    tCalibrate_ClockTimeOutTimer;
    const word cService_Routine_Enable_AC_MainOszi =                   621;
    const word cService_Routine_Enable_AC_SubOszi =                    622;
    const word cService_Routine_Enable_GC_MainOszi =                   623;
    const word cService_Routine_StoreMainCal =                         625;

    const word cService_Routine_ReadCalState =                         630;
    const word cService_Routine_ReadCalDDR3 =                          631;
    const byte cCALDDR3 = 1;
    const word cService_Routine_ReadCalVCom =                          632;
    const byte cCALVCom = 2;
    const word cService_Routine_ReadCalGamma =                         633;
    const byte cCALGamma = 3;
    const word cService_Routine_ReadCalWhiteBal =                      634;
    const byte cCALWhiteBal = 4;
    const word cService_Routine_ReadCalMVOControl =                    635;
    const byte cCALMVOControl = 5;
    const word cService_Routine_ReadCalSoundVolume =                   636;
    const byte cCALSoundVolume = 6;
    const word cService_Routine_ReadCalKL30Cal =                       637;
    const byte cCALKL30Cal = 7;
    const word cService_Routine_ReadCalQuartzCal =                     638;
    const byte cCALQuartzCal = 8;
    const word cService_Routine_ReadCalShowVal =                       639;
    const byte cCALShowVal = 9;
    msTimer                tCAL_ReadTimeOutTimer;

    const word cService_Routine_ReadAC_All =                           680;
    msTimer                tDIO_AC_TimeOutTimer;
    msTimer                tDIO_ReadAC_All_CyclicTimer;
    word wReadDIO_AC_ChannelsTimer = 1000; // msec
    const word cDIAG_DIO_AC_ReadCycleTime = 250;  //msec 
    const word cService_Routine_ReadAC_P0 =                            681;
    const word cService_Routine_ReadAC_P1 =                            682;
    const word cService_Routine_ReadAC_P2 =                            683;
    const word cService_Routine_ReadAC_P3 =                            684;
    const word cService_Routine_ReadAC_P4 =                            685;
    const word cService_Routine_ReadAC_P16 =                           686;
    const word cService_Routine_ReadAC_P17 =                           687;

    const word cService_Routine_ReadGC_All =                           690;
    msTimer                tDIO_GC_TimeOutTimer;
    msTimer                tDIO_ReadGC_All_CyclicTimer;
    word wReadDIO_GC_ChannelsTimer = 1000;
    const word cDIAG_DIO_GC_ReadCycleTime = 250;  //msec 
    const word cService_Routine_ReadGC_P0 =                            691;
    const word cService_Routine_ReadGC_P1 =                            692;
    const word cService_Routine_ReadGC_P2 =                            693;
    const word cService_Routine_ReadGC_P3 =                            694;
    const word cService_Routine_ReadGC_P4 =                            695;
    const word cService_Routine_ReadGC_P5 =                            696;
    const word cService_Routine_ReadGC_P6 =                            697;

    const word cService_Routine_WriteAC_P0 =                           701;
    const word cService_Routine_WriteAC_P1 =                           702;
    const word cService_Routine_WriteAC_P2 =                           703;
    const word cService_Routine_WriteAC_P3 =                           704;
    const word cService_Routine_WriteAC_P4 =                           705;
    const word cService_Routine_WriteAC_P16 =                          706;
    const word cService_Routine_WriteAC_P17 =                          707;

    const word cService_Routine_WriteAC_Px =                           709;
    const word cService_Routine_ReadPx =                               708;
    const word cService_Routine_WriteGC_P0 =                           711;
    const word cService_Routine_WriteGC_P1 =                           712;
    const word cService_Routine_WriteGC_P2 =                           713;
    const word cService_Routine_WriteGC_P3 =                           714;
    const word cService_Routine_WriteGC_P4 =                           715;
    const word cService_Routine_WriteGC_P5 =                           716;
    const word cService_Routine_WriteGC_P6 =                           717;
    const word cService_Routine_WriteGC_Px =                           718;
    const word cService_Routine_ReadCompareInput =                     720;
    const word cService_Routine_ReadPWM =                              730;
    const word cService_Routine_ReadPWM_Ch00 =                         731;
    const word cService_Routine_ReadPWM_Ch01 =                         732;
    const word cService_Routine_ReadPWM_Ch02 =                         733;
    const word cService_Routine_ReadPWM_Ch03 =                         734;
    const word cService_Routine_ReadPWM_Ch04 =                         735;
    const word cService_Routine_ReadPWM_Ch05 =                         736;
    const word cService_Routine_ReadPWM_Ch06 =                         737;
    const word cService_Routine_ReadPWM_Ch07 =                         738;
    const word cService_Routine_ReadPWM_Ch08 =                         739;
    const word cService_Routine_ReadPWM_Ch09 =                         740;
    const word cService_Routine_ReadPWM_Ch10 =                         741;
    const word cService_Routine_ReadPWM_Ch11 =                         742;
    const word cService_Routine_ReadPWM_Ch12 =                         743;
    const word cService_Routine_ReadPWM_Eval =                         744;
    const word cService_Routine_ReadPWM_Ch13 =                         745;
    
    const word cService_Routine_WritePWMFreq =                         751;
    const word cService_Routine_WritePWMDuty =                         752;
    const word cService_Routine_WritePWMDuty_Ch00 =                    753;
    const word cService_Routine_WritePWMDuty_Ch01 =                    754;
    const word cService_Routine_WritePWMDuty_Ch02 =                    755;
    const word cService_Routine_WritePWMDuty_Ch03 =                    756;
    const word cService_Routine_WritePWMDuty_Ch04 =                    757;
    const word cService_Routine_WritePWMDuty_Ch05 =                    758;
    const word cService_Routine_WritePWMDuty_Ch06 =                    759;
    const word cService_Routine_WritePWMDuty_Ch07 =                    760;
    const word cService_Routine_WritePWMDuty_Ch08 =                    761;
    const word cService_Routine_WritePWMDuty_Ch09 =                    762;
    const word cService_Routine_WritePWMDuty_Ch10 =                    763;
    const word cService_Routine_WritePWMDuty_Ch11 =                    764;
    const word cService_Routine_WritePWMDuty_Ch12 =                    765;
    const word cService_Routine_WritePWMDuty_Ch13 =                    807;
    const word cService_Routine_StopPWMControl =                       766;
    const word cService_Routine_LVDS_ReadPin_Sync =                    770;
    const word cService_Routine_LVDS_ReadFramecounter =                771;
    const word cService_Routine_LVDS_ReadRegister =                    772;
    msTimer                    tLVDS_ReadTimeOutTimer;            
    const word cService_Routine_LVDS_WriteRegister =                   773;
    msTimer                    tLVDS_WriteTimeOutTimer;            
    const word cService_Routine_LVDS_Switch_Func =                     774;
    const word cService_Routine_LVDS_Switch_Disp =                     775;
    const word cService_Routine_LVDS_ReadTestpic_CRC =                 776;
    const word cService_Routine_StartDisplayTest =                     790;
    const word cService_Routine_StopDisplayTest =                      791;
    const word cService_Routine_StartSoundTest =                       800;
    const word cService_Routine_StopSoundTest =                        801;
//    const word cService_Routine_VolumeSoundTest =                      802;
    const word cService_Routine_StartSoundQTest =                      803;
    const word cService_Routine_StopSoundQTest =                       804;
    const word cService_Routine_StartSoundDMode =                      805;
    const word cService_Routine_StopSoundDMode =                       806;
               
    const word cService_Routine_ReadRawADC =                           830;
    const word cService_Routine_ReadRawADC_Ch00 =                      831;
    const word cService_Routine_ReadRawADC_Ch01 =                      832;
    const word cService_Routine_ReadRawADC_Ch02 =                      833;
    const word cService_Routine_ReadRawADC_Ch03 =                      834;
    const word cService_Routine_ReadRawADC_Ch04 =                      835;
    const word cService_Routine_ReadRawADC_Ch05 =                      836;
    const word cService_Routine_ReadRawADC_Ch06 =                      837;
    const word cService_Routine_ReadRawADC_Ch07 =                      838;
    const word cService_Routine_ReadRawADC_Ch08 =                      839;
    const word cService_Routine_ReadRawADC_Ch09 =                      840;
    const word cService_Routine_ReadRawADC_Ch10 =                      841;
    const word cService_Routine_ReadRawADC_Ch11 =                      842;
    const word cService_Routine_ReadRawADC_Ch12 =                      843;
    const word cService_Routine_ReadRawADC_Ch13 =                      844;
    const word cService_Routine_ReadRawADC_Ch14 =                      845;
    const word cService_Routine_ReadRawADC_Ch15 =                      846;
    const word cService_Routine_ReadRawADC_Eval =                      847;
    msTimer                tADC_GetRaw_TimeOutTimer;
    mstimer                tADC_GetRawChannelsCyclic;
    
    const word cService_ReadPhysicalPorts_P0 =                         900;
    const word cService_ReadPhysicalPorts_P1 =                         901;
    const word cService_ReadPhysicalPorts_P2 =                         902;
    const word cService_ReadPhysicalPorts_P3 =                         903;
    const word cService_ReadPhysicalPorts_P10 =                        904;
    const word cService_ReadPhysicalPorts_P11 =                        905;
    const word cService_ReadPhysicalPorts_P16 =                        906;
    const word cService_ReadPhysicalPorts_P17 =                        907;
    const word cService_ReadPhysicalPorts_P21 =                        908;
    const word cService_ReadPhysicalPorts_P40 =                        909;
    const word cService_ReadPhysicalPorts_P42 =                        910;
    const word cService_ReadPhysicalPorts_P43 =                        911;
    const word cService_ReadPhysicalPorts_P44 =                        912;
    const word cService_ReadPhysicalPorts_P45 =                        913;
    const word cService_ReadPhysicalPorts_JP0 =                        914;
    const word cRead_PhysicalPorts           =                         915;
    msTimer tGPIO_TimeOutTimer;
    
    const word cService_SessionLevel =                                1000; // responce selector
    const word cService_SessionLevel_Default =                        1001; // service only
    const word cService_SessionLevel_Program =                        1002; // service only
    const word cService_SessionLevel_Extended =                       1003; // service only
    const word cService_SessionLevel_Supplier =                       1004; // service only
    const word cService_SessionLevel_Boardtest =                      1005; // service only
    msTimer                tSecLevel_SendTimeOutTimer;            

    const word cService_SecLevel =                                    1010; // responce selector
    const word cService_SecLevel_Default =                            1011; // service only
    const word cService_SecLevel_Antitheft =                          1012; // service only
    const word cService_SecLevel_Manifacturing =                      1013; // service only
    const word cService_SecLevel_Supplier =                           1014; // service only
    msTimer                tSessionSendTimeOutTimer;

    const word cService_SessionLevelCheck =                           1020;
    const word cService_SessionLevelCheck_Default =                   1021; 
    const word cService_SessionLevelCheck_Program =                   1022; 
    const word cService_SessionLevelCheck_Extended =                  1023; 
    const word cService_SessionLevelCheck_Supplier =                  1024; 
    const word cService_SessionLevelCheck_Boardtest =                 1025; 
    byte bRequestedSessionLevel;

    const word cService_ControlLog_DataToFile =                       1030; 

    const word cService_Control_Start_DiagSession =                   1040;
    const word cService_Control_Stop_DiagSession =                    1041;

    const word cService_Control_Lamptest_On =                         1100;
    const word cService_Control_Lamptest_Off =                        1101;

    const word cService_Control_Warp_Data_Write =                     1200;
    const word cService_Control_Warp_Data_Vehicle_Write =             1201;
    const word cService_Control_Warp_Data_Clear_Vehicle_Write =       1202;
    const word cService_Control_Warp_Data_Clear_HUD_Write =           1203;
    const word cService_Control_Warp_Data_HUD_Write =                 1204;
    msTimer                tWarp_TimeOutTimer;

    const word cService_Delay_Timer0100msec =                        65529; 
    const word cService_Delay_Timer0200msec =                        65530; 
    const word cService_Delay_Timer0250msec =                        65531; 
    const word cService_Delay_Timer0500msec =                        65532; 
    const word cService_Delay_Timer1000msec =                        65533; 
    const word cService_Delay_Timer2000msec =                        65534; 
    msTimer                tDelay_Timer;

    const word cService_NOP =                                        65535; 




    msTimer tDSP_StartControlTimeOutTimer;
    msTimer tDSP_StopControlTimeOutTimer;

    msTimer tSND_StartControlTimeOutTimer;
    msTimer tSND_StopControlTimeOutTimer;
    msTimer tSND_VolumeControlTimeOutTimer;


    byte bDIO_ActualRq_Port;





    msTimer tPWM_TimeOutTimer;
    msTimer tPWM_ReadAllValuesCycleTimer;

    msTimer tMRW_FormatFEE_TimeOutTimer;

    word wReadRawADC_ChannelsTimer = 1000;
    const word cDIAG_ADC_ReadCycleTime = 250;  //msec 
    byte bReadRawADC_CurrentChannel = 0;
    word wADCRaw[17];
    word wADCRawMin[17];
    word wADCRawMax[17];

    // PWM

    byte cPWM_IndexToChannel[100];
    word wReadPWM_ChannelsTimer = 1000;
    const word cDIAG_PWM_ReadCycleTime = 250;  //msec 
    byte bReadPWM_CurrentChannel = 0;
    word wPWMFreq[14];
    word wPWMDuty[14];
    word wPWMDutyMin[14];
    word wPWMDutyMax[14];
    word wSetDuty_Buffer;
    byte bSetDutyChannel_Buffer;
    dword dwSetFreq_Buffer;
    byte bSetFreqChannel_Buffer;
    byte bSetGPIOChannel_Buffer;

/*   MRW   */
//          TESTER__abRWEEepromShadow[TESTER__bRWEActDataSet][i] = getValue( DIAG_MRW_Data255);i++;
    byte DIAG__bMRW_ActDataSet              = 0x00;
    const int DTOP_iBlocSize = 4096;
//     byte DTPO__pbRxDataBuffer[DTOP_iBlocSize];
//     byte DTPO__pbTxDataBuffer[DTOP_iBlocSize];

    byte DataBuffer[DTOP_iBlocSize];

//DEFINITION: EEPROM MODES
    const int OFF =                         0;
    const int RWEEPROM =                1;
    const int RWFTFILE =               2;
    const int SMC =                         3;
    const int ROMFILE =                    4;
    const int CONTROLLER =                5;
    const int CLUSTERINF =                6;
    const int FINPROGPCB =                7;
    const int FINPROGKI =               8;
    const int EE_TEST =                9;

    const byte READ_EEPROM =          0x01;
    const byte WRITE_EEPROM =          0x02;

//READ/WRITE EEPROM
    int  DIAG__iMRWActEepromReadState           = OFF;
    int  DIAG__iMRWActEepromWriteState          = OFF;
    int  DIAG__iMRWMissingBytes                 = 0;
    int  DIAG__iMRWActShadowPosition            = 0;
    byte DIAG__bMRWActDataSet                   = 0x00;
    char DIAG__acMRWDataSetNameShadow[2][64]    = {"DATA AREA 1", "DATA AREA 2"};
    int  DIAG__iMRWCyclicReadShadow[2]          = {0,0};
    int  DIAG__iMRWCycReadIntervShadow[2]       = {1000,1000};
    byte DIAG__abMRWAddressShadow[2][4]         = {{0x00,0x00,0x00,0x00},{0x00,0x00,0x00,0x00}};
    int  DIAG__iMRWDataLengthShadow[2]          = {1,1};
    byte DIAG__abMRWEepromShadow[2][256];
    byte DIAG__abMRWActAddress[4];
    int  DIAG__iMRWDataLength                   = 0;
    byte DIAG__bROMMEmServiceSpecial            = 0;
    const byte UPDATE_MIRROR                      = 0x04;
    const byte LD_MODULE_STATE                  = 0x05;

//READ/WRITE EEPROM ( 2 )
    msTimer tMRW_InterBlockDelay;
    word cMRW_InterBlockDelay = 20; // msec

    int   DIAG__iReadFileLifeCount =           0;
    long  DIAG__lReadFileRxFrameCount =      0;
    int   DIAG__bReadFileActDataLen =           0;
    dword DIAG__dwReadFileActAddress =      0;
    dword DIAG__dwReadFileStartAddress =      0;
    dword DIAG__dwReadFileEndAddress =      0;
    long  DIAG__lReadFileFileHandle =           0;

    int   MRW_iWriteFileLifeCount =           0;
    long  MRW_lWriteFileTxFrameCount =      0;
    long  MRW_lWriteFileHandle =           0;


//NB_READ_WRITE READ/WRITE MEM
     const int NB_READ_WRITE = 16;

    msTimer tMRW_ReadCyclic;

     byte bRequestLMS = 0;

    const dword DIAG__cdwMRWStartAdr_AC_IntFlashID  = 0;
    const dword DIAG__cdwMRWStartAdr_AC_IntFlash    = 0x00000000;
    const dword DIAG__cdwMRWStartAdr_AC_IntFlashLen                 = 0x00200000;

    const dword DIAG__cdwMRWStartAdr_GC_IntFlashID  = 1;
    const dword DIAG__cdwMRWStartAdr_GC_IntFlash    = 0x01000000;
    const dword DIAG__cdwMRWStartAdr_GC_IntFlashLen                 = 0x00200000;

    const dword DIAG__cdwMRWStartAdr_AC_EEP_FEEID   = 2;
    const dword DIAG__cdwMRWStartAdr_AC_EEP_FEE     = 0x02000000; //1st was 0x02000000 //2nd was 0xEF000000(until pre70)
    const dword DIAG__cdwMRWStartAdr_AC_EEP_FEELen                  = 0x00002000;

    const dword DIAG__cdwMRWStartAdr_GC_DDR3ID      = 3;
    const dword DIAG__cdwMRWStartAdr_GC_DDR3        = 0x03400000;
    const dword DIAG__cdwMRWStartAdr_GC_DDR3Len                     = 0x1FC00000;

    const dword DIAG__cdwMRWStartAdr_GC_NANDID      = 4;
    const dword DIAG__cdwMRWStartAdr_GC_NAND        = 0x24000000;
    const dword DIAG__cdwMRWStartAdr_GC_NANDLen                     = 0x20000000;

    const dword DIAG__cdwMRWStartAdr_GC_PBUSID      = 5;
    const dword DIAG__cdwMRWStartAdr_GC_PBUS        = 0xFD400000;
    const dword DIAG__cdwMRWStartAdr_GC_PBUSLen                     = 0x01000000;

    const dword DIAG__cdwMRWStartAdr_GC_IntRAMID    = 6;
    const dword DIAG__cdwMRWStartAdr_GC_IntRAM      = 0xFEC00000;
    const dword DIAG__cdwMRWStartAdr_GC_IntRAMLen                   = 0x00018000;

    const dword DIAG__cdwMRWStartAdr_AC_IntRAMID    = 7;
    const dword DIAG__cdwMRWStartAdr_AC_IntRAM      = 0xFEDD0000;
    const dword DIAG__cdwMRWStartAdr_AC_IntRAMLen                   = 0x00030000;

    const dword DIAG__cdwMRWStartAdr_AC_PBUSID      = 8;
    const dword DIAG__cdwMRWStartAdr_AC_PBUS        = 0xFF400000;
    const dword DIAG__cdwMRWStartAdr_AC_PBUSLen                     = 0x00360000;

    const dword DIAG__cdwMRWStartAdr_AC_BURAMID     = 9;
    const dword DIAG__cdwMRWStartAdr_AC_BURAM       = 0xFF760000;
    const dword DIAG__cdwMRWStartAdr_AC_BURAMLen                    = 0x00004000;

    const dword DIAG__cdwMRWStartAdr_AC_PBUS2ID     = 10;
    const dword DIAG__cdwMRWStartAdr_AC_PBUS2       = 0xFF764000;
    const dword DIAG__cdwMRWStartAdr_AC_PBUS2Len                    = 0x000DC000;

    const dword DIAG__cdwMRWStartAdr_AC_IntRegID    = 11;
    const dword DIAG__cdwMRWStartAdr_AC_IntReg      = 0xFFFF5000;
    const dword DIAG__cdwMRWStartAdr_AC_IntRegLen                   = 0x0000B000;

    const dword DIAG__cdwMRWPx_Reg                  = 0x00;
    const dword DIAG__cdwMRWP0_Reg                  = 0x00;
    const dword DIAG__cdwMRWP1_Reg                  = 0x04;
    const dword DIAG__cdwMRWP2_Reg                  = 0x08;
    const dword DIAG__cdwMRWP3_Reg                  = 0x0C;
    const dword DIAG__cdwMRWP4_Reg                  = 0x10;
    const dword DIAG__cdwMRWP5_Reg                  = 0x14;
    const dword DIAG__cdwMRWP6_Reg                  = 0x18;
    const dword DIAG__cdwMRWP7_Reg                  = 0x1C;
    const dword DIAG__cdwMRWP8_Reg                  = 0x20;
    const dword DIAG__cdwMRWP9_Reg                  = 0x24;
    const dword DIAG__cdwMRWP10_Reg                 = 0x28;
    const dword DIAG__cdwMRWP16_Reg                 = 0x40;
    const dword DIAG__cdwMRWP17_Reg                 = 0x44;
    const dword DIAG__cdwMRWVCPC0_Reg               = 0x418008;
    const dword DIAG__cdwMRWVCPC1_Reg               = 0x41800C;

    const dword SDF_nAdrSAP_Nr_AC =                      0x001FE020;
    const dword SDF_nAdrSAP_Nr_GC_EL =                   0x001FF020;
    const dword SDF_nAdrSAP_Nr_GC_HL =                   0x00F80020;
    const dword SDF_nAdrDdr3RamCalibValidPattern =       0x00041040;
    const dword SDF_nAdrVComCalibValidPattern =          0x000410C0;
    const dword SDF_nAdrGammaCalibValidPattern =         0x00041100;
    const dword SDF_nAdrWhiteBalanceValidPattern =       0x00041160;
    const dword SDF_nAdrMVOControlValidPattern =         0x000414A0;
    const dword SDF_nAdrArea_SoundVolumeCalib =          0x00041500;
    const byte  SDF_nAdrArea_ValidPatternLength =        4;
    const dword SDF_nValidPattern =                      0x55AA55AA;
    const dword SDF_nAdrArea_KL30Cal =                   0x00000361;
    const byte  SDF_nAdrArea_KL30CalLength =             12;
    const dword SDF_nAdrArea_QuartzCal =                 0x000002DC;
    const byte  SDF_nAdrArea_QuartzCalLength =           2;
          dword dwVariSoundOffset =                      0;

    
    byte bCalClock_Step = 0;
    const long cwLowerLimit_freq = 3999490;  // Hz
    const long cwUpperLimit_freq = 4000510;  // Hz
    long dwFrequencyMainOsziAC;


//    char strLogDecriptor[20];
    long  DIAG__lLogFileFileHandle =           0;
    int   DIAG__iLogFileLifeCount =           0;

//========== Read Error Storage
	char 	sBigStr[180*(64+40)] 		= "";

	byte	bDTC_HighByte	= 0;			
	byte	bDTC_LowByte	= 0;
	byte	bDTC_Symptom	= 0;
	byte 	bDTC_StatusMask	= 0;		
	int		iDTC_Counter	= 0;

	//Supported DTCs from config file
	byte DTC_nNoSupportedDTC;
	dword DTC_adwTroubleCode[180];
	byte DTC_abSymptom[180];
	char DTC_strSymptomBinary[10];
	char DTC_astrDTC[180][7];
	char DTC_astrSymptom[180][3];
	char DTC_astrTroubleCode[180][41];

	byte DTC_nNoSupportedDTC_VDO;
	dword DTC_adwTroubleCode_VDO[30];
	byte DTC_adwTroubleCode_VDO_Avail[30];
	byte DTC_abSymptom_VDO[30];
	char DTC_strSymptomBinary_VDO[10];
	char DTC_astrDTC_VDO[30][7];
	char DTC_astrSymptom_VDO[30][3];
	char DTC_astrTroubleCode_VDO[30][41];

    // WemStatus
    byte WenStatusLesen_buffer[120];
    byte WenStatusLesen_buffer_length;
    char WenStatusLesen_value_char1;
    char WenStatusLesen_value_char2;
    byte WemFileOpened = 0;
    long DIAG__lWEMFileFileHandle = 0;
    int  DIAG__iWEMFileLifeCount = 0;

    // Optik-Panel
    mstimer tOptics_LED_Preglow_Timer;
    mstimer tOptics_RPM_Reduction_Timer;
    const word cOptics_LED_Preglow_Timer_1_min = 60000; 
    const int TachoDefault = 740;
    const float SpeedoDefault = 155;
    const byte EngineCoolantTempMax = 127;
    const byte EngineCoolantTempMin = 20;
    const byte DistronicBeginMax = 50;
    const byte DistronicBeginMin =  3;
    const byte DistronicEndMax = 251;
    const byte DistronicEndMin = 51;

    // allgemeine Services
    char ByteToHex_value_char1;
    char ByteToHex_value_char2;

    // HUD-Warping-Services
    byte Warping_data[756];
    const word Warping_data_count = 756;
    long  Warp_lFileHandle =           0;
    char cWarp_FileName[270];
    char cWarp_FilePath[270];

//============== Protokollieren im Write-Fenster =========================
	int ProtokollActive=FALSE;
//============== PWM Channel numbers =========================
    //============== LL_ML Channel numbers =========================
    const byte LL_ML_DISP_VLCD_PWM  = 0x01;
    const byte LL_ML_DISP_VREF_PWM  = 0x03;
    const byte LL_ML_DIAL           = 0x43;
    const byte LL_ML_PTR            = 0x44;
    const byte LL_ML_TT             = 0x45;
    const byte LL_ML_TT_SAFETY      = 0x46;
    const byte LL_ML_BL_DIMM        = 0x47;
    //============== HL/HL+ Channel numbers ========================    
    const byte HL_HLP_TT          = 0x32;
    const byte HL_HLP_TT_SAFETY   = 0x33;
    const byte HL_HLP_PTR         = 0x34;
    const byte HL_HLP_DIAL        = 0x35;
    const byte HL_HLP_ART         = 0x36;
    const byte HL_HLP_BAR_FU      = 0x37;
    const byte HL_HLP_BAR_FU_PASS = 0x38;
    const byte HL_HLP_RES1        = 0x39;
    const byte HL_HLP_RES2        = 0x3a;
    const byte HL_HLP_1V25_SS     = 0x3b;
    const byte HL_HLP_BL_DIMM     = 0x3c;
    const byte HL_HLP_BL_SS       = 0x3d;
    const byte HL_HLP_BAR_TE      = 0x3e;
    const byte HL_HLP_BAR_TE_PASS = 0x3f;
    
}

on preStart
{
    OSEKTL_SetCAN (1);                    //Receive and Send on Channel 1 s.S.15

    TesterPresentPhysFkt = cPHYSICAL;
}

on start
{
    putValue( DIAG_CTRL_Disp_DiagStateOnOff, cInactiv );

    if( ServicePhys )
        putValue( DHMI__ServiceStatus, 0 );
    else
        putValue( DHMI__ServiceStatus, 1 );

    putValue( DIAG_CTRL_IC_Type_Selector, 0x2C );    //   Set Project VS30LL/ML
    EnableControl( "Calibrate Clock", "Button:DIAG_CALClock_StoreCal", 0 ); // default

    EnableControl( "Reset FEE", "EnvVar:DIAG_FEE_ResetTrigger", 0 );
    putValue( DIAG_FEE_DisclaimerRead_Ackn, 0 );

    putValue( DIAG_Main_ErrorStatus, "Diagnose deaktiviert" );

    putValue( DIAG_PWM_Ch00Title, "   " );
    putValue( DIAG_PWM_Ch01Title, "   " );
    putValue( DIAG_PWM_Ch02Title, "   " );
    putValue( DIAG_PWM_Ch03Title, "   " );
    putValue( DIAG_PWM_Ch04Title, "   " );
    putValue( DIAG_PWM_Ch05Title, "   " );
    putValue( DIAG_PWM_Ch06Title, "   " );
    putValue( DIAG_PWM_Ch07Title, "   " );
    putValue( DIAG_PWM_Ch08Title, "   " );
    putValue( DIAG_PWM_Ch09Title, "   " );
    putValue( DIAG_PWM_Ch10Title, "   " );
    putValue( DIAG_PWM_Ch11Title, "   " );
    putValue( DIAG_PWM_Ch12Title, "   " );
    putValue( DIAG_PWM_Ch13Title, "   " );
    putValue( DIAG_PWM_Ch14Title, "   " );

    //  ADC Kanäle
    putValue( DIAG_ADC_Ch00Title, "" );
    putValue( DIAG_ADC_Ch01Title, "" );
    putValue( DIAG_ADC_Ch02Title, "" );
    putValue( DIAG_ADC_Ch03Title, "" );
    putValue( DIAG_ADC_Ch04Title, "" );
    putValue( DIAG_ADC_Ch05Title, "" );
    putValue( DIAG_ADC_Ch06Title, "" );
    putValue( DIAG_ADC_Ch07Title, "" );
    putValue( DIAG_ADC_Ch08Title, "" );
    putValue( DIAG_ADC_Ch09Title, "" );
    putValue( DIAG_ADC_Ch10Title, "" );
    putValue( DIAG_ADC_Ch11Title, "" );
    putValue( DIAG_ADC_Ch12Title, "" );
    putValue( DIAG_ADC_Ch13Title, "" );
    putValue( DIAG_ADC_Ch14Title, "" );
    putValue( DIAG_ADC_Ch15Title, "" );

    bQueueWaitForResponce = FALSE;
    putValue( DIAG_LOG_SessionActiv, 0 );
    putValue( DIAG_ID_Clear_All_Info_Trigger, 1 );
    putValue( DIAG_ID_Clear_All_Info_Trigger, 0 );
    DTC_ClearEnv();

   	DTC_vReadDTCFromFile();
    putValue( DIAG_DTC_00_Line_State, 5 );
    putValue( DIAG_DTC_01_Line_State, 5 );
    putValue( DIAG_DTC_02_Line_State, 5 );
    putValue( DIAG_DTC_03_Line_State, 5 );
    putValue( DIAG_DTC_04_Line_State, 5 );
    putValue( DIAG_DTC_05_Line_State, 5 );
    putValue( DIAG_DTC_06_Line_State, 5 );
    putValue( DIAG_DTC_07_Line_State, 5 );
    putValue( DIAG_DTC_08_Line_State, 5 );
    putValue( DIAG_DTC_09_Line_State, 5 );
    putValue( DIAG_DTC_10_Line_State, 5 );
    putValue( DIAG_DTC_11_Line_State, 5 );
    putValue( DIAG_DTC_12_Line_State, 5 );
    putValue( DIAG_DTC_13_Line_State, 5 );
    putValue( DIAG_DTC_14_Line_State, 5 );
    putValue( DIAG_DTC_15_Line_State, 5 );
    putValue( DIAG_DTC_16_Line_State, 5 );
    putValue( DIAG_DTC_17_Line_State, 5 );
    putValue( DIAG_DTC_18_Line_State, 5 );
    putValue( DIAG_DTC_19_Line_State, 5 );
    putValue( DIAG_DTC_20_Line_State, 5 );
    putValue( DIAG_DTC_21_Line_State, 5 );
    putValue( DIAG_DTC_22_Line_State, 5 );
    putValue( DIAG_DTC_23_Line_State, 5 );
    putValue( DIAG_DTC_24_Line_State, 5 );
    putValue( DIAG_DTC_25_Line_State, 5 );
    putValue( DIAG_DTC_26_Line_State, 5 );
    putValue( DIAG_DTC_27_Line_State, 5 );
    putValue( DIAG_DTC_28_Line_State, 5 );
    putValue( DIAG_DTC_29_Line_State, 5 );
    putValue( DIAG_DTC_30_Line_State, 5 );
    putValue( DIAG_DTC_31_Line_State, 5 );
    putValue( DIAG_DTC_32_Line_State, 5 );
    putValue( DIAG_DTC_33_Line_State, 5 );
    putValue( DIAG_DTC_34_Line_State, 5 );
    putValue( DIAG_DTC_35_Line_State, 5 );
    putValue( DIAG_DTC_36_Line_State, 5 );
    putValue( DIAG_DTC_37_Line_State, 5 );
    putValue( DIAG_DTC_38_Line_State, 5 );
    putValue( DIAG_DTC_39_Line_State, 5 );
    putValue( DIAG_DTC_40_Line_State, 5 );
    putValue( DIAG_DTC_41_Line_State, 5 );
    putValue( DIAG_DTC_42_Line_State, 5 );
    putValue( DIAG_DTC_43_Line_State, 5 );
    putValue( DIAG_DTC_44_Line_State, 5 );
    putValue( DIAG_DTC_45_Line_State, 5 );
    putValue( DIAG_DTC_46_Line_State, 5 );
    putValue( DIAG_DTC_47_Line_State, 5 );
    putValue( DIAG_DTC_48_Line_State, 5 );
    putValue( DIAG_DTC_49_Line_State, 5 );
    putValue( DIAG_DTC_50_Line_State, 5 );
    putValue( DIAG_DTC_51_Line_State, 5 );
    putValue( DIAG_DTC_52_Line_State, 5 );
    putValue( DIAG_DTC_53_Line_State, 5 );
    putValue( DIAG_DTC_54_Line_State, 5 );
    putValue( DIAG_DTC_55_Line_State, 5 );
    putValue( DIAG_DTC_56_Line_State, 5 );
    putValue( DIAG_DTC_57_Line_State, 5 );
    putValue( DIAG_DTC_58_Line_State, 5 );
    putValue( DIAG_DTC_59_Line_State, 5 );
    putValue( DIAG_DTC_60_Line_State, 5 );
    putValue( DIAG_DTC_61_Line_State, 5 );
    putValue( DIAG_DTC_62_Line_State, 5 );
    putValue( DIAG_DTC_63_Line_State, 5 );
    putValue( DIAG_DTC_64_Line_State, 5 );
    putValue( DIAG_DTC_65_Line_State, 5 );
    putValue( DIAG_DTC_66_Line_State, 5 );
    putValue( DIAG_DTC_67_Line_State, 5 );
    putValue( DIAG_DTC_68_Line_State, 5 );
    putValue( DIAG_DTC_69_Line_State, 5 );
    putValue( DIAG_DTC_70_Line_State, 5 );
    putValue( DIAG_DTC_71_Line_State, 5 );
    putValue( DIAG_DTC_72_Line_State, 5 );
    putValue( DIAG_DTC_73_Line_State, 5 );
    putValue( DIAG_DTC_74_Line_State, 5 );
    putValue( DIAG_DTC_75_Line_State, 5 );
    putValue( DIAG_DTC_76_Line_State, 5 );
    putValue( DIAG_DTC_77_Line_State, 5 );
    putValue( DIAG_DTC_78_Line_State, 5 );
    putValue( DIAG_DTC_79_Line_State, 5 );
    putValue( DIAG_DTC_80_Line_State, 5 );
    putValue( DIAG_DTC_81_Line_State, 5 );
    putValue( DIAG_DTC_82_Line_State, 5 );
    putValue( DIAG_DTC_83_Line_State, 5 );
    putValue( DIAG_DTC_84_Line_State, 5 );
    putValue( DIAG_DTC_85_Line_State, 5 );
    putValue( DIAG_DTC_86_Line_State, 5 );
    putValue( DIAG_DTC_87_Line_State, 5 );
    putValue( DIAG_DTC_88_Line_State, 5 );
    putValue( DIAG_DTC_89_Line_State, 5 );
    putValue( DIAG_DTC_90_Line_State, 5 );
    putValue( DIAG_DTC_91_Line_State, 5 );
    putValue( DIAG_DTC_92_Line_State, 5 );
    putValue( DIAG_DTC_93_Line_State, 5 );
    putValue( DIAG_DTC_94_Line_State, 5 );
    putValue( DIAG_DTC_95_Line_State, 5 );
    putValue( DIAG_DTC_96_Line_State, 5 );
    putValue( DIAG_DTC_97_Line_State, 5 );
    putValue( DIAG_DTC_98_Line_State, 5 );
    putValue( DIAG_DTC_99_Line_State, 5 );
    putValue( DIAG_DTC_100_Line_State, 5 );
    putValue( DIAG_DTC_101_Line_State, 5 );
    putValue( DIAG_DTC_102_Line_State, 5 );
    putValue( DIAG_DTC_103_Line_State, 5 );

    ID_Clear_EnvVars();
}

on stopMeasurement
{
    if( DIAG__lLogFileFileHandle != 0 ) 
    {
        fileClose( DIAG__lLogFileFileHandle );
        DIAG_LOG__vLogPutStatusText( "FILE CLOSED" );
        DIAG_LOG_vIncrementLifeCount(0);
    }
}

on timer KL15_ON_OFF
{
  switch(x)
  {
    
    case 0x00:
    {
      cancelTimer(KL15_ON_OFF);
      write("KL15OFF");
      putValue(HMI_ISw_Stat, 0);
      x=0x01;
      setTimer(KL15_ON_OFF, 36);
      if(number == 101) x=2;
      
    }
      break;
    case 0x01:
    {
      cancelTimer(KL15_ON_OFF);
      write("KL15ON");
      putValue(HMI_ISw_Stat, 4);
//      putValue(DIAG_KL15ON_OFF_no, number++);
      x=0x00;
      setTimer(KL15_ON_OFF, 3);
    }
      break;
    default: break;

  }
}

on timer TimeOutTimer
{
    putValue( DIAG_Main_ErrorStatus, "Timeout der Antwort!" );
    bQueueWaitForResponce = FALSE;
    DIAG_CTRL_vStartNewService();
}

on timer tGPIO_CyclicReadSwitch
{
  
  switch(bGPIOCyclicCounter)
    case 0:
    {
      if (getValue(DIAG_GPIO_Read_P0_Cyclic) == 1)
      {
        DIAG_Queue_InsertCommand( cService_ReadPhysicalPorts_P0 );
        DIAG_CTRL_vStartNewService();
        cancelTimer( tGPIO_CyclicReadSwitch );
        bGPIOCyclicCounter = 1;
        write("P0_cyclic_on");
      }
      else
      {
        cancelTimer( tGPIO_CyclicReadSwitch );
        bGPIOCyclicCounter = 1;
        write("P0_cyclic_off");
      }
    break;
    case 1:
    {
      if (getValue(DIAG_GPIO_Read_P1_Cyclic) == 1)
      {
        DIAG_Queue_InsertCommand( cService_ReadPhysicalPorts_P1 );
        DIAG_CTRL_vStartNewService();
        cancelTimer( tGPIO_CyclicReadSwitch );
        bGPIOCyclicCounter = 2;
        write("P1_cyclic_on");
      }
      else
      {
        cancelTimer( tGPIO_CyclicReadSwitch );
        bGPIOCyclicCounter = 2;
        write("P1_cyclic_off");
      }
    }
    break;
    case 2:
    {
      if (getValue(DIAG_GPIO_Read_P2_Cyclic) == 1)
      {
        if(getValue( DIAG_CTRL_IC_Type_Selector) == cKI_VS30_HL)
		    {
			    DIAG_Queue_InsertCommand( cService_ReadPhysicalPorts_P2 );
			    DIAG_CTRL_vStartNewService();
		    }
        cancelTimer( tGPIO_CyclicReadSwitch );
        bGPIOCyclicCounter = 3;
        write("P2_cyclic_on");
      }
      else
      {
        cancelTimer( tGPIO_CyclicReadSwitch );
        bGPIOCyclicCounter = 3;
        write("P2_cyclic_off");
      }
    }
    break;
    case 3:
    {
      if (getValue(DIAG_GPIO_Read_P3_Cyclic) == 1)
      {
        DIAG_Queue_InsertCommand( cService_ReadPhysicalPorts_P3 );
        DIAG_CTRL_vStartNewService();
        cancelTimer( tGPIO_CyclicReadSwitch );
        bGPIOCyclicCounter = 4;
        write("P3_cyclic_on");
      }
      else
      {
        cancelTimer( tGPIO_CyclicReadSwitch );
        bGPIOCyclicCounter = 4;
        write("P3_cyclic_off");
      }
    }
    break;
    case 4:
    {
      if (getValue(DIAG_GPIO_Read_P10_Cyclic) == 1)
      {
        if(getValue( DIAG_CTRL_IC_Type_Selector) == cKI_VS30_EL)
        {
          ADC_InsertAllReadRawRequestsGPIO();
          DIAG_Queue_InsertCommand( cService_ReadPhysicalPorts_P10 );
          DIAG_CTRL_vStartNewService();
        }
        else if (getValue( DIAG_CTRL_IC_Type_Selector) == cKI_VS30_HL)
        {
          ADC_InsertAllReadRawRequestsGPIO();
          DIAG_Queue_InsertCommand( cService_ReadPhysicalPorts_P10 );
          DIAG_CTRL_vStartNewService();
        }
        cancelTimer( tGPIO_CyclicReadSwitch );
        bGPIOCyclicCounter = 5;
        write("P10_cyclic_on");
      }
      else
      {
        cancelTimer( tGPIO_CyclicReadSwitch );
        bGPIOCyclicCounter = 5;
        write("P10_cyclic_off");
      }
    }
    break;
    case 5:
    {
      if (getValue(DIAG_GPIO_Read_P11_Cyclic) == 1)
      {
        DIAG_Queue_InsertCommand( cService_ReadPhysicalPorts_P11 );
        DIAG_CTRL_vStartNewService();
        cancelTimer( tGPIO_CyclicReadSwitch );
        bGPIOCyclicCounter = 6;
        write("P11_cyclic_on");
      }
      else
      {
        cancelTimer( tGPIO_CyclicReadSwitch );
        bGPIOCyclicCounter = 6;
        write("P11_cyclic_off");
      }
    }
    break;
    case 6:
    {
      if (getValue(DIAG_GPIO_Read_P16_Cyclic) == 1)
      {
        if(getValue( DIAG_CTRL_IC_Type_Selector) == cKI_VS30_EL)
        {
          PWM_InsertAllReadRequestsGPIO();
          DIAG_Queue_InsertCommand( cService_ReadPhysicalPorts_P16 );
          DIAG_CTRL_vStartNewService();
        }
        else if(getValue( DIAG_CTRL_IC_Type_Selector) == cKI_VS30_HL)
        {
          DIAG_Queue_InsertCommand( cService_ReadPhysicalPorts_P16 );
          DIAG_CTRL_vStartNewService();
        }
        cancelTimer( tGPIO_CyclicReadSwitch );
        bGPIOCyclicCounter = 7;
        write("P16_cyclic_on");
      }
      else
      {
        cancelTimer( tGPIO_CyclicReadSwitch );
        bGPIOCyclicCounter = 7;
        write("P16_cyclic_off");
      }
    }
    break;
    case 7:
    {
      if (getValue(DIAG_GPIO_Read_P17_Cyclic) == 1)
      {
        DIAG_Queue_InsertCommand( cService_ReadPhysicalPorts_P17 );
        DIAG_CTRL_vStartNewService();
        cancelTimer( tGPIO_CyclicReadSwitch );
        bGPIOCyclicCounter = 8;
        write("P17_cyclic_on");
      }
      else
      {
        cancelTimer( tGPIO_CyclicReadSwitch );
        bGPIOCyclicCounter = 8;
        write("P17_cyclic_off");
      }
    }
    break;
    case 8:
    {
      if (getValue(DIAG_GPIO_Read_P21_Cyclic) == 1)
      {
        DIAG_Queue_InsertCommand( cService_ReadPhysicalPorts_P21 );
        DIAG_CTRL_vStartNewService();
        cancelTimer( tGPIO_CyclicReadSwitch );
        bGPIOCyclicCounter = 9;
        write("P21_cyclic_on");
      }
      else
      {
        cancelTimer( tGPIO_CyclicReadSwitch );
        bGPIOCyclicCounter = 9;
        write("P21_cyclic_off");
      }
    }
    break;
    case 9:
    {
      if (getValue(DIAG_GPIO_Read_P40_Cyclic) == 1)
      {
        if(getValue( DIAG_CTRL_IC_Type_Selector) == cKI_VS30_HL)
		    {
			    DIAG_Queue_InsertCommand( cService_ReadPhysicalPorts_P40 );
			    DIAG_CTRL_vStartNewService();
		    }
        cancelTimer( tGPIO_CyclicReadSwitch );
        bGPIOCyclicCounter = 10;
        write("P40_cyclic_on");
      }
      else
      {
        cancelTimer( tGPIO_CyclicReadSwitch );
        bGPIOCyclicCounter = 10;
        write("P40_cyclic_off");
      }
    }
    break;
    case 10:
    {
      if (getValue(DIAG_GPIO_Read_P42_Cyclic) == 1)
      {
        if(getValue( DIAG_CTRL_IC_Type_Selector) == cKI_VS30_EL)
		    {
          DIAG_Queue_InsertCommand( cService_ReadPhysicalPorts_P42 );
          DIAG_CTRL_vStartNewService();
        }
        else if(getValue( DIAG_CTRL_IC_Type_Selector) == cKI_VS30_HL)
        { 
          PWM_InsertAllReadRequestsGPIO();
          DIAG_Queue_InsertCommand( cService_ReadPhysicalPorts_P42 );
          DIAG_CTRL_vStartNewService();
        }
        cancelTimer( tGPIO_CyclicReadSwitch );
        bGPIOCyclicCounter = 11;
        write("P42_cyclic_on");
      }
      else
      {
        cancelTimer( tGPIO_CyclicReadSwitch );
        bGPIOCyclicCounter = 11;
        write("P42_cyclic_off");
      }
    }
    break;
    case 11:
    {
      if (getValue(DIAG_GPIO_Read_P43_Cyclic) == 1)
      {
        DIAG_Queue_InsertCommand( cService_ReadPhysicalPorts_P43 );
        DIAG_CTRL_vStartNewService();
        cancelTimer( tGPIO_CyclicReadSwitch );
        bGPIOCyclicCounter = 12;
        write("P43_cyclic_on");
      }
      else
      {
        cancelTimer( tGPIO_CyclicReadSwitch );
        bGPIOCyclicCounter = 12;
        write("P43_cyclic_off");
      }
    }
    break;
    case 12:
    {
      if (getValue(DIAG_GPIO_Read_P44_Cyclic) == 1)
      {
        DIAG_Queue_InsertCommand( cService_ReadPhysicalPorts_P44 );
        DIAG_CTRL_vStartNewService();
        cancelTimer( tGPIO_CyclicReadSwitch );
        bGPIOCyclicCounter = 13;
        write("P44_cyclic_on");
      }
      else
      {
        cancelTimer( tGPIO_CyclicReadSwitch );
        bGPIOCyclicCounter = 13;
        write("P44_cyclic_off");
      }
    }
    break;
    case 13:
    {
      if (getValue(DIAG_GPIO_Read_P45_Cyclic) == 1)
      {
        DIAG_Queue_InsertCommand( cService_ReadPhysicalPorts_P45 );
        DIAG_CTRL_vStartNewService();
        cancelTimer( tGPIO_CyclicReadSwitch );
        bGPIOCyclicCounter = 14;
        write("P45_cyclic_on");
      }
      else
      {
        cancelTimer( tGPIO_CyclicReadSwitch );
        bGPIOCyclicCounter = 14;
        write("P45_cyclic_off");
      }
    }
    break;
    case 14:
    {
      if (getValue(DIAG_GPIO_Read_JP0_Cyclic) == 1)
      {
        DIAG_Queue_InsertCommand( cService_ReadPhysicalPorts_JP0 );
        DIAG_CTRL_vStartNewService();
        cancelTimer( tGPIO_CyclicReadSwitch );
        bGPIOCyclicCounter = 15;
        write("JP0_cyclic_on");
      }
      else
      {
        cancelTimer( tGPIO_CyclicReadSwitch );
        bGPIOCyclicCounter = 15;
        write("JP0_cyclic_off");
      }
    }
    break;
    default:
      write("DEFAULT");
      bGPIOCyclicCounter = 0;
      break;  
  }
  
  if(getValue(DIAG_GPIO_CyclicReadSwitch)==1)
    setTimer( tGPIO_CyclicReadSwitch, 1000 );
  else
    cancelTimer( tGPIO_CyclicReadSwitch );
}

on timer tADC_GetRawChannelsCyclic
{
    if( getValue( DIAG_ADC_ReadCyclic ) )
    {
        setTimer( tADC_GetRawChannelsCyclic, wReadRawADC_ChannelsTimer );
        ADC_InsertAllReadRawRequests();
        DIAG_CTRL_vStartNewService();
    }
}

on timer tADC_GetRaw_TimeOutTimer
{
    putValue( DIAG_Main_ErrorStatus, "Timeout der Antwort!" );
    bQueueWaitForResponce = FALSE;
    DIAG_CTRL_vStartNewService();
}

on timer tCAL_ReadTimeOutTimer
{
    putValue( DIAG_CAL_StatusBar , "Timeout of answer!" );
    bQueueWaitForResponce = FALSE;
    DIAG_CTRL_vStartNewService();
}

on timer tCalibrate_ClockTimeOutTimer
{
    putValue( DIAG_CALClock_UserCommandLine, "Timeout !  Diag-Session Started?" );
    bQueueWaitForResponce = FALSE;
    DIAG_CTRL_vStartNewService();
}

on timer tCalibrate_KL30TimeOutTimer
{
    putValue( DIAG_CALKL30_UserCommandLine , "Timeout !  Diag-Session Started?" );
    bQueueWaitForResponce = FALSE;
    DIAG_CTRL_vStartNewService();
}

on timer tDIO_AC_TimeOutTimer
{
    putValue( DIAG_DIO_StatusBar , "Timeout of answer ( tDIO_ReadP0_17AC_TimeOutTimer )!" );
    bQueueWaitForResponce = FALSE;
    DIAG_CTRL_vStartNewService();
}

on timer tDIO_GC_TimeOutTimer
{
    putValue( DIAG_DIO_StatusBar , "Timeout of answer! ( tDIO_ReadGC_All_TimeOutTimer )" );
    bQueueWaitForResponce = FALSE;
    DIAG_CTRL_vStartNewService();
}

on timer tDIO_ReadGC_All_CyclicTimer
{
    if( getValue( DIAG_DIO_ReadAC_All_Cyclic ) )
    {
        setTimer( tDIO_ReadGC_All_CyclicTimer, wReadDIO_GC_ChannelsTimer );
        DIAG_Queue_InsertCommand( cService_Routine_ReadGC_All );
        DIAG_CTRL_vStartNewService();
    }
}

on timer tDIO_ReadAC_All_CyclicTimer
{
    if( getValue( DIAG_DIO_ReadAC_All_Cyclic ) )
    {
        setTimer( tDIO_ReadAC_All_CyclicTimer, wReadDIO_AC_ChannelsTimer );
        DIAG_Queue_InsertCommand( cService_Routine_ReadAC_All );
        DIAG_CTRL_vStartNewService();
    }
}

on timer tDSP_StartControlTimeOutTimer
{
    putValue( DIAG_Main_ErrorStatus, "Timeout der Antwort!" );
    bQueueWaitForResponce = FALSE;   
    DIAG_CTRL_vStartNewService();
}

on timer tDSP_StopControlTimeOutTimer
{
    putValue( DIAG_Main_ErrorStatus, "Timeout der Antwort!" );
    bQueueWaitForResponce = FALSE;    
    DIAG_CTRL_vStartNewService();
}

on timer tDTC_ReadCyclicTimer
{
    if( getValue( DIAG_DTC_ReadCyclicActive ) )
    {
        DIAG_Queue_InsertCommand( cService_Routine_ReadDTC );
        setTimer( tDTC_ReadCyclicTimer, 1000 );
        DIAG_CTRL_vStartNewService();
    }
}

on timer tDTC_ReadTimeOutTimer
{
    putValue( DIAG_Main_ErrorStatus, "Timeout der Antwort!" );
    bQueueWaitForResponce = FALSE;
    DIAG_CTRL_vStartNewService();
}

on timer tDelay_Timer
{
    bQueueWaitForResponce = FALSE;
    DiagAktion = 0; 
    DIAG_CTRL_vStartNewService();
}

on timer tEMCTimer
{
    setTimer( tEMCTimer, getValue( DIAG_CTRL_EMC_Cycle_Time ) );
    ADC_InsertAllReadRawRequests();
    DIAG_Queue_InsertCommand( cService_Routine_ReadAC_All );
    DIAG_CTRL_vStartNewService();
}

on timer tID_Get_TimeOutTimer
{
    putValue( DIAG_Main_ErrorStatus, "Timeout der Antwort!" );
    bQueueWaitForResponce = FALSE;
    DIAG_CTRL_vStartNewService();
}

on timer tLVDS_ReadTimeOutTimer   // Timeout-Timer
{
    putValue( DIAG_Main_ErrorStatus, "Timeout der Antwort!" );
    bQueueWaitForResponce = FALSE;
    DIAG_CTRL_vStartNewService();
}

on timer tLVDS_WriteTimeOutTimer   // Timeout-Timer
{
    putValue( DIAG_Main_ErrorStatus, "Timeout der Antwort!" );
    bQueueWaitForResponce = FALSE;
    DIAG_CTRL_vStartNewService();
}

on timer tLoggingTimer
{
    setTimer( tLoggingTimer, getValue( DIAG_CTRL_LOG_Cycle_Time ) );
    DIAG_LOG_InsertCommandToQueue();
}

on timer tMRW_FormatFEE_TimeOutTimer
{
    putValue( DIAG_Main_ErrorStatus, "Timeout der Antwort!" );
    bQueueWaitForResponce = FALSE;
    DiagAktion = 0;   
    DIAG_CTRL_vStartNewService();
}

on timer tMRW_InterBlockDelay
{
    MRW_vWriteFileRcdWriteMemAddr(); 
}

on timer tMRW_ReadCyclic
{
    if( DIAG__iMRWCyclicReadShadow[ DIAG__bMRWActDataSet ] )
    {
        MRW_vReadMemoryPressed();
        setTimer( tMRW_ReadCyclic, DIAG__iMRWCycReadIntervShadow[ DIAG__bMRWActDataSet ] );
    }
}

on timer tMRW_TimeoutTimer
{
    putValue( DIAG_Main_ErrorStatus, "Timeout der Antwort! ( MRW-Timeout Timer )" );
    bQueueWaitForResponce = FALSE;
    DiagAktion = 0;   
    DIAG_CTRL_vStartNewService();
}

on timer tPWM_ReadAllValuesCycleTimer
{
    if( getValue( DIAG_PWM_ReadCyclic ) )       // 730
        setTimer( tPWM_ReadAllValuesCycleTimer, getValue( DIAG_PWM_ReadCycleTime ) );
    PWM_InsertAllReadRequests();
    DIAG_CTRL_vStartNewService();
}

on timer tPWM_TimeOutTimer
{
    putValue( DIAG_PWM_StatusBar, "Timeout der Antwort!" );
    bQueueWaitForResponce = FALSE;
    DIAG_CTRL_vStartNewService();
    write("%d", DiagAktion);
}

on timer tGPIO_TimeOutTimer
{
    bQueueWaitForResponce = FALSE;
    DIAG_CTRL_vStartNewService();
}

on timer tSND_StartControlTimeOutTimer
{
    putValue( DIAG_Main_ErrorStatus, "Timeout der Antwort!" );
    bQueueWaitForResponce = FALSE;
    DIAG_CTRL_vStartNewService();
}

on timer tSND_StopControlTimeOutTimer
{
    putValue( DIAG_Main_ErrorStatus, "Timeout der Antwort!" );
    bQueueWaitForResponce = FALSE;
    DIAG_CTRL_vStartNewService();
}

on timer tSND_VolumeControlTimeOutTimer
{
    putValue( DIAG_Main_ErrorStatus, "Timeout der Antwort!" );
    bQueueWaitForResponce = FALSE;
    DIAG_CTRL_vStartNewService();
}

on timer tSecLevel_SendTimeOutTimer
{
    putValue( DIAG_Main_ErrorStatus, "Timeout der Antwort!" );
    bQueueWaitForResponce = FALSE;
    DIAG_CTRL_vStartNewService();
}

on timer tSessionSendTimeOutTimer
{
    putValue( DIAG_Main_ErrorStatus, "Timeout der Antwort!" );
    bQueueWaitForResponce = FALSE;
    DIAG_CTRL_vStartNewService();
}

on timer tTesterPresentTimer
{
    // uds tester present
    rqBuf[0] = 0x3E;
    if( getValue( DIAG_CTRL_SendTP_SupAnswer ) )
        rqBuf[1] = 0x80;
    else
        rqBuf[1] = 0x00;
    if( TesterPresentPhysFkt == cFUNCTIONAL )
        DIAG_SendRequest( cFUNCTIONAL, 2 );
    else
        DIAG_SendRequest( cPHYSICAL, 2 );
     setTimer( tTesterPresentTimer, TesterPresentTime );
}

on envVar DIAG_KL15ON_OFF
{  
  if(getValue(this)==0x01)
  {
      x=0x00;
      putValue(DIAG_KL15ON_OFF_no, 0x00); 
      setTimer( KL15_ON_OFF, 5 );
  }
  else
  {
     cancelTimer(KL15_ON_OFF);
  }
}

on envVar Lane_Departure_white
{
  byte state;
  
  state = getValue(this);
  
  switch(state)
  {
    case 1:
    {
      if(initial_white == 0x00)
      {
        putValue(HMI_LDP_IndLmp_On_Rq_V2, 0x02);
        putValue(Lane_Departure_red_blink, 0x00);
        putValue(Lane_Departure_OFF, 0x00);
        initial_white = 0x01;
        initial_red   = 0x00;
        initial_OFF   = 0x00;        
      }
      else
      {
        initial_white = 0x00;
      }
    break;
    }      
    case 0:
    {
      if(initial_white == 0x01)
      {
        putValue(HMI_LDP_IndLmp_On_Rq_V2, 0x01);
        putValue(Lane_Departure_red_blink, 0x00);
        putValue(Lane_Departure_OFF, 0x00);
        initial_white = 0x00;
        initial_red   = 0x00;
        initial_OFF   = 0x00;
      }
    
      break;
    }
  }
}

on envVar Lane_Departure_red_blink
{
  byte state;
  
  state = getValue(this);
  
  switch(state)
  {
    case 1:
    {
      if(initial_red == 0x00)
      {
        putValue(HMI_LDP_IndLmp_On_Rq_V2, 0x07);
        putValue(Lane_Departure_white, 0x00);
        putValue(Lane_Departure_OFF, 0x00);
        initial_white = 0x00;
        initial_red   = 0x01;
        initial_OFF   = 0x00;
      }
      else
      {
        initial_white = 0x00;
      }
    }
      break;
    case 0:
    {
      if(initial_red == 0x01)
      {
        putValue(HMI_LDP_IndLmp_On_Rq_V2, 0x01);
        putValue(Lane_Departure_white, 0x00);
        putValue(Lane_Departure_OFF, 0x00);
        initial_white = 0x00;
        initial_red   = 0x00;
        initial_OFF   = 0x00;
      }
    }
      break;
  }
}

on envVar Lane_Departure_OFF
{
  byte state;
  
  state = getValue(this);
  
  switch(state)
  {
    case 1:
    {
      if(initial_OFF == 0x00)
      {
        putValue(HMI_LDP_IndLmp_On_Rq_V2, 0x00);
        putValue(Lane_Departure_red_blink, 0x00);
        putValue(Lane_Departure_white, 0x00);
        initial_white = 0x00;
        initial_red   = 0x00;
        initial_OFF   = 0x01;
      }
      else
      {
        initial_OFF = 0x00;
      }
    }
      break;
    case 0:
    {
      if(initial_OFF == 0x01)
      {
        putValue(HMI_LDP_IndLmp_On_Rq_V2, 0x01);
        putValue(Lane_Departure_red_blink, 0x00);
        putValue(Lane_Departure_white, 0x00);
        initial_white = 0x00;
        initial_red   = 0x00;
        initial_OFF   = 0x00;
      }
    }
      break;
  }
}


On EnvVar DIAG_CTRL_DiagnoseMainOnOff
{
    int nECU;

    if( getValue( this ) )
    {
        if( FillCommand( SessionPhys ) ) return;
        if( DiagnoseAktiv)
        {
             cancelTimer( tTesterPresentTimer);
             DiagnoseAktiv=0;
             putValue( DIAG_CTRL_Disp_DiagStateOnOff, cInactiv );
             putValue( DIAG_Main_ErrorStatus, "Diagnose deaktiviert." );
             OSEKTL_SetRxId( 0x7FF );
        }
        else
        {
            InitOSEK_TP();
            nECU = getValue( DIAG_CTRL_ECU_Selector );
            OSEKTL_SetRxId( ECUResId[ nECU ] );
            DiagnoseAktiv=1;
            putValue( DIAG_CTRL_Disp_DiagStateOnOff, cActiv );
            cancelTimer( tTesterPresentTimer );
            setTimer( tTesterPresentTimer, FirstTesterPresentTime );
            putValue( DIAG_Main_ErrorStatus, "Diagnose aktiviert." );
        }
    } 
}

on envVar DIAG_ADC_AllChActiv
{
    if( getValue( this ) )
    {
        putValue( DIAG_ADC_Ch00Activ, 1 );
        putValue( DIAG_ADC_Ch01Activ, 1 );
        putValue( DIAG_ADC_Ch02Activ, 1 );
        putValue( DIAG_ADC_Ch03Activ, 1 );
        putValue( DIAG_ADC_Ch04Activ, 1 );
        putValue( DIAG_ADC_Ch05Activ, 1 );
        putValue( DIAG_ADC_Ch06Activ, 1 );
        putValue( DIAG_ADC_Ch07Activ, 1 );
        putValue( DIAG_ADC_Ch08Activ, 1 );
        putValue( DIAG_ADC_Ch09Activ, 1 );
        putValue( DIAG_ADC_Ch10Activ, 1 );
        putValue( DIAG_ADC_Ch11Activ, 1 );
        putValue( DIAG_ADC_Ch12Activ, 1 );
        putValue( DIAG_ADC_Ch13Activ, 1 );
        putValue( DIAG_ADC_Ch14Activ, 1 );
        putValue( DIAG_ADC_Ch15Activ, 1 );
    }
    else
    {
        putValue( DIAG_ADC_Ch00Activ, 0 );
        putValue( DIAG_ADC_Ch01Activ, 0 );
        putValue( DIAG_ADC_Ch02Activ, 0 );
        putValue( DIAG_ADC_Ch03Activ, 0 );
        putValue( DIAG_ADC_Ch04Activ, 0 );
        putValue( DIAG_ADC_Ch05Activ, 0 );
        putValue( DIAG_ADC_Ch06Activ, 0 );
        putValue( DIAG_ADC_Ch07Activ, 0 );
        putValue( DIAG_ADC_Ch08Activ, 0 );
        putValue( DIAG_ADC_Ch09Activ, 0 );
        putValue( DIAG_ADC_Ch10Activ, 0 );
        putValue( DIAG_ADC_Ch11Activ, 0 );
        putValue( DIAG_ADC_Ch12Activ, 0 );
        putValue( DIAG_ADC_Ch13Activ, 0 );
        putValue( DIAG_ADC_Ch14Activ, 0 );
        putValue( DIAG_ADC_Ch15Activ, 0 );
    }
}

on envVar DIAG_ADC_AllChLogActiv
{
    if( getValue( this ) )
    {
        putValue( DIAG_ADC_Ch00Log, 1 );
        putValue( DIAG_ADC_Ch01Log, 1 );
        putValue( DIAG_ADC_Ch02Log, 1 );
        putValue( DIAG_ADC_Ch03Log, 1 );
        putValue( DIAG_ADC_Ch04Log, 1 );
        putValue( DIAG_ADC_Ch05Log, 1 );
        putValue( DIAG_ADC_Ch06Log, 1 );
        putValue( DIAG_ADC_Ch07Log, 1 );
        putValue( DIAG_ADC_Ch08Log, 1 );
        putValue( DIAG_ADC_Ch09Log, 1 );
        putValue( DIAG_ADC_Ch10Log, 1 );
        putValue( DIAG_ADC_Ch11Log, 1 );
        putValue( DIAG_ADC_Ch12Log, 1 );
        putValue( DIAG_ADC_Ch13Log, 1 );
        putValue( DIAG_ADC_Ch14Log, 1 );
        putValue( DIAG_ADC_Ch15Log, 1 );
    }
    else
    {
        putValue( DIAG_ADC_Ch00Log, 0 );
        putValue( DIAG_ADC_Ch01Log, 0 );
        putValue( DIAG_ADC_Ch02Log, 0 );
        putValue( DIAG_ADC_Ch03Log, 0 );
        putValue( DIAG_ADC_Ch04Log, 0 );
        putValue( DIAG_ADC_Ch05Log, 0 );
        putValue( DIAG_ADC_Ch06Log, 0 );
        putValue( DIAG_ADC_Ch07Log, 0 );
        putValue( DIAG_ADC_Ch08Log, 0 );
        putValue( DIAG_ADC_Ch09Log, 0 );
        putValue( DIAG_ADC_Ch10Log, 0 );
        putValue( DIAG_ADC_Ch11Log, 0 );
        putValue( DIAG_ADC_Ch12Log, 0 );
        putValue( DIAG_ADC_Ch13Log, 0 );
        putValue( DIAG_ADC_Ch14Log, 0 );
        putValue( DIAG_ADC_Ch15Log, 0 );
    }
}

on envVar DIAG_ADC_ReadCycleTime
{
    if( getValue( this ) < cDIAG_ADC_ReadCycleTime )
    {
        wReadRawADC_ChannelsTimer = cDIAG_ADC_ReadCycleTime;
        putValue( DIAG_ADC_ReadCycleTime, cDIAG_ADC_ReadCycleTime );
    }
    else
        wReadRawADC_ChannelsTimer = getValue( this );
}

on envVar DIAG_ADC_ReadCyclic
{
    if( getValue( this ) )
    {
        if( getValue( DIAG_ADC_ReadCycleTime ) < cDIAG_ADC_ReadCycleTime )
        {
            wReadRawADC_ChannelsTimer = cDIAG_ADC_ReadCycleTime;
            putValue( DIAG_ADC_ReadCycleTime, cDIAG_ADC_ReadCycleTime );
        }
        setTimer( tADC_GetRawChannelsCyclic, wReadRawADC_ChannelsTimer );
        ADC_InsertAllReadRawRequests();
        DIAG_CTRL_vStartNewService(); 
    }
    else
    {
        cancelTimer( tADC_GetRawChannelsCyclic );
    }
}

on envVar DIAG_ADC_ResetMaxValues
{
    if( getValue( this ) )
    {
        putValue( DIAG_ADC_Ch00Max,     0 ); wADCRawMax[ 0] = 0;
        putValue( DIAG_ADC_Ch01Max,     0 ); wADCRawMax[ 1] = 0;
        putValue( DIAG_ADC_Ch02Max,     0 ); wADCRawMax[ 2] = 0;
        putValue( DIAG_ADC_Ch03Max,     0 ); wADCRawMax[ 3] = 0;
        putValue( DIAG_ADC_Ch04Max,     0 ); wADCRawMax[ 4] = 0;
        putValue( DIAG_ADC_Ch05Max,     0 ); wADCRawMax[ 5] = 0;
        putValue( DIAG_ADC_Ch06Max,     0 ); wADCRawMax[ 6] = 0;
        putValue( DIAG_ADC_Ch07Max,     0 ); wADCRawMax[ 7] = 0;
        putValue( DIAG_ADC_Ch08Max,     0 ); wADCRawMax[ 8] = 0;
        putValue( DIAG_ADC_Ch09Max,     0 ); wADCRawMax[ 9] = 0;
        putValue( DIAG_ADC_Ch10Max,     0 ); wADCRawMax[10] = 0;
        putValue( DIAG_ADC_Ch11Max,     0 ); wADCRawMax[11] = 0;
        putValue( DIAG_ADC_Ch12Max,     0 ); wADCRawMax[12] = 0;
        putValue( DIAG_ADC_Ch13Max,     0 ); wADCRawMax[13] = 0;
        putValue( DIAG_ADC_Ch14Max,     0 ); wADCRawMax[14] = 0;
        putValue( DIAG_ADC_Ch15Max,     0 ); wADCRawMax[15] = 0;
    }
}

on envVar DIAG_ADC_ResetMinValues
{
    if( getValue( this ) )
    {
        putValue( DIAG_ADC_Ch00Min, 0x3ff ); wADCRawMin[ 0] = 0x3ff;
        putValue( DIAG_ADC_Ch01Min, 0x3ff ); wADCRawMin[ 1] = 0x3ff;
        putValue( DIAG_ADC_Ch02Min, 0x3ff ); wADCRawMin[ 2] = 0x3ff;
        putValue( DIAG_ADC_Ch03Min, 0x3ff ); wADCRawMin[ 3] = 0x3ff;
        putValue( DIAG_ADC_Ch04Min, 0x3ff ); wADCRawMin[ 4] = 0x3ff;
        putValue( DIAG_ADC_Ch05Min, 0x3ff ); wADCRawMin[ 5] = 0x3ff;
        putValue( DIAG_ADC_Ch06Min, 0x3ff ); wADCRawMin[ 6] = 0x3ff;
        putValue( DIAG_ADC_Ch07Min, 0x3ff ); wADCRawMin[ 7] = 0x3ff;
        putValue( DIAG_ADC_Ch08Min, 0x3ff ); wADCRawMin[ 8] = 0x3ff;
        putValue( DIAG_ADC_Ch09Min, 0x3ff ); wADCRawMin[ 9] = 0x3ff;
        putValue( DIAG_ADC_Ch10Min, 0x3ff ); wADCRawMin[10] = 0x3ff;
        putValue( DIAG_ADC_Ch11Min, 0x3ff ); wADCRawMin[11] = 0x3ff;
        putValue( DIAG_ADC_Ch12Min, 0x3ff ); wADCRawMin[12] = 0x3ff;
        putValue( DIAG_ADC_Ch13Min, 0x3ff ); wADCRawMin[13] = 0x3ff;
        putValue( DIAG_ADC_Ch14Min, 0x3ff ); wADCRawMin[14] = 0x3ff;
        putValue( DIAG_ADC_Ch15Min, 0x3ff ); wADCRawMin[15] = 0x3ff;
    }
}

on envVar DIAG_ADC_StartReadRaw
{
    if( getValue( this ) )
    {
        if( getValue( DIAG_ADC_ReadCyclic ) )
            setTimer( tADC_GetRawChannelsCyclic, wReadRawADC_ChannelsTimer );
        ADC_InsertAllReadRawRequests();
        DIAG_CTRL_vStartNewService();
    }
}

on envVar DIAG_ADC_StopReadRaw
{
    cancelTimer( tADC_GetRawChannelsCyclic );
    cancelTimer( tADC_GetRaw_TimeOutTimer );
    putValue( DIAG_ADC_StatusBar, "Stopped ..." );
    DIAG_CTRL_vStartNewService();
}

on envVar DIAG_CALClock_Freq_Higher
{
    if( getValue( this ) )
    {
        EnableControl( "Calibrate Clock", "Freq_kleiner_Eingabefeld", 0 );
        EnableControl( "Calibrate Clock", "Freq_groesser_Eingabefeld", 1 );
    }
    else
    {
        EnableControl( "Calibrate Clock", "Freq_kleiner_Eingabefeld", 1 );
        EnableControl( "Calibrate Clock", "Freq_groesser_Eingabefeld", 0 );
    }
}

on envVar DIAG_CALClock_Frequency_from_counter
{
    word wCalVal;
    dwFrequencyMainOsziAC = 3999000;
    if( getValue( DIAG_CALClock_Freq_Higher ) )
        dwFrequencyMainOsziAC = dwFrequencyMainOsziAC + 1000;
    dwFrequencyMainOsziAC = dwFrequencyMainOsziAC + getValue( this );

    if( dwFrequencyMainOsziAC > 4000000 )
    {
        wCalVal = dwFrequencyMainOsziAC - 4000000;
    }
    else
    {
        wCalVal = 4000000 - dwFrequencyMainOsziAC;
        wCalVal = 0x8000 + wCalVal;
    }
    rqBuf[ 7 ] = wCalVal & 0xff;
    putValue( DIAG_CALClock_LowValue_FEE, wCalVal & 0xff );
    rqBuf[ 8 ] = wCalVal >> 8;
    putValue( DIAG_CALClock_HighValue_FEE, wCalVal >> 8 );
}

on envVar DIAG_CALClock_StartCalTrigger_AC_MainOszi
{
    if( getValue( this ) )
    {
        DIAG_Queue_InsertCommand( cService_Routine_Calibrate_Clock );
        DIAG_CTRL_vStartNewService();
    }
}

on envVar DIAG_CALClock_StartTrigger_AC_MainOszi
{
    if( getValue( this ) )
    {
        DIAG_Queue_InsertCommand( cService_Routine_Enable_AC_MainOszi );
        DIAG_CTRL_vStartNewService();
    }
}

on envVar DIAG_CALClock_StartTrigger_AC_SubOszi
{
    if( getValue( this ) )
    {
        DIAG_Queue_InsertCommand( cService_Routine_Enable_AC_SubOszi );
        DIAG_CTRL_vStartNewService();
    }
}

on envVar DIAG_CALClock_StartTrigger_GC_MainOszi
{
    if( getValue( this ) )
    {
        DIAG_Queue_InsertCommand( cService_Routine_Enable_GC_MainOszi );
        DIAG_CTRL_vStartNewService();
    }
}

on envVar DIAG_CALClock_StoreCal
{
    if( getValue( this ) )
    {
        if( getValue( DIAG_CTRL_IC_Type_Selector ) == cKI_W222 )   // W222 only
        {
            DIAG_Queue_InsertCommand( cService_Routine_StoreMainCal );
            DIAG_CTRL_vStartNewService();
        }
    }
}

on envVar DIAG_CALKL30_CalStepDone
{
    if( getValue( this ) )
    {
        DIAG_Queue_InsertCommand( cService_Routine_Calibrate_KL30_GetValue );
        DIAG_CTRL_vStartNewService();
    }
}

on envVar DIAG_CALKL30_StartTrigger
{
    if( getValue( this ) )
    {
        EnableControl( "Calibrate KL30", "EnvVar:DIAG_CALKL30_StoreCal", 0 );
        DIAG_Queue_InsertCommand( cService_Routine_Calibrate_KL30_Init );
        DIAG_CTRL_vStartNewService();
    }
}

on envVar DIAG_CALKL30_StoreCal
{
    if( getValue( this ) )
    {
	DIAG_Queue_InsertCommand( cService_Routine_Calibrate_KL30_StoreCal );
        DIAG_CTRL_vStartNewService();
    }
}

on envVar DIAG_CAL_ReadValues_Trigger
{
    if( getValue( this ) )
    {
        DIAG_Queue_InsertCommand( cService_SessionLevelCheck_Supplier );
        DIAG_Queue_InsertCommand( cService_SessionLevel_Supplier );
        DIAG_Queue_InsertCommand( cService_SecLevel_Supplier );
        DIAG_Queue_InsertCommand( cService_Routine_ReadCalDDR3 );
        DIAG_Queue_InsertCommand( cService_Routine_ReadCalVCom );
        DIAG_Queue_InsertCommand( cService_Routine_ReadCalGamma );
        DIAG_Queue_InsertCommand( cService_Routine_ReadCalWhiteBal );
        DIAG_Queue_InsertCommand( cService_Routine_ReadCalMVOControl );
        DIAG_Queue_InsertCommand( cService_Routine_ReadCalSoundVolume );
        DIAG_Queue_InsertCommand( cService_Routine_ReadCalKL30Cal );
        DIAG_Queue_InsertCommand( cService_Routine_ReadCalQuartzCal );
        DIAG_Queue_InsertCommand( cService_Routine_ReadCalShowVal );
        DIAG_CTRL_vStartNewService();
    }
}

on envVar DIAG_CTRL_DisableNormCom_Fkt
{
    if( getValue( this ) )
    {
        DIAG_Queue_InsertCommand( cService_Routine_DisableNormalComFkt );
        DIAG_CTRL_vStartNewService();
    }
}

on envVar DIAG_CTRL_DisableNormCom_Phys
{
    if( getValue( this ) )
    {
        DIAG_Queue_InsertCommand( cService_Routine_DisableNormalComPhys );
        DIAG_CTRL_vStartNewService();
    }
}

on envVar DIAG_CTRL_EnableNormCom_Fkt
{
    if( getValue( this ) )
    {
        DIAG_Queue_InsertCommand( cService_Routine_EnableNormalComFkt );
        DIAG_CTRL_vStartNewService();
    }
}

on envVar DIAG_CTRL_EnableNormCom_Phys
{
    if( getValue( this ) )
    {
        DIAG_Queue_InsertCommand( cService_Routine_EnableNormalComPhys );
        DIAG_CTRL_vStartNewService();
    }
}

on envVar DIAG_CTRL_HardReset_Fkt
{
    if( getValue( this ) )
    {
        DIAG_Queue_InsertCommand( cService_Routine_HardResetFkt );
        DIAG_CTRL_vStartNewService();
    }
}

on envVar DIAG_CTRL_HardReset_Phys
{
    if( getValue( this ) )
    {
        DIAG_Queue_InsertCommand( cService_Routine_HardResetPhys );
        DIAG_CTRL_vStartNewService();
    }
}

on envVar DIAG_CTRL_IC_Type_Selector
{
    EnableControl( "Calibrate Clock", "Button:DIAG_CALClock_StoreCal", 0 ); // default

    if( getValue( this ) == cKI_W222 )  // W222
    {
        // PWM-Setup
        cPWM_IndexToChannel[0] =  0x11;
        cPWM_IndexToChannel[1] =  0x12;
        cPWM_IndexToChannel[2] =  0x13;
        cPWM_IndexToChannel[3] =  0x15;
        cPWM_IndexToChannel[4] =  0x25;
        cPWM_IndexToChannel[5] =  0x27;
        cPWM_IndexToChannel[6] =  0x33;
        cPWM_IndexToChannel[7] =  0x35;
        cPWM_IndexToChannel[8] =  0x37;
        cPWM_IndexToChannel[9] =  0x37;
        cPWM_IndexToChannel[10] = 0x37;
        cPWM_IndexToChannel[11] = 0x37;
        cPWM_IndexToChannel[12] = 0x37;
        putValue( DIAG_PWM_Ch00Title, "TAUA 1O1  ML_BL_PWMDIMM1" );
        putValue( DIAG_PWM_Ch01Title, "TAUA 1O2     BL phaseshift" );
        putValue( DIAG_PWM_Ch02Title, "TAUA 1O3  ML_BL_PWMDIMM2" );
        putValue( DIAG_PWM_Ch03Title, "TAUA 1O5  ML_BL_SSC" );
        putValue( DIAG_PWM_Ch04Title, "TAUA 2O5  ML_BL1_Sync" );
        putValue( DIAG_PWM_Ch05Title, "TAUA 2O7  ML_BL2_Sync" );
        putValue( DIAG_PWM_Ch06Title, "TAUA 3O3  ML_CBL_PWM1" );
        putValue( DIAG_PWM_Ch07Title, "TAUA 3O5  ML_CBL_PWM2" );
        putValue( DIAG_PWM_Ch08Title, "TAUA 3O7  ML_CBL_PWM3" );
        putValue( DIAG_PWM_Ch09Title, "   " );
        putValue( DIAG_PWM_Ch10Title, "   " );
        putValue( DIAG_PWM_Ch11Title, "   " );
        putValue( DIAG_PWM_Ch12Title, "   " );
        putValue( DIAG_PWM_Ch13Title, "   " );
        putValue( DIAG_PWM_Ch14Title, "   " );

        //  ADC Kanäle
        putValue( DIAG_ADC_Ch00Title, "ML_ADC_NTC_BL_TFT" );
        putValue( DIAG_ADC_Ch01Title, "ML_ADC_BL_STATUS" );
        putValue( DIAG_ADC_Ch02Title, "ML_ADC_NTC_BL_FET1" );
        putValue( DIAG_ADC_Ch03Title, "ML_ADC_NTC_BL_FET2" );
        putValue( DIAG_ADC_Ch04Title, "ML_ADC_CBL_LSS_STAT" );
        putValue( DIAG_ADC_Ch05Title, "GND" );
        putValue( DIAG_ADC_Ch06Title, "ML_ADC_KL30" );
        putValue( DIAG_ADC_Ch07Title, "ML_ADC_5VG" );
        putValue( DIAG_ADC_Ch08Title, "ML_ADC_NTC_AUDIO" );
        putValue( DIAG_ADC_Ch09Title, "ML_ADC_NTC_PL_DDR" );
        putValue( DIAG_ADC_Ch10Title, "ML_ADC_NTC_NEURAL" );
        putValue( DIAG_ADC_Ch11Title, "ML_ADC_NTC_MPS_1" );
        putValue( DIAG_ADC_Ch12Title, "ML_ADC_NTC_MPS_2" );
        putValue( DIAG_ADC_Ch13Title, "TFT_ML_ADC_12V5" );
        putValue( DIAG_ADC_Ch14Title, "TFT_ML_ADC_GAMMA_V[0]" );
        putValue( DIAG_ADC_Ch15Title, "TFT_ML_ADC_VCOM" );
        EnableControl( "Calibrate Clock", "Button:DIAG_CALClock_StoreCal", 1 );

    }
    if( getValue( this ) == cKI_W205 )  // W205
    {
        // PWM-Setup
        cPWM_IndexToChannel[0] =  0x11; // W205
        cPWM_IndexToChannel[1] =  0x12;
        cPWM_IndexToChannel[2] =  0x17;
        cPWM_IndexToChannel[3] =  0x13;
        cPWM_IndexToChannel[4] =  0x1A;
        cPWM_IndexToChannel[5] =  0x15;
        cPWM_IndexToChannel[6] =  0x1B;
        cPWM_IndexToChannel[7] =  0x1D;
        cPWM_IndexToChannel[8] =  0x25;
        cPWM_IndexToChannel[9] =  0x2B;
        cPWM_IndexToChannel[10] = 0x2D;
        cPWM_IndexToChannel[11] = 0x33;
        cPWM_IndexToChannel[12] = 0x37;
        cPWM_IndexToChannel[13] = 0x7F;
        cPWM_IndexToChannel[14] = 0x7F;
        putValue( DIAG_PWM_Ch00Title, "TAUA 1O1  ML_ILLU_ART" );
        putValue( DIAG_PWM_Ch01Title, "TAUA 1O2  ML_ILLU_BAR_FU" );
        putValue( DIAG_PWM_Ch02Title, "TAUA 1O7  ML_ILLU_BAR_PASS_FU" );
        putValue( DIAG_PWM_Ch03Title, "TAUA 1O3  ML_ILLU_BAR_TE" );
        putValue( DIAG_PWM_Ch04Title, "TAUA 1O10 ML_ILLU_BAR_PASS_TE" );
        putValue( DIAG_PWM_Ch05Title, "TAUA 1O5  ML_ILLU_PTR" );
        putValue( DIAG_PWM_Ch06Title, "TAUA 1O11 ML_ILLU_DIAL_BARGRAPHEN" );
        putValue( DIAG_PWM_Ch07Title, "TAUA 1O13 ML_ILLU_DIAL" );
        putValue( DIAG_PWM_Ch08Title, "TAUA 2O5  ML_ILLU_TT_0" );
        putValue( DIAG_PWM_Ch09Title, "TAUA 2O11 ML_ILLU_TT_1" );
        putValue( DIAG_PWM_Ch10Title, "TAUA 2O13 ML_ILLU_TT_2" );
        putValue( DIAG_PWM_Ch11Title, "TAUA 3O3  ML_BL_DIMM_CH1" );
        putValue( DIAG_PWM_Ch12Title, "TAUA 3O7  ML_BL_DIMM_CH2" );
        putValue( DIAG_PWM_Ch13Title, "   " );
        putValue( DIAG_PWM_Ch14Title, "   " );

        // ADC-Setup
        putValue( DIAG_ADC_Ch00Title, "NTC_ML_ADC_TFT" );
        putValue( DIAG_ADC_Ch01Title, "MPS_ML_ADC_BOOST" );
        putValue( DIAG_ADC_Ch02Title, "GND" );
        putValue( DIAG_ADC_Ch03Title, "NTC_ML_ADC_BL" );
        putValue( DIAG_ADC_Ch04Title, "NTC_ML_ADC_AUDIO" );
        putValue( DIAG_ADC_Ch05Title, "KL30_ML_ADC" );
        putValue( DIAG_ADC_Ch06Title, "GND" );
        putValue( DIAG_ADC_Ch07Title, "5V_ML_ADC_5V" );
        putValue( DIAG_ADC_Ch08Title, "NTC_ML_ADC_DDR" );
        putValue( DIAG_ADC_Ch09Title, "NTC_ML_ADC_MPS2" );
        putValue( DIAG_ADC_Ch10Title, "NTC_ML_ADC_MPS1" );
        putValue( DIAG_ADC_Ch11Title, "NTC_ML_ADC_NEUTRAL" );
        putValue( DIAG_ADC_Ch12Title, "BL_ML_ADC_CH2" );
        putValue( DIAG_ADC_Ch13Title, "BL_ML_ADC_CH1" );
        putValue( DIAG_ADC_Ch14Title, "ADC_ML_PHOTO_AMB" );
        putValue( DIAG_ADC_Ch15Title, "ADC_ML_PHOTO_DIESEL" );

    }
    if( getValue( this ) == cKI_W213_EL )  // W213 Entry-Line
    {
        // PWM-Setup
        cPWM_IndexToChannel[0] =  0x11;
        cPWM_IndexToChannel[1] =  0x15;
        cPWM_IndexToChannel[2] =  0x17;
        cPWM_IndexToChannel[3] =  0x19;
        cPWM_IndexToChannel[4] =  0x1B;
        cPWM_IndexToChannel[5] =  0x1D;
        cPWM_IndexToChannel[6] =  0x1F;
        cPWM_IndexToChannel[7] =  0x29;
        cPWM_IndexToChannel[8] =  0x2B;
        cPWM_IndexToChannel[9] =  0x2E;
        cPWM_IndexToChannel[10] = 0x46;
        cPWM_IndexToChannel[11] = 0x4E;
        cPWM_IndexToChannel[12] = 0x4E;
        putValue( DIAG_PWM_Ch00Title, "TAUA 1O1  AC2ILLU_PWM_DIAL" );
        putValue( DIAG_PWM_Ch01Title, "TAUA 1O5  AC2ILLU_PWM_PTR" );
        putValue( DIAG_PWM_Ch02Title, "TAUA 1O7  AC2ILLU_PWM_FU_PASS" );
        putValue( DIAG_PWM_Ch03Title, "TAUA 1O9  AC2ILLU_PWM_TT " );
        putValue( DIAG_PWM_Ch04Title, "TAUA 1OB  AC2ILLU_PWM_TE " );
        putValue( DIAG_PWM_Ch05Title, "TAUA 1OD  AC2ILLU_PWM_TE_PASS" );
        putValue( DIAG_PWM_Ch06Title, "TAUA 1OF  AC2ILLU_PWM_ART" );
        putValue( DIAG_PWM_Ch07Title, "TAUA 2O9  AC2MPS_1V3_SSC " );
        putValue( DIAG_PWM_Ch08Title, "TAUA 2OB  AC2BL_PWM_DIMM" );
        putValue( DIAG_PWM_Ch09Title, "TAUA 2OE  AC2ILLU_PWM_RES2" );
        putValue( DIAG_PWM_Ch10Title, "TAUA 4O6  AC2ILLU_PWM_FU" );
        putValue( DIAG_PWM_Ch11Title, "TAUA 4OE  AC2ILLU_PWM_RES1" );
        putValue( DIAG_PWM_Ch12Title, "   " );
        putValue( DIAG_PWM_Ch13Title, "   " );
        putValue( DIAG_PWM_Ch14Title, "   " );

        //  ADC Kanäle
        putValue( DIAG_ADC_Ch00Title, "NTC2AC_ADC_TFT" );
        putValue( DIAG_ADC_Ch01Title, "unused" );
        putValue( DIAG_ADC_Ch02Title, "NTC2AC_ADC_BL" );
        putValue( DIAG_ADC_Ch03Title, "MPS2AC_ADC_NAND_3V3" );
        putValue( DIAG_ADC_Ch04Title, "ILLU2AC_ADC_PHOTO" );
        putValue( DIAG_ADC_Ch05Title, "unused" );
        putValue( DIAG_ADC_Ch06Title, "KL302AC_ADC_KL30" );
        putValue( DIAG_ADC_Ch07Title, "MPS2AC_ADC_5VS1" );
        putValue( DIAG_ADC_Ch08Title, "NTC2AC_ADC_AUDIO" );
        putValue( DIAG_ADC_Ch09Title, "NTC2AC_ADC_DDR" );
        putValue( DIAG_ADC_Ch10Title, "NTC2AC_ADC_NEUTRAL" );
        putValue( DIAG_ADC_Ch11Title, "NTC2AC_ADC_PREBOOST" );
        putValue( DIAG_ADC_Ch12Title, "NTC2AC_ADC_MPS" );
        putValue( DIAG_ADC_Ch13Title, "TFT2AC_ADC_VDD2_TFT" );
        putValue( DIAG_ADC_Ch14Title, "TFT2AC_ADC_GAMMA_V[0]" );
        putValue( DIAG_ADC_Ch15Title, "TFT2AC_ADC_VCOM" );
        EnableControl( "Calibrate Clock", "Button:DIAG_CALClock_StoreCal", 1 );

    }
    if( getValue( this ) == cKI_W213_HL )  // W213 High-Line
    {
        // PWM-Setup
        cPWM_IndexToChannel[0] =  0x11;
        cPWM_IndexToChannel[1] =  0x15;
        cPWM_IndexToChannel[2] =  0x17;
        cPWM_IndexToChannel[3] =  0x19;
        cPWM_IndexToChannel[4] =  0x1B;
        cPWM_IndexToChannel[5] =  0x1D;
        cPWM_IndexToChannel[6] =  0x2B;
        cPWM_IndexToChannel[7] =  0x29;
        cPWM_IndexToChannel[8] =  0x2B;
        cPWM_IndexToChannel[9] =  0x2F;
        cPWM_IndexToChannel[10] = 0x46;
        cPWM_IndexToChannel[11] = 0x4E;
        cPWM_IndexToChannel[12] = 0x4E;
        putValue( DIAG_PWM_Ch00Title, "   " );
        putValue( DIAG_PWM_Ch01Title, "   " );
        putValue( DIAG_PWM_Ch02Title, "   " );
        putValue( DIAG_PWM_Ch03Title, "   " );
        putValue( DIAG_PWM_Ch04Title, "   " );
        putValue( DIAG_PWM_Ch05Title, "   " );
        putValue( DIAG_PWM_Ch06Title, "   " );
        putValue( DIAG_PWM_Ch07Title, "TAUA 2O9  AC2BL_SSC" );
        putValue( DIAG_PWM_Ch08Title, "TAUA 2OB  AC2BL1_PWM_DIMM" );
        putValue( DIAG_PWM_Ch09Title, "TAUA 2OF  AC2BL2_PWM_DIMM" );
        putValue( DIAG_PWM_Ch10Title, "   " );
        putValue( DIAG_PWM_Ch11Title, "   " );
        putValue( DIAG_PWM_Ch12Title, "   " );
        putValue( DIAG_PWM_Ch13Title, "   " );
        putValue( DIAG_PWM_Ch14Title, "   " );

        //  ADC Kanäle
        putValue( DIAG_ADC_Ch00Title, "NTC2AC_ADC_TFT" );
        putValue( DIAG_ADC_Ch01Title, "NTC2AC_ADC_GCPS" );
        putValue( DIAG_ADC_Ch02Title, "NTC2AC_ADC_BL1_FET" );
        putValue( DIAG_ADC_Ch03Title, "NTC2AC_ADC_BL2_FET" );
        putValue( DIAG_ADC_Ch04Title, "BL2AC_ADC_FOTO" );
        putValue( DIAG_ADC_Ch05Title, "NTC2AC_ADC_EMMC" );
        putValue( DIAG_ADC_Ch06Title, "KL302AC_ADC_KL30" );
        putValue( DIAG_ADC_Ch07Title, "unused" );
        putValue( DIAG_ADC_Ch08Title, "NTC2AC_ADC_AUDIO" );
        putValue( DIAG_ADC_Ch09Title, "NTC2AC_ADC_DDR" );
        putValue( DIAG_ADC_Ch10Title, "NTC2AC_ADC_TCON" );
        putValue( DIAG_ADC_Ch11Title, "NTC2AC_ADC_PREBOOST" );
        putValue( DIAG_ADC_Ch12Title, "NTC2AC_ADC_MPS" );
        putValue( DIAG_ADC_Ch13Title, "TFT2AC_ADC_VDD2_TFT" );
        putValue( DIAG_ADC_Ch14Title, "TFT2AC_ADC_GAMMA_V[0]" );
        putValue( DIAG_ADC_Ch15Title, "TFT2AC_ADC_VCOM" );
        EnableControl( "Calibrate Clock", "Button:DIAG_CALClock_StoreCal", 1 );

    }
    
    if( getValue( this ) == cKI_VS30_EL )  // VS30 Entry-Line/Mid-Line
    {
        //reset info values
        ID_Clear_EnvVars();
        //Info Panel
        putValue( DIAG_Info_Part_0, "P0 Bootloader" );
        putValue( DIAG_Info_Part_1, "P1 Application" );
        putValue( DIAG_Info_Part_2, "N/A" );
        putValue( DIAG_Info_Part_3, "N/A" );
        putValue( DIAG_Info_Part_4, "N/A" );
        putValue( DIAG_Info_Part_5, "N/A" );
      
        // PWM-Setup
        cPWM_IndexToChannel[0] =  LL_ML_DIAL;
        cPWM_IndexToChannel[1] =  LL_ML_PTR;
        cPWM_IndexToChannel[2] =  LL_ML_TT;
        cPWM_IndexToChannel[3] =  LL_ML_TT_SAFETY;
        cPWM_IndexToChannel[4] =  LL_ML_BL_DIMM;
        cPWM_IndexToChannel[5] =  LL_ML_DISP_VLCD_PWM;
        cPWM_IndexToChannel[6] =  LL_ML_DISP_VREF_PWM;
        putValue( DIAG_PWM_Ch00Title, "PWGA19O - AC_ILLU_PWM_DIAL" );
        putValue( DIAG_PWM_Ch01Title, "PWGA20O - AC_ILLU_PWM_PTR" );
        putValue( DIAG_PWM_Ch02Title, "PWGA21O - AC_ILLU_PWM_TT" );
        putValue( DIAG_PWM_Ch03Title, "PWGA22O - AC_ILLU_PWM_TT_SAFETY" );
        putValue( DIAG_PWM_Ch04Title, "PWGA23O - AC_ILLU_PWM_BL" );
        putValue( DIAG_PWM_Ch05Title, "PWGA16O - AC_DISP_VLCD_PWM" );
        putValue( DIAG_PWM_Ch06Title, "PWGA17O - AC_DISP_VREF_PWM" );
        putValue( DIAG_PWM_Ch07Title, "   " );
        putValue( DIAG_PWM_Ch08Title, "   " );
        putValue( DIAG_PWM_Ch09Title, "   " );
        putValue( DIAG_PWM_Ch10Title, "   " );
        putValue( DIAG_PWM_Ch11Title, "   " );
        putValue( DIAG_PWM_Ch12Title, "   " );
        putValue( DIAG_PWM_Ch13Title, "   " );
        putValue( DIAG_PWM_Ch14Title, "   " );

        //  ADC Kanäle
        putValue( DIAG_ADC_Ch00Title, "ADCE0I0 - ADC_nDISP_AC_NTC" );
        putValue( DIAG_ADC_Ch01Title, "ADCE0I1 - ADC_nDISP_AC_VLCD" );
        putValue( DIAG_ADC_Ch02Title, "ADCE0I2 - ADC_nPS_AC_KL30ADC" );
        putValue( DIAG_ADC_Ch03Title, "ADCE0I3 - ADC_nPS_AC_5V0ADC" );
        putValue( DIAG_ADC_Ch04Title, "ADCE0I4 - ADC_nPS_AC_PBOOST_NTC" );
        putValue( DIAG_ADC_Ch05Title, "ADCE0I7 - ADC_nILLU_AC_NTC_LEFT" );
        putValue( DIAG_ADC_Ch06Title, "ADCE0I5 - ADC_nILLU_AC_NTC_RIGHT" );
        putValue( DIAG_ADC_Ch07Title, "ADCE0I6 - ADC_nILLU_AC_NTC_BL" );
        putValue( DIAG_ADC_Ch08Title, "unused" );
        putValue( DIAG_ADC_Ch09Title, "unused" );
        putValue( DIAG_ADC_Ch10Title, "unused" );
        putValue( DIAG_ADC_Ch11Title, "unused" );
        putValue( DIAG_ADC_Ch12Title, "unused" );
        putValue( DIAG_ADC_Ch13Title, "unused" );
        putValue( DIAG_ADC_Ch14Title, "unused" );
        putValue( DIAG_ADC_Ch15Title, "unused" );
        EnableControl( "Calibrate Clock", "Button:DIAG_CALClock_StoreCal", 1 );
      
        //GPIO ports and pins
      
        putValue(DIAG_GPIO_P0_0_nmb, "P0_0");
        putValue(DIAG_GPIO_P0_1_nmb, "P0_1");
        putValue(DIAG_GPIO_P0_2_nmb, "P0_2");
        putValue(DIAG_GPIO_P0_3_nmb, "P0_3");
        putValue(DIAG_GPIO_P0_4_nmb, "P0_4");
        putValue(DIAG_GPIO_P0_5_nmb, "P0_5");
        putValue(DIAG_GPIO_P0_6_nmb, "P0_6");
        putValue(DIAG_GPIO_P0_7_nmb, "P0_7");
        putValue(DIAG_GPIO_P0_8_nmb, "P0_8");
        putValue(DIAG_GPIO_P0_9_nmb, "P0_9");
        putValue(DIAG_GPIO_P0_10_nmb, "P0_10");
        putValue(DIAG_GPIO_P0_11_nmb, "P0_11");
        putValue(DIAG_GPIO_P0_12_nmb, "P0_12");
        putValue(DIAG_GPIO_P0_13_nmb, "P0_13");
        putValue(DIAG_GPIO_P0_14_nmb, "P0_14");
        putValue(DIAG_GPIO_P0_15_nmb, "P0_15");
        
        putValue(DIAG_GPIO_P0_0_uC_pin, "12");
        putValue(DIAG_GPIO_P0_1_uC_pin, "11");
        putValue(DIAG_GPIO_P0_2_uC_pin, "10");
        putValue(DIAG_GPIO_P0_3_uC_pin, "9");
        putValue(DIAG_GPIO_P0_4_uC_pin, "8");
        putValue(DIAG_GPIO_P0_5_uC_pin, "143");
        putValue(DIAG_GPIO_P0_6_uC_pin, "142");
        putValue(DIAG_GPIO_P0_7_uC_pin, "141");
        putValue(DIAG_GPIO_P0_8_uC_pin, "140");
        putValue(DIAG_GPIO_P0_9_uC_pin, "139");
        putValue(DIAG_GPIO_P0_10_uC_pin, "none");
        putValue(DIAG_GPIO_P0_11_uC_pin, "none");
        putValue(DIAG_GPIO_P0_12_uC_pin, "none");
        putValue(DIAG_GPIO_P0_13_uC_pin, "none");
        putValue(DIAG_GPIO_P0_14_uC_pin, "none");
        putValue(DIAG_GPIO_P0_15_uC_pin, "none");
      
        putValue(DIAG_GPIO_P0_0_func, "CSIH0CSS0");
        putValue(DIAG_GPIO_P0_1_func, "CSIH0SO");
        putValue(DIAG_GPIO_P0_2_func, "CSIH0SI");
        putValue(DIAG_GPIO_P0_3_func, "CSIH0SC");
        putValue(DIAG_GPIO_P0_4_func, "CAN0TX");
        putValue(DIAG_GPIO_P0_5_func, "CAN0RX");
        putValue(DIAG_GPIO_P0_6_func, "CAN1TX");
        putValue(DIAG_GPIO_P0_7_func, "CAN1RX");
        putValue(DIAG_GPIO_P0_8_func, "RLIN30TX");
        putValue(DIAG_GPIO_P0_9_func, "RLIN30RX");
        putValue(DIAG_GPIO_P0_10_func, "none");
        putValue(DIAG_GPIO_P0_11_func, "none");
        putValue(DIAG_GPIO_P0_12_func, "none");
        putValue(DIAG_GPIO_P0_13_func, "none");
        putValue(DIAG_GPIO_P0_14_func, "none");
        putValue(DIAG_GPIO_P0_15_func, "none");
      
        putValue(DIAG_GPIO_P1_0_nmb, "P1_0");
        putValue(DIAG_GPIO_P1_1_nmb, "P1_1");
        putValue(DIAG_GPIO_P1_2_nmb, "P1_2");
        putValue(DIAG_GPIO_P1_3_nmb, "P1_3");
        putValue(DIAG_GPIO_P1_4_nmb, "P1_4");
        putValue(DIAG_GPIO_P1_5_nmb, "P1_5");
        putValue(DIAG_GPIO_P1_6_nmb, "P1_6");
        putValue(DIAG_GPIO_P1_7_nmb, "P1_7");
        putValue(DIAG_GPIO_P1_8_nmb, "P1_8");
        putValue(DIAG_GPIO_P1_9_nmb, "P1_9");
        putValue(DIAG_GPIO_P1_10_nmb, "P1_10");
        putValue(DIAG_GPIO_P1_11_nmb, "P1_11");
        putValue(DIAG_GPIO_P1_12_nmb, "P1_12");
        putValue(DIAG_GPIO_P1_13_nmb, "P1_13");
        putValue(DIAG_GPIO_P1_14_nmb, "P1_14");
        putValue(DIAG_GPIO_P1_15_nmb, "P1_15");
        
        putValue(DIAG_GPIO_P1_0_uC_pin, "135");
        putValue(DIAG_GPIO_P1_1_uC_pin, "134");
        putValue(DIAG_GPIO_P1_2_uC_pin, "133");
        putValue(DIAG_GPIO_P1_3_uC_pin, "none");
        putValue(DIAG_GPIO_P1_4_uC_pin, "none");
        putValue(DIAG_GPIO_P1_5_uC_pin, "none");
        putValue(DIAG_GPIO_P1_6_uC_pin, "none");
        putValue(DIAG_GPIO_P1_7_uC_pin, "none");
        putValue(DIAG_GPIO_P1_8_uC_pin, "none");
        putValue(DIAG_GPIO_P1_9_uC_pin, "none");
        putValue(DIAG_GPIO_P1_10_uC_pin, "none");
        putValue(DIAG_GPIO_P1_11_uC_pin, "none");
        putValue(DIAG_GPIO_P1_12_uC_pin, "none");
        putValue(DIAG_GPIO_P1_13_uC_pin, "none");
        putValue(DIAG_GPIO_P1_14_uC_pin, "none");
        putValue(DIAG_GPIO_P1_15_uC_pin, "none");
      
        putValue(DIAG_GPIO_P1_0_func, "IO");
        putValue(DIAG_GPIO_P1_1_func, "IO");
        putValue(DIAG_GPIO_P1_2_func, "CSIH0RYI");
        putValue(DIAG_GPIO_P1_3_func, "none");
        putValue(DIAG_GPIO_P1_4_func, "none");
        putValue(DIAG_GPIO_P1_5_func, "none");
        putValue(DIAG_GPIO_P1_6_func, "none");
        putValue(DIAG_GPIO_P1_7_func, "none");
        putValue(DIAG_GPIO_P1_8_func, "none");
        putValue(DIAG_GPIO_P1_9_func, "none");
        putValue(DIAG_GPIO_P1_10_func, "none");
        putValue(DIAG_GPIO_P1_11_func, "none");
        putValue(DIAG_GPIO_P1_12_func, "none");
        putValue(DIAG_GPIO_P1_13_func, "none");
        putValue(DIAG_GPIO_P1_14_func, "none");
        putValue(DIAG_GPIO_P1_15_func, "none");
      
        putValue(DIAG_GPIO_P2_0_nmb, "P2_0");
        putValue(DIAG_GPIO_P2_1_nmb, "P2_1");
        putValue(DIAG_GPIO_P2_2_nmb, "P2_2");
        putValue(DIAG_GPIO_P2_3_nmb, "P2_3");
        putValue(DIAG_GPIO_P2_4_nmb, "P2_4");
        putValue(DIAG_GPIO_P2_5_nmb, "P2_5");
        putValue(DIAG_GPIO_P2_6_nmb, "P2_6");
        putValue(DIAG_GPIO_P2_7_nmb, "P2_7");
        putValue(DIAG_GPIO_P2_8_nmb, "P2_8");
        putValue(DIAG_GPIO_P2_9_nmb, "P2_9");
        putValue(DIAG_GPIO_P2_10_nmb, "P2_10");
        putValue(DIAG_GPIO_P2_11_nmb, "P2_11");
        putValue(DIAG_GPIO_P2_12_nmb, "P2_12");
        putValue(DIAG_GPIO_P2_13_nmb, "P2_13");
        putValue(DIAG_GPIO_P2_14_nmb, "P2_14");
        putValue(DIAG_GPIO_P2_15_nmb, "P2_15");
        
        putValue(DIAG_GPIO_P2_0_uC_pin, "none");
        putValue(DIAG_GPIO_P2_1_uC_pin, "none");
        putValue(DIAG_GPIO_P2_2_uC_pin, "none");
        putValue(DIAG_GPIO_P2_3_uC_pin, "none");
        putValue(DIAG_GPIO_P2_4_uC_pin, "none");
        putValue(DIAG_GPIO_P2_5_uC_pin, "none");
        putValue(DIAG_GPIO_P2_6_uC_pin, "none");
        putValue(DIAG_GPIO_P2_7_uC_pin, "none");
        putValue(DIAG_GPIO_P2_8_uC_pin, "none");
        putValue(DIAG_GPIO_P2_9_uC_pin, "none");
        putValue(DIAG_GPIO_P2_10_uC_pin, "none");
        putValue(DIAG_GPIO_P2_11_uC_pin, "none");
        putValue(DIAG_GPIO_P2_12_uC_pin, "none");
        putValue(DIAG_GPIO_P2_13_uC_pin, "none");
        putValue(DIAG_GPIO_P2_14_uC_pin, "none");
        putValue(DIAG_GPIO_P2_15_uC_pin, "none");
        
        putValue(DIAG_GPIO_P2_0_func, "none");
        putValue(DIAG_GPIO_P2_1_func, "none");
        putValue(DIAG_GPIO_P2_2_func, "none");
        putValue(DIAG_GPIO_P2_3_func, "none");
        putValue(DIAG_GPIO_P2_4_func, "none");
        putValue(DIAG_GPIO_P2_5_func, "none");
        putValue(DIAG_GPIO_P2_6_func, "none");
        putValue(DIAG_GPIO_P2_7_func, "none");
        putValue(DIAG_GPIO_P2_8_func, "none");
        putValue(DIAG_GPIO_P2_9_func, "none");
        putValue(DIAG_GPIO_P2_10_func, "none");
        putValue(DIAG_GPIO_P2_11_func, "none");
        putValue(DIAG_GPIO_P2_12_func, "none");
        putValue(DIAG_GPIO_P2_13_func, "none");
        putValue(DIAG_GPIO_P2_14_func, "none");
        putValue(DIAG_GPIO_P2_15_func, "none");
        
        putValue(DIAG_GPIO_P3_0_nmb, "P3_0");
        putValue(DIAG_GPIO_P3_1_nmb, "P3_1");
        putValue(DIAG_GPIO_P3_2_nmb, "P3_2");
        putValue(DIAG_GPIO_P3_3_nmb, "P3_3");
        putValue(DIAG_GPIO_P3_4_nmb, "P3_4");
        putValue(DIAG_GPIO_P3_5_nmb, "P3_5");
        putValue(DIAG_GPIO_P3_6_nmb, "P3_6");
        putValue(DIAG_GPIO_P3_7_nmb, "P3_7");
        putValue(DIAG_GPIO_P3_8_nmb, "P3_8");
        putValue(DIAG_GPIO_P3_9_nmb, "P3_9");
        putValue(DIAG_GPIO_P3_10_nmb, "P3_10");
        putValue(DIAG_GPIO_P3_11_nmb, "P3_11");
        putValue(DIAG_GPIO_P3_12_nmb, "P3_12");
        putValue(DIAG_GPIO_P3_13_nmb, "P3_13");
        putValue(DIAG_GPIO_P3_14_nmb, "P3_14");
        putValue(DIAG_GPIO_P3_15_nmb, "P3_15");
        
        putValue(DIAG_GPIO_P3_0_uC_pin, "none");
        putValue(DIAG_GPIO_P3_1_uC_pin, "none");
        putValue(DIAG_GPIO_P3_2_uC_pin, "97");
        putValue(DIAG_GPIO_P3_3_uC_pin, "98");
        putValue(DIAG_GPIO_P3_4_uC_pin, "99");
        putValue(DIAG_GPIO_P3_5_uC_pin, "100");
        putValue(DIAG_GPIO_P3_6_uC_pin, "101");
        putValue(DIAG_GPIO_P3_7_uC_pin, "102");
        putValue(DIAG_GPIO_P3_8_uC_pin, "103");
        putValue(DIAG_GPIO_P3_9_uC_pin, "104");
        putValue(DIAG_GPIO_P3_10_uC_pin, "none");
        putValue(DIAG_GPIO_P3_11_uC_pin, "none");
        putValue(DIAG_GPIO_P3_12_uC_pin, "none");
        putValue(DIAG_GPIO_P3_13_uC_pin, "none");
        putValue(DIAG_GPIO_P3_14_uC_pin, "none");
        putValue(DIAG_GPIO_P3_15_uC_pin, "none");
        
        putValue(DIAG_GPIO_P3_0_func, "none");
        putValue(DIAG_GPIO_P3_1_func, "none");
        putValue(DIAG_GPIO_P3_2_func, "IO");
        putValue(DIAG_GPIO_P3_3_func, "SSIF0TXD");
        putValue(DIAG_GPIO_P3_4_func, "SSIF0SCK");
        putValue(DIAG_GPIO_P3_5_func, "SSIF0WS");
        putValue(DIAG_GPIO_P3_6_func, "SSIFACK");
        putValue(DIAG_GPIO_P3_7_func, "IO");
        putValue(DIAG_GPIO_P3_8_func, "IO");
        putValue(DIAG_GPIO_P3_9_func, "IO");
        putValue(DIAG_GPIO_P3_10_func, "none");
        putValue(DIAG_GPIO_P3_11_func, "none");
        putValue(DIAG_GPIO_P3_12_func, "none");
        putValue(DIAG_GPIO_P3_13_func, "none");
        putValue(DIAG_GPIO_P3_14_func, "none");
        putValue(DIAG_GPIO_P3_15_func, "none");
      
        putValue(DIAG_GPIO_P10_0_nmb, "P10_0");
        putValue(DIAG_GPIO_P10_1_nmb, "P10_1");
        putValue(DIAG_GPIO_P10_2_nmb, "P10_2");
        putValue(DIAG_GPIO_P10_3_nmb, "P10_3");
        putValue(DIAG_GPIO_P10_4_nmb, "P10_4");
        putValue(DIAG_GPIO_P10_5_nmb, "P10_5");
        putValue(DIAG_GPIO_P10_6_nmb, "P10_6");
        putValue(DIAG_GPIO_P10_7_nmb, "P10_7");
        putValue(DIAG_GPIO_P10_8_nmb, "P10_8");
        putValue(DIAG_GPIO_P10_9_nmb, "P10_9");
        putValue(DIAG_GPIO_P10_10_nmb, "P10_10");
        putValue(DIAG_GPIO_P10_11_nmb, "P10_11");
        putValue(DIAG_GPIO_P10_12_nmb, "P10_12");
        putValue(DIAG_GPIO_P10_13_nmb, "P10_13");
        putValue(DIAG_GPIO_P10_14_nmb, "P10_14");
        putValue(DIAG_GPIO_P10_15_nmb, "P10_15");
        
        putValue(DIAG_GPIO_P10_0_uC_pin, "108");
        putValue(DIAG_GPIO_P10_1_uC_pin, "109");
        putValue(DIAG_GPIO_P10_2_uC_pin, "110");
        putValue(DIAG_GPIO_P10_3_uC_pin, "111");
        putValue(DIAG_GPIO_P10_4_uC_pin, "112");
        putValue(DIAG_GPIO_P10_5_uC_pin, "113");
        putValue(DIAG_GPIO_P10_6_uC_pin, "114");
        putValue(DIAG_GPIO_P10_7_uC_pin, "115");
        putValue(DIAG_GPIO_P10_8_uC_pin, "116");
        putValue(DIAG_GPIO_P10_9_uC_pin, "117");
        putValue(DIAG_GPIO_P10_10_uC_pin, "118");
        putValue(DIAG_GPIO_P10_11_uC_pin, "119");
        putValue(DIAG_GPIO_P10_12_uC_pin, "none");
        putValue(DIAG_GPIO_P10_13_uC_pin, "none");
        putValue(DIAG_GPIO_P10_14_uC_pin, "none");
        putValue(DIAG_GPIO_P10_15_uC_pin, "none");
      
        putValue(DIAG_GPIO_P10_0_func, "ADCE0I0");
        putValue(DIAG_GPIO_P10_1_func, "ADCE0I1");
        putValue(DIAG_GPIO_P10_2_func, "ADCE0I2");
        putValue(DIAG_GPIO_P10_3_func, "ADCE0I3");
        putValue(DIAG_GPIO_P10_4_func, "ADCE0I4");
        putValue(DIAG_GPIO_P10_5_func, "ADCE0I5");
        putValue(DIAG_GPIO_P10_6_func, "ADCE0I6");
        putValue(DIAG_GPIO_P10_7_func, "ADCE0I7");
        putValue(DIAG_GPIO_P10_8_func, "TAUB0I11");
        putValue(DIAG_GPIO_P10_9_func, "IO");
        putValue(DIAG_GPIO_P10_10_func, "IO");
        putValue(DIAG_GPIO_P10_11_func, "IO");
        putValue(DIAG_GPIO_P10_12_func, "none");
        putValue(DIAG_GPIO_P10_13_func, "none");
        putValue(DIAG_GPIO_P10_14_func, "none");
        putValue(DIAG_GPIO_P10_15_func, "none");
      
        putValue(DIAG_GPIO_P11_0_nmb, "P11_0");
        putValue(DIAG_GPIO_P11_1_nmb, "P11_1");
        putValue(DIAG_GPIO_P11_2_nmb, "P11_2");
        putValue(DIAG_GPIO_P11_3_nmb, "P11_3");
        putValue(DIAG_GPIO_P11_4_nmb, "P11_4");
        putValue(DIAG_GPIO_P11_5_nmb, "P11_5");
        putValue(DIAG_GPIO_P11_6_nmb, "P11_6");
        putValue(DIAG_GPIO_P11_7_nmb, "P11_7");
        putValue(DIAG_GPIO_P11_8_nmb, "P11_8");
        putValue(DIAG_GPIO_P11_9_nmb, "P11_9");
        putValue(DIAG_GPIO_P11_10_nmb, "P11_10");
        putValue(DIAG_GPIO_P11_11_nmb, "P11_11");
        putValue(DIAG_GPIO_P11_12_nmb, "P11_12");
        putValue(DIAG_GPIO_P11_13_nmb, "P11_13");
        putValue(DIAG_GPIO_P11_14_nmb, "P11_14");
        putValue(DIAG_GPIO_P11_15_nmb, "P11_15");
        
        putValue(DIAG_GPIO_P11_0_uC_pin, "120");
        putValue(DIAG_GPIO_P11_1_uC_pin, "121");
        putValue(DIAG_GPIO_P11_2_uC_pin, "122");
        putValue(DIAG_GPIO_P11_3_uC_pin, "123");
        putValue(DIAG_GPIO_P11_4_uC_pin, "none");
        putValue(DIAG_GPIO_P11_5_uC_pin, "none");
        putValue(DIAG_GPIO_P11_6_uC_pin, "none");
        putValue(DIAG_GPIO_P11_7_uC_pin, "none");
        putValue(DIAG_GPIO_P11_8_uC_pin, "none");
        putValue(DIAG_GPIO_P11_9_uC_pin, "none");
        putValue(DIAG_GPIO_P11_10_uC_pin, "none");
        putValue(DIAG_GPIO_P11_11_uC_pin, "none");
        putValue(DIAG_GPIO_P11_12_uC_pin, "none");
        putValue(DIAG_GPIO_P11_13_uC_pin, "none");
        putValue(DIAG_GPIO_P11_14_uC_pin, "none");
        putValue(DIAG_GPIO_P11_15_uC_pin, "none");
      
        putValue(DIAG_GPIO_P11_0_func, "IO");
        putValue(DIAG_GPIO_P11_1_func, "TAUB1I2");
        putValue(DIAG_GPIO_P11_2_func, "IO");
        putValue(DIAG_GPIO_P11_3_func, "IO");
        putValue(DIAG_GPIO_P11_4_func, "none");
        putValue(DIAG_GPIO_P11_5_func, "none");
        putValue(DIAG_GPIO_P11_6_func, "none");
        putValue(DIAG_GPIO_P11_7_func, "none");
        putValue(DIAG_GPIO_P11_8_func, "none");
        putValue(DIAG_GPIO_P11_9_func, "none");
        putValue(DIAG_GPIO_P11_10_func, "none");
        putValue(DIAG_GPIO_P11_11_func, "none");
        putValue(DIAG_GPIO_P11_12_func, "none");
        putValue(DIAG_GPIO_P11_13_func, "none");
        putValue(DIAG_GPIO_P11_14_func, "none");
        putValue(DIAG_GPIO_P11_15_func, "none");
      
        putValue(DIAG_GPIO_P16_0_nmb, "P16_0");
        putValue(DIAG_GPIO_P16_1_nmb, "P16_1");
        putValue(DIAG_GPIO_P16_2_nmb, "P16_2");
        putValue(DIAG_GPIO_P16_3_nmb, "P16_3");
        putValue(DIAG_GPIO_P16_4_nmb, "P16_4");
        putValue(DIAG_GPIO_P16_5_nmb, "P16_5");
        putValue(DIAG_GPIO_P16_6_nmb, "P16_6");
        putValue(DIAG_GPIO_P16_7_nmb, "P16_7");
        putValue(DIAG_GPIO_P16_8_nmb, "P16_8");
        putValue(DIAG_GPIO_P16_9_nmb, "P16_9");
        putValue(DIAG_GPIO_P16_10_nmb, "P16_10");
        putValue(DIAG_GPIO_P16_11_nmb, "P16_11");
        putValue(DIAG_GPIO_P16_12_nmb, "P16_12");
        putValue(DIAG_GPIO_P16_13_nmb, "P16_13");
        putValue(DIAG_GPIO_P16_14_nmb, "P16_14");
        putValue(DIAG_GPIO_P16_15_nmb, "P16_15");
        
        putValue(DIAG_GPIO_P16_0_uC_pin, "64");
        putValue(DIAG_GPIO_P16_1_uC_pin, "65");
        putValue(DIAG_GPIO_P16_2_uC_pin, "66");
        putValue(DIAG_GPIO_P16_3_uC_pin, "67");
        putValue(DIAG_GPIO_P16_4_uC_pin, "68");
        putValue(DIAG_GPIO_P16_5_uC_pin, "69");
        putValue(DIAG_GPIO_P16_6_uC_pin, "70");
        putValue(DIAG_GPIO_P16_7_uC_pin, "71");
        putValue(DIAG_GPIO_P16_8_uC_pin, "75");
        putValue(DIAG_GPIO_P16_9_uC_pin, "76");
        putValue(DIAG_GPIO_P16_10_uC_pin, "77");
        putValue(DIAG_GPIO_P16_11_uC_pin, "78");
        putValue(DIAG_GPIO_P16_12_uC_pin, "none");
        putValue(DIAG_GPIO_P16_13_uC_pin, "none");
        putValue(DIAG_GPIO_P16_14_uC_pin, "none");
        putValue(DIAG_GPIO_P16_15_uC_pin, "none");
      
        putValue(DIAG_GPIO_P16_0_func, "PWGA16O");
        putValue(DIAG_GPIO_P16_1_func, "PWGA17O");
        putValue(DIAG_GPIO_P16_2_func, "IO");
        putValue(DIAG_GPIO_P16_3_func, "PWGA19O");
        putValue(DIAG_GPIO_P16_4_func, "PWGA20O");
        putValue(DIAG_GPIO_P16_5_func, "PWGA21O");
        putValue(DIAG_GPIO_P16_6_func, "PWGA22O");
        putValue(DIAG_GPIO_P16_7_func, "PWGA23O");
        putValue(DIAG_GPIO_P16_8_func, "IO");
        putValue(DIAG_GPIO_P16_9_func, "IO");
        putValue(DIAG_GPIO_P16_10_func, "IO");
        putValue(DIAG_GPIO_P16_11_func, "IO");
        putValue(DIAG_GPIO_P16_12_func, "none");
        putValue(DIAG_GPIO_P16_13_func, "none");
        putValue(DIAG_GPIO_P16_14_func, "none");
        putValue(DIAG_GPIO_P16_15_func, "none");
      
        putValue(DIAG_GPIO_P17_0_nmb, "P17_0");
        putValue(DIAG_GPIO_P17_1_nmb, "P17_1");
        putValue(DIAG_GPIO_P17_2_nmb, "P17_2");
        putValue(DIAG_GPIO_P17_3_nmb, "P17_3");
        putValue(DIAG_GPIO_P17_4_nmb, "P17_4");
        putValue(DIAG_GPIO_P17_5_nmb, "P17_5");
        putValue(DIAG_GPIO_P17_6_nmb, "P17_6");
        putValue(DIAG_GPIO_P17_7_nmb, "P17_7");
        putValue(DIAG_GPIO_P17_8_nmb, "P17_8");
        putValue(DIAG_GPIO_P17_9_nmb, "P17_9");
        putValue(DIAG_GPIO_P17_10_nmb, "P17_10");
        putValue(DIAG_GPIO_P17_11_nmb, "P17_11");
        putValue(DIAG_GPIO_P17_12_nmb, "P17_12");
        putValue(DIAG_GPIO_P17_13_nmb, "P17_13");
        putValue(DIAG_GPIO_P17_14_nmb, "P17_14");
        putValue(DIAG_GPIO_P17_15_nmb, "P17_15");
        
        putValue(DIAG_GPIO_P17_0_uC_pin, "79");
        putValue(DIAG_GPIO_P17_1_uC_pin, "80");
        putValue(DIAG_GPIO_P17_2_uC_pin, "81");
        putValue(DIAG_GPIO_P17_3_uC_pin, "82");
        putValue(DIAG_GPIO_P17_4_uC_pin, "86");
        putValue(DIAG_GPIO_P17_5_uC_pin, "87");
        putValue(DIAG_GPIO_P17_6_uC_pin, "88");
        putValue(DIAG_GPIO_P17_7_uC_pin, "89");
        putValue(DIAG_GPIO_P17_8_uC_pin, "90");
        putValue(DIAG_GPIO_P17_9_uC_pin, "91");
        putValue(DIAG_GPIO_P17_10_uC_pin, "92");
        putValue(DIAG_GPIO_P17_11_uC_pin, "93");
        putValue(DIAG_GPIO_P17_12_uC_pin, "none");
        putValue(DIAG_GPIO_P17_13_uC_pin, "none");
        putValue(DIAG_GPIO_P17_14_uC_pin, "none");
        putValue(DIAG_GPIO_P17_15_uC_pin, "none");
      
        putValue(DIAG_GPIO_P17_0_func, "IO");
        putValue(DIAG_GPIO_P17_1_func, "IO");
        putValue(DIAG_GPIO_P17_2_func, "IO");
        putValue(DIAG_GPIO_P17_3_func, "IO");
        putValue(DIAG_GPIO_P17_4_func, "ISM31");
        putValue(DIAG_GPIO_P17_5_func, "ISM32");
        putValue(DIAG_GPIO_P17_6_func, "ISM33");
        putValue(DIAG_GPIO_P17_7_func, "ISM34");
        putValue(DIAG_GPIO_P17_8_func, "ISM41");
        putValue(DIAG_GPIO_P17_9_func, "ISM42");
        putValue(DIAG_GPIO_P17_10_func, "ISM43");
        putValue(DIAG_GPIO_P17_11_func, "ISM44");
        putValue(DIAG_GPIO_P17_12_func, "none");
        putValue(DIAG_GPIO_P17_13_func, "none");
        putValue(DIAG_GPIO_P17_14_func, "none");
        putValue(DIAG_GPIO_P17_15_func, "none");
      
        putValue(DIAG_GPIO_P21_0_nmb, "P21_0");
        putValue(DIAG_GPIO_P21_1_nmb, "P21_1");
        putValue(DIAG_GPIO_P21_2_nmb, "P21_2");
        putValue(DIAG_GPIO_P21_3_nmb, "P21_3");
        putValue(DIAG_GPIO_P21_4_nmb, "P21_4");
        putValue(DIAG_GPIO_P21_5_nmb, "P21_5");
        putValue(DIAG_GPIO_P21_6_nmb, "P21_6");
        putValue(DIAG_GPIO_P21_7_nmb, "P21_7");
        putValue(DIAG_GPIO_P21_8_nmb, "P21_8");
        putValue(DIAG_GPIO_P21_9_nmb, "P21_9");
        putValue(DIAG_GPIO_P21_10_nmb, "P21_10");
        putValue(DIAG_GPIO_P21_11_nmb, "P21_11");
        putValue(DIAG_GPIO_P21_12_nmb, "P21_12");
        putValue(DIAG_GPIO_P21_13_nmb, "P21_13");
        putValue(DIAG_GPIO_P21_14_nmb, "P21_14");
        putValue(DIAG_GPIO_P21_15_nmb, "P21_15");
        
        putValue(DIAG_GPIO_P21_0_uC_pin, "61");
        putValue(DIAG_GPIO_P21_1_uC_pin, "60");
        putValue(DIAG_GPIO_P21_2_uC_pin, "59");
        putValue(DIAG_GPIO_P21_3_uC_pin, "58");
        putValue(DIAG_GPIO_P21_4_uC_pin, "57");
        putValue(DIAG_GPIO_P21_5_uC_pin, "56");
        putValue(DIAG_GPIO_P21_6_uC_pin, "none");
        putValue(DIAG_GPIO_P21_7_uC_pin, "none");
        putValue(DIAG_GPIO_P21_8_uC_pin, "none");
        putValue(DIAG_GPIO_P21_9_uC_pin, "none");
        putValue(DIAG_GPIO_P21_10_uC_pin, "none");
        putValue(DIAG_GPIO_P21_11_uC_pin, "none");
        putValue(DIAG_GPIO_P21_12_uC_pin, "none");
        putValue(DIAG_GPIO_P21_13_uC_pin, "none");
        putValue(DIAG_GPIO_P21_14_uC_pin, "none");
        putValue(DIAG_GPIO_P21_15_uC_pin, "none");
        
        putValue(DIAG_GPIO_P21_0_func, "SFMA0CLK");
        putValue(DIAG_GPIO_P21_1_func, "SFMA0SSL");
        putValue(DIAG_GPIO_P21_2_func, "SFMA0I00");
        putValue(DIAG_GPIO_P21_3_func, "SFMA0I10");
        putValue(DIAG_GPIO_P21_4_func, "SFMA0I20");
        putValue(DIAG_GPIO_P21_5_func, "SFMA0I30");
        putValue(DIAG_GPIO_P21_6_func, "none");
        putValue(DIAG_GPIO_P21_7_func, "none");
        putValue(DIAG_GPIO_P21_8_func, "none");
        putValue(DIAG_GPIO_P21_9_func, "none");
        putValue(DIAG_GPIO_P21_10_func, "none");
        putValue(DIAG_GPIO_P21_11_func, "none");
        putValue(DIAG_GPIO_P21_12_func, "none");
        putValue(DIAG_GPIO_P21_13_func, "none");
        putValue(DIAG_GPIO_P21_14_func, "none");
        putValue(DIAG_GPIO_P21_15_func, "none");
      
        putValue(DIAG_GPIO_P40_0_nmb, "P40_0");
        putValue(DIAG_GPIO_P40_1_nmb, "P40_1");
        putValue(DIAG_GPIO_P40_2_nmb, "P40_2");
        putValue(DIAG_GPIO_P40_3_nmb, "P40_3");
        putValue(DIAG_GPIO_P40_4_nmb, "P40_4");
        putValue(DIAG_GPIO_P40_5_nmb, "P40_5");
        putValue(DIAG_GPIO_P40_6_nmb, "P40_6");
        putValue(DIAG_GPIO_P40_7_nmb, "P40_7");
        putValue(DIAG_GPIO_P40_8_nmb, "P40_8");
        putValue(DIAG_GPIO_P40_9_nmb, "P40_9");
        putValue(DIAG_GPIO_P40_10_nmb, "P40_10");
        putValue(DIAG_GPIO_P40_11_nmb, "P40_11");
        putValue(DIAG_GPIO_P40_12_nmb, "P40_12");
        putValue(DIAG_GPIO_P40_13_nmb, "P40_13");
        putValue(DIAG_GPIO_P40_14_nmb, "P40_14");
        putValue(DIAG_GPIO_P40_15_nmb, "P40_15");
        
        putValue(DIAG_GPIO_P40_0_uC_pin, "none");
        putValue(DIAG_GPIO_P40_1_uC_pin, "none");
        putValue(DIAG_GPIO_P40_2_uC_pin, "none");
        putValue(DIAG_GPIO_P40_3_uC_pin, "none");
        putValue(DIAG_GPIO_P40_4_uC_pin, "none");
        putValue(DIAG_GPIO_P40_5_uC_pin, "none");
        putValue(DIAG_GPIO_P40_6_uC_pin, "none");
        putValue(DIAG_GPIO_P40_7_uC_pin, "none");
        putValue(DIAG_GPIO_P40_8_uC_pin, "none");
        putValue(DIAG_GPIO_P40_9_uC_pin, "none");
        putValue(DIAG_GPIO_P40_10_uC_pin, "none");
        putValue(DIAG_GPIO_P40_11_uC_pin, "none");
        putValue(DIAG_GPIO_P40_12_uC_pin, "none");
        putValue(DIAG_GPIO_P40_13_uC_pin, "none");
        putValue(DIAG_GPIO_P40_14_uC_pin, "none");
        putValue(DIAG_GPIO_P40_15_uC_pin, "none");
      
        putValue(DIAG_GPIO_P40_0_func, "none");
        putValue(DIAG_GPIO_P40_1_func, "none");
        putValue(DIAG_GPIO_P40_2_func, "none");
        putValue(DIAG_GPIO_P40_3_func, "none");
        putValue(DIAG_GPIO_P40_4_func, "none");
        putValue(DIAG_GPIO_P40_5_func, "none");
        putValue(DIAG_GPIO_P40_6_func, "none");
        putValue(DIAG_GPIO_P40_7_func, "none");
        putValue(DIAG_GPIO_P40_8_func, "none");
        putValue(DIAG_GPIO_P40_9_func, "none");
        putValue(DIAG_GPIO_P40_10_func, "none");
        putValue(DIAG_GPIO_P40_11_func, "none");
        putValue(DIAG_GPIO_P40_12_func, "none");
        putValue(DIAG_GPIO_P40_13_func, "none");
        putValue(DIAG_GPIO_P40_14_func, "none");
        putValue(DIAG_GPIO_P40_15_func, "none");
      
        putValue(DIAG_GPIO_P42_0_nmb, "P42_0");
        putValue(DIAG_GPIO_P42_1_nmb, "P42_1");
        putValue(DIAG_GPIO_P42_2_nmb, "P42_2");
        putValue(DIAG_GPIO_P42_3_nmb, "P42_3");
        putValue(DIAG_GPIO_P42_4_nmb, "P42_4");
        putValue(DIAG_GPIO_P42_5_nmb, "P42_5");
        putValue(DIAG_GPIO_P42_6_nmb, "P42_6");
        putValue(DIAG_GPIO_P42_7_nmb, "P42_7");
        putValue(DIAG_GPIO_P42_8_nmb, "P42_8");
        putValue(DIAG_GPIO_P42_9_nmb, "P42_9");
        putValue(DIAG_GPIO_P42_10_nmb, "P42_10");
        putValue(DIAG_GPIO_P42_11_nmb, "P42_11");
        putValue(DIAG_GPIO_P42_12_nmb, "P42_12");
        putValue(DIAG_GPIO_P42_13_nmb, "P42_13");
        putValue(DIAG_GPIO_P42_14_nmb, "P42_14");
        putValue(DIAG_GPIO_P42_15_nmb, "P42_15");
        
        putValue(DIAG_GPIO_P42_0_uC_pin, "none");
        putValue(DIAG_GPIO_P42_1_uC_pin, "none");
        putValue(DIAG_GPIO_P42_2_uC_pin, "none");
        putValue(DIAG_GPIO_P42_3_uC_pin, "none");
        putValue(DIAG_GPIO_P42_4_uC_pin, "none");
        putValue(DIAG_GPIO_P42_5_uC_pin, "none");
        putValue(DIAG_GPIO_P42_6_uC_pin, "none");
        putValue(DIAG_GPIO_P42_7_uC_pin, "130");
        putValue(DIAG_GPIO_P42_8_uC_pin, "129");
        putValue(DIAG_GPIO_P42_9_uC_pin, "128");
        putValue(DIAG_GPIO_P42_10_uC_pin, "127");
        putValue(DIAG_GPIO_P42_11_uC_pin, "none");
        putValue(DIAG_GPIO_P42_12_uC_pin, "none");
        putValue(DIAG_GPIO_P42_13_uC_pin, "none");
        putValue(DIAG_GPIO_P42_14_uC_pin, "none");
        putValue(DIAG_GPIO_P42_15_uC_pin, "none");
      
        putValue(DIAG_GPIO_P42_0_func, "none");
        putValue(DIAG_GPIO_P42_1_func, "none");
        putValue(DIAG_GPIO_P42_2_func, "none");
        putValue(DIAG_GPIO_P42_3_func, "none");
        putValue(DIAG_GPIO_P42_4_func, "none");
        putValue(DIAG_GPIO_P42_5_func, "none");
        putValue(DIAG_GPIO_P42_6_func, "none");
        putValue(DIAG_GPIO_P42_7_func, "IO");
        putValue(DIAG_GPIO_P42_8_func, "CSIG3SO");
        putValue(DIAG_GPIO_P42_9_func, "CSIG3SI");
        putValue(DIAG_GPIO_P42_10_func, "CSIG3SC");
        putValue(DIAG_GPIO_P42_11_func, "none");
        putValue(DIAG_GPIO_P42_12_func, "none");
        putValue(DIAG_GPIO_P42_13_func, "none");
        putValue(DIAG_GPIO_P42_14_func, "none");
        putValue(DIAG_GPIO_P42_15_func, "none");
      
        putValue(DIAG_GPIO_P43_0_nmb, "P43_0");
        putValue(DIAG_GPIO_P43_1_nmb, "P43_1");
        putValue(DIAG_GPIO_P43_2_nmb, "P43_2");
        putValue(DIAG_GPIO_P43_3_nmb, "P43_3");
        putValue(DIAG_GPIO_P43_4_nmb, "P43_4");
        putValue(DIAG_GPIO_P43_5_nmb, "P43_5");
        putValue(DIAG_GPIO_P43_6_nmb, "P43_6");
        putValue(DIAG_GPIO_P43_7_nmb, "P43_7");
        putValue(DIAG_GPIO_P43_8_nmb, "P43_8");
        putValue(DIAG_GPIO_P43_9_nmb, "P43_9");
        putValue(DIAG_GPIO_P43_10_nmb, "P43_10");
        putValue(DIAG_GPIO_P43_11_nmb, "P43_11");
        putValue(DIAG_GPIO_P43_12_nmb, "P43_12");
        putValue(DIAG_GPIO_P43_13_nmb, "P43_13");
        putValue(DIAG_GPIO_P43_14_nmb, "P43_14");
        putValue(DIAG_GPIO_P43_15_nmb, "P43_15");
        
        putValue(DIAG_GPIO_P43_0_uC_pin, "27");
        putValue(DIAG_GPIO_P43_1_uC_pin, "26");
        putValue(DIAG_GPIO_P43_2_uC_pin, "none");
        putValue(DIAG_GPIO_P43_3_uC_pin, "none");
        putValue(DIAG_GPIO_P43_4_uC_pin, "none");
        putValue(DIAG_GPIO_P43_5_uC_pin, "none");
        putValue(DIAG_GPIO_P43_6_uC_pin, "none");
        putValue(DIAG_GPIO_P43_7_uC_pin, "none");
        putValue(DIAG_GPIO_P43_8_uC_pin, "none");
        putValue(DIAG_GPIO_P43_9_uC_pin, "none");
        putValue(DIAG_GPIO_P43_10_uC_pin, "none");
        putValue(DIAG_GPIO_P43_11_uC_pin, "none");
        putValue(DIAG_GPIO_P43_12_uC_pin, "none");
        putValue(DIAG_GPIO_P43_13_uC_pin, "none");
        putValue(DIAG_GPIO_P43_14_uC_pin, "none");
        putValue(DIAG_GPIO_P43_15_uC_pin, "none");
      
        putValue(DIAG_GPIO_P43_0_func, "IO");
        putValue(DIAG_GPIO_P43_1_func, "IO");
        putValue(DIAG_GPIO_P43_2_func, "none");
        putValue(DIAG_GPIO_P43_3_func, "none");
        putValue(DIAG_GPIO_P43_4_func, "none");
        putValue(DIAG_GPIO_P43_5_func, "none");
        putValue(DIAG_GPIO_P43_6_func, "none");
        putValue(DIAG_GPIO_P43_7_func, "none");
        putValue(DIAG_GPIO_P43_8_func, "none");
        putValue(DIAG_GPIO_P43_9_func, "none");
        putValue(DIAG_GPIO_P43_10_func, "none");
        putValue(DIAG_GPIO_P43_11_func, "none");
        putValue(DIAG_GPIO_P43_12_func, "none");
        putValue(DIAG_GPIO_P43_13_func, "none");
        putValue(DIAG_GPIO_P43_14_func, "none");
        putValue(DIAG_GPIO_P43_15_func, "none");
      
        putValue(DIAG_GPIO_P44_0_nmb, "P44_0");
        putValue(DIAG_GPIO_P44_1_nmb, "P44_1");
        putValue(DIAG_GPIO_P44_2_nmb, "P44_2");
        putValue(DIAG_GPIO_P44_3_nmb, "P44_3");
        putValue(DIAG_GPIO_P44_4_nmb, "P44_4");
        putValue(DIAG_GPIO_P44_5_nmb, "P44_5");
        putValue(DIAG_GPIO_P44_6_nmb, "P44_6");
        putValue(DIAG_GPIO_P44_7_nmb, "P44_7");
        putValue(DIAG_GPIO_P44_8_nmb, "P44_8");
        putValue(DIAG_GPIO_P44_9_nmb, "P44_9");
        putValue(DIAG_GPIO_P44_10_nmb, "P44_10");
        putValue(DIAG_GPIO_P44_11_nmb, "P44_11");
        putValue(DIAG_GPIO_P44_12_nmb, "P44_12");
        putValue(DIAG_GPIO_P44_13_nmb, "P44_13");
        putValue(DIAG_GPIO_P44_14_nmb, "P44_14");
        putValue(DIAG_GPIO_P44_15_nmb, "P44_15");
        
        putValue(DIAG_GPIO_P44_0_uC_pin, "none");
        putValue(DIAG_GPIO_P44_1_uC_pin, "53");
        putValue(DIAG_GPIO_P44_2_uC_pin, "52");
        putValue(DIAG_GPIO_P44_3_uC_pin, "51");
        putValue(DIAG_GPIO_P44_4_uC_pin, "50");
        putValue(DIAG_GPIO_P44_5_uC_pin, "none");
        putValue(DIAG_GPIO_P44_6_uC_pin, "49");
        putValue(DIAG_GPIO_P44_7_uC_pin, "48");
        putValue(DIAG_GPIO_P44_8_uC_pin, "47");
        putValue(DIAG_GPIO_P44_9_uC_pin, "44");
        putValue(DIAG_GPIO_P44_10_uC_pin, "43");
        putValue(DIAG_GPIO_P44_11_uC_pin, "42");
        putValue(DIAG_GPIO_P44_12_uC_pin, "none");
        putValue(DIAG_GPIO_P44_13_uC_pin, "none");
        putValue(DIAG_GPIO_P44_14_uC_pin, "none");
        putValue(DIAG_GPIO_P44_15_uC_pin, "none");
      
        putValue(DIAG_GPIO_P44_0_func, "none");
        putValue(DIAG_GPIO_P44_1_func, "IO");
        putValue(DIAG_GPIO_P44_2_func, "RIIC0SDA");
        putValue(DIAG_GPIO_P44_3_func, "RIIC0SCL");
        putValue(DIAG_GPIO_P44_4_func, "IO");
        putValue(DIAG_GPIO_P44_5_func, "none");
        putValue(DIAG_GPIO_P44_6_func, "INTP3");
        putValue(DIAG_GPIO_P44_7_func, "IO");
        putValue(DIAG_GPIO_P44_8_func, "IO");
        putValue(DIAG_GPIO_P44_9_func, "INTP1");
        putValue(DIAG_GPIO_P44_10_func, "RIIC1SDA");
        putValue(DIAG_GPIO_P44_11_func, "RIIC1SCL");
        putValue(DIAG_GPIO_P44_12_func, "none");
        putValue(DIAG_GPIO_P44_13_func, "none");
        putValue(DIAG_GPIO_P44_14_func, "none");
        putValue(DIAG_GPIO_P44_15_func, "none");
      
        putValue(DIAG_GPIO_P45_0_nmb, "P45_0");
        putValue(DIAG_GPIO_P45_1_nmb, "P45_1");
        putValue(DIAG_GPIO_P45_2_nmb, "P45_2");
        putValue(DIAG_GPIO_P45_3_nmb, "P45_3");
        putValue(DIAG_GPIO_P45_4_nmb, "P45_4");
        putValue(DIAG_GPIO_P45_5_nmb, "P45_5");
        putValue(DIAG_GPIO_P45_6_nmb, "P45_6");
        putValue(DIAG_GPIO_P45_7_nmb, "P45_7");
        putValue(DIAG_GPIO_P45_8_nmb, "P45_8");
        putValue(DIAG_GPIO_P45_9_nmb, "P45_9");
        putValue(DIAG_GPIO_P45_10_nmb, "P45_10");
        putValue(DIAG_GPIO_P45_11_nmb, "P45_11");
        putValue(DIAG_GPIO_P45_12_nmb, "P45_12");
        putValue(DIAG_GPIO_P45_13_nmb, "P45_13");
        putValue(DIAG_GPIO_P45_14_nmb, "P45_14");
        putValue(DIAG_GPIO_P45_15_nmb, "P45_15");
        
        putValue(DIAG_GPIO_P45_0_uC_pin, "41");
        putValue(DIAG_GPIO_P45_1_uC_pin, "40");
        putValue(DIAG_GPIO_P45_2_uC_pin, "39");
        putValue(DIAG_GPIO_P45_3_uC_pin, "38");
        putValue(DIAG_GPIO_P45_4_uC_pin, "37");
        putValue(DIAG_GPIO_P45_5_uC_pin, "36");
        putValue(DIAG_GPIO_P45_6_uC_pin, "35");
        putValue(DIAG_GPIO_P45_7_uC_pin, "34");
        putValue(DIAG_GPIO_P45_8_uC_pin, "33");
        putValue(DIAG_GPIO_P45_9_uC_pin, "32");
        putValue(DIAG_GPIO_P45_10_uC_pin, "31");
        putValue(DIAG_GPIO_P45_11_uC_pin, "30");
        putValue(DIAG_GPIO_P45_12_uC_pin, "29");
        putValue(DIAG_GPIO_P45_13_uC_pin, "28");
        putValue(DIAG_GPIO_P45_14_uC_pin, "none");
        putValue(DIAG_GPIO_P45_15_uC_pin, "none");
      
        putValue(DIAG_GPIO_P45_0_func, "IO");
        putValue(DIAG_GPIO_P45_1_func, "IO");
        putValue(DIAG_GPIO_P45_2_func, "_CSIG0SSI");
        putValue(DIAG_GPIO_P45_3_func, "CSIG0SO");
        putValue(DIAG_GPIO_P45_4_func, "CSIG0SI");
        putValue(DIAG_GPIO_P45_5_func, "CSIG0SC");
        putValue(DIAG_GPIO_P45_6_func, "IO");
        putValue(DIAG_GPIO_P45_7_func, "IO");
        putValue(DIAG_GPIO_P45_8_func, "IO");
        putValue(DIAG_GPIO_P45_9_func, "IO");
        putValue(DIAG_GPIO_P45_10_func, "IO");
        putValue(DIAG_GPIO_P45_11_func, "IO");
        putValue(DIAG_GPIO_P45_12_func, "IO");
        putValue(DIAG_GPIO_P45_13_func, "IO");
        putValue(DIAG_GPIO_P45_14_func, "none");
        putValue(DIAG_GPIO_P45_15_func, "none");
      
        putValue(DIAG_GPIO_JP0_0_nmb, "JP0_0");
        putValue(DIAG_GPIO_JP0_1_nmb, "JP0_1");
        putValue(DIAG_GPIO_JP0_2_nmb, "JP0_2");
        putValue(DIAG_GPIO_JP0_3_nmb, "JP0_3");
        putValue(DIAG_GPIO_JP0_4_nmb, "JP0_4");
        putValue(DIAG_GPIO_JP0_5_nmb, "JP0_5");
        putValue(DIAG_GPIO_JP0_6_nmb, "JP0_6");
        putValue(DIAG_GPIO_JP0_7_nmb, "JP0_7");
        putValue(DIAG_GPIO_JP0_8_nmb, "JP0_8");
        putValue(DIAG_GPIO_JP0_9_nmb, "JP0_9");
        putValue(DIAG_GPIO_JP0_10_nmb, "JP0_10");
        putValue(DIAG_GPIO_JP0_11_nmb, "JP0_11");
        putValue(DIAG_GPIO_JP0_12_nmb, "JP0_12");
        putValue(DIAG_GPIO_JP0_13_nmb, "JP0_13");
        putValue(DIAG_GPIO_JP0_14_nmb, "JP0_14");
        putValue(DIAG_GPIO_JP0_15_nmb, "JP0_15");
        
        putValue(DIAG_GPIO_JP0_0_uC_pin, "5");
        putValue(DIAG_GPIO_JP0_1_uC_pin, "4");
        putValue(DIAG_GPIO_JP0_2_uC_pin, "3");
        putValue(DIAG_GPIO_JP0_3_uC_pin, "2");
        putValue(DIAG_GPIO_JP0_4_uC_pin, "1");
        putValue(DIAG_GPIO_JP0_5_uC_pin, "144");
        putValue(DIAG_GPIO_JP0_6_uC_pin, "none");
        putValue(DIAG_GPIO_JP0_7_uC_pin, "none");
        putValue(DIAG_GPIO_JP0_8_uC_pin, "none");
        putValue(DIAG_GPIO_JP0_9_uC_pin, "none");
        putValue(DIAG_GPIO_JP0_10_uC_pin, "none");
        putValue(DIAG_GPIO_JP0_11_uC_pin, "none");
        putValue(DIAG_GPIO_JP0_12_uC_pin, "none");
        putValue(DIAG_GPIO_JP0_13_uC_pin, "none");
        putValue(DIAG_GPIO_JP0_14_uC_pin, "none");
        putValue(DIAG_GPIO_JP0_15_uC_pin, "none");
      
        putValue(DIAG_GPIO_JP0_0_func, "IO");
        putValue(DIAG_GPIO_JP0_1_func, "IO");
        putValue(DIAG_GPIO_JP0_2_func, "IO");
        putValue(DIAG_GPIO_JP0_3_func, "IO");
        putValue(DIAG_GPIO_JP0_4_func, "IO");
        putValue(DIAG_GPIO_JP0_5_func, "IO");
        putValue(DIAG_GPIO_JP0_6_func, "none");
        putValue(DIAG_GPIO_JP0_7_func, "none");
        putValue(DIAG_GPIO_JP0_8_func, "none");
        putValue(DIAG_GPIO_JP0_9_func, "none");
        putValue(DIAG_GPIO_JP0_10_func, "none");
        putValue(DIAG_GPIO_JP0_11_func, "none");
        putValue(DIAG_GPIO_JP0_12_func, "none");
        putValue(DIAG_GPIO_JP0_13_func, "none");
        putValue(DIAG_GPIO_JP0_14_func, "none");
        putValue(DIAG_GPIO_JP0_15_func, "none");
      
        putvalue(DIAG_GPIO_P10_0_dir, "ADC");
	      putvalue(DIAG_GPIO_P10_1_dir, "ADC");
	      putvalue(DIAG_GPIO_P10_2_dir, "ADC");
	      putvalue(DIAG_GPIO_P10_3_dir, "ff");
	      putvalue(DIAG_GPIO_P10_4_dir, "ADC");
	      putvalue(DIAG_GPIO_P10_5_dir, "ADC");
	      putvalue(DIAG_GPIO_P10_6_dir, "ADC");
	      putvalue(DIAG_GPIO_P10_7_dir, "ADC");
	
	      putvalue(DIAG_GPIO_P10_8_dir, "ff");
	      putvalue(DIAG_GPIO_P10_9_dir, "ff");
	      putvalue(DIAG_GPIO_P10_10_dir, "ff");
	      putvalue(DIAG_GPIO_P10_11_dir, "ff");
	      putvalue(DIAG_GPIO_P10_12_dir, "ff");
	      putvalue(DIAG_GPIO_P10_13_dir, "ff");
	      putvalue(DIAG_GPIO_P10_14_dir, "ff");
	      putvalue(DIAG_GPIO_P10_15_dir, "ff");
         
        putvalue(DIAG_GPIO_P16_0_dir, "PWM");
	      putvalue(DIAG_GPIO_P16_1_dir, "PWM");
	      putvalue(DIAG_GPIO_P16_2_dir, "ff");
	      putvalue(DIAG_GPIO_P16_3_dir, "PWM");
	      putvalue(DIAG_GPIO_P16_4_dir, "PWM");
	      putvalue(DIAG_GPIO_P16_5_dir, "PWM");
	      putvalue(DIAG_GPIO_P16_6_dir, "PWM");
	      putvalue(DIAG_GPIO_P16_7_dir, "PWM");
	
	      putvalue(DIAG_GPIO_P16_8_dir, "ff");
	      putvalue(DIAG_GPIO_P16_9_dir, "ff");
	      putvalue(DIAG_GPIO_P16_10_dir, "ff");
	      putvalue(DIAG_GPIO_P16_11_dir, "ff");
	      putvalue(DIAG_GPIO_P16_12_dir, "ff");
	      putvalue(DIAG_GPIO_P16_13_dir, "ff");
	      putvalue(DIAG_GPIO_P16_14_dir, "ff");
	      putvalue(DIAG_GPIO_P16_15_dir, "ff");
        
		    putvalue(DIAG_GPIO_P42_0_dir, "ff");
	      putvalue(DIAG_GPIO_P42_1_dir, "ff");
	      putvalue(DIAG_GPIO_P42_2_dir, "ff");
	      putvalue(DIAG_GPIO_P42_3_dir, "ff");
	      putvalue(DIAG_GPIO_P42_4_dir, "ff");
	      putvalue(DIAG_GPIO_P42_5_dir, "ff");
	      putvalue(DIAG_GPIO_P42_6_dir, "ff");
	      putvalue(DIAG_GPIO_P42_7_dir, "ff");
	
	      putvalue(DIAG_GPIO_P42_8_dir, "ff");
	      putvalue(DIAG_GPIO_P42_9_dir, "ff");
	      putvalue(DIAG_GPIO_P42_10_dir, "ff");
	      putvalue(DIAG_GPIO_P42_11_dir, "ff");
	      putvalue(DIAG_GPIO_P42_12_dir, "ff");
	      putvalue(DIAG_GPIO_P42_13_dir, "ff");
	      putvalue(DIAG_GPIO_P42_14_dir, "ff");
	      putvalue(DIAG_GPIO_P42_15_dir, "ff");

    }
    if( getValue( this ) == cKI_VS30_HL )  // VS30 High-Line/High-Line+
    {    
        //reset info values
        ID_Clear_EnvVars();
        //Info Panel
        putValue( DIAG_Info_Part_0, "P0 Bootloader" );
        putValue( DIAG_Info_Part_1, "P1 Application" );
        putValue( DIAG_Info_Part_2, "P2 Bitmap" );
        putValue( DIAG_Info_Part_3, "P3 Font" );
        putValue( DIAG_Info_Part_4, "P4 Sound" );
        putValue( DIAG_Info_Part_5, "P5 Extension" );
        // PWM-Setup
        cPWM_IndexToChannel[0] =  HL_HLP_TT;
        cPWM_IndexToChannel[1] =  HL_HLP_TT_SAFETY;
        cPWM_IndexToChannel[2] =  HL_HLP_PTR;
        cPWM_IndexToChannel[3] =  HL_HLP_DIAL;
        cPWM_IndexToChannel[4] =  HL_HLP_ART;
        cPWM_IndexToChannel[5] =  HL_HLP_BAR_FU;
        cPWM_IndexToChannel[6] =  HL_HLP_BAR_FU_PASS;
        cPWM_IndexToChannel[7] =  HL_HLP_RES1;
        cPWM_IndexToChannel[8] =  HL_HLP_RES2;
        cPWM_IndexToChannel[9] =  HL_HLP_1V25_SS;
        cPWM_IndexToChannel[10] = HL_HLP_BL_DIMM;
        cPWM_IndexToChannel[11] = HL_HLP_BL_SS;  
        cPWM_IndexToChannel[12] = HL_HLP_BAR_TE;
        cPWM_IndexToChannel[13] = HL_HLP_BAR_TE_PASS;
        putValue( DIAG_PWM_Ch00Title, "PWGA2O  - UC2ILLU_PWM_TT" );
        putValue( DIAG_PWM_Ch01Title, "PWGA3O  - UC2ILLU_PWM_TT_SAFETY" );
        putValue( DIAG_PWM_Ch02Title, "PWGA4O  - UC2ILLU_PWM_PTR" );
        putValue( DIAG_PWM_Ch03Title, "PWGA5O  - UC2ILLU_PWM_DIAL" );
        putValue( DIAG_PWM_Ch04Title, "PWGA6O  - UC2ILLU_PWM_ART" );
        putValue( DIAG_PWM_Ch05Title, "PWGA7O  - UC2ILLU_PWM_BAR_FU" );
        putValue( DIAG_PWM_Ch06Title, "PWGA8O  - UC2ILLU_PWM_BAR_FU_PASS" );
        putValue( DIAG_PWM_Ch07Title, "PWGA9O  - UC2ILLU_PWM_RES1" );
        putValue( DIAG_PWM_Ch08Title, "PWGA10O - UC2ILLU_PWM_RES2" );
        putValue( DIAG_PWM_Ch09Title, "PWGA11O - 1V25_SS" );
        putValue( DIAG_PWM_Ch10Title, "PWGA12O - BL_DIMM" );
        putValue( DIAG_PWM_Ch11Title, "PWGA13O - BL_SS" );
        putValue( DIAG_PWM_Ch12Title, "PWGA14O - UC2ILLU_PWM_BAR_TE" );
        putValue( DIAG_PWM_Ch13Title, "PWGA15O - UC2ILLU_PWM_BAR_TE_PASS" );
        putValue( DIAG_PWM_Ch14Title, "   " );

        //  ADC Kanäle
        putValue( DIAG_ADC_Ch00Title, "ADCE0I0  - ADC_nNTC_PREBOOST" );
        putValue( DIAG_ADC_Ch01Title, "ADCE0I1  - ADC_nNTC_MPS" );
        putValue( DIAG_ADC_Ch02Title, "ADCE0I2  - ADC_nNTC_BLDRIVER" );
        putValue( DIAG_ADC_Ch03Title, "ADCE0I3  - ADC_nNTC_LEFT" );
        putValue( DIAG_ADC_Ch04Title, "ADCE0I4  - ADC_nNTC_RIGHT" );
        putValue( DIAG_ADC_Ch05Title, "ADCE0I5  - ADC_nNTC_AUDIO" );
        putValue( DIAG_ADC_Ch06Title, "unused" );
        putValue( DIAG_ADC_Ch07Title, "ADCE0I7  - ADC_nNTC_TFT" );
        putValue( DIAG_ADC_Ch08Title, "ADCE0I6  - ADC_nPHOTO_AMB" );
        putValue( DIAG_ADC_Ch09Title, "ADCE0I9  - ADC_nHSS_SENSE" );
        putValue( DIAG_ADC_Ch10Title, "ADCE0I10 - ADC_nKL30_ADC" );
        putValue( DIAG_ADC_Ch11Title, "unused" );
        putValue( DIAG_ADC_Ch12Title, "unused" );
        putValue( DIAG_ADC_Ch13Title, "unused" );
        putValue( DIAG_ADC_Ch14Title, "unused" );
        putValue( DIAG_ADC_Ch15Title, "unused" );
        EnableControl( "Calibrate Clock", "Button:DIAG_CALClock_StoreCal", 1 );
      
               //GPIO ports and pins
      
        putValue(DIAG_GPIO_P0_0_nmb, "P0_0");
        putValue(DIAG_GPIO_P0_1_nmb, "P0_1");
        putValue(DIAG_GPIO_P0_2_nmb, "P0_2");
        putValue(DIAG_GPIO_P0_3_nmb, "P0_3");
        putValue(DIAG_GPIO_P0_4_nmb, "P0_4");
        putValue(DIAG_GPIO_P0_5_nmb, "P0_5");
        putValue(DIAG_GPIO_P0_6_nmb, "P0_6");
        putValue(DIAG_GPIO_P0_7_nmb, "P0_7");
        putValue(DIAG_GPIO_P0_8_nmb, "P0_8");
        putValue(DIAG_GPIO_P0_9_nmb, "P0_9");
        putValue(DIAG_GPIO_P0_10_nmb, "P0_10");
        putValue(DIAG_GPIO_P0_11_nmb, "P0_11");
        putValue(DIAG_GPIO_P0_12_nmb, "P0_12");
        putValue(DIAG_GPIO_P0_13_nmb, "P0_13");
        putValue(DIAG_GPIO_P0_14_nmb, "P0_14");
        putValue(DIAG_GPIO_P0_15_nmb, "P0_15");
        
        putValue(DIAG_GPIO_P0_0_uC_pin, "AE9");
        putValue(DIAG_GPIO_P0_1_uC_pin, "AD9");
        putValue(DIAG_GPIO_P0_2_uC_pin, "AF8");
        putValue(DIAG_GPIO_P0_3_uC_pin, "AE8");
        putValue(DIAG_GPIO_P0_4_uC_pin, "AD8");
        putValue(DIAG_GPIO_P0_5_uC_pin, "AC9");
        putValue(DIAG_GPIO_P0_6_uC_pin, "AF7");
        putValue(DIAG_GPIO_P0_7_uC_pin, "AE7");
        putValue(DIAG_GPIO_P0_8_uC_pin, "AD6");
        putValue(DIAG_GPIO_P0_9_uC_pin, "AD7");
        putValue(DIAG_GPIO_P0_10_uC_pin, "none");
        putValue(DIAG_GPIO_P0_11_uC_pin, "none");
        putValue(DIAG_GPIO_P0_12_uC_pin, "none");
        putValue(DIAG_GPIO_P0_13_uC_pin, "none");
        putValue(DIAG_GPIO_P0_14_uC_pin, "none");
        putValue(DIAG_GPIO_P0_15_uC_pin, "none");
      
        putValue(DIAG_GPIO_P0_0_func, "IO");
        putValue(DIAG_GPIO_P0_1_func, "FLMD1");
        putValue(DIAG_GPIO_P0_2_func, "RLIN32TX");
        putValue(DIAG_GPIO_P0_3_func, "RLIN32RX");
        putValue(DIAG_GPIO_P0_4_func, "CAN0TX");
        putValue(DIAG_GPIO_P0_5_func, "CAN0RX");
        putValue(DIAG_GPIO_P0_6_func, "CAN1TX");
        putValue(DIAG_GPIO_P0_7_func, "CAN1RX");
        putValue(DIAG_GPIO_P0_8_func, "INTP9");
        putValue(DIAG_GPIO_P0_9_func, "RLIN30RX");
        putValue(DIAG_GPIO_P0_10_func, "none");
        putValue(DIAG_GPIO_P0_11_func, "none");
        putValue(DIAG_GPIO_P0_12_func, "none");
        putValue(DIAG_GPIO_P0_13_func, "none");
        putValue(DIAG_GPIO_P0_14_func, "none");
        putValue(DIAG_GPIO_P0_15_func, "none");
      
        putValue(DIAG_GPIO_P1_0_nmb, "P1_0");
        putValue(DIAG_GPIO_P1_1_nmb, "P1_1");
        putValue(DIAG_GPIO_P1_2_nmb, "P1_2");
        putValue(DIAG_GPIO_P1_3_nmb, "P1_3");
        putValue(DIAG_GPIO_P1_4_nmb, "P1_4");
        putValue(DIAG_GPIO_P1_5_nmb, "P1_5");
        putValue(DIAG_GPIO_P1_6_nmb, "P1_6");
        putValue(DIAG_GPIO_P1_7_nmb, "P1_7");
        putValue(DIAG_GPIO_P1_8_nmb, "P1_8");
        putValue(DIAG_GPIO_P1_9_nmb, "P1_9");
        putValue(DIAG_GPIO_P1_10_nmb, "P1_10");
        putValue(DIAG_GPIO_P1_11_nmb, "P1_11");
        putValue(DIAG_GPIO_P1_12_nmb, "P1_12");
        putValue(DIAG_GPIO_P1_13_nmb, "P1_13");
        putValue(DIAG_GPIO_P1_14_nmb, "P1_14");
        putValue(DIAG_GPIO_P1_15_nmb, "P1_15");
        
        putValue(DIAG_GPIO_P1_0_uC_pin, "W3");
        putValue(DIAG_GPIO_P1_1_uC_pin, "W1");
        putValue(DIAG_GPIO_P1_2_uC_pin, "W2");
        putValue(DIAG_GPIO_P1_3_uC_pin, "V2");
        putValue(DIAG_GPIO_P1_4_uC_pin, "V3");
        putValue(DIAG_GPIO_P1_5_uC_pin, "V1");
        putValue(DIAG_GPIO_P1_6_uC_pin, "U3");
        putValue(DIAG_GPIO_P1_7_uC_pin, "U2");
        putValue(DIAG_GPIO_P1_8_uC_pin, "U1");
        putValue(DIAG_GPIO_P1_9_uC_pin, "T3");
        putValue(DIAG_GPIO_P1_10_uC_pin, "T2");
        putValue(DIAG_GPIO_P1_11_uC_pin, "T1");
        putValue(DIAG_GPIO_P1_12_uC_pin, "none");
        putValue(DIAG_GPIO_P1_13_uC_pin, "none");
        putValue(DIAG_GPIO_P1_14_uC_pin, "none");
        putValue(DIAG_GPIO_P1_15_uC_pin, "none");
      
        putValue(DIAG_GPIO_P1_0_func, "IO");
        putValue(DIAG_GPIO_P1_1_func, "_CSIH0SSI");
        putValue(DIAG_GPIO_P1_2_func, "IO");
        putValue(DIAG_GPIO_P1_3_func, "CSIH0SO");
        putValue(DIAG_GPIO_P1_4_func, "CSIH0SI");
        putValue(DIAG_GPIO_P1_5_func, "CSIH0SC");
        putValue(DIAG_GPIO_P1_6_func, "CSIG2SO");
        putValue(DIAG_GPIO_P1_7_func, "CSIG2SI");
        putValue(DIAG_GPIO_P1_8_func, "CSIG2SC");
        putValue(DIAG_GPIO_P1_9_func, "IO");
        putValue(DIAG_GPIO_P1_10_func, "IO");
        putValue(DIAG_GPIO_P1_11_func, "IO");
        putValue(DIAG_GPIO_P1_12_func, "none");
        putValue(DIAG_GPIO_P1_13_func, "none");
        putValue(DIAG_GPIO_P1_14_func, "none");
        putValue(DIAG_GPIO_P1_15_func, "none");
      
        putValue(DIAG_GPIO_P2_0_nmb, "P2_0");
        putValue(DIAG_GPIO_P2_1_nmb, "P2_1");
        putValue(DIAG_GPIO_P2_2_nmb, "P2_2");
        putValue(DIAG_GPIO_P2_3_nmb, "P2_3");
        putValue(DIAG_GPIO_P2_4_nmb, "P2_4");
        putValue(DIAG_GPIO_P2_5_nmb, "P2_5");
        putValue(DIAG_GPIO_P2_6_nmb, "P2_6");
        putValue(DIAG_GPIO_P2_7_nmb, "P2_7");
        putValue(DIAG_GPIO_P2_8_nmb, "P2_8");
        putValue(DIAG_GPIO_P2_9_nmb, "P2_9");
        putValue(DIAG_GPIO_P2_10_nmb, "P2_10");
        putValue(DIAG_GPIO_P2_11_nmb, "P2_11");
        putValue(DIAG_GPIO_P2_12_nmb, "P2_12");
        putValue(DIAG_GPIO_P2_13_nmb, "P2_13");
        putValue(DIAG_GPIO_P2_14_nmb, "P2_14");
        putValue(DIAG_GPIO_P2_15_nmb, "P2_15");
        
        putValue(DIAG_GPIO_P2_0_uC_pin, "AC1");
        putValue(DIAG_GPIO_P2_1_uC_pin, "AC3");
        putValue(DIAG_GPIO_P2_2_uC_pin, "AC2");
        putValue(DIAG_GPIO_P2_3_uC_pin, "AB2");
        putValue(DIAG_GPIO_P2_4_uC_pin, "AB3");
        putValue(DIAG_GPIO_P2_5_uC_pin, "AA3");
        putValue(DIAG_GPIO_P2_6_uC_pin, "AB1");
        putValue(DIAG_GPIO_P2_7_uC_pin, "AA1");
        putValue(DIAG_GPIO_P2_8_uC_pin, "AA2");
        putValue(DIAG_GPIO_P2_9_uC_pin, "Y2");
        putValue(DIAG_GPIO_P2_10_uC_pin, "Y3");
        putValue(DIAG_GPIO_P2_11_uC_pin, "Y1");
        putValue(DIAG_GPIO_P2_12_uC_pin, "none");
        putValue(DIAG_GPIO_P2_13_uC_pin, "none");
        putValue(DIAG_GPIO_P2_14_uC_pin, "none");
        putValue(DIAG_GPIO_P2_15_uC_pin, "none");
      
        putValue(DIAG_GPIO_P2_0_func, "IO");
        putValue(DIAG_GPIO_P2_1_func, "CSIG3SO");
        putValue(DIAG_GPIO_P2_2_func, "CSIG3SI");
        putValue(DIAG_GPIO_P2_3_func, "CSIG3SC");
        putValue(DIAG_GPIO_P2_4_func, "IO");
        putValue(DIAG_GPIO_P2_5_func, "CSIG1SO");
        putValue(DIAG_GPIO_P2_6_func, "CSIG1SI");
        putValue(DIAG_GPIO_P2_7_func, "CSIG1SC");
        putValue(DIAG_GPIO_P2_8_func, "IO");
        putValue(DIAG_GPIO_P2_9_func, "IO");
        putValue(DIAG_GPIO_P2_10_func, "IO");
        putValue(DIAG_GPIO_P2_11_func, "IO");
        putValue(DIAG_GPIO_P2_12_func, "none");
        putValue(DIAG_GPIO_P2_13_func, "none");
        putValue(DIAG_GPIO_P2_14_func, "none");
        putValue(DIAG_GPIO_P2_15_func, "none");
		
		    //At some point in time this port will be unpowered due to standby mode, keep in mind
		    putValue(DIAG_GPIO_P3_0_nmb, "P3_0");  
        putValue(DIAG_GPIO_P3_1_nmb, "P3_1");
        putValue(DIAG_GPIO_P3_2_nmb, "P3_2");
        putValue(DIAG_GPIO_P3_3_nmb, "P3_3");
        putValue(DIAG_GPIO_P3_4_nmb, "P3_4");
        putValue(DIAG_GPIO_P3_5_nmb, "P3_5");
        putValue(DIAG_GPIO_P3_6_nmb, "P3_6");
        putValue(DIAG_GPIO_P3_7_nmb, "P3_7");
        putValue(DIAG_GPIO_P3_8_nmb, "P3_8");
        putValue(DIAG_GPIO_P3_9_nmb, "P3_9");
        putValue(DIAG_GPIO_P3_10_nmb, "P3_10");
        putValue(DIAG_GPIO_P3_11_nmb, "P3_11");
        putValue(DIAG_GPIO_P3_12_nmb, "P3_12");
        putValue(DIAG_GPIO_P3_13_nmb, "P3_13");
        putValue(DIAG_GPIO_P3_14_nmb, "P3_14");
        putValue(DIAG_GPIO_P3_15_nmb, "P3_15");
        
        putValue(DIAG_GPIO_P3_0_uC_pin, "AE6");
        putValue(DIAG_GPIO_P3_1_uC_pin, "AE5");
        putValue(DIAG_GPIO_P3_2_uC_pin, "AF6");
        putValue(DIAG_GPIO_P3_3_uC_pin, "AD5");
        putValue(DIAG_GPIO_P3_4_uC_pin, "AF5");
        putValue(DIAG_GPIO_P3_5_uC_pin, "AF4");
        putValue(DIAG_GPIO_P3_6_uC_pin, "AE4");
        putValue(DIAG_GPIO_P3_7_uC_pin, "AE3");
        putValue(DIAG_GPIO_P3_8_uC_pin, "AE2");
        putValue(DIAG_GPIO_P3_9_uC_pin, "AD3");
        putValue(DIAG_GPIO_P3_10_uC_pin, "AD4");
        putValue(DIAG_GPIO_P3_11_uC_pin, "AC4");
        putValue(DIAG_GPIO_P3_12_uC_pin, "AD2");
        putValue(DIAG_GPIO_P3_13_uC_pin, "AD1");
        putValue(DIAG_GPIO_P3_14_uC_pin, "none");
        putValue(DIAG_GPIO_P3_15_uC_pin, "none");
      
        putValue(DIAG_GPIO_P3_0_func, "IO");
        putValue(DIAG_GPIO_P3_1_func, "IO");
        putValue(DIAG_GPIO_P3_2_func, "IO");
        putValue(DIAG_GPIO_P3_3_func, "SSIF0TXD");
        putValue(DIAG_GPIO_P3_4_func, "SSIF0SCK");
        putValue(DIAG_GPIO_P3_5_func, "SSIF0WS");
        putValue(DIAG_GPIO_P3_6_func, "SSIFACK");
        putValue(DIAG_GPIO_P3_7_func, "IO");
        putValue(DIAG_GPIO_P3_8_func, "IO");
        putValue(DIAG_GPIO_P3_9_func, "IO");
        putValue(DIAG_GPIO_P3_10_func, "PWGA12O");
        putValue(DIAG_GPIO_P3_11_func, "PWGA13O");
        putValue(DIAG_GPIO_P3_12_func, "IO");
        putValue(DIAG_GPIO_P3_13_func, "TAUB1I10");
        putValue(DIAG_GPIO_P3_14_func, "none");
        putValue(DIAG_GPIO_P3_15_func, "none");
      
        putValue(DIAG_GPIO_P10_0_nmb, "P10_0");
        putValue(DIAG_GPIO_P10_1_nmb, "P10_1");
        putValue(DIAG_GPIO_P10_2_nmb, "P10_2");
        putValue(DIAG_GPIO_P10_3_nmb, "P10_3");
        putValue(DIAG_GPIO_P10_4_nmb, "P10_4");
        putValue(DIAG_GPIO_P10_5_nmb, "P10_5");
        putValue(DIAG_GPIO_P10_6_nmb, "P10_6");
        putValue(DIAG_GPIO_P10_7_nmb, "P10_7");
        putValue(DIAG_GPIO_P10_8_nmb, "P10_8");
        putValue(DIAG_GPIO_P10_9_nmb, "P10_9");
        putValue(DIAG_GPIO_P10_10_nmb, "P10_10");
        putValue(DIAG_GPIO_P10_11_nmb, "P10_11");
        putValue(DIAG_GPIO_P10_12_nmb, "P10_12");
        putValue(DIAG_GPIO_P10_13_nmb, "P10_13");
        putValue(DIAG_GPIO_P10_14_nmb, "P10_14");
        putValue(DIAG_GPIO_P10_15_nmb, "P10_15");
        
        putValue(DIAG_GPIO_P10_0_uC_pin, "AD21");//ADC
        putValue(DIAG_GPIO_P10_1_uC_pin, "AC21");
        putValue(DIAG_GPIO_P10_2_uC_pin, "AE21");//ADC
        putValue(DIAG_GPIO_P10_3_uC_pin, "AF21");//ADC
        putValue(DIAG_GPIO_P10_4_uC_pin, "AD20");//ADC
        putValue(DIAG_GPIO_P10_5_uC_pin, "AE20");//ADC
        putValue(DIAG_GPIO_P10_6_uC_pin, "AF20");//ADC
        putValue(DIAG_GPIO_P10_7_uC_pin, "AD19");//ADC
        putValue(DIAG_GPIO_P10_8_uC_pin, "AE19");//ADC
        putValue(DIAG_GPIO_P10_9_uC_pin, "AF19");//ADC
        putValue(DIAG_GPIO_P10_10_uC_pin, "AD18");//ADC
        putValue(DIAG_GPIO_P10_11_uC_pin, "AE18");
        putValue(DIAG_GPIO_P10_12_uC_pin, "none");
        putValue(DIAG_GPIO_P10_13_uC_pin, "none");
        putValue(DIAG_GPIO_P10_14_uC_pin, "none");
        putValue(DIAG_GPIO_P10_15_uC_pin, "none");
      
        putValue(DIAG_GPIO_P10_0_func, "ADCE0I0");
        putValue(DIAG_GPIO_P10_1_func, "ADCE0I1");
        putValue(DIAG_GPIO_P10_2_func, "IO");
        putValue(DIAG_GPIO_P10_3_func, "ADCE0I3");
        putValue(DIAG_GPIO_P10_4_func, "ADCE0I4");
        putValue(DIAG_GPIO_P10_5_func, "ADCE0I5");
        putValue(DIAG_GPIO_P10_6_func, "ADCE0I6");
        putValue(DIAG_GPIO_P10_7_func, "ADCE0I7");
        putValue(DIAG_GPIO_P10_8_func, "ADCE0I8");
        putValue(DIAG_GPIO_P10_9_func, "ADCE0I9");
        putValue(DIAG_GPIO_P10_10_func, "ADCE0I10");
        putValue(DIAG_GPIO_P10_11_func, "IO");
        putValue(DIAG_GPIO_P10_12_func, "none");
        putValue(DIAG_GPIO_P10_13_func, "none");
        putValue(DIAG_GPIO_P10_14_func, "none");
        putValue(DIAG_GPIO_P10_15_func, "none");
      
        putValue(DIAG_GPIO_P11_0_nmb, "P11_0");
        putValue(DIAG_GPIO_P11_1_nmb, "P11_1");
        putValue(DIAG_GPIO_P11_2_nmb, "P11_2");
        putValue(DIAG_GPIO_P11_3_nmb, "P11_3");
        putValue(DIAG_GPIO_P11_4_nmb, "P11_4");
        putValue(DIAG_GPIO_P11_5_nmb, "P11_5");
        putValue(DIAG_GPIO_P11_6_nmb, "P11_6");
        putValue(DIAG_GPIO_P11_7_nmb, "P11_7");
        putValue(DIAG_GPIO_P11_8_nmb, "P11_8");
        putValue(DIAG_GPIO_P11_9_nmb, "P11_9");
        putValue(DIAG_GPIO_P11_10_nmb, "P11_10");
        putValue(DIAG_GPIO_P11_11_nmb, "P11_11");
        putValue(DIAG_GPIO_P11_12_nmb, "P11_12");
        putValue(DIAG_GPIO_P11_13_nmb, "P11_13");
        putValue(DIAG_GPIO_P11_14_nmb, "P11_14");
        putValue(DIAG_GPIO_P11_15_nmb, "P11_15");
        
        putValue(DIAG_GPIO_P11_0_uC_pin, "AF18");
        putValue(DIAG_GPIO_P11_1_uC_pin, "AE17");
        putValue(DIAG_GPIO_P11_2_uC_pin, "AC18");
        putValue(DIAG_GPIO_P11_3_uC_pin, "AD17");
        putValue(DIAG_GPIO_P11_4_uC_pin, "AF17");
        putValue(DIAG_GPIO_P11_5_uC_pin, "AE16");
        putValue(DIAG_GPIO_P11_6_uC_pin, "AD16");
        putValue(DIAG_GPIO_P11_7_uC_pin, "AF16");
        putValue(DIAG_GPIO_P11_8_uC_pin, "none");
        putValue(DIAG_GPIO_P11_9_uC_pin, "none");
        putValue(DIAG_GPIO_P11_10_uC_pin, "none");
        putValue(DIAG_GPIO_P11_11_uC_pin, "none");
        putValue(DIAG_GPIO_P11_12_uC_pin, "none");
        putValue(DIAG_GPIO_P11_13_uC_pin, "none");
        putValue(DIAG_GPIO_P11_14_uC_pin, "none");
        putValue(DIAG_GPIO_P11_15_uC_pin, "none");
      
        putValue(DIAG_GPIO_P11_0_func, "IO");
        putValue(DIAG_GPIO_P11_1_func, "IO");
        putValue(DIAG_GPIO_P11_2_func, "IO");
        putValue(DIAG_GPIO_P11_3_func, "IO");
        putValue(DIAG_GPIO_P11_4_func, "IO");
        putValue(DIAG_GPIO_P11_5_func, "IO");
        putValue(DIAG_GPIO_P11_6_func, "IO");
        putValue(DIAG_GPIO_P11_7_func, "IO");
        putValue(DIAG_GPIO_P11_8_func, "none");
        putValue(DIAG_GPIO_P11_9_func, "none");
        putValue(DIAG_GPIO_P11_10_func, "none");
        putValue(DIAG_GPIO_P11_11_func, "none");
        putValue(DIAG_GPIO_P11_12_func, "none");
        putValue(DIAG_GPIO_P11_13_func, "none");
        putValue(DIAG_GPIO_P11_14_func, "none");
        putValue(DIAG_GPIO_P11_15_func, "none");
      
		     //At some point in time this port will be unpowered due to standby mode, keep in mind	  
        putValue(DIAG_GPIO_P16_0_nmb, "P16_0");
        putValue(DIAG_GPIO_P16_1_nmb, "P16_1");
        putValue(DIAG_GPIO_P16_2_nmb, "P16_2");
        putValue(DIAG_GPIO_P16_3_nmb, "P16_3");
        putValue(DIAG_GPIO_P16_4_nmb, "P16_4");
        putValue(DIAG_GPIO_P16_5_nmb, "P16_5");
        putValue(DIAG_GPIO_P16_6_nmb, "P16_6");
        putValue(DIAG_GPIO_P16_7_nmb, "P16_7");
        putValue(DIAG_GPIO_P16_8_nmb, "P16_8");
        putValue(DIAG_GPIO_P16_9_nmb, "P16_9");
        putValue(DIAG_GPIO_P16_10_nmb, "P16_10");
        putValue(DIAG_GPIO_P16_11_nmb, "P16_11");
        putValue(DIAG_GPIO_P16_12_nmb, "P16_12");
        putValue(DIAG_GPIO_P16_13_nmb, "P16_13");
        putValue(DIAG_GPIO_P16_14_nmb, "P16_14");
        putValue(DIAG_GPIO_P16_15_nmb, "P16_15");
        
        putValue(DIAG_GPIO_P16_0_uC_pin, "M23");
        putValue(DIAG_GPIO_P16_1_uC_pin, "N24");
        putValue(DIAG_GPIO_P16_2_uC_pin, "N23");
        putValue(DIAG_GPIO_P16_3_uC_pin, "P25");
        putValue(DIAG_GPIO_P16_4_uC_pin, "P23");
        putValue(DIAG_GPIO_P16_5_uC_pin, "R26");
        putValue(DIAG_GPIO_P16_6_uC_pin, "R23");
        putValue(DIAG_GPIO_P16_7_uC_pin, "P24");
        putValue(DIAG_GPIO_P16_8_uC_pin, "R25");
        putValue(DIAG_GPIO_P16_9_uC_pin, "R24");
        putValue(DIAG_GPIO_P16_10_uC_pin, "T26");
        putValue(DIAG_GPIO_P16_11_uC_pin, "T25");
        putValue(DIAG_GPIO_P16_12_uC_pin, "none");
        putValue(DIAG_GPIO_P16_13_uC_pin, "none");
        putValue(DIAG_GPIO_P16_14_uC_pin, "none");
        putValue(DIAG_GPIO_P16_15_uC_pin, "none");
      
        putValue(DIAG_GPIO_P16_0_func, "IO");
        putValue(DIAG_GPIO_P16_1_func, "IO");
        putValue(DIAG_GPIO_P16_2_func, "IO");
        putValue(DIAG_GPIO_P16_3_func, "IO");
        putValue(DIAG_GPIO_P16_4_func, "IO");
        putValue(DIAG_GPIO_P16_5_func, "IO");
        putValue(DIAG_GPIO_P16_6_func, "IO");
        putValue(DIAG_GPIO_P16_7_func, "IO");
        putValue(DIAG_GPIO_P16_8_func, "IO");
        putValue(DIAG_GPIO_P16_9_func, "IO");
        putValue(DIAG_GPIO_P16_10_func, "IO");
        putValue(DIAG_GPIO_P16_11_func, "IO");
        putValue(DIAG_GPIO_P16_12_func, "none");
        putValue(DIAG_GPIO_P16_13_func, "none");
        putValue(DIAG_GPIO_P16_14_func, "none");
        putValue(DIAG_GPIO_P16_15_func, "none");

		//At some point in time this port will be unpowered due to standby mode, keep in mind		
        putValue(DIAG_GPIO_P17_0_nmb, "P17_0");
        putValue(DIAG_GPIO_P17_1_nmb, "P17_1");
        putValue(DIAG_GPIO_P17_2_nmb, "P17_2");
        putValue(DIAG_GPIO_P17_3_nmb, "P17_3");
        putValue(DIAG_GPIO_P17_4_nmb, "P17_4");
        putValue(DIAG_GPIO_P17_5_nmb, "P17_5");
        putValue(DIAG_GPIO_P17_6_nmb, "P17_6");
        putValue(DIAG_GPIO_P17_7_nmb, "P17_7");
        putValue(DIAG_GPIO_P17_8_nmb, "P17_8");
        putValue(DIAG_GPIO_P17_9_nmb, "P17_9");
        putValue(DIAG_GPIO_P17_10_nmb, "P17_10");
        putValue(DIAG_GPIO_P17_11_nmb, "P17_11");
        putValue(DIAG_GPIO_P17_12_nmb, "P17_12");
        putValue(DIAG_GPIO_P17_13_nmb, "P17_13");
        putValue(DIAG_GPIO_P17_14_nmb, "P17_14");
        putValue(DIAG_GPIO_P17_15_nmb, "P17_15");
        
        putValue(DIAG_GPIO_P17_0_uC_pin, "T23");
        putValue(DIAG_GPIO_P17_1_uC_pin, "U26");
        putValue(DIAG_GPIO_P17_2_uC_pin, "U23");
        putValue(DIAG_GPIO_P17_3_uC_pin, "T24");
        putValue(DIAG_GPIO_P17_4_uC_pin, "U25");
        putValue(DIAG_GPIO_P17_5_uC_pin, "U24");
        putValue(DIAG_GPIO_P17_6_uC_pin, "V26");
        putValue(DIAG_GPIO_P17_7_uC_pin, "V25");
        putValue(DIAG_GPIO_P17_8_uC_pin, "V24");
        putValue(DIAG_GPIO_P17_9_uC_pin, "V23");
        putValue(DIAG_GPIO_P17_10_uC_pin, "W24");
        putValue(DIAG_GPIO_P17_11_uC_pin, "W23");
        putValue(DIAG_GPIO_P17_12_uC_pin, "none");
        putValue(DIAG_GPIO_P17_13_uC_pin, "none");
        putValue(DIAG_GPIO_P17_14_uC_pin, "none");
        putValue(DIAG_GPIO_P17_15_uC_pin, "none");
      
        putValue(DIAG_GPIO_P17_0_func, "IO");
        putValue(DIAG_GPIO_P17_1_func, "IO");
        putValue(DIAG_GPIO_P17_2_func, "IO");
        putValue(DIAG_GPIO_P17_3_func, "IO");
        putValue(DIAG_GPIO_P17_4_func, "ISM31");
        putValue(DIAG_GPIO_P17_5_func, "ISM32");
        putValue(DIAG_GPIO_P17_6_func, "ISM33");
        putValue(DIAG_GPIO_P17_7_func, "ISM34");
        putValue(DIAG_GPIO_P17_8_func, "ISM41");
        putValue(DIAG_GPIO_P17_9_func, "ISM42");
        putValue(DIAG_GPIO_P17_10_func, "ISM43");
        putValue(DIAG_GPIO_P17_11_func, "ISM44");
        putValue(DIAG_GPIO_P17_12_func, "none");
        putValue(DIAG_GPIO_P17_13_func, "none");
        putValue(DIAG_GPIO_P17_14_func, "none");
        putValue(DIAG_GPIO_P17_15_func, "none");
      
        putValue(DIAG_GPIO_P21_0_nmb, "P21_0");
        putValue(DIAG_GPIO_P21_1_nmb, "P21_1");
        putValue(DIAG_GPIO_P21_2_nmb, "P21_2");
        putValue(DIAG_GPIO_P21_3_nmb, "P21_3");
        putValue(DIAG_GPIO_P21_4_nmb, "P21_4");
        putValue(DIAG_GPIO_P21_5_nmb, "P21_5");
        putValue(DIAG_GPIO_P21_6_nmb, "P21_6");
        putValue(DIAG_GPIO_P21_7_nmb, "P21_7");
        putValue(DIAG_GPIO_P21_8_nmb, "P21_8");
        putValue(DIAG_GPIO_P21_9_nmb, "P21_9");
        putValue(DIAG_GPIO_P21_10_nmb, "P21_10");
        putValue(DIAG_GPIO_P21_11_nmb, "P21_11");
        putValue(DIAG_GPIO_P21_12_nmb, "P21_12");
        putValue(DIAG_GPIO_P21_13_nmb, "P21_13");
        putValue(DIAG_GPIO_P21_14_nmb, "P21_14");
        putValue(DIAG_GPIO_P21_15_nmb, "P21_15");
        
        putValue(DIAG_GPIO_P21_0_uC_pin, "C17");
        putValue(DIAG_GPIO_P21_1_uC_pin, "C16");
        putValue(DIAG_GPIO_P21_2_uC_pin, "B16");
        putValue(DIAG_GPIO_P21_3_uC_pin, "A16");
        putValue(DIAG_GPIO_P21_4_uC_pin, "C15");
        putValue(DIAG_GPIO_P21_5_uC_pin, "B15");
        putValue(DIAG_GPIO_P21_6_uC_pin, "A15");
        putValue(DIAG_GPIO_P21_7_uC_pin, "B14");
        putValue(DIAG_GPIO_P21_8_uC_pin, "C14");
        putValue(DIAG_GPIO_P21_9_uC_pin, "A14");
        putValue(DIAG_GPIO_P21_10_uC_pin, "B13");
        putValue(DIAG_GPIO_P21_11_uC_pin, "C13");
        putValue(DIAG_GPIO_P21_12_uC_pin, "A13");
        putValue(DIAG_GPIO_P21_13_uC_pin, "none");
        putValue(DIAG_GPIO_P21_14_uC_pin, "none");
        putValue(DIAG_GPIO_P21_15_uC_pin, "none");
      
        putValue(DIAG_GPIO_P21_0_func, "SFMA0CLK");
        putValue(DIAG_GPIO_P21_1_func, "SFMA0SSL");
        putValue(DIAG_GPIO_P21_2_func, "SFMA0I00");
        putValue(DIAG_GPIO_P21_3_func, "SFMA0I10");
        putValue(DIAG_GPIO_P21_4_func, "SFMA0I20");
        putValue(DIAG_GPIO_P21_5_func, "SFMA0I30");
        putValue(DIAG_GPIO_P21_6_func, "SFMA0I01");
        putValue(DIAG_GPIO_P21_7_func, "SFMA0I11");
        putValue(DIAG_GPIO_P21_8_func, "SFMA0I21");
        putValue(DIAG_GPIO_P21_9_func, "SFMA0O31");
        putValue(DIAG_GPIO_P21_10_func, "IO");
        putValue(DIAG_GPIO_P21_11_func, "IO");
        putValue(DIAG_GPIO_P21_12_func, "TAUB0I15");
        putValue(DIAG_GPIO_P21_13_func, "none");
        putValue(DIAG_GPIO_P21_14_func, "none");
        putValue(DIAG_GPIO_P21_15_func, "none");
      
        putValue(DIAG_GPIO_P40_0_nmb, "P40_0");
        putValue(DIAG_GPIO_P40_1_nmb, "P40_1");
        putValue(DIAG_GPIO_P40_2_nmb, "P40_2");
        putValue(DIAG_GPIO_P40_3_nmb, "P40_3");
        putValue(DIAG_GPIO_P40_4_nmb, "P40_4");
        putValue(DIAG_GPIO_P40_5_nmb, "P40_5");
        putValue(DIAG_GPIO_P40_6_nmb, "P40_6");
        putValue(DIAG_GPIO_P40_7_nmb, "P40_7");
        putValue(DIAG_GPIO_P40_8_nmb, "P40_8");
        putValue(DIAG_GPIO_P40_9_nmb, "P40_9");
        putValue(DIAG_GPIO_P40_10_nmb, "P40_10");
        putValue(DIAG_GPIO_P40_11_nmb, "P40_11");
        putValue(DIAG_GPIO_P40_12_nmb, "P40_12");
        putValue(DIAG_GPIO_P40_13_nmb, "P40_13");
        putValue(DIAG_GPIO_P40_14_nmb, "P40_14");
        putValue(DIAG_GPIO_P40_15_nmb, "P40_15");
        
        putValue(DIAG_GPIO_P40_0_uC_pin, "AD14");
        putValue(DIAG_GPIO_P40_1_uC_pin, "AD15");
        putValue(DIAG_GPIO_P40_2_uC_pin, "AE14");
        putValue(DIAG_GPIO_P40_3_uC_pin, "AF14");
        putValue(DIAG_GPIO_P40_4_uC_pin, "AE15");
        putValue(DIAG_GPIO_P40_5_uC_pin, "AF15");
        putValue(DIAG_GPIO_P40_6_uC_pin, "none");
        putValue(DIAG_GPIO_P40_7_uC_pin, "none");
        putValue(DIAG_GPIO_P40_8_uC_pin, "none");
        putValue(DIAG_GPIO_P40_9_uC_pin, "none");
        putValue(DIAG_GPIO_P40_10_uC_pin, "none");
        putValue(DIAG_GPIO_P40_11_uC_pin, "none");
        putValue(DIAG_GPIO_P40_12_uC_pin, "none");
        putValue(DIAG_GPIO_P40_13_uC_pin, "none");
        putValue(DIAG_GPIO_P40_14_uC_pin, "none");
        putValue(DIAG_GPIO_P40_15_uC_pin, "none");
      
        putValue(DIAG_GPIO_P40_0_func, "IO");
        putValue(DIAG_GPIO_P40_1_func, "IO");
        putValue(DIAG_GPIO_P40_2_func, "IO");
        putValue(DIAG_GPIO_P40_3_func, "IO");
        putValue(DIAG_GPIO_P40_4_func, "IO");
        putValue(DIAG_GPIO_P40_5_func, "IO");
        putValue(DIAG_GPIO_P40_6_func, "none");
        putValue(DIAG_GPIO_P40_7_func, "none");
        putValue(DIAG_GPIO_P40_8_func, "none");
        putValue(DIAG_GPIO_P40_9_func, "none");
        putValue(DIAG_GPIO_P40_10_func, "none");
        putValue(DIAG_GPIO_P40_11_func, "none");
        putValue(DIAG_GPIO_P40_12_func, "none");
        putValue(DIAG_GPIO_P40_13_func, "none");
        putValue(DIAG_GPIO_P40_14_func, "none");
        putValue(DIAG_GPIO_P40_15_func, "none");
      
        putValue(DIAG_GPIO_P42_0_nmb, "P42_0");
        putValue(DIAG_GPIO_P42_1_nmb, "P42_1");
        putValue(DIAG_GPIO_P42_2_nmb, "P42_2");
        putValue(DIAG_GPIO_P42_3_nmb, "P42_3");
        putValue(DIAG_GPIO_P42_4_nmb, "P42_4");
        putValue(DIAG_GPIO_P42_5_nmb, "P42_5");
        putValue(DIAG_GPIO_P42_6_nmb, "P42_6");
        putValue(DIAG_GPIO_P42_7_nmb, "P42_7");
        putValue(DIAG_GPIO_P42_8_nmb, "P42_8");
        putValue(DIAG_GPIO_P42_9_nmb, "P42_9");
        putValue(DIAG_GPIO_P42_10_nmb, "P42_10");
        putValue(DIAG_GPIO_P42_11_nmb, "P42_11");
        putValue(DIAG_GPIO_P42_12_nmb, "P42_12");
        putValue(DIAG_GPIO_P42_13_nmb, "P42_13");
        putValue(DIAG_GPIO_P42_14_nmb, "P42_14");
        putValue(DIAG_GPIO_P42_15_nmb, "P42_15");
        
        putValue(DIAG_GPIO_P42_0_uC_pin, "B22");
        putValue(DIAG_GPIO_P42_1_uC_pin, "A22");
        putValue(DIAG_GPIO_P42_2_uC_pin, "B21");//PWM
        putValue(DIAG_GPIO_P42_3_uC_pin, "C21");//PWM
        putValue(DIAG_GPIO_P42_4_uC_pin, "C20");//PWM
        putValue(DIAG_GPIO_P42_5_uC_pin, "A21");//PWM
        putValue(DIAG_GPIO_P42_6_uC_pin, "A20");//PWM
        putValue(DIAG_GPIO_P42_7_uC_pin, "B20");
        putValue(DIAG_GPIO_P42_8_uC_pin, "C19");
        putValue(DIAG_GPIO_P42_9_uC_pin, "B19");//PWM
        putValue(DIAG_GPIO_P42_10_uC_pin, "A19");//PWM
        putValue(DIAG_GPIO_P42_11_uC_pin, "C18");//PWM
        putValue(DIAG_GPIO_P42_12_uC_pin, "B18");//PWM
        putValue(DIAG_GPIO_P42_13_uC_pin, "A18");//PWM
        putValue(DIAG_GPIO_P42_14_uC_pin, "B17");//PWM
        putValue(DIAG_GPIO_P42_15_uC_pin, "A17");//PWM
      
        putValue(DIAG_GPIO_P42_0_func, "RIIC1SDA");
        putValue(DIAG_GPIO_P42_1_func, "RIIC1SCL");
        putValue(DIAG_GPIO_P42_2_func, "PWGA2O");
        putValue(DIAG_GPIO_P42_3_func, "PWGA3O");
        putValue(DIAG_GPIO_P42_4_func, "PWGA4O");
        putValue(DIAG_GPIO_P42_5_func, "PWGA5O");
        putValue(DIAG_GPIO_P42_6_func, "PWGA6O");
        putValue(DIAG_GPIO_P42_7_func, "IO");
        putValue(DIAG_GPIO_P42_8_func, "IO");
        putValue(DIAG_GPIO_P42_9_func, "PWGA14O");
        putValue(DIAG_GPIO_P42_10_func, "PWGA15O");
        putValue(DIAG_GPIO_P42_11_func, "PWGA7O");
        putValue(DIAG_GPIO_P42_12_func, "PWGA8O");
        putValue(DIAG_GPIO_P42_13_func, "PWGA9O");
        putValue(DIAG_GPIO_P42_14_func, "PWGA10O");
        putValue(DIAG_GPIO_P42_15_func, "PWGA11O");
      
        putValue(DIAG_GPIO_P43_0_nmb, "P43_0");
        putValue(DIAG_GPIO_P43_1_nmb, "P43_1");
        putValue(DIAG_GPIO_P43_2_nmb, "P43_2");
        putValue(DIAG_GPIO_P43_3_nmb, "P43_3");
        putValue(DIAG_GPIO_P43_4_nmb, "P43_4");
        putValue(DIAG_GPIO_P43_5_nmb, "P43_5");
        putValue(DIAG_GPIO_P43_6_nmb, "P43_6");
        putValue(DIAG_GPIO_P43_7_nmb, "P43_7");
        putValue(DIAG_GPIO_P43_8_nmb, "P43_8");
        putValue(DIAG_GPIO_P43_9_nmb, "P43_9");
        putValue(DIAG_GPIO_P43_10_nmb, "P43_10");
        putValue(DIAG_GPIO_P43_11_nmb, "P43_11");
        putValue(DIAG_GPIO_P43_12_nmb, "P43_12");
        putValue(DIAG_GPIO_P43_13_nmb, "P43_13");
        putValue(DIAG_GPIO_P43_14_nmb, "P43_14");
        putValue(DIAG_GPIO_P43_15_nmb, "P43_15");
        
        putValue(DIAG_GPIO_P43_0_uC_pin, "P26");
        putValue(DIAG_GPIO_P43_1_uC_pin, "N25");
        putValue(DIAG_GPIO_P43_2_uC_pin, "N26");
        putValue(DIAG_GPIO_P43_3_uC_pin, "M24");
        putValue(DIAG_GPIO_P43_4_uC_pin, "M25");
        putValue(DIAG_GPIO_P43_5_uC_pin, "M26");
        putValue(DIAG_GPIO_P43_6_uC_pin, "L24");
        putValue(DIAG_GPIO_P43_7_uC_pin, "B24");
        putValue(DIAG_GPIO_P43_8_uC_pin, "A24");
        putValue(DIAG_GPIO_P43_9_uC_pin, "C23");
        putValue(DIAG_GPIO_P43_10_uC_pin, "B23");
        putValue(DIAG_GPIO_P43_11_uC_pin, "A23");
        putValue(DIAG_GPIO_P43_12_uC_pin, "C22");
        putValue(DIAG_GPIO_P43_13_uC_pin, "none");
        putValue(DIAG_GPIO_P43_14_uC_pin, "none");
        putValue(DIAG_GPIO_P43_15_uC_pin, "none");
      
        putValue(DIAG_GPIO_P43_0_func, "VDCE0_VO_TCON2");
        putValue(DIAG_GPIO_P43_1_func, "VDCE0_VO_TCON0");
        putValue(DIAG_GPIO_P43_2_func, "VDCE0_VO_TCON3");
        putValue(DIAG_GPIO_P43_3_func, "IO");
        putValue(DIAG_GPIO_P43_4_func, "IO");
        putValue(DIAG_GPIO_P43_5_func, "IO");
        putValue(DIAG_GPIO_P43_6_func, "IO");
        putValue(DIAG_GPIO_P43_7_func, "TAUB0I9");
        putValue(DIAG_GPIO_P43_8_func, "TAUB0I10");
        putValue(DIAG_GPIO_P43_9_func, "IO");
        putValue(DIAG_GPIO_P43_10_func, "IO");
        putValue(DIAG_GPIO_P43_11_func, "IO");
        putValue(DIAG_GPIO_P43_12_func, "IO");
        putValue(DIAG_GPIO_P43_13_func, "none");
        putValue(DIAG_GPIO_P43_14_func, "none");
        putValue(DIAG_GPIO_P43_15_func, "none");
      
        putValue(DIAG_GPIO_P44_0_nmb, "P44_0");
        putValue(DIAG_GPIO_P44_1_nmb, "P44_1");
        putValue(DIAG_GPIO_P44_2_nmb, "P44_2");
        putValue(DIAG_GPIO_P44_3_nmb, "P44_3");
        putValue(DIAG_GPIO_P44_4_nmb, "P44_4");
        putValue(DIAG_GPIO_P44_5_nmb, "P44_5");
        putValue(DIAG_GPIO_P44_6_nmb, "P44_6");
        putValue(DIAG_GPIO_P44_7_nmb, "P44_7");
        putValue(DIAG_GPIO_P44_8_nmb, "P44_8");
        putValue(DIAG_GPIO_P44_9_nmb, "P44_9");
        putValue(DIAG_GPIO_P44_10_nmb, "P44_10");
        putValue(DIAG_GPIO_P44_11_nmb, "P44_11");
        putValue(DIAG_GPIO_P44_12_nmb, "P44_12");
        putValue(DIAG_GPIO_P44_13_nmb, "P44_13");
        putValue(DIAG_GPIO_P44_14_nmb, "P44_14");
        putValue(DIAG_GPIO_P44_15_nmb, "P44_15");
        
        putValue(DIAG_GPIO_P44_0_uC_pin, "AF22");
        putValue(DIAG_GPIO_P44_1_uC_pin, "AE22");
        putValue(DIAG_GPIO_P44_2_uC_pin, "AF23");
        putValue(DIAG_GPIO_P44_3_uC_pin, "AE23");
        putValue(DIAG_GPIO_P44_4_uC_pin, "AD22");
        putValue(DIAG_GPIO_P44_5_uC_pin, "AD23");
        putValue(DIAG_GPIO_P44_6_uC_pin, "AF24");
        putValue(DIAG_GPIO_P44_7_uC_pin, "AE24");
        putValue(DIAG_GPIO_P44_8_uC_pin, "AE25");
        putValue(DIAG_GPIO_P44_9_uC_pin, "AD24");
        putValue(DIAG_GPIO_P44_10_uC_pin, "AC24");
        putValue(DIAG_GPIO_P44_11_uC_pin, "AB24");
        putValue(DIAG_GPIO_P44_12_uC_pin, "none");
        putValue(DIAG_GPIO_P44_13_uC_pin, "none");
        putValue(DIAG_GPIO_P44_14_uC_pin, "none");
        putValue(DIAG_GPIO_P44_15_uC_pin, "none");
      
        putValue(DIAG_GPIO_P44_0_func, "VDCE0_VO_DATA23");
        putValue(DIAG_GPIO_P44_1_func, "VDCE0_VO_DATA22");
        putValue(DIAG_GPIO_P44_2_func, "VDCE0_VO_DATA21");
        putValue(DIAG_GPIO_P44_3_func, "VDCE0_VO_DATA20");
        putValue(DIAG_GPIO_P44_4_func, "VDCE0_VO_DATA19");
        putValue(DIAG_GPIO_P44_5_func, "VDCE0_VO_DATA18");
        putValue(DIAG_GPIO_P44_6_func, "VDCE0_VO_DATA17");
        putValue(DIAG_GPIO_P44_7_func, "VDCE0_VO_DATA16");
        putValue(DIAG_GPIO_P44_8_func, "VDCE0_VO_DATA15");
        putValue(DIAG_GPIO_P44_9_func, "VDCE0_VO_DATA14");
        putValue(DIAG_GPIO_P44_10_func, "VDCE0_VO_DATA13");
        putValue(DIAG_GPIO_P44_11_func, "VDCE0_VO_DATA12");
        putValue(DIAG_GPIO_P44_12_func, "none");
        putValue(DIAG_GPIO_P44_13_func, "none");
        putValue(DIAG_GPIO_P44_14_func, "none");
        putValue(DIAG_GPIO_P44_15_func, "none");
      
        putValue(DIAG_GPIO_P45_0_nmb, "P45_0");
        putValue(DIAG_GPIO_P45_1_nmb, "P45_1");
        putValue(DIAG_GPIO_P45_2_nmb, "P45_2");
        putValue(DIAG_GPIO_P45_3_nmb, "P45_3");
        putValue(DIAG_GPIO_P45_4_nmb, "P45_4");
        putValue(DIAG_GPIO_P45_5_nmb, "P45_5");
        putValue(DIAG_GPIO_P45_6_nmb, "P45_6");
        putValue(DIAG_GPIO_P45_7_nmb, "P45_7");
        putValue(DIAG_GPIO_P45_8_nmb, "P45_8");
        putValue(DIAG_GPIO_P45_9_nmb, "P45_9");
        putValue(DIAG_GPIO_P45_10_nmb, "P45_10");
        putValue(DIAG_GPIO_P45_11_nmb, "P45_11");
        putValue(DIAG_GPIO_P45_12_nmb, "P45_12");
        putValue(DIAG_GPIO_P45_13_nmb, "P45_13");
        putValue(DIAG_GPIO_P45_14_nmb, "P45_14");
        putValue(DIAG_GPIO_P45_15_nmb, "P45_15");
        
        putValue(DIAG_GPIO_P45_0_uC_pin, "AD25");
        putValue(DIAG_GPIO_P45_1_uC_pin, "AD26");
        putValue(DIAG_GPIO_P45_2_uC_pin, "AC25");
        putValue(DIAG_GPIO_P45_3_uC_pin, "AC26");
        putValue(DIAG_GPIO_P45_4_uC_pin, "AA24");
        putValue(DIAG_GPIO_P45_5_uC_pin, "Y24");
        putValue(DIAG_GPIO_P45_6_uC_pin, "AB25");
        putValue(DIAG_GPIO_P45_7_uC_pin, "AB26");
        putValue(DIAG_GPIO_P45_8_uC_pin, "AA25");
        putValue(DIAG_GPIO_P45_9_uC_pin, "AA26");
        putValue(DIAG_GPIO_P45_10_uC_pin, "Y25");
        putValue(DIAG_GPIO_P45_11_uC_pin, "Y26");
        putValue(DIAG_GPIO_P45_12_uC_pin, "W25");
        putValue(DIAG_GPIO_P45_13_uC_pin, "W26");
        putValue(DIAG_GPIO_P45_14_uC_pin, "none");
        putValue(DIAG_GPIO_P45_15_uC_pin, "none");
        
         putValue(DIAG_GPIO_P45_0_func, "VDCE0_VO_CLKP");
        putValue(DIAG_GPIO_P45_1_func, "VDCE0_VO_CLKN");
        putValue(DIAG_GPIO_P45_2_func, "VDCE0_VO_DATA11");
        putValue(DIAG_GPIO_P45_3_func, "VDCE0_VO_DATA10");
        putValue(DIAG_GPIO_P45_4_func, "VDCE0_VO_DATA9");
        putValue(DIAG_GPIO_P45_5_func, "VDCE0_VO_DATA8");
        putValue(DIAG_GPIO_P45_6_func, "VDCE0_VO_DATA7");
        putValue(DIAG_GPIO_P45_7_func, "VDCE0_VO_DATA6");
        putValue(DIAG_GPIO_P45_8_func, "VDCE0_VO_DATA5");
        putValue(DIAG_GPIO_P45_9_func, "VDCE0_VO_DATA4");
        putValue(DIAG_GPIO_P45_10_func, "VDCE0_VO_DATA3");
        putValue(DIAG_GPIO_P45_11_func, "VDCE0_VO_DATA2");
        putValue(DIAG_GPIO_P45_12_func, "VDCE0_VO_DATA1");
        putValue(DIAG_GPIO_P45_13_func, "VDCE0_VO_DATA0");
        putValue(DIAG_GPIO_P45_14_func, "none");
        putValue(DIAG_GPIO_P45_15_func, "none");
      
        putValue(DIAG_GPIO_JP0_0_nmb, "JP0_0");
        putValue(DIAG_GPIO_JP0_1_nmb, "JP0_1");
        putValue(DIAG_GPIO_JP0_2_nmb, "JP0_2");
        putValue(DIAG_GPIO_JP0_3_nmb, "JP0_3");
        putValue(DIAG_GPIO_JP0_4_nmb, "JP0_4");
        putValue(DIAG_GPIO_JP0_5_nmb, "JP0_5");
        putValue(DIAG_GPIO_JP0_6_nmb, "JP0_6");
        putValue(DIAG_GPIO_JP0_7_nmb, "JP0_7");
        putValue(DIAG_GPIO_JP0_8_nmb, "JP0_8");
        putValue(DIAG_GPIO_JP0_9_nmb, "JP0_9");
        putValue(DIAG_GPIO_JP0_10_nmb, "JP0_10");
        putValue(DIAG_GPIO_JP0_11_nmb, "JP0_11");
        putValue(DIAG_GPIO_JP0_12_nmb, "JP0_12");
        putValue(DIAG_GPIO_JP0_13_nmb, "JP0_13");
        putValue(DIAG_GPIO_JP0_14_nmb, "JP0_14");
        putValue(DIAG_GPIO_JP0_15_nmb, "JP0_15");
        
        putValue(DIAG_GPIO_JP0_0_uC_pin, "AD13");
        putValue(DIAG_GPIO_JP0_1_uC_pin, "AE12");
        putValue(DIAG_GPIO_JP0_2_uC_pin, "AC13");
        putValue(DIAG_GPIO_JP0_3_uC_pin, "AD12");
        putValue(DIAG_GPIO_JP0_4_uC_pin, "AC11");
        putValue(DIAG_GPIO_JP0_5_uC_pin, "AF9");
        putValue(DIAG_GPIO_JP0_6_uC_pin, "none");
        putValue(DIAG_GPIO_JP0_7_uC_pin, "none");
        putValue(DIAG_GPIO_JP0_8_uC_pin, "none");
        putValue(DIAG_GPIO_JP0_9_uC_pin, "none");
        putValue(DIAG_GPIO_JP0_10_uC_pin, "none");
        putValue(DIAG_GPIO_JP0_11_uC_pin, "none");
        putValue(DIAG_GPIO_JP0_12_uC_pin, "none");
        putValue(DIAG_GPIO_JP0_13_uC_pin, "none");
        putValue(DIAG_GPIO_JP0_14_uC_pin, "none");
        putValue(DIAG_GPIO_JP0_15_uC_pin, "none");
      
        putValue(DIAG_GPIO_JP0_0_func, "DCUTDI");
        putValue(DIAG_GPIO_JP0_1_func, "DCUTDO");
        putValue(DIAG_GPIO_JP0_2_func, "DCUTCK");
        putValue(DIAG_GPIO_JP0_3_func, "DCUTMS");
        putValue(DIAG_GPIO_JP0_4_func, "_DCUTRST");
        putValue(DIAG_GPIO_JP0_5_func, "_DCUTRDY");
        putValue(DIAG_GPIO_JP0_6_func, "none");
        putValue(DIAG_GPIO_JP0_7_func, "none");
        putValue(DIAG_GPIO_JP0_8_func, "none");
        putValue(DIAG_GPIO_JP0_9_func, "none");
        putValue(DIAG_GPIO_JP0_10_func, "none");
        putValue(DIAG_GPIO_JP0_11_func, "none");
        putValue(DIAG_GPIO_JP0_12_func, "none");
        putValue(DIAG_GPIO_JP0_13_func, "none");
        putValue(DIAG_GPIO_JP0_14_func, "none");
        putValue(DIAG_GPIO_JP0_15_func, "none");
      
        putvalue(DIAG_GPIO_P10_0_dir, "ADC");
	      putvalue(DIAG_GPIO_P10_1_dir, "ADC");
	      putvalue(DIAG_GPIO_P10_2_dir, "ADC");
	      putvalue(DIAG_GPIO_P10_3_dir, "ADC");
	      putvalue(DIAG_GPIO_P10_4_dir, "ADC");
	      putvalue(DIAG_GPIO_P10_5_dir, "ADC");
	      putvalue(DIAG_GPIO_P10_6_dir, "ADC");
	      putvalue(DIAG_GPIO_P10_7_dir, "ADC");
	
	      putvalue(DIAG_GPIO_P10_8_dir, "ADC");
	      putvalue(DIAG_GPIO_P10_9_dir, "ADC");
	      putvalue(DIAG_GPIO_P10_10_dir, "ADC");
	      putvalue(DIAG_GPIO_P10_11_dir, "ADC");
	      putvalue(DIAG_GPIO_P10_12_dir, "ff");
	      putvalue(DIAG_GPIO_P10_13_dir, "ff");
	      putvalue(DIAG_GPIO_P10_14_dir, "ff");
	      putvalue(DIAG_GPIO_P10_15_dir, "ff");
        
		    putvalue(DIAG_GPIO_P16_0_dir, "ff");
	      putvalue(DIAG_GPIO_P16_1_dir, "ff");
	      putvalue(DIAG_GPIO_P16_2_dir, "ff");
	      putvalue(DIAG_GPIO_P16_3_dir, "ff");
	      putvalue(DIAG_GPIO_P16_4_dir, "ff");
	      putvalue(DIAG_GPIO_P16_5_dir, "ff");
	      putvalue(DIAG_GPIO_P16_6_dir, "ff");
	      putvalue(DIAG_GPIO_P16_7_dir, "ff");
	
	      putvalue(DIAG_GPIO_P16_8_dir, "ff");
	      putvalue(DIAG_GPIO_P16_9_dir, "ff");
	      putvalue(DIAG_GPIO_P16_10_dir, "ff");
	      putvalue(DIAG_GPIO_P16_11_dir, "ff");
	      putvalue(DIAG_GPIO_P16_12_dir, "ff");
	      putvalue(DIAG_GPIO_P16_13_dir, "ff");
	      putvalue(DIAG_GPIO_P16_14_dir, "ff");
	      putvalue(DIAG_GPIO_P16_15_dir, "ff");
      
        putvalue(DIAG_GPIO_P42_0_dir, "ff");
	      putvalue(DIAG_GPIO_P42_1_dir, "ff");
	      putvalue(DIAG_GPIO_P42_2_dir, "PWM");
	      putvalue(DIAG_GPIO_P42_3_dir, "PWM");
	      putvalue(DIAG_GPIO_P42_4_dir, "PWM");
	      putvalue(DIAG_GPIO_P42_5_dir, "PWM");
	      putvalue(DIAG_GPIO_P42_6_dir, "PWM");
	      putvalue(DIAG_GPIO_P42_7_dir, "ff");
	
	      putvalue(DIAG_GPIO_P42_8_dir, "ff");
	      putvalue(DIAG_GPIO_P42_9_dir, "PWM");
	      putvalue(DIAG_GPIO_P42_10_dir, "PWM");
	      putvalue(DIAG_GPIO_P42_11_dir, "PWM");
	      putvalue(DIAG_GPIO_P42_12_dir, "PWM");
	      putvalue(DIAG_GPIO_P42_13_dir, "PWM");
	      putvalue(DIAG_GPIO_P42_14_dir, "PWM");
	      putvalue(DIAG_GPIO_P42_15_dir, "PWM");

    }
} 

on envVar HMI_All_TT_ON
{
 if(getValue(this))
 {
    switch(getValue(DIAG_CTRL_IC_Type_Selector))
    {
      case cKI_VS30_EL: 
      {
        putValue(Env_TurnInd_Lt_On, 1);
        putValue(Env_TurnInd_Rt_On, 1);
        putValue(HMI_HiBm_IndLmp_On_Rq, 1);
        putValue(HMI_LoBm_IndLmp_On_Rq, 1);
        putValue(HMI_PosnLmp_IndLmp_On_Rq, 1);
        putValue(HMI_FogLmp_Ft_IndLmp_On_Rq, 1);
        putValue(HMI_FogLmp_R_IndLmp_On_Rq, 1);
        putValue(HMI_MIL_On_Rq, 1);
        putValue(HMI_ABS_IndLmp_On_Rq, 1);
        putValue(HMI_ESP_CtrlLmp_Info, 1);
        putValue(HMI_BrkIndLmp_On_Rq_ESP, 1);
        putValue(HMI_BrkIndLmp_On_Rq_EPkB, 1);
        putValue(HMI_RBS_IndLmp_On_Rq, 1);
        putValue(HMI_ESP_Off_IndLmp_On_Rq, 1);
        putValue(HMI_SRS_IndLmp_Rq, 1);
        putValue(HMI_Bckl_Sw_D_Stat, 1);
        putValue(HMI_TankLvl_Min, 1);
        putValue(HMI_PkBrkIndLmp_On_Rq, 1);
        putValue(HMI_PN14_WarnIcon1_Disp_Rq, 1);
        putValue(HMI_TPM_IndLmp_On_Rq, 1);
        putValue(HMI_EPS_IndLmp_On_Rq, 1);
        putValue(HMI_FCW_IndLmp_On_Rq, 1);
        putValue(HMI_FCW_Stat, 0);
        putValue(HMI_PreHtIndLmp_On_Rq, 1);
        putValue(HMI_Retarder_Flt, 1);
        
        putValue(HMI_ECall_SOS_Rdy, 0);
        putValue(HMI_DrRLtch_FL_Stat, 2);
        putValue(HMI_IHC_Actv, 1);
        putValue(HMI_DrowDtctIndLmp_On_Rq, 0);
        putValue(HMI_AdblueEU6_RefillMsg_Disp_Rq, 1);
        putValue(HMI_AdBlue_TankChk_Warn2_Disp_Rq, 3);
        putValue(HMI_LDP_IndLmp_On_Rq_V2, 2);
        putValue(HMI_TCASE_GrLo_IndLmp_On_Rq, 1);
        putValue(Lane_Departure_white, 1);
        
      }
      break;
      case cKI_VS30_HL: 
      {
        putValue(Env_TurnInd_Lt_On, 1);
        putValue(Env_TurnInd_Rt_On, 1);
        putValue(HMI_HiBm_IndLmp_On_Rq, 1);
        putValue(HMI_LoBm_IndLmp_On_Rq, 1);
        putValue(HMI_PosnLmp_IndLmp_On_Rq, 1);
        putValue(HMI_FogLmp_Ft_IndLmp_On_Rq, 1);
        putValue(HMI_FogLmp_R_IndLmp_On_Rq, 1);
        putValue(HMI_MIL_On_Rq, 1);
        putValue(HMI_ABS_IndLmp_On_Rq, 1);
        putValue(HMI_ESP_CtrlLmp_Info, 1);
        putValue(HMI_BrkIndLmp_On_Rq_ESP, 1);
        putValue(HMI_BrkIndLmp_On_Rq_EPkB, 1);
        putValue(HMI_RBS_IndLmp_On_Rq, 1);
        putValue(HMI_ESP_Off_IndLmp_On_Rq, 1);
        putValue(HMI_SRS_IndLmp_Rq, 1);
        putValue(HMI_Bckl_Sw_D_Stat, 1);
        putValue(HMI_TankLvl_Min, 1);
        putValue(HMI_PkBrkIndLmp_On_Rq, 1);
        putValue(HMI_PN14_WarnIcon1_Disp_Rq, 1);
        putValue(HMI_TPM_IndLmp_On_Rq, 1);
        putValue(HMI_EPS_IndLmp_On_Rq, 1);
        putValue(HMI_FCW_IndLmp_On_Rq, 1);
        putValue(HMI_FCW_Stat, 1);
        putValue(HMI_PreHtIndLmp_On_Rq, 1);    
      }  
      break;
      default: break;
    } 
 }
 else
 {
    switch(getValue(DIAG_CTRL_IC_Type_Selector))
    {
      case cKI_VS30_EL: 
      {
        putValue(Env_TurnInd_Lt_On, 0);
        putValue(Env_TurnInd_Rt_On, 0);
        putValue(HMI_HiBm_IndLmp_On_Rq, 0);
        putValue(HMI_LoBm_IndLmp_On_Rq, 0);
        putValue(HMI_PosnLmp_IndLmp_On_Rq, 0);
        putValue(HMI_FogLmp_Ft_IndLmp_On_Rq, 0);
        putValue(HMI_FogLmp_R_IndLmp_On_Rq, 0);
        putValue(HMI_MIL_On_Rq, 0);
        putValue(HMI_ABS_IndLmp_On_Rq, 0);
        putValue(HMI_ESP_CtrlLmp_Info, 0);
        putValue(HMI_BrkIndLmp_On_Rq_ESP, 0);
        putValue(HMI_BrkIndLmp_On_Rq_EPkB, 0);
        putValue(HMI_RBS_IndLmp_On_Rq, 0);
        putValue(HMI_ESP_Off_IndLmp_On_Rq, 0);
        putValue(HMI_SRS_IndLmp_Rq, 0);
        putValue(HMI_Bckl_Sw_D_Stat, 0);
        putValue(HMI_TankLvl_Min, 0);
        putValue(HMI_PkBrkIndLmp_On_Rq, 0);
        putValue(HMI_PN14_WarnIcon1_Disp_Rq, 0);
        putValue(HMI_TPM_IndLmp_On_Rq, 0);
        putValue(HMI_EPS_IndLmp_On_Rq, 0);
        putValue(HMI_FCW_IndLmp_On_Rq, 0);
        putValue(HMI_FCW_Stat, 1);
        putValue(HMI_PreHtIndLmp_On_Rq, 0);
        putValue(HMI_Retarder_Flt, 0);
        
        putValue(HMI_ECall_SOS_Rdy, 1);
        putValue(HMI_DrRLtch_FL_Stat, 1);
        putValue(HMI_IHC_Actv, 0);
        putValue(HMI_DrowDtctIndLmp_On_Rq, 1);
        putValue(HMI_AdblueEU6_RefillMsg_Disp_Rq, 0);
        putValue(HMI_AdBlue_TankChk_Warn2_Disp_Rq, 0);
        putValue(HMI_LDP_IndLmp_On_Rq_V2, 1);
        putValue(HMI_TCASE_GrLo_IndLmp_On_Rq, 0);
        
        putValue(Lane_Departure_white, 0);
        
      }
      break;
      case cKI_VS30_HL: 
      {
        putValue(Env_TurnInd_Lt_On, 0);
        putValue(Env_TurnInd_Rt_On, 0);
        putValue(HMI_HiBm_IndLmp_On_Rq, 0);
        putValue(HMI_LoBm_IndLmp_On_Rq, 0);
        putValue(HMI_PosnLmp_IndLmp_On_Rq, 0);
        putValue(HMI_FogLmp_Ft_IndLmp_On_Rq, 0);
        putValue(HMI_FogLmp_R_IndLmp_On_Rq, 0);
        putValue(HMI_MIL_On_Rq, 0);
        putValue(HMI_ABS_IndLmp_On_Rq, 0);
        putValue(HMI_ESP_CtrlLmp_Info, 0);
        putValue(HMI_BrkIndLmp_On_Rq_ESP, 0);
        putValue(HMI_BrkIndLmp_On_Rq_EPkB, 0);
        putValue(HMI_RBS_IndLmp_On_Rq, 0);
        putValue(HMI_ESP_Off_IndLmp_On_Rq, 0);
        putValue(HMI_SRS_IndLmp_Rq, 0);
        putValue(HMI_Bckl_Sw_D_Stat, 0);
        putValue(HMI_TankLvl_Min, 0);
        putValue(HMI_PkBrkIndLmp_On_Rq, 0);
        putValue(HMI_PN14_WarnIcon1_Disp_Rq, 0);
        putValue(HMI_TPM_IndLmp_On_Rq, 0);
        putValue(HMI_EPS_IndLmp_On_Rq, 0);
        putValue(HMI_FCW_IndLmp_On_Rq, 0);
        putValue(HMI_FCW_Stat, 0);
        putValue(HMI_PreHtIndLmp_On_Rq, 0);
    
      }  
      break;
      default: break;
    }   
 }
}

on envVar DIAG_CTRL_SecLevel_Enter
{
    if( getValue( this ) )
    {
        DIAG_Queue_InsertCommand( cService_SecLevel );
        DIAG_CTRL_vStartNewService();
    }   
}

on envVar DIAG_CTRL_SendTP_Fkt
{
    if( getValue( this ) )
    {
        TesterPresentPhysFkt = cFUNCTIONAL;
        DiagnoseAktiv=1;
        putValue( DIAG_CTRL_Disp_DiagStateOnOff, cActiv );
        cancelTimer( tTesterPresentTimer );
        setTimer( tTesterPresentTimer, FirstTesterPresentTime );
        putValue( DIAG_Main_ErrorStatus, "Functional Tester Present aktiviert." );
    }
}

on envVar DIAG_CTRL_SendTP_Phys
{
    if( getValue( this ) )
    {
        TesterPresentPhysFkt = cPHYSICAL;
        DiagnoseAktiv=1;
        putValue( DIAG_CTRL_Disp_DiagStateOnOff, cActiv );
        cancelTimer( tTesterPresentTimer );
        setTimer( tTesterPresentTimer, FirstTesterPresentTime );
        putValue( DIAG_Main_ErrorStatus, "Physical Tester Present aktiviert." );
    }
}

on envVar DIAG_CTRL_SessionRequest
{
    if( getValue( this ) )
    {
        DIAG_Queue_InsertCommand( cService_SessionLevel );
        DIAG_CTRL_vStartNewService();
    }   
}

on envVar DIAG_CTRL_StopTP
{
    if( DiagnoseAktiv )
    {
        cancelTimer( tTesterPresentTimer );
        DiagnoseAktiv = cInactiv;
        putValue( DIAG_CTRL_Disp_DiagStateOnOff, cInactiv );
        putValue( DIAG_Main_ErrorStatus, "Cyclic Tester Present stopped" );
    }
}

on envVar DIAG_DIO_ReadAC_All_CycleTime
{
    if( getValue( this ) < cDIAG_DIO_AC_ReadCycleTime )
    {
        wReadDIO_AC_ChannelsTimer = cDIAG_DIO_AC_ReadCycleTime;
        putValue( DIAG_DIO_ReadAC_All_CycleTime, cDIAG_DIO_AC_ReadCycleTime );
    }
    else
        wReadDIO_AC_ChannelsTimer = getValue( this );
}

on envVar DIAG_DIO_ReadAC_All_Cyclic
{
    if( getValue( this ) )
    {
        if( getValue( DIAG_DIO_ReadAC_All_CycleTime ) < cDIAG_DIO_AC_ReadCycleTime )
        {
            wReadDIO_AC_ChannelsTimer = cDIAG_DIO_AC_ReadCycleTime;
            putValue( DIAG_DIO_ReadGC_All_CycleTime, cDIAG_DIO_AC_ReadCycleTime );
        }
        setTimer( tDIO_ReadAC_All_CyclicTimer, wReadDIO_AC_ChannelsTimer );
        DIAG_Queue_InsertCommand( cService_Routine_ReadAC_All );
        DIAG_CTRL_vStartNewService(); 
    }
    else
    {
        cancelTimer( tDIO_ReadAC_All_CyclicTimer );
        putValue( DIAG_DIO_StatusBar, "Stopped ..." );
    }
}

on envVar DIAG_DIO_ReadAC_All_Stop
{
    if( getValue( this ) )
    {
        cancelTimer( tDIO_ReadAC_All_CyclicTimer );
        cancelTimer( tDIO_AC_TimeOutTimer );
        putValue( DIAG_DIO_StatusBar, "Stopped ..." );
        DIAG_CTRL_vStartNewService();
    }
}

on envVar DIAG_DIO_ReadAC_All_Trigger
{
    if( getValue( this ) )
    {
        if( getValue( DIAG_DIO_ReadAC_All_Cyclic ) )
        {
            setTimer( tDIO_ReadAC_All_CyclicTimer, wReadDIO_AC_ChannelsTimer );
        }
        else
        {
            cancelTimer( tDIO_ReadAC_All_CyclicTimer );
        }
        DIAG_Queue_InsertCommand( cService_Routine_ReadAC_All );
        DIAG_CTRL_vStartNewService();
     }   
}

on envVar DIAG_DIO_ReadAC_P0_Trigger
{
    if( getValue( this ) )
    {
        DIAG_Queue_InsertCommand( cService_Routine_ReadAC_P0 );
        DIAG_CTRL_vStartNewService();
    }
}

on envVar DIAG_DIO_ReadAC_P1_Trigger
{
    if( getValue( this ) )
    {
        DIAG_Queue_InsertCommand( cService_Routine_ReadAC_P1 );
        DIAG_CTRL_vStartNewService();
    }
}

on envVar DIAG_DIO_ReadAC_P2_Trigger
{
    if( getValue( this ) )
    {
        DIAG_Queue_InsertCommand( cService_Routine_ReadAC_P2 );
        DIAG_CTRL_vStartNewService();
    }
}

on envVar DIAG_DIO_ReadAC_P3_Trigger
{
    if( getValue( this ) )
    {
        DIAG_Queue_InsertCommand( cService_Routine_ReadAC_P3 );
        DIAG_CTRL_vStartNewService();
    }
}

on envVar DIAG_DIO_ReadAC_P4_Trigger
{
    if( getValue( this ) )
    {
        DIAG_Queue_InsertCommand( cService_Routine_ReadAC_P4 );
        DIAG_CTRL_vStartNewService();
    }
}

on envVar DIAG_DIO_ReadAC_P16_Trigger
{
    if( getValue( this ) )
    {
        DIAG_Queue_InsertCommand( cService_Routine_ReadAC_P16 );
        DIAG_CTRL_vStartNewService();
    }
}

on envVar DIAG_DIO_ReadAC_P17_Trigger
{
    if( getValue( this ) )
    {
        DIAG_Queue_InsertCommand( cService_Routine_ReadAC_P17 );
        DIAG_CTRL_vStartNewService();
    }
}

on envVar DIAG_DIO_ReadCompareInput_Trigger
{
    if( getValue( this ) )
     {
          DiagAktion = 0;
          if( FillCommand( ServicePhys ) ) return;
          {
              rqBuf[0] = 0x23;
              rqBuf[1] = 0x14;
              rqBuf[2] = ( ( DIAG__cdwMRWStartAdr_AC_PBUS + DIAG__cdwMRWVCPC0_Reg ) & 0xFF000000 ) >> 24;
              rqBuf[3] = ( ( DIAG__cdwMRWStartAdr_AC_PBUS + DIAG__cdwMRWVCPC0_Reg ) & 0x00FF0000 ) >> 16;
              rqBuf[4] = ( ( DIAG__cdwMRWStartAdr_AC_PBUS + DIAG__cdwMRWVCPC0_Reg ) & 0x0000FF00 ) >> 8;
              rqBuf[5] = ( ( DIAG__cdwMRWStartAdr_AC_PBUS + DIAG__cdwMRWVCPC0_Reg ) & 0x000000FF );
              rqBuf[6] = 0x08;
              DIAG_SendRequest( SessionPhys, 7);
          }

//          if( SessionPhys )
          {
               DiagAktion = cService_Routine_ReadCompareInput;
                 putValue( DIAG_Main_ErrorStatus, "Warte auf Antwort..." );
               setTimer( TimeOutTimer, TimeOut );
          }
//          else
 //                putValue( DIAG_Main_ErrorStatus, "" );
     }   
}

on envVar DIAG_DIO_ReadGC_All_CycleTime
{
    if( getValue( this ) < cDIAG_DIO_GC_ReadCycleTime )
    {
        wReadDIO_GC_ChannelsTimer = cDIAG_DIO_GC_ReadCycleTime;
        putValue( DIAG_DIO_ReadGC_All_CycleTime, cDIAG_DIO_GC_ReadCycleTime );
    }
    else
        wReadDIO_GC_ChannelsTimer = getValue( this );
}

on envVar DIAG_DIO_ReadGC_All_Cyclic
{
    if( getValue( this ) )
    {
        if( getValue( DIAG_DIO_ReadGC_All_CycleTime ) < cDIAG_DIO_GC_ReadCycleTime )
        {
            wReadDIO_GC_ChannelsTimer = cDIAG_DIO_GC_ReadCycleTime;
            putValue( DIAG_DIO_ReadGC_All_CycleTime, cDIAG_DIO_GC_ReadCycleTime );
        }
        setTimer( tDIO_ReadGC_All_CyclicTimer, wReadDIO_GC_ChannelsTimer );
        DIAG_Queue_InsertCommand( cService_Routine_ReadGC_All );
        DIAG_CTRL_vStartNewService(); 
    }
    else
    {
        cancelTimer( tDIO_ReadGC_All_CyclicTimer );
        putValue( DIAG_DIO_StatusBar, "Stopped ..." );
    }
}

on envVar DIAG_DIO_ReadGC_All_Stop
{
    cancelTimer( tDIO_ReadGC_All_CyclicTimer );
    cancelTimer( tDIO_GC_TimeOutTimer );
    putValue( DIAG_DIO_StatusBar, "Stopped ..." );
    DIAG_CTRL_vStartNewService();
}

on envVar DIAG_DIO_ReadGC_All_Trigger
{
    if( getValue( this ) )
    {
        if( getValue( DIAG_DIO_ReadGC_All_Cyclic ) )
        {
            setTimer( tDIO_ReadGC_All_CyclicTimer, wReadDIO_GC_ChannelsTimer );
        }
        else
        {
            cancelTimer( tDIO_ReadGC_All_CyclicTimer );
        }
        DIAG_Queue_InsertCommand( cService_Routine_ReadGC_All );
        DIAG_CTRL_vStartNewService();
    }   
}

on envVar DIAG_DIO_ReadGC_P0_Trigger
{
    if( getValue( this ) )
    {
        DIAG_Queue_InsertCommand( cService_Routine_ReadGC_P0 );
        DIAG_CTRL_vStartNewService();
    }
}

on envVar DIAG_DIO_ReadGC_P1_Trigger
{
    if( getValue( this ) )
    {
        DIAG_Queue_InsertCommand( cService_Routine_ReadGC_P1 );
        DIAG_CTRL_vStartNewService();
    }
}

on envVar DIAG_DIO_ReadGC_P2_Trigger
{
    if( getValue( this ) )
    {
        DIAG_Queue_InsertCommand( cService_Routine_ReadGC_P2 );
        DIAG_CTRL_vStartNewService();
    }
}

on envVar DIAG_DIO_ReadGC_P3_Trigger
{
    if( getValue( this ) )
    {
        DIAG_Queue_InsertCommand( cService_Routine_ReadGC_P3 );
        DIAG_CTRL_vStartNewService();
    }
}

on envVar DIAG_DIO_ReadGC_P4_Trigger
{
    if( getValue( this ) )
    {
        DIAG_Queue_InsertCommand( cService_Routine_ReadGC_P4 );
        DIAG_CTRL_vStartNewService();
    }
}

on envVar DIAG_DIO_ReadGC_P5_Trigger
{
    if( getValue( this ) )
    {
        DIAG_Queue_InsertCommand( cService_Routine_ReadGC_P5 );
        DIAG_CTRL_vStartNewService();
    }
}

on envVar DIAG_DIO_ReadGC_P6_Trigger
{
    if( getValue( this ) )
    {
        DIAG_Queue_InsertCommand( cService_Routine_ReadGC_P6 );
        DIAG_CTRL_vStartNewService();
    }
}

on envVar DIAG_DIO_WriteAC_P0_Trigger
{
    if( getValue( this ) )
    {
        DIAG_Queue_InsertCommand( cService_Routine_ReadAC_P0 );
        DIAG_Queue_InsertCommand( cService_Routine_WriteAC_P0 );
        DIAG_CTRL_vStartNewService();
    }   
}

on envVar DIAG_DIO_WriteAC_P1_Trigger
{
    if( getValue( this ) )
    {
        DIAG_Queue_InsertCommand( cService_Routine_ReadAC_P1 );
        DIAG_Queue_InsertCommand( cService_Routine_WriteAC_P1 );
        DIAG_CTRL_vStartNewService();
    }   
}

on envVar DIAG_DIO_WriteAC_P2_Trigger
{
    if( getValue( this ) )
    {
        DIAG_Queue_InsertCommand( cService_Routine_ReadAC_P2 );
        DIAG_Queue_InsertCommand( cService_Routine_WriteAC_P2 );
        DIAG_CTRL_vStartNewService();
    }   
}

on envVar DIAG_DIO_WriteAC_P3_Trigger
{
    if( getValue( this ) )
    {
        DIAG_Queue_InsertCommand( cService_Routine_ReadAC_P3 );
        DIAG_Queue_InsertCommand( cService_Routine_WriteAC_P3 );
        DIAG_CTRL_vStartNewService();
    }   
}

on envVar DIAG_DIO_WriteAC_P4_Trigger
{
    if( getValue( this ) )
    {
        DIAG_Queue_InsertCommand( cService_Routine_ReadAC_P4 );
        DIAG_Queue_InsertCommand( cService_Routine_WriteAC_P4 );
        DIAG_CTRL_vStartNewService();
    }   
}

on envVar DIAG_DIO_WriteAC_P16_Trigger
{
    if( getValue( this ) )
    {
        DIAG_Queue_InsertCommand( cService_Routine_ReadAC_P16 );
        DIAG_Queue_InsertCommand( cService_Routine_WriteAC_P16 );
        DIAG_CTRL_vStartNewService();
    }
}

on envVar DIAG_DIO_WriteAC_P17_Trigger
{
    if( getValue( this ) )
    {
        DIAG_Queue_InsertCommand( cService_Routine_ReadAC_P17 );
        DIAG_Queue_InsertCommand( cService_Routine_WriteAC_P17 );
        DIAG_CTRL_vStartNewService();
    }
}

on envVar DIAG_DIO_WriteGC_P0_Trigger
{
    if( getValue( this ) )
    {
        DIAG_Queue_InsertCommand( cService_Routine_ReadGC_P0 );
        DIAG_Queue_InsertCommand( cService_Routine_WriteGC_P0 );
        DIAG_CTRL_vStartNewService();
    }   
}

on envVar DIAG_DIO_WriteGC_P1_Trigger
{
    if( getValue( this ) )
    {
        DIAG_Queue_InsertCommand( cService_Routine_ReadGC_P1 );
        DIAG_Queue_InsertCommand( cService_Routine_WriteGC_P1 );
        DIAG_CTRL_vStartNewService();
    }   
}

on envVar DIAG_DIO_WriteGC_P2_Trigger
{
    if( getValue( this ) )
    {
        DIAG_Queue_InsertCommand( cService_Routine_ReadGC_P2 );
        DIAG_Queue_InsertCommand( cService_Routine_WriteGC_P2 );
        DIAG_CTRL_vStartNewService();
    }   
}

on envVar DIAG_DIO_WriteGC_P3_Trigger
{
    if( getValue( this ) )
    {
        DIAG_Queue_InsertCommand( cService_Routine_ReadGC_P3 );
        DIAG_Queue_InsertCommand( cService_Routine_WriteGC_P3 );
        DIAG_CTRL_vStartNewService();
    }   
}

on envVar DIAG_DIO_WriteGC_P4_Trigger
{
    if( getValue( this ) )
    {
        DIAG_Queue_InsertCommand( cService_Routine_ReadGC_P4 );
        DIAG_Queue_InsertCommand( cService_Routine_WriteGC_P4 );
        DIAG_CTRL_vStartNewService();
    }   
}

on envVar DIAG_DIO_WriteGC_P5_Trigger
{
    if( getValue( this ) )
    {
        DIAG_Queue_InsertCommand( cService_Routine_ReadGC_P5 );
        DIAG_Queue_InsertCommand( cService_Routine_WriteGC_P5 );
        DIAG_CTRL_vStartNewService();
    }   
}

on envVar DIAG_DIO_WriteGC_P6_Trigger
{
    if( getValue( this ) )
    {
        DIAG_Queue_InsertCommand( cService_Routine_ReadGC_P6 );
        DIAG_Queue_InsertCommand( cService_Routine_WriteGC_P6 );
        DIAG_CTRL_vStartNewService();
    }   
}

on envVar DIAG_DSP_StartControl_Trigger
{
    if( getValue( this ) )
    {
        DIAG_Queue_InsertCommand( cService_SessionLevelCheck_Supplier );
        DIAG_Queue_InsertCommand( cService_SessionLevel_Supplier );
        DIAG_Queue_InsertCommand( cService_SecLevel_Supplier );
        DIAG_Queue_InsertCommand( cService_Routine_StartDisplayTest );
        DIAG_CTRL_vStartNewService();
    }   
}

on envVar DIAG_DSP_StopControl_Trigger
{
    if( getValue( this ) )
    {
        DIAG_Queue_InsertCommand( cService_Routine_StopDisplayTest );
        DIAG_CTRL_vStartNewService();
    }   
}

on envVar DIAG_DTC_ClearMirrorStorage
{
    if( getValue( this ) )
    {
        DIAG_Queue_InsertCommand( cService_SessionLevelCheck_Supplier );
        DIAG_Queue_InsertCommand( cService_SessionLevel_Supplier );
        DIAG_Queue_InsertCommand( cService_SecLevel_Supplier );
        DIAG_Queue_InsertCommand( cService_Routine_ClearDTC_MirrorMemory );
        DIAG_CTRL_vStartNewService();
    }
}

on envVar DIAG_DTC_ClearPrivateStorage
{
    if( getValue( this ) )
    {
        DIAG_Queue_InsertCommand( cService_SessionLevelCheck_Supplier );
        DIAG_Queue_InsertCommand( cService_SessionLevel_Supplier );
        DIAG_Queue_InsertCommand( cService_SecLevel_Supplier );
        DIAG_Queue_InsertCommand( cercvice_Routine_ClearPrivteDTC );
        DIAG_CTRL_vStartNewService();
    }
}

On EnvVar DIAG_DTC_ClearStorage
{
    if( getValue( this ) )
    {
        DIAG_Queue_InsertCommand( cService_Routine_ClearDTC );
        DIAG_Queue_InsertCommand( cService_Delay_Timer1000msec );
        DIAG_Queue_InsertCommand( cService_Routine_ReadDTC );
        DIAG_CTRL_vStartNewService();
    }
}

on envVar DIAG_DTC_OpenPrivateDTC
{
    if( getValue( this ) )
    {
        DIAG_Queue_InsertCommand( cService_SessionLevelCheck_Supplier );
        DIAG_Queue_InsertCommand( cService_SessionLevel_Supplier );
        DIAG_Queue_InsertCommand( cService_SecLevel_Supplier );
        DIAG_Queue_InsertCommand( cService_Routine_ReadActivePrivteDTCList );
        DIAG_CTRL_vStartNewService();

        openPanel( "Read_Private_Error_Storage" );
    }
}

On EnvVar DIAG_DTC_ReadCyclicActive
{
    if( getValue( this ) )
    {
        DIAG_Queue_InsertCommand( cService_Routine_ReadDTC );
        setTimer( tDTC_ReadCyclicTimer, 1000 );
        DIAG_CTRL_vStartNewService();
    }
    else
    {
        cancelTimer( tDTC_ReadCyclicTimer );
    }
}

On EnvVar DIAG_DTC_ReadErrorStorage
{
    if( getValue( this ) )
    {
        DIAG_Queue_InsertCommand( cService_Routine_ReadDTC );
        DIAG_CTRL_vStartNewService();
    }
}

on envVar DIAG_EMC_SessionActiv
{
    if( getValue( this ) )
    {
        setTimer( tEMCTimer, getValue( DIAG_CTRL_EMC_Cycle_Time ) );
//        write("tEMCTimer - on env: DIAG_CTRL_EMC_Cycle_Time : %d ", getValue( DIAG_CTRL_EMC_Cycle_Time ) );
        cancelTimer( tLoggingTimer );
        cancelTimer( tADC_GetRawChannelsCyclic );
        cancelTimer( tPWM_ReadAllValuesCycleTimer );
        cancelTimer( tMRW_ReadCyclic );
        putValue( DIAG_ADC_AllChLogActiv, 1 );
        putValue( DIAG_ADC_AllChActiv, 1 );
        putValue( DIAG_PWM_AllChActiv, 1 );
        putValue( DIAG_PWM_AllChLogActiv, 1 );
        putValue( DIAG_LOG_SessionActiv, 0 );
        ADC_InsertAllReadRawRequests();
        DIAG_CTRL_vStartNewService();
    }
}

on envVar DIAG_FEE_DisclaimerRead_Ackn
{
    if( getValue( this ) )
        EnableControl( "Reset FEE", "EnvVar:DIAG_FEE_ResetTrigger", 1 );
    else
        EnableControl( "Reset FEE", "EnvVar:DIAG_FEE_ResetTrigger", 0 );


}

on envVar DIAG_FEE_ResetTrigger
{
    if( getValue( this ) )
    {
        DIAG_Queue_InsertCommand( cService_Routine_FormatFEE );
        DIAG_CTRL_vStartNewService();
    }
}

on envVar DIAG_GPIO_Clear_all
{
    if( getValue( this ) )
    {
      putvalue(DIAG_GPIO_JP0_0, 0xff);
	    putvalue(DIAG_GPIO_JP0_1, 0xff);
	    putvalue(DIAG_GPIO_JP0_2, 0xff);
	    putvalue(DIAG_GPIO_JP0_3, 0xff);
	    putvalue(DIAG_GPIO_JP0_4, 0xff);
	    putvalue(DIAG_GPIO_JP0_5, 0xff);
	    putvalue(DIAG_GPIO_JP0_6, 0xff);
	    putvalue(DIAG_GPIO_JP0_7, 0xff);
	
	    putvalue(DIAG_GPIO_JP0_8, 0xff);
	    putvalue(DIAG_GPIO_JP0_9, 0xff);
	    putvalue(DIAG_GPIO_JP0_10, 0xff);
	    putvalue(DIAG_GPIO_JP0_11, 0xff);
	    putvalue(DIAG_GPIO_JP0_12, 0xff);
	    putvalue(DIAG_GPIO_JP0_13, 0xff);
	    putvalue(DIAG_GPIO_JP0_14, 0xff);
	    putvalue(DIAG_GPIO_JP0_15, 0xff);
  
      putvalue(DIAG_GPIO_JP0_0_dir, 0xff);
	    putvalue(DIAG_GPIO_JP0_1_dir, 0xff);
	    putvalue(DIAG_GPIO_JP0_2_dir, 0xff);
	    putvalue(DIAG_GPIO_JP0_3_dir, 0xff);
	    putvalue(DIAG_GPIO_JP0_4_dir, 0xff);
	    putvalue(DIAG_GPIO_JP0_5_dir, 0xff);
	    putvalue(DIAG_GPIO_JP0_6_dir, 0xff);
	    putvalue(DIAG_GPIO_JP0_7_dir, 0xff);
	
	    putvalue(DIAG_GPIO_JP0_8_dir, 0xff);
	    putvalue(DIAG_GPIO_JP0_9_dir, 0xff);
	    putvalue(DIAG_GPIO_JP0_10_dir, 0xff);
	    putvalue(DIAG_GPIO_JP0_11_dir, 0xff);
	    putvalue(DIAG_GPIO_JP0_12_dir, 0xff);
	    putvalue(DIAG_GPIO_JP0_13_dir, 0xff);
	    putvalue(DIAG_GPIO_JP0_14_dir, 0xff);
	    putvalue(DIAG_GPIO_JP0_15_dir, 0xff);
      
      putvalue(DIAG_GPIO_P0_0, 0xff);
	    putvalue(DIAG_GPIO_P0_1, 0xff);
	    putvalue(DIAG_GPIO_P0_2, 0xff);
	    putvalue(DIAG_GPIO_P0_3, 0xff);
	    putvalue(DIAG_GPIO_P0_4, 0xff);
	    putvalue(DIAG_GPIO_P0_5, 0xff);
	    putvalue(DIAG_GPIO_P0_6, 0xff);
	    putvalue(DIAG_GPIO_P0_7, 0xff);
	
	    putvalue(DIAG_GPIO_P0_8, 0xff);
	    putvalue(DIAG_GPIO_P0_9, 0xff);
	    putvalue(DIAG_GPIO_P0_10, 0xff);
	    putvalue(DIAG_GPIO_P0_11, 0xff);
	    putvalue(DIAG_GPIO_P0_12, 0xff);
	    putvalue(DIAG_GPIO_P0_13, 0xff);
	    putvalue(DIAG_GPIO_P0_14, 0xff);
	    putvalue(DIAG_GPIO_P0_15, 0xff);
  
		  putvalue(DIAG_GPIO_P0_0_dir, 0xff);
	    putvalue(DIAG_GPIO_P0_1_dir, 0xff);
	    putvalue(DIAG_GPIO_P0_2_dir, 0xff);
	    putvalue(DIAG_GPIO_P0_3_dir, 0xff);
	    putvalue(DIAG_GPIO_P0_4_dir, 0xff);
	    putvalue(DIAG_GPIO_P0_5_dir, 0xff);
	    putvalue(DIAG_GPIO_P0_6_dir, 0xff);
	    putvalue(DIAG_GPIO_P0_7_dir, 0xff);
	
	    putvalue(DIAG_GPIO_P0_8_dir, 0xff);
	    putvalue(DIAG_GPIO_P0_9_dir, 0xff);
	    putvalue(DIAG_GPIO_P0_10_dir, 0xff);
	    putvalue(DIAG_GPIO_P0_11_dir, 0xff);
	    putvalue(DIAG_GPIO_P0_12_dir, 0xff);
	    putvalue(DIAG_GPIO_P0_13_dir, 0xff);
	    putvalue(DIAG_GPIO_P0_14_dir, 0xff);
	    putvalue(DIAG_GPIO_P0_15_dir, 0xff);
      
      putvalue(DIAG_GPIO_P1_0, 0xff);
	    putvalue(DIAG_GPIO_P1_1, 0xff);
	    putvalue(DIAG_GPIO_P1_2, 0xff);
	    putvalue(DIAG_GPIO_P1_3, 0xff);
	    putvalue(DIAG_GPIO_P1_4, 0xff);
	    putvalue(DIAG_GPIO_P1_5, 0xff);
	    putvalue(DIAG_GPIO_P1_6, 0xff);
	    putvalue(DIAG_GPIO_P1_7, 0xff);
	
	    putvalue(DIAG_GPIO_P1_8, 0xff);
	    putvalue(DIAG_GPIO_P1_9, 0xff);
	    putvalue(DIAG_GPIO_P1_10, 0xff);
	    putvalue(DIAG_GPIO_P1_11, 0xff);
	    putvalue(DIAG_GPIO_P1_12, 0xff);
	    putvalue(DIAG_GPIO_P1_13, 0xff);
	    putvalue(DIAG_GPIO_P1_14, 0xff);
	    putvalue(DIAG_GPIO_P1_15, 0xff);
  
		  putvalue(DIAG_GPIO_P1_0_dir, 0xff);
	    putvalue(DIAG_GPIO_P1_1_dir, 0xff);
	    putvalue(DIAG_GPIO_P1_2_dir, 0xff);
	    putvalue(DIAG_GPIO_P1_3_dir, 0xff);
	    putvalue(DIAG_GPIO_P1_4_dir, 0xff);
	    putvalue(DIAG_GPIO_P1_5_dir, 0xff);
	    putvalue(DIAG_GPIO_P1_6_dir, 0xff);
	    putvalue(DIAG_GPIO_P1_7_dir, 0xff);
	
	    putvalue(DIAG_GPIO_P1_8_dir, 0xff);
	    putvalue(DIAG_GPIO_P1_9_dir, 0xff);
	    putvalue(DIAG_GPIO_P1_10_dir, 0xff);
	    putvalue(DIAG_GPIO_P1_11_dir, 0xff);
	    putvalue(DIAG_GPIO_P1_12_dir, 0xff);
	    putvalue(DIAG_GPIO_P1_13_dir, 0xff);
	    putvalue(DIAG_GPIO_P1_14_dir, 0xff);
	    putvalue(DIAG_GPIO_P1_15_dir, 0xff);
      
      putvalue(DIAG_GPIO_P2_0, 0xff);
	    putvalue(DIAG_GPIO_P2_1, 0xff);
	    putvalue(DIAG_GPIO_P2_2, 0xff);
	    putvalue(DIAG_GPIO_P2_3, 0xff);
	    putvalue(DIAG_GPIO_P2_4, 0xff);
	    putvalue(DIAG_GPIO_P2_5, 0xff);
	    putvalue(DIAG_GPIO_P2_6, 0xff);
	    putvalue(DIAG_GPIO_P2_7, 0xff);
	
	    putvalue(DIAG_GPIO_P2_8, 0xff);
	    putvalue(DIAG_GPIO_P2_9, 0xff);
	    putvalue(DIAG_GPIO_P2_10, 0xff);
	    putvalue(DIAG_GPIO_P2_11, 0xff);
	    putvalue(DIAG_GPIO_P2_12, 0xff);
	    putvalue(DIAG_GPIO_P2_13, 0xff);
	    putvalue(DIAG_GPIO_P2_14, 0xff);
	    putvalue(DIAG_GPIO_P2_15, 0xff);
  
		  putvalue(DIAG_GPIO_P2_0_dir, 0xff);
	    putvalue(DIAG_GPIO_P2_1_dir, 0xff);
	    putvalue(DIAG_GPIO_P2_2_dir, 0xff);
	    putvalue(DIAG_GPIO_P2_3_dir, 0xff);
	    putvalue(DIAG_GPIO_P2_4_dir, 0xff);
	    putvalue(DIAG_GPIO_P2_5_dir, 0xff);
	    putvalue(DIAG_GPIO_P2_6_dir, 0xff);
	    putvalue(DIAG_GPIO_P2_7_dir, 0xff);
	
	    putvalue(DIAG_GPIO_P2_8_dir, 0xff);
	    putvalue(DIAG_GPIO_P2_9_dir, 0xff);
	    putvalue(DIAG_GPIO_P2_10_dir, 0xff);
	    putvalue(DIAG_GPIO_P2_11_dir, 0xff);
	    putvalue(DIAG_GPIO_P2_12_dir, 0xff);
	    putvalue(DIAG_GPIO_P2_13_dir, 0xff);
	    putvalue(DIAG_GPIO_P2_14_dir, 0xff);
	    putvalue(DIAG_GPIO_P2_15_dir, 0xff);
      
      putvalue(DIAG_GPIO_P3_0, 0xff);
	    putvalue(DIAG_GPIO_P3_1, 0xff);
	    putvalue(DIAG_GPIO_P3_2, 0xff);
	    putvalue(DIAG_GPIO_P3_3, 0xff);
	    putvalue(DIAG_GPIO_P3_4, 0xff);
	    putvalue(DIAG_GPIO_P3_5, 0xff);
	    putvalue(DIAG_GPIO_P3_6, 0xff);
	    putvalue(DIAG_GPIO_P3_7, 0xff);
	
	    putvalue(DIAG_GPIO_P3_8, 0xff);
	    putvalue(DIAG_GPIO_P3_9, 0xff);
	    putvalue(DIAG_GPIO_P3_10, 0xff);
	    putvalue(DIAG_GPIO_P3_11, 0xff);
	    putvalue(DIAG_GPIO_P3_12, 0xff);
	    putvalue(DIAG_GPIO_P3_13, 0xff);
	    putvalue(DIAG_GPIO_P3_14, 0xff);
	    putvalue(DIAG_GPIO_P3_15, 0xff);
  
		  putvalue(DIAG_GPIO_P3_0_dir, 0xff);
	    putvalue(DIAG_GPIO_P3_1_dir, 0xff);
	    putvalue(DIAG_GPIO_P3_2_dir, 0xff);
	    putvalue(DIAG_GPIO_P3_3_dir, 0xff);
	    putvalue(DIAG_GPIO_P3_4_dir, 0xff);
	    putvalue(DIAG_GPIO_P3_5_dir, 0xff);
	    putvalue(DIAG_GPIO_P3_6_dir, 0xff);
	    putvalue(DIAG_GPIO_P3_7_dir, 0xff);
	
	    putvalue(DIAG_GPIO_P3_8_dir, 0xff);
	    putvalue(DIAG_GPIO_P3_9_dir, 0xff);
	    putvalue(DIAG_GPIO_P3_10_dir, 0xff);
	    putvalue(DIAG_GPIO_P3_11_dir, 0xff);
	    putvalue(DIAG_GPIO_P3_12_dir, 0xff);
	    putvalue(DIAG_GPIO_P3_13_dir, 0xff);
	    putvalue(DIAG_GPIO_P3_14_dir, 0xff);
	    putvalue(DIAG_GPIO_P3_15_dir, 0xff);
      
      if(getValue(DIAG_CTRL_IC_Type_Selector) == cKI_VS30_EL)
      {
        putvalue(DIAG_GPIO_P10_0, 0xff);
	      putvalue(DIAG_GPIO_P10_1, 0xff);
	      putvalue(DIAG_GPIO_P10_2, 0xff);
	      putvalue(DIAG_GPIO_P10_3, 0xff);
	      putvalue(DIAG_GPIO_P10_4, 0xff);
	      putvalue(DIAG_GPIO_P10_5, 0xff);
	      putvalue(DIAG_GPIO_P10_6, 0xff);
	      putvalue(DIAG_GPIO_P10_7, 0xff);
	
	      putvalue(DIAG_GPIO_P10_8, 0xff);
	      putvalue(DIAG_GPIO_P10_9, 0xff);
	      putvalue(DIAG_GPIO_P10_10, 0xff);
	      putvalue(DIAG_GPIO_P10_11, 0xff);
	      putvalue(DIAG_GPIO_P10_12, 0xff);
	      putvalue(DIAG_GPIO_P10_13, 0xff);
	      putvalue(DIAG_GPIO_P10_14, 0xff);
	      putvalue(DIAG_GPIO_P10_15, 0xff);

		    putvalue(DIAG_GPIO_P10_0_dir, "ADC");
	      putvalue(DIAG_GPIO_P10_1_dir, "ADC");
	      putvalue(DIAG_GPIO_P10_2_dir, "ADC");
	      putvalue(DIAG_GPIO_P10_3_dir, "ff");
	      putvalue(DIAG_GPIO_P10_4_dir, "ADC");
	      putvalue(DIAG_GPIO_P10_5_dir, "ADC");
	      putvalue(DIAG_GPIO_P10_6_dir, "ADC");
	      putvalue(DIAG_GPIO_P10_7_dir, "ADC");
	
	      putvalue(DIAG_GPIO_P10_8_dir, "ff");
	      putvalue(DIAG_GPIO_P10_9_dir, "ff");
	      putvalue(DIAG_GPIO_P10_10_dir, "ff");
	      putvalue(DIAG_GPIO_P10_11_dir, "ff");
	      putvalue(DIAG_GPIO_P10_12_dir, "ff");
	      putvalue(DIAG_GPIO_P10_13_dir, "ff");
	      putvalue(DIAG_GPIO_P10_14_dir, "ff");
	      putvalue(DIAG_GPIO_P10_15_dir, "ff");
      }
      else if(getValue(DIAG_CTRL_IC_Type_Selector) == cKI_VS30_HL)
      {
         putvalue(DIAG_GPIO_P10_0, 0xff);
	      putvalue(DIAG_GPIO_P10_1, 0xff);
	      putvalue(DIAG_GPIO_P10_2, 0xff);
	      putvalue(DIAG_GPIO_P10_3, 0xff);
	      putvalue(DIAG_GPIO_P10_4, 0xff);
	      putvalue(DIAG_GPIO_P10_5, 0xff);
	      putvalue(DIAG_GPIO_P10_6, 0xff);
	      putvalue(DIAG_GPIO_P10_7, 0xff);
	
	      putvalue(DIAG_GPIO_P10_8, 0xff);
	      putvalue(DIAG_GPIO_P10_9, 0xff);
	      putvalue(DIAG_GPIO_P10_10, 0xff);
	      putvalue(DIAG_GPIO_P10_11, 0xff);
	      putvalue(DIAG_GPIO_P10_12, 0xff);
	      putvalue(DIAG_GPIO_P10_13, 0xff);
	      putvalue(DIAG_GPIO_P10_14, 0xff);
	      putvalue(DIAG_GPIO_P10_15, 0xff);

		    putvalue(DIAG_GPIO_P10_0_dir, "ADC");
	      putvalue(DIAG_GPIO_P10_1_dir, "ADC");
	      putvalue(DIAG_GPIO_P10_2_dir, "ADC");
	      putvalue(DIAG_GPIO_P10_3_dir, "ADC");
	      putvalue(DIAG_GPIO_P10_4_dir, "ADC");
	      putvalue(DIAG_GPIO_P10_5_dir, "ADC");
	      putvalue(DIAG_GPIO_P10_6_dir, "ADC");
	      putvalue(DIAG_GPIO_P10_7_dir, "ADC");
	
	      putvalue(DIAG_GPIO_P10_8_dir, "ADC");
	      putvalue(DIAG_GPIO_P10_9_dir, "ADC");
	      putvalue(DIAG_GPIO_P10_10_dir, "ADC");
	      putvalue(DIAG_GPIO_P10_11_dir, "ADC");
	      putvalue(DIAG_GPIO_P10_12_dir, "ff");
	      putvalue(DIAG_GPIO_P10_13_dir, "ff");
	      putvalue(DIAG_GPIO_P10_14_dir, "ff");
	      putvalue(DIAG_GPIO_P10_15_dir, "ff");
      }
      
      putvalue(DIAG_GPIO_P11_0, 0xff);
	    putvalue(DIAG_GPIO_P11_1, 0xff);
	    putvalue(DIAG_GPIO_P11_2, 0xff);
	    putvalue(DIAG_GPIO_P11_3, 0xff);
	    putvalue(DIAG_GPIO_P11_4, 0xff);
	    putvalue(DIAG_GPIO_P11_5, 0xff);
	    putvalue(DIAG_GPIO_P11_6, 0xff);
	    putvalue(DIAG_GPIO_P11_7, 0xff);
	
	    putvalue(DIAG_GPIO_P11_8, 0xff);
	    putvalue(DIAG_GPIO_P11_9, 0xff);
	    putvalue(DIAG_GPIO_P11_10, 0xff);
	    putvalue(DIAG_GPIO_P11_11, 0xff);
	    putvalue(DIAG_GPIO_P11_12, 0xff);
	    putvalue(DIAG_GPIO_P11_13, 0xff);
	    putvalue(DIAG_GPIO_P11_14, 0xff);
	    putvalue(DIAG_GPIO_P11_15, 0xff);
  
		  putvalue(DIAG_GPIO_P11_0_dir, 0xff);
	    putvalue(DIAG_GPIO_P11_1_dir, 0xff);
	    putvalue(DIAG_GPIO_P11_2_dir, 0xff);
	    putvalue(DIAG_GPIO_P11_3_dir, 0xff);
	    putvalue(DIAG_GPIO_P11_4_dir, 0xff);
	    putvalue(DIAG_GPIO_P11_5_dir, 0xff);
	    putvalue(DIAG_GPIO_P11_6_dir, 0xff);
	    putvalue(DIAG_GPIO_P11_7_dir, 0xff);
	
	    putvalue(DIAG_GPIO_P11_8_dir, 0xff);
	    putvalue(DIAG_GPIO_P11_9_dir, 0xff);
	    putvalue(DIAG_GPIO_P11_10_dir, 0xff);
	    putvalue(DIAG_GPIO_P11_11_dir, 0xff);
	    putvalue(DIAG_GPIO_P11_12_dir, 0xff);
	    putvalue(DIAG_GPIO_P11_13_dir, 0xff);
	    putvalue(DIAG_GPIO_P11_14_dir, 0xff);
	    putvalue(DIAG_GPIO_P11_15_dir, 0xff);
      
      if(getValue(DIAG_CTRL_IC_Type_Selector) == cKI_VS30_EL)
      {
        
        putvalue(DIAG_GPIO_P16_0, 0xff);
	      putvalue(DIAG_GPIO_P16_1, 0xff);
	      putvalue(DIAG_GPIO_P16_2, 0xff);
	      putvalue(DIAG_GPIO_P16_3, 0xff);
	      putvalue(DIAG_GPIO_P16_4, 0xff);
	      putvalue(DIAG_GPIO_P16_5, 0xff);
	      putvalue(DIAG_GPIO_P16_6, 0xff);
	      putvalue(DIAG_GPIO_P16_7, 0xff);
	
	      putvalue(DIAG_GPIO_P16_8, 0xff);
	      putvalue(DIAG_GPIO_P16_9, 0xff);
	      putvalue(DIAG_GPIO_P16_10, 0xff);
	      putvalue(DIAG_GPIO_P16_11, 0xff);
	      putvalue(DIAG_GPIO_P16_12, 0xff);
	      putvalue(DIAG_GPIO_P16_13, 0xff);
	      putvalue(DIAG_GPIO_P16_14, 0xff);
	      putvalue(DIAG_GPIO_P16_15, 0xff);
       
        putvalue(DIAG_GPIO_P16_0_dir, "PWM");
	      putvalue(DIAG_GPIO_P16_1_dir, "PWM");
	      putvalue(DIAG_GPIO_P16_2_dir, "ff");
	      putvalue(DIAG_GPIO_P16_3_dir, "PWM");
	      putvalue(DIAG_GPIO_P16_4_dir, "PWM");
	      putvalue(DIAG_GPIO_P16_5_dir, "PWM");
	      putvalue(DIAG_GPIO_P16_6_dir, "PWM");
	      putvalue(DIAG_GPIO_P16_7_dir, "PWM");
	
	      putvalue(DIAG_GPIO_P16_8_dir, "ff");
	      putvalue(DIAG_GPIO_P16_9_dir, "ff");
	      putvalue(DIAG_GPIO_P16_10_dir, "ff");
	      putvalue(DIAG_GPIO_P16_11_dir, "ff");
	      putvalue(DIAG_GPIO_P16_12_dir, "ff");
	      putvalue(DIAG_GPIO_P16_13_dir, "ff");
	      putvalue(DIAG_GPIO_P16_14_dir, "ff");
	      putvalue(DIAG_GPIO_P16_15_dir, "ff");
      }
      else if(getValue(DIAG_CTRL_IC_Type_Selector) == cKI_VS30_HL)
      {
        putvalue(DIAG_GPIO_P16_0, 0xff);
	      putvalue(DIAG_GPIO_P16_1, 0xff);
	      putvalue(DIAG_GPIO_P16_2, 0xff);
	      putvalue(DIAG_GPIO_P16_3, 0xff);
	      putvalue(DIAG_GPIO_P16_4, 0xff);
	      putvalue(DIAG_GPIO_P16_5, 0xff);
	      putvalue(DIAG_GPIO_P16_6, 0xff);
	      putvalue(DIAG_GPIO_P16_7, 0xff);
	
	      putvalue(DIAG_GPIO_P16_8, 0xff);
	      putvalue(DIAG_GPIO_P16_9, 0xff);
	      putvalue(DIAG_GPIO_P16_10, 0xff);
	      putvalue(DIAG_GPIO_P16_11, 0xff);
	      putvalue(DIAG_GPIO_P16_12, 0xff);
	      putvalue(DIAG_GPIO_P16_13, 0xff);
	      putvalue(DIAG_GPIO_P16_14, 0xff);
	      putvalue(DIAG_GPIO_P16_15, 0xff);
        
  	    putvalue(DIAG_GPIO_P16_0_dir, "ff");
	      putvalue(DIAG_GPIO_P16_1_dir, "ff");
	      putvalue(DIAG_GPIO_P16_2_dir, "ff");
	      putvalue(DIAG_GPIO_P16_3_dir, "ff");
	      putvalue(DIAG_GPIO_P16_4_dir, "ff");
	      putvalue(DIAG_GPIO_P16_5_dir, "ff");
	      putvalue(DIAG_GPIO_P16_6_dir, "ff");
	      putvalue(DIAG_GPIO_P16_7_dir, "ff");
	
	      putvalue(DIAG_GPIO_P16_8_dir, "ff");
	      putvalue(DIAG_GPIO_P16_9_dir, "ff");
	      putvalue(DIAG_GPIO_P16_10_dir, "ff");
	      putvalue(DIAG_GPIO_P16_11_dir, "ff");
	      putvalue(DIAG_GPIO_P16_12_dir, "ff");
	      putvalue(DIAG_GPIO_P16_13_dir, "ff");
	      putvalue(DIAG_GPIO_P16_14_dir, "ff");
	      putvalue(DIAG_GPIO_P16_15_dir, "ff");
      }
      
      putvalue(DIAG_GPIO_P17_0, 0xff);
	    putvalue(DIAG_GPIO_P17_1, 0xff);
	    putvalue(DIAG_GPIO_P17_2, 0xff);
	    putvalue(DIAG_GPIO_P17_3, 0xff);
	    putvalue(DIAG_GPIO_P17_4, 0xff);
	    putvalue(DIAG_GPIO_P17_5, 0xff);
	    putvalue(DIAG_GPIO_P17_6, 0xff);
	    putvalue(DIAG_GPIO_P17_7, 0xff);
	
	    putvalue(DIAG_GPIO_P17_8, 0xff);
	    putvalue(DIAG_GPIO_P17_9, 0xff);
	    putvalue(DIAG_GPIO_P17_10, 0xff);
	    putvalue(DIAG_GPIO_P17_11, 0xff);
	    putvalue(DIAG_GPIO_P17_12, 0xff);
	    putvalue(DIAG_GPIO_P17_13, 0xff);
	    putvalue(DIAG_GPIO_P17_14, 0xff);
	    putvalue(DIAG_GPIO_P17_15, 0xff);
  
		  putvalue(DIAG_GPIO_P17_0_dir, 0xff);
	    putvalue(DIAG_GPIO_P17_1_dir, 0xff);
	    putvalue(DIAG_GPIO_P17_2_dir, 0xff);
	    putvalue(DIAG_GPIO_P17_3_dir, 0xff);
	    putvalue(DIAG_GPIO_P17_4_dir, 0xff);
	    putvalue(DIAG_GPIO_P17_5_dir, 0xff);
	    putvalue(DIAG_GPIO_P17_6_dir, 0xff);
	    putvalue(DIAG_GPIO_P17_7_dir, 0xff);
	
	    putvalue(DIAG_GPIO_P17_8_dir, 0xff);
	    putvalue(DIAG_GPIO_P17_9_dir, 0xff);
	    putvalue(DIAG_GPIO_P17_10_dir, 0xff);
	    putvalue(DIAG_GPIO_P17_11_dir, 0xff);
	    putvalue(DIAG_GPIO_P17_12_dir, 0xff);
	    putvalue(DIAG_GPIO_P17_13_dir, 0xff);
	    putvalue(DIAG_GPIO_P17_14_dir, 0xff);
	    putvalue(DIAG_GPIO_P17_15_dir, 0xff);
      
      putvalue(DIAG_GPIO_P21_0, 0xff);
	    putvalue(DIAG_GPIO_P21_1, 0xff);
	    putvalue(DIAG_GPIO_P21_2, 0xff);
	    putvalue(DIAG_GPIO_P21_3, 0xff);
	    putvalue(DIAG_GPIO_P21_4, 0xff);
	    putvalue(DIAG_GPIO_P21_5, 0xff);
	    putvalue(DIAG_GPIO_P21_6, 0xff);
	    putvalue(DIAG_GPIO_P21_7, 0xff);
	
	    putvalue(DIAG_GPIO_P21_8, 0xff);
	    putvalue(DIAG_GPIO_P21_9, 0xff);
	    putvalue(DIAG_GPIO_P21_10, 0xff);
	    putvalue(DIAG_GPIO_P21_11, 0xff);
	    putvalue(DIAG_GPIO_P21_12, 0xff);
	    putvalue(DIAG_GPIO_P21_13, 0xff);
	    putvalue(DIAG_GPIO_P21_14, 0xff);
	    putvalue(DIAG_GPIO_P21_15, 0xff);
  
		  putvalue(DIAG_GPIO_P21_0_dir, 0xff);
	    putvalue(DIAG_GPIO_P21_1_dir, 0xff);
	    putvalue(DIAG_GPIO_P21_2_dir, 0xff);
	    putvalue(DIAG_GPIO_P21_3_dir, 0xff);
	    putvalue(DIAG_GPIO_P21_4_dir, 0xff);
	    putvalue(DIAG_GPIO_P21_5_dir, 0xff);
	    putvalue(DIAG_GPIO_P21_6_dir, 0xff);
	    putvalue(DIAG_GPIO_P21_7_dir, 0xff);
	
	    putvalue(DIAG_GPIO_P21_8_dir, 0xff);
	    putvalue(DIAG_GPIO_P21_9_dir, 0xff);
	    putvalue(DIAG_GPIO_P21_10_dir, 0xff);
	    putvalue(DIAG_GPIO_P21_11_dir, 0xff);
	    putvalue(DIAG_GPIO_P21_12_dir, 0xff);
	    putvalue(DIAG_GPIO_P21_13_dir, 0xff);
	    putvalue(DIAG_GPIO_P21_14_dir, 0xff);
	    putvalue(DIAG_GPIO_P21_15_dir, 0xff);
      
      putvalue(DIAG_GPIO_P40_0, 0xff);
	    putvalue(DIAG_GPIO_P40_1, 0xff);
	    putvalue(DIAG_GPIO_P40_2, 0xff);
	    putvalue(DIAG_GPIO_P40_3, 0xff);
	    putvalue(DIAG_GPIO_P40_4, 0xff);
	    putvalue(DIAG_GPIO_P40_5, 0xff);
	    putvalue(DIAG_GPIO_P40_6, 0xff);
	    putvalue(DIAG_GPIO_P40_7, 0xff);
	
	    putvalue(DIAG_GPIO_P40_8, 0xff);
	    putvalue(DIAG_GPIO_P40_9, 0xff);
	    putvalue(DIAG_GPIO_P40_10, 0xff);
	    putvalue(DIAG_GPIO_P40_11, 0xff);
	    putvalue(DIAG_GPIO_P40_12, 0xff);
	    putvalue(DIAG_GPIO_P40_13, 0xff);
	    putvalue(DIAG_GPIO_P40_14, 0xff);
	    putvalue(DIAG_GPIO_P40_15, 0xff);
  
		  putvalue(DIAG_GPIO_P40_0_dir, 0xff);
	    putvalue(DIAG_GPIO_P40_1_dir, 0xff);
	    putvalue(DIAG_GPIO_P40_2_dir, 0xff);
	    putvalue(DIAG_GPIO_P40_3_dir, 0xff);
	    putvalue(DIAG_GPIO_P40_4_dir, 0xff);
	    putvalue(DIAG_GPIO_P40_5_dir, 0xff);
	    putvalue(DIAG_GPIO_P40_6_dir, 0xff);
	    putvalue(DIAG_GPIO_P40_7_dir, 0xff);
	
	    putvalue(DIAG_GPIO_P40_8_dir, 0xff);
	    putvalue(DIAG_GPIO_P40_9_dir, 0xff);
	    putvalue(DIAG_GPIO_P40_10_dir, 0xff);
	    putvalue(DIAG_GPIO_P40_11_dir, 0xff);
	    putvalue(DIAG_GPIO_P40_12_dir, 0xff);
	    putvalue(DIAG_GPIO_P40_13_dir, 0xff);
	    putvalue(DIAG_GPIO_P40_14_dir, 0xff);
	    putvalue(DIAG_GPIO_P40_15_dir, 0xff);
      
      if(getValue(DIAG_CTRL_IC_Type_Selector) == cKI_VS30_EL)
      {
        putvalue(DIAG_GPIO_P42_0, 0xff);
	      putvalue(DIAG_GPIO_P42_1, 0xff);
	      putvalue(DIAG_GPIO_P42_2, 0xff);
	      putvalue(DIAG_GPIO_P42_3, 0xff);
	      putvalue(DIAG_GPIO_P42_4, 0xff);
	      putvalue(DIAG_GPIO_P42_5, 0xff);
	      putvalue(DIAG_GPIO_P42_6, 0xff);
	      putvalue(DIAG_GPIO_P42_7, 0xff);
	
	      putvalue(DIAG_GPIO_P42_8, 0xff);
	      putvalue(DIAG_GPIO_P42_9, 0xff);
	      putvalue(DIAG_GPIO_P42_10, 0xff);
	      putvalue(DIAG_GPIO_P42_11, 0xff);
	      putvalue(DIAG_GPIO_P42_12, 0xff);
	      putvalue(DIAG_GPIO_P42_13, 0xff);
	      putvalue(DIAG_GPIO_P42_14, 0xff);
	      putvalue(DIAG_GPIO_P42_15, 0xff);
     
		    putvalue(DIAG_GPIO_P42_0_dir, "ff");
	      putvalue(DIAG_GPIO_P42_1_dir, "ff");
	      putvalue(DIAG_GPIO_P42_2_dir, "ff");
	      putvalue(DIAG_GPIO_P42_3_dir, "ff");
	      putvalue(DIAG_GPIO_P42_4_dir, "ff");
	      putvalue(DIAG_GPIO_P42_5_dir, "ff");
	      putvalue(DIAG_GPIO_P42_6_dir, "ff");
	      putvalue(DIAG_GPIO_P42_7_dir, "ff");
	
	      putvalue(DIAG_GPIO_P42_8_dir, "ff");
	      putvalue(DIAG_GPIO_P42_9_dir, "ff");
	      putvalue(DIAG_GPIO_P42_10_dir, "ff");
	      putvalue(DIAG_GPIO_P42_11_dir, "ff");
	      putvalue(DIAG_GPIO_P42_12_dir, "ff");
	      putvalue(DIAG_GPIO_P42_13_dir, "ff");
	      putvalue(DIAG_GPIO_P42_14_dir, "ff");
	      putvalue(DIAG_GPIO_P42_15_dir, "ff");
      }
      else if(getValue(DIAG_CTRL_IC_Type_Selector) == cKI_VS30_HL)
      {
        putvalue(DIAG_GPIO_P42_0, 0xff);
	      putvalue(DIAG_GPIO_P42_1, 0xff);
	      putvalue(DIAG_GPIO_P42_2, 0xff);
	      putvalue(DIAG_GPIO_P42_3, 0xff);
	      putvalue(DIAG_GPIO_P42_4, 0xff);
	      putvalue(DIAG_GPIO_P42_5, 0xff);
	      putvalue(DIAG_GPIO_P42_6, 0xff);
	      putvalue(DIAG_GPIO_P42_7, 0xff);
	
	      putvalue(DIAG_GPIO_P42_8, 0xff);
	      putvalue(DIAG_GPIO_P42_9, 0xff);
	      putvalue(DIAG_GPIO_P42_10, 0xff);
	      putvalue(DIAG_GPIO_P42_11, 0xff);
	      putvalue(DIAG_GPIO_P42_12, 0xff);
	      putvalue(DIAG_GPIO_P42_13, 0xff);
	      putvalue(DIAG_GPIO_P42_14, 0xff);
	      putvalue(DIAG_GPIO_P42_15, 0xff);
        
		    putvalue(DIAG_GPIO_P42_0_dir, "ff");
	      putvalue(DIAG_GPIO_P42_1_dir, "ff");
	      putvalue(DIAG_GPIO_P42_2_dir, "PWM");
	      putvalue(DIAG_GPIO_P42_3_dir, "PWM");
	      putvalue(DIAG_GPIO_P42_4_dir, "PWM");
	      putvalue(DIAG_GPIO_P42_5_dir, "PWM");
	      putvalue(DIAG_GPIO_P42_6_dir, "PWM");
	      putvalue(DIAG_GPIO_P42_7_dir, "ff");
	
	      putvalue(DIAG_GPIO_P42_8_dir, "ff");
	      putvalue(DIAG_GPIO_P42_9_dir, "PWM");
	      putvalue(DIAG_GPIO_P42_10_dir, "PWM");
	      putvalue(DIAG_GPIO_P42_11_dir, "PWM");
	      putvalue(DIAG_GPIO_P42_12_dir, "PWM");
	      putvalue(DIAG_GPIO_P42_13_dir, "PWM");
	      putvalue(DIAG_GPIO_P42_14_dir, "PWM");
	      putvalue(DIAG_GPIO_P42_15_dir, "PWM");
      }
      
      putvalue(DIAG_GPIO_P43_0, 0xff);
	    putvalue(DIAG_GPIO_P43_1, 0xff);
	    putvalue(DIAG_GPIO_P43_2, 0xff);
	    putvalue(DIAG_GPIO_P43_3, 0xff);
	    putvalue(DIAG_GPIO_P43_4, 0xff);
	    putvalue(DIAG_GPIO_P43_5, 0xff);
	    putvalue(DIAG_GPIO_P43_6, 0xff);
	    putvalue(DIAG_GPIO_P43_7, 0xff);
	
	    putvalue(DIAG_GPIO_P43_8, 0xff);
	    putvalue(DIAG_GPIO_P43_9, 0xff);
	    putvalue(DIAG_GPIO_P43_10, 0xff);
	    putvalue(DIAG_GPIO_P43_11, 0xff);
	    putvalue(DIAG_GPIO_P43_12, 0xff);
	    putvalue(DIAG_GPIO_P43_13, 0xff);
	    putvalue(DIAG_GPIO_P43_14, 0xff);
	    putvalue(DIAG_GPIO_P43_15, 0xff);
  
		  putvalue(DIAG_GPIO_P43_0_dir, 0xff);
	    putvalue(DIAG_GPIO_P43_1_dir, 0xff);
	    putvalue(DIAG_GPIO_P43_2_dir, 0xff);
	    putvalue(DIAG_GPIO_P43_3_dir, 0xff);
	    putvalue(DIAG_GPIO_P43_4_dir, 0xff);
	    putvalue(DIAG_GPIO_P43_5_dir, 0xff);
	    putvalue(DIAG_GPIO_P43_6_dir, 0xff);
	    putvalue(DIAG_GPIO_P43_7_dir, 0xff);
	
	    putvalue(DIAG_GPIO_P43_8_dir, 0xff);
	    putvalue(DIAG_GPIO_P43_9_dir, 0xff);
	    putvalue(DIAG_GPIO_P43_10_dir, 0xff);
	    putvalue(DIAG_GPIO_P43_11_dir, 0xff);
	    putvalue(DIAG_GPIO_P43_12_dir, 0xff);
	    putvalue(DIAG_GPIO_P43_13_dir, 0xff);
	    putvalue(DIAG_GPIO_P43_14_dir, 0xff);
	    putvalue(DIAG_GPIO_P43_15_dir, 0xff);
      
      putvalue(DIAG_GPIO_P44_0, 0xff);
	    putvalue(DIAG_GPIO_P44_1, 0xff);
	    putvalue(DIAG_GPIO_P44_2, 0xff);
	    putvalue(DIAG_GPIO_P44_3, 0xff);
	    putvalue(DIAG_GPIO_P44_4, 0xff);
	    putvalue(DIAG_GPIO_P44_5, 0xff);
	    putvalue(DIAG_GPIO_P44_6, 0xff);
	    putvalue(DIAG_GPIO_P44_7, 0xff);
	
	    putvalue(DIAG_GPIO_P44_8, 0xff);
	    putvalue(DIAG_GPIO_P44_9, 0xff);
	    putvalue(DIAG_GPIO_P44_10, 0xff);
	    putvalue(DIAG_GPIO_P44_11, 0xff);
	    putvalue(DIAG_GPIO_P44_12, 0xff);
	    putvalue(DIAG_GPIO_P44_13, 0xff);
	    putvalue(DIAG_GPIO_P44_14, 0xff);
	    putvalue(DIAG_GPIO_P44_15, 0xff);
  
		  putvalue(DIAG_GPIO_P44_0_dir, 0xff);
	    putvalue(DIAG_GPIO_P44_1_dir, 0xff);
	    putvalue(DIAG_GPIO_P44_2_dir, 0xff);
	    putvalue(DIAG_GPIO_P44_3_dir, 0xff);
	    putvalue(DIAG_GPIO_P44_4_dir, 0xff);
	    putvalue(DIAG_GPIO_P44_5_dir, 0xff);
	    putvalue(DIAG_GPIO_P44_6_dir, 0xff);
	    putvalue(DIAG_GPIO_P44_7_dir, 0xff);
	
	    putvalue(DIAG_GPIO_P44_8_dir, 0xff);
	    putvalue(DIAG_GPIO_P44_9_dir, 0xff);
	    putvalue(DIAG_GPIO_P44_10_dir, 0xff);
	    putvalue(DIAG_GPIO_P44_11_dir, 0xff);
	    putvalue(DIAG_GPIO_P44_12_dir, 0xff);
	    putvalue(DIAG_GPIO_P44_13_dir, 0xff);
	    putvalue(DIAG_GPIO_P44_14_dir, 0xff);
	    putvalue(DIAG_GPIO_P44_15_dir, 0xff);
      
      putvalue(DIAG_GPIO_P45_0, 0xff);
	    putvalue(DIAG_GPIO_P45_1, 0xff);
	    putvalue(DIAG_GPIO_P45_2, 0xff);
	    putvalue(DIAG_GPIO_P45_3, 0xff);
	    putvalue(DIAG_GPIO_P45_4, 0xff);
	    putvalue(DIAG_GPIO_P45_5, 0xff);
	    putvalue(DIAG_GPIO_P45_6, 0xff);
	    putvalue(DIAG_GPIO_P45_7, 0xff);
	
	    putvalue(DIAG_GPIO_P45_8, 0xff);
	    putvalue(DIAG_GPIO_P45_9, 0xff);
	    putvalue(DIAG_GPIO_P45_10, 0xff);
	    putvalue(DIAG_GPIO_P45_11, 0xff);
	    putvalue(DIAG_GPIO_P45_12, 0xff);
	    putvalue(DIAG_GPIO_P45_13, 0xff);
	    putvalue(DIAG_GPIO_P45_14, 0xff);
	    putvalue(DIAG_GPIO_P45_15, 0xff);
  
		  putvalue(DIAG_GPIO_P45_0_dir, 0xff);
	    putvalue(DIAG_GPIO_P45_1_dir, 0xff);
	    putvalue(DIAG_GPIO_P45_2_dir, 0xff);
	    putvalue(DIAG_GPIO_P45_3_dir, 0xff);
	    putvalue(DIAG_GPIO_P45_4_dir, 0xff);
	    putvalue(DIAG_GPIO_P45_5_dir, 0xff);
	    putvalue(DIAG_GPIO_P45_6_dir, 0xff);
	    putvalue(DIAG_GPIO_P45_7_dir, 0xff);
	
	    putvalue(DIAG_GPIO_P45_8_dir, 0xff);
	    putvalue(DIAG_GPIO_P45_9_dir, 0xff);
	    putvalue(DIAG_GPIO_P45_10_dir, 0xff);
	    putvalue(DIAG_GPIO_P45_11_dir, 0xff);
	    putvalue(DIAG_GPIO_P45_12_dir, 0xff);
	    putvalue(DIAG_GPIO_P45_13_dir, 0xff);
	    putvalue(DIAG_GPIO_P45_14_dir, 0xff);
	    putvalue(DIAG_GPIO_P45_15_dir, 0xff);
    }  
}

on envVar DIAG_GPIO_CyclicRead_all
{
  if (getValue( this ))
  {
    putValue(DIAG_GPIO_Read_P0_Cyclic, 1);
    putValue(DIAG_GPIO_Read_P1_Cyclic, 1);
    putValue(DIAG_GPIO_Read_P2_Cyclic, 1);
    putValue(DIAG_GPIO_Read_P3_Cyclic, 1);
    putValue(DIAG_GPIO_Read_P10_Cyclic, 1);
    putValue(DIAG_GPIO_Read_P11_Cyclic, 1);
    putValue(DIAG_GPIO_Read_P16_Cyclic, 1);
    putValue(DIAG_GPIO_Read_P17_Cyclic, 1);
    putValue(DIAG_GPIO_Read_P21_Cyclic, 1);
    putValue(DIAG_GPIO_Read_P40_Cyclic, 1);
    putValue(DIAG_GPIO_Read_P42_Cyclic, 1);
    putValue(DIAG_GPIO_Read_P43_Cyclic, 1);
    putValue(DIAG_GPIO_Read_P44_Cyclic, 1);
    putValue(DIAG_GPIO_Read_P45_Cyclic, 1);
    putValue(DIAG_GPIO_Read_JP0_Cyclic, 1);
  }
  else
  {
    putValue(DIAG_GPIO_Read_P0_Cyclic, 0);
    putValue(DIAG_GPIO_Read_P1_Cyclic, 0);
    putValue(DIAG_GPIO_Read_P2_Cyclic, 0);
    putValue(DIAG_GPIO_Read_P3_Cyclic, 0);
    putValue(DIAG_GPIO_Read_P10_Cyclic, 0);
    putValue(DIAG_GPIO_Read_P11_Cyclic, 0);
    putValue(DIAG_GPIO_Read_P16_Cyclic, 0);
    putValue(DIAG_GPIO_Read_P17_Cyclic, 0);
    putValue(DIAG_GPIO_Read_P21_Cyclic, 0);
    putValue(DIAG_GPIO_Read_P40_Cyclic, 0);
    putValue(DIAG_GPIO_Read_P42_Cyclic, 0);
    putValue(DIAG_GPIO_Read_P43_Cyclic, 0);
    putValue(DIAG_GPIO_Read_P44_Cyclic, 0);
    putValue(DIAG_GPIO_Read_P45_Cyclic, 0);
    putValue(DIAG_GPIO_Read_JP0_Cyclic, 0);
  }
}

on envVar DIAG_GPIO_CyclicReadSwitch
{
    if( getValue( this ) )
    {
        setTimer( tGPIO_CyclicReadSwitch, 1000 );
    }
    else    
    {
        cancelTimer( tADC_GetRawChannelsCyclic );
    }
}

on envVar DIAG_GPIO_Read_P0
{
    if( getValue( this ) )
    {
        DIAG_Queue_InsertCommand( cService_ReadPhysicalPorts_P0 );
        DIAG_CTRL_vStartNewService();
    }
}

on envVar DIAG_GPIO_Read_P1
{
    if( getValue( this ) )
    {
        DIAG_Queue_InsertCommand( cService_ReadPhysicalPorts_P1 );
        DIAG_CTRL_vStartNewService();
    }
}

on envVar DIAG_GPIO_Read_P2
{
  if( getValue( this ) )	//HL only
	{
		if(getValue( DIAG_CTRL_IC_Type_Selector) == cKI_VS30_HL)
		{
			DIAG_Queue_InsertCommand( cService_ReadPhysicalPorts_P2 );
			DIAG_CTRL_vStartNewService();
		}
  }
	else
	{
		//do nothing
	}
}

on envVar DIAG_GPIO_Read_P3
{
    if( getValue( this ) )
    {
        DIAG_Queue_InsertCommand( cService_ReadPhysicalPorts_P3 );
        DIAG_CTRL_vStartNewService();
    }
}

on envVar DIAG_GPIO_Read_P10
{
    if( getValue( this ) )
    {
        if(getValue( DIAG_CTRL_IC_Type_Selector) == cKI_VS30_EL)
        {
          ADC_InsertAllReadRawRequestsGPIO();
          DIAG_Queue_InsertCommand( cService_ReadPhysicalPorts_P10 );
          DIAG_CTRL_vStartNewService();
        }
        else if (getValue( DIAG_CTRL_IC_Type_Selector) == cKI_VS30_HL)
        {
          ADC_InsertAllReadRawRequestsGPIO();
          DIAG_Queue_InsertCommand( cService_ReadPhysicalPorts_P10 );
          DIAG_CTRL_vStartNewService();
        }
    }
}

on envVar DIAG_GPIO_Read_P11
{
    if( getValue( this ) )
    {
        DIAG_Queue_InsertCommand( cService_ReadPhysicalPorts_P11 );
        DIAG_CTRL_vStartNewService();
    }
}

on envVar DIAG_GPIO_Read_P16
{
    if( getValue( this ) )
    {
      if(getValue( DIAG_CTRL_IC_Type_Selector) == cKI_VS30_EL)
      {
        PWM_InsertAllReadRequestsGPIO();
        DIAG_Queue_InsertCommand( cService_ReadPhysicalPorts_P16 );
        DIAG_CTRL_vStartNewService();
      }
      else if(getValue( DIAG_CTRL_IC_Type_Selector) == cKI_VS30_HL)
      {
        DIAG_Queue_InsertCommand( cService_ReadPhysicalPorts_P16 );
        DIAG_CTRL_vStartNewService();
      }
    }
}

on envVar DIAG_GPIO_Read_P17
{
    if( getValue( this ) )
    {
        DIAG_Queue_InsertCommand( cService_ReadPhysicalPorts_P17 );
        DIAG_CTRL_vStartNewService();
    }
}

on envVar DIAG_GPIO_Read_P21
{
    if( getValue( this ) )
    {
        DIAG_Queue_InsertCommand( cService_ReadPhysicalPorts_P21 );
        DIAG_CTRL_vStartNewService();
    }
}

on envVar DIAG_GPIO_Read_P40
{
  if( getValue( this ) )	//HL only
	{
		if(getValue( DIAG_CTRL_IC_Type_Selector) == cKI_VS30_HL)
		{
			DIAG_Queue_InsertCommand( cService_ReadPhysicalPorts_P40 );
			DIAG_CTRL_vStartNewService();
		}
  }
	else
	{
		//do nothing
	}
}

on envVar DIAG_GPIO_Read_P42
{
    if( getValue( this ) )
    {
      if(getValue( DIAG_CTRL_IC_Type_Selector) == cKI_VS30_EL)
		  {
        DIAG_Queue_InsertCommand( cService_ReadPhysicalPorts_P42 );
        DIAG_CTRL_vStartNewService();
      }
      else if(getValue( DIAG_CTRL_IC_Type_Selector) == cKI_VS30_HL)
      { 
        PWM_InsertAllReadRequestsGPIO();
        DIAG_Queue_InsertCommand( cService_ReadPhysicalPorts_P42 );
        DIAG_CTRL_vStartNewService();
      }
    }
}

on envVar DIAG_GPIO_Read_P43
{
    if( getValue( this ) )
    {
        DIAG_Queue_InsertCommand( cService_ReadPhysicalPorts_P43 );
        DIAG_CTRL_vStartNewService();
    }
}

on envVar DIAG_GPIO_Read_P44
{
    if( getValue( this ) )
    {
        DIAG_Queue_InsertCommand( cService_ReadPhysicalPorts_P44 );
        DIAG_CTRL_vStartNewService();
    }
}

on envVar DIAG_GPIO_Read_P45
{
    if( getValue( this ) )
    {
        DIAG_Queue_InsertCommand( cService_ReadPhysicalPorts_P45 );
        DIAG_CTRL_vStartNewService();
    }
}

on envVar DIAG_GPIO_Read_JP0
{
    if( getValue( this ) )
    {
        DIAG_Queue_InsertCommand( cService_ReadPhysicalPorts_JP0 );
        DIAG_CTRL_vStartNewService();
    }
}


on envVar DIAG_ID_BootLoader_Vers_Info_Get_Trigger
{
    if( getValue( this ) )
     {
        DIAG_Queue_InsertCommand( cService_SessionLevelCheck_Program );
        DIAG_Queue_InsertCommand( cService_SessionLevel_Program );
        DIAG_Queue_InsertCommand( cService_Delay_Timer0500msec );
        DIAG_Queue_InsertCommand( cService_Routine_BootLoader_Vers_BL_Info_Get );
        DIAG_Queue_InsertCommand( cService_Routine_Diag_Index_BL_Info_Get );
        DIAG_Queue_InsertCommand( cService_Routine_HW_Vers_BL_Info_Get );
        DIAG_Queue_InsertCommand( cService_Routine_SW_Vers_BL_Info_Get );
        DIAG_Queue_InsertCommand( cService_Routine_FingerPrint_Get );
        DIAG_Queue_InsertCommand( cService_Routine_HardResetPhys );
        DIAG_CTRL_vStartNewService();
     }   
}

on envVar DIAG_ID_Clear_All_Info_Trigger
{
    if( getValue( this ) )
    {
        ID_Clear_EnvVars();
    }   
}

on envVar DIAG_ID_Read_All_Info_Get_Trigger
{
    if( getValue( this ) )
     {
        DIAG_Queue_InsertCommand( cService_Routine_SW_Vers_Info_Get );
        DIAG_Queue_InsertCommand( cService_Routine_BootLoader_Vers_Info_Get );
        DIAG_Queue_InsertCommand( cService_Routine_ECU_ID_Info_Get );
        DIAG_Queue_InsertCommand( cService_Routine_Diag_Index_Info_Get );
        DIAG_Queue_InsertCommand( cService_Routine_HW_Vers_Info_Get );
        DIAG_Queue_InsertCommand( cService_Routine_AUTOsar_ID_Info_Get );
		DIAG_Queue_InsertCommand( cService_Routine_VehManufacturerSparePartNumber_Get );
        DIAG_Queue_InsertCommand( cService_SessionLevelCheck_Supplier );
        DIAG_Queue_InsertCommand( cService_SessionLevel_Supplier );
        DIAG_Queue_InsertCommand( cService_SecLevel_Supplier );
        DIAG_Queue_InsertCommand( cService_Routine_VDO_SAP_Nr_Info_Get );
        DIAG_Queue_InsertCommand( cService_Routine_VDO_Vers_Info_Get );
        DIAG_Queue_InsertCommand( cService_Routine_AC_SDF_SAP_Nr);
        if( getValue( DIAG_CTRL_IC_Type_Selector ) == 13 )
            DIAG_Queue_InsertCommand( cService_Routine_GC_EL_SDF_SAP_Nr);
 //       if( getValue( DIAG_CTRL_IC_Type_Selector ) == 77 )
 //           DIAG_Queue_InsertCommand( cService_Routine_GC_HL_SDF_SAP_Nr);   not supported by HL
        DIAG_CTRL_vStartNewService();
     }   
}

on envVar DIAG_LOG_OneShotLog
{
//        write("DIAG_LOG_SessionActiv - on env: this : %d ", getValue( this ) );
    if( getValue( this ) )
    {
        if(  getValue( DIAG_LOG_OneShotLogLinkedToIgnSwitch ) )
            DIAG_LOG_InsertCommandToQueue();
    }
    putValue( DIAG_LOG_OneShotLog,0 );
}

on envVar DIAG_LOG_SessionActiv
{
//        write("DIAG_LOG_SessionActiv - on env: this : %d ", getValue( this ) );
    if( getValue( this ) )
    {
        setTimer( tLoggingTimer, getValue( DIAG_CTRL_LOG_Cycle_Time ) );
//        write("DIAG_LOG_SessionActiv - on env: DIAG_CTRL_LOG_Cycle_Time : %d ", getValue( DIAG_CTRL_LOG_Cycle_Time ) );
        cancelTimer( tEMCTimer );
        cancelTimer( tADC_GetRawChannelsCyclic );
        cancelTimer( tPWM_ReadAllValuesCycleTimer );
        cancelTimer( tMRW_ReadCyclic );
        putValue( DIAG_ADC_AllChLogActiv, 1 );
        putValue( DIAG_ADC_AllChActiv, 1 );
        putValue( DIAG_PWM_AllChActiv, 1 );
        putValue( DIAG_PWM_AllChLogActiv, 1 );
        putValue( DIAG_EMC_SessionActiv, 0 );
        DIAG_LOG_InsertCommandToQueue();
    }
    else
    {
        cancelTimer( tLoggingTimer );
    }
}

on envVar DIAG_LOG_StartLog
{
    if( getValue( this ) )
    {
        DIAG_LOG_OpenLogFile();
    }
}

on envVar DIAG_LOG_StopLog
{
    if( getValue( this ) )
    {
        if(  DIAG__lLogFileFileHandle != 0 ) 
        {
            fileClose ( DIAG__lLogFileFileHandle );
            DIAG_LOG__vLogPutStatusText( "FILE CLOSED" );
            DIAG_LOG_vIncrementLifeCount(0);
            DIAG__lLogFileFileHandle = 0;
        }
    }
}

on envVar DIAG_LVDS_StartTrigger_Framecounter
{
    if( getValue( this ) )
    {
        DIAG_Queue_InsertCommand( cService_SessionLevelCheck_Supplier );
        DIAG_Queue_InsertCommand( cService_SessionLevel_Supplier );
        DIAG_Queue_InsertCommand( cService_SecLevel_Supplier );
        DIAG_Queue_InsertCommand( cService_Routine_LVDS_ReadFramecounter );
        DIAG_CTRL_vStartNewService();
    }   
}

on envVar DIAG_LVDS_StartTrigger_Pin_Sync
{
    if( getValue( this ) )
    {
        DIAG_Queue_InsertCommand( cService_SessionLevelCheck_Supplier );
        DIAG_Queue_InsertCommand( cService_SessionLevel_Supplier );
        DIAG_Queue_InsertCommand( cService_SecLevel_Supplier );
        DIAG_Queue_InsertCommand( cService_Routine_LVDS_ReadPin_Sync );
        DIAG_CTRL_vStartNewService();
    }   
}

on envVar DIAG_LVDS_StartTrigger_Read_Reg
{
    if( getValue( this ) )
    {
        DIAG_Queue_InsertCommand( cService_SessionLevelCheck_Supplier );
        DIAG_Queue_InsertCommand( cService_SessionLevel_Supplier );
        DIAG_Queue_InsertCommand( cService_SecLevel_Supplier );
        DIAG_Queue_InsertCommand( cService_Routine_LVDS_ReadRegister );
        DIAG_CTRL_vStartNewService();
    }   
}

on envVar DIAG_LVDS_StartTrigger_Switch_Display
{
    if( getValue( this ) )
    {
        DIAG_Queue_InsertCommand( cService_SessionLevelCheck_Supplier );
        DIAG_Queue_InsertCommand( cService_SessionLevel_Supplier );
        DIAG_Queue_InsertCommand( cService_SecLevel_Supplier );
        DIAG_Queue_InsertCommand( cService_Routine_LVDS_Switch_Disp );
        DIAG_CTRL_vStartNewService();
    }   
}

on envVar DIAG_LVDS_StartTrigger_Switch_Function
{
    if( getValue( this ) )
    {
        DIAG_Queue_InsertCommand( cService_SessionLevelCheck_Supplier );
        DIAG_Queue_InsertCommand( cService_SessionLevel_Supplier );
        DIAG_Queue_InsertCommand( cService_SecLevel_Supplier );
        DIAG_Queue_InsertCommand( cService_Routine_LVDS_Switch_Func );
        DIAG_CTRL_vStartNewService();
    }   
}

on envVar DIAG_LVDS_StartTrigger_Testpic_CRC
{
    if( getValue( this ) )
    {
        DIAG_Queue_InsertCommand( cService_SessionLevelCheck_Supplier );
        DIAG_Queue_InsertCommand( cService_SessionLevel_Supplier );
        DIAG_Queue_InsertCommand( cService_SecLevel_Supplier );
        DIAG_Queue_InsertCommand( cService_Routine_LVDS_ReadTestpic_CRC );
        DIAG_CTRL_vStartNewService();
    }   
}

on envVar DIAG_LVDS_StartTrigger_Write_Reg
{
    if( getValue( this ) )
    {
        DIAG_Queue_InsertCommand( cService_SessionLevelCheck_Supplier );
        DIAG_Queue_InsertCommand( cService_SessionLevel_Supplier );
        DIAG_Queue_InsertCommand( cService_SecLevel_Supplier );
        DIAG_Queue_InsertCommand( cService_Routine_LVDS_WriteRegister );
        DIAG_CTRL_vStartNewService();
    }   
}

on envVar DIAG_MRW_ActDataSet
{
    DIAG__bMRWActDataSet = getValue( this );
    MRW_vUpdateDataSet();
}

on envVar DIAG_MRW_Addr
{
    MRW_vCalcAbsoluteAddress();
}

on envVar DIAG_MRW_AddrOffsetSound
{
    dwVariSoundOffset = getValue( this );
}

on envVar DIAG_MRW_CyclicRead
{
    DIAG__iMRWCyclicReadShadow[ DIAG__bMRWActDataSet ] = getValue( this );
    MRW_vSetCyclic();
}

on envVar DIAG_MRW_CyclicReadInterv
{
    DIAG__iMRWCycReadIntervShadow[ DIAG__bMRWActDataSet ] = getValue( this );
}

on envVar DIAG_MRW_MemLocation
{
    MRW_vCalcAbsoluteAddress();
}

on envVar DIAG_MRW_Read
{
    if(  getValue( this ) == 0 )
    {
        DIAG_Queue_InsertCommand( cService_SessionLevelCheck_Supplier );
        DIAG_Queue_InsertCommand( cService_SessionLevel_Supplier );
        DIAG_Queue_InsertCommand( cService_SecLevel_Supplier );
        DIAG_Queue_InsertCommand( cService_Routine_MRW_Read );
        DIAG_CTRL_vStartNewService();
    }
}

on envVar DIAG_MRW_ReadEEPToFile
{
    if( getValue( this ) == 0 )
    {
        DIAG_Queue_InsertCommand( cService_SessionLevelCheck_Supplier );
        DIAG_Queue_InsertCommand( cService_SessionLevel_Supplier );
        DIAG_Queue_InsertCommand( cService_SecLevel_Supplier );
        DIAG_Queue_InsertCommand( cService_Routine_ReadEEP2File );
        DIAG_CTRL_vStartNewService();
    }
}

on envVar DIAG_MRW_Write
{
    if( getValue( this ) == 0 )
    {
        DIAG_Queue_InsertCommand( cService_SessionLevelCheck_Supplier );
        DIAG_Queue_InsertCommand( cService_SessionLevel_Supplier );
        DIAG_Queue_InsertCommand( cService_SecLevel_Supplier );
        DIAG_Queue_InsertCommand( cService_Routine_MRW_Write );
        DIAG_CTRL_vStartNewService();
    }
}

on envVar DIAG_MRW_WriteFileToEEP
{
    if( getValue( this ) == 0 )
    {
        DIAG_Queue_InsertCommand( cService_SessionLevelCheck_Supplier );
        DIAG_Queue_InsertCommand( cService_SessionLevel_Supplier );
        DIAG_Queue_InsertCommand( cService_SecLevel_Supplier );
        DIAG_Queue_InsertCommand( cService_Routine_WriteFile2EEP );
        DIAG_CTRL_vStartNewService();
    }
}

on envVar DIAG_PWM_AllChActiv
{
    if( getValue( this ) )
    {
        putValue( DIAG_PWM_Ch00Activ, 1 );
        putValue( DIAG_PWM_Ch01Activ, 1 );
        putValue( DIAG_PWM_Ch02Activ, 1 );
        putValue( DIAG_PWM_Ch03Activ, 1 );
        putValue( DIAG_PWM_Ch04Activ, 1 );
        putValue( DIAG_PWM_Ch05Activ, 1 );
        putValue( DIAG_PWM_Ch06Activ, 1 );
        putValue( DIAG_PWM_Ch07Activ, 1 );
        putValue( DIAG_PWM_Ch08Activ, 1 );
        putValue( DIAG_PWM_Ch09Activ, 1 );
        putValue( DIAG_PWM_Ch10Activ, 1 );
        putValue( DIAG_PWM_Ch11Activ, 1 );
        putValue( DIAG_PWM_Ch12Activ, 1 );
        putValue( DIAG_PWM_Ch13Activ, 1 );
    }
    else
    {
        putValue( DIAG_PWM_Ch00Activ, 0 );
        putValue( DIAG_PWM_Ch01Activ, 0 );
        putValue( DIAG_PWM_Ch02Activ, 0 );
        putValue( DIAG_PWM_Ch03Activ, 0 );
        putValue( DIAG_PWM_Ch04Activ, 0 );
        putValue( DIAG_PWM_Ch05Activ, 0 );
        putValue( DIAG_PWM_Ch06Activ, 0 );
        putValue( DIAG_PWM_Ch07Activ, 0 );
        putValue( DIAG_PWM_Ch08Activ, 0 );
        putValue( DIAG_PWM_Ch09Activ, 0 );
        putValue( DIAG_PWM_Ch10Activ, 0 );
        putValue( DIAG_PWM_Ch11Activ, 0 );
        putValue( DIAG_PWM_Ch12Activ, 0 );
        putValue( DIAG_PWM_Ch13Activ, 0 );
    }
}

on envVar DIAG_PWM_AllChLogActiv
{
    if( getValue( this ) )
    {
        putValue( DIAG_PWM_Ch00Log, 1 );
        putValue( DIAG_PWM_Ch01Log, 1 );
        putValue( DIAG_PWM_Ch02Log, 1 );
        putValue( DIAG_PWM_Ch03Log, 1 );
        putValue( DIAG_PWM_Ch04Log, 1 );
        putValue( DIAG_PWM_Ch05Log, 1 );
        putValue( DIAG_PWM_Ch06Log, 1 );
        putValue( DIAG_PWM_Ch07Log, 1 );
        putValue( DIAG_PWM_Ch08Log, 1 );
        putValue( DIAG_PWM_Ch09Log, 1 );
        putValue( DIAG_PWM_Ch10Log, 1 );
        putValue( DIAG_PWM_Ch11Log, 1 );
        putValue( DIAG_PWM_Ch12Log, 1 );
        putValue( DIAG_PWM_Ch13Log, 1 );
    }
    else
    {
        putValue( DIAG_PWM_Ch00Log, 0 );
        putValue( DIAG_PWM_Ch01Log, 0 );
        putValue( DIAG_PWM_Ch02Log, 0 );
        putValue( DIAG_PWM_Ch03Log, 0 );
        putValue( DIAG_PWM_Ch04Log, 0 );
        putValue( DIAG_PWM_Ch05Log, 0 );
        putValue( DIAG_PWM_Ch06Log, 0 );
        putValue( DIAG_PWM_Ch07Log, 0 );
        putValue( DIAG_PWM_Ch08Log, 0 );
        putValue( DIAG_PWM_Ch09Log, 0 );
        putValue( DIAG_PWM_Ch10Log, 0 );
        putValue( DIAG_PWM_Ch11Log, 0 );
        putValue( DIAG_PWM_Ch12Log, 0 );
        putValue( DIAG_PWM_Ch13Log, 0 );
    }
}

on envVar DIAG_PWM_Duty_Ch00_Trigger
{
    if( getValue( this ) )
    {
        DIAG_Queue_InsertCommand( cService_Routine_WritePWMDuty_Ch00 );
        DIAG_CTRL_vStartNewService();
    }
}

on envVar DIAG_PWM_Duty_Ch01_Trigger
{
    if( getValue( this ) )
    {
        DIAG_Queue_InsertCommand( cService_Routine_WritePWMDuty_Ch01 );
        DIAG_CTRL_vStartNewService();
    }
}

on envVar DIAG_PWM_Duty_Ch02_Trigger
{
    if( getValue( this ) )
    {
        DIAG_Queue_InsertCommand( cService_Routine_WritePWMDuty_Ch02 );
        DIAG_CTRL_vStartNewService();
    }
}

on envVar DIAG_PWM_Duty_Ch03_Trigger
{
    if( getValue( this ) )
    {
        DIAG_Queue_InsertCommand( cService_Routine_WritePWMDuty_Ch03 );
        DIAG_CTRL_vStartNewService();
    }
}

on envVar DIAG_PWM_Duty_Ch04_Trigger
{
    if( getValue( this ) )
    {
        DIAG_Queue_InsertCommand( cService_Routine_WritePWMDuty_Ch04 );
        DIAG_CTRL_vStartNewService();
    }
}

on envVar DIAG_PWM_Duty_Ch05_Trigger
{
    if( getValue( this ) )
    {
        DIAG_Queue_InsertCommand( cService_Routine_WritePWMDuty_Ch05 );
        DIAG_CTRL_vStartNewService();
    }
}

on envVar DIAG_PWM_Duty_Ch06_Trigger
{
    if( getValue( this ) )
    {
        DIAG_Queue_InsertCommand( cService_Routine_WritePWMDuty_Ch06 );
        DIAG_CTRL_vStartNewService();
    }
}

on envVar DIAG_PWM_Duty_Ch07_Trigger
{
    if( getValue( this ) )
    {
        DIAG_Queue_InsertCommand( cService_Routine_WritePWMDuty_Ch07 );
        DIAG_CTRL_vStartNewService();
    }
}

on envVar DIAG_PWM_Duty_Ch08_Trigger
{
    if( getValue( this ) )
    {
        DIAG_Queue_InsertCommand( cService_Routine_WritePWMDuty_Ch08 );
        DIAG_CTRL_vStartNewService();
    }
}

on envVar DIAG_PWM_Duty_Ch09_Trigger
{
    if( getValue( this ) )
    {
        DIAG_Queue_InsertCommand( cService_Routine_WritePWMDuty_Ch09 );
        DIAG_CTRL_vStartNewService();
    }
}

on envVar DIAG_PWM_Duty_Ch10_Trigger
{
    if( getValue( this ) )
    {
        DIAG_Queue_InsertCommand( cService_Routine_WritePWMDuty_Ch10 );
        DIAG_CTRL_vStartNewService();
    }
}

on envVar DIAG_PWM_Duty_Ch11_Trigger
{
    if( getValue( this ) )
    {
        DIAG_Queue_InsertCommand( cService_Routine_WritePWMDuty_Ch11 );
        DIAG_CTRL_vStartNewService();
    }
}

on envVar DIAG_PWM_Duty_Ch12_Trigger
{
    if( getValue( this ) )
    {
        DIAG_Queue_InsertCommand( cService_Routine_WritePWMDuty_Ch12 );
        DIAG_CTRL_vStartNewService();
    }
}

on envVar DIAG_PWM_Duty_Ch13_Trigger
{
    if( getValue( this ) )
    {
        DIAG_Queue_InsertCommand( cService_Routine_WritePWMDuty_Ch13 );
        DIAG_CTRL_vStartNewService();
    }
}

on envVar DIAG_PWM_Frequenz_Master1_Trigger
{
    if( getValue( this ) )
    {
        DIAG_Queue_InsertCommand( cService_Routine_WritePWMFreq );
        bSetFreqChannel_Buffer = 0x11;
        dwSetFreq_Buffer = getValue( DIAG_PWM_Ch00Freq );
        DIAG_CTRL_vStartNewService();
    }
}

on envVar DIAG_PWM_Frequenz_Master2_Trigger
{
    if( getValue( this ) )
    {
        DIAG_Queue_InsertCommand( cService_Routine_WritePWMFreq );
        bSetFreqChannel_Buffer = 0x27;
        dwSetFreq_Buffer = getValue( DIAG_PWM_Ch04Freq );
        DIAG_CTRL_vStartNewService();
    }
}

on envVar DIAG_PWM_Frequenz_Master3_Trigger
{
    if( getValue( this ) )
    {
        DIAG_Queue_InsertCommand( cService_Routine_WritePWMFreq );
        bSetFreqChannel_Buffer = 0x35;
        dwSetFreq_Buffer = getValue( DIAG_PWM_Ch06Freq );
        DIAG_CTRL_vStartNewService();
    }
}

on envVar DIAG_PWM_ReadCyclic
{
    if( getValue( this ) )
    {
        setTimer( tPWM_ReadAllValuesCycleTimer, getValue( DIAG_PWM_ReadCycleTime ) );
        PWM_InsertAllReadRequests();
        DIAG_CTRL_vStartNewService();
    }
    else
    {
        cancelTimer( tPWM_ReadAllValuesCycleTimer );
        DIAG_CTRL_vStartNewService();
    }
}

on envVar DIAG_PWM_ResetMaxValues
{
    if( getValue( this ) )
    {
        putValue( DIAG_PWM_Ch00DutyMax,     0 );         wPWMDutyMax[0] = 0;
        putValue( DIAG_PWM_Ch01DutyMax,     0 );         wPWMDutyMax[1] = 0;
        putValue( DIAG_PWM_Ch02DutyMax,     0 );         wPWMDutyMax[2] = 0;
        putValue( DIAG_PWM_Ch03DutyMax,     0 );         wPWMDutyMax[3] = 0;
        putValue( DIAG_PWM_Ch04DutyMax,     0 );         wPWMDutyMax[4] = 0;
        putValue( DIAG_PWM_Ch05DutyMax,     0 );         wPWMDutyMax[5] = 0;
        putValue( DIAG_PWM_Ch06DutyMax,     0 );         wPWMDutyMax[6] = 0;
        putValue( DIAG_PWM_Ch07DutyMax,     0 );         wPWMDutyMax[7] = 0;
        putValue( DIAG_PWM_Ch08DutyMax,     0 );         wPWMDutyMax[8] = 0;
        putValue( DIAG_PWM_Ch09DutyMax,     0 );         wPWMDutyMax[9] = 0;
        putValue( DIAG_PWM_Ch10DutyMax,     0 );         wPWMDutyMax[10] = 0;
        putValue( DIAG_PWM_Ch11DutyMax,     0 );         wPWMDutyMax[11] = 0;
        putValue( DIAG_PWM_Ch12DutyMax,     0 );         wPWMDutyMax[12] = 0;
        putValue( DIAG_PWM_Ch13DutyMax,     0 );         wPWMDutyMax[12] = 0;
    }
}

on envVar DIAG_PWM_ResetMinValues
{
    if( getValue( this ) )
    {
        putValue( DIAG_PWM_Ch00DutyMin,     0xffff );         wPWMDutyMin[0] = 0xffff;
        putValue( DIAG_PWM_Ch01DutyMin,     0xffff );         wPWMDutyMin[1] = 0xffff;
        putValue( DIAG_PWM_Ch02DutyMin,     0xffff );         wPWMDutyMin[2] = 0xffff;
        putValue( DIAG_PWM_Ch03DutyMin,     0xffff );         wPWMDutyMin[3] = 0xffff;
        putValue( DIAG_PWM_Ch04DutyMin,     0xffff );         wPWMDutyMin[4] = 0xffff;
        putValue( DIAG_PWM_Ch05DutyMin,     0xffff );         wPWMDutyMin[5] = 0xffff;
        putValue( DIAG_PWM_Ch06DutyMin,     0xffff );         wPWMDutyMin[6] = 0xffff;
        putValue( DIAG_PWM_Ch07DutyMin,     0xffff );         wPWMDutyMin[7] = 0xffff;
        putValue( DIAG_PWM_Ch08DutyMin,     0xffff );         wPWMDutyMin[8] = 0xffff;
        putValue( DIAG_PWM_Ch09DutyMin,     0xffff );         wPWMDutyMin[9] = 0xffff;
        putValue( DIAG_PWM_Ch10DutyMin,     0xffff );         wPWMDutyMin[10] = 0xffff;
        putValue( DIAG_PWM_Ch11DutyMin,     0xffff );         wPWMDutyMin[11] = 0xffff;
        putValue( DIAG_PWM_Ch12DutyMin,     0xffff );         wPWMDutyMin[12] = 0xffff;
        putValue( DIAG_PWM_Ch13DutyMin,     0xffff );         wPWMDutyMin[12] = 0xffff;
    }
}

on envVar DIAG_PWM_StartRead
{
    if( getValue( this ) )
    {
        if( getValue( DIAG_PWM_ReadCyclic ) )       // 730
            setTimer( tPWM_ReadAllValuesCycleTimer, getValue( DIAG_PWM_ReadCycleTime ) );
        PWM_InsertAllReadRequests();
        DIAG_CTRL_vStartNewService();
    }
}

on envVar DIAG_PWM_StopRead
{
    cancelTimer( tPWM_ReadAllValuesCycleTimer );
    cancelTimer( tPWM_TimeOutTimer );
    bQueueWaitForResponce = FALSE;
    putValue( DIAG_PWM_StatusBar, "Stopped ..." );
    DIAG_CTRL_vStartNewService();
}

on envVar DIAG_PWM_Stop_Control_Trigger
{
    if( getValue( this ) )
    {
        DIAG_Queue_InsertCommand( cService_Routine_StopPWMControl );
        DIAG_CTRL_vStartNewService();
    }
}

on envVar DIAG_SND_StartControl_Trigger
{
    if( getValue( this ) )
    {
        DIAG_Queue_InsertCommand( cService_SessionLevelCheck_Supplier );
        DIAG_Queue_InsertCommand( cService_SessionLevel_Supplier );
        DIAG_Queue_InsertCommand( cService_SecLevel_Supplier );
        DIAG_Queue_InsertCommand( cService_Routine_StartSoundTest );
        DIAG_CTRL_vStartNewService();
    }   
}

on envVar DIAG_SND_StopControl_Trigger
{
     if( getValue( this ) )
     {
         DIAG_Queue_InsertCommand( cService_Routine_StopSoundTest );
         DIAG_CTRL_vStartNewService();
     }   
}

on envVar DIAG_SND_StartQControl_Trigger
{
    if( getValue( this ) )
    {
        DIAG_Queue_InsertCommand( cService_SessionLevelCheck_Supplier );
        DIAG_Queue_InsertCommand( cService_SessionLevel_Supplier );
        DIAG_Queue_InsertCommand( cService_SecLevel_Supplier );
        DIAG_Queue_InsertCommand( cService_Routine_StartSoundQTest );
        DIAG_CTRL_vStartNewService();
    }   
}

on envVar DIAG_SND_StopQControl_Trigger
{
     if( getValue( this ) )
     {
         DIAG_Queue_InsertCommand( cService_Routine_StopSoundQTest );
         DIAG_CTRL_vStartNewService();
     }   
}

on envVar DIAG_SND_StartDMControl_Trigger
{
    if( getValue( this ) )
    {
        DIAG_Queue_InsertCommand( cService_SessionLevelCheck_Supplier );
        DIAG_Queue_InsertCommand( cService_SessionLevel_Supplier );
        DIAG_Queue_InsertCommand( cService_SecLevel_Supplier );
        DIAG_Queue_InsertCommand( cService_Routine_StartSoundDMode );
        DIAG_CTRL_vStartNewService();
    }   
}

on envVar DIAG_SND_StopDMControl_Trigger
{
     if( getValue( this ) )
     {
         DIAG_Queue_InsertCommand( cService_Routine_StopSoundDMode );
         DIAG_CTRL_vStartNewService();
     }   
}

on envVar DIAG_WEM_ResetWriteCounter
{
    if( getValue( this ) )
    {
        DIAG_Queue_InsertCommand( cService_SessionLevelCheck_Supplier );
        DIAG_Queue_InsertCommand( cService_SessionLevel_Supplier );
        DIAG_Queue_InsertCommand( cService_SecLevel_Supplier );
        DIAG_Queue_InsertCommand( cService_Routine_WemResetWriteCounter );
        DIAG_CTRL_vStartNewService();
    }
}

OSEKTL_DataInd( long rxCount )
{
    //Funktion nicht löschen, da von OSEK_TP.dll verlangt
    //int i = 0;

    EmpfangAnzahl = rxCount;
    putValue ( DIAG_Debug_11, EmpfangAnzahl);
    cancelTimer( TimeOutTimer);
    putValue( DHMI__GetBuffer, cleardata, 0);
    OSEKTL_GetRxData( rsBuf, rxCount );

    putValue( DIAG_Debug_10,DiagAktion );
//    putValue( DIAG_Debug_09,rsBuf[9]);
//    putValue( DIAG_Debug_08,rsBuf[8]);
    putValue( DIAG_Debug_07,rsBuf[7]);
    putValue( DIAG_Debug_06,rsBuf[6]);
    putValue( DIAG_Debug_05,rsBuf[5]);
    putValue( DIAG_Debug_04,rsBuf[4]);
    putValue( DIAG_Debug_03,rsBuf[3]);
    putValue( DIAG_Debug_02,rsBuf[2]);
    putValue( DIAG_Debug_01,rsBuf[1]);
    putValue( DIAG_Debug_00,rsBuf[0]);

    if( ( rsBuf[0] == 0x7E ) &&
        ( rsBuf[1] == 0x00 )    )
    {
        // TP ackn
    }
    else
    {
        DIAG_CTRL_vEvalResponce(rxCount );
    }
    if( FuncEmpfang == 1)
    {
        OSEKTL_SetRxId(TempECU);                                   //Receive ID rücksetzen s.S.18
    }
}

OSEKTL_ErrorInd ( int Error)
{
     //Funktion nicht löschen, da von OSEK_TP.dll verlangt
}

OSEKTL_FirstFrameIndication( long sourceAdr, long destAdr, long rxCount )
{
     //Funktion nicht löschen, da von OSEK_TP.dll verlangt
}

ADC_EvalRawValue( byte bChannel, byte bHigh, byte bLow )
{
    word temp;

    temp = bHigh * 256 + bLow;

    if( bChannel < 16 )
    {
        wADCRaw[bChannel] = temp;
        if( temp > wADCRawMax[bChannel] )
        {
            wADCRawMax[bChannel] = temp;
        }
        if( temp < wADCRawMin[bChannel] )
        {
            wADCRawMin[bChannel] = temp;
        }
    }
    if( bChannel == 16 )
    {
          putValue( DIAG_ADC_Ch00,        wADCRaw[0] );
          putValue( DIAG_ADC_Ch00Max,     wADCRawMax[0] );
          putValue( DIAG_ADC_Ch00Min,     wADCRawMin[0] );
          putValue( DIAG_ADC_Ch01,        wADCRaw[1] );
          putValue( DIAG_ADC_Ch01Max,     wADCRawMax[1] );
          putValue( DIAG_ADC_Ch01Min,     wADCRawMin[1] );
          putValue( DIAG_ADC_Ch02,        wADCRaw[2] );
          putValue( DIAG_ADC_Ch02Max,     wADCRawMax[2] );
          putValue( DIAG_ADC_Ch02Min,     wADCRawMin[2] );
          putValue( DIAG_ADC_Ch03,        wADCRaw[3] );
          putValue( DIAG_ADC_Ch03Max,     wADCRawMax[3] );
          putValue( DIAG_ADC_Ch03Min,     wADCRawMin[3] );
          putValue( DIAG_ADC_Ch04,        wADCRaw[4] );
          putValue( DIAG_ADC_Ch04Max,     wADCRawMax[4] );
          putValue( DIAG_ADC_Ch04Min,     wADCRawMin[4] );
          putValue( DIAG_ADC_Ch05,        wADCRaw[5] );
          putValue( DIAG_ADC_Ch05Max,     wADCRawMax[5] );
          putValue( DIAG_ADC_Ch05Min,     wADCRawMin[5] );
          putValue( DIAG_ADC_Ch06,        wADCRaw[6] );
          putValue( DIAG_ADC_Ch06Max,     wADCRawMax[6] );
          putValue( DIAG_ADC_Ch06Min,     wADCRawMin[6] );
          putValue( DIAG_ADC_Ch07,        wADCRaw[7] );
          putValue( DIAG_ADC_Ch07Max,     wADCRawMax[7] );
          putValue( DIAG_ADC_Ch07Min,     wADCRawMin[7] );
          putValue( DIAG_ADC_Ch08,        wADCRaw[8] );
          putValue( DIAG_ADC_Ch08Max,     wADCRawMax[8] );
          putValue( DIAG_ADC_Ch08Min,     wADCRawMin[8] );
          putValue( DIAG_ADC_Ch09,        wADCRaw[9] );
          putValue( DIAG_ADC_Ch09Max,     wADCRawMax[9] );
          putValue( DIAG_ADC_Ch09Min,     wADCRawMin[9] );
          putValue( DIAG_ADC_Ch10,        wADCRaw[10] );
          putValue( DIAG_ADC_Ch10Max,     wADCRawMax[10] );
          putValue( DIAG_ADC_Ch10Min,     wADCRawMin[10] );
          putValue( DIAG_ADC_Ch11,        wADCRaw[11] );
          putValue( DIAG_ADC_Ch11Max,     wADCRawMax[11] );
          putValue( DIAG_ADC_Ch11Min,     wADCRawMin[11] );
          putValue( DIAG_ADC_Ch12,        wADCRaw[12] );
          putValue( DIAG_ADC_Ch12Max,     wADCRawMax[12] );
          putValue( DIAG_ADC_Ch12Min,     wADCRawMin[12] );
          putValue( DIAG_ADC_Ch13,        wADCRaw[13] );
          putValue( DIAG_ADC_Ch13Max,     wADCRawMax[13] );
          putValue( DIAG_ADC_Ch13Min,     wADCRawMin[13] );
          putValue( DIAG_ADC_Ch14,        wADCRaw[14] );
          putValue( DIAG_ADC_Ch14Max,     wADCRawMax[14] );
          putValue( DIAG_ADC_Ch14Min,     wADCRawMin[14] );
          putValue( DIAG_ADC_Ch15,        wADCRaw[15] );
          putValue( DIAG_ADC_Ch15Max,     wADCRawMax[15] );
          putValue( DIAG_ADC_Ch15Min,     wADCRawMin[15] );
          putValue( DIAG_ADC_StatusBar, "Successful" );
          
          if(getValue( DIAG_CTRL_IC_Type_Selector) == cKI_VS30_EL)
          {
            putValue(DIAG_GPIO_P10_0, wADCRaw[0]); 
            putValue(DIAG_GPIO_P10_1, wADCRaw[1]);
            putValue(DIAG_GPIO_P10_2, wADCRaw[2]);
            putValue(DIAG_GPIO_P10_4, wADCRaw[3]);
            putValue(DIAG_GPIO_P10_5, wADCRaw[4]);
            putValue(DIAG_GPIO_P10_6, wADCRaw[5]);
            putValue(DIAG_GPIO_P10_7, wADCRaw[6]);
          }
          else if(getValue( DIAG_CTRL_IC_Type_Selector) == cKI_VS30_HL)
          {
            putValue(DIAG_GPIO_P10_0, wADCRaw[0]);
            putValue(DIAG_GPIO_P10_1, wADCRaw[1]);
            putValue(DIAG_GPIO_P10_2, wADCRaw[2]);
            putValue(DIAG_GPIO_P10_3, wADCRaw[3]);
            putValue(DIAG_GPIO_P10_4, wADCRaw[4]);
            putValue(DIAG_GPIO_P10_5, wADCRaw[5]);
            putValue(DIAG_GPIO_P10_6, wADCRaw[6]);
            putValue(DIAG_GPIO_P10_7, wADCRaw[7]);
            putValue(DIAG_GPIO_P10_8, wADCRaw[8]);
            putValue(DIAG_GPIO_P10_9, wADCRaw[9]);
            putValue(DIAG_GPIO_P10_10, wADCRaw[10]);
            putValue(DIAG_GPIO_P10_11, wADCRaw[11]);
         }
    }
}

ADC_EvalReadRawADC()
{
    if(( rsBuf[0] == 0x71 ) && 
       ( rsBuf[1] == 0x01 ) &&
       ( rsBuf[2] == 0xF0 ) &&
       ( rsBuf[3] == 0x06 )    )
     {
        ADC_EvalRawValue( bReadRawADC_CurrentChannel, rsBuf[5], rsBuf[6] );
        
        DiagAktion = 0;
        bQueueWaitForResponce = FALSE;
        cancelTimer( tADC_GetRaw_TimeOutTimer );
        DIAG_CTRL_vStartNewService();
    }
    else
        if( AntwortAuswertung( 1, rsBuf[0], rsBuf[2]) )
        {
            DiagAktion = 0;
            cancelTimer( tADC_GetRaw_TimeOutTimer );
            bQueueWaitForResponce = FALSE;
        }
    DIAG_CTRL_vStartNewService();

}

ADC_GetRawValue( byte bChannel )
{
    if( bChannel == 0xFF ) return;
    DiagAktion = 0;
    if( FillCommand( ServicePhys ) ) return;
    rqBuf[0] = 0x31;
    rqBuf[1] = 0x01;
    rqBuf[2] = 0xF0;
    rqBuf[3] = 0x06;
    rqBuf[4] = bChannel;
    bReadRawADC_CurrentChannel = bChannel;
    DIAG_SendRequest( SessionPhys, 5);

    DiagAktion = cService_Routine_ReadRawADC;
    bQueueWaitForResponce = TRUE;
    putValue( DIAG_ADC_StatusBar, "Warte auf Antwort..." );
    setTimer( tADC_GetRaw_TimeOutTimer, TimeOut );
}
ADC_InsertAllReadRawRequestsGPIO()
{
    byte bNextIndex;

    bNextIndex = 0xFE;  // NOP
    
    if(getValue( DIAG_CTRL_IC_Type_Selector) == cKI_VS30_EL) 
    {
        DIAG_Queue_InsertCommand( cService_Routine_ReadRawADC_Ch00 );
        DIAG_Queue_InsertCommand( cService_Routine_ReadRawADC_Ch01 );
        DIAG_Queue_InsertCommand( cService_Routine_ReadRawADC_Ch02 );
        DIAG_Queue_InsertCommand( cService_Routine_ReadRawADC_Ch03 );
        DIAG_Queue_InsertCommand( cService_Routine_ReadRawADC_Ch04 );
        DIAG_Queue_InsertCommand( cService_Routine_ReadRawADC_Ch05 );
        DIAG_Queue_InsertCommand( cService_Routine_ReadRawADC_Ch06 );
        DIAG_Queue_InsertCommand( cService_Routine_ReadRawADC_Ch07 );

        bNextIndex = 0x09;
    }
    else
    {
        DIAG_Queue_InsertCommand( cService_Routine_ReadRawADC_Ch00 );
        DIAG_Queue_InsertCommand( cService_Routine_ReadRawADC_Ch01 );
        DIAG_Queue_InsertCommand( cService_Routine_ReadRawADC_Ch02 );
        DIAG_Queue_InsertCommand( cService_Routine_ReadRawADC_Ch03 );
        DIAG_Queue_InsertCommand( cService_Routine_ReadRawADC_Ch04 );
        DIAG_Queue_InsertCommand( cService_Routine_ReadRawADC_Ch05 );
        DIAG_Queue_InsertCommand( cService_Routine_ReadRawADC_Ch06 );
        DIAG_Queue_InsertCommand( cService_Routine_ReadRawADC_Ch07 );
        DIAG_Queue_InsertCommand( cService_Routine_ReadRawADC_Ch08 );
        DIAG_Queue_InsertCommand( cService_Routine_ReadRawADC_Ch09 );
        DIAG_Queue_InsertCommand( cService_Routine_ReadRawADC_Ch10 );
        DIAG_Queue_InsertCommand( cService_Routine_ReadRawADC_Ch11 );

        bNextIndex = 0x09;
    }

    if( bNextIndex == 0x09 )  // not NOP    
    {
        DIAG_Queue_InsertCommand( cService_Routine_ReadRawADC_Eval ); // only if new data requested
    }
}

ADC_InsertAllReadRawRequests()
{
    byte bNextIndex;

    bNextIndex = 0xFE;  // NOP
    if( getValue( DIAG_ADC_Ch00Activ ) )
    {
        DIAG_Queue_InsertCommand( cService_Routine_ReadRawADC_Ch00 );        bNextIndex = 0x09;
    }
    if( getValue( DIAG_ADC_Ch01Activ ) )
    {
        DIAG_Queue_InsertCommand( cService_Routine_ReadRawADC_Ch01 );        bNextIndex = 0x09;
    }
    if( getValue( DIAG_ADC_Ch02Activ ) )
    {
        DIAG_Queue_InsertCommand( cService_Routine_ReadRawADC_Ch02 );        bNextIndex = 0x09;
    }
    if( getValue( DIAG_ADC_Ch03Activ ) )
    {
        DIAG_Queue_InsertCommand( cService_Routine_ReadRawADC_Ch03 );        bNextIndex = 0x09;
    }
    if( getValue( DIAG_ADC_Ch04Activ ) )
    {
        DIAG_Queue_InsertCommand( cService_Routine_ReadRawADC_Ch04 );        bNextIndex = 0x09;
    }
    if( getValue( DIAG_ADC_Ch05Activ ) )
    {
        DIAG_Queue_InsertCommand( cService_Routine_ReadRawADC_Ch05 );        bNextIndex = 0x09;
    }
    if( getValue( DIAG_ADC_Ch06Activ ) )    
    {
        DIAG_Queue_InsertCommand( cService_Routine_ReadRawADC_Ch06 );        bNextIndex = 0x09;
    }
    if( getValue( DIAG_ADC_Ch07Activ ) )
    {
        DIAG_Queue_InsertCommand( cService_Routine_ReadRawADC_Ch07 );        bNextIndex = 0x09;
    }
    if( getValue( DIAG_ADC_Ch08Activ ) )
    {
        DIAG_Queue_InsertCommand( cService_Routine_ReadRawADC_Ch08 );        bNextIndex = 0x09;
    }
    if( getValue( DIAG_ADC_Ch09Activ ) )
    {
        DIAG_Queue_InsertCommand( cService_Routine_ReadRawADC_Ch09 );        bNextIndex = 0x09;
    }
    if( getValue( DIAG_ADC_Ch10Activ ) )
    {
        DIAG_Queue_InsertCommand( cService_Routine_ReadRawADC_Ch10 );        bNextIndex = 0x09;
    }
    if( getValue( DIAG_ADC_Ch11Activ ) )
    {
        DIAG_Queue_InsertCommand( cService_Routine_ReadRawADC_Ch11 );        bNextIndex = 0x09;
    }
    if( getValue( DIAG_ADC_Ch12Activ ) )
    {
        DIAG_Queue_InsertCommand( cService_Routine_ReadRawADC_Ch12 );        bNextIndex = 0x09;
    }
    if( getValue( DIAG_ADC_Ch13Activ ) )
    {
        DIAG_Queue_InsertCommand( cService_Routine_ReadRawADC_Ch13 );        bNextIndex = 0x09;
    }
    if( getValue( DIAG_ADC_Ch14Activ ) )
    {
        DIAG_Queue_InsertCommand( cService_Routine_ReadRawADC_Ch14 );        bNextIndex = 0x09;
    }
    if( getValue( DIAG_ADC_Ch15Activ ) )
    {
        DIAG_Queue_InsertCommand( cService_Routine_ReadRawADC_Ch15 );        bNextIndex = 0x09; 
    }
    if( bNextIndex == 0x09 )  // not NOP    
    {
        DIAG_Queue_InsertCommand( cService_Routine_ReadRawADC_Eval ); // only if new data requested
    }
}

int AntwortAuswertung( byte Ok_NotOk, byte byte0, byte byte2 )
{
    if( byte0 == 0x7F )
    {
        switch( byte2 )
        {
            case 0x10: /* general reject */                                     putValue( DIAG_Main_ErrorStatus, "General reject" );                                     break;
            case 0x11: /* service not supported */                              putValue( DIAG_Main_ErrorStatus, "Service not supported" );                              break;
            case 0x12: /* invalid format */                                     putValue( DIAG_Main_ErrorStatus, "Sub function not supported / Invalid format" );        break;
            case 0x13:                                                          putValue( DIAG_Main_ErrorStatus, "Incorrect message length or invalid format" );         break;
            case 0x21: /* busy - repeat request */                              putValue( DIAG_Main_ErrorStatus, "Busy / repeat request" );                              break;
            case 0x22: /* conditions not correct */                             putValue( DIAG_Main_ErrorStatus, "Conditions not correct or request sequence error" );   break;
            case 0x23: /* routine not complete */                               putValue( DIAG_Main_ErrorStatus, "Routine not complete" );                               break;
            case 0x24:                                                          putValue( DIAG_Main_ErrorStatus, "Request sequence error" );                             break;
            case 0x31: /* request out of range */                               putValue( DIAG_Main_ErrorStatus, "Request out of range" );                               break;
            case 0x33: /* security access denied - security access requested */ putValue( DIAG_Main_ErrorStatus, "Security access denied" );                             break;
            case 0x35: /* invalid key */                                        putValue( DIAG_Main_ErrorStatus, "Invalid key" );                                        break;
            case 0x36: /* exceed number of attempts */                          putValue( DIAG_Main_ErrorStatus, "Exceed number attempts" );                             break;
            case 0x37: /* required time delay not expired */                    putValue( DIAG_Main_ErrorStatus, "Required time delay not expired" );                    break;
            case 0x70:                                                          putValue( DIAG_Main_ErrorStatus, "Upload / Download not accepted" );                     break;
            case 0x71:                                                          putValue( DIAG_Main_ErrorStatus, "Transfer data suspended" );                            break;
            case 0x72:                                                          putValue( DIAG_Main_ErrorStatus, "General programming failure" );                        break;
            case 0x73:                                                          putValue( DIAG_Main_ErrorStatus, "Wrong block sequence counter" );                       break;
            case 0x78: /* request correctly received - response pending */      putValue( DIAG_Main_ErrorStatus, "Request correctly received / Response pending" );      return(0); // Diagnose-Befehl fortsetzen
            case 0x7E:                                                          putValue( DIAG_Main_ErrorStatus, "Sub function not supported in active session" );       break;
            case 0x7F:                                                          putValue( DIAG_Main_ErrorStatus, "Service not supported in active session" );            break;
            case 0x80: /* not supported in active diagnostic mode */            putValue( DIAG_Main_ErrorStatus, "Service not supported in active diagnostic session" ); break;
            default:   /* Diagnoseantwort nicht definiert */                    putValue( DIAG_Main_ErrorStatus, "Response not defined" );                               break;
         }
         ClearGetBuffer();
    }
    else
    {
        if( Ok_NotOk == 0)        /* Antwort ist korrekt */
            putValue( DIAG_Main_ErrorStatus, "Response ok" );
        else                      /* Antwort ist nicht korrekt */
            putValue( DIAG_Main_ErrorStatus, "Undefined response" );
    }
    return( 1 );                          //DiagnoseBefehl beenden
}

CALClock_Start_Trigger_AC_MainOszi()
{
    DiagAktion = 0;
    if( FillCommand( ServicePhys ) ) return;
    {
        rqBuf[0] = 0x2E;
        rqBuf[1] = 0xFD;
        rqBuf[2] = 0x04;
        rqBuf[3] = 0x06;
        rqBuf[4] = 0x01;
        DIAG_SendRequest( SessionPhys, 5 );
    }
    DiagAktion = cService_Routine_Enable_AC_MainOszi;
    bQueueWaitForResponce = TRUE;
    putValue( DIAG_CAL_StatusBar, "Waiting for answer..." );
    setTimer( tCalibrate_ClockTimeOutTimer, TimeOut );
}

CALClock_Start_Trigger_AC_SubOszi()
{
    DiagAktion = 0;
    if( FillCommand( ServicePhys ) ) return;
    {
        rqBuf[0] = 0x2E;
        rqBuf[1] = 0xFD;
        rqBuf[2] = 0x04;
        rqBuf[3] = 0x08;
        rqBuf[4] = 0x01;
        DIAG_SendRequest( SessionPhys, 5 );
    }
    DiagAktion = cService_Routine_Enable_AC_SubOszi;
    bQueueWaitForResponce = TRUE;
    putValue( DIAG_CAL_StatusBar, "Waiting for answer..." );
    setTimer( tCalibrate_ClockTimeOutTimer, TimeOut );
}

CALClock_Start_Trigger_CalAC_MainOszi()
{
    bCalClock_Step = 4;
    write("CALClock_Start_Trigger_CalAC_MainOszi triggered" );
    DiagAktion = 0;
    if( FillCommand( ServicePhys ) ) return;
    {
        rqBuf[0] = 0x2E;
        rqBuf[1] = 0xFD;
        rqBuf[2] = 0x04;
        rqBuf[3] = 0x06;
        rqBuf[4] = 0x01;
        DIAG_SendRequest( SessionPhys, 5);
    }
    DiagAktion = cService_Routine_Calibrate_Clock;
    bCalClock_Step = 4;
    bQueueWaitForResponce = TRUE;
    putValue( DIAG_CAL_StatusBar, "Waiting for answer..." );
    setTimer( tCalibrate_ClockTimeOutTimer, TimeOut );
}

CALClock_Start_Trigger_GC_MainOszi()
{
    DiagAktion = 0;
    if( FillCommand( ServicePhys ) ) return;
    {
        rqBuf[0] = 0x2E;
        rqBuf[1] = 0xFD;
        rqBuf[2] = 0x05;
        rqBuf[3] = 0x06;
        rqBuf[4] = 0x01;
        DIAG_SendRequest( SessionPhys, 5 );
    }
    DiagAktion = cService_Routine_Enable_GC_MainOszi;
    bQueueWaitForResponce = TRUE;
    putValue( DIAG_CAL_StatusBar, "Waiting for answer..." );
    setTimer( tCalibrate_ClockTimeOutTimer, TimeOut );
}

CALClock_StoreCalibrationValue()
{
    dword adresse;
    byte bLength;
    word wCalVal;
    
    DiagAktion = 0;
    if( FillCommand( ServicePhys ) ) return;
    adresse = DIAG__cdwMRWStartAdr_AC_EEP_FEE + SDF_nAdrArea_QuartzCal;
    bLength = SDF_nAdrArea_QuartzCalLength;
    rqBuf[ 0 ] = 0x3D;
    rqBuf[ 1 ] = 0x14;
    rqBuf[ 2 ] = ( adresse & 0xFF000000 ) >> 24;
    rqBuf[ 3 ] = ( adresse & 0x00FF0000 ) >> 16;
    rqBuf[ 4 ] = ( adresse & 0x0000FF00 ) >> 8;
    rqBuf[ 5 ] = ( adresse & 0x000000FF );
    rqBuf[ 6 ] = SDF_nAdrArea_QuartzCalLength;
    if( dwFrequencyMainOsziAC > 4000000 )
    {
        wCalVal = dwFrequencyMainOsziAC - 4000000;
    }
    else
    {
        wCalVal = 4000000 - dwFrequencyMainOsziAC;
        wCalVal = 0x8000 + wCalVal;
    }
    rqBuf[ 7 ] = wCalVal & 0xff;
    rqBuf[ 8 ] = wCalVal >> 8;

    DIAG_SendRequest( SessionPhys, 9 );
    bCalClock_Step = 5;
    DiagAktion = cService_Routine_StoreMainCal;
    bQueueWaitForResponce = TRUE;
    putValue( DIAG_CAL_StatusBar, "Waiting for answer..." );
    setTimer( tCAL_ReadTimeOutTimer, TimeOut );
}

CALClock_vEvalCalResponce()
{
    word wTemp;
    float fValY1, fValY2, fVakY3;
    char acStatusText[100];

    putVAlue( DIAG_CALClock_ValuesStoredDone, 0 );
    switch( bCalClock_Step )
    {
        case 4: // answer values stored  
                write("CALClock_vEvalCalResponce reached, CalStep 4" );
                if(   ( rsBuf[0] == 0x6E ) &&
                      ( rsBuf[1] == 0xFD ) &&
                    ( ( rsBuf[2] == 0x04 ) || ( rsBuf[2] == 0x05 ) ) )
                {
                    bQueueWaitForResponce = FALSE;
                    DiagAktion = 0;
                    cancelTimer( tCalibrate_ClockTimeOutTimer );
                }
                else
                {
                    bQueueWaitForResponce = FALSE;
                    DiagAktion = 0;
                    cancelTimer( tCalibrate_ClockTimeOutTimer );
                }
                break;

        case 5: // answer values stored  
                write("CALClock_vEvalCalResponce reached, CalStep 5" );
                if( ( rsBuf[0] == 0x7D ) && 
                    ( rsBuf[1] == 0x14 ) &&
                    ( rsBuf[2] == 0x02 ) &&
                    ( rsBuf[3] == 0x00 ) &&
                    ( rsBuf[4] == 0x02 ) &&
                    ( rsBuf[5] == 0xDC ) &&
                    ( rsBuf[6] == 0x02 )    )
        	    {
                    putVAlue( DIAG_CALClock_ValuesStoredDone, 1 );
                    snprintf( acStatusText,100, "Values successfully stored" );
                    CALClock_vPutCommandText( acStatusText );
                    bCalClock_Step = 0;
                    bQueueWaitForResponce = FALSE;
                    DiagAktion = 0;
            	    cancelTimer( tCalibrate_ClockTimeOutTimer );
                }
                break;
    }
    DIAG_CTRL_vStartNewService();
}

CALClock_vEvalResponce()
{
    word wTemp;
    float fValY1, fValY2, fVakY3;
    char acStatusText[100];

    if( ( rsBuf[0] == 0x6E ) &&
        ( rsBuf[1] == 0xFD ) &&
        ( ( rsBuf[2] == 0x04 ) || ( rsBuf[2] == 0x05 ) ) )
    {
        snprintf( acStatusText,100, "Oszillator Output Enabled" );
    }
    bQueueWaitForResponce = FALSE;
    DiagAktion = 0;
    cancelTimer( tCalibrate_ClockTimeOutTimer );
    DIAG_CTRL_vStartNewService();
}

CALClock_vPutCommandText (char cText[])
{
     putValue( DIAG_CALClock_UserCommandLine,cText );
}

CALKL30_GetCalibrationValue()
{
    dword adresse;
    byte bLength;
    
    if( ( bCalKL30_Step > 1 ) &&
        ( bCalKL30_Step < 5 )    )
    {
        DiagAktion = 0;
        if( FillCommand( ServicePhys ) ) return;
        rqBuf[0] = 0x31;
        rqBuf[1] = 0x01;
        rqBuf[2] = 0xF0;
        rqBuf[3] = 0x06;
        if( getValue( DIAG_CTRL_IC_Type_Selector ) == cKI_W205 )
            rqBuf[4] = 0x05;    // KL30 ADC  // W205 
        else
            if( getValue( DIAG_CTRL_IC_Type_Selector ) == cKI_W222 )
                rqBuf[4] = 0x06;    // KL30 ADC  // W222
        DIAG_SendRequest( SessionPhys, 5 );
        DiagAktion = cService_Routine_Calibrate_KL30;
        bQueueWaitForResponce = TRUE;
        putValue( DIAG_CALKL30_UserCommandLine, "Waiting for answer..." );
        setTimer( tCalibrate_KL30TimeOutTimer, TimeOut );
    }
}

CALKL30_Start_Trigger()
{
    dword adresse;
    byte bLength;
    
    bCal[ 0 ] = 0;
    bCal[ 1 ] = 0;
    bCal[ 2 ] = 0;
    bCal[ 3 ] = 0;
    bCal[ 4 ] = 0;
    bCal[ 5 ] = 0;
    bCal[ 6 ] = 0;
    bCal[ 7 ] = 0;
    bCal[ 8 ] = 0;
    bReadCAL_CurrentPosition =1;
    EnableControl( "Calibrate KL30", "EnvVar:DIAG_CALKL30_StoreCal", 0 );
    putVAlue( DIAG_CALKL30_LowValue_OK, 0 );
    putVAlue( DIAG_CALKL30_MidValue_OK, 0 );
    putVAlue( DIAG_CALKL30_HighValue_OK, 0 );
    adresse = DIAG__cdwMRWStartAdr_AC_EEP_FEE + SDF_nAdrArea_KL30Cal;
    bLength = SDF_nAdrArea_KL30CalLength;
    DiagAktion = 0;
    if( FillCommand( ServicePhys ) ) return;
    {
        rqBuf[0] = 0x23;
        rqBuf[1] = 0x14;
        rqBuf[2] = ( adresse & 0xFF000000 ) >> 24;
        rqBuf[3] = ( adresse & 0x00FF0000 ) >> 16;
        rqBuf[4] = ( adresse & 0x0000FF00 ) >> 8;
        rqBuf[5] = ( adresse & 0x000000FF );
        rqBuf[6] = bLength;
        DIAG_SendRequest( SessionPhys, 7);
    }
    bCalKL30_Step = 1;
    DiagAktion = cService_Routine_Calibrate_KL30;
    bQueueWaitForResponce = TRUE;
    putValue( DIAG_CAL_StatusBar, "Waiting for answer..." );
    setTimer( tCalibrate_KL30TimeOutTimer, TimeOut );
}

CALKL30_StoreCalibrationValue()
{
    dword adresse;
    byte bLength;
    
    DiagAktion = 0;
    if( FillCommand( ServicePhys ) ) return;
    adresse = DIAG__cdwMRWStartAdr_AC_EEP_FEE + SDF_nAdrArea_KL30Cal;
    bLength = SDF_nAdrArea_KL30CalLength;
    rqBuf[ 0] = 0x3D;
    rqBuf[ 1] = 0x14;
    rqBuf[ 2] = ( adresse & 0xFF000000 ) >> 24;
    rqBuf[ 3] = ( adresse & 0x00FF0000 ) >> 16;
    rqBuf[ 4] = ( adresse & 0x0000FF00 ) >> 8;
    rqBuf[ 5] = ( adresse & 0x000000FF );
    rqBuf[ 6] = 6;
    rqBuf[ 7] = Kl30_x1 & 0xff;
    rqBuf[ 8] = Kl30_x1 >> 8;
    rqBuf[ 9] = Kl30_x2 & 0xff;
    rqBuf[10] = Kl30_x2 >> 8;
    rqBuf[11] = Kl30_x3 & 0xff;
    rqBuf[12] = Kl30_x3 >> 8;

    DIAG_SendRequest( SessionPhys, 13 );
    DiagAktion = cService_Routine_Calibrate_KL30;
    bQueueWaitForResponce = TRUE;
    putValue( DIAG_CAL_StatusBar, "Waiting for answer..." );
    setTimer( tCAL_ReadTimeOutTimer, TimeOut );
}

CALKL30_vEvalResponce()
{
    word wTemp;
    float fValY1, fValY2, fVakY3;
    char acStatusText[100];

    switch( bCalKL30_Step )
    {
        case 1: // Calibrate 8V-Punkt
                if( rsBuf[0] == 0x63 )
                {

                    Kl30_x1 = rsBuf[1] + rsBuf[2]  * 256;
                    Kl30_x2 = rsBuf[3] + rsBuf[4]  * 256;
                    Kl30_x3 = rsBuf[5] + rsBuf[6]  * 256;
                    Kl30_y1 = rsBuf[7] + rsBuf[8]  * 256;
                    Kl30_y2 = rsBuf[9] + rsBuf[10]  * 256;
                    Kl30_y3 = rsBuf[11] + rsBuf[12]  * 256;

                    putValue( DIAG_CALKL30_LowValue_ADC_y, ((float )( Kl30_y1 ) ) / 10);
                    putValue( DIAG_CALKL30_MidValue_ADC_y, ((float )( Kl30_y2 ) ) / 10);
                    putValue( DIAG_CALKL30_HighValue_ADC_y, ((float )( Kl30_y3 ) ) / 10);
                    if( ( Kl30_y1 > cwLowerLimit_Y ) &&
                        ( Kl30_y1 < cwUpperLimit_Y ) &&
                        ( Kl30_y2 > cwLowerLimit_Y ) &&
                        ( Kl30_y2 < cwUpperLimit_Y ) &&
                        ( Kl30_y3 > cwLowerLimit_Y ) &&
                        ( Kl30_y3 < cwUpperLimit_Y ) &&
                        ( Kl30_y1 < Kl30_y2        ) &&
                        ( Kl30_y2 < Kl30_y3        )    )
                    { // Y werte OK Kalibrierung ist möglich
                        // erste Anweisung ausgaeben, "Done"-button freigeben
                        putValue( DIAG_CALKL30_ValuesStoredDone, 0 );
                        putValue( DIAG_CALKL30_LowValue_OK, 0 );
                        putValue( DIAG_CALKL30_MidValue_OK, 0 );
                        putValue( DIAG_CALKL30_HighValue_OK, 0 );
                        putVAlue( DIAG_CALKL30_LowValue_ADC_x, 0 );
                        putVAlue( DIAG_CALKL30_MidValue_ADC_x, 0 );
                        putVAlue( DIAG_CALKL30_HighValue_ADC_x, 0 );
                        EnableControl( "Calibrate KL30", "EnvVar:DIAG_CALKL30_StoreCal", 0 );
                        EnableControl( "Calibrate KL30", "EnvVar:DIAG_CALKL30_CalStepDone", 1 );

                        snprintf( acStatusText,100, "SetPower supply to: %4.2f Volt", ((float )( Kl30_y1 ) ) / 10 );
                        CALKL30_vPutCommandText( acStatusText );
                        bCalKL30_Step = 2;
                        bQueueWaitForResponce = FALSE;
                        cancelTimer( tCalibrate_KL30TimeOutTimer );
                    }
                    else
                    {
                        putValue( DIAG_CALKL30_ValuesStoredDone, 0 );
                        putValue( DIAG_CALKL30_LowValue_OK, 0 );
                        putValue( DIAG_CALKL30_MidValue_OK, 0 );
                        putValue( DIAG_CALKL30_HighValue_OK, 0 );
                        putVAlue( DIAG_CALKL30_LowValue_ADC_x, 0 );
                        putVAlue( DIAG_CALKL30_MidValue_ADC_x, 0 );
                        putVAlue( DIAG_CALKL30_HighValue_ADC_x, 0 );
                        EnableControl( "Calibrate KL30", "EnvVar:DIAG_CALKL30_StoreCal", 0 );
                        EnableControl( "Calibrate KL30", "EnvVar:DIAG_CALKL30_CalStepDone", 0 );
                        snprintf( acStatusText,100, "Readout not OK -> Dataset corrupt" );
                        CALKL30_vPutCommandText( acStatusText );
                        // Warnung ausgeben
                        bQueueWaitForResponce = FALSE;
                        cancelTimer( tCalibrate_KL30TimeOutTimer );
                        // Session beenden
                    }
                }
                break;

        case 2: // Answer 8V, request Calibrate 21V-Punkt     
                if( ( rsBuf[0] == 0x71 ) && 
                    ( rsBuf[1] == 0x01 ) &&
                    ( rsBuf[2] == 0xF0 ) &&
                    ( rsBuf[3] == 0x06 )    )
                {
                    Kl30_x1 = rsBuf[4] * 256 + rsBuf[5];                   
                    putValue( DIAG_CALKL30_LowByte_y1, Kl30_x1 & 0xff );
                    putValue( DIAG_CALKL30_HighByte_y1, Kl30_x1 >> 8 );
                    putVAlue( DIAG_CALKL30_LowValue_ADC_x, ( (float )Kl30_x1 *27 / 1000 ) );
                    putVAlue( DIAG_CALKL30_LowValue_OK, 1 );
                    snprintf( acStatusText,100, "SetPower supply to: %4.2f Volt", ((float )( Kl30_y3 ) ) / 10 );
                    CALKL30_vPutCommandText( acStatusText );
                    bQueueWaitForResponce = FALSE;
                    bCalKL30_Step = 3;
                    cancelTimer( tCalibrate_KL30TimeOutTimer );
                }
                break;

        case 3: // Calibrate 13,5V-Punkt     
                if( ( rsBuf[0] == 0x71 ) && 
                    ( rsBuf[1] == 0x01 ) &&
                    ( rsBuf[2] == 0xF0 ) &&
                    ( rsBuf[3] == 0x06 )    )
                {
                    Kl30_x3 = rsBuf[4] * 256 + rsBuf[5];
                    putValue( DIAG_CALKL30_LowByte_y3, Kl30_x3 & 0xff );
                    putValue( DIAG_CALKL30_HighByte_y3, Kl30_x3 >> 8 );
                    putVAlue( DIAG_CALKL30_HighValue_ADC_x, ( (float )Kl30_x3 *27 / 1000 ) );
                    putVAlue( DIAG_CALKL30_HighValue_OK, 1 );
                    snprintf( acStatusText,100, "SetPower supply to: %4.2f Volt", ((float )( Kl30_y2 ) ) / 10 );
                    CALKL30_vPutCommandText( acStatusText );
                    bQueueWaitForResponce = FALSE;
                    bCalKL30_Step = 4;
                    cancelTimer( tCalibrate_KL30TimeOutTimer );
                }
                break;
        case 4: // Calibrate 13,5V-Punkt     
                if( ( rsBuf[0] == 0x71 ) && 
                    ( rsBuf[1] == 0x01 ) &&
                    ( rsBuf[2] == 0xF0 ) &&
                    ( rsBuf[3] == 0x06 )    )
                {
                    Kl30_x2 = rsBuf[4] * 256 + rsBuf[5];
                    putValue( DIAG_CALKL30_LowByte_y2, Kl30_x2 & 0xff );
                    putValue( DIAG_CALKL30_HighByte_y2, Kl30_x2 >> 8 );
                    putValue( DIAG_CALKL30_MidValue_ADC_x, ( (float )Kl30_x2 *27 / 1000 ) );
                    putValue( DIAG_CALKL30_MidValue_OK, 1 );
                     snprintf( acStatusText,100, "Store values with manualy EOL-Tool" );
                    if( getValue( DIAG_CTRL_IC_Type_Selector ) == cKI_W222 ) // W222
                    {
                        EnableControl( "Calibrate KL30", "EnvVar:DIAG_CALKL30_StoreCal", 1 );
                        snprintf( acStatusText,100, "Store values with ""Store""-Button" );
                    }
                    EnableControl( "Calibrate KL30", "EnvVar:DIAG_CALKL30_CalStepDone", 0 );
                    CALKL30_vPutCommandText( acStatusText );
                    bCalKL30_Step = 5;
                    bQueueWaitForResponce = FALSE;
                    cancelTimer( tCalibrate_KL30TimeOutTimer );
                }
                break;

        case 5: // answer values stored  
                if( ( rsBuf[0] == 0x7D ) && 
                    ( rsBuf[1] == 0x14 ) &&
                    ( rsBuf[2] == 0x02 ) &&
                    ( rsBuf[3] == 0x00 ) &&
                    ( rsBuf[4] == 0x03 ) &&
                    ( rsBuf[5] == 0x61 ) &&
                    ( rsBuf[6] == 0x06 )    )
                {
                    putVAlue( DIAG_CALKL30_ValuesStoredDone, 1 );
                    snprintf( acStatusText,100, "Values successfully stored" );
                    EnableControl( "Calibrate KL30", "EnvVar:DIAG_CALKL30_StoreCal", 0 );
                    CALKL30_vPutCommandText( acStatusText );
                    bCalKL30_Step = 0;
                    bQueueWaitForResponce = FALSE;
                    DiagAktion = 0;
                    cancelTimer( tCalibrate_KL30TimeOutTimer );
                }
                break;
    DIAG_CTRL_vStartNewService();
    }
}

CALKL30_vPutCommandText (char cText[])
{
    putValue( DIAG_CALKL30_UserCommandLine,cText );
}

CAL_EvalReceivedValue( byte position )
{
    dword dValue = 0;
    word wQuartzCal = 0;

    bCal[ position ] = 0;
    if( position < 7 ) // stored in CAL-Flash
    {
        dValue =              + rsBuf[1];
        dValue = dValue * 256 + rsBuf[2];
        dValue = dValue * 256 + rsBuf[3];
        dValue = dValue * 256 + rsBuf[4];
        if( dValue == SDF_nValidPattern )
        {
            bCal[ position ] = 1;   // OK
        }
        else
        {
            bCal[ position ] = 2;   // NOK
        }
        return;
    }
    if( position == 7 )  // stored in EEP/FEE
    {
        Kl30_x1 = rsBuf[2]  * 256 + rsBuf[1];
        Kl30_x2 = rsBuf[4]  * 256 + rsBuf[3];
        Kl30_x3 = rsBuf[6]  * 256 + rsBuf[5];
        Kl30_y1 = rsBuf[8]  * 256 + rsBuf[7];
        Kl30_y2 = rsBuf[10] * 256 + rsBuf[9];
        Kl30_y3 = rsBuf[12] * 256 + rsBuf[11];
        if( ( Kl30_x1 > cwLowerLimit_X ) &&
            ( Kl30_x1 < cwUpperLimit_X ) &&
            ( Kl30_x2 > cwLowerLimit_X ) &&
            ( Kl30_x2 < cwUpperLimit_X ) &&
            ( Kl30_x3 > cwLowerLimit_X ) &&
            ( Kl30_x3 < cwUpperLimit_X ) &&
            ( Kl30_y1 > cwLowerLimit_Y ) &&
            ( Kl30_y1 < cwUpperLimit_Y ) &&
            ( Kl30_y2 > cwLowerLimit_Y ) &&
            ( Kl30_y2 < cwUpperLimit_Y ) &&
            ( Kl30_y3 > cwLowerLimit_Y ) &&
            ( Kl30_y3 < cwUpperLimit_Y ) &&
            ( Kl30_x1 < Kl30_x2        ) &&
            ( Kl30_x2 < Kl30_x3        ) &&
            ( Kl30_y1 < Kl30_y2        ) &&
            ( Kl30_y2 < Kl30_y3        )    )
        {
            bCal[ position ] = 1;   // OK
        }
        else
        {
            bCal[ position ] = 2;   // NOK
        }
    }
    if( position == 8 )  // stored in EEP/FEE
    {
        wQuartzCal = rsBuf[1] + ( rsBuf[2] * 256 );
        if( ( ( wQuartzCal > 0x8200 ) && ( wQuartzCal <= 0xFFFF ) ) ||
            ( ( wQuartzCal > 0x0200 ) && ( wQuartzCal <= 0x7FFF ) )    )
        {
            bCal[ position ] = 2;   // NOK
        }
        else
        {
            bCal[ position ] = 1;   // OK
        }
        putValue( DIAG_CAL_DDR3,        bCal[ 1 ] );
        putValue( DIAG_CAL_VCOM,        bCal[ 2 ] );
        putValue( DIAG_CAL_Gamma,       bCal[ 3 ] );
        putValue( DIAG_CAL_White,       bCal[ 4 ] );
        putValue( DIAG_CAL_Dither,      bCal[ 5 ] );
        putValue( DIAG_CAL_SoundMaxVol, bCal[ 6 ] );
        putValue( DIAG_CAL_KL30_Val,    bCal[ 7 ] );
        putValue( DIAG_CAL_Quartz_Cor,  bCal[ 8 ] );
    }
}

CAL_ReadNext_Trigger( byte section )
{
    dword adresse;
    byte bLength;

    switch( section )
    {
       case 1:  bCal[ 0 ] = 0;
                bCal[ 1 ] = 0;
                bCal[ 2 ] = 0;
                bCal[ 3 ] = 0;
                bCal[ 4 ] = 0;
                bCal[ 5 ] = 0;
                bCal[ 6 ] = 0;
                bCal[ 7 ] = 0;
                bCal[ 8 ] = 0;
                adresse = DIAG__cdwMRWStartAdr_GC_IntFlash + SDF_nAdrDdr3RamCalibValidPattern;
                bLength = SDF_nAdrArea_ValidPatternLength;
                break;
       case 2:  adresse = DIAG__cdwMRWStartAdr_GC_IntFlash + SDF_nAdrVComCalibValidPattern;
                bLength = SDF_nAdrArea_ValidPatternLength;
                break;
       case 3:  adresse = DIAG__cdwMRWStartAdr_GC_IntFlash + SDF_nAdrGammaCalibValidPattern;
                bLength = SDF_nAdrArea_ValidPatternLength;
                break;
       case 4:  adresse = DIAG__cdwMRWStartAdr_GC_IntFlash + SDF_nAdrWhiteBalanceValidPattern;
                bLength = SDF_nAdrArea_ValidPatternLength;
                break;
       case 5:  adresse = DIAG__cdwMRWStartAdr_GC_IntFlash + SDF_nAdrMVOControlValidPattern;
                bLength = SDF_nAdrArea_ValidPatternLength;
                break;
       case 6:  adresse = DIAG__cdwMRWStartAdr_GC_IntFlash + SDF_nAdrArea_SoundVolumeCalib;
                bLength = SDF_nAdrArea_ValidPatternLength;
                break;
       case 7:  adresse = DIAG__cdwMRWStartAdr_AC_EEP_FEE + SDF_nAdrArea_KL30Cal;
                bLength = SDF_nAdrArea_KL30CalLength;
                break;
       case 8:  adresse = DIAG__cdwMRWStartAdr_AC_EEP_FEE + SDF_nAdrArea_QuartzCal;
                bLength = SDF_nAdrArea_QuartzCalLength;
                break;
       case 9:  CAL_EvalReceivedValue( bReadCAL_CurrentPosition );
                break;
       case 255: // Ende
       default: adresse = DIAG__cdwMRWStartAdr_GC_IntFlash + 0x41002;
                bLength = SDF_nAdrArea_ValidPatternLength;
                break;
    }
    if( section == 9 )
    {
        bReadCAL_CurrentPosition = 0xFF;
        DiagAktion = 0;
        bQueueWaitForResponce = FALSE; 
        cancelTimer( tCAL_ReadTimeOutTimer );
        putValue( DIAG_CAL_StatusBar, "Successful finished" );
        DIAG_CTRL_vStartNewService();
        return;
    }
    DiagAktion = 0;
    if( FillCommand( ServicePhys ) ) return;
    {
        rqBuf[0] = 0x23;
        rqBuf[1] = 0x14;
        rqBuf[2] = ( adresse & 0xFF000000 ) >> 24;
        rqBuf[3] = ( adresse & 0x00FF0000 ) >> 16;
        rqBuf[4] = ( adresse & 0x0000FF00 ) >> 8;
        rqBuf[5] = ( adresse & 0x000000FF );
        rqBuf[6] = bLength;
        DIAG_SendRequest( SessionPhys, 7);
    }
    DiagAktion = cService_Routine_ReadCalState;
    bReadCAL_CurrentPosition = section;
    bQueueWaitForResponce = TRUE; 
    putValue( DIAG_CAL_StatusBar, "Waiting for answer..." );
    setTimer( tCAL_ReadTimeOutTimer, TimeOut );
}

CAL_vEvalReadCAL()
{   // pos res Pos. Response [hex]: 71,01,F0,07,Dc-Hi,Dc-Lo,Fq-Hi,Fq-MidHi,Fq-MidLo,Fq-Lo 
    if( rsBuf[0] == 0x63 )
    {
        CAL_EvalReceivedValue( bReadCAL_CurrentPosition );
        if( bReadCAL_CurrentPosition < 9 )
        {
            DIAG_CTRL_vStartNewService();
        }
        else
        {
            CAL_EvalReceivedValue( bReadRawADC_CurrentChannel );
            bReadCAL_CurrentPosition = 0xFF;
            DiagAktion = 0;
            bQueueWaitForResponce = FALSE; 
            cancelTimer( tCAL_ReadTimeOutTimer );
            putValue( DIAG_CAL_StatusBar, "Successful finished" );
        }
    }
    else
        if( AntwortAuswertung( 1, rsBuf[0], rsBuf[2]) )
        {
            DiagAktion = 0;
            bQueueWaitForResponce = FALSE; 
            cancelTimer( tADC_GetRaw_TimeOutTimer );
            putValue( DIAG_CAL_StatusBar, "Error while executing" );
        }
    DIAG_CTRL_vStartNewService();
}

DIAG_CTRL_DisableNormCom_Eval()
{
    if( rsBuf[0] == 0x68 )
    {
        DiagAktion = 0;
        putValue( DIAG_Main_ErrorStatus, "Successful" );
        bQueueWaitForResponce = FALSE;
        cancelTimer( TimeOutTimer );
        DIAG_CTRL_vStartNewService();
    }     
    else
        if( AntwortAuswertung( 1, rsBuf[0], rsBuf[2]) )
        {
            DiagAktion = 0;
            bQueueWaitForResponce = FALSE;
            cancelTimer( TimeOutTimer );
            DIAG_CTRL_vStartNewService();
        }
}

DIAG_CTRL_DisableNormCom_Fkt_Trigger()
{
    DiagAktion = 0;
    if( FillCommand( ServicePhys ) ) return;
    rqBuf[0] = 0x28;
    rqBuf[2] = 0x01;
    if( getValue( DIAG_CTRL_DisableNormCom_SupAnswer ) )
        rqBuf[1] = 0x81;
    else
    {
        rqBuf[1] = 0x00;
        setTimer( TimeOutTimer, TimeOut );
        DiagAktion = cService_Routine_DisableNormalCom;
        bQueueWaitForResponce = TRUE;
    }
    DIAG_SendRequest( cFUNCTIONAL, 3 );
    putValue( DIAG_Main_ErrorStatus, "Functional Disable Normal Communication ( for all nodes )" );
}

DIAG_CTRL_DisableNormCom_Phys_Trigger()
{
    DiagAktion = 0;
    if( FillCommand( ServicePhys ) ) return;
    rqBuf[0] = 0x28;
    rqBuf[2] = 0x01;
    if( getValue( DIAG_CTRL_DisableNormCom_SupAnswer ) )
        rqBuf[1] = 0x81;
    else
    {
        rqBuf[1] = 0x00;
        setTimer( TimeOutTimer, TimeOut );
        DiagAktion = cService_Routine_DisableNormalCom;
        bQueueWaitForResponce = TRUE;
    }
    DIAG_SendRequest( cPHYSICAL, 3 );
    putValue( DIAG_Main_ErrorStatus, "Physical Disable Normal Communication ( for IC only )" );
}

DIAG_CTRL_EnableNormCom_Eval()
{
    if( rsBuf[0] == 0x69)
    {
        AntwortAuswertung( 0, rsBuf[0], rsBuf[2]);
        bQueueWaitForResponce = FALSE;
        DiagAktion = 0;
    }
    else 
        if( rsBuf[0] == 0x68)
        {
            AntwortAuswertung( 0, rsBuf[0], rsBuf[2]);
            bQueueWaitForResponce = FALSE;
            DiagAktion = 0;
        }
        else 
            if( AntwortAuswertung( 1, rsBuf[0], rsBuf[2]) )
            {
                DiagAktion = 0;
                bQueueWaitForResponce = FALSE;
            }
    DIAG_CTRL_vStartNewService();
}

DIAG_CTRL_EnableNormCom_Fkt_Trigger()
{
    if( FillCommand( ServicePhys ) ) return;
    rqBuf[0] = 0x28;
    rqBuf[2] = 0x01;
    if( getValue( DIAG_CTRL_EnableNormCom_SupAnswer ) )
        rqBuf[1] = 0x81;
    else
    {
        rqBuf[1] = 0x00;
        setTimer( TimeOutTimer, TimeOut );
        DiagAktion = cService_Routine_EnableNormalCom;
        bQueueWaitForResponce = TRUE;
    }
    DIAG_SendRequest( cFUNCTIONAL, 3 );
    putValue( DIAG_Main_ErrorStatus, "Functional Enable Normal Communication ( for all nodes )" );
}

DIAG_CTRL_EnableNormCom_Phys_Trigger()
{
    if( FillCommand( ServicePhys ) ) return;
    rqBuf[0] = 0x28;
    rqBuf[2] = 0x01;
    if( getValue( DIAG_CTRL_EnableNormCom_SupAnswer ) )
        rqBuf[1] = 0x81;
    else
    {
        rqBuf[1] = 0x00;
        setTimer( TimeOutTimer, TimeOut );
        DiagAktion = cService_Routine_EnableNormalCom;
        bQueueWaitForResponce = TRUE;
    }
    DIAG_SendRequest( cPHYSICAL, 3 );
    putValue( DIAG_Main_ErrorStatus, "Functional Enable Normal Communication ( for all nodes )" );
}

DIAG_CTRL_HardReset_Eval()
{
    if( rsBuf[0] == 0x51)
    {
        putValue( DIAG_Main_ErrorStatus, "ECU reset ok." );
        bQueueWaitForResponce = FALSE;
        DiagAktion = 0;
    }
    else 
        if( AntwortAuswertung( 1, rsBuf[0], rsBuf[2]) )
        {
            DiagAktion = 0;
            bQueueWaitForResponce = FALSE;
        }
    DIAG_CTRL_vStartNewService();
}

DIAG_CTRL_HardReset_Fkt_Trigger()
{
    if( FillCommand( ServicePhys ) ) return;
    rqBuf[0] = 0x11;
    if( getValue( DIAG_CTRL_HardReset_SupAnswer ) )
        rqBuf[1] = 0x81;
    else
    {
        rqBuf[1] = 0x01;
        setTimer( TimeOutTimer, TimeOut );
        DiagAktion = cService_Routine_HardReset;
    }
    DIAG_SendRequest( cFUNCTIONAL, 2 );
    putValue( DIAG_Main_ErrorStatus, "Functional HardReset ( for all nodes )" );
}

DIAG_CTRL_HardReset_Phys_Trigger()
{
    if( FillCommand( ServicePhys ) ) return;
    rqBuf[0] = 0x11;
    if( getValue( DIAG_CTRL_HardReset_SupAnswer ) )
        rqBuf[1] = 0x81;
    else
    {
        rqBuf[1] = 0x01;
        setTimer( TimeOutTimer, TimeOut );
        DiagAktion = cService_Routine_HardReset;
    }
    DIAG_SendRequest( cPHYSICAL, 2 );
    putValue( DIAG_Main_ErrorStatus, "Physical HardReset ( for IC only )" );
}

void DIAG_CTRL_vEvalResponce( int Laenge )
{
    switch( DiagAktion )
    {
        case  0:     break;  /* Keine Aktion */
        case  1:    break;     /* Diagnose On/Off */
        case  cService_Routine_DisableNormalCom:     DIAG_CTRL_DisableNormCom_Eval();    break;     /* Normal Message Transmission off */
        case  cService_Routine_EnableNormalCom:      DIAG_CTRL_EnableNormCom_Eval();     break;     /* Normal Message Transmission on */

        case  14:      /* Speicher lesen */
               if( rsBuf[0] == 0x61)
                  {
                              // KWP2000 Antwort
                            AntwortAuswertung( 0, rsBuf[0], rsBuf[2]);
                    DiagAktion = 0;
                            GetBuffer();
                  }
                         else if( rsBuf[0] == 0x62 )
                         {
                              // UDS Antwort
                            AntwortAuswertung( 0, rsBuf[0], rsBuf[2]);
                    DiagAktion = 0;
                            GetBuffer();
                         }
                  else if( AntwortAuswertung( 1, rsBuf[0], rsBuf[2]) )
                     DiagAktion = 0;
                  break;

        case  15:      // Speicher schreiben
               if(rsBuf[0] == 0x7b)
                  {
                       AntwortAuswertung( 0, rsBuf[0], rsBuf[2]);
                     DiagAktion = 0;
                  }
                  else if( AntwortAuswertung( 1, rsBuf[0], rsBuf[2]) )
                         DiagAktion = 0;
                  break;

        case  16:      // I/O Control
                          if(rsBuf[0] == 0x70)
                  {
                    AntwortAuswertung( 0, rsBuf[0], rsBuf[2]);
                    DiagAktion = 0;
                            GetBuffer();
                  }
                  else if( AntwortAuswertung( 1, rsBuf[0], rsBuf[2]) )
                                 DiagAktion = 0;
                  break;

        case  17:      // manuelle Befehlseingabe
                  if( AntwortAuswertung( 0, rsBuf[0], rsBuf[2]) )
                    DiagAktion = 0;
                       GetBuffer();
                  break;


        case cService_Routine_HardReset:                    DIAG_CTRL_HardReset_Eval();         break;// ECU Reset
        case cService_Routine_ClearDTC:                     DTC_Clear_DTC_Eval();               break;
        case cService_Routine_ReadDTC:                      DTC_Read_DTC_Eval(Laenge, getValue( DIAG_DTC_ReadErrStat ) ); break;
        case cService_Routine_ReadActivePrivteDTCList:      DTC_GET_Private_DTC_List_Eval();    break;
        case cercvice_Routine_ClearPrivteDTC:               DTC_Clear_Private_DTC_Eval();       break;
        case cService_Routine_ClearDTC_MirrorMemory:        DTC_Clear_DTC_Mirror_Memory_Eval(); break;
        case cService_Routine_WemResetWriteCounter:         WEM_ResetWriteCounter_Eval();       break;
        case cService_Routine_WemStatusLesen:               WEM_StatusLesen_Eval(Laenge);       break;

        case cService_Routine_SW_Vers_Info_Get:             ID_SW_Vers_Info_Eval();             break; // 100
        case cService_Routine_BootLoader_Vers_Info_Get:     ID_BootLoader_Vers_Info_Eval();     break; // 101
        case cService_Routine_ECU_ID_Info_Get:              ID_ECU_ID_Info_Eval();              break; // 102
        case cService_Routine_Diag_Index_Info_Get:          ID_Diag_Index_Info_Eval();          break; // 103
        case cService_Routine_HW_Vers_Info_Get:             ID_HW_Vers_Info_Eval();             break; // 104
        case cService_Routine_AUTOsar_ID_Info_Get:          ID_AUTOsar_ID_Info_Eval();          break; // 105
        case cService_Routine_VDO_SAP_Nr_Info_Get:          ID_VDO_SAP_Nr_Info_Eval();          break; // 106
        case cService_Routine_VDO_Vers_Info_Get:            ID_VDO_Vers_Info_Eval();            break; // 107
        case cService_Routine_SW_Vers_BL_Info_Get:          ID_SW_Vers_BL_Info_Eval( Laenge );  break; // 108
        case cService_Routine_BootLoader_Vers_BL_Info_Get:  ID_BootLoader_Vers_BL_Info_Eval();  break; // 109
        case cService_Routine_Diag_Index_BL_Info_Get:       ID_Diag_Index_BL_Info_Eval();       break; // 110
        case cService_Routine_HW_Vers_BL_Info_Get:          ID_HW_Vers_BL_Info_Eval();          break; // 111
        case cService_Routine_FingerPrint_Get:              ID_FingerPrint_Eval();              break; // 112
        case cService_Routine_AC_SDF_SAP_Nr:                ID_SDF_AC_SAP_Eval();               break; // 115       
 //       case cService_Routine_GC_HL_SDF_SAP_Nr:             ID_SDF_GC_SAP_Eval();               break; // 116    
        case cService_Routine_GC_EL_SDF_SAP_Nr:             ID_SDF_GC_EL_SAP_Eval();               break; // 117   
		case cService_Routine_VehManufacturerSparePartNumber_Get:             ID_VehManufacturerSparePartNumber_Eval();               break; // 118

        case cService_Routine_MRW_Read:                     MRW_Read_Eval( Laenge );            break;
        case cService_Routine_MRW_Write:                    MRW_Write_Eval();                   break;
        case cService_Routine_ReadEEP2File:                 MRW_File_Read_Eval( Laenge );       break;
        case cService_Routine_WriteFile2EEP:                MRW_File_Write_Eval();              break;
        case cService_Routine_FormatFEE:                    MRW_vReset_FEE_Eval();              break;
        case cService_Routine_ReadCalState:                 CAL_vEvalReadCAL();                 break;

        case cService_Routine_Calibrate_KL30_Init: 
        case cService_Routine_Calibrate_KL30_GetValue:
        case cService_Routine_Calibrate_KL30_StoreCal:
        case cService_Routine_Calibrate_KL30:               CALKL30_vEvalResponce();            break;

        case cService_Routine_Calibrate_Clock:
        case cService_Routine_StoreMainCal:                 CALClock_vEvalCalResponce();        break;
        case cService_Routine_Enable_AC_MainOszi:
        case cService_Routine_Enable_AC_SubOszi:
        case cService_Routine_Enable_GC_MainOszi:           CALClock_vEvalResponce();           break;

        case cService_Routine_ReadAC_All:                   DIO_EvalReadPort0_17AC();           break;
        case cService_Routine_ReadPx:                       DIO_EvalReadPortx();                break;
        case cService_Routine_WriteAC_P0:           
        case cService_Routine_WriteAC_P1:           
        case cService_Routine_WriteAC_P2:           
        case cService_Routine_WriteAC_P3:           
        case cService_Routine_WriteAC_P4:           
        case cService_Routine_WriteAC_P16:          
        case cService_Routine_WriteAC_P17:                  DIO_WriteAC_Px_Eval();              break;
        case cService_Routine_ReadGC_All:                   DIO_EvalReadGC_All();               break;
        case cService_Routine_WriteGC_P0:           
        case cService_Routine_WriteGC_P1:           
        case cService_Routine_WriteGC_P2:           
        case cService_Routine_WriteGC_P3:           
        case cService_Routine_WriteGC_P4:           
        case cService_Routine_WriteGC_P5:           
        case cService_Routine_WriteGC_P6:                   DIO_WriteGC_Px_Eval();              break;
        case cService_Routine_ReadCompareInput:             DIO_EvalReadCompareInput();         break;
        case cService_Routine_LVDS_ReadPin_Sync:            LVDS_EvalRead_Pin_Sync();           break;
        case cService_Routine_LVDS_ReadFramecounter:        LVDS_EvalRead_Framecounter();       break;
        case cService_Routine_LVDS_ReadRegister:            LVDS_Eval_Read_Register();          break;
        case cService_Routine_LVDS_WriteRegister:           LVDS_Eval_Write_Register();         break;
        case cService_Routine_LVDS_Switch_Func:             LVDS_Eval_Switch_Func();            break;
        case cService_Routine_LVDS_Switch_Disp:             LVDS_Eval_Switch_Disp();            break;
        case cService_Routine_LVDS_ReadTestpic_CRC:         LVDS_EvalRead_Testpic_CRC();        break;
        case cService_Routine_StartDisplayTest:             DSP_EvalStartDisplayTest();         break;
        case cService_Routine_StopDisplayTest:              DSP_EvalStopDisplayTest();          break;
        case cService_Routine_StartSoundTest:               SND_EvalStartSoundTest();           break;
        case cService_Routine_StopSoundTest:                SND_EvalStopSoundTest();            break;
//    case cService_Routine_VolumeSoundTest:        SND_EvalVolumeSoundTest();      break;
        case cService_Routine_StartSoundQTest:              SND_EvalStartSoundQTest();          break;
        case cService_Routine_StopSoundQTest:               SND_EvalStopSoundQTest();           break;
        case cService_Routine_StartSoundDMode:              SND_EvalStartSoundDMode();          break;
        case cService_Routine_StopSoundDMode:               SND_EvalStopSoundDMode();           break;
    
        case cService_Routine_ReadPWM:                      PWM_EvalReadPWM();                  break;
        case cService_Routine_WritePWMFreq:                 PWM_EvalSetFreqValue();             break;
        case cService_Routine_WritePWMDuty_Ch00:            PWM_EvalSetDutyValue();             break;
        case cService_Routine_WritePWMDuty_Ch01:            PWM_EvalSetDutyValue();             break;
        case cService_Routine_WritePWMDuty_Ch02:            PWM_EvalSetDutyValue();             break;
        case cService_Routine_WritePWMDuty_Ch03:            PWM_EvalSetDutyValue();             break;
        case cService_Routine_WritePWMDuty_Ch04:            PWM_EvalSetDutyValue();             break;
        case cService_Routine_WritePWMDuty_Ch05:            PWM_EvalSetDutyValue();             break;
        case cService_Routine_WritePWMDuty_Ch06:            PWM_EvalSetDutyValue();             break;
        case cService_Routine_WritePWMDuty_Ch07:            PWM_EvalSetDutyValue();             break;
        case cService_Routine_WritePWMDuty_Ch08:            PWM_EvalSetDutyValue();             break;
        case cService_Routine_WritePWMDuty_Ch09:            PWM_EvalSetDutyValue();             break;
        case cService_Routine_WritePWMDuty_Ch10:            PWM_EvalSetDutyValue();             break;
        case cService_Routine_WritePWMDuty_Ch11:            PWM_EvalSetDutyValue();             break;
        case cService_Routine_WritePWMDuty_Ch12:            PWM_EvalSetDutyValue();             break;
        case cService_Routine_WritePWMDuty_Ch13:            PWM_EvalSetDutyValue();             break;
        case cService_Routine_StopPWMControl:               PWM_EvalStopPWMControl();           break;
        
        case cRead_PhysicalPorts:                           GPIO_EvalReadPhysicalPorts();       break; //915
        
        case cService_Routine_ReadRawADC:                   ADC_EvalReadRawADC();               break;

        case cService_Control_Lamptest_On:                  Routine_Lamptest_On_Eval();         break;
        case cService_Control_Lamptest_Off:                 Routine_Lamptest_Off_Eval();        break;

        case cService_Control_Warp_Data_Write:              Warp_Data_Write_Eval();             break;

        case cService_SecLevel:                             DIAG_CTRL_vEvalSecLevelEnter();     break;  // change of security level

        case cService_SessionLevel:     // session-wechsel bei physikalischer addressierung
                         if( AntwortAuswertung(0, rsBuf[0], rsBuf[1]) )
                    {
                              DiagAktion = 0;
                        cancelTimer( tSessionSendTimeOutTimer );
                        bQueueWaitForResponce = FALSE;
                        DIAG_CTRL_vStartNewService();
                    }
                         break;
        case cService_SessionLevelCheck:                    DIAG_CTRL_vEvalSessionLevelCheck( bRequestedSessionLevel ); break;

    }
    if( Buf_Diag) GetBuffer();     //Erweiterte Diagnose
    DIAG_CTRL_vStartNewService();

}

DIAG_CTRL_vEvalSecLevelEnter()
{
    if( (rsBuf[0] == 0x67) && (rsBuf[1] == getValue( DIAG_CTRL_SecLevel ) ) )
    {
         rqBuf[0] = 0x27 ;
         rqBuf[1] = getValue( DIAG_CTRL_SecLevel ) + 1;
         rqBuf[2] = rsBuf[2];
         rqBuf[3] = rsBuf[3];
         rqBuf[4] = rsBuf[4];
         rqBuf[5] = rsBuf[5];
         rqBuf[6] = rsBuf[6];
         rqBuf[7] = rsBuf[7];
         rqBuf[8] = rsBuf[8];
         rqBuf[9] = rsBuf[9];
         DIAG_SendRequest( ServicePhys, 10);
         return;
    }
    else
    if( ( rsBuf[0] == 0x67) && ( rsBuf[1] == ( getValue( DIAG_CTRL_SecLevel ) + 1 ) ) )
    {
        putValue( DIAG_Main_ErrorStatus, "Session entered" );
        bQueueWaitForResponce = FALSE;
        cancelTimer( tSecLevel_SendTimeOutTimer );
        DiagAktion = 0;
        DIAG_CTRL_vStartNewService();
    }
    else
        if( AntwortAuswertung( 1, rsBuf[0], rsBuf[2]) )
        {
            DiagAktion = 0;
            cancelTimer( tSecLevel_SendTimeOutTimer );
            bQueueWaitForResponce = FALSE;
            DIAG_CTRL_vStartNewService();
        }
}

DIAG_CTRL_vEvalSessionLevelCheck( byte bRequiredSession )
{
    byte bActiveSession;
    if( (rsBuf[0] == 0x62 ) && (rsBuf[1] == 0xF1) && (rsBuf[2] == 0x00) )
    {
        putValue( DIAG_ID_DiagIndex, (( rsBuf[ 4] * 256 ) + rsBuf[ 5] ) );
        bActiveSession = rsBuf[6];

        putValue( DIAG_Main_ErrorStatus, "Active Session Checked" );
        bQueueWaitForResponce = FALSE;
        cancelTimer( tSecLevel_SendTimeOutTimer );
        DiagAktion = 0;
        if( ( bActiveSession == bRequiredSession ) &&
            ( bRequiredSession > 1 )  )
        {
            DIAG_Queue_GetNextCommand();   
            DIAG_Queue_GetNextCommand();   
        }
        DIAG_CTRL_vStartNewService();
    }
    else
        if( AntwortAuswertung( 1, rsBuf[0], rsBuf[2]) )
        {
            DiagAktion = 0;
            cancelTimer( tSecLevel_SendTimeOutTimer );
            bQueueWaitForResponce = FALSE;
            DIAG_CTRL_vStartNewService();
            return;
        }
}

DIAG_CTRL_vHardReset_Phys( )
{
    if( FillCommand( ServicePhys ) ) return;
    rqBuf[0] = 0x11;
    if( getValue( DIAG_CTRL_HardReset_SupAnswer ) )
        rqBuf[1] = 0x81;
    else
    {
        rqBuf[1] = 0x01;
        setTimer( TimeOutTimer, TimeOut );
        DiagAktion = cService_Routine_HardResetPhys;
    }
    DIAG_SendRequest( cPHYSICAL, 2 );
    putValue( DIAG_Main_ErrorStatus, "Physical HardReset ( for IC only )" );
}

DIAG_CTRL_vSecLevel_Send( byte bSecLevel )
{
    DiagAktion = 0;
    if( FillCommand( ServicePhys ) ) return;
    {
        rqBuf[0] = 0x27;
        rqBuf[1] = bSecLevel;
        putValue( DIAG_CTRL_SecLevel, bSecLevel );
        DIAG_SendRequest( SessionPhys, 2 );

        DiagAktion = cService_SecLevel;
        bQueueWaitForResponce = TRUE;
        putValue( DIAG_Main_ErrorStatus, "Warte auf Antwort..." );
        setTimer( tSecLevel_SendTimeOutTimer, TimeOut );
     }
}

DIAG_CTRL_vSend_HardReset_Phys()
{
    if( FillCommand( ServicePhys ) ) return;
    rqBuf[0] = 0x11;
    if( getValue( DIAG_CTRL_HardReset_SupAnswer ) )
        rqBuf[1] = 0x81;
    else
    {
        rqBuf[1] = 0x01;
        setTimer( TimeOutTimer, TimeOut );
        DiagAktion = cService_Routine_HardResetPhys;
    }
    DIAG_SendRequest( cPHYSICAL, 2 );
    putValue( DIAG_Main_ErrorStatus, "Physical HardReset ( for IC only )" );
}

DIAG_CTRL_vSessionLevelCheck_Send( byte ReqLevel )
{
    DiagAktion = 0;
    if( FillCommand( ServicePhys ) ) return;
    {
        rqBuf[0] = 0x22;
        rqBuf[1] = 0xF1;
        rqBuf[2] = 0x00;
        DIAG_SendRequest( SessionPhys, 3);
        bRequestedSessionLevel = ReqLevel;

        DiagAktion = cService_SessionLevelCheck;
        bQueueWaitForResponce = TRUE;
        putValue( DIAG_Main_ErrorStatus, "Warte auf Antwort..." );
        setTimer( tSecLevel_SendTimeOutTimer, TimeOut );
    }
}

DIAG_CTRL_vSessionSend( byte bSession )
{
    DiagAktion = 0;
    if( FillCommand( ServicePhys ) ) return;
    {
        rqBuf[0] = 0x10;
        rqBuf[1] = bSession;
        putValue( DIAG_CTRL_Session, bSession );
        DIAG_SendRequest( SessionPhys, 2 );
        putValue( DIAG_CALKL30_ValuesStoredDone, 0 );
        putValue( DIAG_CALKL30_LowValue_OK, 0 );
        putValue( DIAG_CALKL30_MidValue_OK, 0 );
        putValue( DIAG_CALKL30_HighValue_OK, 0 );
        putVAlue( DIAG_CALKL30_LowValue_ADC_x, 0 );
        putVAlue( DIAG_CALKL30_MidValue_ADC_x, 0 );
        putVAlue( DIAG_CALKL30_HighValue_ADC_x, 0 );
        putVAlue( DIAG_CALKL30_LowValue_ADC_y, 0 );
        putVAlue( DIAG_CALKL30_MidValue_ADC_y, 0 );
        putVAlue( DIAG_CALKL30_HighValue_ADC_y, 0 );
        EnableControl( "Calibrate KL30", "EnvVar:DIAG_CALKL30_StoreCal", 0 );
        EnableControl( "Calibrate KL30", "EnvVar:DIAG_CALKL30_CalStepDone", 0 );
        CALKL30_vPutCommandText( "" );
    }
    if( SessionPhys )
    {
        DiagAktion = cService_SessionLevel;
        bQueueWaitForResponce = TRUE;
        putValue( DIAG_Main_ErrorStatus, "Warte auf Antwort..." );
        setTimer( tSessionSendTimeOutTimer, TimeOut );
    }
    else
    {
        putValue( DIAG_Main_ErrorStatus, "" );
    }
}

void DIAG_CTRL_vStartNewService()
{
    word wNextCommand;
    // Schedules the cyclic diag requests send to IC
    // check for active requests, send them and consume active flag

    if( bQueueWaitForResponce )
        return;                         // Quit if an answer is still missing for the last request

    wNextCommand = DIAG_Queue_GetNextCommand();
    //write( "DIAG_CTRL_vStartNewService() NextCommand : %d", wNextCommand );
    switch( wNextCommand )
    {
        case cService_Routine_EnableNormalComFkt:           DIAG_CTRL_EnableNormCom_Fkt_Trigger();   return; //    3
        case cService_Routine_EnableNormalComPhys:          DIAG_CTRL_EnableNormCom_Phys_Trigger();  return; //    4
        case cService_Routine_DisableNormalComFkt:          DIAG_CTRL_DisableNormCom_Fkt_Trigger();  return; //    6
        case cService_Routine_DisableNormalComPhys:         DIAG_CTRL_DisableNormCom_Phys_Trigger(); return; //    7
        case cService_Routine_HardResetFkt:                 DIAG_CTRL_HardReset_Fkt_Trigger();       return; //   26
        case cService_Routine_HardResetPhys:                DIAG_CTRL_HardReset_Phys_Trigger();      return; //   27

        case cService_Routine_ClearDTC:                     DTC_Clear_DTC_Trigger();                 return; //   30
        case cService_Routine_ReadDTC:                      DTC_Read_DTC_Trigger( getValue( DIAG_DTC_ReadErrStat ) );    return;         return; 
        case cercvice_Routine_ClearPrivteDTC:               DTC_Clear_Private_DTC_Trigger();         return; //   32
        case cService_Routine_ClearDTC_MirrorMemory:        DTC_Clear_DTC_Mirror_Memory_Trigger();   return; //   60
        case cService_Routine_WemResetWriteCounter:         WEM_ResetWriteCounter_Trigger();         return; //   59
        case cService_Routine_WemStatusLesen:               WEM_StatusLesen_Trigger();               return;

        case cService_Routine_SW_Vers_Info_Get:             ID_SW_Vers_Info_Get();                   return; //  100
        case cService_Routine_BootLoader_Vers_Info_Get:     ID_BootLoader_Vers_Info_Get();           return; //  101
        case cService_Routine_ECU_ID_Info_Get:              ID_ECU_ID_Info_Get();                    return; //  102
        case cService_Routine_Diag_Index_Info_Get:          ID_Diag_Index_Info_Get();                return; //  103
        case cService_Routine_HW_Vers_Info_Get:             ID_HW_Vers_Info_Get();                   return; //  104
        case cService_Routine_AUTOsar_ID_Info_Get:          ID_AUTOsar_ID_Info_Get();                return; //  105
        case cService_Routine_VDO_SAP_Nr_Info_Get:          ID_VDO_SAP_Nr_Info_Get();                return; //  106
        case cService_Routine_VDO_Vers_Info_Get:            ID_VDO_Vers_Info_Get();                  return; //  107
        case cService_Routine_SW_Vers_BL_Info_Get:          ID_SW_Vers_BL_Info_Get();                return; //  108
        case cService_Routine_BootLoader_Vers_BL_Info_Get:  ID_BootLoader_Vers_BL_Info_Get();        return; //  109
        case cService_Routine_Diag_Index_BL_Info_Get:       ID_Diag_Index_BL_Info_Get();             return; //  110
        case cService_Routine_HW_Vers_BL_Info_Get:          ID_HW_Vers_BL_Info_Get();                return; //  111
        case cService_Routine_FingerPrint_Get:              ID_FingerPrint_Get();                    return; //  112
        case cService_Routine_AC_SDF_SAP_Nr:                ID_SDF_AC_SAP_Get();                     return; //  115
//        case cService_Routine_GC_HL_SDF_SAP_Nr:             ID_SDF_GC_HL_SAP_Get();                  return; //  116
        case cService_Routine_GC_EL_SDF_SAP_Nr:             ID_SDF_GC_EL_SAP_Get();                  return; //  117
		case cService_Routine_VehManufacturerSparePartNumber_Get:             ID_VehManufacturerSparePartNumber_Get();                   return; //  118

        case cService_Routine_MRW_Read:                     MRW_vReadMemoryPressed();                return; //  600
        case cService_Routine_MRW_Write:                    MRW_vWriteMemoryPressed();               return; //  601
        case cService_Routine_ReadEEP2File:                 MRW_vReadFilePressed();                  return; //  602
        case cService_Routine_WriteFile2EEP:                MRW_vWriteFilePressed();                 return; //  603
        case cService_Routine_ReadCalDDR3:                  CAL_ReadNext_Trigger( cCALDDR3 );        return; //  631
        case cService_Routine_ReadCalVCom:                  CAL_ReadNext_Trigger( cCALVCom );        return; //  631
        case cService_Routine_ReadCalGamma:                 CAL_ReadNext_Trigger( cCALGamma );       return; //  631
        case cService_Routine_ReadCalWhiteBal:              CAL_ReadNext_Trigger( cCALWhiteBal );    return; //  631
        case cService_Routine_ReadCalMVOControl:            CAL_ReadNext_Trigger( cCALMVOControl );  return; //  631
        case cService_Routine_ReadCalSoundVolume:           CAL_ReadNext_Trigger( cCALSoundVolume ); return; //  631
        case cService_Routine_ReadCalKL30Cal:               CAL_ReadNext_Trigger( cCALKL30Cal );     return; //  631
        case cService_Routine_ReadCalQuartzCal:             CAL_ReadNext_Trigger( cCALQuartzCal );   return; //  631
        case cService_Routine_ReadCalShowVal:               CAL_ReadNext_Trigger( cCALShowVal );     return; //  631

        case cService_Routine_FormatFEE:                    MRW_vReset_FEE_Trigger();                return; //  605
        case cService_Routine_Calibrate_KL30:               return;

        case cService_Routine_Calibrate_KL30_Init:          CALKL30_Start_Trigger();                 return; //  611
        case cService_Routine_Calibrate_KL30_GetValue:      CALKL30_GetCalibrationValue();           return; //  612
        case cService_Routine_Calibrate_KL30_StoreCal:      CALKL30_StoreCalibrationValue();         return; //  613

        case cService_Routine_Calibrate_Clock:              CALClock_Start_Trigger_CalAC_MainOszi(); return; //  620

        case cService_Routine_Enable_AC_MainOszi:           CALClock_Start_Trigger_AC_MainOszi();    return; //  621
        case cService_Routine_Enable_AC_SubOszi:            CALClock_Start_Trigger_AC_SubOszi();     return; //  622
        case cService_Routine_Enable_GC_MainOszi:           CALClock_Start_Trigger_GC_MainOszi();    return; //  623

        case cService_Routine_StoreMainCal:                 CALClock_StoreCalibrationValue();        return; //  625

        case cService_Routine_ReadAC_All:               DIO_ReadAC_AllTrigger();                     return; //  700
        case cService_Routine_ReadAC_P0:                DIO_ReadPx_Trigger( 0x00 );                  return; //  680
        case cService_Routine_ReadAC_P1:                DIO_ReadPx_Trigger( 0x01 );                  return; //  681
        case cService_Routine_ReadAC_P2:                DIO_ReadPx_Trigger( 0x02 );                  return; //  682
        case cService_Routine_ReadAC_P3:                DIO_ReadPx_Trigger( 0x03 );                  return; //  683
        case cService_Routine_ReadAC_P4:                DIO_ReadPx_Trigger( 0x04 );                  return; //  684
        case cService_Routine_ReadAC_P16:               DIO_ReadPx_Trigger( 0x06 );                  return; //  685
        case cService_Routine_ReadAC_P17:               DIO_ReadPx_Trigger( 0x07 );                  return; //  686
        case cService_Routine_ReadGC_All:               DIO_ReadGC_All_Trigger();                    return; //  710
        case cService_Routine_ReadGC_P0:                DIO_ReadPx_Trigger( 0x10 );                  return; //  690
        case cService_Routine_ReadGC_P1:                DIO_ReadPx_Trigger( 0x11 );                  return; //  691
        case cService_Routine_ReadGC_P2:                DIO_ReadPx_Trigger( 0x12 );                  return; //  692
        case cService_Routine_ReadGC_P3:                DIO_ReadPx_Trigger( 0x13 );                  return; //  693
        case cService_Routine_ReadGC_P4:                DIO_ReadPx_Trigger( 0x14 );                  return; //  694
        case cService_Routine_ReadGC_P5:                DIO_ReadPx_Trigger( 0x15 );                  return; //  695
        case cService_Routine_ReadGC_P6:                DIO_ReadPx_Trigger( 0x16 );                  return; //  695
        case cService_Routine_WriteAC_P0:               DIO_WriteAC_P0_Trigger();                    return; //  701
        case cService_Routine_WriteAC_P1:               DIO_WriteAC_P1_Trigger();                    return; //  702
        case cService_Routine_WriteAC_P2:               DIO_WriteAC_P2_Trigger();                    return; //  703
        case cService_Routine_WriteAC_P3:               DIO_WriteAC_P3_Trigger();                    return; //  704
        case cService_Routine_WriteAC_P4:               DIO_WriteAC_P4_Trigger();                    return; //  705
        case cService_Routine_WriteAC_P16:              DIO_WriteAC_P16_Trigger();                   return; //  706
        case cService_Routine_WriteAC_P17:              DIO_WriteAC_P17_Trigger();                   return; //  707
        case cService_Routine_WriteAC_Px:               DIO_WriteAC_P0_Trigger();                    return; //  709
        case cService_Routine_WriteGC_P0:               DIO_WriteGC_P0_Trigger();                    return; //  711
    //  case cService_Routine_WriteGC_P1:               DIO_WriteGC_P1_Trigger();                    return; //  712
    //  case cService_Routine_WriteGC_P2:               DIO_WriteGC_P2_Trigger();                    return; //  713
    //  case cService_Routine_WriteGC_P3:               DIO_WriteGC_P3_Trigger();                    return; //  714
        case cService_Routine_WriteGC_P4:               DIO_WriteGC_P4_Trigger();                    return; //  715
        case cService_Routine_WriteGC_P5:               DIO_WriteGC_P5_Trigger();                    return; //  716
        case cService_Routine_WriteGC_P6:               DIO_WriteGC_P6_Trigger();                    return; //  717
        case cService_Routine_WriteGC_Px:                                                            return; //  718 

        case cService_Routine_ReadPWM_Ch00:             if(getValue( DIAG_CTRL_IC_Type_Selector) == cKI_VS30_EL)  
                                                          PWM_GetValue( LL_ML_DIAL );       /*LL*/
                                                        else
                                                          PWM_GetValue( HL_HLP_TT );        /*HL*/                    return; //  731
        
        case cService_Routine_ReadPWM_Ch01:             if(getValue( DIAG_CTRL_IC_Type_Selector) == cKI_VS30_EL)  
                                                          PWM_GetValue( LL_ML_PTR );        /*LL*/
                                                        else
                                                          PWM_GetValue( HL_HLP_TT_SAFETY ); /*HL*/                    return; //  732
        
        case cService_Routine_ReadPWM_Ch02:             if(getValue( DIAG_CTRL_IC_Type_Selector) == cKI_VS30_EL)  
                                                          PWM_GetValue( LL_ML_TT );         /*LL*/
                                                        else
                                                          PWM_GetValue( HL_HLP_PTR );       /*HL*/                    return; //  733
        
        case cService_Routine_ReadPWM_Ch03:             if(getValue( DIAG_CTRL_IC_Type_Selector) == cKI_VS30_EL)  
                                                          PWM_GetValue( LL_ML_TT_SAFETY );  /*LL*/
                                                        else
                                                          PWM_GetValue( HL_HLP_DIAL );      /*HL*/                    return; //  734
        
        case cService_Routine_ReadPWM_Ch04:             if(getValue( DIAG_CTRL_IC_Type_Selector) == cKI_VS30_EL)  
                                                          PWM_GetValue( LL_ML_BL_DIMM );    /*LL*/
                                                        else
                                                          PWM_GetValue( HL_HLP_ART );       /*HL+ only*/              return; //  735
        
        case cService_Routine_ReadPWM_Ch05:             if(getValue( DIAG_CTRL_IC_Type_Selector) == cKI_VS30_EL)  
                                                          PWM_GetValue( LL_ML_DISP_VLCD_PWM );  /*LL*/
                                                        else
                                                          PWM_GetValue( HL_HLP_BAR_FU );        /*HL*/                return; //  736
                                                            
        case cService_Routine_ReadPWM_Ch06:             {if(getValue( DIAG_CTRL_IC_Type_Selector) == cKI_VS30_EL)  
                                                          PWM_GetValue( LL_ML_DISP_VREF_PWM );  /*LL*/
                                                        else
                                                          PWM_GetValue( HL_HLP_BAR_FU_PASS );}  /*HL*/                return; //  737
        
        case cService_Routine_ReadPWM_Ch07:             PWM_GetValue( HL_HLP_RES1 );        /*HL/HL+ only*/           return; //  738
        case cService_Routine_ReadPWM_Ch08:             PWM_GetValue( HL_HLP_RES2 );        /*HL/HL+ only*/           return; //  739
        case cService_Routine_ReadPWM_Ch09:             PWM_GetValue( HL_HLP_1V25_SS );     /*HL/HL+ only*/           return; //  740
        case cService_Routine_ReadPWM_Ch10:             PWM_GetValue( HL_HLP_BL_DIMM );     /*HL/HL+ only*/           return; //  741
        case cService_Routine_ReadPWM_Ch11:             PWM_GetValue( HL_HLP_BL_SS );       /*HL/HL+ only*/           return; //  742
        case cService_Routine_ReadPWM_Ch12:             PWM_GetValue( HL_HLP_BAR_TE );      /*HL/HL+ only*/           return; //  743
        case cService_Routine_ReadPWM_Eval:             PWM_EvalValues( 0x10, 0, 0);                                  return; //  744
        case cService_Routine_ReadPWM_Ch13:             PWM_GetValue( HL_HLP_BAR_TE_PASS ); /*HL/HL+ only*/           return; //  745
        
        case cService_Routine_WritePWMFreq:             PWM_SetFreqValue();                          return; //  751

        case cService_Routine_WritePWMDuty:             PWM_SetDutyValue();                          return; //  732
        case cService_Routine_WritePWMDuty_Ch00:        PWM_SetDutyValue_Ch00();                     return; //  733
        case cService_Routine_WritePWMDuty_Ch01:        PWM_SetDutyValue_Ch01();                     return; //  733
        case cService_Routine_WritePWMDuty_Ch02:        PWM_SetDutyValue_Ch02();                     return; //  735
        case cService_Routine_WritePWMDuty_Ch03:        PWM_SetDutyValue_Ch03();                     return; //  736
        case cService_Routine_WritePWMDuty_Ch04:        PWM_SetDutyValue_Ch04();                     return; //  737
        case cService_Routine_WritePWMDuty_Ch05:        PWM_SetDutyValue_Ch05();                     return; //  738
        case cService_Routine_WritePWMDuty_Ch06:        PWM_SetDutyValue_Ch06();                     return; //  739
        case cService_Routine_WritePWMDuty_Ch07:        PWM_SetDutyValue_Ch07();                     return; //  740
        case cService_Routine_WritePWMDuty_Ch08:        PWM_SetDutyValue_Ch08();                     return; //  741
        case cService_Routine_WritePWMDuty_Ch09:        PWM_SetDutyValue_Ch09();                     return; //  742
        case cService_Routine_WritePWMDuty_Ch10:        PWM_SetDutyValue_Ch10();                     return; //  743
        case cService_Routine_WritePWMDuty_Ch11:        PWM_SetDutyValue_Ch11();                     return; //  744
        case cService_Routine_WritePWMDuty_Ch12:        PWM_SetDutyValue_Ch12();                     return; //  745
        case cService_Routine_WritePWMDuty_Ch13:        PWM_SetDutyValue_Ch13();                     return; //  807
        case cService_Routine_StopPWMControl:           PWM_StopPWMControl();                        return; //  746
        case cService_Routine_LVDS_ReadPin_Sync:        LVDS_Read_Pin_Sync_Trigger();                return; //  750
        case cService_Routine_LVDS_ReadFramecounter:    LVDS_Read_Framecounter_Trigger();            return; //  751
        case cService_Routine_LVDS_ReadRegister:        LVDS_Read_Register_Trigger();                return; //  752
        case cService_Routine_LVDS_WriteRegister:       LVDS_Write_Register_Trigger();               return; //  753
        case cService_Routine_LVDS_Switch_Func:         LVDS_Write_LVDS_Switch_Func_Trigger();       return; //  754
        case cService_Routine_LVDS_Switch_Disp:         LVDS_Write_LVDS_Switch_Disp_Trigger();       return; //  755
        case cService_Routine_LVDS_ReadTestpic_CRC:     LVDS_Read_Testpic_CRC_Trigger();             return; //  756
        case cService_Routine_StartDisplayTest:         DSP_vStartControl_Send();                    return; //  770
        case cService_Routine_StopDisplayTest:          DSP_vStopControl_Send();                     return; //  771
        case cService_Routine_StartSoundTest:           SND_vStartControl_Send();                    return; //  780
        case cService_Routine_StopSoundTest:            SND_vStopControl_Send();                     return; //  781
//        case cService_Routine_VolumeSoundTest:          SND_vVolume();                               return; // 782
        case cService_Routine_StartSoundQTest:          SND_vStartQControl_Send();                   return; //  803
        case cService_Routine_StopSoundQTest:           SND_vStopQControl_Send();                    return; //  804
        case cService_Routine_StartSoundDMode:          SND_vStartDMControl_Send();                  return; //  805
        case cService_Routine_StopSoundDMode:           SND_vStopDMControl_Send();                   return; //  806

        case cService_Routine_ReadRawADC_Ch00:          ADC_GetRawValue( 00 );                       return; //  831
        case cService_Routine_ReadRawADC_Ch01:          ADC_GetRawValue( 01 );                       return; //  832 
        case cService_Routine_ReadRawADC_Ch02:          ADC_GetRawValue( 02 );                       return; //  833
        case cService_Routine_ReadRawADC_Ch03:          ADC_GetRawValue( 03 );                       return; //  834
        case cService_Routine_ReadRawADC_Ch04:          ADC_GetRawValue( 04 );                       return; //  835
        case cService_Routine_ReadRawADC_Ch05:          ADC_GetRawValue( 05 );                       return; //  836
        case cService_Routine_ReadRawADC_Ch06:          ADC_GetRawValue( 06 );                       return; //  837
        case cService_Routine_ReadRawADC_Ch07:          ADC_GetRawValue( 07 );                       return; //  838
        case cService_Routine_ReadRawADC_Ch08:          ADC_GetRawValue( 08 );                       return; //  839
        case cService_Routine_ReadRawADC_Ch09:          ADC_GetRawValue( 09 );                       return; //  840
        case cService_Routine_ReadRawADC_Ch10:          ADC_GetRawValue( 10 );                       return; //  841
        case cService_Routine_ReadRawADC_Ch11:          ADC_GetRawValue( 11 );                       return; //  842
        case cService_Routine_ReadRawADC_Ch12:          ADC_GetRawValue( 12 );                       return; //  843
        case cService_Routine_ReadRawADC_Ch13:          ADC_GetRawValue( 13 );                       return; //  844
        case cService_Routine_ReadRawADC_Ch14:          ADC_GetRawValue( 14 );                       return; //  845
        case cService_Routine_ReadRawADC_Ch15:          ADC_GetRawValue( 15 );                       return; //  846
        case cService_Routine_ReadRawADC_Eval:          ADC_EvalRawValue( 0x10, 0, 0 );              return; //  847
        
        case cService_ReadPhysicalPorts_P0:             {GPIO_SetPort_P0();   write("ajunge");}                        return; //900
        case cService_ReadPhysicalPorts_P1:             GPIO_SetPort_P1();                           return; //901
        case cService_ReadPhysicalPorts_P2:             GPIO_SetPort_P2();                           return; //902
        case cService_ReadPhysicalPorts_P3:             GPIO_SetPort_P3();                           return; //903
        case cService_ReadPhysicalPorts_P10:            GPIO_SetPort_P10();                          return; //904
        case cService_ReadPhysicalPorts_P11:            GPIO_SetPort_P11();                          return; //905
        case cService_ReadPhysicalPorts_P16:            GPIO_SetPort_P16();                          return; //906
        case cService_ReadPhysicalPorts_P17:            GPIO_SetPort_P17();                          return; //907
        case cService_ReadPhysicalPorts_P21:            GPIO_SetPort_P21();                          return; //908
        case cService_ReadPhysicalPorts_P40:            GPIO_SetPort_P40();                          return; //909
        case cService_ReadPhysicalPorts_P42:            GPIO_SetPort_P42();                          return; //910
        case cService_ReadPhysicalPorts_P43:            GPIO_SetPort_P43();                          return; //911
        case cService_ReadPhysicalPorts_P44:            GPIO_SetPort_P44();                          return; //912
        case cService_ReadPhysicalPorts_P45:            GPIO_SetPort_P45();                          return; //913
        case cService_ReadPhysicalPorts_JP0:            GPIO_SetPort_JP0();                          return; //914
        
        case cService_SessionLevel:                     DIAG_CTRL_vSessionSend( getValue( DIAG_CTRL_Session ) );   return; // 1000
        case cService_SessionLevel_Default:             DIAG_CTRL_vSessionSend( SessionLevel0 );    return; // 1001
        case cService_SessionLevel_Program:             DIAG_CTRL_vSessionSend( SessionLevel1 );    return; // 1002
        case cService_SessionLevel_Extended:            DIAG_CTRL_vSessionSend( SessionLevel2 );    return; // 1003
        case cService_SessionLevel_Supplier:            DIAG_CTRL_vSessionSend( SessionLevel3 );    return; // 1004
        case cService_SessionLevel_Boardtest:           DIAG_CTRL_vSessionSend( SessionLevel4 );    return; // 1005

        case cService_SecLevel:                         DIAG_CTRL_vSecLevel_Send( getValue( DIAG_CTRL_SecLevel ) );   return; // 1010
        case cService_SecLevel_Default:                 DIAG_CTRL_vSecLevel_Send( SecurityLevel0 );   return; // 1011
        case cService_SecLevel_Antitheft:               DIAG_CTRL_vSecLevel_Send( SecurityLevel1 );   return; // 1012
        case cService_SecLevel_Manifacturing:           DIAG_CTRL_vSecLevel_Send( SecurityLevel2 );   return; // 1013
        case cService_SecLevel_Supplier:                DIAG_CTRL_vSecLevel_Send( SecurityLevel3 );   return; // 1014

        case cService_SessionLevelCheck:                DIAG_CTRL_vSessionLevelCheck_Send( getValue( DIAG_CTRL_Session ) );    return; // 1020
        case cService_SessionLevelCheck_Default:        DIAG_CTRL_vSessionLevelCheck_Send( SessionLevel0 );    return; // 1021
        case cService_SessionLevelCheck_Program:        DIAG_CTRL_vSessionLevelCheck_Send( SessionLevel1 );    return; // 1022
        case cService_SessionLevelCheck_Extended:       DIAG_CTRL_vSessionLevelCheck_Send( SessionLevel2 );    return; // 1023
        case cService_SessionLevelCheck_Supplier:       DIAG_CTRL_vSessionLevelCheck_Send( SessionLevel3 );    return; // 1024
        case cService_SessionLevelCheck_Boardtest:      DIAG_CTRL_vSessionLevelCheck_Send( SessionLevel4 );    return; // 1025

        case cService_ControlLog_DataToFile:            DIAG_LOG_SaveDataToFile();                             return; // 1030

        case cService_Control_Start_DiagSession:        DIAG_CTRL_Start_DiagSession();                         return; // 1040
        case cService_Control_Stop_DiagSession:         DIAG_CTRL_Stop_DiagSession();                          return; // 1041

        case cService_Control_Lamptest_On:              Routine_Lamptest_On_Trigger();                         return; // 1040
        case cService_Control_Lamptest_Off:             Routine_Lamptest_Off_Trigger();                        return; // 1041

        case cService_Control_Warp_Data_Vehicle_Write:  Warp_Data_Vehicle_Write_Trigger();                     return; // 1201
        case cService_Control_Warp_Data_Clear_Vehicle_Write: Warp_Data_Clear_Vehicle_Write_Trigger();                       return; // 1202
        case cService_Control_Warp_Data_Clear_HUD_Write: Warp_Data_Clear_HUD_Write_Trigger();                       return; // 1202
        case cService_Control_Warp_Data_HUD_Write:      Warp_Data_HUD_Write_Trigger();                         return; // 1203

        case cService_Delay_Timer0100msec:              setTimer( tDelay_Timer,  100 ); bQueueWaitForResponce = TRUE; DiagAktion = cService_NOP; break;
        case cService_Delay_Timer0200msec:              setTimer( tDelay_Timer,  200 ); bQueueWaitForResponce = TRUE; DiagAktion = cService_NOP; break;
        case cService_Delay_Timer0250msec:              setTimer( tDelay_Timer,  250 ); bQueueWaitForResponce = TRUE; DiagAktion = cService_NOP; break; 
        case cService_Delay_Timer0500msec:              setTimer( tDelay_Timer,  500 ); bQueueWaitForResponce = TRUE; DiagAktion = cService_NOP; break;
        case cService_Delay_Timer1000msec:              setTimer( tDelay_Timer, 1000 ); bQueueWaitForResponce = TRUE; DiagAktion = cService_NOP; break;
        case cService_Delay_Timer2000msec:              setTimer( tDelay_Timer, 2000 ); bQueueWaitForResponce = TRUE; DiagAktion = cService_NOP; break;

        case cService_NOP:                              DIAG_CTRL_vStartNewService();                          return; // 65535
   }
}

DIAG_LOG_InsertCommandToQueue()
{
    DIAG_Queue_InsertCommand( cService_SessionLevelCheck_Supplier );
    DIAG_Queue_InsertCommand( cService_SessionLevel_Supplier );
    DIAG_Queue_InsertCommand( cService_SecLevel_Supplier );
    DIAG_Queue_InsertCommand( cService_Routine_ReadAC_All );
//    DIAG_Queue_InsertCommand( cService_Routine_ReadGC_All );
    ADC_InsertAllReadRawRequests();
    PWM_InsertAllReadRequests();
    DIAG_Queue_InsertCommand( cService_ControlLog_DataToFile );  // Save the aquired data to file
    DIAG_CTRL_vStartNewService();
}

void DIAG_LOG_OpenLogFile(void)
{
    char temp[64];
    byte bLength;
    byte bResult;
    byte acLineData[40];
    char cFileName[270];
    char cFilePath[250];
    char cHelp[270];
    long lResult;
    int iFileDialog;
    int i,j;

    iFileDialog = 1;
    if( !iFileDialog )
    {
        getValue( DIAG_LOG_LogFilePathName, cFilePath);
        getValue( DIAG_LOG_LogFileFileName, cFileName );
    }
    else
    {
        getValue( DIAG_LOG_LogFileDialog, cHelp );
        // cFilePath bestimmen
        for( i=elCount(cHelp)-1; i>0; i--)
        {
            if(cHelp[i] == '\\')
            {
                strncpy(cFilePath, cHelp, i+2 );
                j=0;
                i++;
                for( ; i<80; i++)
                    cFileName[j++] = cHelp[i];
                    break;
            }
        }
    }

    setWritePath( cFilePath );

    DIAG__lLogFileFileHandle = OpenFileWrite( cFileName, 3 );//open for write, existing file will be deleted
    if(  DIAG__lLogFileFileHandle != 0 ) 
    {
        DIAG_LOG__vLogPutStatusText( "FILE OPENED" );
        DIAG_LOG_vIncrementLifeCount(1);
        acLineData[0] = 0x0D;
        acLineData[1] = 0x0A;
        // hole aktuelle Zeit
        getLocalTimeString( temp );       // now timeBuffer contains for example. "Fri Aug 21 15:22:24 1998"
        for( i=2; i < 26;i++)    //                                                0  3  6  9  2  5  8  1 3   
        {
            acLineData[i] = temp[i-2];
        }
        acLineData[i] = 0x3B;   // write ";" to line
        i += 1;

        fileWriteBinaryBlock( acLineData, i, DIAG__lLogFileFileHandle );
        DIAG_LOG_WriteCRLFToLogfile();
    }
    else
    {
        DIAG_LOG__vLogPutStatusText( "ERROR: NOT ABLE TO OPEN FILE" );
        fileClose ( DIAG__lLogFileFileHandle );
    }
}

DIAG_LOG_SaveDataToFile()
{
    long tm[9];
    byte tempString[250];
    word wIndex = 0;

    DIAG_LOG_vIncrementLifeCount(1);
    getLocalTime( tm );   // now tm contains the following entries: tm[0] = 3; (seconds ) tm[1] = 51; (minutes ) tm[2] = 16; (hours )
    DIAG_LOG_WriteCRLFToLogfile();
    if( getValue( DIAG_ADC_Ch00Log ) )    DIAG_LOG_WriteEntryToLogfile( "ADC Raw CH 00:", wADCRaw[ 0] );    else    DIAG_LOG_WriteEmptyEntryToLogfile();
    if( getValue( DIAG_ADC_Ch01Log ) )    DIAG_LOG_WriteEntryToLogfile( "ADC Raw CH 01:", wADCRaw[ 1] );    else    DIAG_LOG_WriteEmptyEntryToLogfile();
    if( getValue( DIAG_ADC_Ch02Log ) )    DIAG_LOG_WriteEntryToLogfile( "ADC Raw CH 02:", wADCRaw[ 2] );    else    DIAG_LOG_WriteEmptyEntryToLogfile();
    if( getValue( DIAG_ADC_Ch03Log ) )    DIAG_LOG_WriteEntryToLogfile( "ADC Raw CH 03:", wADCRaw[ 3] );    else    DIAG_LOG_WriteEmptyEntryToLogfile();
    if( getValue( DIAG_ADC_Ch04Log ) )    DIAG_LOG_WriteEntryToLogfile( "ADC Raw CH 04:", wADCRaw[ 4] );    else    DIAG_LOG_WriteEmptyEntryToLogfile();
    if( getValue( DIAG_ADC_Ch05Log ) )    DIAG_LOG_WriteEntryToLogfile( "ADC Raw CH 05:", wADCRaw[ 5] );    else    DIAG_LOG_WriteEmptyEntryToLogfile();
    if( getValue( DIAG_ADC_Ch06Log ) )    DIAG_LOG_WriteEntryToLogfile( "ADC Raw CH 06:", wADCRaw[ 6] );    else    DIAG_LOG_WriteEmptyEntryToLogfile();
    if( getValue( DIAG_ADC_Ch07Log ) )    DIAG_LOG_WriteEntryToLogfile( "ADC Raw CH 07:", wADCRaw[ 7] );    else    DIAG_LOG_WriteEmptyEntryToLogfile();
    if( getValue( DIAG_ADC_Ch08Log ) )    DIAG_LOG_WriteEntryToLogfile( "ADC Raw CH 08:", wADCRaw[ 8] );    else    DIAG_LOG_WriteEmptyEntryToLogfile();
    if( getValue( DIAG_ADC_Ch09Log ) )    DIAG_LOG_WriteEntryToLogfile( "ADC Raw CH 09:", wADCRaw[ 9] );    else    DIAG_LOG_WriteEmptyEntryToLogfile();
    if( getValue( DIAG_ADC_Ch10Log ) )    DIAG_LOG_WriteEntryToLogfile( "ADC Raw CH 10:", wADCRaw[10] );    else    DIAG_LOG_WriteEmptyEntryToLogfile();
    if( getValue( DIAG_ADC_Ch11Log ) )    DIAG_LOG_WriteEntryToLogfile( "ADC Raw CH 11:", wADCRaw[11] );    else    DIAG_LOG_WriteEmptyEntryToLogfile();
    if( getValue( DIAG_ADC_Ch12Log ) )    DIAG_LOG_WriteEntryToLogfile( "ADC Raw CH 12:", wADCRaw[12] );    else    DIAG_LOG_WriteEmptyEntryToLogfile();
    if( getValue( DIAG_ADC_Ch13Log ) )    DIAG_LOG_WriteEntryToLogfile( "ADC Raw CH 13:", wADCRaw[13] );    else    DIAG_LOG_WriteEmptyEntryToLogfile();
    if( getValue( DIAG_ADC_Ch14Log ) )    DIAG_LOG_WriteEntryToLogfile( "ADC Raw CH 14:", wADCRaw[14] );    else    DIAG_LOG_WriteEmptyEntryToLogfile();
    if( getValue( DIAG_ADC_Ch15Log ) )    DIAG_LOG_WriteEntryToLogfile( "ADC Raw CH 15:", wADCRaw[15] );    else    DIAG_LOG_WriteEmptyEntryToLogfile();

    if( getValue( DIAG_MPS_LogActive ) )
    {
        DIAG_LOG_WriteEntryToLogfile( "MPSD Overtemp Warn:", ( getValue( DIAG_MPS_OverTempWarning )-1) );
        DIAG_LOG_WriteEntryToLogfile( "MPSD Overtemp:", ( getValue( DIAG_MPS_OverTemp )-1) );
    }
    else
    {
        DIAG_LOG_WriteEmptyEntryToLogfile();
        DIAG_LOG_WriteEmptyEntryToLogfile();
    }

    if( getValue( DIAG_DIO_AC_LogActive ) )
    {
        DIAG_LOG_WriteEntryToLogfile( "DIO AC P0",  ( rsBuf[ 2] * 256 ) + rsBuf[ 1] );
        DIAG_LOG_WriteEntryToLogfile( "AC P1",      ( rsBuf[ 6] * 256 ) + rsBuf[ 5] );
        DIAG_LOG_WriteEntryToLogfile( "AC P2",      ( rsBuf[10] * 256 ) + rsBuf[ 9] );
        DIAG_LOG_WriteEntryToLogfile( "AC P3",      ( rsBuf[14] * 256 ) + rsBuf[13] );
        DIAG_LOG_WriteEntryToLogfile( "AC P4",      ( rsBuf[18] * 256 ) + rsBuf[17] );
    }
    else
    {
        DIAG_LOG_WriteEmptyEntryToLogfile();
        DIAG_LOG_WriteEmptyEntryToLogfile();
        DIAG_LOG_WriteEmptyEntryToLogfile();
        DIAG_LOG_WriteEmptyEntryToLogfile();
        DIAG_LOG_WriteEmptyEntryToLogfile();
    }

    if( getValue( DIAG_DIO_GC_LogActive ) )
    {
        DIAG_LOG_WriteEntryToLogfile( "DIO GC P0",  ( rsBuf[ 2] * 256 ) + rsBuf[ 1] );
        DIAG_LOG_WriteEntryToLogfile( "GC P1",      ( rsBuf[ 6] * 256 ) + rsBuf[ 5] );
        DIAG_LOG_WriteEntryToLogfile( "GC P2",      ( rsBuf[10] * 256 ) + rsBuf[ 9] );
        DIAG_LOG_WriteEntryToLogfile( "GC P3",      ( rsBuf[14] * 256 ) + rsBuf[13] );
        DIAG_LOG_WriteEntryToLogfile( "GC P4",      ( rsBuf[18] * 256 ) + rsBuf[17] );
        DIAG_LOG_WriteEntryToLogfile( "GC P5",      ( rsBuf[22] * 256 ) + rsBuf[21] );
        DIAG_LOG_WriteEntryToLogfile( "GC P6",      ( rsBuf[26] * 256 ) + rsBuf[25] );
    }
    else
    {
        DIAG_LOG_WriteEmptyEntryToLogfile();
        DIAG_LOG_WriteEmptyEntryToLogfile();
        DIAG_LOG_WriteEmptyEntryToLogfile();
        DIAG_LOG_WriteEmptyEntryToLogfile();
        DIAG_LOG_WriteEmptyEntryToLogfile();
        DIAG_LOG_WriteEmptyEntryToLogfile();
        DIAG_LOG_WriteEmptyEntryToLogfile();
    }

//    DIAG_LOG_WriteCRLFToLogfile();

    if( getValue( DIAG_PWM_Ch00Log ) )    DIAG_LOG_WriteEntryToLogfile( "PWM Duty CH 00:", wPWMDuty[ 0] );    else    DIAG_LOG_WriteEmptyEntryToLogfile();
    if( getValue( DIAG_PWM_Ch01Log ) )    DIAG_LOG_WriteEntryToLogfile( "PWM Duty CH 01:", wPWMDuty[ 1] );    else    DIAG_LOG_WriteEmptyEntryToLogfile();
    if( getValue( DIAG_PWM_Ch02Log ) )    DIAG_LOG_WriteEntryToLogfile( "PWM Duty CH 02:", wPWMDuty[ 2] );    else    DIAG_LOG_WriteEmptyEntryToLogfile();
    if( getValue( DIAG_PWM_Ch03Log ) )    DIAG_LOG_WriteEntryToLogfile( "PWM Duty CH 03:", wPWMDuty[ 3] );    else    DIAG_LOG_WriteEmptyEntryToLogfile();
    if( getValue( DIAG_PWM_Ch04Log ) )    DIAG_LOG_WriteEntryToLogfile( "PWM Duty CH 04:", wPWMDuty[ 4] );    else    DIAG_LOG_WriteEmptyEntryToLogfile();
    if( getValue( DIAG_PWM_Ch05Log ) )    DIAG_LOG_WriteEntryToLogfile( "PWM Duty CH 05:", wPWMDuty[ 5] );    else    DIAG_LOG_WriteEmptyEntryToLogfile();
    if( getValue( DIAG_PWM_Ch06Log ) )    DIAG_LOG_WriteEntryToLogfile( "PWM Duty CH 06:", wPWMDuty[ 6] );    else    DIAG_LOG_WriteEmptyEntryToLogfile();
    if( getValue( DIAG_PWM_Ch07Log ) )    DIAG_LOG_WriteEntryToLogfile( "PWM Duty CH 07:", wPWMDuty[ 7] );    else    DIAG_LOG_WriteEmptyEntryToLogfile();
    if( getValue( DIAG_PWM_Ch08Log ) )    DIAG_LOG_WriteEntryToLogfile( "PWM Duty CH 08:", wPWMDuty[ 8] );    else    DIAG_LOG_WriteEmptyEntryToLogfile();
    if( getValue( DIAG_PWM_Ch09Log ) )    DIAG_LOG_WriteEntryToLogfile( "PWM Duty CH 09:", wPWMDuty[ 9] );    else    DIAG_LOG_WriteEmptyEntryToLogfile();
    if( getValue( DIAG_PWM_Ch10Log ) )    DIAG_LOG_WriteEntryToLogfile( "PWM Duty CH 10:", wPWMDuty[10] );    else    DIAG_LOG_WriteEmptyEntryToLogfile();
    if( getValue( DIAG_PWM_Ch11Log ) )    DIAG_LOG_WriteEntryToLogfile( "PWM Duty CH 11:", wPWMDuty[11] );    else    DIAG_LOG_WriteEmptyEntryToLogfile();
    if( getValue( DIAG_PWM_Ch12Log ) )    DIAG_LOG_WriteEntryToLogfile( "PWM Duty CH 12:", wPWMDuty[12] );    else    DIAG_LOG_WriteEmptyEntryToLogfile();

    bQueueWaitForResponce = FALSE;
    DiagAktion = 0;
    DIAG_CTRL_vStartNewService();
}

DIAG_LOG_WriteCRLFToLogfile()
{
    int i;
    char temp[64];
    byte bLength;
    byte bResult;
    byte acLineData[40];

    if( DIAG__lLogFileFileHandle != 0 ) 
    {   // nur wenn File offen ist !!!!
        acLineData[0] = 0x0D;
        acLineData[1] = 0x0A;
        // hole aktuelle Zeit
        getLocalTimeString( temp);       // now timeBuffer contains for example. "Fri Aug 21 15:22:24 1998"
        for( i=2; i < 10;i++)
        {
            acLineData[i] = temp[i+9];
        }
        acLineData[i] = 0x3B;   // write ";" to line
        i += 1;
        fileWriteBinaryBlock ( acLineData, i, DIAG__lLogFileFileHandle );
    }
}

DIAG_LOG_WriteEmptyEntryToLogfile()
{
    int i,j;
    char temp[20];
    byte bLength;
    byte bResult;
    byte acLineData[80];

    if(  DIAG__lLogFileFileHandle != 0 ) 
    {   // nur wenn File offen ist !!!!
        acLineData[0] = 0x3B;   // write ";" to line
        acLineData[1] = 0x3B;   // write ";" to line
        i = 2;
        fileWriteBinaryBlock ( acLineData, i, DIAG__lLogFileFileHandle );
    }
}

DIAG_LOG_WriteEntryToLogfile( char strLogDecriptor[], long value )
{
    int i,j;
    char temp[20];
    byte bLength;
    byte bResult;
    byte acLineData[80];

    if(  DIAG__lLogFileFileHandle != 0 ) 
    {   // nur wenn File offen ist !!!!
        bLength = strlen(strLogDecriptor);
        for( i=0; i < bLength;i++)
        {
            acLineData[i] = strLogDecriptor[i];
        }
        acLineData[i] = 0x3B;   // write ";" to line
        i += 1;
        ltoa( value, temp, 10 );
        bLength = strlen( temp);
        for(j=0; j < bLength;j++)
        {
            acLineData[i+j] = temp[j];
        }
        acLineData[i+j] = 0x3B;   // write ";" to line
        i = i+j+1;
        fileWriteBinaryBlock ( acLineData, i, DIAG__lLogFileFileHandle );
    }
}

void DIAG_LOG__vLogPutStatusText (char cText[])
{
    putValue( DIAG_LOG_LogFileStatusBar, cText );
}

void DIAG_LOG_vIncrementLifeCount( byte bMode )
{
    switch( bMode )
    {
        case 0: DIAG__iLogFileLifeCount = 0;            break;
        case 1: if( DIAG__iLogFileLifeCount < 2 )    DIAG__iLogFileLifeCount++;    else    DIAG__iLogFileLifeCount = 0;   break;
        default: DIAG__iLogFileLifeCount = 0;           break;
    }
    putValue( DIAG_LOG_LogFileLife, DIAG__iLogFileLifeCount );
}

word DIAG_Queue_GetNextCommand()
{
    byte bReturnValPos;
    if( bQueueActPos == bQueueLastCommand )
    {
//        write( "DIAG_Queue_GetNextCommand() wNewCommand : xxx   --> bQueueActPos == bQueueLastCommand!!  bQueueLastCommand : %d   bQueueActPos : %d  ",  bQueueLastCommand, bQueueActPos );
        return 0;
    }
    else
    {
        if( bQueueActPos == 255 )
            bQueueActPos = 0;
        else
            bQueueActPos += 1;
//        write( "DIAG_Queue_GetNextCommand() wNextCommand : %d   -->   bQueueActPos : %d  ", wQueue[ bQueueActPos ],  bQueueActPos );
        return wQueue[ bQueueActPos ];
    }
}

byte DIAG_Queue_InsertCommand( word wNewCommand )
{
    if( ( ( bQueueLastCommand + 1 ) & 0xff ) == bQueueActPos )
    {
        DIAG_CTRL_vStartNewService();
//        write( "DIAG_Queue_InsertCommand() wNewCommand : %d   --> Overflow  bQueueLastCommand : %d   bQueueActPos : %d  ", wNewCommand, bQueueLastCommand, bQueueActPos );
        return 1;   // Queue overflow -> Error
    }
    else
    {
        if( bQueueLastCommand == 255 )
        {
            wQueue[ 0 ] = wNewCommand;
//            write( "DIAG_Queue_InsertCommand() wNewCommand : %d   --> First Pos  bQueueLastCommand : %d   bQueueActPos : %d  ", wNewCommand, bQueueLastCommand, bQueueActPos );
            bQueueLastCommand = 0;
        }
        else
        {
            wQueue[ bQueueLastCommand + 1 ] = wNewCommand;
//            write( "DIAG_Queue_InsertCommand() wNewCommand : %d   --> Inserted  bQueueLastCommand : %d   bQueueActPos : %d  ", wNewCommand, bQueueLastCommand, bQueueActPos );
            bQueueLastCommand += 1;
        }
        DIAG_CTRL_vStartNewService();
        return 0;
    }
}

void DIAG_SendRequest( byte xxxPhys, long length )
{
     if( Buf_Diag)                                                       //Erweiterte Diagnose
     {
          PutValue( DHMI__PutBuffer, cleardata, 0);
          PutValue( DHMI__PutBuffer, rqBuf, length);
     }
    cancelTimer( tTesterPresentTimer );
    if( DiagnoseAktiv == 1 )
        setTimer( tTesterPresentTimer, TesterPresentTime );
     if( xxxPhys )
     {
         FuncEmpfang = 0;
         OSEKTL_DataReq(rqBuf, length);                              //Versenden der Daten
     }
     else
     {
          FuncEmpfang = 1;
          TempECU = OSEKTL_GetTxId();
          OSEKTL_SetTxId (0x441);               //Transmit ID setzen                 s.S.18
          OSEKTL_DataReq(rqBuf, length);                             //Versenden der Daten
          OSEKTL_SetTxId(TempECU);                                   //Transmit ID rücksetzen          s.S.18
     }
}

byte DIAG_bAsciiToHex (char CharBuffer[])
{
     byte bHexValue;
     
     if( ( CharBuffer[1] >= 0x30 ) && ( CharBuffer[1] <= 0x39 ) )
          bHexValue = CharBuffer[1] - 0x30;
     else
     {
          switch(CharBuffer[1])
          {
               case 'a':                    bHexValue = 0x0A;               break;
               case 'A':                    bHexValue = 0x0A;               break;
               case 'b':                    bHexValue = 0x0B;               break;
               case 'B':                    bHexValue = 0x0B;               break;
               case 'c':                    bHexValue = 0x0C;               break;
               case 'C':                    bHexValue = 0x0C;               break;
               case 'd':                    bHexValue = 0x0D;               break;
               case 'D':                    bHexValue = 0x0D;               break;
               case 'e':                    bHexValue = 0x0E;               break;
               case 'E':                    bHexValue = 0x0E;               break;
               case 'f':                    bHexValue = 0x0F;               break;
               case 'F':                    bHexValue = 0x0F;               break;
               default:                     bHexValue = 0x00;               break;
          }
     }
     if( ( CharBuffer[0] >= 0x30 ) && ( CharBuffer[0] <= 0x39 ) )
          bHexValue |= ((CharBuffer[0] - 0x30) << 4);
     else
     {
          switch(CharBuffer[0])
          {
               case 'a':                    bHexValue |= 0xA0;               break;
               case 'A':                    bHexValue |= 0xA0;               break;
               case 'b':                    bHexValue |= 0xB0;               break;
               case 'B':                    bHexValue |= 0xB0;               break;
               case 'c':                    bHexValue |= 0xC0;               break;
               case 'C':                    bHexValue |= 0xC0;               break;
               case 'd':                    bHexValue |= 0xD0;               break;
               case 'D':                    bHexValue |= 0xD0;               break;
               case 'e':                    bHexValue |= 0xE0;               break;
               case 'E':                    bHexValue |= 0xE0;               break;
               case 'f':                    bHexValue |= 0xF0;               break;
               case 'F':                    bHexValue |= 0xF0;               break;
               default:                     bHexValue |= 0x00;               break;
          }
     }
     return( bHexValue );
}

DIO_EvalReadCompareInput()
{
    if( rsBuf[0] == 0x63 )
    {
        putValue( DIAG_DIO_CompareInput0, ( rsBuf[1] & 0x01 ) );
        putValue( DIAG_DIO_CompareInput1, ( rsBuf[2] & 0x01 ) );
        DiagAktion = 0;
        bQueueWaitForResponce = FALSE;
        DIAG_CTRL_vStartNewService();
    }
    else
        if( AntwortAuswertung( 1, rsBuf[0], rsBuf[2]) )
        {
            DiagAktion = 0;
            bQueueWaitForResponce = FALSE;
            DIAG_CTRL_vStartNewService();
        }
}

DIO_EvalReadGC_All()
{
    if( rsBuf[0] == 0x63 )
    {
        putValue( DIAG_DIO_DataGC_P0, ( rsBuf[ 2] * 256 + rsBuf[ 1] ) );
        putValue( DIAG_DIO_DataGC_P1, ( rsBuf[ 6] * 256 + rsBuf[ 5] ) );
        putValue( DIAG_DIO_DataGC_P2, ( rsBuf[10] * 256 + rsBuf[ 9] ) );
        putValue( DIAG_DIO_DataGC_P3, ( rsBuf[14] * 256 + rsBuf[13] ) );
        putValue( DIAG_DIO_DataGC_P4, ( rsBuf[18] * 256 + rsBuf[17] ) );
        putValue( DIAG_DIO_DataGC_P5, ( rsBuf[22] * 256 + rsBuf[21] ) );
        putValue( DIAG_DIO_DataGC_P6, ( rsBuf[26] * 256 + rsBuf[25] ) );
        putValue( DIAG_DIO_StatusBar, "Successful" );
        if( rsBuf[ 1] & 0x01 )    putValue( DIAG_DIO_PL_P0_00, 2 );    else    putValue( DIAG_DIO_PL_P0_00, 1 );
        if( rsBuf[ 1] & 0x02 )            putValue( DIAG_DIO_PL_P0_01, 2 );        else            putValue( DIAG_DIO_PL_P0_01, 1 );
        if( rsBuf[ 1] & 0x04 )            putValue( DIAG_DIO_PL_P0_02, 2 );        else            putValue( DIAG_DIO_PL_P0_02, 1 );
        if( rsBuf[ 1] & 0x40 )            putValue( DIAG_DIO_PL_P0_06, 2 );        else            putValue( DIAG_DIO_PL_P0_06, 1 );
        if( rsBuf[ 1] & 0x80 )            putValue( DIAG_DIO_PL_P0_07, 2 );        else            putValue( DIAG_DIO_PL_P0_07, 1 );
        if( rsBuf[ 2] & 0x01 )            putValue( DIAG_DIO_PL_P0_08, 2 );        else            putValue( DIAG_DIO_PL_P0_08, 1 );
        if( rsBuf[ 2] & 0x02 )            putValue( DIAG_DIO_PL_P0_09, 2 );        else            putValue( DIAG_DIO_PL_P0_09, 1 );
        if( rsBuf[ 2] & 0x04 )            putValue( DIAG_DIO_PL_P0_10, 2 );        else            putValue( DIAG_DIO_PL_P0_10, 1 );
        if( rsBuf[ 2] & 0x80 )            putValue( DIAG_DIO_PL_P0_15, 2 );        else            putValue( DIAG_DIO_PL_P0_15, 1 );
        if( rsBuf[18] & 0x04 )            putValue( DIAG_DIO_PL_P4_10, 2 );        else            putValue( DIAG_DIO_PL_P4_10, 1 );
        if( rsBuf[18] & 0x08 )            putValue( DIAG_DIO_PL_P4_11, 2 );        else            putValue( DIAG_DIO_PL_P4_11, 1 );
        if( rsBuf[18] & 0x10 )            putValue( DIAG_DIO_PL_P4_12, 2 );        else            putValue( DIAG_DIO_PL_P4_12, 1 );
        if( rsBuf[21] & 0x08 )            putValue( DIAG_DIO_PL_P5_03, 2 );        else            putValue( DIAG_DIO_PL_P5_03, 1 );
        if( rsBuf[21] & 0x10 )            putValue( DIAG_DIO_PL_P5_04, 2 );        else            putValue( DIAG_DIO_PL_P5_04, 1 );
        if( rsBuf[21] & 0x20 )            putValue( DIAG_DIO_PL_P5_05, 2 );        else            putValue( DIAG_DIO_PL_P5_05, 1 );
        if( rsBuf[21] & 0x40 )            putValue( DIAG_DIO_PL_P5_06, 2 );        else            putValue( DIAG_DIO_PL_P5_06, 1 );
        if( rsBuf[22] & 0x04 )            putValue( DIAG_DIO_PL_P5_10, 2 );        else            putValue( DIAG_DIO_PL_P5_10, 1 );
        if( rsBuf[22] & 0x08 )            putValue( DIAG_DIO_PL_P5_11, 2 );        else            putValue( DIAG_DIO_PL_P5_11, 1 );
        if( rsBuf[22] & 0x10 )            putValue( DIAG_DIO_PL_P5_12, 2 );        else            putValue( DIAG_DIO_PL_P5_12, 1 );
        if( rsBuf[22] & 0x20 )            putValue( DIAG_DIO_PL_P5_13, 2 );        else            putValue( DIAG_DIO_PL_P5_13, 1 );
        if( rsBuf[22] & 0x40 )            putValue( DIAG_DIO_PL_P5_14, 2 );        else            putValue( DIAG_DIO_PL_P5_14, 1 );
        if( rsBuf[22] & 0x80 )            putValue( DIAG_DIO_PL_P5_15, 2 );        else            putValue( DIAG_DIO_PL_P5_15, 1 );
        if( rsBuf[25] & 0x01 )            putValue( DIAG_DIO_PL_P6_00, 2 );        else            putValue( DIAG_DIO_PL_P6_00, 1 );
        if( rsBuf[25] & 0x04 )            putValue( DIAG_DIO_PL_P6_02, 2 );        else            putValue( DIAG_DIO_PL_P6_02, 1 );
        if( rsBuf[25] & 0x20 )            putValue( DIAG_DIO_PL_P6_05, 2 );        else            putValue( DIAG_DIO_PL_P6_05, 1 );
        if( rsBuf[25] & 0x40 )            putValue( DIAG_DIO_PL_P6_06, 2 );        else            putValue( DIAG_DIO_PL_P6_06, 1 );
        if( rsBuf[25] & 0x80 )            putValue( DIAG_DIO_PL_P6_07, 2 );        else            putValue( DIAG_DIO_PL_P6_07, 1 );
    
        DiagAktion = 0;
        cancelTimer( tDIO_GC_TimeOutTimer );
        bQueueWaitForResponce = FALSE;
        DIAG_CTRL_vStartNewService();
    }	
    else
    {
        if( AntwortAuswertung( 1, rsBuf[0], rsBuf[2]) )
        {
            DiagAktion = 0;
            bQueueWaitForResponce = FALSE;
            cancelTimer( tDIO_GC_TimeOutTimer );
            DIAG_CTRL_vStartNewService();
        }
        else
        {
            cancelTimer( tDIO_GC_TimeOutTimer );
            setTimer( tDIO_GC_TimeOutTimer, TimeOut );
        }
    }
}

DIO_EvalReadPort0_17AC()
{
    if( rsBuf[0] == 0x63 )
    {
        putValue( DIAG_DIO_DataAC_P0,  ( ( rsBuf[ 2] * 256 ) + rsBuf[1] ) );
        putValue( DIAG_DIO_DataAC_P1,  ( ( rsBuf[ 6] * 256 ) + rsBuf[5] ) );
        putValue( DIAG_DIO_DataAC_P2,  ( ( rsBuf[10] * 256 ) + rsBuf[9] ) );
        putValue( DIAG_DIO_DataAC_P3,  ( ( rsBuf[14] * 256 ) + rsBuf[13] ) );
        putValue( DIAG_DIO_DataAC_P4,  ( ( rsBuf[18] * 256 ) + rsBuf[17] ) );
        putValue( DIAG_DIO_DataAC_P16, ( ( rsBuf[66] * 256 ) + rsBuf[65] ) );
        putValue( DIAG_DIO_DataAC_P17, ( ( rsBuf[70] * 256 ) + rsBuf[69] ) );
        putValue( DIAG_DIO_StatusBar, "Successful" );
        DiagAktion = 0;
    	cancelTimer( tDIO_AC_TimeOutTimer );
        bQueueWaitForResponce = FALSE;
    // separate the individul pin-signals
        putValue( DIAG_DIO_ML_P0_00,  ( rsBuf[1] & 0x01 ) ? 2 : 1 );
//      putValue( DIAG_DIO_ML_P0_01,  ( rsBuf[1] & 0x02 ) ? 2 : 1 );
        putValue( DIAG_DIO_ML_P0_02,  ( rsBuf[1] & 0x04 ) ? 2 : 1 );
        putValue( DIAG_DIO_ML_P0_03,  ( rsBuf[1] & 0x08 ) ? 2 : 1 );
        putValue( DIAG_DIO_ML_P0_04,  ( rsBuf[1] & 0x10 ) ? 2 : 1 );
        putValue( DIAG_DIO_ML_P0_05,  ( rsBuf[1] & 0x20 ) ? 2 : 1 );
//      putValue( DIAG_DIO_ML_P0_06,  ( rsBuf[1] & 0x40 ) ? 2 : 1 );
//      putValue( DIAG_DIO_ML_P0_07,  ( rsBuf[1] & 0x80 ) ? 2 : 1 );
//      putValue( DIAG_DIO_ML_P0_08,  ( rsBuf[2] & 0x01 ) ? 2 : 1 );
//      putValue( DIAG_DIO_ML_P0_09,  ( rsBuf[2] & 0x02 ) ? 2 : 1 );
        putValue( DIAG_DIO_ML_P0_10,  ( rsBuf[2] & 0x04 ) ? 2 : 1 );
        putValue( DIAG_DIO_ML_P0_11,  ( rsBuf[2] & 0x08 ) ? 2 : 1 );
        putValue( DIAG_DIO_ML_P0_12,  ( rsBuf[2] & 0x10 ) ? 2 : 1 );
        putValue( DIAG_DIO_ML_P0_13,  ( rsBuf[2] & 0x20 ) ? 2 : 1 );
        putValue( DIAG_DIO_ML_P0_14,  ( rsBuf[2] & 0x40 ) ? 2 : 1 );
        putValue( DIAG_DIO_ML_P0_15,  ( rsBuf[2] & 0x80 ) ? 2 : 1 ); 

        putValue( DIAG_DIO_ML_P1_01,  ( rsBuf[5] & 0x02 ) ? 2 : 1 );
        putValue( DIAG_DIO_ML_P1_02,  ( rsBuf[5] & 0x04 ) ? 2 : 1 );
        putValue( DIAG_DIO_ML_P1_04,  ( rsBuf[5] & 0x10 ) ? 2 : 1 );
        putValue( DIAG_DIO_ML_P1_05,  ( rsBuf[5] & 0x20 ) ? 2 : 1 );
        putValue( DIAG_DIO_ML_P1_06,  ( rsBuf[5] & 0x40 ) ? 2 : 1 );
        putValue( DIAG_DIO_ML_P1_08,  ( rsBuf[6] & 0x01 ) ? 2 : 1 );
        putValue( DIAG_DIO_ML_P1_09,  ( rsBuf[6] & 0x02 ) ? 2 : 1 );
        putValue( DIAG_DIO_ML_P1_10,  ( rsBuf[6] & 0x04 ) ? 2 : 1 );
        putValue( DIAG_DIO_ML_P1_11,  ( rsBuf[6] & 0x08 ) ? 2 : 1 );
        putValue( DIAG_DIO_ML_P1_12,  ( rsBuf[6] & 0x10 ) ? 2 : 1 );
        putValue( DIAG_DIO_ML_P1_13,  ( rsBuf[6] & 0x20 ) ? 2 : 1 );
        putValue( DIAG_DIO_ML_P1_14,  ( rsBuf[6] & 0x40 ) ? 2 : 1 );
        putValue( DIAG_DIO_ML_P1_15,  ( rsBuf[6] & 0x80 ) ? 2 : 1 );

        putValue( DIAG_DIO_ML_P2_00,  ( rsBuf[9] & 0x01 ) ? 2 : 1 );

        putValue( DIAG_DIO_ML_P3_00,  ( rsBuf[13] & 0x01 ) ? 2 : 1 );
        putValue( DIAG_DIO_ML_P3_01,  ( rsBuf[13] & 0x02 ) ? 2 : 1 );
        putValue( DIAG_DIO_ML_P3_02,  ( rsBuf[13] & 0x04 ) ? 2 : 1 );
        putValue( DIAG_DIO_ML_P3_03,  ( rsBuf[13] & 0x08 ) ? 2 : 1 );
//      putValue( DIAG_DIO_ML_P3_04,  ( rsBuf[13] & 0x10 ) ? 2 : 1 );
        putValue( DIAG_DIO_ML_P3_05,  ( rsBuf[13] & 0x20 ) ? 2 : 1 );
        putValue( DIAG_DIO_ML_P3_06,  ( rsBuf[13] & 0x40 ) ? 2 : 1 );
        putValue( DIAG_DIO_ML_P3_07,  ( rsBuf[13] & 0x80 ) ? 2 : 1 );
        putValue( DIAG_DIO_ML_P3_08,  ( rsBuf[14] & 0x01 ) ? 2 : 1 );
        putValue( DIAG_DIO_ML_P3_09,  ( rsBuf[14] & 0x02 ) ? 2 : 1 );
        putValue( DIAG_DIO_ML_P3_10,  ( rsBuf[14] & 0x04 ) ? 2 : 1 );
        putValue( DIAG_DIO_ML_P3_11,  ( rsBuf[14] & 0x08 ) ? 2 : 1 );
        putValue( DIAG_DIO_ML_P3_12,  ( rsBuf[14] & 0x10 ) ? 2 : 1 );
//      putValue( DIAG_DIO_ML_P3_13,  ( rsBuf[14] & 0x20 ) ? 2 : 1 );
//      putValue( DIAG_DIO_ML_P3_14,  ( rsBuf[14] & 0x40 ) ? 2 : 1 );
//      putValue( DIAG_DIO_ML_P3_15,  ( rsBuf[14] & 0x80 ) ? 2 : 1 ); 

        putValue( DIAG_DIO_ML_P4_00,  ( rsBuf[17] & 0x01 ) ? 2 : 1 );
        putValue( DIAG_DIO_ML_P4_01,  ( rsBuf[17] & 0x02 ) ? 2 : 1 );
        putValue( DIAG_DIO_ML_P4_02,  ( rsBuf[17] & 0x04 ) ? 2 : 1 );
        putValue( DIAG_DIO_ML_P4_04,  ( rsBuf[17] & 0x10 ) ? 2 : 1 );
        putValue( DIAG_DIO_ML_P4_05,  ( rsBuf[17] & 0x20 ) ? 2 : 1 );
        putValue( DIAG_DIO_ML_P4_10,  ( rsBuf[18] & 0x04 ) ? 2 : 1 );
        putValue( DIAG_DIO_ML_P4_11,  ( rsBuf[18] & 0x08 ) ? 2 : 1 );

        putValue( DIAG_DIO_ML_P16_04, ( rsBuf[65] & 0x10 ) ? 2 : 1 );
        putValue( DIAG_DIO_ML_P16_05, ( rsBuf[65] & 0x20 ) ? 2 : 1 );
        putValue( DIAG_DIO_ML_P16_06, ( rsBuf[65] & 0x40 ) ? 2 : 1 );
        putValue( DIAG_DIO_ML_P16_07, ( rsBuf[65] & 0x80 ) ? 2 : 1 );
        putValue( DIAG_DIO_ML_P16_10, ( rsBuf[66] & 0x04 ) ? 2 : 1 );

        putValue( DIAG_DIO_ML_P17_10, ( rsBuf[70] & 0x04 ) ? 2 : 1 );
        putValue( DIAG_DIO_ML_P17_11, ( rsBuf[70] & 0x08 ) ? 2 : 1 );

        DIAG_CTRL_vStartNewService();
    }	
    else
    {
        if( AntwortAuswertung( 1, rsBuf[0], rsBuf[2]) )
        {
            DiagAktion = 0;
            cancelTimer( tDIO_AC_TimeOutTimer );
            bQueueWaitForResponce = FALSE;
            DIAG_CTRL_vStartNewService();
        }
        else
        {
            cancelTimer( tDIO_AC_TimeOutTimer );
            setTimer( tDIO_AC_TimeOutTimer, TimeOut );
        }
    }
}

DIO_EvalReadPortx()
{
// ACHTUNG !!! nur für WritePort-befehle werden hier die Inhalte des PORT ( AUSGANGS !!!!! - ) Registers eingelesen.
//  Porteingänge MÜSSEN über PPR-Register per MRW gelesen werden !!!!!

    if( ( rsBuf[0] == 0x71 ) &&
        ( rsBuf[1] == 0x01 ) &&
        ( rsBuf[2] == 0xF0 ) &&
        ( rsBuf[3] == 0x04 )    )
    {
        putValue( DIAG_DIO_StatusBar, "Successful" );
        DiagAktion = 0;
        cancelTimer( tDIO_AC_TimeOutTimer );
        bQueueWaitForResponce = FALSE;
        // separate the individul pin-signals
        if( bDIO_ActualRq_Port == 0x00 )
        {
            putValue( DIAG_DIO_ML_P0_Data, ( ( rsBuf[ 4 ] * 256 ) + rsBuf[ 5 ] ) );
            putValue( DIAG_DIO_ML_P0_Dir,  ( ( rsBuf[ 6 ] * 256 ) + rsBuf[ 7 ] ) );
        } 
        if( bDIO_ActualRq_Port == 0x01 )
        {
            putValue( DIAG_DIO_ML_P1_Data, ( ( rsBuf[ 4 ] * 256 ) + rsBuf[ 5 ] ) );
            putValue( DIAG_DIO_ML_P1_Dir,  ( ( rsBuf[ 6 ] * 256 ) + rsBuf[ 7 ] ) );
        } 
        if( bDIO_ActualRq_Port == 0x02 )
        {
            putValue( DIAG_DIO_ML_P2_Data, ( ( rsBuf[ 4 ] * 256 ) + rsBuf[ 5 ] ) );
            putValue( DIAG_DIO_ML_P2_Dir,  ( ( rsBuf[ 6 ] * 256 ) + rsBuf[ 7 ] ) );
        } 
        if( bDIO_ActualRq_Port == 0x03 )
        {
            putValue( DIAG_DIO_ML_P3_Data, ( ( rsBuf[ 4 ] * 256 ) + rsBuf[ 5 ] ) );
            putValue( DIAG_DIO_ML_P3_Dir,  ( ( rsBuf[ 6 ] * 256 ) + rsBuf[ 7 ] ) );
        } 
        if( bDIO_ActualRq_Port == 0x04 )
        {
            putValue( DIAG_DIO_ML_P4_Data, ( ( rsBuf[ 4 ] * 256 ) + rsBuf[ 5 ] ) );
            putValue( DIAG_DIO_ML_P4_Dir,  ( ( rsBuf[ 6 ] * 256 ) + rsBuf[ 7 ] ) );
        } 
        if( bDIO_ActualRq_Port == 0x06 )
        {
            putValue( DIAG_DIO_ML_P16_Data, ( ( rsBuf[ 4 ] * 256 ) + rsBuf[ 5 ] ) );
            putValue( DIAG_DIO_ML_P16_Dir,  ( ( rsBuf[ 6 ] * 256 ) + rsBuf[ 7 ] ) );
        } 
        if( bDIO_ActualRq_Port == 0x07 )
        {
            putValue( DIAG_DIO_ML_P17_Data, ( ( rsBuf[ 4 ] * 256 ) + rsBuf[ 5 ] ) );
            putValue( DIAG_DIO_ML_P17_Dir,  ( ( rsBuf[ 6 ] * 256 ) + rsBuf[ 7 ] ) );
        } 
        if( bDIO_ActualRq_Port == 0x10 )
        {
            putValue( DIAG_DIO_PL_P0_Data, ( ( rsBuf[ 4 ] * 256 ) + rsBuf[ 5 ] ) );
            putValue( DIAG_DIO_PL_P0_Dir,  ( ( rsBuf[ 6 ] * 256 ) + rsBuf[ 7 ] ) );
            putValue( DIAG_DIO_PL_P0_15, ( rsBuf[4] & 0x80 ) ?  2 : 1 );
        } 
        if( bDIO_ActualRq_Port == 0x11 )
        {
            putValue( DIAG_DIO_PL_P1_Data, ( ( rsBuf[ 4 ] * 256 ) + rsBuf[ 5 ] ) );
            putValue( DIAG_DIO_PL_P1_Dir,  ( ( rsBuf[ 6 ] * 256 ) + rsBuf[ 7 ] ) );
        } 
        if( bDIO_ActualRq_Port == 0x12 )
        {
            putValue( DIAG_DIO_PL_P2_Data, ( ( rsBuf[ 4 ] * 256 ) + rsBuf[ 5 ] ) );
            putValue( DIAG_DIO_PL_P2_Dir,  ( ( rsBuf[ 6 ] * 256 ) + rsBuf[ 7 ] ) );
        } 
        if( bDIO_ActualRq_Port == 0x13 )
        {
            putValue( DIAG_DIO_PL_P3_Data, ( ( rsBuf[ 4 ] * 256 ) + rsBuf[ 5 ] ) );
            putValue( DIAG_DIO_PL_P3_Dir,  ( ( rsBuf[ 6 ] * 256 ) + rsBuf[ 7 ] ) );
        } 
        if( bDIO_ActualRq_Port == 0x14 )
        {
            putValue( DIAG_DIO_PL_P4_Data, ( ( rsBuf[ 4 ] * 256 ) + rsBuf[ 5 ] ) );
            putValue( DIAG_DIO_PL_P4_Dir,  ( ( rsBuf[ 6 ] * 256 ) + rsBuf[ 7 ] ) );
        } 
        if( bDIO_ActualRq_Port == 0x15 )
        {
            putValue( DIAG_DIO_PL_P5_Data, ( ( rsBuf[ 4 ] * 256 ) + rsBuf[ 5 ] ) );
            putValue( DIAG_DIO_PL_P5_Dir,  ( ( rsBuf[ 6 ] * 256 ) + rsBuf[ 7 ] ) );
        } 
        if( bDIO_ActualRq_Port == 0x16 )
        {
            putValue( DIAG_DIO_PL_P6_Data, ( ( rsBuf[ 4 ] * 256 ) + rsBuf[ 5 ] ) );
            putValue( DIAG_DIO_PL_P6_Dir,  ( ( rsBuf[ 6 ] * 256 ) + rsBuf[ 7 ] ) );
        } 
         DIAG_CTRL_vStartNewService();
    }
    else
    {
        if( AntwortAuswertung( 1, rsBuf[0], rsBuf[2]) )
        {
            DiagAktion = 0;
            cancelTimer( tDIO_AC_TimeOutTimer );
            bQueueWaitForResponce = FALSE;
            DIAG_CTRL_vStartNewService();
        }
        else
        {
           cancelTimer( tDIO_AC_TimeOutTimer );
           setTimer( tDIO_AC_TimeOutTimer, TimeOut );
        }
    }
}

DIO_ReadAC_AllTrigger()
{
    dword adresse;
    
    DiagAktion = 0;
    if( FillCommand( ServicePhys ) ) return;
    {
        adresse = DIAG__cdwMRWStartAdr_AC_PBUS + 0x200;
        rqBuf[0] = 0x23;
        rqBuf[1] = 0x14;
        rqBuf[2] = ( adresse & 0xFF000000 ) >> 24;
        rqBuf[3] = ( adresse & 0x00FF0000 ) >> 16;
        rqBuf[4] = ( adresse & 0x0000FF00 ) >> 8;
        rqBuf[5] = ( adresse & 0x000000FF );
        rqBuf[6] = 0x48;
        DIAG_SendRequest( SessionPhys, 7);
    }
    DiagAktion = cService_Routine_ReadAC_All;
    bQueueWaitForResponce = TRUE;
    putValue( DIAG_DIO_StatusBar, "Warte auf Antwort..." );
    setTimer( tDIO_AC_TimeOutTimer, TimeOutMid);
}

DIO_ReadGC_All_Trigger()
{
    dword adresse;
    
    DiagAktion = 0;
    if( FillCommand( ServicePhys ) ) return;
    {
        adresse = DIAG__cdwMRWStartAdr_GC_PBUS + 0x200;
        rqBuf[0] = 0x23;
        rqBuf[1] = 0x14;
        rqBuf[2] = ( adresse & 0xFF000000 ) >> 24;
        rqBuf[3] = ( adresse & 0x00FF0000 ) >> 16;
        rqBuf[4] = ( adresse & 0x0000FF00 ) >> 8;
        rqBuf[5] = ( adresse & 0x000000FF );
        rqBuf[6] = 0x1C;
        DIAG_SendRequest( SessionPhys, 7);
    }
    DiagAktion = cService_Routine_ReadGC_All;
    bQueueWaitForResponce = TRUE;
    putValue( DIAG_DIO_StatusBar, "Warte auf Antwort..." );
    setTimer( tDIO_GC_TimeOutTimer, TimeOutMid);
}

DIO_ReadPx_Trigger( byte channel )
{
    dword adresse;
    
    DiagAktion = 0;
    if( FillCommand( ServicePhys ) ) return;
    {
        rqBuf[0] = 0x31;
        rqBuf[1] = 0x01;
        rqBuf[2] = 0xF0;
        rqBuf[3] = 0x04;
        rqBuf[4] = channel;  
        bDIO_ActualRq_Port = channel;
        DIAG_SendRequest( SessionPhys, 5);
    }
    DiagAktion = cService_Routine_ReadPx;
    bQueueWaitForResponce = TRUE;
    putValue( DIAG_DIO_StatusBar, "Warte auf Antwort..." );
    setTimer( tDIO_AC_TimeOutTimer, TimeOutMid);
}

DIO_WriteAC_P0_Eval()
{
    word wTemp;
    dword adresse;

    if( rsBuf[0] == 0x6E )
    {
        DiagAktion = 0;
        cancelTimer( tDIO_AC_TimeOutTimer );
        bQueueWaitForResponce = FALSE;
        putValue( DIAG_DIO_StatusBar, "Successful" );
        DIAG_CTRL_vStartNewService();
    }
    else
    {
        if( AntwortAuswertung( 1, rsBuf[0], rsBuf[2]) )
        {
            DiagAktion = 0;
            cancelTimer( tDIO_AC_TimeOutTimer );
            bQueueWaitForResponce = FALSE;
            putValue( DIAG_DIO_StatusBar, "negativ responce" );
            DIAG_CTRL_vStartNewService();
        }
        else
        {
            cancelTimer( tDIO_AC_TimeOutTimer );
            setTimer( tDIO_AC_TimeOutTimer, TimeOut );
        }
    }
}

DIO_WriteAC_P0_Trigger()
{
    word wTemp = 0;
    byte IsW222 = 0;
    byte IsW205 = 0;
    
    DiagAktion = 0;
    if( FillCommand( ServicePhys  ) ) return;
    {
        rqBuf[0] = 0x2E;
        rqBuf[1] = 0xFD;
        rqBuf[2] = 0x01;
        rqBuf[3] = 0x00;    // Portnummer
        if( getValue( DIAG_CTRL_IC_Type_Selector ) == cKI_W222 )
        {   // W222
            IsW222 = 1;
            rqBuf[4] = 0x80;    // Mask Data
            rqBuf[5] = 0x3C;    // Mask Data
        }
        else
        {   // W205
            IsW205 = 1;
            rqBuf[4] = 0x80;    // Mask Data
            rqBuf[5] = 0x3D;    // Mask Data
        }
        wTemp = 0;
        if( IsW205 )    wTemp =         ( ( getValue( DIAG_DIO_ML_P0_00 ) - 1 )       );
                        wTemp = wTemp + ( ( getValue( DIAG_DIO_ML_P0_02 ) - 1 ) << 02 );
                        wTemp = wTemp + ( ( getValue( DIAG_DIO_ML_P0_03 ) - 1 ) << 03 );
                        wTemp = wTemp + ( ( getValue( DIAG_DIO_ML_P0_04 ) - 1 ) << 04 );
                        wTemp = wTemp + ( ( getValue( DIAG_DIO_ML_P0_05 ) - 1 ) << 05 );
                        wTemp = wTemp + ( ( getValue( DIAG_DIO_ML_P0_15 ) - 1 ) << 15 );
        rqBuf[6] = ( byte )( wTemp >> 8 );    // Port Data
        rqBuf[7] = ( byte )( wTemp & 0xFF );    // Port Data
        rqBuf[8] = ( byte )( getValue( DIAG_DIO_ML_P0_Dir ) >> 8 );    // Port Data
        rqBuf[9] = ( byte )( getValue( DIAG_DIO_ML_P0_Dir ) & 0xFF );    // Port Data
        DIAG_SendRequest( SessionPhys, 10);
    }
    DiagAktion = cService_Routine_WriteAC_Px;
    bQueueWaitForResponce = TRUE;
    putValue( DIAG_DIO_StatusBar, "Warte auf Antwort..." );
    setTimer( tDIO_AC_TimeOutTimer, TimeOutMid);
}

DIO_WriteAC_P1_Eval()
{
    word wTemp;
    dword adresse;

    if( rsBuf[0] == 0x6E )
    {
        DiagAktion = 0;
        cancelTimer( tDIO_AC_TimeOutTimer );
        bQueueWaitForResponce = FALSE;
        putValue( DIAG_DIO_StatusBar, "Successful" );
        DIAG_CTRL_vStartNewService();
    }
    else
    {
        if( AntwortAuswertung( 1, rsBuf[0], rsBuf[2]) )
        {
            DiagAktion = 0;
            cancelTimer( tDIO_AC_TimeOutTimer );
            bQueueWaitForResponce = FALSE;
            putValue( DIAG_DIO_StatusBar, "negativ responce" );
            DIAG_CTRL_vStartNewService();
        }
        else
        {
            cancelTimer( tDIO_AC_TimeOutTimer );
            setTimer( tDIO_AC_TimeOutTimer, TimeOut );
        }
    }
}

DIO_WriteAC_P1_Trigger()
{
    word wTemp = 0;
    byte IsW222 = 0;
    byte IsW205 = 0;
    
    DiagAktion = 0;
    if( FillCommand( ServicePhys ) ) return;
    {
        rqBuf[0] = 0x2E;
        rqBuf[1] = 0xFD;
        rqBuf[2] = 0x01;
        rqBuf[3] = 0x01;    // Portnummer
        if( getValue( DIAG_CTRL_IC_Type_Selector ) == cKI_W222 )
        {   // W222
            IsW222 = 1;
            rqBuf[4] = 0xE4;    // Mask Data
            rqBuf[5] = 0x00;    // Mask Data
        }
        else
        {   // W205
            IsW205 = 1;
            rqBuf[4] = 0xE5;    // Mask Data
            rqBuf[5] = 0x00;    // Mask Data
        }
        wTemp = 0;
        if( IsW205 )    wTemp = wTemp + ( ( getValue( DIAG_DIO_ML_P1_08 ) - 1 ) << 08 );
                        wTemp = wTemp + ( ( getValue( DIAG_DIO_ML_P1_10 ) - 1 ) << 10 );
                        wTemp = wTemp + ( ( getValue( DIAG_DIO_ML_P1_13 ) - 1 ) << 13 );
                        wTemp = wTemp + ( ( getValue( DIAG_DIO_ML_P1_14 ) - 1 ) << 14 );
                        wTemp = wTemp + ( ( getValue( DIAG_DIO_ML_P1_15 ) - 1 ) << 15 );
        rqBuf[6] = ( byte )( wTemp >> 8 );    // Port Data
        rqBuf[7] = ( byte )( wTemp & 0xFF );    // Port Data
        rqBuf[8] = ( byte )( getValue( DIAG_DIO_ML_P1_Dir ) >> 8 );    // Port Data
        rqBuf[9] = ( byte )( getValue( DIAG_DIO_ML_P1_Dir ) & 0xFF );    // Port Data
        DIAG_SendRequest( SessionPhys, 10);
    }
    DiagAktion = cService_Routine_WriteAC_Px;
    bQueueWaitForResponce = TRUE;
    putValue( DIAG_DIO_StatusBar, "Warte auf Antwort..." );
    setTimer( tDIO_AC_TimeOutTimer, TimeOutMid);
}

DIO_WriteAC_P2_Eval()
{
    word wTemp;
    dword adresse;

    if( rsBuf[0] == 0x6E )
    {
        DiagAktion = 0;
        cancelTimer( tDIO_AC_TimeOutTimer );
        bQueueWaitForResponce = FALSE;
        putValue( DIAG_DIO_StatusBar, "Successful" );
        DIAG_CTRL_vStartNewService();
    }
    else
    {
        if( AntwortAuswertung( 1, rsBuf[0], rsBuf[2]) )
        {
            DiagAktion = 0;
            cancelTimer( tDIO_AC_TimeOutTimer );
            bQueueWaitForResponce = FALSE;
            putValue( DIAG_DIO_StatusBar, "negativ responce" );
            DIAG_CTRL_vStartNewService();
        }
        else
        {
            cancelTimer( tDIO_AC_TimeOutTimer );
            setTimer( tDIO_AC_TimeOutTimer, TimeOut );
        }
    }
}

DIO_WriteAC_P2_Trigger()
{
    word wTemp = 0;
    byte IsW222 = 0;
    byte IsW205 = 0;
    
    DiagAktion = 0;
    if( FillCommand( ServicePhys ) ) return;
    {
        rqBuf[0] = 0x2E;
        rqBuf[1] = 0xFD;
        rqBuf[2] = 0x01;
        rqBuf[3] = 0x02;
        if( getValue( DIAG_CTRL_IC_Type_Selector ) == cKI_W222 )
        {   // W222
            IsW222 = 1;
            rqBuf[4] = 0x00;    // Mask Data
            rqBuf[5] = 0x01;    // Mask Data
        }
        else
        {   // W205
            IsW205 = 1;
            rqBuf[4] = 0x00;    // Mask Data
            rqBuf[5] = 0x00;    // Mask Data
        }
        wTemp = 0;
        if( IsW222 )    wTemp =         ( ( getValue( DIAG_DIO_ML_P2_00 ) - 1 ) );
        rqBuf[6] = ( byte )( wTemp >> 8 );    // Port Data
        rqBuf[7] = ( byte )( wTemp & 0xFF );    // Port Data
        rqBuf[8] = ( byte )( getValue( DIAG_DIO_ML_P2_Dir ) >> 8 );    // Port Data
        rqBuf[9] = ( byte )( getValue( DIAG_DIO_ML_P2_Dir ) & 0xFF );    // Port Data
        DIAG_SendRequest( SessionPhys, 8);
    }
    DiagAktion = cService_Routine_WriteAC_P2;
    bQueueWaitForResponce = TRUE;
    putValue( DIAG_DIO_StatusBar, "Warte auf Antwort..." );
    setTimer( tDIO_AC_TimeOutTimer, TimeOutMid);
}

DIO_WriteAC_P3_Eval()
{
    word wTemp;
    dword adresse;

    if( rsBuf[0] == 0x6E )
    {
        DiagAktion = 0;
        cancelTimer( tDIO_AC_TimeOutTimer );
        bQueueWaitForResponce = FALSE;
        putValue( DIAG_DIO_StatusBar, "Successful" );
        DIAG_CTRL_vStartNewService();
    }
    else
    {
        if( AntwortAuswertung( 1, rsBuf[0], rsBuf[2]) )
        {
            DiagAktion = 0;
            cancelTimer( tDIO_AC_TimeOutTimer );
            bQueueWaitForResponce = FALSE;
            putValue( DIAG_DIO_StatusBar, "negativ responce" );
            DIAG_CTRL_vStartNewService();
        }
        else
        {
            cancelTimer( tDIO_AC_TimeOutTimer );
            setTimer( tDIO_AC_TimeOutTimer, TimeOut );
        }
    }
}

DIO_WriteAC_P3_Trigger()
{
    word wTemp = 0;
    byte IsW222 = 0;
    byte IsW205 = 0;
    
    DiagAktion = 0;
    if( FillCommand( ServicePhys ) ) return;
    {
        rqBuf[0] = 0x2E;
        rqBuf[1] = 0xFD;
        rqBuf[2] = 0x01;
        rqBuf[3] = 0x03;    // Portnummer
        if( getValue( DIAG_CTRL_IC_Type_Selector ) == cKI_W222 )
        {   // W222
            IsW222 = 1;
            rqBuf[4] = 0x18;    // Mask Data
            rqBuf[5] = 0x20;    // Mask Data
        }
        else
        {   // W205
            IsW205 = 1;
            rqBuf[4] = 0x12;    // Mask Data
            rqBuf[5] = 0x6F;    // Mask Data
        }
        wTemp = 0;
        if( IsW205 )    wTemp = wTemp + ( ( getValue( DIAG_DIO_ML_P3_00 ) - 1 ) << 00 );
        if( IsW205 )    wTemp = wTemp + ( ( getValue( DIAG_DIO_ML_P3_01 ) - 1 ) << 01 );
        if( IsW205 )    wTemp = wTemp + ( ( getValue( DIAG_DIO_ML_P3_02 ) - 1 ) << 02 );
        if( IsW205 )    wTemp = wTemp + ( ( getValue( DIAG_DIO_ML_P3_03 ) - 1 ) << 03 );
                        wTemp = wTemp + ( ( getValue( DIAG_DIO_ML_P3_05 ) - 1 ) << 05 );
        if( IsW205 )    wTemp = wTemp + ( ( getValue( DIAG_DIO_ML_P3_06 ) - 1 ) << 06 );
        if( IsW205 )    wTemp = wTemp + ( ( getValue( DIAG_DIO_ML_P3_09 ) - 1 ) << 09 );
        if( IsW222 )    wTemp = wTemp + ( ( getValue( DIAG_DIO_ML_P3_11 ) - 1 ) << 11 );
                        wTemp = wTemp + ( ( getValue( DIAG_DIO_ML_P3_12 ) - 1 ) << 12 );
        rqBuf[6] = ( byte )( wTemp >> 8 );    // Port Data
        rqBuf[7] = ( byte )( wTemp & 0xFF );    // Port Data
        rqBuf[8] = ( byte )( getValue( DIAG_DIO_ML_P3_Dir ) >> 8 );    // Port Data
        rqBuf[9] = ( byte )( getValue( DIAG_DIO_ML_P3_Dir ) & 0xFF );    // Port Data
        DIAG_SendRequest( SessionPhys, 10);
    }
    DiagAktion = cService_Routine_WriteAC_Px;
    bQueueWaitForResponce = TRUE;
    putValue( DIAG_DIO_StatusBar, "Warte auf Antwort..." );
    setTimer( tDIO_AC_TimeOutTimer, TimeOutMid);
}

DIO_WriteAC_P4_Eval()
{
    word wTemp;
    dword adresse;

    if( rsBuf[0] == 0x6E )
    {
        DiagAktion = 0;
        cancelTimer( tDIO_AC_TimeOutTimer );
        bQueueWaitForResponce = FALSE;
        putValue( DIAG_DIO_StatusBar, "Successful" );
        DIAG_CTRL_vStartNewService();
    }
    else
    {
        if( AntwortAuswertung( 1, rsBuf[0], rsBuf[2]) )
        {
            DiagAktion = 0;
            cancelTimer( tDIO_AC_TimeOutTimer );
            bQueueWaitForResponce = FALSE;
            putValue( DIAG_DIO_StatusBar, "negativ responce" );
            DIAG_CTRL_vStartNewService();
        }
        else
        {
            cancelTimer( tDIO_AC_TimeOutTimer );
            setTimer( tDIO_AC_TimeOutTimer, TimeOut );
        }
    }
}

DIO_WriteAC_P4_Trigger()
{
    word wTemp = 0;
    byte IsW222 = 0;
    byte IsW205 = 0;
    
    DiagAktion = 0;
    if( FillCommand( ServicePhys ) ) return;
    {
        rqBuf[0] = 0x2E;
        rqBuf[1] = 0xFD;
        rqBuf[2] = 0x01;
        rqBuf[3] = 0x04;    // Portnummer
        if( getValue( DIAG_CTRL_IC_Type_Selector ) == cKI_W222 )
        {   // W222
            IsW222 = 1;
            rqBuf[4] = 0x0C;    // Mask Data
            rqBuf[5] = 0x12;    // Mask Data
        }
        else
        {   // W205
            IsW205 = 1;
            rqBuf[4] = 0x00;    // Mask Data
            rqBuf[5] = 0x02;    // Mask Data
        }
        wTemp = 0;
                        wTemp = wTemp + ( ( getValue( DIAG_DIO_ML_P4_01 ) - 1 ) << 01 );
        if( IsW222 )    wTemp = wTemp + ( ( getValue( DIAG_DIO_ML_P4_04 ) - 1 ) << 04 );
        if( IsW222 )    wTemp = wTemp + ( ( getValue( DIAG_DIO_ML_P4_10 ) - 1 ) << 10 );
        if( IsW222 )    wTemp = wTemp + ( ( getValue( DIAG_DIO_ML_P4_11 ) - 1 ) << 11 );
        rqBuf[6] = ( byte )( wTemp >> 8 );    // Port Data
        rqBuf[7] = ( byte )( wTemp & 0xFF );    // Port Data
        rqBuf[8] = ( byte )( getValue( DIAG_DIO_ML_P4_Dir ) >> 8 );    // Port Data
        rqBuf[9] = ( byte )( getValue( DIAG_DIO_ML_P4_Dir ) & 0xFF );    // Port Data
        DIAG_SendRequest( SessionPhys, 10);
    }
    DiagAktion = cService_Routine_WriteAC_Px;
    bQueueWaitForResponce = TRUE;
    putValue( DIAG_DIO_StatusBar, "Warte auf Antwort..." );
    setTimer( tDIO_AC_TimeOutTimer, TimeOutMid);
}

DIO_WriteAC_P16_Trigger()
{
    word wTemp;
    
    DiagAktion = 0;
    if( FillCommand( ServicePhys ) ) return;
    {
        rqBuf[0] = 0x2E;
        rqBuf[1] = 0xFD;
        rqBuf[2] = 0x01;
        rqBuf[3] = 0x06;
        wTemp =         ( ( getValue( DIAG_DIO_ML_P16_04 ) - 1 ) << 04 );
        wTemp = wTemp + ( ( getValue( DIAG_DIO_ML_P16_05 ) - 1 ) << 05 );
        wTemp = wTemp + ( ( getValue( DIAG_DIO_ML_P16_06 ) - 1 ) << 06 );
        wTemp = wTemp + ( ( getValue( DIAG_DIO_ML_P16_07 ) - 1 ) << 07 );
        wTemp = wTemp + ( ( getValue( DIAG_DIO_ML_P16_10 ) - 1 ) << 10 );
        rqBuf[4] = ( byte )( wTemp >> 8 );
        rqBuf[5] = ( byte )( wTemp & 0xFF );
        rqBuf[6] = 0xFF;
        rqBuf[7] = 0x44;
        DIAG_SendRequest( SessionPhys, 8);
    }
    DiagAktion = cService_Routine_WriteAC_Px;
    bQueueWaitForResponce = TRUE;
    putValue( DIAG_DIO_StatusBar, "Warte auf Antwort..." );
    setTimer( tDIO_AC_TimeOutTimer, TimeOutMid);
}

DIO_WriteAC_P17_Trigger()
{
    word wTemp;
    
    DiagAktion = 0;
    if( FillCommand( ServicePhys ) ) return;
    {
        rqBuf[0] = 0x2E;
        rqBuf[1] = 0xFD;
        rqBuf[2] = 0x01;
        rqBuf[3] = 0x07;
        wTemp =         ( ( getValue( DIAG_DIO_ML_P17_10 ) - 1 ) << 10 );
        wTemp = wTemp + ( ( getValue( DIAG_DIO_ML_P17_11 ) - 1 ) << 11 );
        rqBuf[4] = ( byte )( wTemp >> 8 );
        rqBuf[5] = ( byte )( wTemp & 0xFF );
        rqBuf[6] = 0xFF;
        rqBuf[7] = 0x44;
        DIAG_SendRequest( SessionPhys, 8);
    }
    DiagAktion = cService_Routine_WriteAC_Px;
    bQueueWaitForResponce = TRUE;
    putValue( DIAG_DIO_StatusBar, "Warte auf Antwort..." );
    setTimer( tDIO_AC_TimeOutTimer, TimeOutMid);
}

DIO_WriteAC_Px_Eval()
{
    word wTemp;
    dword adresse;

    if( rsBuf[0] == 0x6E )
    {
        DiagAktion = 0;
        cancelTimer( tDIO_AC_TimeOutTimer );
        bQueueWaitForResponce = FALSE;
        putValue( DIAG_DIO_StatusBar, "Successful" );
        DIAG_CTRL_vStartNewService();
    }
    else
    {
        if( AntwortAuswertung( 1, rsBuf[0], rsBuf[2]) )
        {
            DiagAktion = 0;
            cancelTimer( tDIO_AC_TimeOutTimer );
            bQueueWaitForResponce = FALSE;
            putValue( DIAG_DIO_StatusBar, "negativ responce" );
            DIAG_CTRL_vStartNewService();
        }
        else
        {
            cancelTimer( tDIO_AC_TimeOutTimer );
            setTimer( tDIO_AC_TimeOutTimer, TimeOutMid);
        }
    }
}

DIO_WriteGC_P0_Eval()
{
    word wTemp;
    dword adresse;

    if( rsBuf[0] == 0x6E )
    {
        DiagAktion = 0;
        cancelTimer( tDIO_GC_TimeOutTimer );
        bQueueWaitForResponce = FALSE;
        putValue( DIAG_DIO_StatusBar, "Successful" );
        DIAG_CTRL_vStartNewService();
    }
    else
    {
        if( AntwortAuswertung( 1, rsBuf[0], rsBuf[2]) )
        {
            DiagAktion = 0;
            cancelTimer( tDIO_GC_TimeOutTimer );
            bQueueWaitForResponce = FALSE;
            putValue( DIAG_DIO_StatusBar, "negativ responce" );
            DIAG_CTRL_vStartNewService();
        }
        else
        {
            cancelTimer( tDIO_GC_TimeOutTimer );
            setTimer( tDIO_GC_TimeOutTimer, TimeOut );
        }
    }
}

DIO_WriteGC_P0_Trigger()
{
    word wTemp;
    byte IsW222 = 0;
    byte IsW205 = 0;
    
    DiagAktion = 0;
    if( FillCommand( ServicePhys ) ) return;
    {
        rqBuf[0] = 0x2E;
        rqBuf[1] = 0xFD;
        rqBuf[2] = 0x01;
        rqBuf[3] = 0x10;    // Portnummer
        if( getValue( DIAG_CTRL_IC_Type_Selector ) == cKI_W222 )
        {   // W222
            IsW222 = 1;
            rqBuf[4] = 0x05;    // Mask Data
            rqBuf[5] = 0x47;    // Mask Data
        }
        else
        {   // W205
            IsW205 = 1;
            rqBuf[4] = 0x80;    // Mask Data
            rqBuf[5] = 0x3C;    // Mask Data
        }
        wTemp = 0;
        if( IsW222 )
        {
            wTemp =         ( ( getValue( DIAG_DIO_PL_P0_00 ) - 1 ) << 00 );
            wTemp = wTemp + ( ( getValue( DIAG_DIO_PL_P0_01 ) - 1 ) << 01 );
            wTemp = wTemp + ( ( getValue( DIAG_DIO_PL_P0_02 ) - 1 ) << 02 );
            wTemp = wTemp + ( ( getValue( DIAG_DIO_PL_P0_06 ) - 1 ) << 06 );
            wTemp = wTemp + ( ( getValue( DIAG_DIO_PL_P0_08 ) - 1 ) << 08 );
            wTemp = wTemp + ( ( getValue( DIAG_DIO_PL_P0_10 ) - 1 ) << 10 );
        }
        if( IsW205 )
        {
            wTemp =         ( ( getValue( DIAG_DIO_PL_P0_06 ) - 1 ) << 06 );
            wTemp = wTemp + ( ( getValue( DIAG_DIO_PL_P0_07 ) - 1 ) << 07 );
            wTemp = wTemp + ( ( getValue( DIAG_DIO_PL_P0_08 ) - 1 ) << 08 );
            wTemp = wTemp + ( ( getValue( DIAG_DIO_PL_P0_09 ) - 1 ) << 09 );
            wTemp = wTemp + ( ( getValue( DIAG_DIO_PL_P0_15 ) - 1 ) << 15 );
        }
        rqBuf[6] = ( byte )( wTemp >> 8 );    // Port Data
        rqBuf[7] = ( byte )( wTemp & 0xFF );    // Port Data
        rqBuf[8] = ( byte )( getValue( DIAG_DIO_ML_P0_Dir ) >> 8 );    // Port Data
        rqBuf[9] = ( byte )( getValue( DIAG_DIO_ML_P0_Dir ) & 0xFF );    // Port Data
        DIAG_SendRequest( SessionPhys, 10);
    }
    DiagAktion = cService_Routine_WriteGC_Px;
    bQueueWaitForResponce = TRUE;
    putValue( DIAG_DIO_StatusBar, "Warte auf Antwort..." );
    setTimer( tDIO_GC_TimeOutTimer, TimeOutMid);
}

DIO_WriteGC_P4_Eval()
{
    word wTemp;
    dword adresse;

    if( rsBuf[0] == 0x6E )
    {
        DiagAktion = 0;
        cancelTimer( tDIO_GC_TimeOutTimer );
        bQueueWaitForResponce = FALSE;
        putValue( DIAG_DIO_StatusBar, "Successful" );
        DIAG_CTRL_vStartNewService();
    }
    else
    {
        if( AntwortAuswertung( 1, rsBuf[0], rsBuf[2]) )
        {
            DiagAktion = 0;
            cancelTimer( tDIO_GC_TimeOutTimer );
            bQueueWaitForResponce = FALSE;
            putValue( DIAG_DIO_StatusBar, "negativ responce" );
            DIAG_CTRL_vStartNewService();
        }
        else
        {
            cancelTimer( tDIO_GC_TimeOutTimer );
            setTimer( tDIO_GC_TimeOutTimer, TimeOut );
        }
    }
}

DIO_WriteGC_P4_Trigger()
{
    word wTemp;
    byte IsW222 = 0;
    byte IsW205 = 0;

    DiagAktion = 0;
    if( FillCommand( ServicePhys ) ) return;
    {
        rqBuf[0] = 0x2E;
        rqBuf[1] = 0xFD;
        rqBuf[2] = 0x01;
        rqBuf[3] = 0x14;    // Portnummer
        if( getValue( DIAG_CTRL_IC_Type_Selector ) == cKI_W222 )
        {   // W222
            IsW222 = 1;
            rqBuf[4] = 0x1C;    // Mask Data
            rqBuf[5] = 0x00;    // Mask Data
        }
        else
        {   // W205
            IsW205 = 1;
            rqBuf[4] = 0x1C;    // Mask Data
            rqBuf[5] = 0x00;    // Mask Data
        }
        wTemp = 0;
        if( IsW222 )
        {
            wTemp =         ( ( getValue( DIAG_DIO_PL_P4_10 ) - 1 ) << 10 );
            wTemp = wTemp + ( ( getValue( DIAG_DIO_PL_P4_11 ) - 1 ) << 11 );
            wTemp = wTemp + ( ( getValue( DIAG_DIO_PL_P4_12 ) - 1 ) << 12 );
        }
        if( IsW205 )
        {
            wTemp =         ( ( getValue( DIAG_DIO_PL_P4_10 ) - 1 ) << 10 );
            wTemp = wTemp + ( ( getValue( DIAG_DIO_PL_P4_11 ) - 1 ) << 11 );
            wTemp = wTemp + ( ( getValue( DIAG_DIO_PL_P4_12 ) - 1 ) << 12 );
        }
        rqBuf[6] = ( byte )( wTemp >> 8 );    // Port Data
        rqBuf[7] = ( byte )( wTemp & 0xFF );    // Port Data
        rqBuf[8] = ( byte )( getValue( DIAG_DIO_ML_P0_Dir ) >> 8 );    // Port Data
        rqBuf[9] = ( byte )( getValue( DIAG_DIO_ML_P0_Dir ) & 0xFF );    // Port Data        
        DIAG_SendRequest( SessionPhys, 10);
    }
    DiagAktion = cService_Routine_WriteGC_Px;
    bQueueWaitForResponce = TRUE;
    putValue( DIAG_DIO_StatusBar, "Warte auf Antwort..." );
    setTimer( tDIO_GC_TimeOutTimer, TimeOutMid);
}

DIO_WriteGC_P5_Trigger()
{
    word wTemp;
    byte IsW222 = 0;
    byte IsW205 = 0;

    DiagAktion = 0;
    if( FillCommand( ServicePhys ) ) return;
    {
        rqBuf[0] = 0x2E;
        rqBuf[1] = 0xFD;
        rqBuf[2] = 0x01;
        rqBuf[3] = 0x15;    // Portnummer
        if( getValue( DIAG_CTRL_IC_Type_Selector ) == cKI_W222 )
        {   // W222
            IsW222 = 1;
            rqBuf[4] = 0x00;    // Mask Data
            rqBuf[5] = 0x00;    // Mask Data
        }
        else
        {   // W205
            IsW205 = 1;
            rqBuf[4] = 0xFC;    // Mask Data
            rqBuf[5] = 0x78;    // Mask Data
        }
        if( IsW222 )
        {
            wTemp = 0; // not used
        }
        if( IsW205 )
        {
            wTemp =         ( ( getValue( DIAG_DIO_PL_P5_03 ) - 1 ) << 03 );
            wTemp = wTemp + ( ( getValue( DIAG_DIO_PL_P5_04 ) - 1 ) << 04 );
            wTemp = wTemp + ( ( getValue( DIAG_DIO_PL_P5_05 ) - 1 ) << 05 );
            wTemp = wTemp + ( ( getValue( DIAG_DIO_PL_P5_06 ) - 1 ) << 06 );
            wTemp = wTemp + ( ( getValue( DIAG_DIO_PL_P5_10 ) - 1 ) << 10 );
            wTemp = wTemp + ( ( getValue( DIAG_DIO_PL_P5_11 ) - 1 ) << 11 );
            wTemp = wTemp + ( ( getValue( DIAG_DIO_PL_P5_12 ) - 1 ) << 12 );
            wTemp = wTemp + ( ( getValue( DIAG_DIO_PL_P5_13 ) - 1 ) << 13 );
            wTemp = wTemp + ( ( getValue( DIAG_DIO_PL_P5_14 ) - 1 ) << 14 );
            wTemp = wTemp + ( ( getValue( DIAG_DIO_PL_P5_15 ) - 1 ) << 15 );
        }
        rqBuf[6] = ( byte )( wTemp >> 8 );    // Port Data
        rqBuf[7] = ( byte )( wTemp & 0xFF );    // Port Data
        rqBuf[8] = ( byte )( getValue( DIAG_DIO_ML_P0_Dir ) >> 8 );    // Port Data
        rqBuf[9] = ( byte )( getValue( DIAG_DIO_ML_P0_Dir ) & 0xFF );    // Port Data
        DIAG_SendRequest( SessionPhys, 10);
    }
    DiagAktion = cService_Routine_WriteGC_Px;
    bQueueWaitForResponce = TRUE;
    putValue( DIAG_DIO_StatusBar, "Warte auf Antwort..." );
    setTimer( tDIO_GC_TimeOutTimer, TimeOutMid);
}

DIO_WriteGC_P6_Eval()
{
    word wTemp;
    dword adresse;

    if( rsBuf[0] == 0x6E )
    {
        DiagAktion = 0;
        cancelTimer( tDIO_GC_TimeOutTimer );
        bQueueWaitForResponce = FALSE;
        putValue( DIAG_DIO_StatusBar, "Successful" );
        DIAG_CTRL_vStartNewService();
    }
    else
    {
        if( AntwortAuswertung( 1, rsBuf[0], rsBuf[2]) )
        {
            DiagAktion = 0;
            cancelTimer( tDIO_GC_TimeOutTimer );
            bQueueWaitForResponce = FALSE;
            putValue( DIAG_DIO_StatusBar, "negativ responce" );
            DIAG_CTRL_vStartNewService();
        }
        else
        {
            cancelTimer( tDIO_GC_TimeOutTimer );
            setTimer( tDIO_GC_TimeOutTimer, TimeOut );
        }
    }
}

DIO_WriteGC_P6_Trigger()
{
    word wTemp = 0;
    byte IsW222 = 0;
    byte IsW205 = 0;
    
    DiagAktion = 0;
    if( FillCommand( ServicePhys ) ) return;
    {
        rqBuf[0] = 0x2E;
        rqBuf[1] = 0xFD;
        rqBuf[2] = 0x01;
        rqBuf[3] = 0x16;    // Portnummer
        if( getValue( DIAG_CTRL_IC_Type_Selector ) == cKI_W222 )
        {   // W222
            IsW222 = 1;
            rqBuf[4] = 0x00;    // Mask Data
            rqBuf[5] = 0x44;    // Mask Data
        }
        else
        {   // W205
            IsW205 = 1;
            rqBuf[4] = 0x00;    // Mask Data
            rqBuf[5] = 0xE5;    // Mask Data
        }
        wTemp = 0;
        if( IsW222 )
        {
            wTemp =         ( ( getValue( DIAG_DIO_PL_P6_02 ) - 1 ) << 02 );
            wTemp = wTemp + ( ( getValue( DIAG_DIO_PL_P6_06 ) - 1 ) << 06 );
        }
        if( IsW205 )
        {
            wTemp =         ( ( getValue( DIAG_DIO_PL_P6_00 ) - 1 ) << 00 );
            wTemp = wTemp + ( ( getValue( DIAG_DIO_PL_P6_02 ) - 1 ) << 02 );
            wTemp = wTemp + ( ( getValue( DIAG_DIO_PL_P6_05 ) - 1 ) << 05 );
            wTemp = wTemp + ( ( getValue( DIAG_DIO_PL_P6_06 ) - 1 ) << 06 );
            wTemp = wTemp + ( ( getValue( DIAG_DIO_PL_P6_07 ) - 1 ) << 07 );
        }
        rqBuf[6] = ( byte )( wTemp >> 8 );    // Port Data
        rqBuf[7] = ( byte )( wTemp & 0xFF );    // Port Data
        rqBuf[8] = ( byte )( getValue( DIAG_DIO_ML_P0_Dir ) >> 8 );    // Port Data
        rqBuf[9] = ( byte )( getValue( DIAG_DIO_ML_P0_Dir ) & 0xFF );    // Port Data
        DIAG_SendRequest( SessionPhys, 10);
    }
    DiagAktion = cService_Routine_WriteGC_Px;
    bQueueWaitForResponce = TRUE;
    putValue( DIAG_DIO_StatusBar, "Warte auf Antwort..." );
    setTimer( tDIO_GC_TimeOutTimer, TimeOutMid);
}

DIO_WriteGC_Px_Eval()
{
    word wTemp;
    dword adresse;

    if( rsBuf[0] == 0x6E )
    {
        DiagAktion = 0;
        cancelTimer( tDIO_GC_TimeOutTimer );
        bQueueWaitForResponce = FALSE;
        putValue( DIAG_DIO_StatusBar, "Successful" );
        DIAG_CTRL_vStartNewService();
    }
    else
    {
        if( AntwortAuswertung( 1, rsBuf[0], rsBuf[2]) )
        {
            DiagAktion = 0;
            cancelTimer( tDIO_GC_TimeOutTimer );
            bQueueWaitForResponce = FALSE;
            putValue( DIAG_DIO_StatusBar, "negativ responce" );
            DIAG_CTRL_vStartNewService();
        }
        else
        {
            cancelTimer( tDIO_GC_TimeOutTimer );
            setTimer( tDIO_GC_TimeOutTimer, TimeOutMid );
        }
    }
}

DSP_EvalStartDisplayTest()
{
    if(( rsBuf[0] == 0x71 ) && 
       ( rsBuf[1] == 0x01 ) &&
       ( rsBuf[2] == 0x03 ) && 
       ( rsBuf[3] == 0x03 )    )
    {
        DiagAktion = 0;
        bQueueWaitForResponce = FALSE;
        cancelTimer( tDSP_StartControlTimeOutTimer );
        DIAG_CTRL_vStartNewService();
        putValue( DIAG_DSP_StatusBar, "Successful" );
    }	
    else
        if( AntwortAuswertung( 1, rsBuf[0], rsBuf[2]) )
        {
            DiagAktion = 0;
            bQueueWaitForResponce = FALSE;
            cancelTimer( tDSP_StartControlTimeOutTimer );
            DIAG_CTRL_vStartNewService();
            putValue( DIAG_DSP_StatusBar, "Error" );
        }
}

DSP_EvalStopDisplayTest()
{
    if(( rsBuf[0] == 0x71 ) && 
       ( rsBuf[1] == 0x02 ) &&
       ( rsBuf[2] == 0x03 ) &&  
       ( rsBuf[3] == 0x03 )    )
    {
        DiagAktion = 0;
        bQueueWaitForResponce = FALSE;
        cancelTimer( tDSP_StopControlTimeOutTimer );
        DIAG_CTRL_vStartNewService();
        putValue( DIAG_DSP_StatusBar, "Successful" );
    }
    else
        if( AntwortAuswertung( 1, rsBuf[0], rsBuf[2]) )
        {
            DiagAktion = 0;
            bQueueWaitForResponce = FALSE;
            cancelTimer( tDSP_StopControlTimeOutTimer );
            DIAG_CTRL_vStartNewService();
            putValue( DIAG_DSP_StatusBar, "Error" );
        }
}

DSP_vStartControl_Send()
{
    DiagAktion = 0;
    if( FillCommand( ServicePhys ) ) return;
    rqBuf[0] = 0x31;
    rqBuf[1] = 0x01;
    rqBuf[2] = 0x03;
    rqBuf[3] = 0x03;
//    rqBuf[4] = getValue( DIAG_DSP_DisplayNr );
//    rqBuf[5] = getValue( DIAG_DSP_DisplayMode );
    rqBuf[4] = getValue( DIAG_DSP_p0 ); 
    DIAG_SendRequest( SessionPhys, 5); 

    DiagAktion = cService_Routine_StartDisplayTest;
    bQueueWaitForResponce = TRUE;
    putValue( DIAG_DSP_StatusBar, "Warte auf Antwort..." );
    setTimer( tDSP_StartControlTimeOutTimer, TimeOut );
}

DSP_vStopControl_Send()
{
    DiagAktion = 0;
    if( FillCommand( ServicePhys ) ) return;
    rqBuf[0] = 0x31;
    rqBuf[1] = 0x02;
    rqBuf[2] = 0x03;  
    rqBuf[3] = 0x03;
    DIAG_SendRequest( SessionPhys, 4);
    DiagAktion = cService_Routine_StopDisplayTest;
    bQueueWaitForResponce = TRUE;
    putValue( DIAG_DSP_StatusBar, "Warte auf Antwort..." );
    setTimer( TimeOutTimer, TimeOut );
}

DTC_ClearEnv()
{   // The function clears the error storage display panel. 
    bDTC_HighByte =   0;
    bDTC_LowByte =    0;
    bDTC_Symptom =    0;
    bDTC_StatusMask = 0;
    for( iDTC_Counter	= 0; iDTC_Counter	< 32; iDTC_Counter++ )
    {
        DTC_WriteDataToEnv();
    }
    iDTC_Counter	= -1;
    strncpy(sBigStr, "", elCount( sBigStr ) );
    putValue( DIAG_DTC_Line, sBigStr );
    putValue( DIAG_DTC_Line2, sBigStr );
    putValue( DIAG_DTC_FullDisp, 0 );
}

DTC_Clear_DTC_Eval()
{
    if( rsBuf[0] == 0x54 )
    {
        DiagAktion = 0;
        cancelTimer( tDTC_ReadTimeOutTimer );
        bQueueWaitForResponce = FALSE;
        putValue( DIAG_DTC_StatusBar, "Clear DTC : Successful" );
        DIAG_CTRL_vStartNewService();
    }
    else
    {
        if( AntwortAuswertung( 1, rsBuf[0], rsBuf[2]) )
        {
            DiagAktion = 0;
            cancelTimer( tDTC_ReadTimeOutTimer );
            bQueueWaitForResponce = FALSE;
            putValue( DIAG_DTC_StatusBar, "negativ responce :  Clear DTC not successful" );
            DIAG_CTRL_vStartNewService();
        }
        else
        {
            cancelTimer( tDTC_ReadTimeOutTimer );
            setTimer( tDTC_ReadTimeOutTimer, TimeOut );
        }
    }
}

DTC_Clear_DTC_Trigger()
{   // The function sends a physically addressed read diagnostic information request message.
    DiagAktion = 0;
    if( FillCommand( ServicePhys ) ) return;
    rqBuf[0] = 0x14;
    rqBuf[1] = 0xFF;
    rqBuf[2] = 0xFF;
    rqBuf[3] = 0xFF;
    DIAG_SendRequest( SessionPhys, 4);
    DTC_ClearEnv();
    DiagAktion = cService_Routine_ClearDTC;
    bQueueWaitForResponce = TRUE;
    putValue( DIAG_DTC_StatusBar, "Warte auf Antwort..." );
    setTimer( tDTC_ReadTimeOutTimer, TimeOutMid );
}

DTC_Clear_DTC_Mirror_Memory_Eval()
{
    if( ( rsBuf[0] == 0x71 ) &&
        ( rsBuf[1] == 0x01 ) &&
        ( rsBuf[2] == 0xFF ) &&
        ( rsBuf[3] == 0x02 )    )
    {
        DiagAktion = 0;
        cancelTimer( tDTC_ReadTimeOutTimer );
        bQueueWaitForResponce = FALSE;
        putValue( DIAG_DTC_StatusBar, "Clear DTC Mirror Memory : Successful" );
        DIAG_CTRL_vStartNewService();
    }
    else
    {
        if( AntwortAuswertung( 1, rsBuf[0], rsBuf[2]) )
        {
            DiagAktion = 0;
            cancelTimer( tDTC_ReadTimeOutTimer );
            bQueueWaitForResponce = FALSE;
            putValue( DIAG_DTC_StatusBar, "negativ responce :  Clear DTC Mirror Memory not successful" );
            DIAG_CTRL_vStartNewService();
        }
        else
        {
            cancelTimer( tDTC_ReadTimeOutTimer );
            setTimer( tDTC_ReadTimeOutTimer, TimeOut );
        }
    }
}

DTC_Clear_DTC_Mirror_Memory_Trigger()
{   // The function sends a physically addressed read diagnostic information request message.
    DiagAktion = 0;
    if( FillCommand( ServicePhys ) ) return;
    rqBuf[0] = 0x31;
    rqBuf[1] = 0x01;
    rqBuf[2] = 0xFF;
    rqBuf[3] = 0x02;
    DIAG_SendRequest( SessionPhys, 4);
    DiagAktion = cService_Routine_ClearDTC_MirrorMemory;
    bQueueWaitForResponce = TRUE;
    putValue( DIAG_DTC_StatusBar, "Warte auf Antwort..." );
    setTimer( tDTC_ReadTimeOutTimer, TimeOutMid );
}

DTC_Clear_Private_DTC_Eval()
{
    if( ( rsBuf[0] == 0x71 ) &&
        ( rsBuf[1] == 0x01 ) &&
        ( rsBuf[2] == 0xF0 ) &&
        ( rsBuf[3] == 0x00 )    )
    {
        DiagAktion = 0;
        cancelTimer( tDTC_ReadTimeOutTimer );
        bQueueWaitForResponce = FALSE;
        putValue( DIAG_DTC_StatusBar, "Clear Private DTC : Successful" );
        DIAG_CTRL_vStartNewService();
    }
    else
    {
        if( AntwortAuswertung( 1, rsBuf[0], rsBuf[2]) )
        {
            DiagAktion = 0;
            cancelTimer( tDTC_ReadTimeOutTimer );
            bQueueWaitForResponce = FALSE;
            putValue( DIAG_DTC_StatusBar, "negativ responce :  Clear Private DTC not successful" );
            DIAG_CTRL_vStartNewService();
        }
        else
        {
            cancelTimer( tDTC_ReadTimeOutTimer );
            setTimer( tDTC_ReadTimeOutTimer, TimeOut );
        }
    }
}

DTC_Clear_Private_DTC_Trigger()
{   // The function sends a physically addressed read diagnostic information request message.
    DiagAktion = 0;
    if( FillCommand( ServicePhys ) ) return;
    rqBuf[0] = 0x31;
    rqBuf[1] = 0x01;
    rqBuf[2] = 0xF0;
    rqBuf[3] = 0x00;
    DIAG_SendRequest( SessionPhys, 4);
    DiagAktion = cercvice_Routine_ClearPrivteDTC;
    bQueueWaitForResponce = TRUE;
    putValue( DIAG_DTC_StatusBar, "Warte auf Antwort..." );
    setTimer( tDTC_ReadTimeOutTimer, TimeOutMid );
}

DTC_GET_Private_DTC_List_Eval()
{
}

DTC_InitData()
{   // The function initiates the variables of error storage.
    bDTC_HighByte =   0;
    bDTC_LowByte =    0;
    bDTC_Symptom =    0;
    bDTC_StatusMask = 0;
}

DTC_Mark_DTC_Color()
{
    byte i,temp, temp2;

    for( i= 0; i < 88; i++ )
    {
        temp2 = DTC_abSymptom[i];
        switch( temp2 )
        {
            case 0x10: temp = 3; break;
            case 0x00: temp = 0; break;
            case 0x08: temp = 1; break;
            case 0x28: temp = 1; break;
            case 0x09: temp = 2; break;
            case 0x29: temp = 2; break;
        }
        DTC_abSymptom[i] = temp;
    }
    putValue( DIAG_DTC_00_Line_State, DTC_abSymptom[ 00 ] );
    putValue( DIAG_DTC_01_Line_State, DTC_abSymptom[ 01 ] );
    putValue( DIAG_DTC_02_Line_State, DTC_abSymptom[ 02 ] );
    putValue( DIAG_DTC_03_Line_State, DTC_abSymptom[ 03 ] );
    putValue( DIAG_DTC_04_Line_State, DTC_abSymptom[ 04 ] );
    putValue( DIAG_DTC_05_Line_State, DTC_abSymptom[ 05 ] );
    putValue( DIAG_DTC_06_Line_State, DTC_abSymptom[ 06 ] );
    putValue( DIAG_DTC_07_Line_State, DTC_abSymptom[ 07 ] );
    putValue( DIAG_DTC_08_Line_State, DTC_abSymptom[ 08 ] );
    putValue( DIAG_DTC_09_Line_State, DTC_abSymptom[ 09 ] );
    putValue( DIAG_DTC_10_Line_State, DTC_abSymptom[ 10 ] );
    putValue( DIAG_DTC_11_Line_State, DTC_abSymptom[ 11 ] );
    putValue( DIAG_DTC_12_Line_State, DTC_abSymptom[ 12 ] );
    putValue( DIAG_DTC_13_Line_State, DTC_abSymptom[ 13 ] );
    putValue( DIAG_DTC_14_Line_State, DTC_abSymptom[ 14 ] );
    putValue( DIAG_DTC_15_Line_State, DTC_abSymptom[ 15 ] );
    putValue( DIAG_DTC_16_Line_State, DTC_abSymptom[ 16 ] );
    putValue( DIAG_DTC_17_Line_State, DTC_abSymptom[ 17 ] );
    putValue( DIAG_DTC_18_Line_State, DTC_abSymptom[ 18 ] );
    putValue( DIAG_DTC_19_Line_State, DTC_abSymptom[ 19 ] );
    putValue( DIAG_DTC_20_Line_State, DTC_abSymptom[ 20 ] );
    putValue( DIAG_DTC_21_Line_State, DTC_abSymptom[ 21 ] );
    putValue( DIAG_DTC_22_Line_State, DTC_abSymptom[ 22 ] );
    putValue( DIAG_DTC_23_Line_State, DTC_abSymptom[ 23 ] );
    putValue( DIAG_DTC_24_Line_State, DTC_abSymptom[ 24 ] );
    putValue( DIAG_DTC_25_Line_State, DTC_abSymptom[ 25 ] );
    putValue( DIAG_DTC_26_Line_State, DTC_abSymptom[ 26 ] );
    putValue( DIAG_DTC_27_Line_State, DTC_abSymptom[ 27 ] );
    putValue( DIAG_DTC_28_Line_State, DTC_abSymptom[ 28 ] );
    putValue( DIAG_DTC_29_Line_State, DTC_abSymptom[ 29 ] );
    putValue( DIAG_DTC_30_Line_State, DTC_abSymptom[ 30 ] );
    putValue( DIAG_DTC_31_Line_State, DTC_abSymptom[ 31 ] );
    putValue( DIAG_DTC_32_Line_State, DTC_abSymptom[ 32 ] );
    putValue( DIAG_DTC_33_Line_State, DTC_abSymptom[ 33 ] );
    putValue( DIAG_DTC_34_Line_State, DTC_abSymptom[ 34 ] );
    putValue( DIAG_DTC_35_Line_State, DTC_abSymptom[ 35 ] );
    putValue( DIAG_DTC_36_Line_State, DTC_abSymptom[ 36 ] );
    putValue( DIAG_DTC_37_Line_State, DTC_abSymptom[ 37 ] );
    putValue( DIAG_DTC_38_Line_State, DTC_abSymptom[ 38 ] );
    putValue( DIAG_DTC_39_Line_State, DTC_abSymptom[ 39 ] );
    putValue( DIAG_DTC_40_Line_State, DTC_abSymptom[ 40 ] );
    putValue( DIAG_DTC_41_Line_State, DTC_abSymptom[ 41 ] );
    putValue( DIAG_DTC_42_Line_State, DTC_abSymptom[ 42 ] );
    putValue( DIAG_DTC_43_Line_State, DTC_abSymptom[ 43 ] );
    putValue( DIAG_DTC_44_Line_State, DTC_abSymptom[ 44 ] );
    putValue( DIAG_DTC_45_Line_State, DTC_abSymptom[ 45 ] );
    putValue( DIAG_DTC_46_Line_State, DTC_abSymptom[ 46 ] );
    putValue( DIAG_DTC_47_Line_State, DTC_abSymptom[ 47 ] );
    putValue( DIAG_DTC_48_Line_State, DTC_abSymptom[ 48 ] );
    putValue( DIAG_DTC_49_Line_State, DTC_abSymptom[ 49 ] );
    putValue( DIAG_DTC_50_Line_State, DTC_abSymptom[ 50 ] );
    putValue( DIAG_DTC_51_Line_State, DTC_abSymptom[ 51 ] );
    putValue( DIAG_DTC_52_Line_State, DTC_abSymptom[ 52 ] );
    putValue( DIAG_DTC_53_Line_State, DTC_abSymptom[ 53 ] );
    putValue( DIAG_DTC_54_Line_State, DTC_abSymptom[ 54 ] );
    putValue( DIAG_DTC_55_Line_State, DTC_abSymptom[ 55 ] );
    putValue( DIAG_DTC_56_Line_State, DTC_abSymptom[ 56 ] );
    putValue( DIAG_DTC_57_Line_State, DTC_abSymptom[ 57 ] );
    putValue( DIAG_DTC_58_Line_State, DTC_abSymptom[ 58 ] );
    putValue( DIAG_DTC_59_Line_State, DTC_abSymptom[ 59 ] );
    putValue( DIAG_DTC_60_Line_State, DTC_abSymptom[ 60 ] );
    putValue( DIAG_DTC_61_Line_State, DTC_abSymptom[ 61 ] );
    putValue( DIAG_DTC_62_Line_State, DTC_abSymptom[ 62 ] );
    putValue( DIAG_DTC_63_Line_State, DTC_abSymptom[ 63 ] );
    putValue( DIAG_DTC_64_Line_State, DTC_abSymptom[ 64 ] );
    putValue( DIAG_DTC_65_Line_State, DTC_abSymptom[ 65 ] );
    putValue( DIAG_DTC_66_Line_State, DTC_abSymptom[ 66 ] );
    putValue( DIAG_DTC_67_Line_State, DTC_abSymptom[ 67 ] );
    putValue( DIAG_DTC_68_Line_State, DTC_abSymptom[ 68 ] );
    putValue( DIAG_DTC_69_Line_State, DTC_abSymptom[ 69 ] );
    putValue( DIAG_DTC_70_Line_State, DTC_abSymptom[ 70 ] );
    putValue( DIAG_DTC_71_Line_State, DTC_abSymptom[ 71 ] );
    putValue( DIAG_DTC_72_Line_State, DTC_abSymptom[ 72 ] );
    putValue( DIAG_DTC_73_Line_State, DTC_abSymptom[ 73 ] );
    putValue( DIAG_DTC_74_Line_State, DTC_abSymptom[ 74 ] );
    putValue( DIAG_DTC_75_Line_State, DTC_abSymptom[ 75 ] );
    putValue( DIAG_DTC_76_Line_State, DTC_abSymptom[ 76 ] );
    putValue( DIAG_DTC_77_Line_State, DTC_abSymptom[ 77 ] );
    putValue( DIAG_DTC_78_Line_State, DTC_abSymptom[ 78 ] );
    putValue( DIAG_DTC_79_Line_State, DTC_abSymptom[ 79 ] );
    putValue( DIAG_DTC_80_Line_State, DTC_abSymptom[ 80 ] );
    putValue( DIAG_DTC_81_Line_State, DTC_abSymptom[ 81 ] );
    putValue( DIAG_DTC_82_Line_State, DTC_abSymptom[ 82 ] );
    putValue( DIAG_DTC_83_Line_State, DTC_abSymptom[ 83 ] );
    putValue( DIAG_DTC_84_Line_State, DTC_abSymptom[ 84 ] );
    putValue( DIAG_DTC_85_Line_State, DTC_abSymptom[ 85 ] );
    putValue( DIAG_DTC_86_Line_State, DTC_abSymptom[ 86 ] );
    putValue( DIAG_DTC_87_Line_State, DTC_abSymptom[ 87 ] );
    putValue( DIAG_DTC_88_Line_State, DTC_abSymptom[ 88 ] );
    putValue( DIAG_DTC_89_Line_State, DTC_abSymptom[ 89 ] );
    putValue( DIAG_DTC_90_Line_State, DTC_abSymptom[ 90 ] );
    putValue( DIAG_DTC_91_Line_State, DTC_abSymptom[ 91 ] );
    putValue( DIAG_DTC_92_Line_State, DTC_abSymptom[ 92 ] );
    putValue( DIAG_DTC_93_Line_State, DTC_abSymptom[ 93 ] );
    putValue( DIAG_DTC_94_Line_State, DTC_abSymptom[ 94 ] );
    putValue( DIAG_DTC_95_Line_State, DTC_abSymptom[ 95 ] );
    putValue( DIAG_DTC_96_Line_State, DTC_abSymptom[ 96 ] );
    putValue( DIAG_DTC_97_Line_State, DTC_abSymptom[ 97 ] );
    putValue( DIAG_DTC_98_Line_State, DTC_abSymptom[ 98 ] );
    putValue( DIAG_DTC_99_Line_State, DTC_abSymptom[ 99 ] );
    putValue( DIAG_DTC_100_Line_State, DTC_abSymptom[ 100 ] );
    putValue( DIAG_DTC_101_Line_State, DTC_abSymptom[ 101 ] );
    putValue( DIAG_DTC_102_Line_State, DTC_abSymptom[ 102 ] );
    putValue( DIAG_DTC_103_Line_State, DTC_abSymptom[ 103 ] );
 /*   putValue( DIAG_DTC_4_Line_State, DTC_abSymptom[ 4 ] );
    putValue( DIAG_DTC_5_Line_State, DTC_abSymptom[ 5 ] );
    putValue( DIAG_DTC_6_Line_State, DTC_abSymptom[ 6 ] );
    putValue( DIAG_DTC_7_Line_State, DTC_abSymptom[ 7 ] );
    putValue( DIAG_DTC_8_Line_State, DTC_abSymptom[ 8 ] );
    putValue( DIAG_DTC_9_Line_State, DTC_abSymptom[ 9 ] );*/
}

DTC_Read_DTC_Eval( int Laenge, byte bMask )
{
    byte i;
    byte bAliveCtr;

    // positive response 
    if( ( rsBuf[0] == 0x59 ) && ( rsBuf[1] == 0x0A ) )
    {
        if( (rsBuf[2] == 0) && (rsBuf[3] == 0) && (rsBuf[4] == 0) )
        {
            DiagAktion = 0;
            cancelTimer( tDIO_GC_TimeOutTimer );
            bQueueWaitForResponce = FALSE;
            putValue( DIAG_DIO_StatusBar, "Successful" );
            DIAG_CTRL_vStartNewService();
        }
        else
        {
            DTC_ClearEnv();
            bAliveCtr = getValue( DIAG_DTC_MSGAliveCtr );
            if( bAliveCtr < 8 )
                bAliveCtr = ( bAliveCtr + 1 ) & 0x07;
            else
                bAliveCtr = 0;
            putValue( DIAG_DTC_MSGAliveCtr, bAliveCtr );
            for( i = 0; i < ( Laenge - 3 ) / 4; i++ )
            {
                bDTC_HighByte 	= rsBuf[( i * 4) + 3 ];
                bDTC_LowByte	= rsBuf[( i * 4) + 4 ];
                bDTC_Symptom 	= rsBuf[( i * 4) + 5 ];
                bDTC_StatusMask = rsBuf[( i * 4) + 6 ];
                iDTC_Counter++;
                DTC_abSymptom[iDTC_Counter] = bDTC_StatusMask;
//                    write( "%X %X %X %X ",bDTC_HighByte,bDTC_LowByte,bDTC_Symptom,bDTC_StatusMask );
                DTC_WriteDataToEnv();
                if( iDTC_Counter == 39 )
                {
                     putValue( DIAG_DTC_Line, sBigStr );
                     strncpy(sBigStr, "", elCount( sBigStr ) );
                }
            }
            if( iDTC_Counter > 39 )
                putValue( DIAG_DTC_Line2, sBigStr );
            else
                putValue( DIAG_DTC_Line, sBigStr );
            DTC_Mark_DTC_Color();
            DiagAktion = 0;
            cancelTimer( tDIO_GC_TimeOutTimer );
            bQueueWaitForResponce = FALSE;
            putValue( DIAG_DIO_StatusBar, "Successful" );
            DIAG_CTRL_vStartNewService();
        }
    }
}

DTC_Read_DTC_List_VDO_Trigger( byte bMask )
{
    DiagAktion = 0;
    if( FillCommand( ServicePhys ) ) return;
    rqBuf[0] = 0x31;
    rqBuf[1] = 0x01;
    rqBuf[0] = 0xF0;
    rqBuf[1] = 0x01;
    DIAG_SendRequest( SessionPhys, 4);
    DiagAktion = cService_Routine_ReadActivePrivteDTCList;
    bQueueWaitForResponce = TRUE;
    setTimer( tDTC_ReadTimeOutTimer, TimeOutMid );
}

DTC_Read_DTC_Trigger( byte bMask )
{   // The function sends a physically addressed read diagnostic information request message.
    DiagAktion = 0;
    if( FillCommand( ServicePhys ) ) return;
    rqBuf[0] = 0x19;
    rqBuf[1] = 0x0A;
    DIAG_SendRequest( SessionPhys, 2 );
    DiagAktion = cService_Routine_ReadDTC;
    bQueueWaitForResponce = TRUE;
    setTimer( tDTC_ReadTimeOutTimer, TimeOutMid );
}

DTC_Read_DTC_VDO_List_Eval()
{
    byte i, j;
    dword dwDTC;

    // positive response 
    if( ( rsBuf[0] == 0x71 ) && ( rsBuf[1] == 0x01 ) && ( rsBuf[2] == 0xF0 ) && ( rsBuf[3] == 0x01 ) )
    {
        for( i = 0; i < 30; i++ )
            DTC_adwTroubleCode_VDO_Avail[i] = 0;
        for( j = 0; j < rsBuf[4]; j++ )
        {
            dwDTC = rsBuf[j]*65536 + rsBuf[j+1]+256 + rsBuf[j+2];
            for( i = 0; i < DTC_nNoSupportedDTC_VDO; i++ )
            {
                if( dwDTC == DTC_adwTroubleCode_VDO[i] )
                    DTC_adwTroubleCode_VDO_Avail[i] = 1;
            }
        }
        putValue( DIAG_DTC_StatusBar, "Successful" );
    }
    else
        putValue( DIAG_DTC_StatusBar, "Failed" );
    DiagAktion = 0;
    cancelTimer( tDIO_GC_TimeOutTimer );
    bQueueWaitForResponce = FALSE;
    DIAG_CTRL_vStartNewService();
}

DTC_WriteDataToEnv()
{   // The function writes the data of the diagnostic trouble code response messages to the environment variables of the error storage display panel.

    char 	sStr[58]  = "";
    dword 	dwDTCCode;
    int 	iSearchIndex;
    char    Text40[41] = "";
    int 	boDTCFound;
	
    if( ( bDTC_HighByte == 0) && ( bDTC_LowByte == 0) )
        strncpy(sStr, "", elCount(sStr) );
    else
    {
        dwDTCCode =  (((word)( bDTC_HighByte )<<8) + (word)bDTC_LowByte );
        dwDTCCode = (((dword)(dwDTCCode )<<8) + (word)bDTC_Symptom);
// Search received DTC in table 
        for( iSearchIndex = 0; iSearchIndex < DTC_nNoSupportedDTC; iSearchIndex++)
        {
            if( DTC_adwTroubleCode[iSearchIndex] == dwDTCCode )
            {
                snprintf( Text40, 41, DTC_astrTroubleCode[iSearchIndex] );
                _ByteToBin( bDTC_StatusMask );
                snprintf( sStr, 74, "%s %s %s ",
                DTC_astrDTC[iSearchIndex],
                DTC_strSymptomBinary,
                Text40 );
                boDTCFound = 1;	
                break;
            }
            else
            {
// This is not the correct entry
                boDTCFound = 0;
            }
        }
    }
    if(!boDTCFound)
    {
        // Received DTC is not found in list of DTCs create entry
        _ByteToBin( bDTC_StatusMask );
        snprintf(sStr,elCount(sStr), "%06X %s      UNKNOWN TROUBLE CODE                 ",
        dwDTCCode,
        DTC_strSymptomBinary );
    }
    strncat(sBigStr,sStr, elcount(sBigStr) );
    if(( iDTC_Counter > 31) && ( getValue( DIAG_DTC_FullDisp ) == 0) ) 
        putValue( DIAG_DTC_FullDisp, 1 );
}

void DTC_vReadDTCFromFile( void )
{   // @AP:This function reads the information given in the config file and stores them in arrays.
    int iIndex,iCharacter;
    char strEntryCode[9];
    char strEntrySymp[9];
    char strEntryText[90];
    byte bHelp;

    DTC_nNoSupportedDTC = getProfileInt("TROUBLE CODES DAI", "NUMBER_DAI", 0, "CONFIG//DTC_config_file.txt" );
 // write ("DTC_nNoSupportedDTC %d", DTC_nNoSupportedDTC );	
    for( iIndex = 0; iIndex < DTC_nNoSupportedDTC; iIndex++)
    {
        snprintf( DTC_astrTroubleCode[iIndex], 80, "" );
        snprintf(strEntryCode, elcount(strEntryCode ), "CODE_%d" ,iIndex);
        snprintf(strEntryText, elcount(strEntryText ), "TEXT_%d" ,iIndex);
        getProfileString("TROUBLE CODES DAI", strEntryCode, "0000000",			DTC_astrDTC[iIndex], 			7, 		"CONFIG//DTC_config_file.txt" );
        getProfileString("TROUBLE CODES DAI", strEntryText, "ERROR DTC TEXT",	DTC_astrTroubleCode[iIndex], 	80, 	"CONFIG//DTC_config_file.txt" );
        iCharacter = 0;
        strncat( DTC_astrTroubleCode[iIndex], "                                                                        ",elcount( DTC_astrTroubleCode[iIndex])+1);
        DTC_adwTroubleCode[iIndex] = 0;
        for( iCharacter = 0; iCharacter < 6; iCharacter++)
        {
 //         write("char[ %d ] : %c", iCharacter , DTC_astrDTC[iIndex][iCharacter] );
            if(( DTC_astrDTC[iIndex][iCharacter] >= 0x30) && ( DTC_astrDTC[iIndex][iCharacter] <= 0x39) )
                bHelp = DTC_astrDTC[iIndex][iCharacter] - 0x30;
            else 
	        if(( DTC_astrDTC[iIndex][iCharacter] >= 0x41) && ( DTC_astrDTC[iIndex][iCharacter] <= 0x46) )
                    bHelp = DTC_astrDTC[iIndex][iCharacter] - 0x37;
                else 
		    if(( DTC_astrDTC[iIndex][iCharacter] >= 0x61) && ( DTC_astrDTC[iIndex][iCharacter] <= 0x66) )
                        bHelp = DTC_astrDTC[iIndex][iCharacter] - 0x57;
                    else
                        bHelp = 0x0;
            DTC_adwTroubleCode[iIndex] |= ((word)bHelp << (4 * (5 - iCharacter) ) );
        }
        if(ProtokollActive != FALSE) 
            write ("DTC_adwTroubleCode content in RAM: %6X, %sXXX",DTC_adwTroubleCode[iIndex],/* DTC_abSymptom[iIndex], */ DTC_astrTroubleCode[iIndex]);	
    }
    DTC_nNoSupportedDTC_VDO = getProfileInt("TROUBLE CODES VDO", "NUMBER_VDO", 0, "CONFIG//DTC_config_file.txt" );
 // write ("DTC_nNoSupportedDTC %d", DTC_nNoSupportedDTC );	
    for( iIndex = 0; iIndex < DTC_nNoSupportedDTC_VDO; iIndex++)
    {
        snprintf( DTC_astrTroubleCode_VDO[iIndex], 80, "" );
        snprintf(strEntryCode, elcount(strEntryCode ), "CODE_%d" ,iIndex);
        snprintf(strEntryText, elcount(strEntryText ), "TEXT_%d" ,iIndex);
        getProfileString("TROUBLE CODES VDO", strEntryCode, "0000000",			DTC_astrDTC_VDO[iIndex], 			7, 		"CONFIG//DTC_config_file.txt" );
        getProfileString("TROUBLE CODES VDO", strEntryText, "ERROR DTC TEXT",	DTC_astrTroubleCode_VDO[iIndex], 	80, 	"CONFIG//DTC_config_file.txt" );
        iCharacter = 0;
        strncat( DTC_astrTroubleCode_VDO[iIndex], "                                                                        ",elcount( DTC_astrTroubleCode[iIndex])+1);
        DTC_adwTroubleCode_VDO[iIndex] = 0;
        for( iCharacter = 0; iCharacter < 6; iCharacter++)
        {
 //         write("char[ %d ] : %c", iCharacter , DTC_astrDTC[iIndex][iCharacter] );
            if( ( DTC_astrDTC_VDO[iIndex][iCharacter] >= 0x30) && ( DTC_astrDTC_VDO[iIndex][iCharacter] <= 0x39) )
                bHelp = DTC_astrDTC_VDO[iIndex][iCharacter] - 0x30;
            else 
                if(( DTC_astrDTC_VDO[iIndex][iCharacter] >= 0x41) && ( DTC_astrDTC_VDO[iIndex][iCharacter] <= 0x46) )
                    bHelp = DTC_astrDTC_VDO[iIndex][iCharacter] - 0x37;
                else
		    if(( DTC_astrDTC_VDO[iIndex][iCharacter] >= 0x61) && ( DTC_astrDTC_VDO[iIndex][iCharacter] <= 0x66) )
                        bHelp = DTC_astrDTC_VDO[iIndex][iCharacter] - 0x57;
                    else
                        bHelp = 0x0;
           DTC_adwTroubleCode_VDO[iIndex] |= ((word)bHelp << (4 * (5 - iCharacter) ) );
        }
        if(ProtokollActive != FALSE) 
            write ("DTC_adwTroubleCode content in RAM: %6X, %sXXX",DTC_adwTroubleCode_VDO[iIndex],/* DTC_abSymptom[iIndex], */ DTC_astrTroubleCode_VDO[iIndex]);	
    }
}

void DiagAktionStart( byte AktionsNr)
{
    DiagAktion = AktionsNr;
    putValue( DIAG_Main_ErrorStatus, "Warte auf Antwort..." );

    switch( AktionsNr )
    {
        case  11:     /* Diagnose aktivieren */
                     break;

        case  12:       /* Normal Message Transmission off */
                          break;

        case  13:       /* Normal Message Transmission on */
                         if( FillCommand( ServicePhys ) ) return;
                              rqBuf[0] = 0x28;
                              rqBuf[1] = 0x00;
                              rqBuf[2] = 0x01;
                              DIAG_SendRequest( ServicePhys, 3);
                          setTimer( TimeOutTimer, TimeOut );
                          break;

        case  14:       /* Speicher Lesen */
                         if( FillCommand( ServicePhys ) ) return;
                                 rqBuf[0] = 0x22;
                        rqBuf[1] = getValue( DHMI__AnzeigeBlockNr) >> 8;
                        rqBuf[2] = getValue( DHMI__AnzeigeBlockNr) & 0xFF;
                               DIAG_SendRequest( ServicePhys, 3);
                          setTimer( TimeOutTimer, TimeOutLong);
                  break;

        case  15:       /* Speicher schreiben */
                         if( FillCommand( ServicePhys ) ) return;
                         DIAG_SendRequest( ServicePhys, BufferAnzahl);
                          setTimer( TimeOutTimer, TimeOutLong);
                          break;

    case  16:       // I/O Control
                         if( FillCommand( ServicePhys ) ) return;
                          DIAG_SendRequest( ServicePhys, BufferAnzahl);
                  setTimer( TimeOutTimer, TimeOutLong);
                          break;

    case  17:      // man. Befehlseingabe
                         if( FillCommand( ServicePhys ) ) return;
                          DIAG_SendRequest( ServicePhys, BufferAnzahl);
                          setTimer( TimeOutTimer, TimeOutLong);
                          break;

      case  18:       /* DCS SG-Identifikation/DCX MMC ECU Identification */
                         if( FillCommand( ServicePhys ) ) return;
                          /* UDS     */ 
                          rqBuf[0] = 0x22; 
                          rqBuf[1] = 0xF1; 
                          rqBuf[2] = 0x11; 
                          DIAG_SendRequest( ServicePhys, 3); break;
                          setTimer( TimeOutTimer, TimeOut );
                  break;

    case  19:       /* development data */
                         if( FillCommand( ServicePhys ) ) return;
//                              case 2: /* UDS     */ 
                            rqBuf[0] = 0x22; 
                            rqBuf[1] = 0xF1; 
                            rqBuf[2] = 0x0E; 
                            DIAG_SendRequest( ServicePhys, 3); 
                          setTimer( TimeOutTimer, TimeOut );
                          break;

      case 24:      /* SG-Entwicklungsstand e6 */
                         if( FillCommand( ServicePhys ) ) return;
                    //          case 2:     /* UDS         */ 
                    rqBuf[0] = 0x22; 
                    rqBuf[1] = 0xF1; 
                    rqBuf[2] = 0x70; 
                          DIAG_SendRequest( ServicePhys, 3);
                          setTimer( TimeOutTimer, TimeOut );
                          break;
    }
}

int FillCommand( byte xxxPhys )
{
    int nECU;
    nECU = getValue( DIAG_CTRL_ECU_Selector );
    switch( nECU )
    {
        case  0:     if( DiagAktion!=1 || xxxPhys )
                     {
                         putValue( DIAG_Main_ErrorStatus, "Steuergerät auswählen!" );
                         return(1);
                     }
                     break;
        default:     OSEKTL_SetTxId( ECUReqId[ nECU ] );
                     OSEKTL_SetRxId( ECUResId[ nECU ] );
    break;
    }
    return(0);
}

void GetBuffer()
{
    PutValue( DHMI__GetBuffer, cleardata, 0);
    putValue( DHMI__GetBuffer, rsBuf, EmpfangAnzahl );
}

GPIO_ReadPhysicalPorts()
{
	  DiagAktion = 0;
    if( FillCommand( ServicePhys ) ) return;
    rqBuf[0] = 0x31;
    rqBuf[1] = 0x01;
    rqBuf[2] = 0xF0;
    rqBuf[3] = 0x04; 
	  rqBuf[4] = bSetGPIOChannel_Buffer;
    DIAG_SendRequest( SessionPhys, 5);
    DiagAktion = cRead_PhysicalPorts;
    bQueueWaitForResponce = TRUE;
    putValue( DIAG_Main_ErrorStatus, "Warte auf Antwort..." );
    setTimer( tGPIO_TimeOutTimer, TimeOutMid);
    Write("%x %x %x %x %x", rqBuf[0], rqBuf[1], rqBuf[2], rqBuf[3], rqBuf[4]);
}

GPIO_EvalReadPhysicalPorts()
{
 if(   ( rsBuf[0] == 0x71 ) && 
       ( rsBuf[1] == 0x01 ) &&
       ( rsBuf[2] == 0xF0 ) &&
       ( rsBuf[3] == 0x04 )    )
 {
    PortDataHi[0] = rsBuf[5];
		PortDataLo[0] = rsBuf[6];
		PortDirHi[0] = rsBuf[7];
    PortDirLo[0] = rsBuf[8];
  
    switch (bSetGPIOChannel_Buffer)
		{
			case 0x00:            GPIO_EvalSetPort_P0();                           return; //900
			case 0x01:            GPIO_EvalSetPort_P1();                           return; //901
			case 0x02:            GPIO_EvalSetPort_P2();                           return; //902
			case 0x03:            GPIO_EvalSetPort_P3();                           return; //903
			case 0x0A:            GPIO_EvalSetPort_P10();                          return; //904
			case 0x0B:            GPIO_EvalSetPort_P11();                          return; //905
			case 0x10:            GPIO_EvalSetPort_P16();                          return; //906
			case 0x11:            GPIO_EvalSetPort_P17();                          return; //907
			case 0x15:            GPIO_EvalSetPort_P21();                          return; //908
			case 0x28:            GPIO_EvalSetPort_P40();                          return; //909
			case 0x2A:            GPIO_EvalSetPort_P42();                          return; //910
      case 0x2B:            GPIO_EvalSetPort_P43();                          return; //911
			case 0x2C:            GPIO_EvalSetPort_P44();                          return; //911
			case 0x2D:            GPIO_EvalSetPort_P45();                          return; //912
			case 0x30:            GPIO_EvalSetPort_JP0();                          return; //913
			default:                        																			 return; //anything else
		}
		DiagAktion = 0;
    bQueueWaitForResponce = FALSE;
    cancelTimer( tGPIO_TimeOutTimer );
    DIAG_CTRL_vStartNewService();         
    }
    else
        if( AntwortAuswertung( 1, rsBuf[0], rsBuf[2]) )
        {
            DiagAktion = 0;
            cancelTimer( tGPIO_TimeOutTimer );
            bQueueWaitForResponce = FALSE;
        }
    DIAG_CTRL_vStartNewService();
}

GPIO_EvalSetPort_P0()
{
  if ( getValue( DIAG_CTRL_IC_Type_Selector ) == cKI_VS30_EL)
  {
//    putvalue(DIAG_GPIO_P0_0, (PortDataLo[0] & 0x01));
//	  putvalue(DIAG_GPIO_P0_1, ((PortDataLo[0] & 0x02)>>1));
//	  putvalue(DIAG_GPIO_P0_2, ((PortDataLo[0] & 0x04)>>2));
//	  putvalue(DIAG_GPIO_P0_3, ((PortDataLo[0] & 0x08)>>3));
//	  putvalue(DIAG_GPIO_P0_4, ((PortDataLo[0] & 0x10)>>4));
//	  putvalue(DIAG_GPIO_P0_5, ((PortDataLo[0] & 0x20)>>5));
//	  putvalue(DIAG_GPIO_P0_6, ((PortDataLo[0] & 0x40)>>6));
//	  putvalue(DIAG_GPIO_P0_7, ((PortDataLo[0] & 0x80)>>7));
	
//	  putvalue(DIAG_GPIO_P0_8, (PortDataHi[0] & 0x01));
//	  putvalue(DIAG_GPIO_P0_9, ((PortDataHi[0] & 0x02)>>1));
//	  putvalue(DIAG_GPIO_P0_10, ((PortDataHi[0] & 0x04)>>2));
//	  putvalue(DIAG_GPIO_P0_11, ((PortDataHi[0] & 0x08)>>3));
//	  putvalue(DIAG_GPIO_P0_12, ((PortDataHi[0] & 0x10)>>4));
//	  putvalue(DIAG_GPIO_P0_13, ((PortDataHi[0] & 0x20)>>5));
//	  putvalue(DIAG_GPIO_P0_14, ((PortDataHi[0] & 0x40)>>6));
//	  putvalue(DIAG_GPIO_P0_15, ((PortDataHi[0] & 0x80)>>7));
  
//    putvalue(DIAG_GPIO_P0_0_dir, (PortDirLo[0] & 0x01));
//	  putvalue(DIAG_GPIO_P0_1_dir, ((PortDirLo[0] & 0x02)>>1));
//	  putvalue(DIAG_GPIO_P0_2_dir, ((PortDirLo[0] & 0x04)>>2));
//	  putvalue(DIAG_GPIO_P0_3_dir, ((PortDirLo[0] & 0x08)>>3));
//	  putvalue(DIAG_GPIO_P0_4_dir, ((PortDirLo[0] & 0x10)>>4));
//	  putvalue(DIAG_GPIO_P0_5_dir, ((PortDirLo[0] & 0x20)>>5));
//	  putvalue(DIAG_GPIO_P0_6_dir, ((PortDirLo[0] & 0x40)>>6));
//	  putvalue(DIAG_GPIO_P0_7_dir, ((PortDirLo[0] & 0x80)>>7));
	
//	  putvalue(DIAG_GPIO_P0_8_dir, (PortDirHi[0] & 0x01));
//	  putvalue(DIAG_GPIO_P0_9_dir, ((PortDirHi[0] & 0x02)>>1));
//	  putvalue(DIAG_GPIO_P0_10_dir, ((PortDirHi[0] & 0x04)>>2));
//	  putvalue(DIAG_GPIO_P0_11_dir, ((PortDirHi[0] & 0x08)>>3));
//	  putvalue(DIAG_GPIO_P0_12_dir, ((PortDirHi[0] & 0x10)>>4));
//	  putvalue(DIAG_GPIO_P0_13_dir, ((PortDirHi[0] & 0x20)>>5));
//	  putvalue(DIAG_GPIO_P0_14_dir, ((PortDirHi[0] & 0x40)>>6));
//	  putvalue(DIAG_GPIO_P0_15_dir, ((PortDirHi[0] & 0x80)>>7));
  }
  else if ( getValue( DIAG_CTRL_IC_Type_Selector ) == cKI_VS30_HL)
  {
    putvalue(DIAG_GPIO_P0_0, (PortDataLo[0] & 0x01));
//	  putvalue(DIAG_GPIO_P0_1, ((PortDataLo[0] & 0x02)>>1));
//	  putvalue(DIAG_GPIO_P0_2, ((PortDataLo[0] & 0x04)>>2));
//	  putvalue(DIAG_GPIO_P0_3, ((PortDataLo[0] & 0x08)>>3));
//	  putvalue(DIAG_GPIO_P0_4, ((PortDataLo[0] & 0x10)>>4));
//	  putvalue(DIAG_GPIO_P0_5, ((PortDataLo[0] & 0x20)>>5));
//	  putvalue(DIAG_GPIO_P0_6, ((PortDataLo[0] & 0x40)>>6));
//	  putvalue(DIAG_GPIO_P0_7, ((PortDataLo[0] & 0x80)>>7));

//	  putvalue(DIAG_GPIO_P0_8, (PortDataHi[0] & 0x01));
//	  putvalue(DIAG_GPIO_P0_9, ((PortDataHi[0] & 0x02)>>1));
//	  putvalue(DIAG_GPIO_P0_10, ((PortDataHi[0] & 0x04)>>2));
//	  putvalue(DIAG_GPIO_P0_11, ((PortDataHi[0] & 0x08)>>3));
//	  putvalue(DIAG_GPIO_P0_12, ((PortDataHi[0] & 0x10)>>4));
//	  putvalue(DIAG_GPIO_P0_13, ((PortDataHi[0] & 0x20)>>5));
//	  putvalue(DIAG_GPIO_P0_14, ((PortDataHi[0] & 0x40)>>6));
//	  putvalue(DIAG_GPIO_P0_15, ((PortDataHi[0] & 0x80)>>7));
  
    putvalue(DIAG_GPIO_P0_0_dir, (PortDirLo[0] & 0x01));
//	  putvalue(DIAG_GPIO_P0_1_dir, ((PortDirLo[0] & 0x02)>>1));
//	  putvalue(DIAG_GPIO_P0_2_dir, ((PortDirLo[0] & 0x04)>>2));
//	  putvalue(DIAG_GPIO_P0_3_dir, ((PortDirLo[0] & 0x08)>>3));
//	  putvalue(DIAG_GPIO_P0_4_dir, ((PortDirLo[0] & 0x10)>>4));
//	  putvalue(DIAG_GPIO_P0_5_dir, ((PortDirLo[0] & 0x20)>>5));
//	  putvalue(DIAG_GPIO_P0_6_dir, ((PortDirLo[0] & 0x40)>>6));
//	  putvalue(DIAG_GPIO_P0_7_dir, ((PortDirLo[0] & 0x80)>>7));

//	  putvalue(DIAG_GPIO_P0_8_dir, (PortDirHi[0] & 0x01));
//	  putvalue(DIAG_GPIO_P0_9_dir, ((PortDirHi[0] & 0x02)>>1));
//	  putvalue(DIAG_GPIO_P0_10_dir, ((PortDirHi[0] & 0x04)>>2));
//	  putvalue(DIAG_GPIO_P0_11_dir, ((PortDirHi[0] & 0x08)>>3));
//	  putvalue(DIAG_GPIO_P0_12_dir, ((PortDirHi[0] & 0x10)>>4));
//	  putvalue(DIAG_GPIO_P0_13_dir, ((PortDirHi[0] & 0x20)>>5));
//	  putvalue(DIAG_GPIO_P0_14_dir, ((PortDirHi[0] & 0x40)>>6));
//	  putvalue(DIAG_GPIO_P0_15_dir, ((PortDirHi[0] & 0x80)>>7));
  }  
}

GPIO_EvalSetPort_P1()
{
  if ( getValue( DIAG_CTRL_IC_Type_Selector ) == cKI_VS30_EL)
  {
    putvalue(DIAG_GPIO_P1_0, (PortDataLo[0] & 0x01));
	  putvalue(DIAG_GPIO_P1_1, ((PortDataLo[0] & 0x02)>>1));
//	  putvalue(DIAG_GPIO_P1_2, ((PortDataLo[0] & 0x04)>>2));
//	  putvalue(DIAG_GPIO_P1_3, ((PortDataLo[0] & 0x08)>>3));
//	  putvalue(DIAG_GPIO_P1_4, ((PortDataLo[0] & 0x10)>>4));
//	  putvalue(DIAG_GPIO_P1_5, ((PortDataLo[0] & 0x20)>>5));
//	  putvalue(DIAG_GPIO_P1_6, ((PortDataLo[0] & 0x40)>>6));
//	  putvalue(DIAG_GPIO_P1_7, ((PortDataLo[0] & 0x80)>>7));
//	
//	  putvalue(DIAG_GPIO_P1_8, (PortDataHi[0] & 0x01));
//	  putvalue(DIAG_GPIO_P1_9, ((PortDataHi[0] & 0x02)>>1));
//	  putvalue(DIAG_GPIO_P1_10, ((PortDataHi[0] & 0x04)>>2));
//	  putvalue(DIAG_GPIO_P1_11, ((PortDataHi[0] & 0x08)>>3));
//	  putvalue(DIAG_GPIO_P1_12, ((PortDataHi[0] & 0x10)>>4));
//	  putvalue(DIAG_GPIO_P1_13, ((PortDataHi[0] & 0x20)>>5));
//	  putvalue(DIAG_GPIO_P1_14, ((PortDataHi[0] & 0x40)>>6));
//	  putvalue(DIAG_GPIO_P1_15, ((PortDataHi[0] & 0x80)>>7));
  
    putvalue(DIAG_GPIO_P1_0_dir, (PortDirLo[0] & 0x01));
	  putvalue(DIAG_GPIO_P1_1_dir, ((PortDirLo[0] & 0x02)>>1));
//	  putvalue(DIAG_GPIO_P1_2_dir, ((PortDirLo[0] & 0x04)>>2));
//	  putvalue(DIAG_GPIO_P1_3_dir, ((PortDirLo[0] & 0x08)>>3));
//	  putvalue(DIAG_GPIO_P1_4_dir, ((PortDirLo[0] & 0x10)>>4));
//	  putvalue(DIAG_GPIO_P1_5_dir, ((PortDirLo[0] & 0x20)>>5));
//	  putvalue(DIAG_GPIO_P1_6_dir, ((PortDirLo[0] & 0x40)>>6));
//	  putvalue(DIAG_GPIO_P1_7_dir, ((PortDirLo[0] & 0x80)>>7));
//	
//	  putvalue(DIAG_GPIO_P1_8_dir, (PortDirHi[0] & 0x01));
//	  putvalue(DIAG_GPIO_P1_9_dir, ((PortDirHi[0] & 0x02)>>1));
//	  putvalue(DIAG_GPIO_P1_10_dir, ((PortDirHi[0] & 0x04)>>2));
//	  putvalue(DIAG_GPIO_P1_11_dir, ((PortDirHi[0] & 0x08)>>3));
//	  putvalue(DIAG_GPIO_P1_12_dir, ((PortDirHi[0] & 0x10)>>4));
//	  putvalue(DIAG_GPIO_P1_13_dir, ((PortDirHi[0] & 0x20)>>5));
//	  putvalue(DIAG_GPIO_P1_14_dir, ((PortDirHi[0] & 0x40)>>6));
//	  putvalue(DIAG_GPIO_P1_15_dir, ((PortDirHi[0] & 0x80)>>7));
  }
  else if ( getValue( DIAG_CTRL_IC_Type_Selector ) == cKI_VS30_HL)
  {
    putvalue(DIAG_GPIO_P1_0, (PortDataLo[0] & 0x01));
//	  putvalue(DIAG_GPIO_P1_1, ((PortDataLo[0] & 0x02)>>1));
	  putvalue(DIAG_GPIO_P1_2, ((PortDataLo[0] & 0x04)>>2));
//	  putvalue(DIAG_GPIO_P1_3, ((PortDataLo[0] & 0x08)>>3));
//	  putvalue(DIAG_GPIO_P1_4, ((PortDataLo[0] & 0x10)>>4));
//	  putvalue(DIAG_GPIO_P1_5, ((PortDataLo[0] & 0x20)>>5));
//	  putvalue(DIAG_GPIO_P1_6, ((PortDataLo[0] & 0x40)>>6));
//	  putvalue(DIAG_GPIO_P1_7, ((PortDataLo[0] & 0x80)>>7));

//	  putvalue(DIAG_GPIO_P1_8, (PortDataHi[0] & 0x01));
	  putvalue(DIAG_GPIO_P1_9, ((PortDataHi[0] & 0x02)>>1));
	  putvalue(DIAG_GPIO_P1_10, ((PortDataHi[0] & 0x04)>>2));
	  putvalue(DIAG_GPIO_P1_11, ((PortDataHi[0] & 0x08)>>3));
//	  putvalue(DIAG_GPIO_P1_12, ((PortDataHi[0] & 0x10)>>4));
//	  putvalue(DIAG_GPIO_P1_13, ((PortDataHi[0] & 0x20)>>5));
//	  putvalue(DIAG_GPIO_P1_14, ((PortDataHi[0] & 0x40)>>6));
//	  putvalue(DIAG_GPIO_P1_15, ((PortDataHi[0] & 0x80)>>7));
  
    putvalue(DIAG_GPIO_P1_0_dir, (PortDirLo[0] & 0x01));
//	  putvalue(DIAG_GPIO_P1_1_dir, ((PortDirLo[0] & 0x02)>>1));
	  putvalue(DIAG_GPIO_P1_2_dir, ((PortDirLo[0] & 0x04)>>2));
//	  putvalue(DIAG_GPIO_P1_3_dir, ((PortDirLo[0] & 0x08)>>3));
//	  putvalue(DIAG_GPIO_P1_4_dir, ((PortDirLo[0] & 0x10)>>4));
//	  putvalue(DIAG_GPIO_P1_5_dir, ((PortDirLo[0] & 0x20)>>5));
//	  putvalue(DIAG_GPIO_P1_6_dir, ((PortDirLo[0] & 0x40)>>6));
//	  putvalue(DIAG_GPIO_P1_7_dir, ((PortDirLo[0] & 0x80)>>7));

//	  putvalue(DIAG_GPIO_P1_8_dir, (PortDirHi[0] & 0x01));
	  putvalue(DIAG_GPIO_P1_9_dir, ((PortDirHi[0] & 0x02)>>1));
	  putvalue(DIAG_GPIO_P1_10_dir, ((PortDirHi[0] & 0x04)>>2));
	  putvalue(DIAG_GPIO_P1_11_dir, ((PortDirHi[0] & 0x08)>>3));
//	  putvalue(DIAG_GPIO_P1_12_dir, ((PortDirHi[0] & 0x10)>>4));
//	  putvalue(DIAG_GPIO_P1_13_dir, ((PortDirHi[0] & 0x20)>>5));
//	  putvalue(DIAG_GPIO_P1_14_dir, ((PortDirHi[0] & 0x40)>>6));
//	  putvalue(DIAG_GPIO_P1_15_dir, ((PortDirHi[0] & 0x80)>>7));
  }  
}

GPIO_EvalSetPort_P2()
{ //HL only
  if ( getValue( DIAG_CTRL_IC_Type_Selector ) == cKI_VS30_EL)
  {
//    putvalue(DIAG_GPIO_P2_0, (PortDataLo[0] & 0x01));
//	  putvalue(DIAG_GPIO_P2_1, ((PortDataLo[0] & 0x02)>>1));
//	  putvalue(DIAG_GPIO_P2_2, ((PortDataLo[0] & 0x04)>>2));
//	  putvalue(DIAG_GPIO_P2_3, ((PortDataLo[0] & 0x08)>>3));
//	  putvalue(DIAG_GPIO_P2_4, ((PortDataLo[0] & 0x10)>>4));
//	  putvalue(DIAG_GPIO_P2_5, ((PortDataLo[0] & 0x20)>>5));
//	  putvalue(DIAG_GPIO_P2_6, ((PortDataLo[0] & 0x40)>>6));
//	  putvalue(DIAG_GPIO_P2_7, ((PortDataLo[0] & 0x80)>>7));
//	
//	  putvalue(DIAG_GPIO_P2_8, (PortDataHi[0] & 0x01));
//	  putvalue(DIAG_GPIO_P2_9, ((PortDataHi[0] & 0x02)>>1));
//	  putvalue(DIAG_GPIO_P2_10, ((PortDataHi[0] & 0x04)>>2));
//	  putvalue(DIAG_GPIO_P2_11, ((PortDataHi[0] & 0x08)>>3));
//	  putvalue(DIAG_GPIO_P2_12, ((PortDataHi[0] & 0x10)>>4));
//	  putvalue(DIAG_GPIO_P2_13, ((PortDataHi[0] & 0x20)>>5));
//	  putvalue(DIAG_GPIO_P2_14, ((PortDataHi[0] & 0x40)>>6));
//	  putvalue(DIAG_GPIO_P2_15, ((PortDataHi[0] & 0x80)>>7));
//  
//    putvalue(DIAG_GPIO_P2_0_dir, (PortDirLo[0] & 0x01));
//	  putvalue(DIAG_GPIO_P2_1_dir, ((PortDirLo[0] & 0x02)>>1));
//	  putvalue(DIAG_GPIO_P2_2_dir, ((PortDirLo[0] & 0x04)>>2));
//	  putvalue(DIAG_GPIO_P2_3_dir, ((PortDirLo[0] & 0x08)>>3));
//	  putvalue(DIAG_GPIO_P2_4_dir, ((PortDirLo[0] & 0x10)>>4));
//	  putvalue(DIAG_GPIO_P2_5_dir, ((PortDirLo[0] & 0x20)>>5));
//	  putvalue(DIAG_GPIO_P2_6_dir, ((PortDirLo[0] & 0x40)>>6));
//	  putvalue(DIAG_GPIO_P2_7_dir, ((PortDirLo[0] & 0x80)>>7));
//	
//	  putvalue(DIAG_GPIO_P2_8_dir, (PortDirHi[0] & 0x01));
//	  putvalue(DIAG_GPIO_P2_9_dir, ((PortDirHi[0] & 0x02)>>1));
//	  putvalue(DIAG_GPIO_P2_10_dir, ((PortDirHi[0] & 0x04)>>2));
//	  putvalue(DIAG_GPIO_P2_11_dir, ((PortDirHi[0] & 0x08)>>3));
//	  putvalue(DIAG_GPIO_P2_12_dir, ((PortDirHi[0] & 0x10)>>4));
//	  putvalue(DIAG_GPIO_P2_13_dir, ((PortDirHi[0] & 0x20)>>5));
//	  putvalue(DIAG_GPIO_P2_14_dir, ((PortDirHi[0] & 0x40)>>6));
//	  putvalue(DIAG_GPIO_P2_15_dir, ((PortDirHi[0] & 0x80)>>7));
  }
  else if ( getValue( DIAG_CTRL_IC_Type_Selector ) == cKI_VS30_HL)
  {
    putvalue(DIAG_GPIO_P2_0, (PortDataLo[0] & 0x01));
//	  putvalue(DIAG_GPIO_P2_1, ((PortDataLo[0] & 0x02)>>1));
//	  putvalue(DIAG_GPIO_P2_2, ((PortDataLo[0] & 0x04)>>2));
//	  putvalue(DIAG_GPIO_P2_3, ((PortDataLo[0] & 0x08)>>3));
	  putvalue(DIAG_GPIO_P2_4, ((PortDataLo[0] & 0x10)>>4));
//	  putvalue(DIAG_GPIO_P2_5, ((PortDataLo[0] & 0x20)>>5));
//	  putvalue(DIAG_GPIO_P2_6, ((PortDataLo[0] & 0x40)>>6));
//	  putvalue(DIAG_GPIO_P2_7, ((PortDataLo[0] & 0x80)>>7));
	
	  putvalue(DIAG_GPIO_P2_8, (PortDataHi[0] & 0x01));
	  putvalue(DIAG_GPIO_P2_9, ((PortDataHi[0] & 0x02)>>1));
	  putvalue(DIAG_GPIO_P2_10, ((PortDataHi[0] & 0x04)>>2));
	  putvalue(DIAG_GPIO_P2_11, ((PortDataHi[0] & 0x08)>>3));
//	  putvalue(DIAG_GPIO_P2_12, ((PortDataHi[0] & 0x10)>>4));
//	  putvalue(DIAG_GPIO_P2_13, ((PortDataHi[0] & 0x20)>>5));
//	  putvalue(DIAG_GPIO_P2_14, ((PortDataHi[0] & 0x40)>>6));
//	  putvalue(DIAG_GPIO_P2_15, ((PortDataHi[0] & 0x80)>>7));
  
    putvalue(DIAG_GPIO_P2_0_dir, (PortDirLo[0] & 0x01));
//	  putvalue(DIAG_GPIO_P2_1_dir, ((PortDirLo[0] & 0x02)>>1));
//	  putvalue(DIAG_GPIO_P2_2_dir, ((PortDirLo[0] & 0x04)>>2));
//	  putvalue(DIAG_GPIO_P2_3_dir, ((PortDirLo[0] & 0x08)>>3));
	  putvalue(DIAG_GPIO_P2_4_dir, ((PortDirLo[0] & 0x10)>>4));
//	  putvalue(DIAG_GPIO_P2_5_dir, ((PortDirLo[0] & 0x20)>>5));
//	  putvalue(DIAG_GPIO_P2_6_dir, ((PortDirLo[0] & 0x40)>>6));
//	  putvalue(DIAG_GPIO_P2_7_dir, ((PortDirLo[0] & 0x80)>>7));
	
	  putvalue(DIAG_GPIO_P2_8_dir, (PortDirHi[0] & 0x01));
	  putvalue(DIAG_GPIO_P2_9_dir, ((PortDirHi[0] & 0x02)>>1));
	  putvalue(DIAG_GPIO_P2_10_dir, ((PortDirHi[0] & 0x04)>>2));
	  putvalue(DIAG_GPIO_P2_11_dir, ((PortDirHi[0] & 0x08)>>3));
//	  putvalue(DIAG_GPIO_P2_12_dir, ((PortDirHi[0] & 0x10)>>4));
//	  putvalue(DIAG_GPIO_P2_13_dir, ((PortDirHi[0] & 0x20)>>5));
//	  putvalue(DIAG_GPIO_P2_14_dir, ((PortDirHi[0] & 0x40)>>6));
//	  putvalue(DIAG_GPIO_P2_15_dir, ((PortDirHi[0] & 0x80)>>7));
  } 
}

GPIO_EvalSetPort_P3()
{
  if ( getValue( DIAG_CTRL_IC_Type_Selector ) == cKI_VS30_EL)
  {
//    putvalue(DIAG_GPIO_P3_0, (PortDataLo[0] & 0x01));
//	  putvalue(DIAG_GPIO_P3_1, ((PortDataLo[0] & 0x02)>>1));
	  putvalue(DIAG_GPIO_P3_2, ((PortDataLo[0] & 0x04)>>2));
//	  putvalue(DIAG_GPIO_P3_3, ((PortDataLo[0] & 0x08)>>3));
//	  putvalue(DIAG_GPIO_P3_4, ((PortDataLo[0] & 0x10)>>4));
//	  putvalue(DIAG_GPIO_P3_5, ((PortDataLo[0] & 0x20)>>5));
//	  putvalue(DIAG_GPIO_P3_6, ((PortDataLo[0] & 0x40)>>6));
	  putvalue(DIAG_GPIO_P3_7, ((PortDataLo[0] & 0x80)>>7));
	
	  putvalue(DIAG_GPIO_P3_8, (PortDataHi[0] & 0x01));
	  putvalue(DIAG_GPIO_P3_9, ((PortDataHi[0] & 0x02)>>1));
//	  putvalue(DIAG_GPIO_P3_10, ((PortDataHi[0] & 0x04)>>2));
//	  putvalue(DIAG_GPIO_P3_11, ((PortDataHi[0] & 0x08)>>3));
//	  putvalue(DIAG_GPIO_P3_12, ((PortDataHi[0] & 0x10)>>4));
//	  putvalue(DIAG_GPIO_P3_13, ((PortDataHi[0] & 0x20)>>5));
//	  putvalue(DIAG_GPIO_P3_14, ((PortDataHi[0] & 0x40)>>6));
//	  putvalue(DIAG_GPIO_P3_15, ((PortDataHi[0] & 0x80)>>7));
  
//    putvalue(DIAG_GPIO_P3_0_dir, (PortDirLo[0] & 0x01));
//	  putvalue(DIAG_GPIO_P3_1_dir, ((PortDirLo[0] & 0x02)>>1));
	  putvalue(DIAG_GPIO_P3_2_dir, ((PortDirLo[0] & 0x04)>>2));
//	  putvalue(DIAG_GPIO_P3_3_dir, ((PortDirLo[0] & 0x08)>>3));
//	  putvalue(DIAG_GPIO_P3_4_dir, ((PortDirLo[0] & 0x10)>>4));
//	  putvalue(DIAG_GPIO_P3_5_dir, ((PortDirLo[0] & 0x20)>>5));
//	  putvalue(DIAG_GPIO_P3_6_dir, ((PortDirLo[0] & 0x40)>>6));
	  putvalue(DIAG_GPIO_P3_7_dir, ((PortDirLo[0] & 0x80)>>7));
	
	  putvalue(DIAG_GPIO_P3_8_dir, (PortDirHi[0] & 0x01));
	  putvalue(DIAG_GPIO_P3_9_dir, ((PortDirHi[0] & 0x02)>>1));
//	  putvalue(DIAG_GPIO_P3_10_dir, ((PortDirHi[0] & 0x04)>>2));
//	  putvalue(DIAG_GPIO_P3_11_dir, ((PortDirHi[0] & 0x08)>>3));
//	  putvalue(DIAG_GPIO_P3_12_dir, ((PortDirHi[0] & 0x10)>>4));
//	  putvalue(DIAG_GPIO_P3_13_dir, ((PortDirHi[0] & 0x20)>>5));
//	  putvalue(DIAG_GPIO_P3_14_dir, ((PortDirHi[0] & 0x40)>>6));
//	  putvalue(DIAG_GPIO_P3_15_dir, ((PortDirHi[0] & 0x80)>>7));
  }
  else if ( getValue( DIAG_CTRL_IC_Type_Selector ) == cKI_VS30_HL)
  {
    putvalue(DIAG_GPIO_P3_0, (PortDataLo[0] & 0x01));
	  putvalue(DIAG_GPIO_P3_1, ((PortDataLo[0] & 0x02)>>1));
	  putvalue(DIAG_GPIO_P3_2, ((PortDataLo[0] & 0x04)>>2));
//	  putvalue(DIAG_GPIO_P3_3, ((PortDataLo[0] & 0x08)>>3));
//	  putvalue(DIAG_GPIO_P3_4, ((PortDataLo[0] & 0x10)>>4));
//	  putvalue(DIAG_GPIO_P3_5, ((PortDataLo[0] & 0x20)>>5));
//	  putvalue(DIAG_GPIO_P3_6, ((PortDataLo[0] & 0x40)>>6));
	  putvalue(DIAG_GPIO_P3_7, ((PortDataLo[0] & 0x80)>>7));
	
	  putvalue(DIAG_GPIO_P3_8, (PortDataHi[0] & 0x01));
	  putvalue(DIAG_GPIO_P3_9, ((PortDataHi[0] & 0x02)>>1));
	  putvalue(DIAG_GPIO_P3_10, ((PortDataHi[0] & 0x04)>>2));
	  putvalue(DIAG_GPIO_P3_11, ((PortDataHi[0] & 0x08)>>3));
	  putvalue(DIAG_GPIO_P3_12, ((PortDataHi[0] & 0x10)>>4));
//	  putvalue(DIAG_GPIO_P3_13, ((PortDataHi[0] & 0x20)>>5));
//	  putvalue(DIAG_GPIO_P3_14, ((PortDataHi[0] & 0x40)>>6));
//	  putvalue(DIAG_GPIO_P3_15, ((PortDataHi[0] & 0x80)>>7));
  
    putvalue(DIAG_GPIO_P3_0_dir, (PortDirLo[0] & 0x01));
	  putvalue(DIAG_GPIO_P3_1_dir, ((PortDirLo[0] & 0x02)>>1));
	  putvalue(DIAG_GPIO_P3_2_dir, ((PortDirLo[0] & 0x04)>>2));
//	  putvalue(DIAG_GPIO_P3_3_dir, ((PortDirLo[0] & 0x08)>>3));
//	  putvalue(DIAG_GPIO_P3_4_dir, ((PortDirLo[0] & 0x10)>>4));
//	  putvalue(DIAG_GPIO_P3_5_dir, ((PortDirLo[0] & 0x20)>>5));
//	  putvalue(DIAG_GPIO_P3_6_dir, ((PortDirLo[0] & 0x40)>>6));
	  putvalue(DIAG_GPIO_P3_7_dir, ((PortDirLo[0] & 0x80)>>7));
	
	  putvalue(DIAG_GPIO_P3_8_dir, (PortDirHi[0] & 0x01));
	  putvalue(DIAG_GPIO_P3_9_dir, ((PortDirHi[0] & 0x02)>>1));
	  putvalue(DIAG_GPIO_P3_10_dir, ((PortDirHi[0] & 0x04)>>2));
	  putvalue(DIAG_GPIO_P3_11_dir, ((PortDirHi[0] & 0x08)>>3));
	  putvalue(DIAG_GPIO_P3_12_dir, ((PortDirHi[0] & 0x10)>>4));
//	  putvalue(DIAG_GPIO_P3_13_dir, ((PortDirHi[0] & 0x20)>>5));
//	  putvalue(DIAG_GPIO_P3_14_dir, ((PortDirHi[0] & 0x40)>>6));
//	  putvalue(DIAG_GPIO_P3_15_dir, ((PortDirHi[0] & 0x80)>>7));
  }  
}

GPIO_EvalSetPort_P10()
{
  if ( getValue( DIAG_CTRL_IC_Type_Selector ) == cKI_VS30_EL)
  {

//    ltoa((PortDirLo[0] & 0x01), PortDirStrLo_0, 10);
//    ltoa(((PortDirLo[0] & 0x02)>>1), PortDirStrLo_1, 10);
//    ltoa(((PortDirLo[0] & 0x04)>>2), PortDirStrLo_2, 10);
//    ltoa(((PortDirLo[0] & 0x08)>>3), PortDirStrLo_3, 10);
//    ltoa(((PortDirLo[0] & 0x10)>>4), PortDirStrLo_4, 10);
//    ltoa(((PortDirLo[0] & 0x20)>>5), PortDirStrLo_5, 10);
//    ltoa(((PortDirLo[0] & 0x40)>>6), PortDirStrLo_6, 10);
//    ltoa(((PortDirLo[0] & 0x80)>>7), PortDirStrLo_7, 10);
    
//    ltoa((PortDirHi[0] & 0x01), PortDirStrHi_0, 10);
    ltoa(((PortDirHi[0] & 0x02)>>1), PortDirStrHi_1, 10);
    ltoa(((PortDirHi[0] & 0x04)>>2), PortDirStrHi_2, 10);
    ltoa(((PortDirHi[0] & 0x08)>>3), PortDirStrHi_3, 10);
//    ltoa(((PortDirHi[0] & 0x10)>>4), PortDirStrHi_4, 10);
//    ltoa(((PortDirHi[0] & 0x20)>>5), PortDirStrHi_5, 10);
//    ltoa(((PortDirHi[0] & 0x40)>>6), PortDirStrHi_6, 10);
//    ltoa(((PortDirHi[0] & 0x80)>>7), PortDirStrHi_7, 10);
      
//    putvalue(DIAG_GPIO_P10_0, (PortDataLo[0] & 0x01)); //ADC
//	  putvalue(DIAG_GPIO_P10_1, ((PortDataLo[0] & 0x02)>>1));//ADC
//	  putvalue(DIAG_GPIO_P10_2, ((PortDataLo[0] & 0x04)>>2));//ADC
//	  putvalue(DIAG_GPIO_P10_3, ((PortDataLo[0] & 0x08)>>3));//ADC
//	  putvalue(DIAG_GPIO_P10_4, ((PortDataLo[0] & 0x10)>>4));//ADC
//	  putvalue(DIAG_GPIO_P10_5, ((PortDataLo[0] & 0x20)>>5));//ADC
//	  putvalue(DIAG_GPIO_P10_6, ((PortDataLo[0] & 0x40)>>6));//ADC
//	  putvalue(DIAG_GPIO_P10_7, ((PortDataLo[0] & 0x80)>>7));//ADC
	
//	  putvalue(DIAG_GPIO_P10_8, (PortDataHi[0] & 0x01));
	  putvalue(DIAG_GPIO_P10_9, ((PortDataHi[0] & 0x02)>>1));
	  putvalue(DIAG_GPIO_P10_10, ((PortDataHi[0] & 0x04)>>2));
	  putvalue(DIAG_GPIO_P10_11, ((PortDataHi[0] & 0x08)>>3));
//	  putvalue(DIAG_GPIO_P10_12, ((PortDataHi[0] & 0x10)>>4));
//	  putvalue(DIAG_GPIO_P10_13, ((PortDataHi[0] & 0x20)>>5));
//	  putvalue(DIAG_GPIO_P10_14, ((PortDataHi[0] & 0x40)>>6));
//	  putvalue(DIAG_GPIO_P10_15, ((PortDataHi[0] & 0x80)>>7));
  
    putvalue(DIAG_GPIO_P10_0_dir, "ADC");//ADC
	  putvalue(DIAG_GPIO_P10_1_dir, "ADC");//ADC
	  putvalue(DIAG_GPIO_P10_2_dir, "ADC");//ADC
	  putvalue(DIAG_GPIO_P10_3_dir, "ADC");//ADC
	  putvalue(DIAG_GPIO_P10_4_dir, "ADC");//ADC
	  putvalue(DIAG_GPIO_P10_5_dir, "ADC");//ADC
	  putvalue(DIAG_GPIO_P10_6_dir, "ADC");//ADC
	  putvalue(DIAG_GPIO_P10_7_dir, "ADC");//ADC
	
	  putvalue(DIAG_GPIO_P10_8_dir, "ADC");//ADC
	  putvalue(DIAG_GPIO_P10_9_dir, PortDirStrHi_1);
	  putvalue(DIAG_GPIO_P10_10_dir, PortDirStrHi_2);
	  putvalue(DIAG_GPIO_P10_11_dir, PortDirStrHi_3);
	  putvalue(DIAG_GPIO_P10_12_dir, "ff");//not used
	  putvalue(DIAG_GPIO_P10_13_dir, "ff");//not used
	  putvalue(DIAG_GPIO_P10_14_dir, "ff");//not used
	  putvalue(DIAG_GPIO_P10_15_dir, "ff");//not used    
  }
  else if ( getValue( DIAG_CTRL_IC_Type_Selector ) == cKI_VS30_HL)
  {
//    putvalue(DIAG_GPIO_P10_0, (PortDataLo[0] & 0x01));
//	  putvalue(DIAG_GPIO_P10_1, ((PortDataLo[0] & 0x02)>>1));
	  putvalue(DIAG_GPIO_P10_2, ((PortDataLo[0] & 0x04)>>2));
//	  putvalue(DIAG_GPIO_P10_3, ((PortDataLo[0] & 0x08)>>3));
//	  putvalue(DIAG_GPIO_P10_4, ((PortDataLo[0] & 0x10)>>4));
//	  putvalue(DIAG_GPIO_P10_5, ((PortDataLo[0] & 0x20)>>5));
//	  putvalue(DIAG_GPIO_P10_6, ((PortDataLo[0] & 0x40)>>6));
//	  putvalue(DIAG_GPIO_P10_7, ((PortDataLo[0] & 0x80)>>7));
	
//	  putvalue(DIAG_GPIO_P10_8, (PortDataHi[0] & 0x01));
//	  putvalue(DIAG_GPIO_P10_9, ((PortDataHi[0] & 0x02)>>1));
//	  putvalue(DIAG_GPIO_P10_10, ((PortDataHi[0] & 0x04)>>2));
	  putvalue(DIAG_GPIO_P10_11, ((PortDataHi[0] & 0x08)>>3));
//	  putvalue(DIAG_GPIO_P10_12, ((PortDataHi[0] & 0x10)>>4));
//	  putvalue(DIAG_GPIO_P10_13, ((PortDataHi[0] & 0x20)>>5));
//	  putvalue(DIAG_GPIO_P10_14, ((PortDataHi[0] & 0x40)>>6));
//	  putvalue(DIAG_GPIO_P10_15, ((PortDataHi[0] & 0x80)>>7));
  
    putvalue(DIAG_GPIO_P10_0_dir, "ADC");//ADC
	  putvalue(DIAG_GPIO_P10_1_dir, "ADC");//ADC
	  putvalue(DIAG_GPIO_P10_2_dir, "ff");//IO
	  putvalue(DIAG_GPIO_P10_3_dir, "ADC");//ADC
	  putvalue(DIAG_GPIO_P10_4_dir, "ADC");//ADC
	  putvalue(DIAG_GPIO_P10_5_dir, "ADC");//ADC
	  putvalue(DIAG_GPIO_P10_6_dir, "ADC");//ADC
	  putvalue(DIAG_GPIO_P10_7_dir, "ADC");//ADC
	
	  putvalue(DIAG_GPIO_P10_8_dir, "ADC");//ADC
	  putvalue(DIAG_GPIO_P10_9_dir, "ADC");//ADC
	  putvalue(DIAG_GPIO_P10_10_dir, "ADC");//ADC
	  putvalue(DIAG_GPIO_P10_11_dir, "ff");//IO
	  putvalue(DIAG_GPIO_P10_12_dir, "ff");//not used
	  putvalue(DIAG_GPIO_P10_13_dir, "ff");//not used
	  putvalue(DIAG_GPIO_P10_14_dir, "ff");//not used
	  putvalue(DIAG_GPIO_P10_15_dir, "ff");//not used
  }  
}

GPIO_EvalSetPort_P11()
{
  if ( getValue( DIAG_CTRL_IC_Type_Selector ) == cKI_VS30_EL)
  {
    putvalue(DIAG_GPIO_P11_0, (PortDataLo[0] & 0x01));
//	  putvalue(DIAG_GPIO_P11_1, ((PortDataLo[0] & 0x02)>>1));//ADC?
	  putvalue(DIAG_GPIO_P11_2, ((PortDataLo[0] & 0x04)>>2));
	  putvalue(DIAG_GPIO_P11_3, ((PortDataLo[0] & 0x08)>>3));
//	  putvalue(DIAG_GPIO_P11_4, ((PortDataLo[0] & 0x10)>>4));
//	  putvalue(DIAG_GPIO_P11_5, ((PortDataLo[0] & 0x20)>>5));
//	  putvalue(DIAG_GPIO_P11_6, ((PortDataLo[0] & 0x40)>>6));
//	  putvalue(DIAG_GPIO_P11_7, ((PortDataLo[0] & 0x80)>>7));
	
//	  putvalue(DIAG_GPIO_P11_8, (PortDataHi[0] & 0x01));
//	  putvalue(DIAG_GPIO_P11_9, ((PortDataHi[0] & 0x02)>>1));
//	  putvalue(DIAG_GPIO_P11_10, ((PortDataHi[0] & 0x04)>>2));
//	  putvalue(DIAG_GPIO_P11_11, ((PortDataHi[0] & 0x08)>>3));
//	  putvalue(DIAG_GPIO_P11_12, ((PortDataHi[0] & 0x10)>>4));
//	  putvalue(DIAG_GPIO_P11_13, ((PortDataHi[0] & 0x20)>>5));
//	  putvalue(DIAG_GPIO_P11_14, ((PortDataHi[0] & 0x40)>>6));
//	  putvalue(DIAG_GPIO_P11_15, ((PortDataHi[0] & 0x80)>>7));
  
    putvalue(DIAG_GPIO_P11_0_dir, (PortDirLo[0] & 0x01));
//	  putvalue(DIAG_GPIO_P11_1_dir, ((PortDirLo[0] & 0x02)>>1));
	  putvalue(DIAG_GPIO_P11_2_dir, ((PortDirLo[0] & 0x04)>>2));
	  putvalue(DIAG_GPIO_P11_3_dir, ((PortDirLo[0] & 0x08)>>3));
//	  putvalue(DIAG_GPIO_P11_4_dir, ((PortDirLo[0] & 0x10)>>4));
//	  putvalue(DIAG_GPIO_P11_5_dir, ((PortDirLo[0] & 0x20)>>5));
//	  putvalue(DIAG_GPIO_P11_6_dir, ((PortDirLo[0] & 0x40)>>6));
//	  putvalue(DIAG_GPIO_P11_7_dir, ((PortDirLo[0] & 0x80)>>7));
	
//	  putvalue(DIAG_GPIO_P11_8_dir, (PortDirHi[0] & 0x01));
//	  putvalue(DIAG_GPIO_P11_9_dir, ((PortDirHi[0] & 0x02)>>1));
//	  putvalue(DIAG_GPIO_P11_10_dir, ((PortDirHi[0] & 0x04)>>2));
//	  putvalue(DIAG_GPIO_P11_11_dir, ((PortDirHi[0] & 0x08)>>3));
//	  putvalue(DIAG_GPIO_P11_12_dir, ((PortDirHi[0] & 0x10)>>4));
//	  putvalue(DIAG_GPIO_P11_13_dir, ((PortDirHi[0] & 0x20)>>5));
//	  putvalue(DIAG_GPIO_P11_14_dir, ((PortDirHi[0] & 0x40)>>6));
//	  putvalue(DIAG_GPIO_P11_15_dir, ((PortDirHi[0] & 0x80)>>7));
  }
  else if ( getValue( DIAG_CTRL_IC_Type_Selector ) == cKI_VS30_HL)
  {
    putvalue(DIAG_GPIO_P11_0, (PortDataLo[0] & 0x01));
	  putvalue(DIAG_GPIO_P11_1, ((PortDataLo[0] & 0x02)>>1));
	  putvalue(DIAG_GPIO_P11_2, ((PortDataLo[0] & 0x04)>>2));
	  putvalue(DIAG_GPIO_P11_3, ((PortDataLo[0] & 0x08)>>3));
	  putvalue(DIAG_GPIO_P11_4, ((PortDataLo[0] & 0x10)>>4));
	  putvalue(DIAG_GPIO_P11_5, ((PortDataLo[0] & 0x20)>>5));
	  putvalue(DIAG_GPIO_P11_6, ((PortDataLo[0] & 0x40)>>6));
	  putvalue(DIAG_GPIO_P11_7, ((PortDataLo[0] & 0x80)>>7));
	
//	  putvalue(DIAG_GPIO_P11_8, (PortDataHi[0] & 0x01));
//	  putvalue(DIAG_GPIO_P11_9, ((PortDataHi[0] & 0x02)>>1));
//	  putvalue(DIAG_GPIO_P11_10, ((PortDataHi[0] & 0x04)>>2));
//	  putvalue(DIAG_GPIO_P11_11, ((PortDataHi[0] & 0x08)>>3));
//	  putvalue(DIAG_GPIO_P11_12, ((PortDataHi[0] & 0x10)>>4));
//	  putvalue(DIAG_GPIO_P11_13, ((PortDataHi[0] & 0x20)>>5));
//	  putvalue(DIAG_GPIO_P11_14, ((PortDataHi[0] & 0x40)>>6));
//	  putvalue(DIAG_GPIO_P11_15, ((PortDataHi[0] & 0x80)>>7));
  
    putvalue(DIAG_GPIO_P11_0_dir, (PortDirLo[0] & 0x01));
	  putvalue(DIAG_GPIO_P11_1_dir, ((PortDirLo[0] & 0x02)>>1));
	  putvalue(DIAG_GPIO_P11_2_dir, ((PortDirLo[0] & 0x04)>>2));
	  putvalue(DIAG_GPIO_P11_3_dir, ((PortDirLo[0] & 0x08)>>3));
	  putvalue(DIAG_GPIO_P11_4_dir, ((PortDirLo[0] & 0x10)>>4));
	  putvalue(DIAG_GPIO_P11_5_dir, ((PortDirLo[0] & 0x20)>>5));
	  putvalue(DIAG_GPIO_P11_6_dir, ((PortDirLo[0] & 0x40)>>6));
	  putvalue(DIAG_GPIO_P11_7_dir, ((PortDirLo[0] & 0x80)>>7));
	
//	  putvalue(DIAG_GPIO_P11_8_dir, (PortDirHi[0] & 0x01));
//	  putvalue(DIAG_GPIO_P11_9_dir, ((PortDirHi[0] & 0x02)>>1));
//	  putvalue(DIAG_GPIO_P11_10_dir, ((PortDirHi[0] & 0x04)>>2));
//	  putvalue(DIAG_GPIO_P11_11_dir, ((PortDirHi[0] & 0x08)>>3));
//	  putvalue(DIAG_GPIO_P11_12_dir, ((PortDirHi[0] & 0x10)>>4));
//	  putvalue(DIAG_GPIO_P11_13_dir, ((PortDirHi[0] & 0x20)>>5));
//	  putvalue(DIAG_GPIO_P11_14_dir, ((PortDirHi[0] & 0x40)>>6));
//	  putvalue(DIAG_GPIO_P11_15_dir, ((PortDirHi[0] & 0x80)>>7));
  }  
}

GPIO_EvalSetPort_P16()
{
  if ( getValue( DIAG_CTRL_IC_Type_Selector ) == cKI_VS30_EL)
  {
//    ltoa((PortDirLo[0] & 0x01), PortDirStrLo_0, 10);
//    ltoa(((PortDirLo[0] & 0x02)>>1), PortDirStrLo_1, 10);
    ltoa(((PortDirLo[0] & 0x04)>>2), PortDirStrLo_2, 10);
//    ltoa(((PortDirLo[0] & 0x08)>>3), PortDirStrLo_3, 10);
//    ltoa(((PortDirLo[0] & 0x10)>>4), PortDirStrLo_4, 10);
//    ltoa(((PortDirLo[0] & 0x20)>>5), PortDirStrLo_5, 10);
//    ltoa(((PortDirLo[0] & 0x40)>>6), PortDirStrLo_6, 10);
//    ltoa(((PortDirLo[0] & 0x80)>>7), PortDirStrLo_7, 10);
    
    ltoa((PortDirHi[0] & 0x01), PortDirStrHi_0, 10);
    ltoa(((PortDirHi[0] & 0x02)>>1), PortDirStrHi_1, 10);
    ltoa(((PortDirHi[0] & 0x04)>>2), PortDirStrHi_2, 10);
    ltoa(((PortDirHi[0] & 0x08)>>3), PortDirStrHi_3, 10);
//    ltoa(((PortDirHi[0] & 0x10)>>4), PortDirStrHi_4, 10);
//    ltoa(((PortDirHi[0] & 0x20)>>5), PortDirStrHi_5, 10);
//    ltoa(((PortDirHi[0] & 0x40)>>6), PortDirStrHi_6, 10);
//    ltoa(((PortDirHi[0] & 0x80)>>7), PortDirStrHi_7, 10);
    
//    putvalue(DIAG_GPIO_P16_0, (PortDataLo[0] & 0x01));//PWM
//	  putvalue(DIAG_GPIO_P16_1, ((PortDataLo[0] & 0x02)>>1));//PWM
	  putvalue(DIAG_GPIO_P16_2, ((PortDataLo[0] & 0x04)>>2));
//	  putvalue(DIAG_GPIO_P16_3, ((PortDataLo[0] & 0x08)>>3));//PWM
//	  putvalue(DIAG_GPIO_P16_4, ((PortDataLo[0] & 0x10)>>4));//PWM
//	  putvalue(DIAG_GPIO_P16_5, ((PortDataLo[0] & 0x20)>>5));//PWM
//	  putvalue(DIAG_GPIO_P16_6, ((PortDataLo[0] & 0x40)>>6));//PWM
//	  putvalue(DIAG_GPIO_P16_7, ((PortDataLo[0] & 0x80)>>7));//PWM
	
	  putvalue(DIAG_GPIO_P16_8, (PortDataHi[0] & 0x01));
	  putvalue(DIAG_GPIO_P16_9, ((PortDataHi[0] & 0x02)>>1));
	  putvalue(DIAG_GPIO_P16_10, ((PortDataHi[0] & 0x04)>>2));
	  putvalue(DIAG_GPIO_P16_11, ((PortDataHi[0] & 0x08)>>3));
//	  putvalue(DIAG_GPIO_P16_12, ((PortDataHi[0] & 0x10)>>4));
//	  putvalue(DIAG_GPIO_P16_13, ((PortDataHi[0] & 0x20)>>5));
//	  putvalue(DIAG_GPIO_P16_14, ((PortDataHi[0] & 0x40)>>6));
//	  putvalue(DIAG_GPIO_P16_15, ((PortDataHi[0] & 0x80)>>7));
  
    putvalue(DIAG_GPIO_P16_0_dir, "PWM");//ADC
	  putvalue(DIAG_GPIO_P16_1_dir, "PWM");//ADC
	  putvalue(DIAG_GPIO_P16_2_dir, PortDirStrLo_2);
	  putvalue(DIAG_GPIO_P16_3_dir, "PWM");//ADC
	  putvalue(DIAG_GPIO_P16_4_dir, "PWM");//ADC
	  putvalue(DIAG_GPIO_P16_5_dir, "PWM");//ADC
	  putvalue(DIAG_GPIO_P16_6_dir, "PWM");//ADC
	  putvalue(DIAG_GPIO_P16_7_dir, "PWM");//ADC
	
	  putvalue(DIAG_GPIO_P16_8_dir, PortDirStrHi_0);
	  putvalue(DIAG_GPIO_P16_9_dir, PortDirStrHi_1);
	  putvalue(DIAG_GPIO_P16_10_dir, PortDirStrHi_2);
	  putvalue(DIAG_GPIO_P16_11_dir, PortDirStrHi_3);
	  putvalue(DIAG_GPIO_P16_12_dir, "ff");//not used
	  putvalue(DIAG_GPIO_P16_13_dir, "ff");//not used
    putvalue(DIAG_GPIO_P16_14_dir, "ff");//not used
	  putvalue(DIAG_GPIO_P16_15_dir, "ff");//not used
  }
  else if ( getValue( DIAG_CTRL_IC_Type_Selector ) == cKI_VS30_HL)
  {
    
    ltoa((PortDirLo[0] & 0x01), PortDirStrLo_0, 10);
    ltoa(((PortDirLo[0] & 0x02)>>1), PortDirStrLo_1, 10);
    ltoa(((PortDirLo[0] & 0x04)>>2), PortDirStrLo_2, 10);
    ltoa(((PortDirLo[0] & 0x08)>>3), PortDirStrLo_3, 10);
    ltoa(((PortDirLo[0] & 0x10)>>4), PortDirStrLo_4, 10);
    ltoa(((PortDirLo[0] & 0x20)>>5), PortDirStrLo_5, 10);
    ltoa(((PortDirLo[0] & 0x40)>>6), PortDirStrLo_6, 10);
    ltoa(((PortDirLo[0] & 0x80)>>7), PortDirStrLo_7, 10);
    
    ltoa((PortDirHi[0] & 0x01), PortDirStrHi_0, 10);
    ltoa(((PortDirHi[0] & 0x02)>>1), PortDirStrHi_1, 10);
    ltoa(((PortDirHi[0] & 0x04)>>2), PortDirStrHi_2, 10);
    ltoa(((PortDirHi[0] & 0x08)>>3), PortDirStrHi_3, 10);
//    ltoa(((PortDirHi[0] & 0x10)>>4), PortDirStrHi_4, 10);
//    ltoa(((PortDirHi[0] & 0x20)>>5), PortDirStrHi_5, 10);
//    ltoa(((PortDirHi[0] & 0x40)>>6), PortDirStrHi_6, 10);
//    ltoa(((PortDirHi[0] & 0x80)>>7), PortDirStrHi_7, 10);
    
    putvalue(DIAG_GPIO_P16_0, (PortDataLo[0] & 0x01));
	  putvalue(DIAG_GPIO_P16_1, ((PortDataLo[0] & 0x02)>>1));
	  putvalue(DIAG_GPIO_P16_2, ((PortDataLo[0] & 0x04)>>2));
	  putvalue(DIAG_GPIO_P16_3, ((PortDataLo[0] & 0x08)>>3));
	  putvalue(DIAG_GPIO_P16_4, ((PortDataLo[0] & 0x10)>>4));
	  putvalue(DIAG_GPIO_P16_5, ((PortDataLo[0] & 0x20)>>5));
	  putvalue(DIAG_GPIO_P16_6, ((PortDataLo[0] & 0x40)>>6));
	  putvalue(DIAG_GPIO_P16_7, ((PortDataLo[0] & 0x80)>>7));
	
	  putvalue(DIAG_GPIO_P16_8, (PortDataHi[0] & 0x01));
	  putvalue(DIAG_GPIO_P16_9, ((PortDataHi[0] & 0x02)>>1));
	  putvalue(DIAG_GPIO_P16_10, ((PortDataHi[0] & 0x04)>>2));
	  putvalue(DIAG_GPIO_P16_11, ((PortDataHi[0] & 0x08)>>3));
//	  putvalue(DIAG_GPIO_P16_12, ((PortDataHi[0] & 0x10)>>4));
//	  putvalue(DIAG_GPIO_P16_13, ((PortDataHi[0] & 0x20)>>5));
//	  putvalue(DIAG_GPIO_P16_14, ((PortDataHi[0] & 0x40)>>6));
//	  putvalue(DIAG_GPIO_P16_15, ((PortDataHi[0] & 0x80)>>7));
  
    putvalue(DIAG_GPIO_P16_0_dir, PortDirStrLo_0);
	  putvalue(DIAG_GPIO_P16_1_dir, PortDirStrLo_1);
	  putvalue(DIAG_GPIO_P16_2_dir, PortDirStrLo_2);
	  putvalue(DIAG_GPIO_P16_3_dir, PortDirStrLo_3);
	  putvalue(DIAG_GPIO_P16_4_dir, PortDirStrLo_4);
	  putvalue(DIAG_GPIO_P16_5_dir, PortDirStrLo_5);
	  putvalue(DIAG_GPIO_P16_6_dir, PortDirStrLo_6);
	  putvalue(DIAG_GPIO_P16_7_dir, PortDirStrLo_7);
	
	  putvalue(DIAG_GPIO_P16_8_dir, PortDirStrHi_0);
	  putvalue(DIAG_GPIO_P16_9_dir, PortDirStrHi_1);
	  putvalue(DIAG_GPIO_P16_10_dir, PortDirStrHi_2);
	  putvalue(DIAG_GPIO_P16_11_dir, PortDirStrHi_3);
	  putvalue(DIAG_GPIO_P16_12_dir, "ff");//not used
	  putvalue(DIAG_GPIO_P16_13_dir, "ff");//not used
	  putvalue(DIAG_GPIO_P16_14_dir, "ff");//not used
	  putvalue(DIAG_GPIO_P16_15_dir, "ff");//not used
  }  
}

GPIO_EvalSetPort_P17()
{
  if ( getValue( DIAG_CTRL_IC_Type_Selector ) == cKI_VS30_EL)
  {
    putvalue(DIAG_GPIO_P17_0, (PortDataLo[0] & 0x01));
	  putvalue(DIAG_GPIO_P17_1, ((PortDataLo[0] & 0x02)>>1));
	  putvalue(DIAG_GPIO_P17_2, ((PortDataLo[0] & 0x04)>>2));
	  putvalue(DIAG_GPIO_P17_3, ((PortDataLo[0] & 0x08)>>3));
//	  putvalue(DIAG_GPIO_P17_4, ((PortDataLo[0] & 0x10)>>4));
//	  putvalue(DIAG_GPIO_P17_5, ((PortDataLo[0] & 0x20)>>5));
//	  putvalue(DIAG_GPIO_P17_6, ((PortDataLo[0] & 0x40)>>6));
//	  putvalue(DIAG_GPIO_P17_7, ((PortDataLo[0] & 0x80)>>7));
	
//	  putvalue(DIAG_GPIO_P17_8, (PortDataHi[0] & 0x01));
//	  putvalue(DIAG_GPIO_P17_9, ((PortDataHi[0] & 0x02)>>1));
//	  putvalue(DIAG_GPIO_P17_10, ((PortDataHi[0] & 0x04)>>2));
//	  putvalue(DIAG_GPIO_P17_11, ((PortDataHi[0] & 0x08)>>3));
//	  putvalue(DIAG_GPIO_P17_12, ((PortDataHi[0] & 0x10)>>4));
//	  putvalue(DIAG_GPIO_P17_13, ((PortDataHi[0] & 0x20)>>5));
//	  putvalue(DIAG_GPIO_P17_14, ((PortDataHi[0] & 0x40)>>6));
//	  putvalue(DIAG_GPIO_P17_15, ((PortDataHi[0] & 0x80)>>7));
  
    putvalue(DIAG_GPIO_P17_0_dir, (PortDirLo[0] & 0x01));
	  putvalue(DIAG_GPIO_P17_1_dir, ((PortDirLo[0] & 0x02)>>1));
	  putvalue(DIAG_GPIO_P17_2_dir, ((PortDirLo[0] & 0x04)>>2));
	  putvalue(DIAG_GPIO_P17_3_dir, ((PortDirLo[0] & 0x08)>>3));
//	  putvalue(DIAG_GPIO_P17_4_dir, ((PortDirLo[0] & 0x10)>>4));
//	  putvalue(DIAG_GPIO_P17_5_dir, ((PortDirLo[0] & 0x20)>>5));
//	  putvalue(DIAG_GPIO_P17_6_dir, ((PortDirLo[0] & 0x40)>>6));
//	  putvalue(DIAG_GPIO_P17_7_dir, ((PortDirLo[0] & 0x80)>>7));
	
//	  putvalue(DIAG_GPIO_P17_8_dir, (PortDirHi[0] & 0x01));
//	  putvalue(DIAG_GPIO_P17_9_dir, ((PortDirHi[0] & 0x02)>>1));
//	  putvalue(DIAG_GPIO_P17_10_dir, ((PortDirHi[0] & 0x04)>>2));
//	  putvalue(DIAG_GPIO_P17_11_dir, ((PortDirHi[0] & 0x08)>>3));
//	  putvalue(DIAG_GPIO_P17_12_dir, ((PortDirHi[0] & 0x10)>>4));
//	  putvalue(DIAG_GPIO_P17_13_dir, ((PortDirHi[0] & 0x20)>>5));
//	  putvalue(DIAG_GPIO_P17_14_dir, ((PortDirHi[0] & 0x40)>>6));
//	  putvalue(DIAG_GPIO_P17_15_dir, ((PortDirHi[0] & 0x80)>>7));
  } 
  else if ( getValue( DIAG_CTRL_IC_Type_Selector ) == cKI_VS30_HL)
  {
    putvalue(DIAG_GPIO_P17_0, (PortDataLo[0] & 0x01));
	  putvalue(DIAG_GPIO_P17_1, ((PortDataLo[0] & 0x02)>>1));
	  putvalue(DIAG_GPIO_P17_2, ((PortDataLo[0] & 0x04)>>2));
	  putvalue(DIAG_GPIO_P17_3, ((PortDataLo[0] & 0x08)>>3));
//	  putvalue(DIAG_GPIO_P17_4, ((PortDataLo[0] & 0x10)>>4));
//	  putvalue(DIAG_GPIO_P17_5, ((PortDataLo[0] & 0x20)>>5));
//	  putvalue(DIAG_GPIO_P17_6, ((PortDataLo[0] & 0x40)>>6));
//	  putvalue(DIAG_GPIO_P17_7, ((PortDataLo[0] & 0x80)>>7));

//	  putvalue(DIAG_GPIO_P17_8, (PortDataHi[0] & 0x01));
//	  putvalue(DIAG_GPIO_P17_9, ((PortDataHi[0] & 0x02)>>1));
//	  putvalue(DIAG_GPIO_P17_10, ((PortDataHi[0] & 0x04)>>2));
//	  putvalue(DIAG_GPIO_P17_11, ((PortDataHi[0] & 0x08)>>3));
//	  putvalue(DIAG_GPIO_P17_12, ((PortDataHi[0] & 0x10)>>4));
//	  putvalue(DIAG_GPIO_P17_13, ((PortDataHi[0] & 0x20)>>5));
//	  putvalue(DIAG_GPIO_P17_14, ((PortDataHi[0] & 0x40)>>6));
//	  putvalue(DIAG_GPIO_P17_15, ((PortDataHi[0] & 0x80)>>7));
  
    putvalue(DIAG_GPIO_P17_0_dir, (PortDirLo[0] & 0x01));
	  putvalue(DIAG_GPIO_P17_1_dir, ((PortDirLo[0] & 0x02)>>1));
	  putvalue(DIAG_GPIO_P17_2_dir, ((PortDirLo[0] & 0x04)>>2));
	  putvalue(DIAG_GPIO_P17_3_dir, ((PortDirLo[0] & 0x08)>>3));
//	  putvalue(DIAG_GPIO_P17_4_dir, ((PortDirLo[0] & 0x10)>>4));
//	  putvalue(DIAG_GPIO_P17_5_dir, ((PortDirLo[0] & 0x20)>>5));
//	  putvalue(DIAG_GPIO_P17_6_dir, ((PortDirLo[0] & 0x40)>>6));
//	  putvalue(DIAG_GPIO_P17_7_dir, ((PortDirLo[0] & 0x80)>>7));

//	  putvalue(DIAG_GPIO_P17_8_dir, (PortDirHi[0] & 0x01));
//	  putvalue(DIAG_GPIO_P17_9_dir, ((PortDirHi[0] & 0x02)>>1));
//	  putvalue(DIAG_GPIO_P17_10_dir, ((PortDirHi[0] & 0x04)>>2));
//	  putvalue(DIAG_GPIO_P17_11_dir, ((PortDirHi[0] & 0x08)>>3));
//	  putvalue(DIAG_GPIO_P17_12_dir, ((PortDirHi[0] & 0x10)>>4));
//	  putvalue(DIAG_GPIO_P17_13_dir, ((PortDirHi[0] & 0x20)>>5));
//	  putvalue(DIAG_GPIO_P17_14_dir, ((PortDirHi[0] & 0x40)>>6));
//	  putvalue(DIAG_GPIO_P17_15_dir, ((PortDirHi[0] & 0x80)>>7));
  }  
}

GPIO_EvalSetPort_P21()
{
  if ( getValue( DIAG_CTRL_IC_Type_Selector ) == cKI_VS30_EL)
  {
//    putvalue(DIAG_GPIO_P21_0, (PortDataLo[0] & 0x01));
//	  putvalue(DIAG_GPIO_P21_1, ((PortDataLo[0] & 0x02)>>1));
//	  putvalue(DIAG_GPIO_P21_2, ((PortDataLo[0] & 0x04)>>2));
//	  putvalue(DIAG_GPIO_P21_3, ((PortDataLo[0] & 0x08)>>3));
//	  putvalue(DIAG_GPIO_P21_4, ((PortDataLo[0] & 0x10)>>4));
//	  putvalue(DIAG_GPIO_P21_5, ((PortDataLo[0] & 0x20)>>5));
//	  putvalue(DIAG_GPIO_P21_6, ((PortDataLo[0] & 0x40)>>6));
//	  putvalue(DIAG_GPIO_P21_7, ((PortDataLo[0] & 0x80)>>7));
	
//	  putvalue(DIAG_GPIO_P21_8, (PortDataHi[0] & 0x01));
//	  putvalue(DIAG_GPIO_P21_9, ((PortDataHi[0] & 0x02)>>1));
//	  putvalue(DIAG_GPIO_P21_10, ((PortDataHi[0] & 0x04)>>2));
//	  putvalue(DIAG_GPIO_P21_11, ((PortDataHi[0] & 0x08)>>3));
//	  putvalue(DIAG_GPIO_P21_12, ((PortDataHi[0] & 0x10)>>4));
//	  putvalue(DIAG_GPIO_P21_13, ((PortDataHi[0] & 0x20)>>5));
//	  putvalue(DIAG_GPIO_P21_14, ((PortDataHi[0] & 0x40)>>6));
//	  putvalue(DIAG_GPIO_P21_15, ((PortDataHi[0] & 0x80)>>7));
  
//    putvalue(DIAG_GPIO_P21_0_dir, (PortDirLo[0] & 0x01));
//	  putvalue(DIAG_GPIO_P21_1_dir, ((PortDirLo[0] & 0x02)>>1));
//	  putvalue(DIAG_GPIO_P21_2_dir, ((PortDirLo[0] & 0x04)>>2));
//	  putvalue(DIAG_GPIO_P21_3_dir, ((PortDirLo[0] & 0x08)>>3));
//	  putvalue(DIAG_GPIO_P21_4_dir, ((PortDirLo[0] & 0x10)>>4));
//	  putvalue(DIAG_GPIO_P21_5_dir, ((PortDirLo[0] & 0x20)>>5));
//	  putvalue(DIAG_GPIO_P21_6_dir, ((PortDirLo[0] & 0x40)>>6));
//	  putvalue(DIAG_GPIO_P21_7_dir, ((PortDirLo[0] & 0x80)>>7));
	
//	  putvalue(DIAG_GPIO_P21_8_dir, (PortDirHi[0] & 0x01));
//	  putvalue(DIAG_GPIO_P21_9_dir, ((PortDirHi[0] & 0x02)>>1));
//	  putvalue(DIAG_GPIO_P21_10_dir, ((PortDirHi[0] & 0x04)>>2));
//	  putvalue(DIAG_GPIO_P21_11_dir, ((PortDirHi[0] & 0x08)>>3));
//	  putvalue(DIAG_GPIO_P21_12_dir, ((PortDirHi[0] & 0x10)>>4));
//	  putvalue(DIAG_GPIO_P21_13_dir, ((PortDirHi[0] & 0x20)>>5));
//	  putvalue(DIAG_GPIO_P21_14_dir, ((PortDirHi[0] & 0x40)>>6));
//	  putvalue(DIAG_GPIO_P21_15_dir, ((PortDirHi[0] & 0x80)>>7));
  }
  else if ( getValue( DIAG_CTRL_IC_Type_Selector ) == cKI_VS30_HL)
  {
//    putvalue(DIAG_GPIO_P21_0, (PortDataLo[0] & 0x01));
//	  putvalue(DIAG_GPIO_P21_1, ((PortDataLo[0] & 0x02)>>1));
//	  putvalue(DIAG_GPIO_P21_2, ((PortDataLo[0] & 0x04)>>2));
//	  putvalue(DIAG_GPIO_P21_3, ((PortDataLo[0] & 0x08)>>3));
//	  putvalue(DIAG_GPIO_P21_4, ((PortDataLo[0] & 0x10)>>4));
//	  putvalue(DIAG_GPIO_P21_5, ((PortDataLo[0] & 0x20)>>5));
//	  putvalue(DIAG_GPIO_P21_6, ((PortDataLo[0] & 0x40)>>6));
//	  putvalue(DIAG_GPIO_P21_7, ((PortDataLo[0] & 0x80)>>7));

//	  putvalue(DIAG_GPIO_P21_8, (PortDataHi[0] & 0x01));
//	  putvalue(DIAG_GPIO_P21_9, ((PortDataHi[0] & 0x02)>>1));
	  putvalue(DIAG_GPIO_P21_10, ((PortDataHi[0] & 0x04)>>2));
	  putvalue(DIAG_GPIO_P21_11, ((PortDataHi[0] & 0x08)>>3));
//	  putvalue(DIAG_GPIO_P21_12, ((PortDataHi[0] & 0x10)>>4));
//	  putvalue(DIAG_GPIO_P21_13, ((PortDataHi[0] & 0x20)>>5));
//	  putvalue(DIAG_GPIO_P21_14, ((PortDataHi[0] & 0x40)>>6));
//	  putvalue(DIAG_GPIO_P21_15, ((PortDataHi[0] & 0x80)>>7));
  
//    putvalue(DIAG_GPIO_P21_0_dir, (PortDirLo[0] & 0x01));
//	  putvalue(DIAG_GPIO_P21_1_dir, ((PortDirLo[0] & 0x02)>>1));
//	  putvalue(DIAG_GPIO_P21_2_dir, ((PortDirLo[0] & 0x04)>>2));
//	  putvalue(DIAG_GPIO_P21_3_dir, ((PortDirLo[0] & 0x08)>>3));
//	  putvalue(DIAG_GPIO_P21_4_dir, ((PortDirLo[0] & 0x10)>>4));
//	  putvalue(DIAG_GPIO_P21_5_dir, ((PortDirLo[0] & 0x20)>>5));
//	  putvalue(DIAG_GPIO_P21_6_dir, ((PortDirLo[0] & 0x40)>>6));
//	  putvalue(DIAG_GPIO_P21_7_dir, ((PortDirLo[0] & 0x80)>>7));

//	  putvalue(DIAG_GPIO_P21_8_dir, (PortDirHi[0] & 0x01));
//	  putvalue(DIAG_GPIO_P21_9_dir, ((PortDirHi[0] & 0x02)>>1));
	  putvalue(DIAG_GPIO_P21_10_dir, ((PortDirHi[0] & 0x04)>>2));
	  putvalue(DIAG_GPIO_P21_11_dir, ((PortDirHi[0] & 0x08)>>3));
//	  putvalue(DIAG_GPIO_P21_12_dir, ((PortDirHi[0] & 0x10)>>4));
//	  putvalue(DIAG_GPIO_P21_13_dir, ((PortDirHi[0] & 0x20)>>5));
//	  putvalue(DIAG_GPIO_P21_14_dir, ((PortDirHi[0] & 0x40)>>6));
//	  putvalue(DIAG_GPIO_P21_15_dir, ((PortDirHi[0] & 0x80)>>7));
  }  
}
GPIO_EvalSetPort_P40()
{
  if ( getValue( DIAG_CTRL_IC_Type_Selector ) == cKI_VS30_EL)
  {
//    putvalue(DIAG_GPIO_P40_0, (PortDataLo[0] & 0x01));
//	  putvalue(DIAG_GPIO_P40_1, ((PortDataLo[0] & 0x02)>>1));
//	  putvalue(DIAG_GPIO_P40_2, ((PortDataLo[0] & 0x04)>>2));
//	  putvalue(DIAG_GPIO_P40_3, ((PortDataLo[0] & 0x08)>>3));
//	  putvalue(DIAG_GPIO_P40_4, ((PortDataLo[0] & 0x10)>>4));
//	  putvalue(DIAG_GPIO_P40_5, ((PortDataLo[0] & 0x20)>>5));
//	  putvalue(DIAG_GPIO_P40_6, ((PortDataLo[0] & 0x40)>>6));
//	  putvalue(DIAG_GPIO_P40_7, ((PortDataLo[0] & 0x80)>>7));
	
//	  putvalue(DIAG_GPIO_P40_8, (PortDataHi[0] & 0x01));
//	  putvalue(DIAG_GPIO_P40_9, ((PortDataHi[0] & 0x02)>>1));
//	  putvalue(DIAG_GPIO_P40_10, ((PortDataHi[0] & 0x04)>>2));
//	  putvalue(DIAG_GPIO_P40_11, ((PortDataHi[0] & 0x08)>>3));
//	  putvalue(DIAG_GPIO_P40_12, ((PortDataHi[0] & 0x10)>>4));
//	  putvalue(DIAG_GPIO_P40_13, ((PortDataHi[0] & 0x20)>>5));
//	  putvalue(DIAG_GPIO_P40_14, ((PortDataHi[0] & 0x40)>>6));
//	  putvalue(DIAG_GPIO_P40_15, ((PortDataHi[0] & 0x80)>>7));
  
//    putvalue(DIAG_GPIO_P40_0_dir, (PortDirLo[0] & 0x01));
//	  putvalue(DIAG_GPIO_P40_1_dir, ((PortDirLo[0] & 0x02)>>1));
//	  putvalue(DIAG_GPIO_P40_2_dir, ((PortDirLo[0] & 0x04)>>2));
//	  putvalue(DIAG_GPIO_P40_3_dir, ((PortDirLo[0] & 0x08)>>3));
//	  putvalue(DIAG_GPIO_P40_4_dir, ((PortDirLo[0] & 0x10)>>4));
//	  putvalue(DIAG_GPIO_P40_5_dir, ((PortDirLo[0] & 0x20)>>5));
//	  putvalue(DIAG_GPIO_P40_6_dir, ((PortDirLo[0] & 0x40)>>6));
//	  putvalue(DIAG_GPIO_P40_7_dir, ((PortDirLo[0] & 0x80)>>7));
	
//	  putvalue(DIAG_GPIO_P40_8_dir, (PortDirHi[0] & 0x01));
//	  putvalue(DIAG_GPIO_P40_9_dir, ((PortDirHi[0] & 0x02)>>1));
//	  putvalue(DIAG_GPIO_P40_10_dir, ((PortDirHi[0] & 0x04)>>2));
//	  putvalue(DIAG_GPIO_P40_11_dir, ((PortDirHi[0] & 0x08)>>3));
//	  putvalue(DIAG_GPIO_P40_12_dir, ((PortDirHi[0] & 0x10)>>4));
//	  putvalue(DIAG_GPIO_P40_13_dir, ((PortDirHi[0] & 0x20)>>5));
//	  putvalue(DIAG_GPIO_P40_14_dir, ((PortDirHi[0] & 0x40)>>6));
//	  putvalue(DIAG_GPIO_P40_15_dir, ((PortDirHi[0] & 0x80)>>7));
  }
  else if ( getValue( DIAG_CTRL_IC_Type_Selector ) == cKI_VS30_HL)
  {
    putvalue(DIAG_GPIO_P40_0, (PortDataLo[0] & 0x01));
	  putvalue(DIAG_GPIO_P40_1, ((PortDataLo[0] & 0x02)>>1));
	  putvalue(DIAG_GPIO_P40_2, ((PortDataLo[0] & 0x04)>>2));
	  putvalue(DIAG_GPIO_P40_3, ((PortDataLo[0] & 0x08)>>3));
	  putvalue(DIAG_GPIO_P40_4, ((PortDataLo[0] & 0x10)>>4));
	  putvalue(DIAG_GPIO_P40_5, ((PortDataLo[0] & 0x20)>>5));
//	  putvalue(DIAG_GPIO_P40_6, ((PortDataLo[0] & 0x40)>>6));
//	  putvalue(DIAG_GPIO_P40_7, ((PortDataLo[0] & 0x80)>>7));
	
//	  putvalue(DIAG_GPIO_P40_8, (PortDataHi[0] & 0x01));
//	  putvalue(DIAG_GPIO_P40_9, ((PortDataHi[0] & 0x02)>>1));
//	  putvalue(DIAG_GPIO_P40_10, ((PortDataHi[0] & 0x04)>>2));
//	  putvalue(DIAG_GPIO_P40_11, ((PortDataHi[0] & 0x08)>>3));
//	  putvalue(DIAG_GPIO_P40_12, ((PortDataHi[0] & 0x10)>>4));
//	  putvalue(DIAG_GPIO_P40_13, ((PortDataHi[0] & 0x20)>>5));
//	  putvalue(DIAG_GPIO_P40_14, ((PortDataHi[0] & 0x40)>>6));
//	  putvalue(DIAG_GPIO_P40_15, ((PortDataHi[0] & 0x80)>>7));
  
    putvalue(DIAG_GPIO_P40_0_dir, (PortDirLo[0] & 0x01));
	  putvalue(DIAG_GPIO_P40_1_dir, ((PortDirLo[0] & 0x02)>>1));
	  putvalue(DIAG_GPIO_P40_2_dir, ((PortDirLo[0] & 0x04)>>2));
	  putvalue(DIAG_GPIO_P40_3_dir, ((PortDirLo[0] & 0x08)>>3));
	  putvalue(DIAG_GPIO_P40_4_dir, ((PortDirLo[0] & 0x10)>>4));
	  putvalue(DIAG_GPIO_P40_5_dir, ((PortDirLo[0] & 0x20)>>5));
//	  putvalue(DIAG_GPIO_P40_6_dir, ((PortDirLo[0] & 0x40)>>6));
//	  putvalue(DIAG_GPIO_P40_7_dir, ((PortDirLo[0] & 0x80)>>7));
	
//	  putvalue(DIAG_GPIO_P40_8_dir, (PortDirHi[0] & 0x01));
//	  putvalue(DIAG_GPIO_P40_9_dir, ((PortDirHi[0] & 0x02)>>1));
//	  putvalue(DIAG_GPIO_P40_10_dir, ((PortDirHi[0] & 0x04)>>2));
//	  putvalue(DIAG_GPIO_P40_11_dir, ((PortDirHi[0] & 0x08)>>3));
//	  putvalue(DIAG_GPIO_P40_12_dir, ((PortDirHi[0] & 0x10)>>4));
//	  putvalue(DIAG_GPIO_P40_13_dir, ((PortDirHi[0] & 0x20)>>5));
//	  putvalue(DIAG_GPIO_P40_14_dir, ((PortDirHi[0] & 0x40)>>6));
//	  putvalue(DIAG_GPIO_P40_15_dir, ((PortDirHi[0] & 0x80)>>7));
  }  
}

GPIO_EvalSetPort_P42()
{ 
  if ( getValue( DIAG_CTRL_IC_Type_Selector ) == cKI_VS30_EL)
  {
//    ltoa((PortDirLo[0] & 0x01), PortDirStrLo_0, 10);
//    ltoa(((PortDirLo[0] & 0x02)>>1), PortDirStrLo_1, 10);
//    ltoa(((PortDirLo[0] & 0x04)>>2), PortDirStrLo_2, 10);
//    ltoa(((PortDirLo[0] & 0x08)>>3), PortDirStrLo_3, 10);
//    ltoa(((PortDirLo[0] & 0x10)>>4), PortDirStrLo_4, 10);
//    ltoa(((PortDirLo[0] & 0x20)>>5), PortDirStrLo_5, 10);
//    ltoa(((PortDirLo[0] & 0x40)>>6), PortDirStrLo_6, 10);
    ltoa(((PortDirLo[0] & 0x80)>>7), PortDirStrLo_7, 10);
    
//    ltoa((PortDirHi[0] & 0x01), PortDirStrHi_0, 10);
//    ltoa(((PortDirHi[0] & 0x02)>>1), PortDirStrHi_1, 10);
//    ltoa(((PortDirHi[0] & 0x04)>>2), PortDirStrHi_2, 10);
//    ltoa(((PortDirHi[0] & 0x08)>>3), PortDirStrHi_3, 10);
//    ltoa(((PortDirHi[0] & 0x10)>>4), PortDirStrHi_4, 10);
//    ltoa(((PortDirHi[0] & 0x20)>>5), PortDirStrHi_5, 10);
//    ltoa(((PortDirHi[0] & 0x40)>>6), PortDirStrHi_6, 10);
//    ltoa(((PortDirHi[0] & 0x80)>>7), PortDirStrHi_7, 10);
      
//    putvalue(DIAG_GPIO_P42_0, (PortDataLo[0] & 0x01));
//	  putvalue(DIAG_GPIO_P42_1, ((PortDataLo[0] & 0x02)>>1));
//	  putvalue(DIAG_GPIO_P42_2, ((PortDataLo[0] & 0x04)>>2));
//	  putvalue(DIAG_GPIO_P42_3, ((PortDataLo[0] & 0x08)>>3));
//	  putvalue(DIAG_GPIO_P42_4, ((PortDataLo[0] & 0x10)>>4));
//	  putvalue(DIAG_GPIO_P42_5, ((PortDataLo[0] & 0x20)>>5));
//	  putvalue(DIAG_GPIO_P42_6, ((PortDataLo[0] & 0x40)>>6));
	  putvalue(DIAG_GPIO_P42_7, ((PortDataLo[0] & 0x80)>>7));
	
//	  putvalue(DIAG_GPIO_P42_8, (PortDataHi[0] & 0x01));
//	  putvalue(DIAG_GPIO_P42_9, ((PortDataHi[0] & 0x02)>>1));
//	  putvalue(DIAG_GPIO_P42_10, ((PortDataHi[0] & 0x04)>>2));
//	  putvalue(DIAG_GPIO_P42_11, ((PortDataHi[0] & 0x08)>>3));
//	  putvalue(DIAG_GPIO_P42_12, ((PortDataHi[0] & 0x10)>>4));
//	  putvalue(DIAG_GPIO_P42_13, ((PortDataHi[0] & 0x20)>>5));
//	  putvalue(DIAG_GPIO_P42_14, ((PortDataHi[0] & 0x40)>>6));
//	  putvalue(DIAG_GPIO_P42_15, ((PortDataHi[0] & 0x80)>>7));
  
    putvalue(DIAG_GPIO_P42_0_dir, "ff");
	  putvalue(DIAG_GPIO_P42_1_dir, "ff");
	  putvalue(DIAG_GPIO_P42_2_dir, "ff");
	  putvalue(DIAG_GPIO_P42_3_dir, "ff");
	  putvalue(DIAG_GPIO_P42_4_dir, "ff");
	  putvalue(DIAG_GPIO_P42_5_dir, "ff");
	  putvalue(DIAG_GPIO_P42_6_dir, "ff");
	  putvalue(DIAG_GPIO_P42_7_dir, PortDirStrLo_7);
	
	  putvalue(DIAG_GPIO_P42_8_dir, "ff");
	  putvalue(DIAG_GPIO_P42_9_dir, "ff");
	  putvalue(DIAG_GPIO_P42_10_dir, "ff");
	  putvalue(DIAG_GPIO_P42_11_dir, "ff");
	  putvalue(DIAG_GPIO_P42_12_dir, "ff");
	  putvalue(DIAG_GPIO_P42_13_dir, "ff");
    putvalue(DIAG_GPIO_P42_14_dir, "ff");
	  putvalue(DIAG_GPIO_P42_15_dir, "ff");
  }
  else if ( getValue( DIAG_CTRL_IC_Type_Selector ) == cKI_VS30_HL)
  {
    
//    ltoa((PortDirLo[0] & 0x01), PortDirStrLo_0, 10);
//    ltoa(((PortDirLo[0] & 0x02)>>1), PortDirStrLo_1, 10);
//    ltoa(((PortDirLo[0] & 0x04)>>2), PortDirStrLo_2, 10);
//    ltoa(((PortDirLo[0] & 0x08)>>3), PortDirStrLo_3, 10);
//    ltoa(((PortDirLo[0] & 0x10)>>4), PortDirStrLo_4, 10);
//    ltoa(((PortDirLo[0] & 0x20)>>5), PortDirStrLo_5, 10);
//    ltoa(((PortDirLo[0] & 0x40)>>6), PortDirStrLo_6, 10);
    ltoa(((PortDirLo[0] & 0x80)>>7), PortDirStrLo_7, 10);
    
    ltoa((PortDirHi[0] & 0x01), PortDirStrHi_0, 10);
//    ltoa(((PortDirHi[0] & 0x02)>>1), PortDirStrHi_1, 10);
//    ltoa(((PortDirHi[0] & 0x04)>>2), PortDirStrHi_2, 10);
//    ltoa(((PortDirHi[0] & 0x08)>>3), PortDirStrHi_3, 10);
//    ltoa(((PortDirHi[0] & 0x10)>>4), PortDirStrHi_4, 10);
//    ltoa(((PortDirHi[0] & 0x20)>>5), PortDirStrHi_5, 10);
//    ltoa(((PortDirHi[0] & 0x40)>>6), PortDirStrHi_6, 10);
//    ltoa(((PortDirHi[0] & 0x80)>>7), PortDirStrHi_7, 10);
    
//    putvalue(DIAG_GPIO_P42_0, (PortDataLo[0] & 0x01));
//	  putvalue(DIAG_GPIO_P42_1, ((PortDataLo[0] & 0x02)>>1));
//	  putvalue(DIAG_GPIO_P42_2, ((PortDataLo[0] & 0x04)>>2));//PWM
//	  putvalue(DIAG_GPIO_P42_3, ((PortDataLo[0] & 0x08)>>3));//PWM
//	  putvalue(DIAG_GPIO_P42_4, ((PortDataLo[0] & 0x10)>>4));//PWM
//	  putvalue(DIAG_GPIO_P42_5, ((PortDataLo[0] & 0x20)>>5));//PWM
//	  putvalue(DIAG_GPIO_P42_6, ((PortDataLo[0] & 0x40)>>6));//PWM
	  putvalue(DIAG_GPIO_P42_7, ((PortDataLo[0] & 0x80)>>7));
	
	  putvalue(DIAG_GPIO_P42_8, (PortDataHi[0] & 0x01));
//	  putvalue(DIAG_GPIO_P42_9, ((PortDataHi[0] & 0x02)>>1));//PWM
//	  putvalue(DIAG_GPIO_P42_10, ((PortDataHi[0] & 0x04)>>2));//PWM
//	  putvalue(DIAG_GPIO_P42_11, ((PortDataHi[0] & 0x08)>>3));//PWM
//	  putvalue(DIAG_GPIO_P42_12, ((PortDataHi[0] & 0x10)>>4));//PWM
//	  putvalue(DIAG_GPIO_P42_13, ((PortDataHi[0] & 0x20)>>5));//PWM
//	  putvalue(DIAG_GPIO_P42_14, ((PortDataHi[0] & 0x40)>>6));//PWM
//	  putvalue(DIAG_GPIO_P42_15, ((PortDataHi[0] & 0x80)>>7));//PWM
  
//    putvalue(DIAG_GPIO_P42_0_dir, PortDirStrLo_0);
//	  putvalue(DIAG_GPIO_P42_1_dir, PortDirStrLo_1);
	  putvalue(DIAG_GPIO_P42_2_dir, "PWM");//PWM
	  putvalue(DIAG_GPIO_P42_3_dir, "PWM");//PWM
	  putvalue(DIAG_GPIO_P42_4_dir, "PWM");//PWM
	  putvalue(DIAG_GPIO_P42_5_dir, "PWM");//PWM
	  putvalue(DIAG_GPIO_P42_6_dir, "PWM");//PWM
	  putvalue(DIAG_GPIO_P42_7_dir, PortDirStrLo_7);
	
	  putvalue(DIAG_GPIO_P42_8_dir, PortDirStrHi_0);
	  putvalue(DIAG_GPIO_P42_9_dir, "PWM");//PWM
	  putvalue(DIAG_GPIO_P42_10_dir, "PWM");//PWM
	  putvalue(DIAG_GPIO_P42_11_dir, "PWM");//PWM
	  putvalue(DIAG_GPIO_P42_12_dir, "PWM");//PWM
	  putvalue(DIAG_GPIO_P42_13_dir, "PWM");//PWM
	  putvalue(DIAG_GPIO_P42_14_dir, "PWM");//PWM
	  putvalue(DIAG_GPIO_P42_15_dir, "PWM");//PWM
  }  
}

GPIO_EvalSetPort_P43()
{
  if ( getValue( DIAG_CTRL_IC_Type_Selector ) == cKI_VS30_EL)
  {
    putvalue(DIAG_GPIO_P43_0, (PortDataLo[0] & 0x01));
	  putvalue(DIAG_GPIO_P43_1, ((PortDataLo[0] & 0x02)>>1));
//	  putvalue(DIAG_GPIO_P43_2, ((PortDataLo[0] & 0x04)>>2));
//	  putvalue(DIAG_GPIO_P43_3, ((PortDataLo[0] & 0x08)>>3));
//	  putvalue(DIAG_GPIO_P43_4, ((PortDataLo[0] & 0x10)>>4));
//	  putvalue(DIAG_GPIO_P43_5, ((PortDataLo[0] & 0x20)>>5));
//	  putvalue(DIAG_GPIO_P43_6, ((PortDataLo[0] & 0x40)>>6));
//	  putvalue(DIAG_GPIO_P43_7, ((PortDataLo[0] & 0x80)>>7));
	
//	  putvalue(DIAG_GPIO_P43_8, (PortDataHi[0] & 0x01));
//	  putvalue(DIAG_GPIO_P43_9, ((PortDataHi[0] & 0x02)>>1));
//	  putvalue(DIAG_GPIO_P43_10, ((PortDataHi[0] & 0x04)>>2));
//	  putvalue(DIAG_GPIO_P43_11, ((PortDataHi[0] & 0x08)>>3));
//	  putvalue(DIAG_GPIO_P43_12, ((PortDataHi[0] & 0x10)>>4));
//	  putvalue(DIAG_GPIO_P43_13, ((PortDataHi[0] & 0x20)>>5));
//	  putvalue(DIAG_GPIO_P43_14, ((PortDataHi[0] & 0x40)>>6));
//	  putvalue(DIAG_GPIO_P43_15, ((PortDataHi[0] & 0x80)>>7));
  
    putvalue(DIAG_GPIO_P43_0_dir, (PortDirLo[0] & 0x01));
	  putvalue(DIAG_GPIO_P43_1_dir, ((PortDirLo[0] & 0x02)>>1));
//	  putvalue(DIAG_GPIO_P43_2_dir, ((PortDirLo[0] & 0x04)>>2));
//	  putvalue(DIAG_GPIO_P43_3_dir, ((PortDirLo[0] & 0x08)>>3));
//	  putvalue(DIAG_GPIO_P43_4_dir, ((PortDirLo[0] & 0x10)>>4));
//	  putvalue(DIAG_GPIO_P43_5_dir, ((PortDirLo[0] & 0x20)>>5));
//	  putvalue(DIAG_GPIO_P43_6_dir, ((PortDirLo[0] & 0x40)>>6));
//	  putvalue(DIAG_GPIO_P43_7_dir, ((PortDirLo[0] & 0x80)>>7));

//	  putvalue(DIAG_GPIO_P43_8_dir, (PortDirHi[0] & 0x01));
//	  putvalue(DIAG_GPIO_P43_9_dir, ((PortDirHi[0] & 0x02)>>1));
//	  putvalue(DIAG_GPIO_P43_10_dir, ((PortDirHi[0] & 0x04)>>2));
//	  putvalue(DIAG_GPIO_P43_11_dir, ((PortDirHi[0] & 0x08)>>3));
//	  putvalue(DIAG_GPIO_P43_12_dir, ((PortDirHi[0] & 0x10)>>4));
//	  putvalue(DIAG_GPIO_P43_13_dir, ((PortDirHi[0] & 0x20)>>5));
//	  putvalue(DIAG_GPIO_P43_14_dir, ((PortDirHi[0] & 0x40)>>6));
//	  putvalue(DIAG_GPIO_P43_15_dir, ((PortDirHi[0] & 0x80)>>7));
  }
  else if ( getValue( DIAG_CTRL_IC_Type_Selector ) == cKI_VS30_HL)
  {
//    putvalue(DIAG_GPIO_P43_0, (PortDataLo[0] & 0x01));
//	  putvalue(DIAG_GPIO_P43_1, ((PortDataLo[0] & 0x02)>>1));
//	  putvalue(DIAG_GPIO_P43_2, ((PortDataLo[0] & 0x04)>>2));
	  putvalue(DIAG_GPIO_P43_3, ((PortDataLo[0] & 0x08)>>3));
	  putvalue(DIAG_GPIO_P43_4, ((PortDataLo[0] & 0x10)>>4));
	  putvalue(DIAG_GPIO_P43_5, ((PortDataLo[0] & 0x20)>>5));
	  putvalue(DIAG_GPIO_P43_6, ((PortDataLo[0] & 0x40)>>6));
//	  putvalue(DIAG_GPIO_P43_7, ((PortDataLo[0] & 0x80)>>7));//ADC?
//	
//	  putvalue(DIAG_GPIO_P43_8, (PortDataHi[0] & 0x01));ADC?
	  putvalue(DIAG_GPIO_P43_9, ((PortDataHi[0] & 0x02)>>1));
	  putvalue(DIAG_GPIO_P43_10, ((PortDataHi[0] & 0x04)>>2));
	  putvalue(DIAG_GPIO_P43_11, ((PortDataHi[0] & 0x08)>>3));
	  putvalue(DIAG_GPIO_P43_12, ((PortDataHi[0] & 0x10)>>4));
//	  putvalue(DIAG_GPIO_P43_13, ((PortDataHi[0] & 0x20)>>5));
//	  putvalue(DIAG_GPIO_P43_14, ((PortDataHi[0] & 0x40)>>6));
//	  putvalue(DIAG_GPIO_P43_15, ((PortDataHi[0] & 0x80)>>7));
  
//    putvalue(DIAG_GPIO_P43_0_dir, (PortDirLo[0] & 0x01));
//	  putvalue(DIAG_GPIO_P43_1_dir, ((PortDirLo[0] & 0x02)>>1));
//	  putvalue(DIAG_GPIO_P43_2_dir, ((PortDirLo[0] & 0x04)>>2));
	  putvalue(DIAG_GPIO_P43_3_dir, ((PortDirLo[0] & 0x08)>>3));
	  putvalue(DIAG_GPIO_P43_4_dir, ((PortDirLo[0] & 0x10)>>4));
	  putvalue(DIAG_GPIO_P43_5_dir, ((PortDirLo[0] & 0x20)>>5));
	  putvalue(DIAG_GPIO_P43_6_dir, ((PortDirLo[0] & 0x40)>>6));
//	  putvalue(DIAG_GPIO_P43_7_dir, ((PortDirLo[0] & 0x80)>>7));
//	
//	  putvalue(DIAG_GPIO_P43_8_dir, (PortDirHi[0] & 0x01));
	  putvalue(DIAG_GPIO_P43_9_dir, ((PortDirHi[0] & 0x02)>>1));
	  putvalue(DIAG_GPIO_P43_10_dir, ((PortDirHi[0] & 0x04)>>2));
	  putvalue(DIAG_GPIO_P43_11_dir, ((PortDirHi[0] & 0x08)>>3));
	  putvalue(DIAG_GPIO_P43_12_dir, ((PortDirHi[0] & 0x10)>>4));
//	  putvalue(DIAG_GPIO_P43_13_dir, ((PortDirHi[0] & 0x20)>>5));
//	  putvalue(DIAG_GPIO_P43_14_dir, ((PortDirHi[0] & 0x40)>>6));
//	  putvalue(DIAG_GPIO_P43_15_dir, ((PortDirHi[0] & 0x80)>>7));
  }  
}

GPIO_EvalSetPort_P44()
{
  if ( getValue( DIAG_CTRL_IC_Type_Selector ) == cKI_VS30_EL)
  {
//    putvalue(DIAG_GPIO_P44_0, (PortDataLo[0] & 0x01));
	  putvalue(DIAG_GPIO_P44_1, ((PortDataLo[0] & 0x02)>>1));
//	  putvalue(DIAG_GPIO_P44_2, ((PortDataLo[0] & 0x04)>>2));
//	  putvalue(DIAG_GPIO_P44_3, ((PortDataLo[0] & 0x08)>>3));
	  putvalue(DIAG_GPIO_P44_4, ((PortDataLo[0] & 0x10)>>4));
//	  putvalue(DIAG_GPIO_P44_5, ((PortDataLo[0] & 0x20)>>5));
//	  putvalue(DIAG_GPIO_P44_6, ((PortDataLo[0] & 0x40)>>6));
	  putvalue(DIAG_GPIO_P44_7, ((PortDataLo[0] & 0x80)>>7));
	
	  putvalue(DIAG_GPIO_P44_8, (PortDataHi[0] & 0x01));
//	  putvalue(DIAG_GPIO_P44_9, ((PortDataHi[0] & 0x02)>>1));
//	  putvalue(DIAG_GPIO_P44_10, ((PortDataHi[0] & 0x04)>>2));
//	  putvalue(DIAG_GPIO_P44_11, ((PortDataHi[0] & 0x08)>>3));
//	  putvalue(DIAG_GPIO_P44_12, ((PortDataHi[0] & 0x10)>>4));
//	  putvalue(DIAG_GPIO_P44_13, ((PortDataHi[0] & 0x20)>>5));
//	  putvalue(DIAG_GPIO_P44_14, ((PortDataHi[0] & 0x40)>>6));
//	  putvalue(DIAG_GPIO_P44_15, ((PortDataHi[0] & 0x80)>>7));
  
//    putvalue(DIAG_GPIO_P44_0_dir, (PortDirLo[0] & 0x01));
	  putvalue(DIAG_GPIO_P44_1_dir, ((PortDirLo[0] & 0x02)>>1));
//	  putvalue(DIAG_GPIO_P44_2_dir, ((PortDirLo[0] & 0x04)>>2));
//	  putvalue(DIAG_GPIO_P44_3_dir, ((PortDirLo[0] & 0x08)>>3));
	  putvalue(DIAG_GPIO_P44_4_dir, ((PortDirLo[0] & 0x10)>>4));
//	  putvalue(DIAG_GPIO_P44_5_dir, ((PortDirLo[0] & 0x20)>>5));
//	  putvalue(DIAG_GPIO_P44_6_dir, ((PortDirLo[0] & 0x40)>>6));
	  putvalue(DIAG_GPIO_P44_7_dir, ((PortDirLo[0] & 0x80)>>7));
	
	  putvalue(DIAG_GPIO_P44_8_dir, (PortDirHi[0] & 0x01));
//	  putvalue(DIAG_GPIO_P44_9_dir, ((PortDirHi[0] & 0x02)>>1));
//	  putvalue(DIAG_GPIO_P44_10_dir, ((PortDirHi[0] & 0x04)>>2));
//	  putvalue(DIAG_GPIO_P44_11_dir, ((PortDirHi[0] & 0x08)>>3));
//	  putvalue(DIAG_GPIO_P44_12_dir, ((PortDirHi[0] & 0x10)>>4));
//	  putvalue(DIAG_GPIO_P44_13_dir, ((PortDirHi[0] & 0x20)>>5));
//	  putvalue(DIAG_GPIO_P44_14_dir, ((PortDirHi[0] & 0x40)>>6));
//	  putvalue(DIAG_GPIO_P44_15_dir, ((PortDirHi[0] & 0x80)>>7));
  }
  else if ( getValue( DIAG_CTRL_IC_Type_Selector ) == cKI_VS30_HL)
  {
//    putvalue(DIAG_GPIO_P44_0, (PortDataLo[0] & 0x01));
//	  putvalue(DIAG_GPIO_P44_1, ((PortDataLo[0] & 0x02)>>1));
//	  putvalue(DIAG_GPIO_P44_2, ((PortDataLo[0] & 0x04)>>2));
//	  putvalue(DIAG_GPIO_P44_3, ((PortDataLo[0] & 0x08)>>3));
//	  putvalue(DIAG_GPIO_P44_4, ((PortDataLo[0] & 0x10)>>4));
//	  putvalue(DIAG_GPIO_P44_5, ((PortDataLo[0] & 0x20)>>5));
//	  putvalue(DIAG_GPIO_P44_6, ((PortDataLo[0] & 0x40)>>6));
//	  putvalue(DIAG_GPIO_P44_7, ((PortDataLo[0] & 0x80)>>7));

//	  putvalue(DIAG_GPIO_P44_8, (PortDataHi[0] & 0x01));
//	  putvalue(DIAG_GPIO_P44_9, ((PortDataHi[0] & 0x02)>>1));
//	  putvalue(DIAG_GPIO_P44_10, ((PortDataHi[0] & 0x04)>>2));
//	  putvalue(DIAG_GPIO_P44_11, ((PortDataHi[0] & 0x08)>>3));
//	  putvalue(DIAG_GPIO_P44_12, ((PortDataHi[0] & 0x10)>>4));
//	  putvalue(DIAG_GPIO_P44_13, ((PortDataHi[0] & 0x20)>>5));
//	  putvalue(DIAG_GPIO_P44_14, ((PortDataHi[0] & 0x40)>>6));
//	  putvalue(DIAG_GPIO_P44_15, ((PortDataHi[0] & 0x80)>>7));
  
//    putvalue(DIAG_GPIO_P44_0_dir, (PortDirLo[0] & 0x01));
//	  putvalue(DIAG_GPIO_P44_1_dir, ((PortDirLo[0] & 0x02)>>1));
//	  putvalue(DIAG_GPIO_P44_2_dir, ((PortDirLo[0] & 0x04)>>2));
//	  putvalue(DIAG_GPIO_P44_3_dir, ((PortDirLo[0] & 0x08)>>3));
//	  putvalue(DIAG_GPIO_P44_4_dir, ((PortDirLo[0] & 0x10)>>4));
//	  putvalue(DIAG_GPIO_P44_5_dir, ((PortDirLo[0] & 0x20)>>5));
//	  putvalue(DIAG_GPIO_P44_6_dir, ((PortDirLo[0] & 0x40)>>6));
//	  putvalue(DIAG_GPIO_P44_7_dir, ((PortDirLo[0] & 0x80)>>7));

//	  putvalue(DIAG_GPIO_P44_8_dir, (PortDirHi[0] & 0x01));
//	  putvalue(DIAG_GPIO_P44_9_dir, ((PortDirHi[0] & 0x02)>>1));
//	  putvalue(DIAG_GPIO_P44_10_dir, ((PortDirHi[0] & 0x04)>>2));
//	  putvalue(DIAG_GPIO_P44_11_dir, ((PortDirHi[0] & 0x08)>>3));
//	  putvalue(DIAG_GPIO_P44_12_dir, ((PortDirHi[0] & 0x10)>>4));
//	  putvalue(DIAG_GPIO_P44_13_dir, ((PortDirHi[0] & 0x20)>>5));
//	  putvalue(DIAG_GPIO_P44_14_dir, ((PortDirHi[0] & 0x40)>>6));
//	  putvalue(DIAG_GPIO_P44_15_dir, ((PortDirHi[0] & 0x80)>>7));
  }  
}

GPIO_EvalSetPort_P45()
{
  if ( getValue( DIAG_CTRL_IC_Type_Selector ) == cKI_VS30_EL)
  {
    putvalue(DIAG_GPIO_P45_0, (PortDataLo[0] & 0x01));
	  putvalue(DIAG_GPIO_P45_1, ((PortDataLo[0] & 0x02)>>1));
//	  putvalue(DIAG_GPIO_P45_2, ((PortDataLo[0] & 0x04)>>2));
//	  putvalue(DIAG_GPIO_P45_3, ((PortDataLo[0] & 0x08)>>3));
//	  putvalue(DIAG_GPIO_P45_4, ((PortDataLo[0] & 0x10)>>4));
//	  putvalue(DIAG_GPIO_P45_5, ((PortDataLo[0] & 0x20)>>5));
	  putvalue(DIAG_GPIO_P45_6, ((PortDataLo[0] & 0x40)>>6));
	  putvalue(DIAG_GPIO_P45_7, ((PortDataLo[0] & 0x80)>>7));
	
	  putvalue(DIAG_GPIO_P45_8, (PortDataHi[0] & 0x01));
	  putvalue(DIAG_GPIO_P45_9, ((PortDataHi[0] & 0x02)>>1));
	  putvalue(DIAG_GPIO_P45_10, ((PortDataHi[0] & 0x04)>>2));
	  putvalue(DIAG_GPIO_P45_11, ((PortDataHi[0] & 0x08)>>3));
	  putvalue(DIAG_GPIO_P45_12, ((PortDataHi[0] & 0x10)>>4));
	  putvalue(DIAG_GPIO_P45_13, ((PortDataHi[0] & 0x20)>>5));
//	  putvalue(DIAG_GPIO_P45_14, ((PortDataHi[0] & 0x40)>>6));
//	  putvalue(DIAG_GPIO_P45_15, ((PortDataHi[0] & 0x80)>>7));
  
    putvalue(DIAG_GPIO_P45_0_dir, (PortDirLo[0] & 0x01));
	  putvalue(DIAG_GPIO_P45_1_dir, ((PortDirLo[0] & 0x02)>>1));
//	  putvalue(DIAG_GPIO_P45_2_dir, ((PortDirLo[0] & 0x04)>>2));
//	  putvalue(DIAG_GPIO_P45_3_dir, ((PortDirLo[0] & 0x08)>>3));
//	  putvalue(DIAG_GPIO_P45_4_dir, ((PortDirLo[0] & 0x10)>>4));
//	  putvalue(DIAG_GPIO_P45_5_dir, ((PortDirLo[0] & 0x20)>>5));
	  putvalue(DIAG_GPIO_P45_6_dir, ((PortDirLo[0] & 0x40)>>6));
	  putvalue(DIAG_GPIO_P45_7_dir, ((PortDirLo[0] & 0x80)>>7));
	
	  putvalue(DIAG_GPIO_P45_8_dir, (PortDirHi[0] & 0x01));
	  putvalue(DIAG_GPIO_P45_9_dir, ((PortDirHi[0] & 0x02)>>1));
	  putvalue(DIAG_GPIO_P45_10_dir, ((PortDirHi[0] & 0x04)>>2));
	  putvalue(DIAG_GPIO_P45_11_dir, ((PortDirHi[0] & 0x08)>>3));
	  putvalue(DIAG_GPIO_P45_12_dir, ((PortDirHi[0] & 0x10)>>4));
	  putvalue(DIAG_GPIO_P45_13_dir, ((PortDirHi[0] & 0x20)>>5));
//	  putvalue(DIAG_GPIO_P45_14_dir, ((PortDirHi[0] & 0x40)>>6));
//	  putvalue(DIAG_GPIO_P45_15_dir, ((PortDirHi[0] & 0x80)>>7));
  }
  else if ( getValue( DIAG_CTRL_IC_Type_Selector ) == cKI_VS30_HL)
  {
//    putvalue(DIAG_GPIO_P45_0, (PortDataLo[0] & 0x01));
//	  putvalue(DIAG_GPIO_P45_1, ((PortDataLo[0] & 0x02)>>1));
//	  putvalue(DIAG_GPIO_P45_2, ((PortDataLo[0] & 0x04)>>2));
//	  putvalue(DIAG_GPIO_P45_3, ((PortDataLo[0] & 0x08)>>3));
//	  putvalue(DIAG_GPIO_P45_4, ((PortDataLo[0] & 0x10)>>4));
//	  putvalue(DIAG_GPIO_P45_5, ((PortDataLo[0] & 0x20)>>5));
//	  putvalue(DIAG_GPIO_P45_6, ((PortDataLo[0] & 0x40)>>6));
//	  putvalue(DIAG_GPIO_P45_7, ((PortDataLo[0] & 0x80)>>7));
//	
//	  putvalue(DIAG_GPIO_P45_8, (PortDataHi[0] & 0x01));
//	  putvalue(DIAG_GPIO_P45_9, ((PortDataHi[0] & 0x02)>>1));
//	  putvalue(DIAG_GPIO_P45_10, ((PortDataHi[0] & 0x04)>>2));
//	  putvalue(DIAG_GPIO_P45_11, ((PortDataHi[0] & 0x08)>>3));
//	  putvalue(DIAG_GPIO_P45_12, ((PortDataHi[0] & 0x10)>>4));
//	  putvalue(DIAG_GPIO_P45_13, ((PortDataHi[0] & 0x20)>>5));
//	  putvalue(DIAG_GPIO_P45_14, ((PortDataHi[0] & 0x40)>>6));
//	  putvalue(DIAG_GPIO_P45_15, ((PortDataHi[0] & 0x80)>>7));
  
//    putvalue(DIAG_GPIO_P45_0_dir, (PortDirLo[0] & 0x01));
//	  putvalue(DIAG_GPIO_P45_1_dir, ((PortDirLo[0] & 0x02)>>1));
//	  putvalue(DIAG_GPIO_P45_2_dir, ((PortDirLo[0] & 0x04)>>2));
//	  putvalue(DIAG_GPIO_P45_3_dir, ((PortDirLo[0] & 0x08)>>3));
//	  putvalue(DIAG_GPIO_P45_4_dir, ((PortDirLo[0] & 0x10)>>4));
//	  putvalue(DIAG_GPIO_P45_5_dir, ((PortDirLo[0] & 0x20)>>5));
//	  putvalue(DIAG_GPIO_P45_6_dir, ((PortDirLo[0] & 0x40)>>6));
//	  putvalue(DIAG_GPIO_P45_7_dir, ((PortDirLo[0] & 0x80)>>7));

//	  putvalue(DIAG_GPIO_P45_8_dir, (PortDirHi[0] & 0x01));
//	  putvalue(DIAG_GPIO_P45_9_dir, ((PortDirHi[0] & 0x02)>>1));
//	  putvalue(DIAG_GPIO_P45_10_dir, ((PortDirHi[0] & 0x04)>>2));
//	  putvalue(DIAG_GPIO_P45_11_dir, ((PortDirHi[0] & 0x08)>>3));
//	  putvalue(DIAG_GPIO_P45_12_dir, ((PortDirHi[0] & 0x10)>>4));
//	  putvalue(DIAG_GPIO_P45_13_dir, ((PortDirHi[0] & 0x20)>>5));
//	  putvalue(DIAG_GPIO_P45_14_dir, ((PortDirHi[0] & 0x40)>>6));
//	  putvalue(DIAG_GPIO_P45_15_dir, ((PortDirHi[0] & 0x80)>>7));
  }  
}

GPIO_EvalSetPort_JP0()
{
  if ( getValue( DIAG_CTRL_IC_Type_Selector ) == cKI_VS30_EL)
  {
    putvalue(DIAG_GPIO_JP0_0, (PortDataLo[0] & 0x01));
	  putvalue(DIAG_GPIO_JP0_1, ((PortDataLo[0] & 0x02)>>1));
	  putvalue(DIAG_GPIO_JP0_2, ((PortDataLo[0] & 0x04)>>2));
	  putvalue(DIAG_GPIO_JP0_3, ((PortDataLo[0] & 0x08)>>3));
	  putvalue(DIAG_GPIO_JP0_4, ((PortDataLo[0] & 0x10)>>4));
	  putvalue(DIAG_GPIO_JP0_5, ((PortDataLo[0] & 0x20)>>5));
//	  putvalue(DIAG_GPIO_JP0_6, ((PortDataLo[0] & 0x40)>>6));
//	  putvalue(DIAG_GPIO_JP0_7, ((PortDataLo[0] & 0x80)>>7));
	
//	  putvalue(DIAG_GPIO_JP0_8, (PortDataHi[0] & 0x01));
//	  putvalue(DIAG_GPIO_JP0_9, ((PortDataHi[0] & 0x02)>>1));
//	  putvalue(DIAG_GPIO_JP0_10, ((PortDataHi[0] & 0x04)>>2));
//	  putvalue(DIAG_GPIO_JP0_11, ((PortDataHi[0] & 0x08)>>3));
//	  putvalue(DIAG_GPIO_JP0_12, ((PortDataHi[0] & 0x10)>>4));
//	  putvalue(DIAG_GPIO_JP0_13, ((PortDataHi[0] & 0x20)>>5));
//	  putvalue(DIAG_GPIO_JP0_14, ((PortDataHi[0] & 0x40)>>6));
//	  putvalue(DIAG_GPIO_JP0_15, ((PortDataHi[0] & 0x80)>>7));
  
    putvalue(DIAG_GPIO_JP0_0_dir, (PortDirLo[0] & 0x01));
	  putvalue(DIAG_GPIO_JP0_1_dir, ((PortDirLo[0] & 0x02)>>1));
	  putvalue(DIAG_GPIO_JP0_2_dir, ((PortDirLo[0] & 0x04)>>2));
	  putvalue(DIAG_GPIO_JP0_3_dir, ((PortDirLo[0] & 0x08)>>3));
	  putvalue(DIAG_GPIO_JP0_4_dir, ((PortDirLo[0] & 0x10)>>4));
	  putvalue(DIAG_GPIO_JP0_5_dir, ((PortDirLo[0] & 0x20)>>5));
//	  putvalue(DIAG_GPIO_JP0_6_dir, ((PortDirLo[0] & 0x40)>>6));
//	  putvalue(DIAG_GPIO_JP0_7_dir, ((PortDirLo[0] & 0x80)>>7));
	
//	  putvalue(DIAG_GPIO_JP0_8_dir, (PortDirHi[0] & 0x01));
//	  putvalue(DIAG_GPIO_JP0_9_dir, ((PortDirHi[0] & 0x02)>>1));
//	  putvalue(DIAG_GPIO_JP0_10_dir, ((PortDirHi[0] & 0x04)>>2));
//	  putvalue(DIAG_GPIO_JP0_11_dir, ((PortDirHi[0] & 0x08)>>3));
//	  putvalue(DIAG_GPIO_JP0_12_dir, ((PortDirHi[0] & 0x10)>>4));
//	  putvalue(DIAG_GPIO_JP0_13_dir, ((PortDirHi[0] & 0x20)>>5));
//	  putvalue(DIAG_GPIO_JP0_14_dir, ((PortDirHi[0] & 0x40)>>6));
//	  putvalue(DIAG_GPIO_JP0_15_dir, ((PortDirHi[0] & 0x80)>>7));
  }
  else if ( getValue( DIAG_CTRL_IC_Type_Selector ) == cKI_VS30_HL)
  {
//    putvalue(DIAG_GPIO_JP0_0, (PortDataLo[0] & 0x01));
//	  putvalue(DIAG_GPIO_JP0_1, ((PortDataLo[0] & 0x02)>>1));
//	  putvalue(DIAG_GPIO_JP0_2, ((PortDataLo[0] & 0x04)>>2));
//	  putvalue(DIAG_GPIO_JP0_3, ((PortDataLo[0] & 0x08)>>3));
//	  putvalue(DIAG_GPIO_JP0_4, ((PortDataLo[0] & 0x10)>>4));
//	  putvalue(DIAG_GPIO_JP0_5, ((PortDataLo[0] & 0x20)>>5));
//	  putvalue(DIAG_GPIO_JP0_6, ((PortDataLo[0] & 0x40)>>6));
//	  putvalue(DIAG_GPIO_JP0_7, ((PortDataLo[0] & 0x80)>>7));
	
//	  putvalue(DIAG_GPIO_JP0_8, (PortDataHi[0] & 0x01));
//	  putvalue(DIAG_GPIO_JP0_9, ((PortDataHi[0] & 0x02)>>1));
//	  putvalue(DIAG_GPIO_JP0_10, ((PortDataHi[0] & 0x04)>>2));
//	  putvalue(DIAG_GPIO_JP0_11, ((PortDataHi[0] & 0x08)>>3));
//	  putvalue(DIAG_GPIO_JP0_12, ((PortDataHi[0] & 0x10)>>4));
//	  putvalue(DIAG_GPIO_JP0_13, ((PortDataHi[0] & 0x20)>>5));
//	  putvalue(DIAG_GPIO_JP0_14, ((PortDataHi[0] & 0x40)>>6));
//	  putvalue(DIAG_GPIO_JP0_15, ((PortDataHi[0] & 0x80)>>7));
  
//    putvalue(DIAG_GPIO_JP0_0_dir, (PortDirLo[0] & 0x01));
//	  putvalue(DIAG_GPIO_JP0_1_dir, ((PortDirLo[0] & 0x02)>>1));
//	  putvalue(DIAG_GPIO_JP0_2_dir, ((PortDirLo[0] & 0x04)>>2));
//	  putvalue(DIAG_GPIO_JP0_3_dir, ((PortDirLo[0] & 0x08)>>3));
//	  putvalue(DIAG_GPIO_JP0_4_dir, ((PortDirLo[0] & 0x10)>>4));
//	  putvalue(DIAG_GPIO_JP0_5_dir, ((PortDirLo[0] & 0x20)>>5));
//	  putvalue(DIAG_GPIO_JP0_6_dir, ((PortDirLo[0] & 0x40)>>6));
//	  putvalue(DIAG_GPIO_JP0_7_dir, ((PortDirLo[0] & 0x80)>>7));
	
//	  putvalue(DIAG_GPIO_JP0_8_dir, (PortDirHi[0] & 0x01));
//	  putvalue(DIAG_GPIO_JP0_9_dir, ((PortDirHi[0] & 0x02)>>1));
//	  putvalue(DIAG_GPIO_JP0_10_dir, ((PortDirHi[0] & 0x04)>>2));
//	  putvalue(DIAG_GPIO_JP0_11_dir, ((PortDirHi[0] & 0x08)>>3));
//	  putvalue(DIAG_GPIO_JP0_12_dir, ((PortDirHi[0] & 0x10)>>4));
//	  putvalue(DIAG_GPIO_JP0_13_dir, ((PortDirHi[0] & 0x20)>>5));
//	  putvalue(DIAG_GPIO_JP0_14_dir, ((PortDirHi[0] & 0x40)>>6));
//	  putvalue(DIAG_GPIO_JP0_15_dir, ((PortDirHi[0] & 0x80)>>7));
  }  
}

GPIO_SetPort_P0()
{
    bSetGPIOChannel_Buffer = 0x00;
    GPIO_ReadPhysicalPorts();
}

GPIO_SetPort_P1()
{
    bSetGPIOChannel_Buffer = 0x01;
    GPIO_ReadPhysicalPorts();
}

GPIO_SetPort_P2()
{
    bSetGPIOChannel_Buffer = 0x02;
    GPIO_ReadPhysicalPorts();
}

GPIO_SetPort_P3()
{
    bSetGPIOChannel_Buffer = 0x03;
    GPIO_ReadPhysicalPorts();
}

GPIO_SetPort_P10()
{
    bSetGPIOChannel_Buffer = 0x0A;
    GPIO_ReadPhysicalPorts();
}

GPIO_SetPort_P11()
{
    bSetGPIOChannel_Buffer = 0x0B;
    GPIO_ReadPhysicalPorts();
}

GPIO_SetPort_P16()
{
    bSetGPIOChannel_Buffer = 0x10;
    GPIO_ReadPhysicalPorts();
}

GPIO_SetPort_P17()
{
    bSetGPIOChannel_Buffer = 0x11;
    GPIO_ReadPhysicalPorts();
}

GPIO_SetPort_P21()
{
    bSetGPIOChannel_Buffer = 0x15;
    GPIO_ReadPhysicalPorts();
}
GPIO_SetPort_P40()
{
    bSetGPIOChannel_Buffer = 0x28; //HL only
    GPIO_ReadPhysicalPorts();
}
GPIO_SetPort_P42()
{
    bSetGPIOChannel_Buffer = 0x2A;
    GPIO_ReadPhysicalPorts();
}
GPIO_SetPort_P43()
{
    bSetGPIOChannel_Buffer = 0x2B;
    GPIO_ReadPhysicalPorts();
}

GPIO_SetPort_P44()
{
    bSetGPIOChannel_Buffer = 0x2C;
    GPIO_ReadPhysicalPorts();
}

GPIO_SetPort_P45()
{
    bSetGPIOChannel_Buffer = 0x2D;
    GPIO_ReadPhysicalPorts();
}

GPIO_SetPort_JP0()
{
    bSetGPIOChannel_Buffer = 0x30;
    GPIO_ReadPhysicalPorts();
}

ID_AUTOsar_ID_Info_Eval()
{
    if(( rsBuf[0] == 0x62 ) && 
       ( rsBuf[1] == 0xEF ) &&
       ( rsBuf[2] == 0x00 )    )
    {
        putValue( DIAG_ID_Database_Year,       rsBuf[ 3] );
        putValue( DIAG_ID_Database_Week,       rsBuf[ 4] );
        putValue( DIAG_ID_Database_PatchLevel, rsBuf[ 5] );
        DiagAktion = 0;
        putValue( DIAG_Main_ErrorStatus, "Successful" );
        bQueueWaitForResponce = FALSE;
        cancelTimer( tID_Get_TimeOutTimer );
        DIAG_CTRL_vStartNewService();
    }     
    else
        if( AntwortAuswertung( 1, rsBuf[0], rsBuf[2]) )
        {
            DiagAktion = 0;
            bQueueWaitForResponce = FALSE;
            cancelTimer( tID_Get_TimeOutTimer );
            DIAG_CTRL_vStartNewService();
        }
}

ID_AUTOsar_ID_Info_Get()
{
    DiagAktion = 0;
    if( FillCommand( ServicePhys ) ) return;
    rqBuf[0] = 0x22;
    rqBuf[1] = 0xEF;
    rqBuf[2] = 0x00;
    DIAG_SendRequest( SessionPhys, 3);
    DiagAktion = cService_Routine_AUTOsar_ID_Info_Get;
    putValue( DIAG_Main_ErrorStatus, "Warte auf Antwort..." );
    setTimer( tID_Get_TimeOutTimer, TimeOutMid);
    bQueueWaitForResponce = TRUE;
}

ID_BootLoader_Vers_BL_Info_Eval()
{
    if(( rsBuf[0] == 0x62 ) && 
       ( rsBuf[1] == 0xF1 ) &&
       ( rsBuf[2] == 0x53 )    )
    {
        putValue( DIAG_ID_BootLoader_Year_BL,       rsBuf[ 3] );
        putValue( DIAG_ID_BootLoader_Week_BL,       rsBuf[ 4] );
        putValue( DIAG_ID_BootLoader_PatchLevel_BL, rsBuf[ 5] );
        DiagAktion = 0;
        putValue( DIAG_Main_ErrorStatus, "Successful" );
        bQueueWaitForResponce = FALSE;
        cancelTimer( tID_Get_TimeOutTimer );
        DIAG_CTRL_vStartNewService();
    }     
    else
        if( AntwortAuswertung( 1, rsBuf[0], rsBuf[2]) )
        {
            DiagAktion = 0;
            bQueueWaitForResponce = FALSE;
            cancelTimer( tID_Get_TimeOutTimer );
            DIAG_CTRL_vStartNewService();
        }
}

ID_BootLoader_Vers_BL_Info_Get()
{
    DiagAktion = 0;
    if( FillCommand( ServicePhys ) ) return;
    rqBuf[0] = 0x22;
    rqBuf[1] = 0xF1;
    rqBuf[2] = 0x53;
    DIAG_SendRequest( SessionPhys, 3);
    DiagAktion = cService_Routine_BootLoader_Vers_BL_Info_Get;
    putValue( DIAG_Main_ErrorStatus, "Warte auf Antwort..." );
    setTimer( tID_Get_TimeOutTimer, TimeOutMid);
    bQueueWaitForResponce = TRUE;
}

ID_BootLoader_Vers_Info_Eval()
{
    if(( rsBuf[0] == 0x62 ) && 
       ( rsBuf[1] == 0xF1 ) &&
       ( rsBuf[2] == 0x53 )    )
    {
        putValue( DIAG_ID_BootLoader_Year,       rsBuf[ 3] );
        putValue( DIAG_ID_BootLoader_Week,       rsBuf[ 4] );
        putValue( DIAG_ID_BootLoader_PatchLevel, rsBuf[ 5] );
        DiagAktion = 0;
        putValue( DIAG_Main_ErrorStatus, "Successful" );
        bQueueWaitForResponce = FALSE;
        cancelTimer( tID_Get_TimeOutTimer );
        DIAG_CTRL_vStartNewService();
    }     
    else
        if( AntwortAuswertung( 1, rsBuf[0], rsBuf[2]) )
        {
            DiagAktion = 0;
            bQueueWaitForResponce = FALSE;
            cancelTimer( tID_Get_TimeOutTimer );
            DIAG_CTRL_vStartNewService();
        }
}

ID_BootLoader_Vers_Info_Get()
{
    DiagAktion = 0;
    if( FillCommand( ServicePhys ) ) return;
    rqBuf[0] = 0x22;
    rqBuf[1] = 0xF1;
    rqBuf[2] = 0x53;
    DIAG_SendRequest( SessionPhys, 3);
    DiagAktion = cService_Routine_BootLoader_Vers_Info_Get;
    putValue( DIAG_Main_ErrorStatus, "Warte auf Antwort..." );
    setTimer( tID_Get_TimeOutTimer, TimeOutMid);
    bQueueWaitForResponce = TRUE;
}

ID_Clear_EnvVars()
{
    putValue( DIAG_ID_SW_0_Week, 0 );
    putValue( DIAG_ID_SW_0_Year, 0 );
    putValue( DIAG_ID_SW_0_PatchLevel, 0 );
    putValue( DIAG_ID_SW_1_Week, 0 );
    putValue( DIAG_ID_SW_1_Year, 0 );
    putValue( DIAG_ID_SW_1_PatchLevel, 0 );
    putValue( DIAG_ID_SW_2_Week, 0 );
    putValue( DIAG_ID_SW_2_Year, 0 );
    putValue( DIAG_ID_SW_2_PatchLevel, 0 );
    putValue( DIAG_ID_SW_3_Week, 0 );
    putValue( DIAG_ID_SW_3_Year, 0 );
    putValue( DIAG_ID_SW_3_PatchLevel, 0 );
    putValue( DIAG_ID_SW_4_Week, 0 );
    putValue( DIAG_ID_SW_4_Year, 0 );
    putValue( DIAG_ID_SW_4_PatchLevel, 0 );
    putValue( DIAG_ID_SW_5_Week, 0 );
    putValue( DIAG_ID_SW_5_Year, 0 );
    putValue( DIAG_ID_SW_5_PatchLevel, 0 );
    putValue( DIAG_ID_SW_6_Week, 0 );
    putValue( DIAG_ID_SW_6_Year, 0 );
    putValue( DIAG_ID_SW_6_PatchLevel, 0 );
    putValue( DIAG_ID_SW_7_Week, 0 );
    putValue( DIAG_ID_SW_7_Year, 0 );
    putValue( DIAG_ID_SW_7_PatchLevel, 0 );
    putValue( DIAG_ID_SW_8_Week, 0 );
    putValue( DIAG_ID_SW_8_Year, 0 );
    putValue( DIAG_ID_SW_8_PatchLevel, 0 );
    putValue( DIAG_ID_SW_9_Week, 0 );
    putValue( DIAG_ID_SW_9_Year, 0 );
    putValue( DIAG_ID_SW_9_PatchLevel, 0 );
    putValue( DIAG_ID_SW_0_Week_BL, 0 );
    putValue( DIAG_ID_SW_0_Year_BL, 0 );
    putValue( DIAG_ID_SW_0_PatchLevel_BL, 0 );
    putValue( DIAG_ID_SW_1_Week_BL, 0 );
    putValue( DIAG_ID_SW_1_Year_BL, 0 );
    putValue( DIAG_ID_SW_1_PatchLevel_BL, 0 );
    putValue( DIAG_ID_SW_2_Week_BL, 0 );
    putValue( DIAG_ID_SW_2_Year_BL, 0 );
    putValue( DIAG_ID_SW_2_PatchLevel_BL, 0 );
    putValue( DIAG_ID_SW_3_Week_BL, 0 );
    putValue( DIAG_ID_SW_3_Year_BL, 0 );
    putValue( DIAG_ID_SW_3_PatchLevel_BL, 0 );
    putValue( DIAG_ID_SW_4_Week_BL, 0 );
    putValue( DIAG_ID_SW_4_Year_BL, 0 );
    putValue( DIAG_ID_SW_4_PatchLevel_BL, 0 );
    putValue( DIAG_ID_SW_5_Week_BL, 0 );
    putValue( DIAG_ID_SW_5_Year_BL, 0 );
    putValue( DIAG_ID_SW_5_PatchLevel_BL, 0 );
    putValue( DIAG_ID_SW_6_Week_BL, 0 );
    putValue( DIAG_ID_SW_6_Year_BL, 0 );
    putValue( DIAG_ID_SW_6_PatchLevel_BL, 0 );
    putValue( DIAG_ID_SW_7_Week_BL, 0 );
    putValue( DIAG_ID_SW_7_Year_BL, 0 );
    putValue( DIAG_ID_SW_7_PatchLevel_BL, 0 );
    putValue( DIAG_ID_SW_8_Week_BL, 0 );
    putValue( DIAG_ID_SW_8_Year_BL, 0 );
    putValue( DIAG_ID_SW_8_PatchLevel_BL, 0 );
    putValue( DIAG_ID_SW_9_Week_BL, 0 );
    putValue( DIAG_ID_SW_9_Year_BL, 0 );
    putValue( DIAG_ID_SW_9_PatchLevel_BL, 0 );
    putValue( DIAG_ID_BootLoader_Week, 0 );
    putValue( DIAG_ID_BootLoader_Year, 0 );
    putValue( DIAG_ID_BootLoader_PatchLevel, 0 );
    putValue( DIAG_ID_BootLoader_Week_BL, 0 );
    putValue( DIAG_ID_BootLoader_Year_BL, 0 );
    putValue( DIAG_ID_BootLoader_PatchLevel_BL, 0 );
    putValue( DIAG_ID_SW_0_DAI_Num, "" );
    putValue( DIAG_ID_SW_0_DAI_ZGS, "" );
    putValue( DIAG_ID_SW_0_VDO_Ver_Week, 0 );
    putValue( DIAG_ID_SW_0_VDO_Ver_Year, 0 );
    putValue( DIAG_ID_SW_0_VDO_Ver_PatchLevel, 0 );
    putValue( DIAG_ID_SW_0_VDO_SAP, "" );
    putValue( DIAG_ID_SW_1_DAI_Num, "" );
    putValue( DIAG_ID_SW_1_DAI_ZGS, "" );
    putValue( DIAG_ID_SW_1_VDO_Ver_Week, 0 );
    putValue( DIAG_ID_SW_1_VDO_Ver_Year, 0 );
    putValue( DIAG_ID_SW_1_VDO_Ver_PatchLevel, 0 );
    putValue( DIAG_ID_SW_1_VDO_SAP, "" );
    putValue( DIAG_ID_SW_2_DAI_Num, "" );
    putValue( DIAG_ID_SW_2_DAI_ZGS, "" );
    putValue( DIAG_ID_SW_2_VDO_Ver, "" );
    putValue( DIAG_ID_SW_2_VDO_SAP, "" );
    putValue( DIAG_ID_SW_3_DAI_Num, "" );
    putValue( DIAG_ID_SW_3_DAI_ZGS, "" );
    putValue( DIAG_ID_SW_3_VDO_Ver, "" );
    putValue( DIAG_ID_SW_3_VDO_SAP, "" );
    putValue( DIAG_ID_SW_4_DAI_Num, "" );
    putValue( DIAG_ID_SW_4_DAI_ZGS, "" );
    putValue( DIAG_ID_SW_4_VDO_Ver, "" );
    putValue( DIAG_ID_SW_4_VDO_SAP, "" );
    putValue( DIAG_ID_SW_5_DAI_Num, "" );
    putValue( DIAG_ID_SW_5_DAI_ZGS, "" );
    putValue( DIAG_ID_SW_5_VDO_Ver, "" );
    putValue( DIAG_ID_SW_5_VDO_SAP, "" );
    putValue( DIAG_ID_SW_6_DAI_Num, "" );
    putValue( DIAG_ID_SW_6_DAI_ZGS, "" );
    putValue( DIAG_ID_SW_6_VDO_Ver, "" );
    putValue( DIAG_ID_SW_6_VDO_SAP, "" );
    putValue( DIAG_ID_SW_7_DAI_Num, "" );
    putValue( DIAG_ID_SW_7_DAI_ZGS, "" );
    putValue( DIAG_ID_SW_7_VDO_Ver, "" );
    putValue( DIAG_ID_SW_7_VDO_SAP, "" );
    putValue( DIAG_ID_SW_8_DAI_Num, "" );
    putValue( DIAG_ID_SW_8_DAI_ZGS, "" );
    putValue( DIAG_ID_SW_8_VDO_Ver, "" );
    putValue( DIAG_ID_SW_8_VDO_SAP, "" );
    putValue( DIAG_ID_SW_9_DAI_Num, "" );
    putValue( DIAG_ID_SW_9_DAI_ZGS, "" );
    putValue( DIAG_ID_SW_9_VDO_Ver, "" );
    putValue( DIAG_ID_SW_9_VDO_SAP, "" );
    putValue( DIAG_ID_ZB_Num, "" );
    putValue( DIAG_ID_ZB_ZGS, "" );
    putValue( DIAG_ID_HW_Num, "" );
    putValue( DIAG_ID_HW_ZGS, "" );
    putValue( DIAG_ID_DS_PCB, "" );
    putValue( DIAG_ID_DS_IC, "" );
    putValue( DIAG_ID_DS_Del, "" );
	putValue( DIAG_ID_vehicleManufacturerSparePartNumber, "" );
    putValue( DIAG_ID_DiagIndex, 0 );
    putValue( DIAG_ID_HW_Week, 0 );
    putValue( DIAG_ID_HW_Year, 0 );
    putValue( DIAG_ID_HW_PatchLevel, 0 );
    putValue( DIAG_ID_DiagIndex_BL, 0 );
    putValue( DIAG_ID_HW_Week_BL, 0 );
    putValue( DIAG_ID_HW_Year_BL, 0 );
    putValue( DIAG_ID_HW_PatchLevel_BL, 0 );
    putValue( DIAG_ID_Database_Week, 0 );
    putValue( DIAG_ID_Database_Year, 0 );
    putValue( DIAG_ID_Database_PatchLevel, 0 );
    putValue( DIAG_ID_SW_0_FiPri_BL, 0 );
    putValue( DIAG_ID_SW_1_FiPri_BL, 0 );
    putValue( DIAG_ID_SW_2_FiPri_BL, 0 );
    putValue( DIAG_ID_SW_3_FiPri_BL, 0 );
    putValue( DIAG_ID_SW_4_FiPri_BL, 0 );
    putValue( DIAG_ID_SW_5_FiPri_BL, 0 );
    putValue( DIAG_ID_SW_6_FiPri_BL, 0 );
    putValue( DIAG_ID_SW_7_FiPri_BL, 0 );
    putValue( DIAG_ID_SW_8_FiPri_BL, 0 );
    putValue( DIAG_ID_SW_9_FiPri_BL, 0 );
    putValue( DIAG_ID_SDF_AC_Nr, "" );
    putValue( DIAG_ID_SDF_GC_Nr, "" );
}

ID_Diag_Index_BL_Info_Eval()
{
    if(( rsBuf[0] == 0x62 ) && 
       ( rsBuf[1] == 0xF1 ) &&
       ( rsBuf[2] == 0x00 )    )
    {
        putValue( DIAG_ID_DiagIndex_BL, (( rsBuf[ 4] * 256 ) + rsBuf[ 5] ) );
        DiagAktion = 0;
        putValue( DIAG_Main_ErrorStatus, "Successful" );
        bQueueWaitForResponce = FALSE;
        cancelTimer( tID_Get_TimeOutTimer );
        DIAG_CTRL_vStartNewService();
    }     
    else
        if( AntwortAuswertung( 1, rsBuf[0], rsBuf[2]) )
        {
            DiagAktion = 0;
            bQueueWaitForResponce = FALSE;
            cancelTimer( tID_Get_TimeOutTimer );
            DIAG_CTRL_vStartNewService();
        }
}

ID_Diag_Index_BL_Info_Get()
{
    DiagAktion = 0;
    if( FillCommand( ServicePhys ) ) return;

    rqBuf[0] = 0x22;
    rqBuf[1] = 0xF1;
    rqBuf[2] = 0x00;
    DIAG_SendRequest( SessionPhys, 3);

    DiagAktion = cService_Routine_Diag_Index_BL_Info_Get;
    bQueueWaitForResponce = TRUE;
    putValue( DIAG_Main_ErrorStatus, "Warte auf Antwort..." );
    setTimer( tID_Get_TimeOutTimer, TimeOutMid);
}

ID_Diag_Index_Info_Eval()
{
    if(( rsBuf[0] == 0x62 ) && 
       ( rsBuf[1] == 0xF1 ) &&
       ( rsBuf[2] == 0x00 )    )
    {
        putValue( DIAG_ID_DiagIndex, (( rsBuf[ 4] * 256 ) + rsBuf[ 5] ) );
        DiagAktion = 0;
        putValue( DIAG_Main_ErrorStatus, "Successful" );
        bQueueWaitForResponce = FALSE;
        cancelTimer( tID_Get_TimeOutTimer );
        DIAG_CTRL_vStartNewService();
    }     
    else
        if( AntwortAuswertung( 1, rsBuf[0], rsBuf[2]) )
        {
            DiagAktion = 0;
            bQueueWaitForResponce = FALSE;
            cancelTimer( tID_Get_TimeOutTimer );
            DIAG_CTRL_vStartNewService();
        }
}

ID_Diag_Index_Info_Get()
{
    DiagAktion = 0;
    if( FillCommand( ServicePhys ) ) return;
    rqBuf[0] = 0x22;
    rqBuf[1] = 0xF1;
    rqBuf[2] = 0x00;
    DIAG_SendRequest( SessionPhys, 3);
    DiagAktion = cService_Routine_Diag_Index_Info_Get;
    bQueueWaitForResponce = TRUE;
    putValue( DIAG_Main_ErrorStatus, "Warte auf Antwort..." );
    setTimer( tID_Get_TimeOutTimer, TimeOutMid);
}

ID_ECU_ID_Info_Eval()
{
    char text[12];
    byte i,pos;

    if(( rsBuf[0] == 0x62 ) && 
       ( rsBuf[1] == 0x02 ) &&
       ( rsBuf[2] == 0x05 )    )
    {
    pos = 3;
      
    if(getValue(DIAG_CTRL_IC_Type_Selector) == cKI_VS30_HL)
    {
        for( i=0;i<10;i++)
        {
          text[ i ] = rsBuf[ pos + i ];
        }
        text[ i ]= '\0';
        putValue( DIAG_ID_ZB_Num, text );
        pos = 13;
        for( i=0;i<3;i++)
        {
          text[ i ] = rsBuf[ pos + i ];
        }
        text[ i ]= '\0';
        putValue( DIAG_ID_ZB_ZGS, text );
        pos = 16;
        for( i=0;i<10;i++)
        {
          text[ i ] = rsBuf[ pos + i ];
        }
        text[ i ]= '\0';
        putValue( DIAG_ID_HW_Num, text );
        pos = 26;
        for( i=0;i<3;i++)
        {
          text[ i ] = rsBuf[ pos + i ];
        }
        text[ i ]= '\0';
        putValue( DIAG_ID_HW_ZGS, text );
        pos = 29;
        for( i=0;i<10;i++)
        {
          text[ i ] = rsBuf[ pos + i ];
        }
        text[ i ]= '\0';
        putValue( DIAG_ID_SW_0_DAI_Num, text );
        pos = 39;
        for( i=0;i<3;i++)
        {
          text[ i ] = rsBuf[ pos + i ];
        }
        text[ i ]= '\0';
        putValue( DIAG_ID_SW_0_DAI_ZGS, text );
        pos = 42;
        for( i=0;i<10;i++)
        {
          text[ i ] = rsBuf[ pos + i ];
        }
        text[ i ]= '\0';
        putValue( DIAG_ID_SW_1_DAI_Num, text );
        pos = 52;
        for( i=0;i<3;i++)
        {
          text[ i ] = rsBuf[ pos + i ];
        }
        text[ i ]= '\0';
        putValue( DIAG_ID_SW_1_DAI_ZGS, text );
        pos = 55;
        for( i=0;i<10;i++)
        {
          text[ i ] = rsBuf[ pos + i ];
        }
        text[ i ]= '\0';
        putValue( DIAG_ID_SW_2_DAI_Num, text );
        pos = 65;
        for( i=0;i<3;i++)
        {
          text[ i ] = rsBuf[ pos + i ];
        }
        text[ i ]= '\0';
        putValue( DIAG_ID_SW_2_DAI_ZGS, text );
        pos = 68;
        for( i=0;i<10;i++)
        {
          text[ i ] = rsBuf[ pos + i ];
        }
        text[ i ]= '\0';
        putValue( DIAG_ID_SW_3_DAI_Num, text );
        pos = 78;
        for( i=0;i<3;i++)
        {
          text[ i ] = rsBuf[ pos + i ];
        }
        text[ i ]= '\0';
        putValue( DIAG_ID_SW_3_DAI_ZGS, text );
        pos = 81;
        for( i=0;i<10;i++)
        {
          text[ i ] = rsBuf[ pos + i ];
        }
        text[ i ]= '\0';
        putValue( DIAG_ID_SW_4_DAI_Num, text );
        pos = 91;
        for( i=0;i<3;i++)
        {
          text[ i ] = rsBuf[ pos + i ];
        }
        text[ i ]= '\0';
        putValue( DIAG_ID_SW_4_DAI_ZGS, text );
        pos = 94;
        for( i=0;i<10;i++)
        {
          text[ i ] = rsBuf[ pos + i ];
        }
        text[ i ]= '\0';
        putValue( DIAG_ID_SW_5_DAI_Num, text );
        pos = 104;
        for( i=0;i<3;i++)
        {
          text[ i ] = rsBuf[ pos + i ];
        }
        text[ i ]= '\0';
        putValue( DIAG_ID_SW_5_DAI_ZGS, text );
        pos = 107;
        for( i=0;i<10;i++)
        {
          text[ i ] = rsBuf[ pos + i ];
        }
        text[ i ]= '\0';
        putValue( DIAG_ID_SW_6_DAI_Num, text );
        pos = 117;
        for( i=0;i<3;i++)
        {
          text[ i ] = rsBuf[ pos + i ];
        }
        text[ i ]= '\0';
        putValue( DIAG_ID_SW_6_DAI_ZGS, text );
        pos = 120;
        for( i=0;i<10;i++)
        {
          text[ i ] = rsBuf[ pos + i ];
        }
        text[ i ]= '\0';
        putValue( DIAG_ID_SW_7_DAI_Num, text );
        pos = 130;
        for( i=0;i<3;i++)
        {
          text[ i ] = rsBuf[ pos + i ];
        }
        text[ i ]= '\0';
        putValue( DIAG_ID_SW_7_DAI_ZGS, text );
        pos = 133;
        for( i=0;i<10;i++)
        {
          text[ i ] = rsBuf[ pos + i ];
        }
        text[ i ]= '\0';
        putValue( DIAG_ID_SW_8_DAI_Num, text );
        pos = 143;
        for( i=0;i<3;i++)
        {
          text[ i ] = rsBuf[ pos + i ];
        }
        text[ i ]= '\0';
        putValue( DIAG_ID_SW_8_DAI_ZGS, text );
        pos = 146;
        for( i=0;i<10;i++)
        {
          text[ i ] = rsBuf[ pos + i ];
        }
        text[ i ]= '\0';
        putValue( DIAG_ID_SW_9_DAI_Num, text );
        pos = 156;
        for( i=0;i<3;i++)
        {
          text[ i ] = rsBuf[ pos + i ];
        }
        text[ i ]= '\0';
        putValue( DIAG_ID_SW_9_DAI_ZGS, text );
        pos = 159;

        DiagAktion = 0;
        putValue( DIAG_Main_ErrorStatus, "Successful" );
        bQueueWaitForResponce = FALSE;
        cancelTimer( tID_Get_TimeOutTimer );
        DIAG_CTRL_vStartNewService();
    }
    else 
      if(getValue(DIAG_CTRL_IC_Type_Selector) == cKI_VS30_EL)
      {   
            for( i=0;i<10;i++)
            {
              text[ i ] = rsBuf[ pos + i ];
            }
            text[ i ]= '\0';
            putValue( DIAG_ID_ZB_Num, text );
            pos = 13;
            for( i=0;i<3;i++)
            {
              text[ i ] = rsBuf[ pos + i ];
            }
            text[ i ]= '\0';
            putValue( DIAG_ID_ZB_ZGS, text );
            pos = 16;
            for( i=0;i<10;i++)
            {
              text[ i ] = rsBuf[ pos + i ];
            }
            text[ i ]= '\0';
            putValue( DIAG_ID_HW_Num, text );
            pos = 26;
            for( i=0;i<3;i++)
            {
              text[ i ] = rsBuf[ pos + i ];
            }
            text[ i ]= '\0';
            putValue( DIAG_ID_HW_ZGS, text );
            pos = 29;
            for( i=0;i<10;i++)
            {
              text[ i ] = rsBuf[ pos + i ];
            }
            text[ i ]= '\0';
            putValue( DIAG_ID_SW_0_DAI_Num, text );
            pos = 39;
            for( i=0;i<3;i++)
            {
              text[ i ] = rsBuf[ pos + i ];
            }
            text[ i ]= '\0';
            putValue( DIAG_ID_SW_0_DAI_ZGS, text );
            pos = 42;
            for( i=0;i<10;i++)
            {
              text[ i ] = rsBuf[ pos + i ];
            }
            text[ i ]= '\0';
            putValue( DIAG_ID_SW_1_DAI_Num, text );
            pos = 52;
            for( i=0;i<3;i++)
            {
              text[ i ] = rsBuf[ pos + i ];
            }
            text[ i ]= '\0';
            putValue( DIAG_ID_SW_1_DAI_ZGS, text );
            pos = 55;

            DiagAktion = 0;
            putValue( DIAG_Main_ErrorStatus, "Successful" );
            bQueueWaitForResponce = FALSE;
            cancelTimer( tID_Get_TimeOutTimer );
            DIAG_CTRL_vStartNewService();
      }
    }
    else
        if( AntwortAuswertung( 1, rsBuf[0], rsBuf[2]) )
        {
            DiagAktion = 0;
            bQueueWaitForResponce = FALSE;
            cancelTimer( tID_Get_TimeOutTimer );
            DIAG_CTRL_vStartNewService();
        }
}

ID_ECU_ID_Info_Get()
{
    DiagAktion = 0;
    if( FillCommand( ServicePhys ) ) return;
    rqBuf[0] = 0x22;
    rqBuf[1] = 0x02;
    rqBuf[2] = 0x05;
    DIAG_SendRequest( SessionPhys, 3);
    DiagAktion = cService_Routine_ECU_ID_Info_Get;
    bQueueWaitForResponce = TRUE;
    putValue( DIAG_Main_ErrorStatus, "Warte auf Antwort..." );
    setTimer( tID_Get_TimeOutTimer, TimeOutMid);
}

ID_Fingerprint_Eval()
{
    if(( rsBuf[0] == 0x62 ) && 
       ( rsBuf[1] == 0xF1 ) &&
       ( rsBuf[2] == 0x5B )    )
    {
      if(getValue(DIAG_CTRL_IC_Type_Selector) == 44)
      {
        putValue( DIAG_ID_SW_0_FiPri_BL, rsBuf[ 3] );
        putValue( DIAG_ID_SW_1_FiPri_BL, rsBuf[13] );
      }
      if(getValue(DIAG_CTRL_IC_Type_Selector) == 45)
      {
        putValue( DIAG_ID_SW_0_FiPri_BL, rsBuf[ 3] );
        putValue( DIAG_ID_SW_1_FiPri_BL, rsBuf[13] );
        putValue( DIAG_ID_SW_2_FiPri_BL, rsBuf[23] );
        putValue( DIAG_ID_SW_3_FiPri_BL, rsBuf[33] );
        putValue( DIAG_ID_SW_4_FiPri_BL, rsBuf[43] );
        putValue( DIAG_ID_SW_5_FiPri_BL, rsBuf[53] );
      }
        DiagAktion = 0;
        putValue( DIAG_Main_ErrorStatus, "Successful" );
        bQueueWaitForResponce = FALSE;
        cancelTimer( tID_Get_TimeOutTimer );
        DIAG_CTRL_vStartNewService();
    }     
    else
        if( AntwortAuswertung( 1, rsBuf[0], rsBuf[2]) )
        {
            DiagAktion = 0;
            bQueueWaitForResponce = FALSE;
            cancelTimer( tID_Get_TimeOutTimer );
            DIAG_CTRL_vStartNewService();
        }
}

ID_Fingerprint_Get()
{
    DiagAktion = 0;
    if( FillCommand( ServicePhys ) ) return;
    rqBuf[0] = 0x22;
    rqBuf[1] = 0xF1;
    rqBuf[2] = 0x5B;
    DIAG_SendRequest( SessionPhys, 3);
    DiagAktion = cService_Routine_FingerPrint_Get;
    bQueueWaitForResponce = TRUE;
    putValue( DIAG_Main_ErrorStatus, "Warte auf Antwort..." );
    setTimer( tID_Get_TimeOutTimer, TimeOutMid);
}

ID_HW_Vers_BL_Info_Eval()
{
    if(( rsBuf[0] == 0x62 ) && 
       ( rsBuf[1] == 0xF1 ) &&
       ( rsBuf[2] == 0x50 )    )
    {
        putValue( DIAG_ID_HW_Year_BL,       rsBuf[ 3] );
        putValue( DIAG_ID_HW_Week_BL,       rsBuf[ 4] );
        putValue( DIAG_ID_HW_PatchLevel_BL, rsBuf[ 5] );
        DiagAktion = 0;
        putValue( DIAG_Main_ErrorStatus, "Successful" );
        bQueueWaitForResponce = FALSE;
        cancelTimer( tID_Get_TimeOutTimer );
        DIAG_CTRL_vStartNewService();
    }     
    else
        if( AntwortAuswertung( 1, rsBuf[0], rsBuf[2]) )
        {
             DiagAktion = 0;
            bQueueWaitForResponce = FALSE;
            cancelTimer( tID_Get_TimeOutTimer );
            DIAG_CTRL_vStartNewService();
        }
}

ID_HW_Vers_BL_Info_Get()
{
    DiagAktion = 0;
    if( FillCommand( ServicePhys ) ) return;
    rqBuf[0] = 0x22;
    rqBuf[1] = 0xF1;
    rqBuf[2] = 0x50;
    DIAG_SendRequest( SessionPhys, 3);
    DiagAktion = cService_Routine_HW_Vers_BL_Info_Get;
    putValue( DIAG_Main_ErrorStatus, "Warte auf Antwort..." );
    setTimer( tID_Get_TimeOutTimer, TimeOutMid);
    bQueueWaitForResponce = TRUE;
}

ID_HW_Vers_Info_Eval()
{
    if(( rsBuf[0] == 0x62 ) && 
       ( rsBuf[1] == 0xF1 ) &&
       ( rsBuf[2] == 0x50 )    )
    {
        putValue( DIAG_ID_HW_Year,          rsBuf[ 3] );
        putValue( DIAG_ID_HW_Week,          rsBuf[ 4] );
        putValue( DIAG_ID_HW_PatchLevel,    rsBuf[ 5] );
        DiagAktion = 0;
        putValue( DIAG_Main_ErrorStatus, "Successful" );
        bQueueWaitForResponce = FALSE;
        cancelTimer( tID_Get_TimeOutTimer );
        DIAG_CTRL_vStartNewService();
    }     
    else
        if( AntwortAuswertung( 1, rsBuf[0], rsBuf[2]) )
        {
            DiagAktion = 0;
            bQueueWaitForResponce = FALSE;
            cancelTimer( tID_Get_TimeOutTimer );
            DIAG_CTRL_vStartNewService();
        }
}

ID_HW_Vers_Info_Get()
{
    DiagAktion = 0;
    if( FillCommand( ServicePhys ) ) return;
    rqBuf[0] = 0x22;
    rqBuf[1] = 0xF1;
    rqBuf[2] = 0x50;
    DIAG_SendRequest( SessionPhys, 3);
    DiagAktion = cService_Routine_HW_Vers_Info_Get;
    putValue( DIAG_Main_ErrorStatus, "Warte auf Antwort..." );
    setTimer( tID_Get_TimeOutTimer, TimeOutMid);
    bQueueWaitForResponce = TRUE;
}

ID_SW_Vers_BL_Info_Eval( int Laenge )
{
    if(( rsBuf[0] == 0x62 ) && 
       ( rsBuf[1] == 0xF1 ) &&
       ( rsBuf[2] == 0x51 )    )
    {
        putValue( DIAG_ID_SW_0_Year_BL,       rsBuf[ 3] );
        putValue( DIAG_ID_SW_0_Week_BL,       rsBuf[ 4] );
        putValue( DIAG_ID_SW_0_PatchLevel_BL, rsBuf[ 5] );
        putValue( DIAG_ID_SW_1_Year_BL,       rsBuf[ 6] );
        putValue( DIAG_ID_SW_1_Week_BL,       rsBuf[ 7] );
        putValue( DIAG_ID_SW_1_PatchLevel_BL, rsBuf[ 8] );
        if( Laenge > 9 )
        {
            putValue( DIAG_ID_SW_2_Year_BL,       rsBuf[ 9] );
            putValue( DIAG_ID_SW_2_Week_BL,       rsBuf[10] );
            putValue( DIAG_ID_SW_2_PatchLevel_BL, rsBuf[11] );
            putValue( DIAG_ID_SW_3_Year_BL,       rsBuf[12] );
            putValue( DIAG_ID_SW_3_Week_BL,       rsBuf[13] );
            putValue( DIAG_ID_SW_3_PatchLevel_BL, rsBuf[14] );
            putValue( DIAG_ID_SW_4_Year_BL,       rsBuf[15] );
            putValue( DIAG_ID_SW_4_Week_BL,       rsBuf[16] );
            putValue( DIAG_ID_SW_4_PatchLevel_BL, rsBuf[17] );
            putValue( DIAG_ID_SW_5_Year_BL,       rsBuf[18] );
            putValue( DIAG_ID_SW_5_Week_BL,       rsBuf[19] );
            putValue( DIAG_ID_SW_5_PatchLevel_BL, rsBuf[20] );
            putValue( DIAG_ID_SW_6_Year_BL,       rsBuf[21] );
            putValue( DIAG_ID_SW_6_Week_BL,       rsBuf[22] );
            putValue( DIAG_ID_SW_6_PatchLevel_BL, rsBuf[23] );
            putValue( DIAG_ID_SW_7_Year_BL,       rsBuf[24] );
            putValue( DIAG_ID_SW_7_Week_BL,       rsBuf[25] );
            putValue( DIAG_ID_SW_7_PatchLevel_BL, rsBuf[26] );
            putValue( DIAG_ID_SW_8_Year_BL,       rsBuf[27] );
            putValue( DIAG_ID_SW_8_Week_BL,       rsBuf[28] );
            putValue( DIAG_ID_SW_8_PatchLevel_BL, rsBuf[29] );
            putValue( DIAG_ID_SW_9_Year_BL,       rsBuf[30] );
            putValue( DIAG_ID_SW_9_Week_BL,       rsBuf[31] );
            putValue( DIAG_ID_SW_9_PatchLevel_BL, rsBuf[32] );
        }
        DiagAktion = 0;
        putValue( DIAG_Main_ErrorStatus, "Successful" );
        bQueueWaitForResponce = FALSE;
        cancelTimer( tID_Get_TimeOutTimer );
        DIAG_CTRL_vStartNewService();
    }     
    else
        if( AntwortAuswertung( 1, rsBuf[0], rsBuf[2]) )
        {
             DiagAktion = 0;
            bQueueWaitForResponce = FALSE;
            cancelTimer( tID_Get_TimeOutTimer );
            DIAG_CTRL_vStartNewService();
        }
}

ID_SW_Vers_BL_Info_Get()
{
    DiagAktion = 0;
    if( FillCommand( ServicePhys ) ) return;
    rqBuf[0] = 0x22;
    rqBuf[1] = 0xF1;
    rqBuf[2] = 0x51;
    DIAG_SendRequest( SessionPhys, 3);
    DiagAktion = cService_Routine_SW_Vers_BL_Info_Get;
    bQueueWaitForResponce = TRUE;
    putValue( DIAG_Main_ErrorStatus, "Warte auf Antwort..." );
    setTimer( tID_Get_TimeOutTimer, TimeOutMid);
}

ID_SW_Vers_Info_Eval()
{
    if(( rsBuf[0] == 0x62 ) && 
       ( rsBuf[1] == 0xF1 ) &&
       ( rsBuf[2] == 0x51 )    )
    {
        if(getValue(DIAG_CTRL_IC_Type_Selector) == cKI_VS30_HL)
        {
          putValue( DIAG_ID_SW_0_Year,       rsBuf[ 3] );
          putValue( DIAG_ID_SW_0_Week,       rsBuf[ 4] );
          putValue( DIAG_ID_SW_0_PatchLevel, rsBuf[ 5] );
          putValue( DIAG_ID_SW_1_Year,       rsBuf[ 6] );
          putValue( DIAG_ID_SW_1_Week,       rsBuf[ 7] );
          putValue( DIAG_ID_SW_1_PatchLevel, rsBuf[ 8] );
          putValue( DIAG_ID_SW_2_Year,       rsBuf[ 9] );
          putValue( DIAG_ID_SW_2_Week,       rsBuf[10] );
          putValue( DIAG_ID_SW_2_PatchLevel, rsBuf[11] );
          putValue( DIAG_ID_SW_3_Year,       rsBuf[12] );
          putValue( DIAG_ID_SW_3_Week,       rsBuf[13] );
          putValue( DIAG_ID_SW_3_PatchLevel, rsBuf[14] );
          putValue( DIAG_ID_SW_4_Year,       rsBuf[15] );
          putValue( DIAG_ID_SW_4_Week,       rsBuf[16] );
          putValue( DIAG_ID_SW_4_PatchLevel, rsBuf[17] );
          putValue( DIAG_ID_SW_5_Year,       rsBuf[18] );
          putValue( DIAG_ID_SW_5_Week,       rsBuf[19] );
          putValue( DIAG_ID_SW_5_PatchLevel, rsBuf[20] );
          putValue( DIAG_ID_SW_6_Year,       rsBuf[21] );
          putValue( DIAG_ID_SW_6_Week,       rsBuf[22] );
          putValue( DIAG_ID_SW_6_PatchLevel, rsBuf[23] );
          putValue( DIAG_ID_SW_7_Year,       rsBuf[24] );
          putValue( DIAG_ID_SW_7_Week,       rsBuf[25] );
          putValue( DIAG_ID_SW_7_PatchLevel, rsBuf[26] );
          putValue( DIAG_ID_SW_8_Year,       rsBuf[27] );
          putValue( DIAG_ID_SW_8_Week,       rsBuf[28] );
          putValue( DIAG_ID_SW_8_PatchLevel, rsBuf[29] );
          putValue( DIAG_ID_SW_9_Year,       rsBuf[30] );
          putValue( DIAG_ID_SW_9_Week,       rsBuf[31] );
          putValue( DIAG_ID_SW_9_PatchLevel, rsBuf[32] );
          DiagAktion = 0;
          putValue( DIAG_Main_ErrorStatus, "Successful" );
          bQueueWaitForResponce = FALSE;
          cancelTimer( tID_Get_TimeOutTimer );
          DIAG_CTRL_vStartNewService();
        }
        else if (getValue(DIAG_CTRL_IC_Type_Selector) == cKI_VS30_EL)
        {
          putValue( DIAG_ID_SW_0_Year,       rsBuf[ 3] );
          putValue( DIAG_ID_SW_0_Week,       rsBuf[ 4] );
          putValue( DIAG_ID_SW_0_PatchLevel, rsBuf[ 5] );
          putValue( DIAG_ID_SW_1_Year,       rsBuf[ 6] );
          putValue( DIAG_ID_SW_1_Week,       rsBuf[ 7] );
          putValue( DIAG_ID_SW_1_PatchLevel, rsBuf[ 8] );
          DiagAktion = 0;
          putValue( DIAG_Main_ErrorStatus, "Successful" );
          bQueueWaitForResponce = FALSE;
          cancelTimer( tID_Get_TimeOutTimer );
          DIAG_CTRL_vStartNewService();
        }
    }     
    else
        if( AntwortAuswertung( 1, rsBuf[0], rsBuf[2]) )
        {
            DiagAktion = 0;
            bQueueWaitForResponce = FALSE;
            cancelTimer( tID_Get_TimeOutTimer );
            DIAG_CTRL_vStartNewService();
        }
}

ID_SW_Vers_Info_Get()
{
    DiagAktion = 0;
    if( FillCommand( ServicePhys ) ) return;
    rqBuf[0] = 0x22;
    rqBuf[1] = 0xF1;
    rqBuf[2] = 0x51;
    DIAG_SendRequest( SessionPhys, 3);
    DiagAktion = cService_Routine_SW_Vers_Info_Get;
    bQueueWaitForResponce = TRUE;
    putValue( DIAG_Main_ErrorStatus, "Warte auf Antwort..." );
    setTimer( tID_Get_TimeOutTimer, TimeOutMid);
}

ID_VDO_AC_Bootloader_Version_Eval()
{
    if( rsBuf[0] == 0x63 )
    {
        CAL_EvalReceivedValue( bReadCAL_CurrentPosition );
        
        if( bReadCAL_CurrentPosition < 9 )
        {
            DIAG_CTRL_vStartNewService();
        }
        else
        {
            CAL_EvalReceivedValue( bReadRawADC_CurrentChannel );
            bReadCAL_CurrentPosition = 0xFF;
            DiagAktion = 0;
            bQueueWaitForResponce = FALSE; 
            cancelTimer( tCAL_ReadTimeOutTimer );
            putValue( DIAG_CAL_StatusBar, "Successful finished" );
        }

    }
    else
        if(AntwortAuswertung( 1, rsBuf[0], rsBuf[2]))
        {
            DiagAktion = 0;
            bQueueWaitForResponce = FALSE; 
            cancelTimer( tADC_GetRaw_TimeOutTimer );
            putValue( DIAG_CAL_StatusBar, "Error while executing" );
        }
    DIAG_CTRL_vStartNewService();

}

ID_VDO_AC_Bootloader_Version_Get( dword adresse )
{
    
    DiagAktion = 0;
    if(FillCommand(ServicePhys)) return;
    {
        rqBuf[0] = 0x23;
        rqBuf[1] = 0x14;
        rqBuf[2] = ( adresse & 0xFF000000 ) >> 24;
        rqBuf[3] = ( adresse & 0x00FF0000 ) >> 16;
        rqBuf[4] = ( adresse & 0x0000FF00 ) >> 8;
        rqBuf[5] = ( adresse & 0x000000FF );
        rqBuf[6] = 0x03;
        DIAG_SendRequest(SessionPhys, 7);
    }
    DiagAktion = cService_Routine_VDO_AC_BootLoader_Version_Get;
    bQueueWaitForResponce = TRUE; 
    putValue( DIAG_CAL_StatusBar, "Waiting for answer..." );
    setTimer( tCAL_ReadTimeOutTimer, TimeOut);
}

ID_VDO_GC_Bootloader_Version_Get( dword adresse )
{
    
    DiagAktion = 0;
    if(FillCommand(ServicePhys)) return;
    {
        rqBuf[0] = 0x23;
        rqBuf[1] = 0x14;
        rqBuf[2] = ( adresse & 0xFF000000 ) >> 24;
        rqBuf[3] = ( adresse & 0x00FF0000 ) >> 16;
        rqBuf[4] = ( adresse & 0x0000FF00 ) >> 8;
        rqBuf[5] = ( adresse & 0x000000FF );
        rqBuf[6] = 0x03;
        DIAG_SendRequest(SessionPhys, 7);
    }
    DiagAktion = cService_Routine_VDO_GC_BootLoader_Version_Get;
    bQueueWaitForResponce = TRUE; 
    putValue( DIAG_CAL_StatusBar, "Waiting for answer..." );
    setTimer( tCAL_ReadTimeOutTimer, TimeOut);
}

ID_VDO_SAP_Nr_Info_Eval()
{
    char text[12];
    byte i,pos;

    if(( rsBuf[0] == 0x62 ) && 
       ( rsBuf[1] == 0xFD ) &&
       ( rsBuf[2] == 0x07 )    )
    {
        pos = 3;

        for( i=0;i<10;i++)
        {
            text[ i ] = rsBuf[ pos + i ];
        }
        text[ i ]= '\0';
        putValue( DIAG_ID_DS_PCB, text );
        pos = 13;
        for( i=0;i<10;i++)
        {
            text[ i ] = rsBuf[ pos + i ];
        }
        text[ i ]= '\0';
        putValue( DIAG_ID_DS_IC, text );
        pos = 23;
        for( i=0;i<10;i++)
        {
            text[ i ] = rsBuf[ pos + i ];
        }
        text[ i ]= '\0';
        putValue( DIAG_ID_DS_Del, text );
        pos = 33;
        for( i=0;i<10;i++)
        {
            text[ i ] = rsBuf[ pos + i ];
        }
        text[ i ]= '\0';
        putValue( DIAG_ID_SW_0_VDO_SAP, text );
        pos = 43;
        for( i=0;i<10;i++)
        {
            text[ i ] = rsBuf[ pos + i ];
        }
        text[ i ]= '\0';
        putValue( DIAG_ID_SW_1_VDO_SAP, text );
        pos = 53;
 
        DiagAktion = 0;
        putValue( DIAG_Main_ErrorStatus, "Successful" );
        bQueueWaitForResponce = FALSE;
        cancelTimer( tID_Get_TimeOutTimer );
        DIAG_CTRL_vStartNewService();
    }     
    else
        if( AntwortAuswertung( 1, rsBuf[0], rsBuf[2]) )
        {
            DiagAktion = 0;
            bQueueWaitForResponce = FALSE;
            cancelTimer( tID_Get_TimeOutTimer );
            DIAG_CTRL_vStartNewService();
        }
}

ID_VDO_SAP_Nr_Info_Get()
{
    DiagAktion = 0;
    if( FillCommand( ServicePhys ) ) return;
    rqBuf[0] = 0x22;
    rqBuf[1] = 0xFD;
    rqBuf[2] = 0x07;
    DIAG_SendRequest( SessionPhys, 3);
    DiagAktion = cService_Routine_VDO_SAP_Nr_Info_Get;
    putValue( DIAG_Main_ErrorStatus, "Warte auf Antwort..." );
    setTimer( tID_Get_TimeOutTimer, TimeOutMid);
    bQueueWaitForResponce = TRUE;
}

ID_VDO_Vers_Info_Eval()
{
    if(( rsBuf[0] == 0x62 ) && 
       ( rsBuf[1] == 0xFD ) &&
       ( rsBuf[2] == 0x08 )    )
    {
        putValue( DIAG_ID_SW_0_VDO_Ver_Year,       rsBuf[ 3] );
        putValue( DIAG_ID_SW_0_VDO_Ver_Week,       rsBuf[ 4] );
        putValue( DIAG_ID_SW_0_VDO_Ver_PatchLevel, rsBuf[ 5] );
        putValue( DIAG_ID_SW_1_VDO_Ver_Year,       rsBuf[ 6] );
        putValue( DIAG_ID_SW_1_VDO_Ver_Week,       rsBuf[ 7] );
        putValue( DIAG_ID_SW_1_VDO_Ver_PatchLevel, rsBuf[ 8] );
        DiagAktion = 0;
        putValue( DIAG_Main_ErrorStatus, "Successful" );
        bQueueWaitForResponce = FALSE;
        cancelTimer( tID_Get_TimeOutTimer );
        DIAG_CTRL_vStartNewService();
    }     
    else
        if( AntwortAuswertung( 1, rsBuf[0], rsBuf[2]) )
        {
             DiagAktion = 0;
            bQueueWaitForResponce = FALSE;
            cancelTimer( tID_Get_TimeOutTimer );
            DIAG_CTRL_vStartNewService();
        }
}

ID_VDO_Vers_Info_Get()
{
    DiagAktion = 0;
    if( FillCommand( ServicePhys ) ) return;
    rqBuf[0] = 0x22;
    rqBuf[1] = 0xFD;
    rqBuf[2] = 0x08;
    DIAG_SendRequest( SessionPhys, 3);
    DiagAktion = cService_Routine_VDO_Vers_Info_Get;
    putValue( DIAG_Main_ErrorStatus, "Warte auf Antwort..." );
    setTimer( tID_Get_TimeOutTimer, TimeOutMid);
    bQueueWaitForResponce = TRUE;
}

void InitOSEK_TP()
{
     long OutTime = 900;                    //keine höheren Werte eintragen, sonst Probleme mit C-CAN

     OSEKTL_SetNrmlMode();               //Normale Adressierung                s.S.14

     // Transmit ID & Receive ID
     OSEKTL_SetTxId( 0x441 );               //Transmit ID setzen                 s.S.18
     OSEKTL_SetRxId( 0x5FF );                    //Setzt aktive Receive ID       s.S.18

     OSEKTL_SetTxId( 0x641 );
     OSEKTL_SetRxId( 0x5C1 );     
    
    // FlowControl
     OSEKTL_SetBS (8);                    //Block size setzen                    s.S.14
     OSEKTL_SetSTMIN (0);               //STmin setzen                         s.S.14
     OSEKTL_SetUseFC (1);               //FlowControl aktiv                    s.S.15

     // Zero Padding
     OSEKTL_Set0Pattern (0);               //Zero Padding 0                    s.S.15
     OSEKTL_Clr0Padding ();               //Switches Zero Padding off          s.S.15

     // StartSN
     OSEKTL_SetStartSN(1);               //StartNumber of CF = 1               s.S.14

     // TimeOut
     OSEKTL_SetTimeoutFC( OutTime );     //FlowControl - Timeout setzen  s.S.16
     OSEKTL_SetTimeoutCF( OutTime );     //ConsecutiveFrame - Timeout     s.S.16
     OSEKTL_SetTimeoutAr( OutTime );
     OSEKTL_SetTimeoutCr( OutTime );
     OSEKTL_SetTimeoutAs( OutTime );
     OSEKTL_SetTimeoutBs( OutTime );

     OSEKTL_SetDLC8();                    //Sendelänge auf 8 Byte fixieren
}

LVDS_EvalRead_Framecounter()
{
    if(( rsBuf[0] == 0x62 ) && 
       ( rsBuf[1] == 0xFD ) &&
       ( rsBuf[2] == 0x0A )    )
     {
        putValue( DIAG_LVDS_Frame_Counter_State, rsBuf[3] );
        DiagAktion = 0;
        putValue( DIAG_Main_ErrorStatus, "Successful" );
        bQueueWaitForResponce = FALSE;
        cancelTimer( tLVDS_ReadTimeOutTimer );
    }     
    else
        if( AntwortAuswertung( 1, rsBuf[0], rsBuf[2]) )
        {
            DiagAktion = 0;
            bQueueWaitForResponce = FALSE;
            cancelTimer( tLVDS_ReadTimeOutTimer );
        }
    DIAG_CTRL_vStartNewService();
}

LVDS_EvalRead_Pin_Sync()
{
    if(( rsBuf[0] == 0x62 ) && 
       ( rsBuf[1] == 0xFD ) &&
       ( rsBuf[2] == 0x09 )    )
    {
        putValue( DIAG_LVDS_Pin_State_Lock, ( rsBuf[3] & 0x01 ) +1 );
        putValue( DIAG_LVDS_Pin_State_Error, ( ( rsBuf[3] & 0x02 ) >> 1 )+1 );
        putValue( DIAG_LVDS_V_Sync_Freq, rsBuf[4] *256 + rsBuf[5] );
        DiagAktion = 0;
        putValue( DIAG_Main_ErrorStatus, "Successful" );
        bQueueWaitForResponce = FALSE;
        cancelTimer( tLVDS_ReadTimeOutTimer );
    }     
    else
        if( AntwortAuswertung( 1, rsBuf[0], rsBuf[2]) )
        {
            DiagAktion = 0;
            bQueueWaitForResponce = FALSE;
            cancelTimer( tLVDS_ReadTimeOutTimer );
        }
    DIAG_CTRL_vStartNewService();
}

LVDS_EvalRead_Testpic_CRC()
{
    if(( rsBuf[0] == 0x62 ) && 
       ( rsBuf[1] == 0xFD ) &&
       ( rsBuf[2] == 0x0C )    )
     {
        putValue( DIAG_LVDS_Testpic_CRC, rsBuf[3] * 256 + rsBuf[4] );
        DiagAktion = 0;
        putValue( DIAG_Main_ErrorStatus, "Successful" );
        bQueueWaitForResponce = FALSE;
        cancelTimer( tLVDS_ReadTimeOutTimer );
    }     
    else
        if( AntwortAuswertung( 1, rsBuf[0], rsBuf[2]) )
        {
            DiagAktion = 0;
            bQueueWaitForResponce = FALSE;
            cancelTimer( tLVDS_ReadTimeOutTimer );
        }
    DIAG_CTRL_vStartNewService();
}

LVDS_Eval_Read_Register()
{
    if(( rsBuf[0] == 0x71 ) && 
       ( rsBuf[1] == 0x01 ) &&
       ( rsBuf[2] == 0xF0 ) &&
       ( rsBuf[3] == 0x0C )    )
    {
        putValue( DIAG_LVDS_Reg_Data_Read, rsBuf[4] );
        DiagAktion = 0;
        putValue( DIAG_Main_ErrorStatus, "Successful" );
        bQueueWaitForResponce = FALSE;
        cancelTimer( tLVDS_ReadTimeOutTimer );
    }     
    else
        if( AntwortAuswertung( 1, rsBuf[0], rsBuf[2]) )
        {
            DiagAktion = 0;
            bQueueWaitForResponce = FALSE;
            cancelTimer( tLVDS_ReadTimeOutTimer );
        }
}

LVDS_Eval_Switch_Disp()
{
    if(( rsBuf[0] == 0x71 ) && 
       ( rsBuf[1] == 0x01 ) &&
       ( rsBuf[2] == 0xF0 ) &&
       ( rsBuf[3] == 0x0E )    )
    {
        DiagAktion = 0;
        putValue( DIAG_Main_ErrorStatus, "Successful" );
        bQueueWaitForResponce = FALSE;
        cancelTimer( tLVDS_WriteTimeOutTimer );
    }     
    else
        if( AntwortAuswertung( 1, rsBuf[0], rsBuf[2]) )
        {
            DiagAktion = 0;
            bQueueWaitForResponce = FALSE;
            cancelTimer( tLVDS_WriteTimeOutTimer );
        }
}

LVDS_Eval_Switch_Func()
{
    if(( rsBuf[0] == 0x71 ) && 
       ( rsBuf[1] == 0x01 ) &&
       ( rsBuf[2] == 0xF0 ) &&
       ( rsBuf[3] == 0x0D )    )
    {
        DiagAktion = 0;
        putValue( DIAG_Main_ErrorStatus, "Successful" );
        bQueueWaitForResponce = FALSE;
        cancelTimer( tLVDS_WriteTimeOutTimer );
    }     
    else
        if( AntwortAuswertung( 1, rsBuf[0], rsBuf[2]) )
        {
            DiagAktion = 0;
            bQueueWaitForResponce = FALSE;
            cancelTimer( tLVDS_WriteTimeOutTimer );
        }
}

LVDS_Eval_Write_Register()
{
    if(( rsBuf[0] == 0x6E ) && 
       ( rsBuf[1] == 0xFD ) &&
       ( rsBuf[2] == 0x0B )    )
    {
        DiagAktion = 0;
        putValue( DIAG_Main_ErrorStatus, "Successful" );
        bQueueWaitForResponce = FALSE;
        cancelTimer( tLVDS_WriteTimeOutTimer );
    }     
    else
        if( AntwortAuswertung( 1, rsBuf[0], rsBuf[2]) )
        {
            DiagAktion = 0;
            bQueueWaitForResponce = FALSE;
            cancelTimer( tLVDS_WriteTimeOutTimer );
        }
}

LVDS_Read_Framecounter_Trigger()
{
    DiagAktion = 0;
    if( FillCommand( ServicePhys ) ) return;
    rqBuf[0] = 0x22;
    rqBuf[1] = 0xFD;
    rqBuf[2] = 0x0A;
    DIAG_SendRequest( SessionPhys, 3);
    DiagAktion = cService_Routine_LVDS_ReadFramecounter;
    putValue( DIAG_Main_ErrorStatus, "Warte auf Antwort..." );
    setTimer( tLVDS_ReadTimeOutTimer, TimeOut );
    bQueueWaitForResponce = TRUE;
}

LVDS_Read_Pin_Sync_Trigger()
{
    DiagAktion = 0;
    if( FillCommand( ServicePhys ) ) return;
    rqBuf[0] = 0x22;
    rqBuf[1] = 0xFD;
    rqBuf[2] = 0x09;
    DIAG_SendRequest( SessionPhys, 3);
    DiagAktion = cService_Routine_LVDS_ReadPin_Sync;
    putValue( DIAG_Main_ErrorStatus, "Warte auf Antwort..." );
    setTimer( tLVDS_ReadTimeOutTimer, TimeOut );
    bQueueWaitForResponce = TRUE;
}

LVDS_Read_Register_Trigger()
{
    DiagAktion = 0;
    if( FillCommand( ServicePhys ) ) return;
    rqBuf[0] = 0x31;
    rqBuf[1] = 0x01;
    rqBuf[2] = 0xF0;
    rqBuf[3] = 0x0C;
    rqBuf[4] = getValue( DIAG_LVDS_Reg_Adress_Read );
    DIAG_SendRequest( SessionPhys, 5 );
    DiagAktion = cService_Routine_LVDS_ReadRegister;
    putValue( DIAG_Main_ErrorStatus, "Warte auf Antwort..." );
    setTimer( tLVDS_ReadTimeOutTimer, TimeOut );
    bQueueWaitForResponce = TRUE;
}

LVDS_Read_Testpic_CRC_Trigger()
{
    DiagAktion = 0;
    if( FillCommand( ServicePhys ) ) return;
    rqBuf[0] = 0x22;
    rqBuf[1] = 0xFD;
    rqBuf[2] = 0x0C;
    DIAG_SendRequest( SessionPhys, 3);
     DiagAktion = cService_Routine_LVDS_ReadTestpic_CRC;
     putValue( DIAG_Main_ErrorStatus, "Warte auf Antwort..." );
     setTimer( tLVDS_ReadTimeOutTimer, TimeOut );
    bQueueWaitForResponce = TRUE;
}

LVDS_Write_LVDS_Switch_Disp_Trigger()
{
    byte temp;
    
    DiagAktion = 0;
    if( FillCommand( ServicePhys ) ) return;
    rqBuf[0] = 0x31;
    rqBuf[1] = 0x01;
    rqBuf[2] = 0xF0;
    rqBuf[3] = 0x0E;
    temp = getValue( DIAG_LVDS_Switch_Display_State );
    rqBuf[4] = temp & 0x01;
    DIAG_SendRequest( SessionPhys, 5);
    DiagAktion = cService_Routine_LVDS_Switch_Disp;
    putValue( DIAG_Main_ErrorStatus, "Warte auf Antwort..." );
    setTimer( tLVDS_WriteTimeOutTimer, TimeOut );
    bQueueWaitForResponce = TRUE;
}

LVDS_Write_LVDS_Switch_Func_Trigger()
{
    byte temp;

    DiagAktion = 0;
    if( FillCommand( ServicePhys ) ) return;
    rqBuf[0] = 0x31;
    rqBuf[1] = 0x01;
    rqBuf[2] = 0xF0;
    rqBuf[3] = 0x0D;
    temp = getValue( DIAG_LVDS_Switch_Function_State );
    rqBuf[4] = temp & 0x01;
    DIAG_SendRequest( SessionPhys, 5);
    DiagAktion = cService_Routine_LVDS_Switch_Func;
    putValue( DIAG_Main_ErrorStatus, "Warte auf Antwort..." );
    setTimer( tLVDS_WriteTimeOutTimer, TimeOut );
    bQueueWaitForResponce = TRUE;
}

LVDS_Write_Register_Trigger()
{
    DiagAktion = 0;
    if( FillCommand( ServicePhys ) ) return;
    rqBuf[0] = 0x2E;
    rqBuf[1] = 0xFD;
    rqBuf[2] = 0x0B;
    rqBuf[3] = getValue( DIAG_LVDS_Reg_Adress_Write );
    rqBuf[4] = getValue( DIAG_LVDS_Reg_Data_Write );
    DIAG_SendRequest( SessionPhys, 5);
    DiagAktion = cService_Routine_LVDS_WriteRegister;
    putValue( DIAG_Main_ErrorStatus, "Warte auf Antwort..." );
    setTimer( tLVDS_WriteTimeOutTimer, TimeOut );
    bQueueWaitForResponce = TRUE;
}

MRW_File_Read_Eval( byte Laenge )
{
    if( rsBuf[0] == 0x63 )
    {
        MRW_vReadFileRcvdReadMemAddr( Laenge );
    }     
    else
        if( AntwortAuswertung( 1, rsBuf[0], rsBuf[2]) )
        {
            bQueueWaitForResponce = FALSE;
            DiagAktion = 0;
        }
}

MRW_File_Write_Eval()
{
    if( ( rsBuf[0] == 0x7F ) && ( rsBuf[2] == 0x78 ) ) 
    {   // write("resp. pending -> warten!" );
    }
    else                         
    {   // write("no resp. pending" );
        if( rsBuf[0] == 0x7D ) // d 8 07 7D 14 02 00 00 00 10
        {   // write("no resp. pending-> auswerten" );
            setTimer( tMRW_InterBlockDelay, cMRW_InterBlockDelay );
        }
        else
        {   // write("negative resp -> auswerten" );
            if( AntwortAuswertung( 1, rsBuf[0], rsBuf[2]) )
            {
                DiagAktion = 0;
                bQueueWaitForResponce = FALSE;
            }
        }
    }     
}

MRW_Read_Eval( byte Laenge )
{
    if( rsBuf[0] == 0x63 )
    {
        MRW_vCopyRecDataToShadow( Laenge );
        if( DIAG__iMRWMissingBytes > 0 )
        {
            MRW_vSendNextReadMemAddr();
        }
        else
        {
            DiagAktion = 0;
            bQueueWaitForResponce = FALSE;
            cancelTimer( tMRW_TimeoutTimer );
            putValue( DIAG_Main_ErrorStatus, "" );
            putValue( DIAG_MRW_Status_Backplane, 2 );
            putValue( DIAG_MRW_StatusBar, "Successful" );
            MRW_vCopyShadowToEdit();
        }                       
    }     
    else
        if( AntwortAuswertung( 1, rsBuf[0], rsBuf[2]) )
        {
            putValue( DIAG_MRW_Status_Backplane, 3 );
            DiagAktion = 0;
            bQueueWaitForResponce = FALSE;
        }
}

MRW_Write_Eval()
{
    if( ( rsBuf[0] == 0x7F ) && ( rsBuf[2] == 0x78 ) ) 
    {   //resp. pending -> warten!
    }
    else                         
    {   // no resp. pending
        if( rsBuf[0] == 0x7D ) // d 8 07 7D 14 02 00 00 00 10
        {
            if( DIAG__iMRWMissingBytes > 0 )
            {   // no resp. pending-> auswerten
                MRW_vSendNextWriteMemAddr(); 
            }
            else
            {
                DiagAktion = 0;
                bQueueWaitForResponce = FALSE;
                cancelTimer( tMRW_TimeoutTimer );
                putValue( DIAG_Main_ErrorStatus, "" );
                putValue( DIAG_MRW_Status_Backplane, 2 );
                putValue( DIAG_MRW_StatusBar, "Successful" );
                DIAG_CTRL_vStartNewService();
            }                       
        }
        else
        {   // negative resp -> auswerten
            if( AntwortAuswertung( 1, rsBuf[0], rsBuf[2]) )
            {   // negative resp -> service beenden
                putValue( DIAG_MRW_Status_Backplane, 3 );
                DiagAktion = 0;
                bQueueWaitForResponce = FALSE;
                DIAG_CTRL_vStartNewService();
            }
        }
    }     
}

byte MRW_bReadFileCalcNextAddr(void)
{
    byte bSuccess;

    if(( DIAG__dwReadFileActAddress >= DIAG__dwReadFileStartAddress ) && ( DIAG__dwReadFileActAddress < DIAG__dwReadFileEndAddress ) )
    {   // EEPROM
        if( ( DIAG__dwReadFileActAddress + NB_READ_WRITE ) < DIAG__dwReadFileEndAddress )
        {
            DIAG__dwReadFileActAddress += NB_READ_WRITE;
            if( ( DIAG__dwReadFileActAddress + NB_READ_WRITE ) < DIAG__dwReadFileEndAddress )
            {
                DIAG__bReadFileActDataLen = NB_READ_WRITE;
                bSuccess = 1;
            }
            else
            {
                DIAG__bReadFileActDataLen = ( byte )( DIAG__dwReadFileEndAddress - DIAG__dwReadFileActAddress );
                bSuccess = 1;
            }
        }
        else
        {   // Last Address Read
            DIAG__bReadFileActDataLen = 0x00;
              bSuccess = 2;
        }
    }
    else
    {   // Invalid Range
        DIAG__bReadFileActDataLen = 0x00;
        bSuccess = 0;
    }
    return bSuccess;
}

byte MRW_bWriteFileTransmitFileLine (long Handle )
{
    /*     RETURN VALUES : 0x00:      End of File
                           0x01:      Transmit of data successful
                           0x10...0x19:     Error codes */
    long lReadedChars;
    byte bDataLength = 0;
    byte bDataAddressHigh;
    byte bDataAddressLow;
    byte bMode;
    char cStartChar[1];
    char cCharBuffer[3];
    char acHelp[255];
    char acHelpi[3];
    int i,j,iFirstToRead;
    byte bLSB;
    byte bMSB;
    byte bCSUM;

    DiagAktion = 0;
    if( FillCommand( ServicePhys ) ) return(0);
    rqBuf[0] = 0x3D;
    rqBuf[1] = 0x14;
    do
    {     // Search for ":" as sign for start of line 
        lReadedChars=0;
        lReadedChars=dllReadNBytes(1, cStartChar);
        if(lReadedChars != 1) { dllFClose(); return 0x10;}
    }
    while(cStartChar[0]!=':');

    // Determine number of characters in line
    lReadedChars=dllReadNBytes(2, cCharBuffer);
    if(lReadedChars != 2 ) { dllFClose(); return 0x12;}
     
    bDataLength = DIAG_bAsciiToHex( cCharBuffer );
     
    // Determine Address
    lReadedChars = dllReadNBytes(2, cCharBuffer);
    if(lReadedChars != 2 ) { dllFClose(); return 0x13;}
    bDataAddressHigh = DIAG_bAsciiToHex( cCharBuffer );
    lReadedChars=dllReadNBytes(2, cCharBuffer);
    if(lReadedChars != 2 ) { dllFClose(); return 0x14;}
    bDataAddressLow = DIAG_bAsciiToHex( cCharBuffer );

    rqBuf[2] = ( DIAG__cdwMRWStartAdr_AC_EEP_FEE >> 24 ) & 0xFF;
    rqBuf[3] = ( DIAG__cdwMRWStartAdr_AC_EEP_FEE >> 16 ) & 0xFF;
    rqBuf[4] = bDataAddressHigh;
    rqBuf[5] = bDataAddressLow;
    rqBuf[6] = ( byte )( bDataLength & 0xFF );

    j = 7;

    //Get Mode
    lReadedChars=dllReadNBytes(2, cCharBuffer);
    if(lReadedChars != 2 ) { dllFClose(); return 0x15;}
    bMode = DIAG_bAsciiToHex( cCharBuffer );

    if( bDataLength>0)
    {// Read data to array (Not Last Line of File
        iFirstToRead = j;
        for( i = iFirstToRead; i < ( iFirstToRead + bDataLength); i++)
        {
            lReadedChars=dllReadNBytes(2, cCharBuffer);
            if(lReadedChars != 2 ) { dllFClose(); return 0x16;}
            rqBuf[i] = DIAG_bAsciiToHex(cCharBuffer);/* Data Bytes          */
             j++;
        }
        //Send Frame
        snprintf( acHelp,elcount( acHelp), "" );
        for( i=0;i<j;i++)
        {
            snprintf( acHelpi,elcount( acHelpi), "%02X",rqBuf[i]);
            strncat( acHelp,acHelpi,elcount( acHelp) );
        }
        i = j;
        DIAG_SendRequest( SessionPhys, j );
        bQueueWaitForResponce = TRUE;
        DiagAktion = cService_Routine_WriteFile2EEP;
        return 0x01;
    }
    else
    {
        if(( bDataAddressLow == 0x00) && ( bDataAddressHigh == 0x00) && ( bMode == 0x01) )
        {
            lReadedChars=dllReadNBytes(2, cCharBuffer);
            if(lReadedChars != 2 ) { dllFClose(); return 0x17; }
            if( DIAG_bAsciiToHex( cCharBuffer ) == 0xFF )
            {
                // END OF FILE !!
                return 0x00;
            }
            else
            {
                // invalid end of file
                return 0x18;
            }
        }
        else
        {
            //invalid format of line
            return 0x19;
        }
    }
}

byte MRW_bWriteFileTransmitFileLineMHX (long Handle )
{
    /*     RETURN VALUES : 0x00:      End of File
                           0x01:      Transmit of data successful
                           0x10...0x19:     Error codes */
    long lReadedChars;
    dword dwAddress;
    byte bLineType;
    byte bDataLength = 0;
    byte bDataAddressUHigh = 0;
    byte bDataAddressHigh = 0;
    byte bDataAddressMid = 0;
    byte bDataAddressLow = 0;
    byte bMode;
    char cStartChar[1];
    char cCharBuffer[3];
    char acHelp[255];
    char acHelpi[3];
    int i,j,iFirstToRead;
    byte bLSB;
    byte bMSB;
    byte bCSUM;

    DiagAktion = 0;
    if( FillCommand( ServicePhys ) )         return(0);
    rqBuf[0] = 0x3D;
    rqBuf[1] = 0x14;
    do
    {   // Search for ":" as sign for start of line 
        lReadedChars = 0;
        lReadedChars = dllReadNBytes( 1, cStartChar );
        if( lReadedChars != 1)        {            dllFClose();             return 0x10;        }
    }
    while( cStartChar[0] != 'S' );
    // Determine type  of frame in line
    lReadedChars=dllReadNBytes( 1, cCharBuffer );
    if(lReadedChars != 1)     {         dllFClose();         return 0x12;     }
    bLineType = DIAG_bAsciiToHex(cCharBuffer);
    // Determine number of characters in line
    lReadedChars=dllReadNBytes( 2, cCharBuffer );
    if(lReadedChars != 2 )     {        dllFClose();        return 0x12;    }
    bDataLength = DIAG_bAsciiToHex( cCharBuffer );
    // Determine Address
    if( bLineType == 3 )
    {
        lReadedChars = dllReadNBytes( 2, cCharBuffer );
        if(lReadedChars != 2 ) {            dllFClose();            return 0x13;	}
        bDataAddressUHigh = DIAG_bAsciiToHex( cCharBuffer );
        bDataLength -= 1;
    }
    if( ( bLineType == 2 ) || ( bLineType == 3 ) )
    {
        lReadedChars = dllReadNBytes(2, cCharBuffer);
        if(lReadedChars != 2 ) { dllFClose(); return 0x13;}
        bDataAddressHigh = DIAG_bAsciiToHex(cCharBuffer);
        bDataLength -= 1;
    }
    lReadedChars=dllReadNBytes(2, cCharBuffer);
    if(lReadedChars != 2 ) { dllFClose(); return 0x14;}
    bDataAddressMid  = DIAG_bAsciiToHex(cCharBuffer);
    lReadedChars=dllReadNBytes(2, cCharBuffer);
    if(lReadedChars != 2 ) { dllFClose(); return 0x14;}
    bDataAddressLow  = DIAG_bAsciiToHex(cCharBuffer);
    bDataLength -= 2;
    dwAddress = ( bDataAddressUHigh << 24 ) + ( bDataAddressHigh << 16 ) + ( bDataAddressMid << 8 ) + ( bDataAddressLow );
    // Adress-addition DDR3_Start- + Soundoffset + Fileoffset
    dwAddress = DIAG__cdwMRWStartAdr_GC_DDR3 + dwVariSoundOffset + dwAddress;
    rqBuf[2] = ( byte )( dwAddress >> 24 ) & 0xFF;
    rqBuf[3] = ( byte )( dwAddress >> 16 ) & 0xFF;
    rqBuf[4] = ( byte )( dwAddress >>  8 ) & 0xFF;
    rqBuf[5] = ( byte )( dwAddress       ) & 0xFF;
    rqBuf[6] = ( byte )( bDataLength & 0xFF );
    j = 7;
    if( ( bLineType >= 1 ) && ( bLineType <= 3 ) )
    {   // Read data to array (Not Last Line of File
        iFirstToRead = j;
        for( i = iFirstToRead; i < ( iFirstToRead + bDataLength); i++)
        {
            lReadedChars=dllReadNBytes(2, cCharBuffer);
            if(lReadedChars != 2 ) { dllFClose(); return 0x16;}
            rqBuf[i] = DIAG_bAsciiToHex(cCharBuffer);/* Data Bytes          */
            j++;
        }
        //Send Frame
        snprintf( acHelp,elcount( acHelp), "" );
        for( i=0;i<j;i++)
        {
            snprintf( acHelpi,elcount( acHelpi), "%02X",rqBuf[i]);
            strncat( acHelp,acHelpi,elcount( acHelp) );
        }
        i = j;
        DIAG_SendRequest( SessionPhys, j );
        DiagAktion = cService_Routine_WriteFile2EEP;
        return 0x01;
    }
    else
    {
        if( ( bLineType >= 7 ) && ( bLineType <= 9 ) )
        {   // END OF FILE !!
            return 0x00;
        }
        else
        {   //invalid format of line
           return 0x19;
        }
    }
}

long DIAG_lOpenFileForRead( char FileName[] )
{
     long Handle;

     Handle = dllFOpen( FileName );
     if( Handle <= 0 )
          return 0;
     else
          return Handle;
}

MRW_vCalcAbsoluteAddress()
{
    dword dwTempAdress;
    byte bLocation;

    bLocation = getValue( DIAG_MRW_MemLocation );  //EEP_eSelectEepromMemory);
    dwTempAdress = getValue( DIAG_MRW_Addr );
    switch( bLocation )
    {
        case DIAG__cdwMRWStartAdr_AC_IntFlashID:    dwTempAdress = dwTempAdress + DIAG__cdwMRWStartAdr_AC_IntFlash;    break;
        case DIAG__cdwMRWStartAdr_GC_IntFlashID:    dwTempAdress = dwTempAdress + DIAG__cdwMRWStartAdr_GC_IntFlash;    break;
        case DIAG__cdwMRWStartAdr_AC_EEP_FEEID:     dwTempAdress = dwTempAdress + DIAG__cdwMRWStartAdr_AC_EEP_FEE;     break;
        case DIAG__cdwMRWStartAdr_GC_DDR3ID:        dwTempAdress = dwTempAdress + DIAG__cdwMRWStartAdr_GC_DDR3;        break;
        case DIAG__cdwMRWStartAdr_GC_NANDID:        dwTempAdress = dwTempAdress + DIAG__cdwMRWStartAdr_GC_NAND;        break;
        case DIAG__cdwMRWStartAdr_GC_PBUSID:        dwTempAdress = dwTempAdress + DIAG__cdwMRWStartAdr_GC_PBUS;        break;
        case DIAG__cdwMRWStartAdr_GC_IntRAMID:      dwTempAdress = dwTempAdress + DIAG__cdwMRWStartAdr_GC_IntRAM;      break;
        case DIAG__cdwMRWStartAdr_AC_IntRAMID:      dwTempAdress = dwTempAdress + DIAG__cdwMRWStartAdr_AC_IntRAM;      break; 
        case DIAG__cdwMRWStartAdr_AC_PBUSID:        dwTempAdress = dwTempAdress + DIAG__cdwMRWStartAdr_AC_PBUS;        break;
        case DIAG__cdwMRWStartAdr_AC_BURAMID:       dwTempAdress = dwTempAdress + DIAG__cdwMRWStartAdr_AC_BURAM;       break;
        case DIAG__cdwMRWStartAdr_AC_PBUS2ID:       dwTempAdress = dwTempAdress + DIAG__cdwMRWStartAdr_AC_PBUS2;       break;
        case DIAG__cdwMRWStartAdr_AC_IntRegID:      dwTempAdress = dwTempAdress + DIAG__cdwMRWStartAdr_AC_IntReg;      break;
        default:                                    dwTempAdress = dwTempAdress + 0;                                   break;
    }
    DIAG__abMRWAddressShadow[DIAG__bMRWActDataSet][3] = ( byte )( ( dwTempAdress & 0xFF000000 ) >> 24 );
    DIAG__abMRWAddressShadow[DIAG__bMRWActDataSet][2] = ( byte )( ( dwTempAdress & 0x00FF0000 ) >> 16 );
    DIAG__abMRWAddressShadow[DIAG__bMRWActDataSet][1] = ( byte )( ( dwTempAdress & 0x0000FF00 ) >> 8 );
    DIAG__abMRWAddressShadow[DIAG__bMRWActDataSet][0] = ( byte )( ( dwTempAdress & 0x000000FF ) );
}

void MRW_vCalcAddrFields()
{
    dword dwAddress;
    byte bAddress_L;
    byte bAddress_M;
    byte bAddress_H;
    byte bAddress_UH;
    word wLength;

    wLength = getValue( DIAG_MRW_Length );
    bAddress_L  = DIAG__abMRWAddressShadow[ DIAG__bMRWActDataSet ][0];
    bAddress_M  = DIAG__abMRWAddressShadow[ DIAG__bMRWActDataSet ][1];
    bAddress_H  = DIAG__abMRWAddressShadow[ DIAG__bMRWActDataSet ][2];
    bAddress_UH = DIAG__abMRWAddressShadow[ DIAG__bMRWActDataSet ][3];
//  write("Address: %2X %2x %2x %2x Length: %d",bAddress_UH,bAddress_H,bAddress_M,bAddress_L,wLength);
    dwAddress =   (dword)bAddress_L;
    dwAddress |= ((dword)bAddress_M <<  8);
    dwAddress |= ((dword)bAddress_H << 16);
    dwAddress |= ((dword)bAddress_UH << 24);

    if( wLength /*DIAG__iMRWDataLengthShadow[DIAG__bMRWActDataSet]*/ > 0)
    {
        putValue( DIAG_MRW_AddrUH_Line01,DIAG__abMRWAddressShadow[ DIAG__bMRWActDataSet ][3]);
        putValue( DIAG_MRW_AddrH_Line01, DIAG__abMRWAddressShadow[ DIAG__bMRWActDataSet ][2]);
        putValue( DIAG_MRW_AddrM_Line01, DIAG__abMRWAddressShadow[ DIAG__bMRWActDataSet ][1]);
        putValue( DIAG_MRW_AddrL_Line01, DIAG__abMRWAddressShadow[ DIAG__bMRWActDataSet ][0]);
    }
    else
    {
        putValue( DIAG_MRW_AddrUH_Line01,0x00 );
        putValue( DIAG_MRW_AddrH_Line01, 0x00 );
        putValue( DIAG_MRW_AddrM_Line01, 0x00 );
        putValue( DIAG_MRW_AddrL_Line01, 0x00 );
    }

    if( wLength /*DIAG__iMRWDataLengthShadow[DIAG__bMRWActDataSet]*/ > 16)
    {
        dwAddress += 16;
        bAddress_L = ( byte ) (dwAddress & 0x000000FF );
        bAddress_M = ( byte )((dwAddress & 0x0000FF00) >>  8);
        bAddress_H = ( byte )((dwAddress & 0x00FF0000) >> 16);
        bAddress_UH = ( byte )((dwAddress & 0xFF000000) >> 24);
        putValue( DIAG_MRW_AddrUH_Line02,bAddress_UH );
        putValue( DIAG_MRW_AddrH_Line02, bAddress_H  );
        putValue( DIAG_MRW_AddrM_Line02, bAddress_M  );
        putValue( DIAG_MRW_AddrL_Line02, bAddress_L  );
    }
    else
    {
        putValue( DIAG_MRW_AddrUH_Line02,0x00 );
        putValue( DIAG_MRW_AddrH_Line02, 0x00 );
        putValue( DIAG_MRW_AddrM_Line02, 0x00 );
        putValue( DIAG_MRW_AddrL_Line02, 0x00 );
    }

    if( wLength /*DIAG__iMRWDataLengthShadow[DIAG__bMRWActDataSet]*/ > 32 )
    {
        dwAddress += 16;
        bAddress_L = ( byte ) (dwAddress & 0x000000FF );
        bAddress_M = ( byte )((dwAddress & 0x0000FF00) >>  8);
        bAddress_H = ( byte )((dwAddress & 0x00FF0000) >> 16);
        bAddress_UH = ( byte )((dwAddress & 0xFF000000) >> 24);
        putValue( DIAG_MRW_AddrUH_Line03,bAddress_UH );
        putValue( DIAG_MRW_AddrH_Line03, bAddress_H  );
        putValue( DIAG_MRW_AddrM_Line03, bAddress_M  );
        putValue( DIAG_MRW_AddrL_Line03, bAddress_L  );
    }
    else
    {
        putValue( DIAG_MRW_AddrUH_Line03,0x00 );
        putValue( DIAG_MRW_AddrH_Line03, 0x00 );
        putValue( DIAG_MRW_AddrM_Line03, 0x00 );
        putValue( DIAG_MRW_AddrL_Line03, 0x00 );
    }

    if( wLength /*DIAG__iMRWDataLengthShadow[DIAG__bMRWActDataSet]*/ > 48)
    {
        dwAddress += 16;
        bAddress_L = ( byte ) (dwAddress & 0x000000FF );
        bAddress_M = ( byte )((dwAddress & 0x0000FF00) >>  8);
        bAddress_H = ( byte )((dwAddress & 0x00FF0000) >> 16);
        bAddress_UH = ( byte )((dwAddress & 0xFF000000) >> 24);
        putValue( DIAG_MRW_AddrUH_Line04,bAddress_UH );
        putValue( DIAG_MRW_AddrH_Line04, bAddress_H  );
        putValue( DIAG_MRW_AddrM_Line04, bAddress_M  );
        putValue( DIAG_MRW_AddrL_Line04, bAddress_L  );
    }
    else
    {
        putValue( DIAG_MRW_AddrUH_Line04,0x00 );
        putValue( DIAG_MRW_AddrH_Line04, 0x00 );
        putValue( DIAG_MRW_AddrM_Line04, 0x00 );
        putValue( DIAG_MRW_AddrL_Line04, 0x00 );
    }

    if( wLength /*DIAG__iMRWDataLengthShadow[DIAG__bMRWActDataSet]*/ > 64)
    {
        dwAddress += 16;
        bAddress_L = ( byte ) (dwAddress & 0x000000FF );
        bAddress_M = ( byte )((dwAddress & 0x0000FF00) >>  8);
        bAddress_H = ( byte )((dwAddress & 0x00FF0000) >> 16);
        bAddress_UH = ( byte )((dwAddress & 0xFF000000) >> 24);
        putValue( DIAG_MRW_AddrUH_Line05,bAddress_UH );
        putValue( DIAG_MRW_AddrH_Line05, bAddress_H  );
        putValue( DIAG_MRW_AddrM_Line05, bAddress_M  );
        putValue( DIAG_MRW_AddrL_Line05, bAddress_L  );
    }
    else
    {
        putValue( DIAG_MRW_AddrUH_Line05, 0x00 );
        putValue( DIAG_MRW_AddrH_Line05, 0x00 );
        putValue( DIAG_MRW_AddrM_Line05, 0x00 );
        putValue( DIAG_MRW_AddrL_Line05, 0x00 );
    }

    if( wLength /*DIAG__iMRWDataLengthShadow[DIAG__bMRWActDataSet]*/ > 80)
    {
        dwAddress += 16;
        bAddress_L = ( byte ) (dwAddress & 0x000000FF );
        bAddress_M = ( byte )((dwAddress & 0x0000FF00) >>  8);
        bAddress_H = ( byte )((dwAddress & 0x00FF0000) >> 16);
        bAddress_UH = ( byte )((dwAddress & 0xFF000000) >> 24);
        putValue( DIAG_MRW_AddrUH_Line06,bAddress_UH );
        putValue( DIAG_MRW_AddrH_Line06, bAddress_H  );
        putValue( DIAG_MRW_AddrM_Line06, bAddress_M  );
        putValue( DIAG_MRW_AddrL_Line06, bAddress_L  );
    }
    else
    {
        putValue( DIAG_MRW_AddrUH_Line06, 0x00 );
        putValue( DIAG_MRW_AddrH_Line06, 0x00 );
        putValue( DIAG_MRW_AddrM_Line06, 0x00 );
        putValue( DIAG_MRW_AddrL_Line06, 0x00 );
    }

    if( wLength /*DIAG__iMRWDataLengthShadow[DIAG__bMRWActDataSet]*/ > 96)
    {
        dwAddress += 16;
        bAddress_L = ( byte ) (dwAddress & 0x000000FF );
        bAddress_M = ( byte )((dwAddress & 0x0000FF00) >>  8);
        bAddress_H = ( byte )((dwAddress & 0x00FF0000) >> 16);
        bAddress_UH = ( byte )((dwAddress & 0xFF000000) >> 24);
        putValue( DIAG_MRW_AddrUH_Line07,bAddress_UH );
        putValue( DIAG_MRW_AddrH_Line07, bAddress_H  );
        putValue( DIAG_MRW_AddrM_Line07, bAddress_M  );
        putValue( DIAG_MRW_AddrL_Line07, bAddress_L  );
    }
    else
    {
        putValue( DIAG_MRW_AddrUH_Line07, 0x00 );
        putValue( DIAG_MRW_AddrH_Line07, 0x00 );
        putValue( DIAG_MRW_AddrM_Line07, 0x00 );
        putValue( DIAG_MRW_AddrL_Line07, 0x00 );
    }

    if( wLength /*DIAG__iMRWDataLengthShadow[DIAG__bMRWActDataSet]*/ > 112 )
    {
        dwAddress += 16;
        bAddress_L = ( byte ) (dwAddress & 0x000000FF );
        bAddress_M = ( byte )((dwAddress & 0x0000FF00) >>  8);
        bAddress_H = ( byte )((dwAddress & 0x00FF0000) >> 16);
        bAddress_UH = ( byte )((dwAddress & 0xFF000000) >> 24);
        putValue( DIAG_MRW_AddrUH_Line08,bAddress_UH );
        putValue( DIAG_MRW_AddrH_Line08, bAddress_H  );
        putValue( DIAG_MRW_AddrM_Line08, bAddress_M  );
        putValue( DIAG_MRW_AddrL_Line08, bAddress_L  );
    }
    else
    {
        putValue( DIAG_MRW_AddrUH_Line08,0x00 );
        putValue( DIAG_MRW_AddrH_Line08, 0x00 );
        putValue( DIAG_MRW_AddrM_Line08, 0x00 );
        putValue( DIAG_MRW_AddrL_Line08, 0x00 );
    }

    if( wLength /*DIAG__iMRWDataLengthShadow[DIAG__bMRWActDataSet]*/ > 128)
    {
        dwAddress += 16;
        bAddress_L = ( byte ) (dwAddress & 0x000000FF );
        bAddress_M = ( byte )((dwAddress & 0x0000FF00) >>  8);
        bAddress_H = ( byte )((dwAddress & 0x00FF0000) >> 16);
        bAddress_UH = ( byte )((dwAddress & 0xFF000000) >> 24);
        putValue( DIAG_MRW_AddrUH_Line09,bAddress_UH );
        putValue( DIAG_MRW_AddrH_Line09, bAddress_H  );
        putValue( DIAG_MRW_AddrM_Line09, bAddress_M  );
        putValue( DIAG_MRW_AddrL_Line09, bAddress_L  );
    }
    else
    {
        putValue( DIAG_MRW_AddrUH_Line09,0x00 );
        putValue( DIAG_MRW_AddrH_Line09, 0x00 );
        putValue( DIAG_MRW_AddrM_Line09, 0x00 );
        putValue( DIAG_MRW_AddrL_Line09, 0x00 );
    }

    if( wLength /*DIAG__iMRWDataLengthShadow[DIAG__bMRWActDataSet]*/ > 144)
    {
        dwAddress += 16;
        bAddress_L = ( byte ) (dwAddress & 0x000000FF );
        bAddress_M = ( byte )((dwAddress & 0x0000FF00) >>  8);
        bAddress_H = ( byte )((dwAddress & 0x00FF0000) >> 16);
        bAddress_UH = ( byte )((dwAddress & 0xFF000000) >> 24);
        putValue( DIAG_MRW_AddrUH_Line10,bAddress_UH );
        putValue( DIAG_MRW_AddrH_Line10, bAddress_H  );
        putValue( DIAG_MRW_AddrM_Line10, bAddress_M  );
        putValue( DIAG_MRW_AddrL_Line10, bAddress_L  );
    }
    else
    {
        putValue( DIAG_MRW_AddrUH_Line10,0x00 );
        putValue( DIAG_MRW_AddrH_Line10, 0x00 );
        putValue( DIAG_MRW_AddrM_Line10, 0x00 );
        putValue( DIAG_MRW_AddrL_Line10, 0x00 );
    }

    if( wLength /*DIAG__iMRWDataLengthShadow[DIAG__bMRWActDataSet]*/ > 160)
    {
        dwAddress += 16;
        bAddress_L = ( byte ) (dwAddress & 0x000000FF );
        bAddress_M = ( byte )((dwAddress & 0x0000FF00) >>  8);
        bAddress_H = ( byte )((dwAddress & 0x00FF0000) >> 16);
        bAddress_UH = ( byte )((dwAddress & 0xFF000000) >> 24);
        putValue( DIAG_MRW_AddrUH_Line11,bAddress_UH );
        putValue( DIAG_MRW_AddrH_Line11, bAddress_H  );
        putValue( DIAG_MRW_AddrM_Line11, bAddress_M  );
        putValue( DIAG_MRW_AddrL_Line11, bAddress_L  );
    }
    else
    {
        putValue( DIAG_MRW_AddrUH_Line11,0x00 );
        putValue( DIAG_MRW_AddrH_Line11, 0x00 );
        putValue( DIAG_MRW_AddrM_Line11, 0x00 );
        putValue( DIAG_MRW_AddrL_Line11, 0x00 );
    }

    if( wLength /*DIAG__iMRWDataLengthShadow[DIAG__bMRWActDataSet]*/ > 176)
    {
        dwAddress += 16;
        bAddress_L = ( byte ) (dwAddress & 0x000000FF );
        bAddress_M = ( byte )((dwAddress & 0x0000FF00) >>  8);
        bAddress_H = ( byte )((dwAddress & 0x00FF0000) >> 16);
        bAddress_UH = ( byte )((dwAddress & 0xFF000000) >> 24);
        putValue( DIAG_MRW_AddrUH_Line12,bAddress_UH );
        putValue( DIAG_MRW_AddrH_Line12, bAddress_H  );
        putValue( DIAG_MRW_AddrM_Line12, bAddress_M  );
        putValue( DIAG_MRW_AddrL_Line12, bAddress_L  );
    }
    else
    {
        putValue( DIAG_MRW_AddrUH_Line12,0x00 );
        putValue( DIAG_MRW_AddrH_Line12, 0x00 );
        putValue( DIAG_MRW_AddrM_Line12, 0x00 );
        putValue( DIAG_MRW_AddrL_Line12, 0x00 );
    }

    if( wLength /*DIAG__iMRWDataLengthShadow[DIAG__bMRWActDataSet]*/ > 192 )
    {
        dwAddress += 16;
        bAddress_L = ( byte ) (dwAddress & 0x000000FF );
        bAddress_M = ( byte )((dwAddress & 0x0000FF00) >>  8);
        bAddress_H = ( byte )((dwAddress & 0x00FF0000) >> 16);
        bAddress_UH = ( byte )((dwAddress & 0xFF000000) >> 24);
        putValue( DIAG_MRW_AddrUH_Line13,bAddress_UH );
        putValue( DIAG_MRW_AddrH_Line13, bAddress_H  );
        putValue( DIAG_MRW_AddrM_Line13, bAddress_M  );
        putValue( DIAG_MRW_AddrL_Line13, bAddress_L  );
    }
    else
    {
        putValue( DIAG_MRW_AddrUH_Line13,0x00 );
        putValue( DIAG_MRW_AddrH_Line13, 0x00 );
        putValue( DIAG_MRW_AddrM_Line13, 0x00 );
        putValue( DIAG_MRW_AddrL_Line13, 0x00 );
    }

    if( wLength /*DIAG__iMRWDataLengthShadow[DIAG__bMRWActDataSet]*/ > 208)
    {
        dwAddress += 16;
        bAddress_L = ( byte ) (dwAddress & 0x000000FF );
        bAddress_M = ( byte )((dwAddress & 0x0000FF00) >>  8);
        bAddress_H = ( byte )((dwAddress & 0x00FF0000) >> 16);
        bAddress_UH = ( byte )((dwAddress & 0xFF000000) >> 24);
        putValue( DIAG_MRW_AddrUH_Line14,bAddress_UH );
        putValue( DIAG_MRW_AddrH_Line14, bAddress_H  );
        putValue( DIAG_MRW_AddrM_Line14, bAddress_M  );
        putValue( DIAG_MRW_AddrL_Line14, bAddress_L  );
    }
    else
    {
        putValue( DIAG_MRW_AddrUH_Line14,0x00 );
        putValue( DIAG_MRW_AddrH_Line14, 0x00 );
        putValue( DIAG_MRW_AddrM_Line14, 0x00 );
        putValue( DIAG_MRW_AddrL_Line14, 0x00 );
    }

    if( wLength /*DIAG__iMRWDataLengthShadow[DIAG__bMRWActDataSet]*/ > 224)
    {
        dwAddress += 16;
        bAddress_L = ( byte ) (dwAddress & 0x000000FF );
        bAddress_M = ( byte )((dwAddress & 0x0000FF00) >>  8);
        bAddress_H = ( byte )((dwAddress & 0x00FF0000) >> 16);
        bAddress_UH = ( byte )((dwAddress & 0xFF000000) >> 24);
        putValue( DIAG_MRW_AddrUH_Line15,bAddress_UH );
        putValue( DIAG_MRW_AddrH_Line15, bAddress_H  );
        putValue( DIAG_MRW_AddrM_Line15, bAddress_M  );
        putValue( DIAG_MRW_AddrL_Line15, bAddress_L  );
    }
    else
    {
        putValue( DIAG_MRW_AddrUH_Line15,0x00 );
        putValue( DIAG_MRW_AddrH_Line15, 0x00 );
        putValue( DIAG_MRW_AddrM_Line15, 0x00 );
        putValue( DIAG_MRW_AddrL_Line15, 0x00 );
    }

    if( wLength /*DIAG__iMRWDataLengthShadow[DIAG__bMRWActDataSet]*/ > 240)
    {
        dwAddress += 16;
        bAddress_L = ( byte ) (dwAddress & 0x000000FF );
        bAddress_M = ( byte )((dwAddress & 0x0000FF00) >>  8);
        bAddress_H = ( byte )((dwAddress & 0x00FF0000) >> 16);
        bAddress_UH = ( byte )((dwAddress & 0xFF000000) >> 24);
        putValue( DIAG_MRW_AddrUH_Line16,bAddress_UH );
        putValue( DIAG_MRW_AddrH_Line16, bAddress_H  );
        putValue( DIAG_MRW_AddrM_Line16, bAddress_M  );
        putValue( DIAG_MRW_AddrL_Line16, bAddress_L  );
    }
    else
    {
        putValue( DIAG_MRW_AddrUH_Line16,0x00 );
        putValue( DIAG_MRW_AddrH_Line16, 0x00 );
        putValue( DIAG_MRW_AddrM_Line16, 0x00 );
        putValue( DIAG_MRW_AddrL_Line16, 0x00 );
    }
}

void MRW_vClearDataFields()
{
     putValue( DIAG_MRW_Data000, '0' );
     putValue( DIAG_MRW_Data001, '0' );
     putValue( DIAG_MRW_Data002, '0' );
     putValue( DIAG_MRW_Data003, '0' );
     putValue( DIAG_MRW_Data004, '0' );
     putValue( DIAG_MRW_Data005, '0' );
     putValue( DIAG_MRW_Data006, '0' );
     putValue( DIAG_MRW_Data007, '0' );
     putValue( DIAG_MRW_Data008, '0' );
     putValue( DIAG_MRW_Data009, '0' );
     putValue( DIAG_MRW_Data010, '0' );
     putValue( DIAG_MRW_Data011, '0' );
     putValue( DIAG_MRW_Data012, '0' );
     putValue( DIAG_MRW_Data013, '0' );
     putValue( DIAG_MRW_Data014, '0' );
     putValue( DIAG_MRW_Data015, '0' );
     putValue( DIAG_MRW_Data016, '0' );
     putValue( DIAG_MRW_Data017, '0' );
     putValue( DIAG_MRW_Data018, '0' );
     putValue( DIAG_MRW_Data019, '0' );
     putValue( DIAG_MRW_Data020, '0' );
     putValue( DIAG_MRW_Data021, '0' );
     putValue( DIAG_MRW_Data022, '0' );
     putValue( DIAG_MRW_Data023, '0' );
     putValue( DIAG_MRW_Data024, '0' );
     putValue( DIAG_MRW_Data025, '0' );
     putValue( DIAG_MRW_Data026, '0' );
     putValue( DIAG_MRW_Data027, '0' );
     putValue( DIAG_MRW_Data028, '0' );
     putValue( DIAG_MRW_Data029, '0' );
     putValue( DIAG_MRW_Data030, '0' );
     putValue( DIAG_MRW_Data031, '0' );
     putValue( DIAG_MRW_Data032, '0' );
     putValue( DIAG_MRW_Data033, '0' );
     putValue( DIAG_MRW_Data034, '0' );
     putValue( DIAG_MRW_Data035, '0' );
     putValue( DIAG_MRW_Data036, '0' );
     putValue( DIAG_MRW_Data037, '0' );
     putValue( DIAG_MRW_Data038, '0' );
     putValue( DIAG_MRW_Data039, '0' );
     putValue( DIAG_MRW_Data040, '0' );
     putValue( DIAG_MRW_Data041, '0' );
     putValue( DIAG_MRW_Data042, '0' );
     putValue( DIAG_MRW_Data043, '0' );
     putValue( DIAG_MRW_Data044, '0' );
     putValue( DIAG_MRW_Data045, '0' );
     putValue( DIAG_MRW_Data046, '0' );
     putValue( DIAG_MRW_Data047, '0' );
     putValue( DIAG_MRW_Data048, '0' );
     putValue( DIAG_MRW_Data049, '0' );
     putValue( DIAG_MRW_Data050, '0' );
     putValue( DIAG_MRW_Data051, '0' );
     putValue( DIAG_MRW_Data052, '0' );
     putValue( DIAG_MRW_Data053, '0' );
     putValue( DIAG_MRW_Data054, '0' );
     putValue( DIAG_MRW_Data055, '0' );
     putValue( DIAG_MRW_Data056, '0' );
     putValue( DIAG_MRW_Data057, '0' );
     putValue( DIAG_MRW_Data058, '0' );
     putValue( DIAG_MRW_Data059, '0' );
     putValue( DIAG_MRW_Data060, '0' );
     putValue( DIAG_MRW_Data061, '0' );
     putValue( DIAG_MRW_Data062, '0' );
     putValue( DIAG_MRW_Data063, '0' );
     putValue( DIAG_MRW_Data064, '0' );
     putValue( DIAG_MRW_Data065, '0' );
     putValue( DIAG_MRW_Data066, '0' );
     putValue( DIAG_MRW_Data067, '0' );
     putValue( DIAG_MRW_Data068, '0' );
     putValue( DIAG_MRW_Data069, '0' );
     putValue( DIAG_MRW_Data070, '0' );
     putValue( DIAG_MRW_Data071, '0' );
     putValue( DIAG_MRW_Data072, '0' );
     putValue( DIAG_MRW_Data073, '0' );
     putValue( DIAG_MRW_Data074, '0' );
     putValue( DIAG_MRW_Data075, '0' );
     putValue( DIAG_MRW_Data076, '0' );
     putValue( DIAG_MRW_Data077, '0' );
     putValue( DIAG_MRW_Data078, '0' );
     putValue( DIAG_MRW_Data079, '0' );
     putValue( DIAG_MRW_Data080, '0' );
     putValue( DIAG_MRW_Data081, '0' );
     putValue( DIAG_MRW_Data082, '0' );
     putValue( DIAG_MRW_Data083, '0' );
     putValue( DIAG_MRW_Data084, '0' );
     putValue( DIAG_MRW_Data085, '0' );
     putValue( DIAG_MRW_Data086, '0' );
     putValue( DIAG_MRW_Data087, '0' );
     putValue( DIAG_MRW_Data088, '0' );
     putValue( DIAG_MRW_Data089, '0' );
     putValue( DIAG_MRW_Data090, '0' );
     putValue( DIAG_MRW_Data091, '0' );
     putValue( DIAG_MRW_Data092, '0' );
     putValue( DIAG_MRW_Data093, '0' );
     putValue( DIAG_MRW_Data094, '0' );
     putValue( DIAG_MRW_Data095, '0' );
     putValue( DIAG_MRW_Data096, '0' );
     putValue( DIAG_MRW_Data097, '0' );
     putValue( DIAG_MRW_Data098, '0' );
     putValue( DIAG_MRW_Data099, '0' );
     putValue( DIAG_MRW_Data100, '0' );
     putValue( DIAG_MRW_Data101, '0' );
     putValue( DIAG_MRW_Data102, '0' );
     putValue( DIAG_MRW_Data103, '0' );
     putValue( DIAG_MRW_Data104, '0' );
     putValue( DIAG_MRW_Data105, '0' );
     putValue( DIAG_MRW_Data106, '0' );
     putValue( DIAG_MRW_Data107, '0' );
     putValue( DIAG_MRW_Data108, '0' );
     putValue( DIAG_MRW_Data109, '0' );
     putValue( DIAG_MRW_Data110, '0' );
     putValue( DIAG_MRW_Data111, '0' );
     putValue( DIAG_MRW_Data112, '0' );
     putValue( DIAG_MRW_Data113, '0' );
     putValue( DIAG_MRW_Data114, '0' );
     putValue( DIAG_MRW_Data115, '0' );
     putValue( DIAG_MRW_Data116, '0' );
     putValue( DIAG_MRW_Data117, '0' );
     putValue( DIAG_MRW_Data118, '0' );
     putValue( DIAG_MRW_Data119, '0' );
     putValue( DIAG_MRW_Data120, '0' );
     putValue( DIAG_MRW_Data121, '0' );
     putValue( DIAG_MRW_Data122, '0' );
     putValue( DIAG_MRW_Data123, '0' );
     putValue( DIAG_MRW_Data124, '0' );
     putValue( DIAG_MRW_Data125, '0' );
     putValue( DIAG_MRW_Data126, '0' );
     putValue( DIAG_MRW_Data127, '0' );
     putValue( DIAG_MRW_Data128, '0' );
     putValue( DIAG_MRW_Data129, '0' );
     putValue( DIAG_MRW_Data130, '0' );
     putValue( DIAG_MRW_Data131, '0' );
     putValue( DIAG_MRW_Data132, '0' );
     putValue( DIAG_MRW_Data133, '0' );
     putValue( DIAG_MRW_Data134, '0' );
     putValue( DIAG_MRW_Data135, '0' );
     putValue( DIAG_MRW_Data136, '0' );
     putValue( DIAG_MRW_Data137, '0' );
     putValue( DIAG_MRW_Data138, '0' );
     putValue( DIAG_MRW_Data139, '0' );
     putValue( DIAG_MRW_Data140, '0' );
     putValue( DIAG_MRW_Data141, '0' );
     putValue( DIAG_MRW_Data142, '0' );
     putValue( DIAG_MRW_Data143, '0' );
     putValue( DIAG_MRW_Data144, '0' );
     putValue( DIAG_MRW_Data145, '0' );
     putValue( DIAG_MRW_Data146, '0' );
     putValue( DIAG_MRW_Data147, '0' );
     putValue( DIAG_MRW_Data148, '0' );
     putValue( DIAG_MRW_Data149, '0' );
     putValue( DIAG_MRW_Data150, '0' );
     putValue( DIAG_MRW_Data151, '0' );
     putValue( DIAG_MRW_Data152, '0' );
     putValue( DIAG_MRW_Data153, '0' );
     putValue( DIAG_MRW_Data154, '0' );
     putValue( DIAG_MRW_Data155, '0' );
     putValue( DIAG_MRW_Data156, '0' );
     putValue( DIAG_MRW_Data157, '0' );
     putValue( DIAG_MRW_Data158, '0' );
     putValue( DIAG_MRW_Data159, '0' );
     putValue( DIAG_MRW_Data160, '0' );
     putValue( DIAG_MRW_Data161, '0' );
     putValue( DIAG_MRW_Data162, '0' );
     putValue( DIAG_MRW_Data163, '0' );
     putValue( DIAG_MRW_Data164, '0' );
     putValue( DIAG_MRW_Data165, '0' );
     putValue( DIAG_MRW_Data166, '0' );
     putValue( DIAG_MRW_Data167, '0' );
     putValue( DIAG_MRW_Data168, '0' );
     putValue( DIAG_MRW_Data169, '0' );
     putValue( DIAG_MRW_Data170, '0' );
     putValue( DIAG_MRW_Data171, '0' );
     putValue( DIAG_MRW_Data172, '0' );
     putValue( DIAG_MRW_Data173, '0' );
     putValue( DIAG_MRW_Data174, '0' );
     putValue( DIAG_MRW_Data175, '0' );
     putValue( DIAG_MRW_Data176, '0' );
     putValue( DIAG_MRW_Data177, '0' );
     putValue( DIAG_MRW_Data178, '0' );
     putValue( DIAG_MRW_Data179, '0' );
     putValue( DIAG_MRW_Data180, '0' );
     putValue( DIAG_MRW_Data181, '0' );
     putValue( DIAG_MRW_Data182, '0' );
     putValue( DIAG_MRW_Data183, '0' );
     putValue( DIAG_MRW_Data184, '0' );
     putValue( DIAG_MRW_Data185, '0' );
     putValue( DIAG_MRW_Data186, '0' );
     putValue( DIAG_MRW_Data187, '0' );
     putValue( DIAG_MRW_Data188, '0' );
     putValue( DIAG_MRW_Data189, '0' );
     putValue( DIAG_MRW_Data190, '0' );
     putValue( DIAG_MRW_Data191, '0' );
     putValue( DIAG_MRW_Data192, '0' );
     putValue( DIAG_MRW_Data193, '0' );
     putValue( DIAG_MRW_Data194, '0' );
     putValue( DIAG_MRW_Data195, '0' );
     putValue( DIAG_MRW_Data196, '0' );
     putValue( DIAG_MRW_Data197, '0' );
     putValue( DIAG_MRW_Data198, '0' );
     putValue( DIAG_MRW_Data199, '0' );
     putValue( DIAG_MRW_Data200, '0' );
     putValue( DIAG_MRW_Data201, '0' );
     putValue( DIAG_MRW_Data202, '0' );
     putValue( DIAG_MRW_Data203, '0' );
     putValue( DIAG_MRW_Data204, '0' );
     putValue( DIAG_MRW_Data205, '0' );
     putValue( DIAG_MRW_Data206, '0' );
     putValue( DIAG_MRW_Data207, '0' );
     putValue( DIAG_MRW_Data208, '0' );
     putValue( DIAG_MRW_Data209, '0' );
     putValue( DIAG_MRW_Data210, '0' );
     putValue( DIAG_MRW_Data211, '0' );
     putValue( DIAG_MRW_Data212, '0' );
     putValue( DIAG_MRW_Data213, '0' );
     putValue( DIAG_MRW_Data214, '0' );
     putValue( DIAG_MRW_Data215, '0' );
     putValue( DIAG_MRW_Data216, '0' );
     putValue( DIAG_MRW_Data217, '0' );
     putValue( DIAG_MRW_Data218, '0' );
     putValue( DIAG_MRW_Data219, '0' );
     putValue( DIAG_MRW_Data220, '0' );
     putValue( DIAG_MRW_Data221, '0' );
     putValue( DIAG_MRW_Data222, '0' );
     putValue( DIAG_MRW_Data223, '0' );
     putValue( DIAG_MRW_Data224, '0' );
     putValue( DIAG_MRW_Data225, '0' );
     putValue( DIAG_MRW_Data226, '0' );
     putValue( DIAG_MRW_Data227, '0' );
     putValue( DIAG_MRW_Data228, '0' );
     putValue( DIAG_MRW_Data229, '0' );
     putValue( DIAG_MRW_Data230, '0' );
     putValue( DIAG_MRW_Data231, '0' );
     putValue( DIAG_MRW_Data232, '0' );
     putValue( DIAG_MRW_Data233, '0' );
     putValue( DIAG_MRW_Data234, '0' );
     putValue( DIAG_MRW_Data235, '0' );
     putValue( DIAG_MRW_Data236, '0' );
     putValue( DIAG_MRW_Data237, '0' );
     putValue( DIAG_MRW_Data238, '0' );
     putValue( DIAG_MRW_Data239, '0' );
     putValue( DIAG_MRW_Data240, '0' );
     putValue( DIAG_MRW_Data241, '0' );
     putValue( DIAG_MRW_Data242, '0' );
     putValue( DIAG_MRW_Data243, '0' );
     putValue( DIAG_MRW_Data244, '0' );
     putValue( DIAG_MRW_Data245, '0' );
     putValue( DIAG_MRW_Data246, '0' );
     putValue( DIAG_MRW_Data247, '0' );
     putValue( DIAG_MRW_Data248, '0' );
     putValue( DIAG_MRW_Data249, '0' );
     putValue( DIAG_MRW_Data250, '0' );
     putValue( DIAG_MRW_Data251, '0' );
     putValue( DIAG_MRW_Data252, '0' );
     putValue( DIAG_MRW_Data253, '0' );
     putValue( DIAG_MRW_Data254, '0' );
     putValue( DIAG_MRW_Data255, '0' );     
}

void MRW_vClearShadow( void )
{
    int i;

    for( i=0; i<256; i++ )
        DIAG__abMRWEepromShadow[ DIAG__bMRWActDataSet ][ i ] = 0x00;
}

void MRW_vCopyEditToShadow( void )
{
     int i;

     i=0;
     DIAG__abMRWEepromShadow[ DIAG__bMRWActDataSet ][ i ] = getValue( DIAG_MRW_Data000 ); i++;
     DIAG__abMRWEepromShadow[ DIAG__bMRWActDataSet ][ i ] = getValue( DIAG_MRW_Data001 ); i++;
     DIAG__abMRWEepromShadow[ DIAG__bMRWActDataSet ][ i ] = getValue( DIAG_MRW_Data002 ); i++;
     DIAG__abMRWEepromShadow[ DIAG__bMRWActDataSet ][ i ] = getValue( DIAG_MRW_Data003 ); i++;
     DIAG__abMRWEepromShadow[ DIAG__bMRWActDataSet ][ i ] = getValue( DIAG_MRW_Data004 ); i++;
     DIAG__abMRWEepromShadow[ DIAG__bMRWActDataSet ][ i ] = getValue( DIAG_MRW_Data005 ); i++;
     DIAG__abMRWEepromShadow[ DIAG__bMRWActDataSet ][ i ] = getValue( DIAG_MRW_Data006 ); i++;
     DIAG__abMRWEepromShadow[ DIAG__bMRWActDataSet ][ i ] = getValue( DIAG_MRW_Data007 ); i++;
     DIAG__abMRWEepromShadow[ DIAG__bMRWActDataSet ][ i ] = getValue( DIAG_MRW_Data008 ); i++;
     DIAG__abMRWEepromShadow[ DIAG__bMRWActDataSet ][ i ] = getValue( DIAG_MRW_Data009 ); i++;
     DIAG__abMRWEepromShadow[ DIAG__bMRWActDataSet ][ i ] = getValue( DIAG_MRW_Data010 ); i++;
     DIAG__abMRWEepromShadow[ DIAG__bMRWActDataSet ][ i ] = getValue( DIAG_MRW_Data011 ); i++;
     DIAG__abMRWEepromShadow[ DIAG__bMRWActDataSet ][ i ] = getValue( DIAG_MRW_Data012 ); i++;
     DIAG__abMRWEepromShadow[ DIAG__bMRWActDataSet ][ i ] = getValue( DIAG_MRW_Data013 ); i++;
     DIAG__abMRWEepromShadow[ DIAG__bMRWActDataSet ][ i ] = getValue( DIAG_MRW_Data014 ); i++;
     DIAG__abMRWEepromShadow[ DIAG__bMRWActDataSet ][ i ] = getValue( DIAG_MRW_Data015 ); i++;
     DIAG__abMRWEepromShadow[ DIAG__bMRWActDataSet ][ i ] = getValue( DIAG_MRW_Data016 ); i++;
     DIAG__abMRWEepromShadow[ DIAG__bMRWActDataSet ][ i ] = getValue( DIAG_MRW_Data017 ); i++;
     DIAG__abMRWEepromShadow[ DIAG__bMRWActDataSet ][ i ] = getValue( DIAG_MRW_Data018 ); i++;
     DIAG__abMRWEepromShadow[ DIAG__bMRWActDataSet ][ i ] = getValue( DIAG_MRW_Data019 ); i++;
     DIAG__abMRWEepromShadow[ DIAG__bMRWActDataSet ][ i ] = getValue( DIAG_MRW_Data020 ); i++;
     DIAG__abMRWEepromShadow[ DIAG__bMRWActDataSet ][ i ] = getValue( DIAG_MRW_Data021 ); i++;
     DIAG__abMRWEepromShadow[ DIAG__bMRWActDataSet ][ i ] = getValue( DIAG_MRW_Data022 ); i++;
     DIAG__abMRWEepromShadow[ DIAG__bMRWActDataSet ][ i ] = getValue( DIAG_MRW_Data023 ); i++;
     DIAG__abMRWEepromShadow[ DIAG__bMRWActDataSet ][ i ] = getValue( DIAG_MRW_Data024 ); i++;
     DIAG__abMRWEepromShadow[ DIAG__bMRWActDataSet ][ i ] = getValue( DIAG_MRW_Data025 ); i++;
     DIAG__abMRWEepromShadow[ DIAG__bMRWActDataSet ][ i ] = getValue( DIAG_MRW_Data026 ); i++;
     DIAG__abMRWEepromShadow[ DIAG__bMRWActDataSet ][ i ] = getValue( DIAG_MRW_Data027 ); i++;
     DIAG__abMRWEepromShadow[ DIAG__bMRWActDataSet ][ i ] = getValue( DIAG_MRW_Data028 ); i++;
     DIAG__abMRWEepromShadow[ DIAG__bMRWActDataSet ][ i ] = getValue( DIAG_MRW_Data029 ); i++;
     DIAG__abMRWEepromShadow[ DIAG__bMRWActDataSet ][ i ] = getValue( DIAG_MRW_Data030 ); i++;
     DIAG__abMRWEepromShadow[ DIAG__bMRWActDataSet ][ i ] = getValue( DIAG_MRW_Data031 ); i++;
     DIAG__abMRWEepromShadow[ DIAG__bMRWActDataSet ][ i ] = getValue( DIAG_MRW_Data032 ); i++;
     DIAG__abMRWEepromShadow[ DIAG__bMRWActDataSet ][ i ] = getValue( DIAG_MRW_Data033 ); i++;
     DIAG__abMRWEepromShadow[ DIAG__bMRWActDataSet ][ i ] = getValue( DIAG_MRW_Data034 ); i++;
     DIAG__abMRWEepromShadow[ DIAG__bMRWActDataSet ][ i ] = getValue( DIAG_MRW_Data035 ); i++;
     DIAG__abMRWEepromShadow[ DIAG__bMRWActDataSet ][ i ] = getValue( DIAG_MRW_Data036 ); i++;
     DIAG__abMRWEepromShadow[ DIAG__bMRWActDataSet ][ i ] = getValue( DIAG_MRW_Data037 ); i++;
     DIAG__abMRWEepromShadow[ DIAG__bMRWActDataSet ][ i ] = getValue( DIAG_MRW_Data038 ); i++;
     DIAG__abMRWEepromShadow[ DIAG__bMRWActDataSet ][ i ] = getValue( DIAG_MRW_Data039 ); i++;
     DIAG__abMRWEepromShadow[ DIAG__bMRWActDataSet ][ i ] = getValue( DIAG_MRW_Data040 ); i++;
     DIAG__abMRWEepromShadow[ DIAG__bMRWActDataSet ][ i ] = getValue( DIAG_MRW_Data041 ); i++;
     DIAG__abMRWEepromShadow[ DIAG__bMRWActDataSet ][ i ] = getValue( DIAG_MRW_Data042 ); i++;
     DIAG__abMRWEepromShadow[ DIAG__bMRWActDataSet ][ i ] = getValue( DIAG_MRW_Data043 ); i++;
     DIAG__abMRWEepromShadow[ DIAG__bMRWActDataSet ][ i ] = getValue( DIAG_MRW_Data044 ); i++;
     DIAG__abMRWEepromShadow[ DIAG__bMRWActDataSet ][ i ] = getValue( DIAG_MRW_Data045 ); i++;
     DIAG__abMRWEepromShadow[ DIAG__bMRWActDataSet ][ i ] = getValue( DIAG_MRW_Data046 ); i++;
     DIAG__abMRWEepromShadow[ DIAG__bMRWActDataSet ][ i ] = getValue( DIAG_MRW_Data047 ); i++;
     DIAG__abMRWEepromShadow[ DIAG__bMRWActDataSet ][ i ] = getValue( DIAG_MRW_Data048 ); i++;
     DIAG__abMRWEepromShadow[ DIAG__bMRWActDataSet ][ i ] = getValue( DIAG_MRW_Data049 ); i++;
     DIAG__abMRWEepromShadow[ DIAG__bMRWActDataSet ][ i ] = getValue( DIAG_MRW_Data050 ); i++;
     DIAG__abMRWEepromShadow[ DIAG__bMRWActDataSet ][ i ] = getValue( DIAG_MRW_Data051 ); i++;
     DIAG__abMRWEepromShadow[ DIAG__bMRWActDataSet ][ i ] = getValue( DIAG_MRW_Data052 ); i++;
     DIAG__abMRWEepromShadow[ DIAG__bMRWActDataSet ][ i ] = getValue( DIAG_MRW_Data053 ); i++;
     DIAG__abMRWEepromShadow[ DIAG__bMRWActDataSet ][ i ] = getValue( DIAG_MRW_Data054 ); i++;
     DIAG__abMRWEepromShadow[ DIAG__bMRWActDataSet ][ i ] = getValue( DIAG_MRW_Data055 ); i++;
     DIAG__abMRWEepromShadow[ DIAG__bMRWActDataSet ][ i ] = getValue( DIAG_MRW_Data056 ); i++;
     DIAG__abMRWEepromShadow[ DIAG__bMRWActDataSet ][ i ] = getValue( DIAG_MRW_Data057 ); i++;
     DIAG__abMRWEepromShadow[ DIAG__bMRWActDataSet ][ i ] = getValue( DIAG_MRW_Data058 ); i++;
     DIAG__abMRWEepromShadow[ DIAG__bMRWActDataSet ][ i ] = getValue( DIAG_MRW_Data059 ); i++;
     DIAG__abMRWEepromShadow[ DIAG__bMRWActDataSet ][ i ] = getValue( DIAG_MRW_Data060 ); i++;
     DIAG__abMRWEepromShadow[ DIAG__bMRWActDataSet ][ i ] = getValue( DIAG_MRW_Data061 ); i++;
     DIAG__abMRWEepromShadow[ DIAG__bMRWActDataSet ][ i ] = getValue( DIAG_MRW_Data062 ); i++;
     DIAG__abMRWEepromShadow[ DIAG__bMRWActDataSet ][ i ] = getValue( DIAG_MRW_Data063 ); i++;
     DIAG__abMRWEepromShadow[ DIAG__bMRWActDataSet ][ i ] = getValue( DIAG_MRW_Data064 ); i++;
     DIAG__abMRWEepromShadow[ DIAG__bMRWActDataSet ][ i ] = getValue( DIAG_MRW_Data065 ); i++;
     DIAG__abMRWEepromShadow[ DIAG__bMRWActDataSet ][ i ] = getValue( DIAG_MRW_Data066 ); i++;
     DIAG__abMRWEepromShadow[ DIAG__bMRWActDataSet ][ i ] = getValue( DIAG_MRW_Data067 ); i++;
     DIAG__abMRWEepromShadow[ DIAG__bMRWActDataSet ][ i ] = getValue( DIAG_MRW_Data068 ); i++;
     DIAG__abMRWEepromShadow[ DIAG__bMRWActDataSet ][ i ] = getValue( DIAG_MRW_Data069 ); i++;
     DIAG__abMRWEepromShadow[ DIAG__bMRWActDataSet ][ i ] = getValue( DIAG_MRW_Data070 ); i++;
     DIAG__abMRWEepromShadow[ DIAG__bMRWActDataSet ][ i ] = getValue( DIAG_MRW_Data071 ); i++;
     DIAG__abMRWEepromShadow[ DIAG__bMRWActDataSet ][ i ] = getValue( DIAG_MRW_Data072 ); i++;
     DIAG__abMRWEepromShadow[ DIAG__bMRWActDataSet ][ i ] = getValue( DIAG_MRW_Data073 ); i++;
     DIAG__abMRWEepromShadow[ DIAG__bMRWActDataSet ][ i ] = getValue( DIAG_MRW_Data074 ); i++;
     DIAG__abMRWEepromShadow[ DIAG__bMRWActDataSet ][ i ] = getValue( DIAG_MRW_Data075 ); i++;
     DIAG__abMRWEepromShadow[ DIAG__bMRWActDataSet ][ i ] = getValue( DIAG_MRW_Data076 ); i++;
     DIAG__abMRWEepromShadow[ DIAG__bMRWActDataSet ][ i ] = getValue( DIAG_MRW_Data077 ); i++;
     DIAG__abMRWEepromShadow[ DIAG__bMRWActDataSet ][ i ] = getValue( DIAG_MRW_Data078 ); i++;
     DIAG__abMRWEepromShadow[ DIAG__bMRWActDataSet ][ i ] = getValue( DIAG_MRW_Data079 ); i++;
     DIAG__abMRWEepromShadow[ DIAG__bMRWActDataSet ][ i ] = getValue( DIAG_MRW_Data080 ); i++;
     DIAG__abMRWEepromShadow[ DIAG__bMRWActDataSet ][ i ] = getValue( DIAG_MRW_Data081 ); i++;
     DIAG__abMRWEepromShadow[ DIAG__bMRWActDataSet ][ i ] = getValue( DIAG_MRW_Data082 ); i++;
     DIAG__abMRWEepromShadow[ DIAG__bMRWActDataSet ][ i ] = getValue( DIAG_MRW_Data083 ); i++;
     DIAG__abMRWEepromShadow[ DIAG__bMRWActDataSet ][ i ] = getValue( DIAG_MRW_Data084 ); i++;
     DIAG__abMRWEepromShadow[ DIAG__bMRWActDataSet ][ i ] = getValue( DIAG_MRW_Data085 ); i++;
     DIAG__abMRWEepromShadow[ DIAG__bMRWActDataSet ][ i ] = getValue( DIAG_MRW_Data086 ); i++;
     DIAG__abMRWEepromShadow[ DIAG__bMRWActDataSet ][ i ] = getValue( DIAG_MRW_Data087 ); i++;
     DIAG__abMRWEepromShadow[ DIAG__bMRWActDataSet ][ i ] = getValue( DIAG_MRW_Data088 ); i++;
     DIAG__abMRWEepromShadow[ DIAG__bMRWActDataSet ][ i ] = getValue( DIAG_MRW_Data089 ); i++;
     DIAG__abMRWEepromShadow[ DIAG__bMRWActDataSet ][ i ] = getValue( DIAG_MRW_Data090 ); i++;
     DIAG__abMRWEepromShadow[ DIAG__bMRWActDataSet ][ i ] = getValue( DIAG_MRW_Data091 ); i++;
     DIAG__abMRWEepromShadow[ DIAG__bMRWActDataSet ][ i ] = getValue( DIAG_MRW_Data092 ); i++;
     DIAG__abMRWEepromShadow[ DIAG__bMRWActDataSet ][ i ] = getValue( DIAG_MRW_Data093 ); i++;
     DIAG__abMRWEepromShadow[ DIAG__bMRWActDataSet ][ i ] = getValue( DIAG_MRW_Data094 ); i++;
     DIAG__abMRWEepromShadow[ DIAG__bMRWActDataSet ][ i ] = getValue( DIAG_MRW_Data095 ); i++;
     DIAG__abMRWEepromShadow[ DIAG__bMRWActDataSet ][ i ] = getValue( DIAG_MRW_Data096 ); i++;
     DIAG__abMRWEepromShadow[ DIAG__bMRWActDataSet ][ i ] = getValue( DIAG_MRW_Data097 ); i++;
     DIAG__abMRWEepromShadow[ DIAG__bMRWActDataSet ][ i ] = getValue( DIAG_MRW_Data098 ); i++;
     DIAG__abMRWEepromShadow[ DIAG__bMRWActDataSet ][ i ] = getValue( DIAG_MRW_Data099 ); i++;
     DIAG__abMRWEepromShadow[ DIAG__bMRWActDataSet ][ i ] = getValue( DIAG_MRW_Data100 ); i++;
     DIAG__abMRWEepromShadow[ DIAG__bMRWActDataSet ][ i ] = getValue( DIAG_MRW_Data101 ); i++;
     DIAG__abMRWEepromShadow[ DIAG__bMRWActDataSet ][ i ] = getValue( DIAG_MRW_Data102 ); i++;
     DIAG__abMRWEepromShadow[ DIAG__bMRWActDataSet ][ i ] = getValue( DIAG_MRW_Data103 ); i++;
     DIAG__abMRWEepromShadow[ DIAG__bMRWActDataSet ][ i ] = getValue( DIAG_MRW_Data104 ); i++;
     DIAG__abMRWEepromShadow[ DIAG__bMRWActDataSet ][ i ] = getValue( DIAG_MRW_Data105 ); i++;
     DIAG__abMRWEepromShadow[ DIAG__bMRWActDataSet ][ i ] = getValue( DIAG_MRW_Data106 ); i++;
     DIAG__abMRWEepromShadow[ DIAG__bMRWActDataSet ][ i ] = getValue( DIAG_MRW_Data107 ); i++;
     DIAG__abMRWEepromShadow[ DIAG__bMRWActDataSet ][ i ] = getValue( DIAG_MRW_Data108 ); i++;
     DIAG__abMRWEepromShadow[ DIAG__bMRWActDataSet ][ i ] = getValue( DIAG_MRW_Data109 ); i++;
     DIAG__abMRWEepromShadow[ DIAG__bMRWActDataSet ][ i ] = getValue( DIAG_MRW_Data110 ); i++;
     DIAG__abMRWEepromShadow[ DIAG__bMRWActDataSet ][ i ] = getValue( DIAG_MRW_Data111 ); i++;
     DIAG__abMRWEepromShadow[ DIAG__bMRWActDataSet ][ i ] = getValue( DIAG_MRW_Data112 ); i++;
     DIAG__abMRWEepromShadow[ DIAG__bMRWActDataSet ][ i ] = getValue( DIAG_MRW_Data113 ); i++;
     DIAG__abMRWEepromShadow[ DIAG__bMRWActDataSet ][ i ] = getValue( DIAG_MRW_Data114 ); i++;
     DIAG__abMRWEepromShadow[ DIAG__bMRWActDataSet ][ i ] = getValue( DIAG_MRW_Data115 ); i++;
     DIAG__abMRWEepromShadow[ DIAG__bMRWActDataSet ][ i ] = getValue( DIAG_MRW_Data116 ); i++;
     DIAG__abMRWEepromShadow[ DIAG__bMRWActDataSet ][ i ] = getValue( DIAG_MRW_Data117 ); i++;
     DIAG__abMRWEepromShadow[ DIAG__bMRWActDataSet ][ i ] = getValue( DIAG_MRW_Data118 ); i++;
     DIAG__abMRWEepromShadow[ DIAG__bMRWActDataSet ][ i ] = getValue( DIAG_MRW_Data119 ); i++;
     DIAG__abMRWEepromShadow[ DIAG__bMRWActDataSet ][ i ] = getValue( DIAG_MRW_Data120 ); i++;
     DIAG__abMRWEepromShadow[ DIAG__bMRWActDataSet ][ i ] = getValue( DIAG_MRW_Data121 ); i++;
     DIAG__abMRWEepromShadow[ DIAG__bMRWActDataSet ][ i ] = getValue( DIAG_MRW_Data122 ); i++;
     DIAG__abMRWEepromShadow[ DIAG__bMRWActDataSet ][ i ] = getValue( DIAG_MRW_Data123 ); i++;
     DIAG__abMRWEepromShadow[ DIAG__bMRWActDataSet ][ i ] = getValue( DIAG_MRW_Data124 ); i++;
     DIAG__abMRWEepromShadow[ DIAG__bMRWActDataSet ][ i ] = getValue( DIAG_MRW_Data125 ); i++;
     DIAG__abMRWEepromShadow[ DIAG__bMRWActDataSet ][ i ] = getValue( DIAG_MRW_Data126 ); i++;
     DIAG__abMRWEepromShadow[ DIAG__bMRWActDataSet ][ i ] = getValue( DIAG_MRW_Data127 ); i++;
     DIAG__abMRWEepromShadow[ DIAG__bMRWActDataSet ][ i ] = getValue( DIAG_MRW_Data128 ); i++;
     DIAG__abMRWEepromShadow[ DIAG__bMRWActDataSet ][ i ] = getValue( DIAG_MRW_Data129 ); i++;
     DIAG__abMRWEepromShadow[ DIAG__bMRWActDataSet ][ i ] = getValue( DIAG_MRW_Data130 ); i++;
     DIAG__abMRWEepromShadow[ DIAG__bMRWActDataSet ][ i ] = getValue( DIAG_MRW_Data131 ); i++;
     DIAG__abMRWEepromShadow[ DIAG__bMRWActDataSet ][ i ] = getValue( DIAG_MRW_Data132 ); i++;
     DIAG__abMRWEepromShadow[ DIAG__bMRWActDataSet ][ i ] = getValue( DIAG_MRW_Data133 ); i++;
     DIAG__abMRWEepromShadow[ DIAG__bMRWActDataSet ][ i ] = getValue( DIAG_MRW_Data134 ); i++;
     DIAG__abMRWEepromShadow[ DIAG__bMRWActDataSet ][ i ] = getValue( DIAG_MRW_Data135 ); i++;
     DIAG__abMRWEepromShadow[ DIAG__bMRWActDataSet ][ i ] = getValue( DIAG_MRW_Data136 ); i++;
     DIAG__abMRWEepromShadow[ DIAG__bMRWActDataSet ][ i ] = getValue( DIAG_MRW_Data137 ); i++;
     DIAG__abMRWEepromShadow[ DIAG__bMRWActDataSet ][ i ] = getValue( DIAG_MRW_Data138 ); i++;
     DIAG__abMRWEepromShadow[ DIAG__bMRWActDataSet ][ i ] = getValue( DIAG_MRW_Data139 ); i++;
     DIAG__abMRWEepromShadow[ DIAG__bMRWActDataSet ][ i ] = getValue( DIAG_MRW_Data140 ); i++;
     DIAG__abMRWEepromShadow[ DIAG__bMRWActDataSet ][ i ] = getValue( DIAG_MRW_Data141 ); i++;
     DIAG__abMRWEepromShadow[ DIAG__bMRWActDataSet ][ i ] = getValue( DIAG_MRW_Data142 ); i++;
     DIAG__abMRWEepromShadow[ DIAG__bMRWActDataSet ][ i ] = getValue( DIAG_MRW_Data143 ); i++;
     DIAG__abMRWEepromShadow[ DIAG__bMRWActDataSet ][ i ] = getValue( DIAG_MRW_Data144 ); i++;
     DIAG__abMRWEepromShadow[ DIAG__bMRWActDataSet ][ i ] = getValue( DIAG_MRW_Data145 ); i++;
     DIAG__abMRWEepromShadow[ DIAG__bMRWActDataSet ][ i ] = getValue( DIAG_MRW_Data146 ); i++;
     DIAG__abMRWEepromShadow[ DIAG__bMRWActDataSet ][ i ] = getValue( DIAG_MRW_Data147 ); i++;
     DIAG__abMRWEepromShadow[ DIAG__bMRWActDataSet ][ i ] = getValue( DIAG_MRW_Data148 ); i++;
     DIAG__abMRWEepromShadow[ DIAG__bMRWActDataSet ][ i ] = getValue( DIAG_MRW_Data149 ); i++;
     DIAG__abMRWEepromShadow[ DIAG__bMRWActDataSet ][ i ] = getValue( DIAG_MRW_Data150 ); i++;
     DIAG__abMRWEepromShadow[ DIAG__bMRWActDataSet ][ i ] = getValue( DIAG_MRW_Data151 ); i++;
     DIAG__abMRWEepromShadow[ DIAG__bMRWActDataSet ][ i ] = getValue( DIAG_MRW_Data152 ); i++;
     DIAG__abMRWEepromShadow[ DIAG__bMRWActDataSet ][ i ] = getValue( DIAG_MRW_Data153 ); i++;
     DIAG__abMRWEepromShadow[ DIAG__bMRWActDataSet ][ i ] = getValue( DIAG_MRW_Data154 ); i++;
     DIAG__abMRWEepromShadow[ DIAG__bMRWActDataSet ][ i ] = getValue( DIAG_MRW_Data155 ); i++;
     DIAG__abMRWEepromShadow[ DIAG__bMRWActDataSet ][ i ] = getValue( DIAG_MRW_Data156 ); i++;
     DIAG__abMRWEepromShadow[ DIAG__bMRWActDataSet ][ i ] = getValue( DIAG_MRW_Data157 ); i++;
     DIAG__abMRWEepromShadow[ DIAG__bMRWActDataSet ][ i ] = getValue( DIAG_MRW_Data158 ); i++;
     DIAG__abMRWEepromShadow[ DIAG__bMRWActDataSet ][ i ] = getValue( DIAG_MRW_Data159 ); i++;
     DIAG__abMRWEepromShadow[ DIAG__bMRWActDataSet ][ i ] = getValue( DIAG_MRW_Data160 ); i++;
     DIAG__abMRWEepromShadow[ DIAG__bMRWActDataSet ][ i ] = getValue( DIAG_MRW_Data161 ); i++;
     DIAG__abMRWEepromShadow[ DIAG__bMRWActDataSet ][ i ] = getValue( DIAG_MRW_Data162 ); i++;
     DIAG__abMRWEepromShadow[ DIAG__bMRWActDataSet ][ i ] = getValue( DIAG_MRW_Data163 ); i++;
     DIAG__abMRWEepromShadow[ DIAG__bMRWActDataSet ][ i ] = getValue( DIAG_MRW_Data164 ); i++;
     DIAG__abMRWEepromShadow[ DIAG__bMRWActDataSet ][ i ] = getValue( DIAG_MRW_Data165 ); i++;
     DIAG__abMRWEepromShadow[ DIAG__bMRWActDataSet ][ i ] = getValue( DIAG_MRW_Data166 ); i++;
     DIAG__abMRWEepromShadow[ DIAG__bMRWActDataSet ][ i ] = getValue( DIAG_MRW_Data167 ); i++;
     DIAG__abMRWEepromShadow[ DIAG__bMRWActDataSet ][ i ] = getValue( DIAG_MRW_Data168 ); i++;
     DIAG__abMRWEepromShadow[ DIAG__bMRWActDataSet ][ i ] = getValue( DIAG_MRW_Data169 ); i++;
     DIAG__abMRWEepromShadow[ DIAG__bMRWActDataSet ][ i ] = getValue( DIAG_MRW_Data170 ); i++;
     DIAG__abMRWEepromShadow[ DIAG__bMRWActDataSet ][ i ] = getValue( DIAG_MRW_Data171 ); i++;
     DIAG__abMRWEepromShadow[ DIAG__bMRWActDataSet ][ i ] = getValue( DIAG_MRW_Data172 ); i++;
     DIAG__abMRWEepromShadow[ DIAG__bMRWActDataSet ][ i ] = getValue( DIAG_MRW_Data173 ); i++;
     DIAG__abMRWEepromShadow[ DIAG__bMRWActDataSet ][ i ] = getValue( DIAG_MRW_Data174 ); i++;
     DIAG__abMRWEepromShadow[ DIAG__bMRWActDataSet ][ i ] = getValue( DIAG_MRW_Data175 ); i++;
     DIAG__abMRWEepromShadow[ DIAG__bMRWActDataSet ][ i ] = getValue( DIAG_MRW_Data176 ); i++;
     DIAG__abMRWEepromShadow[ DIAG__bMRWActDataSet ][ i ] = getValue( DIAG_MRW_Data177 ); i++;
     DIAG__abMRWEepromShadow[ DIAG__bMRWActDataSet ][ i ] = getValue( DIAG_MRW_Data178 ); i++;
     DIAG__abMRWEepromShadow[ DIAG__bMRWActDataSet ][ i ] = getValue( DIAG_MRW_Data179 ); i++;
     DIAG__abMRWEepromShadow[ DIAG__bMRWActDataSet ][ i ] = getValue( DIAG_MRW_Data180 ); i++;
     DIAG__abMRWEepromShadow[ DIAG__bMRWActDataSet ][ i ] = getValue( DIAG_MRW_Data181 ); i++;
     DIAG__abMRWEepromShadow[ DIAG__bMRWActDataSet ][ i ] = getValue( DIAG_MRW_Data182 ); i++;
     DIAG__abMRWEepromShadow[ DIAG__bMRWActDataSet ][ i ] = getValue( DIAG_MRW_Data183 ); i++;
     DIAG__abMRWEepromShadow[ DIAG__bMRWActDataSet ][ i ] = getValue( DIAG_MRW_Data184 ); i++;
     DIAG__abMRWEepromShadow[ DIAG__bMRWActDataSet ][ i ] = getValue( DIAG_MRW_Data185 ); i++;
     DIAG__abMRWEepromShadow[ DIAG__bMRWActDataSet ][ i ] = getValue( DIAG_MRW_Data186 ); i++;
     DIAG__abMRWEepromShadow[ DIAG__bMRWActDataSet ][ i ] = getValue( DIAG_MRW_Data187 ); i++;
     DIAG__abMRWEepromShadow[ DIAG__bMRWActDataSet ][ i ] = getValue( DIAG_MRW_Data188 ); i++;
     DIAG__abMRWEepromShadow[ DIAG__bMRWActDataSet ][ i ] = getValue( DIAG_MRW_Data189 ); i++;
     DIAG__abMRWEepromShadow[ DIAG__bMRWActDataSet ][ i ] = getValue( DIAG_MRW_Data190 ); i++;
     DIAG__abMRWEepromShadow[ DIAG__bMRWActDataSet ][ i ] = getValue( DIAG_MRW_Data191 ); i++;
     DIAG__abMRWEepromShadow[ DIAG__bMRWActDataSet ][ i ] = getValue( DIAG_MRW_Data192 ); i++;
     DIAG__abMRWEepromShadow[ DIAG__bMRWActDataSet ][ i ] = getValue( DIAG_MRW_Data193 ); i++;
     DIAG__abMRWEepromShadow[ DIAG__bMRWActDataSet ][ i ] = getValue( DIAG_MRW_Data194 ); i++;
     DIAG__abMRWEepromShadow[ DIAG__bMRWActDataSet ][ i ] = getValue( DIAG_MRW_Data195 ); i++;
     DIAG__abMRWEepromShadow[ DIAG__bMRWActDataSet ][ i ] = getValue( DIAG_MRW_Data196 ); i++;
     DIAG__abMRWEepromShadow[ DIAG__bMRWActDataSet ][ i ] = getValue( DIAG_MRW_Data197 ); i++;
     DIAG__abMRWEepromShadow[ DIAG__bMRWActDataSet ][ i ] = getValue( DIAG_MRW_Data198 ); i++;
     DIAG__abMRWEepromShadow[ DIAG__bMRWActDataSet ][ i ] = getValue( DIAG_MRW_Data199 ); i++;
     DIAG__abMRWEepromShadow[ DIAG__bMRWActDataSet ][ i ] = getValue( DIAG_MRW_Data200 ); i++;
     DIAG__abMRWEepromShadow[ DIAG__bMRWActDataSet ][ i ] = getValue( DIAG_MRW_Data201 ); i++;
     DIAG__abMRWEepromShadow[ DIAG__bMRWActDataSet ][ i ] = getValue( DIAG_MRW_Data202 ); i++;
     DIAG__abMRWEepromShadow[ DIAG__bMRWActDataSet ][ i ] = getValue( DIAG_MRW_Data203 ); i++;
     DIAG__abMRWEepromShadow[ DIAG__bMRWActDataSet ][ i ] = getValue( DIAG_MRW_Data204 ); i++;
     DIAG__abMRWEepromShadow[ DIAG__bMRWActDataSet ][ i ] = getValue( DIAG_MRW_Data205 ); i++;
     DIAG__abMRWEepromShadow[ DIAG__bMRWActDataSet ][ i ] = getValue( DIAG_MRW_Data206 ); i++;
     DIAG__abMRWEepromShadow[ DIAG__bMRWActDataSet ][ i ] = getValue( DIAG_MRW_Data207 ); i++;
     DIAG__abMRWEepromShadow[ DIAG__bMRWActDataSet ][ i ] = getValue( DIAG_MRW_Data208 ); i++;
     DIAG__abMRWEepromShadow[ DIAG__bMRWActDataSet ][ i ] = getValue( DIAG_MRW_Data209 ); i++;
     DIAG__abMRWEepromShadow[ DIAG__bMRWActDataSet ][ i ] = getValue( DIAG_MRW_Data210 ); i++;
     DIAG__abMRWEepromShadow[ DIAG__bMRWActDataSet ][ i ] = getValue( DIAG_MRW_Data211 ); i++;
     DIAG__abMRWEepromShadow[ DIAG__bMRWActDataSet ][ i ] = getValue( DIAG_MRW_Data212 ); i++;
     DIAG__abMRWEepromShadow[ DIAG__bMRWActDataSet ][ i ] = getValue( DIAG_MRW_Data213 ); i++;
     DIAG__abMRWEepromShadow[ DIAG__bMRWActDataSet ][ i ] = getValue( DIAG_MRW_Data214 ); i++;
     DIAG__abMRWEepromShadow[ DIAG__bMRWActDataSet ][ i ] = getValue( DIAG_MRW_Data215 ); i++;
     DIAG__abMRWEepromShadow[ DIAG__bMRWActDataSet ][ i ] = getValue( DIAG_MRW_Data216 ); i++;
     DIAG__abMRWEepromShadow[ DIAG__bMRWActDataSet ][ i ] = getValue( DIAG_MRW_Data217 ); i++;
     DIAG__abMRWEepromShadow[ DIAG__bMRWActDataSet ][ i ] = getValue( DIAG_MRW_Data218 ); i++;
     DIAG__abMRWEepromShadow[ DIAG__bMRWActDataSet ][ i ] = getValue( DIAG_MRW_Data219 ); i++;
     DIAG__abMRWEepromShadow[ DIAG__bMRWActDataSet ][ i ] = getValue( DIAG_MRW_Data220 ); i++;
     DIAG__abMRWEepromShadow[ DIAG__bMRWActDataSet ][ i ] = getValue( DIAG_MRW_Data221 ); i++;
     DIAG__abMRWEepromShadow[ DIAG__bMRWActDataSet ][ i ] = getValue( DIAG_MRW_Data222 ); i++;
     DIAG__abMRWEepromShadow[ DIAG__bMRWActDataSet ][ i ] = getValue( DIAG_MRW_Data223 ); i++;
     DIAG__abMRWEepromShadow[ DIAG__bMRWActDataSet ][ i ] = getValue( DIAG_MRW_Data224 ); i++;
     DIAG__abMRWEepromShadow[ DIAG__bMRWActDataSet ][ i ] = getValue( DIAG_MRW_Data225 ); i++;
     DIAG__abMRWEepromShadow[ DIAG__bMRWActDataSet ][ i ] = getValue( DIAG_MRW_Data226 ); i++;
     DIAG__abMRWEepromShadow[ DIAG__bMRWActDataSet ][ i ] = getValue( DIAG_MRW_Data227 ); i++;
     DIAG__abMRWEepromShadow[ DIAG__bMRWActDataSet ][ i ] = getValue( DIAG_MRW_Data228 ); i++;
     DIAG__abMRWEepromShadow[ DIAG__bMRWActDataSet ][ i ] = getValue( DIAG_MRW_Data229 ); i++;
     DIAG__abMRWEepromShadow[ DIAG__bMRWActDataSet ][ i ] = getValue( DIAG_MRW_Data230 ); i++;
     DIAG__abMRWEepromShadow[ DIAG__bMRWActDataSet ][ i ] = getValue( DIAG_MRW_Data231 ); i++;
     DIAG__abMRWEepromShadow[ DIAG__bMRWActDataSet ][ i ] = getValue( DIAG_MRW_Data232 ); i++;
     DIAG__abMRWEepromShadow[ DIAG__bMRWActDataSet ][ i ] = getValue( DIAG_MRW_Data233 ); i++;
     DIAG__abMRWEepromShadow[ DIAG__bMRWActDataSet ][ i ] = getValue( DIAG_MRW_Data234 ); i++;
     DIAG__abMRWEepromShadow[ DIAG__bMRWActDataSet ][ i ] = getValue( DIAG_MRW_Data235 ); i++;
     DIAG__abMRWEepromShadow[ DIAG__bMRWActDataSet ][ i ] = getValue( DIAG_MRW_Data236 ); i++;
     DIAG__abMRWEepromShadow[ DIAG__bMRWActDataSet ][ i ] = getValue( DIAG_MRW_Data237 ); i++;
     DIAG__abMRWEepromShadow[ DIAG__bMRWActDataSet ][ i ] = getValue( DIAG_MRW_Data238 ); i++;
     DIAG__abMRWEepromShadow[ DIAG__bMRWActDataSet ][ i ] = getValue( DIAG_MRW_Data239 ); i++;
     DIAG__abMRWEepromShadow[ DIAG__bMRWActDataSet ][ i ] = getValue( DIAG_MRW_Data240 ); i++;
     DIAG__abMRWEepromShadow[ DIAG__bMRWActDataSet ][ i ] = getValue( DIAG_MRW_Data241 ); i++;
     DIAG__abMRWEepromShadow[ DIAG__bMRWActDataSet ][ i ] = getValue( DIAG_MRW_Data242 ); i++;
     DIAG__abMRWEepromShadow[ DIAG__bMRWActDataSet ][ i ] = getValue( DIAG_MRW_Data243 ); i++;
     DIAG__abMRWEepromShadow[ DIAG__bMRWActDataSet ][ i ] = getValue( DIAG_MRW_Data244 ); i++;
     DIAG__abMRWEepromShadow[ DIAG__bMRWActDataSet ][ i ] = getValue( DIAG_MRW_Data245 ); i++;
     DIAG__abMRWEepromShadow[ DIAG__bMRWActDataSet ][ i ] = getValue( DIAG_MRW_Data246 ); i++;
     DIAG__abMRWEepromShadow[ DIAG__bMRWActDataSet ][ i ] = getValue( DIAG_MRW_Data247 ); i++;
     DIAG__abMRWEepromShadow[ DIAG__bMRWActDataSet ][ i ] = getValue( DIAG_MRW_Data248 ); i++;
     DIAG__abMRWEepromShadow[ DIAG__bMRWActDataSet ][ i ] = getValue( DIAG_MRW_Data249 ); i++;
     DIAG__abMRWEepromShadow[ DIAG__bMRWActDataSet ][ i ] = getValue( DIAG_MRW_Data250 ); i++;
     DIAG__abMRWEepromShadow[ DIAG__bMRWActDataSet ][ i ] = getValue( DIAG_MRW_Data251 ); i++;
     DIAG__abMRWEepromShadow[ DIAG__bMRWActDataSet ][ i ] = getValue( DIAG_MRW_Data252 ); i++;
     DIAG__abMRWEepromShadow[ DIAG__bMRWActDataSet ][ i ] = getValue( DIAG_MRW_Data253 ); i++;
     DIAG__abMRWEepromShadow[ DIAG__bMRWActDataSet ][ i ] = getValue( DIAG_MRW_Data254 ); i++;
     DIAG__abMRWEepromShadow[ DIAG__bMRWActDataSet ][ i ] = getValue( DIAG_MRW_Data255 ); i++;
}

void MRW_vCopyRecDataToShadow( int iNumberOfBytes )
{
    int i;

    for ( i = 0; i < ( iNumberOfBytes -1 ); i++ )
    {
        DIAG__abMRWEepromShadow[ DIAG__bMRWActDataSet ][ DIAG__iMRWActShadowPosition ] = rsBuf[ i+1 ];
        DIAG__iMRWActShadowPosition++;
    }
}

void MRW_vCopyShadowToEdit( void )
{
    int i;

    i=0;
    putValue( DIAG_MRW_Data000, DIAG__abMRWEepromShadow[ DIAG__bMRWActDataSet ][ i ] ); i++;
    putValue( DIAG_MRW_Data001, DIAG__abMRWEepromShadow[ DIAG__bMRWActDataSet ][ i ] ); i++;
    putValue( DIAG_MRW_Data002, DIAG__abMRWEepromShadow[ DIAG__bMRWActDataSet ][ i ] ); i++;
    putValue( DIAG_MRW_Data003, DIAG__abMRWEepromShadow[ DIAG__bMRWActDataSet ][ i ] ); i++;
    putValue( DIAG_MRW_Data004, DIAG__abMRWEepromShadow[ DIAG__bMRWActDataSet ][ i ] ); i++;
    putValue( DIAG_MRW_Data005, DIAG__abMRWEepromShadow[ DIAG__bMRWActDataSet ][ i ] ); i++;
    putValue( DIAG_MRW_Data006, DIAG__abMRWEepromShadow[ DIAG__bMRWActDataSet ][ i ] ); i++;
    putValue( DIAG_MRW_Data007, DIAG__abMRWEepromShadow[ DIAG__bMRWActDataSet ][ i ] ); i++;
    putValue( DIAG_MRW_Data008, DIAG__abMRWEepromShadow[ DIAG__bMRWActDataSet ][ i ] ); i++;
    putValue( DIAG_MRW_Data009, DIAG__abMRWEepromShadow[ DIAG__bMRWActDataSet ][ i ] ); i++;
    putValue( DIAG_MRW_Data010, DIAG__abMRWEepromShadow[ DIAG__bMRWActDataSet ][ i ] ); i++;
    putValue( DIAG_MRW_Data011, DIAG__abMRWEepromShadow[ DIAG__bMRWActDataSet ][ i ] ); i++;
    putValue( DIAG_MRW_Data012, DIAG__abMRWEepromShadow[ DIAG__bMRWActDataSet ][ i ] ); i++;
    putValue( DIAG_MRW_Data013, DIAG__abMRWEepromShadow[ DIAG__bMRWActDataSet ][ i ] ); i++;
    putValue( DIAG_MRW_Data014, DIAG__abMRWEepromShadow[ DIAG__bMRWActDataSet ][ i ] ); i++;
    putValue( DIAG_MRW_Data015, DIAG__abMRWEepromShadow[ DIAG__bMRWActDataSet ][ i ] ); i++;
    putValue( DIAG_MRW_Data016, DIAG__abMRWEepromShadow[ DIAG__bMRWActDataSet ][ i ] ); i++;
    putValue( DIAG_MRW_Data017, DIAG__abMRWEepromShadow[ DIAG__bMRWActDataSet ][ i ] ); i++;
    putValue( DIAG_MRW_Data018, DIAG__abMRWEepromShadow[ DIAG__bMRWActDataSet ][ i ] ); i++;
    putValue( DIAG_MRW_Data019, DIAG__abMRWEepromShadow[ DIAG__bMRWActDataSet ][ i ] ); i++;
    putValue( DIAG_MRW_Data020, DIAG__abMRWEepromShadow[ DIAG__bMRWActDataSet ][ i ] ); i++;
    putValue( DIAG_MRW_Data021, DIAG__abMRWEepromShadow[ DIAG__bMRWActDataSet ][ i ] ); i++;
    putValue( DIAG_MRW_Data022, DIAG__abMRWEepromShadow[ DIAG__bMRWActDataSet ][ i ] ); i++;
    putValue( DIAG_MRW_Data023, DIAG__abMRWEepromShadow[ DIAG__bMRWActDataSet ][ i ] ); i++;
    putValue( DIAG_MRW_Data024, DIAG__abMRWEepromShadow[ DIAG__bMRWActDataSet ][ i ] ); i++;
    putValue( DIAG_MRW_Data025, DIAG__abMRWEepromShadow[ DIAG__bMRWActDataSet ][ i ] ); i++;
    putValue( DIAG_MRW_Data026, DIAG__abMRWEepromShadow[ DIAG__bMRWActDataSet ][ i ] ); i++;
    putValue( DIAG_MRW_Data027, DIAG__abMRWEepromShadow[ DIAG__bMRWActDataSet ][ i ] ); i++;
    putValue( DIAG_MRW_Data028, DIAG__abMRWEepromShadow[ DIAG__bMRWActDataSet ][ i ] ); i++;
    putValue( DIAG_MRW_Data029, DIAG__abMRWEepromShadow[ DIAG__bMRWActDataSet ][ i ] ); i++;
    putValue( DIAG_MRW_Data030, DIAG__abMRWEepromShadow[ DIAG__bMRWActDataSet ][ i ] ); i++;
    putValue( DIAG_MRW_Data031, DIAG__abMRWEepromShadow[ DIAG__bMRWActDataSet ][ i ] ); i++;
    putValue( DIAG_MRW_Data032, DIAG__abMRWEepromShadow[ DIAG__bMRWActDataSet ][ i ] ); i++;
    putValue( DIAG_MRW_Data033, DIAG__abMRWEepromShadow[ DIAG__bMRWActDataSet ][ i ] ); i++;
    putValue( DIAG_MRW_Data034, DIAG__abMRWEepromShadow[ DIAG__bMRWActDataSet ][ i ] ); i++;
    putValue( DIAG_MRW_Data035, DIAG__abMRWEepromShadow[ DIAG__bMRWActDataSet ][ i ] ); i++;
    putValue( DIAG_MRW_Data036, DIAG__abMRWEepromShadow[ DIAG__bMRWActDataSet ][ i ] ); i++;
    putValue( DIAG_MRW_Data037, DIAG__abMRWEepromShadow[ DIAG__bMRWActDataSet ][ i ] ); i++;
    putValue( DIAG_MRW_Data038, DIAG__abMRWEepromShadow[ DIAG__bMRWActDataSet ][ i ] ); i++;
    putValue( DIAG_MRW_Data039, DIAG__abMRWEepromShadow[ DIAG__bMRWActDataSet ][ i ] ); i++;
    putValue( DIAG_MRW_Data040, DIAG__abMRWEepromShadow[ DIAG__bMRWActDataSet ][ i ] ); i++;
    putValue( DIAG_MRW_Data041, DIAG__abMRWEepromShadow[ DIAG__bMRWActDataSet ][ i ] ); i++;
    putValue( DIAG_MRW_Data042, DIAG__abMRWEepromShadow[ DIAG__bMRWActDataSet ][ i ] ); i++;
    putValue( DIAG_MRW_Data043, DIAG__abMRWEepromShadow[ DIAG__bMRWActDataSet ][ i ] ); i++;
    putValue( DIAG_MRW_Data044, DIAG__abMRWEepromShadow[ DIAG__bMRWActDataSet ][ i ] ); i++;
    putValue( DIAG_MRW_Data045, DIAG__abMRWEepromShadow[ DIAG__bMRWActDataSet ][ i ] ); i++;
    putValue( DIAG_MRW_Data046, DIAG__abMRWEepromShadow[ DIAG__bMRWActDataSet ][ i ] ); i++;
    putValue( DIAG_MRW_Data047, DIAG__abMRWEepromShadow[ DIAG__bMRWActDataSet ][ i ] ); i++;
    putValue( DIAG_MRW_Data048, DIAG__abMRWEepromShadow[ DIAG__bMRWActDataSet ][ i ] ); i++;
    putValue( DIAG_MRW_Data049, DIAG__abMRWEepromShadow[ DIAG__bMRWActDataSet ][ i ] ); i++;
    putValue( DIAG_MRW_Data050, DIAG__abMRWEepromShadow[ DIAG__bMRWActDataSet ][ i ] ); i++;
    putValue( DIAG_MRW_Data051, DIAG__abMRWEepromShadow[ DIAG__bMRWActDataSet ][ i ] ); i++;
    putValue( DIAG_MRW_Data052, DIAG__abMRWEepromShadow[ DIAG__bMRWActDataSet ][ i ] ); i++;
    putValue( DIAG_MRW_Data053, DIAG__abMRWEepromShadow[ DIAG__bMRWActDataSet ][ i ] ); i++;
    putValue( DIAG_MRW_Data054, DIAG__abMRWEepromShadow[ DIAG__bMRWActDataSet ][ i ] ); i++;
    putValue( DIAG_MRW_Data055, DIAG__abMRWEepromShadow[ DIAG__bMRWActDataSet ][ i ] ); i++;
    putValue( DIAG_MRW_Data056, DIAG__abMRWEepromShadow[ DIAG__bMRWActDataSet ][ i ] ); i++;
    putValue( DIAG_MRW_Data057, DIAG__abMRWEepromShadow[ DIAG__bMRWActDataSet ][ i ] ); i++;
    putValue( DIAG_MRW_Data058, DIAG__abMRWEepromShadow[ DIAG__bMRWActDataSet ][ i ] ); i++;
    putValue( DIAG_MRW_Data059, DIAG__abMRWEepromShadow[ DIAG__bMRWActDataSet ][ i ] ); i++;
    putValue( DIAG_MRW_Data060, DIAG__abMRWEepromShadow[ DIAG__bMRWActDataSet ][ i ] ); i++;
    putValue( DIAG_MRW_Data061, DIAG__abMRWEepromShadow[ DIAG__bMRWActDataSet ][ i ] ); i++;
    putValue( DIAG_MRW_Data062, DIAG__abMRWEepromShadow[ DIAG__bMRWActDataSet ][ i ] ); i++;
    putValue( DIAG_MRW_Data063, DIAG__abMRWEepromShadow[ DIAG__bMRWActDataSet ][ i ] ); i++;
    putValue( DIAG_MRW_Data064, DIAG__abMRWEepromShadow[ DIAG__bMRWActDataSet ][ i ] ); i++;
    putValue( DIAG_MRW_Data065, DIAG__abMRWEepromShadow[ DIAG__bMRWActDataSet ][ i ] ); i++;
    putValue( DIAG_MRW_Data066, DIAG__abMRWEepromShadow[ DIAG__bMRWActDataSet ][ i ] ); i++;
    putValue( DIAG_MRW_Data067, DIAG__abMRWEepromShadow[ DIAG__bMRWActDataSet ][ i ] ); i++;
    putValue( DIAG_MRW_Data068, DIAG__abMRWEepromShadow[ DIAG__bMRWActDataSet ][ i ] ); i++;
    putValue( DIAG_MRW_Data069, DIAG__abMRWEepromShadow[ DIAG__bMRWActDataSet ][ i ] ); i++;
    putValue( DIAG_MRW_Data070, DIAG__abMRWEepromShadow[ DIAG__bMRWActDataSet ][ i ] ); i++;
    putValue( DIAG_MRW_Data071, DIAG__abMRWEepromShadow[ DIAG__bMRWActDataSet ][ i ] ); i++;
    putValue( DIAG_MRW_Data072, DIAG__abMRWEepromShadow[ DIAG__bMRWActDataSet ][ i ] ); i++;
    putValue( DIAG_MRW_Data073, DIAG__abMRWEepromShadow[ DIAG__bMRWActDataSet ][ i ] ); i++;
    putValue( DIAG_MRW_Data074, DIAG__abMRWEepromShadow[ DIAG__bMRWActDataSet ][ i ] ); i++;
    putValue( DIAG_MRW_Data075, DIAG__abMRWEepromShadow[ DIAG__bMRWActDataSet ][ i ] ); i++;
    putValue( DIAG_MRW_Data076, DIAG__abMRWEepromShadow[ DIAG__bMRWActDataSet ][ i ] ); i++;
    putValue( DIAG_MRW_Data077, DIAG__abMRWEepromShadow[ DIAG__bMRWActDataSet ][ i ] ); i++;
    putValue( DIAG_MRW_Data078, DIAG__abMRWEepromShadow[ DIAG__bMRWActDataSet ][ i ] ); i++;
    putValue( DIAG_MRW_Data079, DIAG__abMRWEepromShadow[ DIAG__bMRWActDataSet ][ i ] ); i++;
    putValue( DIAG_MRW_Data080, DIAG__abMRWEepromShadow[ DIAG__bMRWActDataSet ][ i ] ); i++;
    putValue( DIAG_MRW_Data081, DIAG__abMRWEepromShadow[ DIAG__bMRWActDataSet ][ i ] ); i++;
    putValue( DIAG_MRW_Data082, DIAG__abMRWEepromShadow[ DIAG__bMRWActDataSet ][ i ] ); i++;
    putValue( DIAG_MRW_Data083, DIAG__abMRWEepromShadow[ DIAG__bMRWActDataSet ][ i ] ); i++;
    putValue( DIAG_MRW_Data084, DIAG__abMRWEepromShadow[ DIAG__bMRWActDataSet ][ i ] ); i++;
    putValue( DIAG_MRW_Data085, DIAG__abMRWEepromShadow[ DIAG__bMRWActDataSet ][ i ] ); i++;
    putValue( DIAG_MRW_Data086, DIAG__abMRWEepromShadow[ DIAG__bMRWActDataSet ][ i ] ); i++;
    putValue( DIAG_MRW_Data087, DIAG__abMRWEepromShadow[ DIAG__bMRWActDataSet ][ i ] ); i++;
    putValue( DIAG_MRW_Data088, DIAG__abMRWEepromShadow[ DIAG__bMRWActDataSet ][ i ] ); i++;
    putValue( DIAG_MRW_Data089, DIAG__abMRWEepromShadow[ DIAG__bMRWActDataSet ][ i ] ); i++;
    putValue( DIAG_MRW_Data090, DIAG__abMRWEepromShadow[ DIAG__bMRWActDataSet ][ i ] ); i++;
    putValue( DIAG_MRW_Data091, DIAG__abMRWEepromShadow[ DIAG__bMRWActDataSet ][ i ] ); i++;
    putValue( DIAG_MRW_Data092, DIAG__abMRWEepromShadow[ DIAG__bMRWActDataSet ][ i ] ); i++;
    putValue( DIAG_MRW_Data093, DIAG__abMRWEepromShadow[ DIAG__bMRWActDataSet ][ i ] ); i++;
    putValue( DIAG_MRW_Data094, DIAG__abMRWEepromShadow[ DIAG__bMRWActDataSet ][ i ] ); i++;
    putValue( DIAG_MRW_Data095, DIAG__abMRWEepromShadow[ DIAG__bMRWActDataSet ][ i ] ); i++;
    putValue( DIAG_MRW_Data096, DIAG__abMRWEepromShadow[ DIAG__bMRWActDataSet ][ i ] ); i++;
    putValue( DIAG_MRW_Data097, DIAG__abMRWEepromShadow[ DIAG__bMRWActDataSet ][ i ] ); i++;
    putValue( DIAG_MRW_Data098, DIAG__abMRWEepromShadow[ DIAG__bMRWActDataSet ][ i ] ); i++;
    putValue( DIAG_MRW_Data099, DIAG__abMRWEepromShadow[ DIAG__bMRWActDataSet ][ i ] ); i++;
    putValue( DIAG_MRW_Data100, DIAG__abMRWEepromShadow[ DIAG__bMRWActDataSet ][ i ] ); i++;
    putValue( DIAG_MRW_Data101, DIAG__abMRWEepromShadow[ DIAG__bMRWActDataSet ][ i ] ); i++;
    putValue( DIAG_MRW_Data102, DIAG__abMRWEepromShadow[ DIAG__bMRWActDataSet ][ i ] ); i++;
    putValue( DIAG_MRW_Data103, DIAG__abMRWEepromShadow[ DIAG__bMRWActDataSet ][ i ] ); i++;
    putValue( DIAG_MRW_Data104, DIAG__abMRWEepromShadow[ DIAG__bMRWActDataSet ][ i ] ); i++;
    putValue( DIAG_MRW_Data105, DIAG__abMRWEepromShadow[ DIAG__bMRWActDataSet ][ i ] ); i++;
    putValue( DIAG_MRW_Data106, DIAG__abMRWEepromShadow[ DIAG__bMRWActDataSet ][ i ] ); i++;
    putValue( DIAG_MRW_Data107, DIAG__abMRWEepromShadow[ DIAG__bMRWActDataSet ][ i ] ); i++;
    putValue( DIAG_MRW_Data108, DIAG__abMRWEepromShadow[ DIAG__bMRWActDataSet ][ i ] ); i++;
    putValue( DIAG_MRW_Data109, DIAG__abMRWEepromShadow[ DIAG__bMRWActDataSet ][ i ] ); i++;
    putValue( DIAG_MRW_Data110, DIAG__abMRWEepromShadow[ DIAG__bMRWActDataSet ][ i ] ); i++;
    putValue( DIAG_MRW_Data111, DIAG__abMRWEepromShadow[ DIAG__bMRWActDataSet ][ i ] ); i++;
    putValue( DIAG_MRW_Data112, DIAG__abMRWEepromShadow[ DIAG__bMRWActDataSet ][ i ] ); i++;
    putValue( DIAG_MRW_Data113, DIAG__abMRWEepromShadow[ DIAG__bMRWActDataSet ][ i ] ); i++;
    putValue( DIAG_MRW_Data114, DIAG__abMRWEepromShadow[ DIAG__bMRWActDataSet ][ i ] ); i++;
    putValue( DIAG_MRW_Data115, DIAG__abMRWEepromShadow[ DIAG__bMRWActDataSet ][ i ] ); i++;
    putValue( DIAG_MRW_Data116, DIAG__abMRWEepromShadow[ DIAG__bMRWActDataSet ][ i ] ); i++;
    putValue( DIAG_MRW_Data117, DIAG__abMRWEepromShadow[ DIAG__bMRWActDataSet ][ i ] ); i++;
    putValue( DIAG_MRW_Data118, DIAG__abMRWEepromShadow[ DIAG__bMRWActDataSet ][ i ] ); i++;
    putValue( DIAG_MRW_Data119, DIAG__abMRWEepromShadow[ DIAG__bMRWActDataSet ][ i ] ); i++;
    putValue( DIAG_MRW_Data120, DIAG__abMRWEepromShadow[ DIAG__bMRWActDataSet ][ i ] ); i++;
    putValue( DIAG_MRW_Data121, DIAG__abMRWEepromShadow[ DIAG__bMRWActDataSet ][ i ] ); i++;
    putValue( DIAG_MRW_Data122, DIAG__abMRWEepromShadow[ DIAG__bMRWActDataSet ][ i ] ); i++;
    putValue( DIAG_MRW_Data123, DIAG__abMRWEepromShadow[ DIAG__bMRWActDataSet ][ i ] ); i++;
    putValue( DIAG_MRW_Data124, DIAG__abMRWEepromShadow[ DIAG__bMRWActDataSet ][ i ] ); i++;
    putValue( DIAG_MRW_Data125, DIAG__abMRWEepromShadow[ DIAG__bMRWActDataSet ][ i ] ); i++;
    putValue( DIAG_MRW_Data126, DIAG__abMRWEepromShadow[ DIAG__bMRWActDataSet ][ i ] ); i++;
    putValue( DIAG_MRW_Data127, DIAG__abMRWEepromShadow[ DIAG__bMRWActDataSet ][ i ] ); i++;
    putValue( DIAG_MRW_Data128, DIAG__abMRWEepromShadow[ DIAG__bMRWActDataSet ][ i ] ); i++;
    putValue( DIAG_MRW_Data129, DIAG__abMRWEepromShadow[ DIAG__bMRWActDataSet ][ i ] ); i++;
    putValue( DIAG_MRW_Data130, DIAG__abMRWEepromShadow[ DIAG__bMRWActDataSet ][ i ] ); i++;
    putValue( DIAG_MRW_Data131, DIAG__abMRWEepromShadow[ DIAG__bMRWActDataSet ][ i ] ); i++;
    putValue( DIAG_MRW_Data132, DIAG__abMRWEepromShadow[ DIAG__bMRWActDataSet ][ i ] ); i++;
    putValue( DIAG_MRW_Data133, DIAG__abMRWEepromShadow[ DIAG__bMRWActDataSet ][ i ] ); i++;
    putValue( DIAG_MRW_Data134, DIAG__abMRWEepromShadow[ DIAG__bMRWActDataSet ][ i ] ); i++;
    putValue( DIAG_MRW_Data135, DIAG__abMRWEepromShadow[ DIAG__bMRWActDataSet ][ i ] ); i++;
    putValue( DIAG_MRW_Data136, DIAG__abMRWEepromShadow[ DIAG__bMRWActDataSet ][ i ] ); i++;
    putValue( DIAG_MRW_Data137, DIAG__abMRWEepromShadow[ DIAG__bMRWActDataSet ][ i ] ); i++;
    putValue( DIAG_MRW_Data138, DIAG__abMRWEepromShadow[ DIAG__bMRWActDataSet ][ i ] ); i++;
    putValue( DIAG_MRW_Data139, DIAG__abMRWEepromShadow[ DIAG__bMRWActDataSet ][ i ] ); i++;
    putValue( DIAG_MRW_Data140, DIAG__abMRWEepromShadow[ DIAG__bMRWActDataSet ][ i ] ); i++;
    putValue( DIAG_MRW_Data141, DIAG__abMRWEepromShadow[ DIAG__bMRWActDataSet ][ i ] ); i++;
    putValue( DIAG_MRW_Data142, DIAG__abMRWEepromShadow[ DIAG__bMRWActDataSet ][ i ] ); i++;
    putValue( DIAG_MRW_Data143, DIAG__abMRWEepromShadow[ DIAG__bMRWActDataSet ][ i ] ); i++;
    putValue( DIAG_MRW_Data144, DIAG__abMRWEepromShadow[ DIAG__bMRWActDataSet ][ i ] ); i++;
    putValue( DIAG_MRW_Data145, DIAG__abMRWEepromShadow[ DIAG__bMRWActDataSet ][ i ] ); i++;
    putValue( DIAG_MRW_Data146, DIAG__abMRWEepromShadow[ DIAG__bMRWActDataSet ][ i ] ); i++;
    putValue( DIAG_MRW_Data147, DIAG__abMRWEepromShadow[ DIAG__bMRWActDataSet ][ i ] ); i++;
    putValue( DIAG_MRW_Data148, DIAG__abMRWEepromShadow[ DIAG__bMRWActDataSet ][ i ] ); i++;
    putValue( DIAG_MRW_Data149, DIAG__abMRWEepromShadow[ DIAG__bMRWActDataSet ][ i ] ); i++;
    putValue( DIAG_MRW_Data150, DIAG__abMRWEepromShadow[ DIAG__bMRWActDataSet ][ i ] ); i++;
    putValue( DIAG_MRW_Data151, DIAG__abMRWEepromShadow[ DIAG__bMRWActDataSet ][ i ] ); i++;
    putValue( DIAG_MRW_Data152, DIAG__abMRWEepromShadow[ DIAG__bMRWActDataSet ][ i ] ); i++;
    putValue( DIAG_MRW_Data153, DIAG__abMRWEepromShadow[ DIAG__bMRWActDataSet ][ i ] ); i++;
    putValue( DIAG_MRW_Data154, DIAG__abMRWEepromShadow[ DIAG__bMRWActDataSet ][ i ] ); i++;
    putValue( DIAG_MRW_Data155, DIAG__abMRWEepromShadow[ DIAG__bMRWActDataSet ][ i ] ); i++;
    putValue( DIAG_MRW_Data156, DIAG__abMRWEepromShadow[ DIAG__bMRWActDataSet ][ i ] ); i++;
    putValue( DIAG_MRW_Data157, DIAG__abMRWEepromShadow[ DIAG__bMRWActDataSet ][ i ] ); i++;
    putValue( DIAG_MRW_Data158, DIAG__abMRWEepromShadow[ DIAG__bMRWActDataSet ][ i ] ); i++;
    putValue( DIAG_MRW_Data159, DIAG__abMRWEepromShadow[ DIAG__bMRWActDataSet ][ i ] ); i++;
    putValue( DIAG_MRW_Data160, DIAG__abMRWEepromShadow[ DIAG__bMRWActDataSet ][ i ] ); i++;
    putValue( DIAG_MRW_Data161, DIAG__abMRWEepromShadow[ DIAG__bMRWActDataSet ][ i ] ); i++;
    putValue( DIAG_MRW_Data162, DIAG__abMRWEepromShadow[ DIAG__bMRWActDataSet ][ i ] ); i++;
    putValue( DIAG_MRW_Data163, DIAG__abMRWEepromShadow[ DIAG__bMRWActDataSet ][ i ] ); i++;
    putValue( DIAG_MRW_Data164, DIAG__abMRWEepromShadow[ DIAG__bMRWActDataSet ][ i ] ); i++;
    putValue( DIAG_MRW_Data165, DIAG__abMRWEepromShadow[ DIAG__bMRWActDataSet ][ i ] ); i++;
    putValue( DIAG_MRW_Data166, DIAG__abMRWEepromShadow[ DIAG__bMRWActDataSet ][ i ] ); i++;
    putValue( DIAG_MRW_Data167, DIAG__abMRWEepromShadow[ DIAG__bMRWActDataSet ][ i ] ); i++;
    putValue( DIAG_MRW_Data168, DIAG__abMRWEepromShadow[ DIAG__bMRWActDataSet ][ i ] ); i++;
    putValue( DIAG_MRW_Data169, DIAG__abMRWEepromShadow[ DIAG__bMRWActDataSet ][ i ] ); i++;
    putValue( DIAG_MRW_Data170, DIAG__abMRWEepromShadow[ DIAG__bMRWActDataSet ][ i ] ); i++;
    putValue( DIAG_MRW_Data171, DIAG__abMRWEepromShadow[ DIAG__bMRWActDataSet ][ i ] ); i++;
    putValue( DIAG_MRW_Data172, DIAG__abMRWEepromShadow[ DIAG__bMRWActDataSet ][ i ] ); i++;
    putValue( DIAG_MRW_Data173, DIAG__abMRWEepromShadow[ DIAG__bMRWActDataSet ][ i ] ); i++;
    putValue( DIAG_MRW_Data174, DIAG__abMRWEepromShadow[ DIAG__bMRWActDataSet ][ i ] ); i++;
    putValue( DIAG_MRW_Data175, DIAG__abMRWEepromShadow[ DIAG__bMRWActDataSet ][ i ] ); i++;
    putValue( DIAG_MRW_Data176, DIAG__abMRWEepromShadow[ DIAG__bMRWActDataSet ][ i ] ); i++;
    putValue( DIAG_MRW_Data177, DIAG__abMRWEepromShadow[ DIAG__bMRWActDataSet ][ i ] ); i++;
    putValue( DIAG_MRW_Data178, DIAG__abMRWEepromShadow[ DIAG__bMRWActDataSet ][ i ] ); i++;
    putValue( DIAG_MRW_Data179, DIAG__abMRWEepromShadow[ DIAG__bMRWActDataSet ][ i ] ); i++;
    putValue( DIAG_MRW_Data180, DIAG__abMRWEepromShadow[ DIAG__bMRWActDataSet ][ i ] ); i++;
    putValue( DIAG_MRW_Data181, DIAG__abMRWEepromShadow[ DIAG__bMRWActDataSet ][ i ] ); i++;
    putValue( DIAG_MRW_Data182, DIAG__abMRWEepromShadow[ DIAG__bMRWActDataSet ][ i ] ); i++;
    putValue( DIAG_MRW_Data183, DIAG__abMRWEepromShadow[ DIAG__bMRWActDataSet ][ i ] ); i++;
    putValue( DIAG_MRW_Data184, DIAG__abMRWEepromShadow[ DIAG__bMRWActDataSet ][ i ] ); i++;
    putValue( DIAG_MRW_Data185, DIAG__abMRWEepromShadow[ DIAG__bMRWActDataSet ][ i ] ); i++;
    putValue( DIAG_MRW_Data186, DIAG__abMRWEepromShadow[ DIAG__bMRWActDataSet ][ i ] ); i++;
    putValue( DIAG_MRW_Data187, DIAG__abMRWEepromShadow[ DIAG__bMRWActDataSet ][ i ] ); i++;
    putValue( DIAG_MRW_Data188, DIAG__abMRWEepromShadow[ DIAG__bMRWActDataSet ][ i ] ); i++;
    putValue( DIAG_MRW_Data189, DIAG__abMRWEepromShadow[ DIAG__bMRWActDataSet ][ i ] ); i++;
    putValue( DIAG_MRW_Data190, DIAG__abMRWEepromShadow[ DIAG__bMRWActDataSet ][ i ] ); i++;
    putValue( DIAG_MRW_Data191, DIAG__abMRWEepromShadow[ DIAG__bMRWActDataSet ][ i ] ); i++;
    putValue( DIAG_MRW_Data192, DIAG__abMRWEepromShadow[ DIAG__bMRWActDataSet ][ i ] ); i++;
    putValue( DIAG_MRW_Data193, DIAG__abMRWEepromShadow[ DIAG__bMRWActDataSet ][ i ] ); i++;
    putValue( DIAG_MRW_Data194, DIAG__abMRWEepromShadow[ DIAG__bMRWActDataSet ][ i ] ); i++;
    putValue( DIAG_MRW_Data195, DIAG__abMRWEepromShadow[ DIAG__bMRWActDataSet ][ i ] ); i++;
    putValue( DIAG_MRW_Data196, DIAG__abMRWEepromShadow[ DIAG__bMRWActDataSet ][ i ] ); i++;
    putValue( DIAG_MRW_Data197, DIAG__abMRWEepromShadow[ DIAG__bMRWActDataSet ][ i ] ); i++;
    putValue( DIAG_MRW_Data198, DIAG__abMRWEepromShadow[ DIAG__bMRWActDataSet ][ i ] ); i++;
    putValue( DIAG_MRW_Data199, DIAG__abMRWEepromShadow[ DIAG__bMRWActDataSet ][ i ] ); i++;
    putValue( DIAG_MRW_Data200, DIAG__abMRWEepromShadow[ DIAG__bMRWActDataSet ][ i ] ); i++;
    putValue( DIAG_MRW_Data201, DIAG__abMRWEepromShadow[ DIAG__bMRWActDataSet ][ i ] ); i++;
    putValue( DIAG_MRW_Data202, DIAG__abMRWEepromShadow[ DIAG__bMRWActDataSet ][ i ] ); i++;
    putValue( DIAG_MRW_Data203, DIAG__abMRWEepromShadow[ DIAG__bMRWActDataSet ][ i ] ); i++;
    putValue( DIAG_MRW_Data204, DIAG__abMRWEepromShadow[ DIAG__bMRWActDataSet ][ i ] ); i++;
    putValue( DIAG_MRW_Data205, DIAG__abMRWEepromShadow[ DIAG__bMRWActDataSet ][ i ] ); i++;
    putValue( DIAG_MRW_Data206, DIAG__abMRWEepromShadow[ DIAG__bMRWActDataSet ][ i ] ); i++;
    putValue( DIAG_MRW_Data207, DIAG__abMRWEepromShadow[ DIAG__bMRWActDataSet ][ i ] ); i++;
    putValue( DIAG_MRW_Data208, DIAG__abMRWEepromShadow[ DIAG__bMRWActDataSet ][ i ] ); i++;
    putValue( DIAG_MRW_Data209, DIAG__abMRWEepromShadow[ DIAG__bMRWActDataSet ][ i ] ); i++;
    putValue( DIAG_MRW_Data210, DIAG__abMRWEepromShadow[ DIAG__bMRWActDataSet ][ i ] ); i++;
    putValue( DIAG_MRW_Data211, DIAG__abMRWEepromShadow[ DIAG__bMRWActDataSet ][ i ] ); i++;
    putValue( DIAG_MRW_Data212, DIAG__abMRWEepromShadow[ DIAG__bMRWActDataSet ][ i ] ); i++;
    putValue( DIAG_MRW_Data213, DIAG__abMRWEepromShadow[ DIAG__bMRWActDataSet ][ i ] ); i++;
    putValue( DIAG_MRW_Data214, DIAG__abMRWEepromShadow[ DIAG__bMRWActDataSet ][ i ] ); i++;
    putValue( DIAG_MRW_Data215, DIAG__abMRWEepromShadow[ DIAG__bMRWActDataSet ][ i ] ); i++;
    putValue( DIAG_MRW_Data216, DIAG__abMRWEepromShadow[ DIAG__bMRWActDataSet ][ i ] ); i++;
    putValue( DIAG_MRW_Data217, DIAG__abMRWEepromShadow[ DIAG__bMRWActDataSet ][ i ] ); i++;
    putValue( DIAG_MRW_Data218, DIAG__abMRWEepromShadow[ DIAG__bMRWActDataSet ][ i ] ); i++;
    putValue( DIAG_MRW_Data219, DIAG__abMRWEepromShadow[ DIAG__bMRWActDataSet ][ i ] ); i++;
    putValue( DIAG_MRW_Data220, DIAG__abMRWEepromShadow[ DIAG__bMRWActDataSet ][ i ] ); i++;
    putValue( DIAG_MRW_Data221, DIAG__abMRWEepromShadow[ DIAG__bMRWActDataSet ][ i ] ); i++;
    putValue( DIAG_MRW_Data222, DIAG__abMRWEepromShadow[ DIAG__bMRWActDataSet ][ i ] ); i++;
    putValue( DIAG_MRW_Data223, DIAG__abMRWEepromShadow[ DIAG__bMRWActDataSet ][ i ] ); i++;
    putValue( DIAG_MRW_Data224, DIAG__abMRWEepromShadow[ DIAG__bMRWActDataSet ][ i ] ); i++;
    putValue( DIAG_MRW_Data225, DIAG__abMRWEepromShadow[ DIAG__bMRWActDataSet ][ i ] ); i++;
    putValue( DIAG_MRW_Data226, DIAG__abMRWEepromShadow[ DIAG__bMRWActDataSet ][ i ] ); i++;
    putValue( DIAG_MRW_Data227, DIAG__abMRWEepromShadow[ DIAG__bMRWActDataSet ][ i ] ); i++;
    putValue( DIAG_MRW_Data228, DIAG__abMRWEepromShadow[ DIAG__bMRWActDataSet ][ i ] ); i++;
    putValue( DIAG_MRW_Data229, DIAG__abMRWEepromShadow[ DIAG__bMRWActDataSet ][ i ] ); i++;
    putValue( DIAG_MRW_Data230, DIAG__abMRWEepromShadow[ DIAG__bMRWActDataSet ][ i ] ); i++;
    putValue( DIAG_MRW_Data231, DIAG__abMRWEepromShadow[ DIAG__bMRWActDataSet ][ i ] ); i++;
    putValue( DIAG_MRW_Data232, DIAG__abMRWEepromShadow[ DIAG__bMRWActDataSet ][ i ] ); i++;
    putValue( DIAG_MRW_Data233, DIAG__abMRWEepromShadow[ DIAG__bMRWActDataSet ][ i ] ); i++;
    putValue( DIAG_MRW_Data234, DIAG__abMRWEepromShadow[ DIAG__bMRWActDataSet ][ i ] ); i++;
    putValue( DIAG_MRW_Data235, DIAG__abMRWEepromShadow[ DIAG__bMRWActDataSet ][ i ] ); i++;
    putValue( DIAG_MRW_Data236, DIAG__abMRWEepromShadow[ DIAG__bMRWActDataSet ][ i ] ); i++;
    putValue( DIAG_MRW_Data237, DIAG__abMRWEepromShadow[ DIAG__bMRWActDataSet ][ i ] ); i++;
    putValue( DIAG_MRW_Data238, DIAG__abMRWEepromShadow[ DIAG__bMRWActDataSet ][ i ] ); i++;
    putValue( DIAG_MRW_Data239, DIAG__abMRWEepromShadow[ DIAG__bMRWActDataSet ][ i ] ); i++;
    putValue( DIAG_MRW_Data240, DIAG__abMRWEepromShadow[ DIAG__bMRWActDataSet ][ i ] ); i++;
    putValue( DIAG_MRW_Data241, DIAG__abMRWEepromShadow[ DIAG__bMRWActDataSet ][ i ] ); i++;
    putValue( DIAG_MRW_Data242, DIAG__abMRWEepromShadow[ DIAG__bMRWActDataSet ][ i ] ); i++;
    putValue( DIAG_MRW_Data243, DIAG__abMRWEepromShadow[ DIAG__bMRWActDataSet ][ i ] ); i++;
    putValue( DIAG_MRW_Data244, DIAG__abMRWEepromShadow[ DIAG__bMRWActDataSet ][ i ] ); i++;
    putValue( DIAG_MRW_Data245, DIAG__abMRWEepromShadow[ DIAG__bMRWActDataSet ][ i ] ); i++;
    putValue( DIAG_MRW_Data246, DIAG__abMRWEepromShadow[ DIAG__bMRWActDataSet ][ i ] ); i++;
    putValue( DIAG_MRW_Data247, DIAG__abMRWEepromShadow[ DIAG__bMRWActDataSet ][ i ] ); i++;
    putValue( DIAG_MRW_Data248, DIAG__abMRWEepromShadow[ DIAG__bMRWActDataSet ][ i ] ); i++;
    putValue( DIAG_MRW_Data249, DIAG__abMRWEepromShadow[ DIAG__bMRWActDataSet ][ i ] ); i++;
    putValue( DIAG_MRW_Data250, DIAG__abMRWEepromShadow[ DIAG__bMRWActDataSet ][ i ] ); i++;
    putValue( DIAG_MRW_Data251, DIAG__abMRWEepromShadow[ DIAG__bMRWActDataSet ][ i ] ); i++;
    putValue( DIAG_MRW_Data252, DIAG__abMRWEepromShadow[ DIAG__bMRWActDataSet ][ i ] ); i++;
    putValue( DIAG_MRW_Data253, DIAG__abMRWEepromShadow[ DIAG__bMRWActDataSet ][ i ] ); i++;
    putValue( DIAG_MRW_Data254, DIAG__abMRWEepromShadow[ DIAG__bMRWActDataSet ][ i ] ); i++;
    putValue( DIAG_MRW_Data255, DIAG__abMRWEepromShadow[ DIAG__bMRWActDataSet ][ i ] ); i++;
}

void MRW_vPutStatusText(char cText[])
{
     putValue( DIAG_MRW_StatusBar, cText );
}

void MRW_vRcdWriteMemAddr(long lNumberOfBytes )
{
    char acStatusText[100];

    if( DIAG__iMRWMissingBytes > 0)
    {
        snprintf( acStatusText,100, "DATA BYTES TO WRITE: %3d",DIAG__iMRWMissingBytes );
        MRW_vReadFilePutStatusText( acStatusText );
        MRW_vSendNextWriteMemAddr();
    }
    else
    {   /* all bytes read */
        cancelTimer( tMRW_TimeoutTimer );
        putValue( DIAG_Main_ErrorStatus, "" );
        MRW_vReadFilePutStatusText("WRITING SUCCESSFUL" );
        bQueueWaitForResponce = FALSE;
        DIAG__iMRWActEepromWriteState =     OFF;
    }
}

void MRW_vReadFileIncrementLifeCount ( byte bMode )
{
    switch( bMode )
    {
        case 0:    DIAG__iReadFileLifeCount = 0;      break;
        case 1:    if( DIAG__iReadFileLifeCount < 2 )
                       DIAG__iReadFileLifeCount++;
                   else
                       DIAG__iReadFileLifeCount = 0;
                   break;
        default:   DIAG__iReadFileLifeCount = 0;      break;
    }
    putValue( DIAG_MRW_ReadFileLife, DIAG__iReadFileLifeCount );
}

void MRW_vReadFilePressed (void)
{
     char cFileName[270];
     char cFilePath[250];
     char cHelp[270];
     long lResult;
     int iFileDialog;
     int i,j;

     iFileDialog = 1;
     
     if( !iFileDialog )
     {
          getValue( DIAG_MRW_ReadFilePathName, cFilePath);
          getValue( DIAG_MRW_ReadFileFileName, cFileName );
     }
     else
     {
          getValue( DIAG_MRW_ReadFileDialog, cHelp );
          // cFilePath bestimmen
          for( i=elCount(cHelp)-1; i>0; i--)
          {
               if(cHelp[i] == '\\')
               {
                    strncpy(cFilePath, cHelp, i+2 );
                    j=0;
                    i++;
                    for( ; i<80; i++)
                         cFileName[j++] = cHelp[i];
                    break;
               }
          }
     }

     setWritePath( cFilePath );
          
     DIAG__lReadFileRxFrameCount = 0;
     DIAG__lReadFileFileHandle = OpenFileWrite ( cFileName, 1 );//open for write, existing file will be deleted
     if(  DIAG__lReadFileFileHandle !=0 ) 
     {
          fileClose ( DIAG__lReadFileFileHandle );

          DIAG__lReadFileFileHandle = OpenFileWrite ( cFileName, 3 );//existing file will be appended
          if(  DIAG__lReadFileFileHandle != 0 ) 
          {
               MRW_vReadFilePutStatusText( "FILE OPENED" );
               DIAG__dwReadFileStartAddress = getValue( DIAG_MRW_ReadFileStartAddress );
               DIAG__dwReadFileStartAddress = DIAG__dwReadFileStartAddress + DIAG__cdwMRWStartAdr_AC_EEP_FEE;
               DIAG__dwReadFileActAddress = DIAG__dwReadFileStartAddress;
               DIAG__dwReadFileEndAddress = DIAG__dwReadFileStartAddress + getValue( DIAG_MRW_ReadFileDataLength );
               if( DIAG__dwReadFileActAddress <= DIAG__dwReadFileEndAddress )
               {
                    if(( DIAG__dwReadFileActAddress + NB_READ_WRITE ) <= DIAG__dwReadFileEndAddress )
                    {
                         DIAG__bReadFileActDataLen =  NB_READ_WRITE;
                    }
                    else
                    {
                         DIAG__bReadFileActDataLen = ( byte )( DIAG__dwReadFileEndAddress - DIAG__dwReadFileActAddress );
                    }
                    MRW_vReadFileReqNextLine( DIAG__dwReadFileActAddress, DIAG__bReadFileActDataLen );
                    MRW_vReadFilePutStatusText ("START READING DATA" );
               }
               else
               {
                    //if( DEBUG) {write("ERROR StartAddress not in first part of EEPROM" );}
               }
          }
          else
          {
               MRW_vReadFilePutStatusText ("ERROR: NOT ABLE TO OPEN FILE" );
               bQueueWaitForResponce = FALSE;
               fileClose ( DIAG__lReadFileFileHandle );
          }
     }
     else
     {
          MRW_vReadFilePutStatusText ("ERROR: NOT ABLE TO OPEN FILE" );
          bQueueWaitForResponce = FALSE;
          fileClose ( DIAG__lReadFileFileHandle );
     }
}

void MRW_vReadFilePutStatusText( char cText[] )
{
    putValue( DIAG_MRW_ReadFileStatusBar, cText );
}

void MRW_vReadFileRcvdReadMemAddr( int iNumberOfBytes )
{
     int i;
     byte bResult;
     byte abLineData[1+2+1+NB_READ_WRITE+1];
     char cHelp[80];
     byte acLineData[(2*(1+2+1+NB_READ_WRITE+1) )+3];
     byte bFirstChar;
     byte bSeconChar;
     byte bEOF[11]={0x3A,0x30,0x30,0x30,0x30,0x30,0x30,0x30,0x31,0x46,0x46};
     dword dwCheckSum;

     DIAG__iMRWActEepromReadState = OFF;
     DIAG__lReadFileRxFrameCount ++;
     DIAG__iReadFileLifeCount++;

     abLineData[0] = DIAG__bReadFileActDataLen;                                         /* LENGTH           */
     abLineData[1] = ( byte ) (( DIAG__dwReadFileActAddress & 0x0000FF00) >> 8);      /* ADDRESS HIGH */
     abLineData[2] = ( byte )  ( DIAG__dwReadFileActAddress & 0x000000FF );           /* ADDRESS LOW      */
     abLineData[3] = 0x00;                                                                 /* MODE           */
     
     //copy data from buffer to byte array of line
     for ( i=0;i < DIAG__bReadFileActDataLen;i++)
     {
          abLineData[4+i] = rsBuf[i+1];                                                 /* DATA           */
     }

     //calculate check sum
     dwCheckSum = 0;
     for( i=0;i<(1+2+1+DIAG__bReadFileActDataLen );i++)
     {
          dwCheckSum += abLineData[i];
     }
     dwCheckSum = dwCheckSum%256;
     dwCheckSum = 256 - dwCheckSum;

     //copy checksum to byte array of line
     abLineData[1+2+1+ DIAG__bReadFileActDataLen ] = ( byte )dwCheckSum;               /* CHECK SUM      */
     
     //clear ASCII line
     for( i=0; i < ((2*(1+2+1+NB_READ_WRITE+1) )+2 );i++)
     {
          acLineData[i] = 0x00;
     }

     //create line in ASCII
    acLineData[0] = ':';
    for( i=0; i < (1+2+1+DIAG__bReadFileActDataLen+1);i++)
    {
        bFirstChar = (( abLineData[i] & 0xF0)>>4);
        bSeconChar =  ( abLineData[i] & 0x0F );
        if(( bFirstChar >= 0) && ( bFirstChar <= 9) )
            acLineData[(2*i)+1] = bFirstChar + 0x30;
        else
            acLineData[(2*i)+1] = ( bFirstChar - 0x0A) + 0x41;
        if(( bSeconChar >= 0) && ( bSeconChar <= 9) )
            acLineData[(2*i)+2] = bSeconChar + 0x30;
        else
            acLineData[(2*i)+2] = ( bSeconChar - 0x0A) + 0x41;
    }
    acLineData[(2*(1+2+1+NB_READ_WRITE+1) )+1] = 0x0D;
    acLineData[(2*(1+2+1+NB_READ_WRITE+1) )+2] = 0x0A;
    fileWriteBinaryBlock ( acLineData, elCount( acLineData), DIAG__lReadFileFileHandle );
    snprintf(cHelp,elCount(cHelp), "FRAME RECEIVED: %3d", DIAG__lReadFileRxFrameCount );
    MRW_vReadFilePutStatusText( cHelp );
    bResult = MRW_bReadFileCalcNextAddr();
    if( bResult > 0)
    {
        if( bResult == 1 )
        {
            MRW_vReadFileReqNextLine( DIAG__dwReadFileActAddress, DIAG__bReadFileActDataLen );
            MRW_vReadFileIncrementLifeCount(1);
        }
        else
        {
            if( bResult == 2 )
            {
                MRW_vReadFilePutStatusText( "READING SUCCESSFUL" );
                fileWriteBinaryBlock( bEOF, elCount( bEOF ), DIAG__lReadFileFileHandle );
                MRW_vReadFileIncrementLifeCount(0);
                cancelTimer( tMRW_TimeoutTimer );
                bQueueWaitForResponce = FALSE;
                fileClose( DIAG__lReadFileFileHandle );
            }
            else
            {
                MRW_vReadFilePutStatusText( "ERROR: Calculating Next Address" );
                MRW_vReadFileIncrementLifeCount(0);
                bQueueWaitForResponce = FALSE;
                fileClose( DIAG__lReadFileFileHandle );
            }
        }
    }
    else
    {
        MRW_vReadFilePutStatusText( "ERROR: Calculating Next Address" );
        MRW_vReadFileIncrementLifeCount(0);
        bQueueWaitForResponce = FALSE;
        fileClose ( DIAG__lReadFileFileHandle );
    }
}

void MRW_vReadFileReqNextLine(dword dwAddress, byte bLength)
{
    int i, j;
    byte bLSB, bMSB, bCSUM, bMode;

    DIAG__iMRWActEepromReadState = RWFTFILE;

    DiagAktion = 0;
    if( FillCommand( ServicePhys ) ) return;
    rqBuf[0] = 0x23;
    rqBuf[1] = 0x14;
    rqBuf[2] = ( byte )(( dwAddress & 0xFF000000 ) >>  24 );
    rqBuf[3] = ( byte )(( dwAddress & 0x00FF0000 ) >>  16 );
    rqBuf[4] = ( byte )(( dwAddress & 0x0000FF00 ) >>   8 );
    rqBuf[5] = ( byte )(( dwAddress & 0x000000FF ) );
    rqBuf[6] = bLength;
    DIAG_SendRequest( SessionPhys, 7);
    bQueueWaitForResponce = TRUE;
    setTimer( tMRW_TimeoutTimer, TimeOutMid );
    DiagAktion = cService_Routine_ReadEEP2File;
}

void MRW_vReadMemoryPressed()
{
    putValue( DIAG_MRW_Status_Backplane, 1 );
    MRW_vClearShadow();
    MRW_vCalcAbsoluteAddress();
    DIAG__abMRWActAddress[0] = DIAG__abMRWAddressShadow[ DIAG__bMRWActDataSet ][0];
    DIAG__abMRWActAddress[1] = DIAG__abMRWAddressShadow[ DIAG__bMRWActDataSet ][1];
    DIAG__abMRWActAddress[2] = DIAG__abMRWAddressShadow[ DIAG__bMRWActDataSet ][2];
    DIAG__abMRWActAddress[3] = DIAG__abMRWAddressShadow[ DIAG__bMRWActDataSet ][3];
    DIAG__iMRWDataLength = DIAG__iMRWDataLengthShadow[ DIAG__bMRWActDataSet ];
    DIAG__iMRWActEepromReadState = RWEEPROM;
    DIAG__iMRWMissingBytes = getValue( DIAG_MRW_Length );//DIAG__iMRWDataLength;
    DIAG__iMRWActShadowPosition = 0;
    MRW_vCalcAddrFields();
    MRW_vStartReadMemory();
}

MRW_vReset_FEE_Eval()
{
    if(( rsBuf[0] == 0x71 ) && 
       ( rsBuf[1] == 0x01 )    )
    {
        DiagAktion = 0;
        putValue( DIAG_Main_ErrorStatus, "Successful" );
        bQueueWaitForResponce = FALSE;
        cancelTimer( tMRW_FormatFEE_TimeOutTimer );
        DIAG_CTRL_vHardReset_Phys();
        putValue( DIAG_FEE_DisclaimerRead_Ackn, 0 );
    }
    else
        if( AntwortAuswertung( 1, rsBuf[0], rsBuf[2]) )
        {
            DiagAktion = 0;
            bQueueWaitForResponce = FALSE;
            cancelTimer( tMRW_FormatFEE_TimeOutTimer );
        }
}

MRW_vReset_FEE_Trigger()
{
    byte temp;
    DiagAktion = 0;
    if( FillCommand( ServicePhys ) ) return;
    rqBuf[0] = 0x31;
    rqBuf[1] = 0x01;
    rqBuf[2] = 0xF0;
    rqBuf[3] = 0x0B;
    DIAG_SendRequest( SessionPhys, 4);
    DiagAktion = cService_Routine_FormatFEE;
    putValue( DIAG_Main_ErrorStatus, "Warte auf Antwort..." );
    setTimer( tMRW_FormatFEE_TimeOutTimer, 2000);
    bQueueWaitForResponce = TRUE;
}

void MRW_vSendNextReadMemAddr(void)
{
    int i, j;
    byte bLSB, bMSB, bCSUM;
    dword dwTempAdr;
// service-dependent
    DiagAktion = 0;
    if( FillCommand( ServicePhys ) ) return;
    rqBuf[0] = 0x23;
    rqBuf[1] = 0x14;
    rqBuf[2] = DIAG__abMRWAddressShadow[DIAG__bMRWActDataSet][3];
    rqBuf[3] = DIAG__abMRWAddressShadow[DIAG__bMRWActDataSet][2];
    rqBuf[4] = DIAG__abMRWAddressShadow[DIAG__bMRWActDataSet][1];
    rqBuf[5] = DIAG__abMRWAddressShadow[DIAG__bMRWActDataSet][0];
    if( DIAG__iMRWMissingBytes >= 0x80 )
    {
        rqBuf[6] = 0x80;
        DIAG__iMRWMissingBytes -= 0x80;
        dwTempAdr = ( ( DIAG__abMRWAddressShadow[DIAG__bMRWActDataSet][3] << 24 ) +
                      ( DIAG__abMRWAddressShadow[DIAG__bMRWActDataSet][2] << 16 ) +
                      ( DIAG__abMRWAddressShadow[DIAG__bMRWActDataSet][1] <<  8 ) +
                      ( DIAG__abMRWAddressShadow[DIAG__bMRWActDataSet][0]       ) + 0x80 );
        DIAG__abMRWAddressShadow[DIAG__bMRWActDataSet][3] = ( ( dwTempAdr  ) & 0xFF000000 ) >> 24;
        DIAG__abMRWAddressShadow[DIAG__bMRWActDataSet][2] = ( ( dwTempAdr  ) & 0x00FF0000 ) >> 16;
        DIAG__abMRWAddressShadow[DIAG__bMRWActDataSet][1] = ( ( dwTempAdr  ) & 0x0000FF00 ) >> 8;
        DIAG__abMRWAddressShadow[DIAG__bMRWActDataSet][0] = ( ( dwTempAdr  ) & 0x000000FF );
    }
    else
    {
        rqBuf[6] = DIAG__iMRWMissingBytes;
        DIAG__iMRWMissingBytes = 0;
    }
    DIAG_SendRequest( SessionPhys, 7);
    bQueueWaitForResponce = TRUE;
    setTimer( tMRW_TimeoutTimer, TimeOutMid );
    DiagAktion = cService_Routine_MRW_Read;
}

void MRW_vSendNextWriteMemAddr(void)
{
    int i, j;
    byte bLSB, bMSB, bCSUM;
    dword dwAddress;
    byte bMode;
    byte bActualTransferLength = 0;
     
// service-dependent
    DiagAktion = 0;
    if( FillCommand( ServicePhys ) ) return;
    rqBuf[0] = 0x3D;
    rqBuf[1] = 0x14;
    rqBuf[2] = DIAG__abMRWAddressShadow[DIAG__bMRWActDataSet][3];
    rqBuf[3] = DIAG__abMRWAddressShadow[DIAG__bMRWActDataSet][2];
    rqBuf[4] = DIAG__abMRWAddressShadow[DIAG__bMRWActDataSet][1];
    rqBuf[5] = DIAG__abMRWAddressShadow[DIAG__bMRWActDataSet][0];
    if( DIAG__iMRWMissingBytes >= 0x80 )
    {
        rqBuf[6] = 0x80;
        bActualTransferLength = 0x80;
        DIAG__iMRWMissingBytes -= 0x80;
        dwAddress = ( ( DIAG__abMRWAddressShadow[DIAG__bMRWActDataSet][3] << 24 ) +
                      ( DIAG__abMRWAddressShadow[DIAG__bMRWActDataSet][2] << 16 ) +
                      ( DIAG__abMRWAddressShadow[DIAG__bMRWActDataSet][1] <<  8 ) +
                      ( DIAG__abMRWAddressShadow[DIAG__bMRWActDataSet][0]       ) + 0x80 );
        DIAG__abMRWAddressShadow[DIAG__bMRWActDataSet][3] = ( ( dwAddress  ) & 0xFF000000 ) >> 24;
        DIAG__abMRWAddressShadow[DIAG__bMRWActDataSet][2] = ( ( dwAddress  ) & 0x00FF0000 ) >> 16;
        DIAG__abMRWAddressShadow[DIAG__bMRWActDataSet][1] = ( ( dwAddress  ) & 0x0000FF00 ) >> 8;
        DIAG__abMRWAddressShadow[DIAG__bMRWActDataSet][0] = ( ( dwAddress  ) & 0x000000FF );
    }
    else
    {
        rqBuf[6] = DIAG__iMRWMissingBytes;
        bActualTransferLength = DIAG__iMRWMissingBytes;
        DIAG__iMRWMissingBytes = 0;
    }
    // Daten
     for(j = 0; j < bActualTransferLength; j++)
    {
        rqBuf[ j + 7 ] = DIAG__abMRWEepromShadow[DIAG__bMRWActDataSet][DIAG__iMRWActShadowPosition++];
    }



    DIAG_SendRequest( SessionPhys, ( bActualTransferLength + 7 ) );
    bQueueWaitForResponce = TRUE;
    setTimer( tMRW_TimeoutTimer, TimeOutMid );
    DiagAktion = cService_Routine_MRW_Write;
}

void MRW_vSetCyclic (void)
{
     //write("READ CYCLIC (%d): %d",DIAG__bMRWActDataSet, TESTER__iRWECyclicReadShadow[DIAG__bMRWActDataSet]);
     if( DIAG__iMRWCyclicReadShadow[ DIAG__bMRWActDataSet ] )
     {
          cancelTimer( tMRW_ReadCyclic );
          setTimer( tMRW_ReadCyclic, DIAG__iMRWCycReadIntervShadow[DIAG__bMRWActDataSet] );
     }
     else
          cancelTimer( tMRW_ReadCyclic );
}

void MRW_vStartReadMemory()
{
    char acStatusText[100];

    if( DIAG__iMRWMissingBytes  > 0 )
    {
        if( DIAG__iMRWMissingBytes  <= 256 )
        {
            snprintf( acStatusText, 100, "START READING %3d DATA BYTES", DIAG__iMRWMissingBytes );
            MRW_vPutStatusText( acStatusText );  // TESTER__vRWEPutStatusText ( xx )
            MRW_vSendNextReadMemAddr();  // TESTER__vRWESendNextReadMemAddr();
            DiagAktion = cService_Routine_MRW_Read;
            setTimer( tMRW_TimeoutTimer, TimeOutMid );
            putValue( DIAG_Main_ErrorStatus, "Warte auf Antwort..." );
        }
        else
        {
            MRW_vPutStatusText("ERROR: Maximum Data Length is 256" );
            bQueueWaitForResponce = FALSE;
        }
    }
    else
    {
        MRW_vPutStatusText("ERROR: Data Length must be larger than 0" );
        bQueueWaitForResponce = FALSE;
    }
}

void MRW_vStartWriteMemAddr ()
{
     char acStatusText[100];

     if( DIAG__iMRWMissingBytes  > 0)
     {
          if( DIAG__iMRWMissingBytes  <= 256)
          {
               snprintf( acStatusText,100, "START WRITING %3d DATA BYTES",DIAG__iMRWMissingBytes );
               MRW_vPutStatusText( acStatusText );
               MRW_vSendNextWriteMemAddr();
          }
          else
          {
               MRW_vPutStatusText("ERROR: Maximum Data Length is 256" );
               bQueueWaitForResponce = FALSE;
          }
     }
     else
     {
          MRW_vPutStatusText("ERROR: Data Length must be larger than 0" );
          bQueueWaitForResponce = FALSE;
     }
}

void MRW_vUpdateDataSet()
{
    dword dwStartAdr;
    DIAG__iMRWActEepromReadState  =      OFF;
    DIAG__iMRWActEepromWriteState =      OFF;

    dwStartAdr =    (dword)DIAG__abMRWAddressShadow[DIAG__bMRWActDataSet][0];
    dwStartAdr |= (((dword)DIAG__abMRWAddressShadow[DIAG__bMRWActDataSet][1])<< 8);
    dwStartAdr |= (((dword)DIAG__abMRWAddressShadow[DIAG__bMRWActDataSet][2])<<16);
    dwStartAdr |= (((dword)DIAG__abMRWAddressShadow[DIAG__bMRWActDataSet][3])<<24);
    putValue( DIAG_MRW_Addr, dwStartAdr );
    putValue( DIAG_MRW_Length, DIAG__iMRWDataLengthShadow[ DIAG__bMRWActDataSet ]);
    putValue( DIAG_MRW_CyclicRead, DIAG__iMRWCyclicReadShadow[ DIAG__bMRWActDataSet ]);
    putValue( DIAG_MRW_CyclicReadInterv, DIAG__iMRWCycReadIntervShadow[ DIAG__bMRWActDataSet ]);
    putValue( DIAG_MRW_DataSetName, DIAG__acMRWDataSetNameShadow[ DIAG__bMRWActDataSet ]);
    MRW_vCalcAddrFields();
    MRW_vCopyShadowToEdit();
    MRW_vSetCyclic();
}

void MRW_vWriteFileCloseFile(void)
{
    MRW_vWriteFileIncrementLifeCount(0);
    dllFClose();
}

void MRW_vWriteFileIncrementLifeCount ( byte bMode )
{
    switch( bMode )
    {
        case 0:  MRW_iWriteFileLifeCount = 0;
                 break;

        case 1:  if( MRW_iWriteFileLifeCount < 2 )
                     MRW_iWriteFileLifeCount++;
                 else
                     MRW_iWriteFileLifeCount = 0;
                 break;

        default: //if( DEBUG) {write("ERROR: Increment Life Count" );}
                 MRW_iWriteFileLifeCount = 0;
                 break;
    }
     putValue( DIAG_MRW_WriteLife, MRW_iWriteFileLifeCount );
}

void MRW_vWriteFilePressed()
{
    char cFileName[270];
    char cFilePath[250];
    char cHelp[270];
    long lResult;
    int iFileDialog;
    int i,j;

    iFileDialog = 1;
    
    if(!iFileDialog)
    {
        getValue( DIAG_MRW_WritePathName,cFileName );
        getValue( DIAG_MRW_WriteFileName,cHelp);
        strncat( cFileName, cHelp, elCount(cFileName ) );
    }
    else
    {
        getValue( DIAG_MRW_WriteFileNameDialog, cFileName );
          // cFilePath bestimmen
          for( i=elCount(cHelp)-1; i>0; i--)
          {
               if(cHelp[i] == '\\')
               {
                    strncpy(cFilePath, cHelp, i+2 );
                    j=0;
                    i++;
                    for( ; i<250; i++)
                         cFileName[j++] = cHelp[i];
                    break;
               }
          }
    }
    write("filename : %s", cFileName );

    DIAG__iMRWActEepromWriteState = RWFTFILE;
    MRW_lWriteFileTxFrameCount = 0;
    MRW_lWriteFileHandle = DIAG_lOpenFileForRead( cFileName );
    if( MRW_lWriteFileHandle != 0 )
    {
        MRW_vWriteFilePutStatusText( "FILE OPENED" );
        lResult = MRW_bWriteFileTransmitFileLine( MRW_lWriteFileHandle );
        if(lResult == 0x00)
        {
            // End of File (No Data)
            DIAG__iMRWActEepromWriteState = OFF;
            MRW_vWriteFilePutStatusText( "END OF FILE (NO DATA)" );
            bQueueWaitForResponce = FALSE;
            MRW_vWriteFileCloseFile();
        }
        else
        {
            if( lResult == 0x01 )
            {
                   // Transmitting of first line successful
//                    write("Transmitting of first line successful" );
            }
            else
            {
                // Error Transmitting first line
                snprintf( cHelp,elCount(cHelp), "ERROR: NOT ABLE TO SEND FRAME (%x): Check input-file", lResult );
                MRW_vWriteFilePutStatusText( cHelp );
                bQueueWaitForResponce = FALSE;
                MRW_vWriteFileCloseFile();
            }     
        }
    }
    else
    {
        MRW_vWriteFilePutStatusText( "ERROR: NOT ABLE TO OPEN FILE" );
        bQueueWaitForResponce = FALSE;
        //TST__vWFCloseFile();
    }
}

void MRW_vWriteFilePutStatusText (char cText[])
{
    putValue( DIAG_MRW_WriteFileStatusBar, cText );
}

void MRW_vWriteFileRcdWriteMemAddr()
{
    long lResult;
    char cHelp[80];

    MRW_lWriteFileTxFrameCount++;
    snprintf(cHelp,elCount(cHelp), "FRAME TRANSMITTED: %3d", MRW_lWriteFileTxFrameCount );
    setTimer( tMRW_TimeoutTimer, TimeOutMid );
    MRW_vWriteFilePutStatusText( cHelp);

    lResult = MRW_bWriteFileTransmitFileLine(MRW_lWriteFileHandle );
    if(lResult == 0x00)
    {
        // End of File
        DIAG__iMRWActEepromWriteState = OFF;
        cancelTimer( tMRW_TimeoutTimer );
        putValue( DIAG_Main_ErrorStatus, "" );
        MRW_vWriteFilePutStatusText( "WRITING SUCCESSFUL" );
        bQueueWaitForResponce = FALSE;
        MRW_vWriteFileCloseFile();
    }
    else
    {
        if( lResult == 0x01 )
        {
            // Transmitting of first line successful
            MRW_vWriteFileIncrementLifeCount(1);
        }
        else
        {
            // Error Transmitting first line
            snprintf(cHelp,elCount(cHelp), "ERROR: NOT ABLE TO SEND FRAME (%x)",lResult );
            MRW_vWriteFilePutStatusText( cHelp );
            bQueueWaitForResponce = FALSE;
            MRW_vWriteFileCloseFile();
        }     
    }
}

MRW_vWriteMemoryPressed()
{
    putValue( DIAG_MRW_Status_Backplane, 1 );
    MRW_vClearShadow();
    MRW_vCalcAbsoluteAddress();
    DIAG__abMRWActAddress[0] =      DIAG__abMRWAddressShadow[DIAG__bMRWActDataSet][0];
    DIAG__abMRWActAddress[1] =      DIAG__abMRWAddressShadow[DIAG__bMRWActDataSet][1];
    DIAG__abMRWActAddress[2] =      DIAG__abMRWAddressShadow[DIAG__bMRWActDataSet][2];
    DIAG__abMRWActAddress[3] =      DIAG__abMRWAddressShadow[DIAG__bMRWActDataSet][3];
    DIAG__iMRWDataLength =           DIAG__iMRWDataLengthShadow[DIAG__bMRWActDataSet];

    DIAG__iMRWActEepromWriteState = RWEEPROM;
    DIAG__iMRWMissingBytes = getValue( DIAG_MRW_Length );//DIAG__iMRWDataLength;
    DIAG__iMRWActShadowPosition = 0;
    MRW_vCopyEditToShadow();
    MRW_vStartWriteMemAddr();
}

PWM_EvalReadPWM()
{
    if(( rsBuf[0] == 0x71 ) && 
       ( rsBuf[1] == 0x01 ) &&
       ( rsBuf[2] == 0xF0 ) &&
       ( rsBuf[3] == 0x07 )    )
    {   
        DutyCycleHi[0]=rsBuf[5];
        DutyCycleLo[0]=rsBuf[6];
      
        if((bReadPWM_CurrentChannel == LL_ML_DISP_VLCD_PWM)||(bReadPWM_CurrentChannel == LL_ML_DISP_VREF_PWM))
        {  
          switch(bReadPWM_CurrentChannel)
          {
            case 0x01: bReadPWM_CurrentChannel=0x05; break;
            case 0x03: bReadPWM_CurrentChannel=0x06; break;
            default: break;
          }          
          PWM_EvalValues( (bReadPWM_CurrentChannel), ((rsBuf[5]*256) + rsBuf[6]), ((((rsBuf[6]*256) + rsBuf[7]*256) + rsBuf[8]*256) + rsBuf[9]) );
        }
        else
          if(getvalue(DIAG_CTRL_IC_Type_Selector) == cKI_VS30_EL) 
            PWM_EvalValues( (bReadPWM_CurrentChannel - 0x43), (((rsBuf[5]*256) + rsBuf[6])>>4), ((((rsBuf[6]*256) + rsBuf[7]*256) + rsBuf[8]*256) + rsBuf[9]) );
          else 
            PWM_EvalValues( (bReadPWM_CurrentChannel - 0x32), (((rsBuf[5]*256) + rsBuf[6])>>4), ((((rsBuf[6]*256) + rsBuf[7]*256) + rsBuf[8]*256) + rsBuf[9]) );
         
        DiagAktion = 0;
        bQueueWaitForResponce = FALSE;
        cancelTimer( tPWM_TimeOutTimer );
        DIAG_CTRL_vStartNewService(); 
    }
    else
        if( AntwortAuswertung( 1, rsBuf[0], rsBuf[2]) )
        {
            DiagAktion = 0;
            cancelTimer( tPWM_TimeOutTimer );
            bQueueWaitForResponce = FALSE;
        }
    DIAG_CTRL_vStartNewService();
}

PWM_EvalSetDutyValue()
{
    if(( rsBuf[0] == 0x6E ) && 
       ( rsBuf[1] == 0xFD ) &&
       ( rsBuf[2] == 0x02 )    )
    {
        DiagAktion = 0;
        bQueueWaitForResponce = FALSE;
        cancelTimer( tPWM_TimeOutTimer );
        DIAG_CTRL_vStartNewService();
        putValue( DIAG_PWM_StatusBar, "Successful" );
    }
    else
        if( AntwortAuswertung( 1, rsBuf[0], rsBuf[2]) )
        {
            DiagAktion = 0;
            bQueueWaitForResponce = FALSE;
            cancelTimer( tPWM_TimeOutTimer );
            DIAG_CTRL_vStartNewService();
            putValue( DIAG_PWM_StatusBar, "Error" );
        }
}

PWM_EvalSetFreqValue()
{
    if(( rsBuf[0] == 0x6E ) && 
       ( rsBuf[1] == 0xFD ) &&
       ( rsBuf[2] == 0x03 )    )
    {
        DiagAktion = 0;
        bQueueWaitForResponce = FALSE;
        cancelTimer( tPWM_TimeOutTimer );
        DIAG_CTRL_vStartNewService();
        putValue( DIAG_PWM_StatusBar, "Successful" );
    }
    else
        if( AntwortAuswertung( 1, rsBuf[0], rsBuf[2]) )
        {
            DiagAktion = 0;
            bQueueWaitForResponce = FALSE;
            cancelTimer( tPWM_TimeOutTimer );
            DIAG_CTRL_vStartNewService();
            putValue( DIAG_PWM_StatusBar, "Error" );
        }
}

PWM_EvalStopPWMControl()
{
    if(( rsBuf[0] == 0x71 ) && 
       ( rsBuf[1] == 0x01 ) &&
       ( rsBuf[2] == 0xF0 ) &&
       ( rsBuf[3] == 0x09 )    )
    {
        DiagAktion = 0;
        bQueueWaitForResponce = FALSE;
        cancelTimer( tPWM_TimeOutTimer );
        DIAG_CTRL_vStartNewService();
        putValue( DIAG_PWM_StatusBar, "Successful" );
    }
    else
        if( AntwortAuswertung( 1, rsBuf[0], rsBuf[2]) )
        {
            DiagAktion = 0;
            bQueueWaitForResponce = FALSE;
            cancelTimer( tPWM_TimeOutTimer );
            DIAG_CTRL_vStartNewService();
            putValue( DIAG_PWM_StatusBar, "Error" );
        }
}

PWM_EvalValues( byte bChannel, word bDuty, dword bFreq )
{
    if( bChannel < 16 )
    {
        wPWMDuty[bChannel] = bDuty;
        if( bDuty > wPWMDutyMax[bChannel] )
            wPWMDutyMax[bChannel] = bDuty;
          
        if( bDuty < wPWMDutyMin[bChannel] )
            wPWMDutyMin[bChannel] = bDuty;
        wPWMFreq[bChannel] = bFreq;
    }
    if( bChannel == 16 )
    {
        putValue( DIAG_PWM_Ch00Freq,        wPWMFreq[0] );
        putValue( DIAG_PWM_Ch00Duty,        wPWMDuty[0] );
        putValue( DIAG_PWM_Ch00Duty_float,  ( ( (float )wPWMDuty[0] * 100 ) / 4095 ) );
        putValue( DIAG_PWM_Ch00DutyMax,     wPWMDutyMax[0] );
        putValue( DIAG_PWM_Ch00DutyMin,     wPWMDutyMin[0] );
        putValue( DIAG_PWM_Ch01Freq,        wPWMFreq[1] );
        putValue( DIAG_PWM_Ch01Duty,        wPWMDuty[1] );
        putValue( DIAG_PWM_Ch01Duty_float,  ( ( (float )wPWMDuty[1] * 100 ) / 4095 ) );
        putValue( DIAG_PWM_Ch01DutyMax,     wPWMDutyMax[1] );
        putValue( DIAG_PWM_Ch01DutyMin,     wPWMDutyMin[1] );
        putValue( DIAG_PWM_Ch02Freq,        wPWMFreq[2] );
        putValue( DIAG_PWM_Ch02Duty,        wPWMDuty[2] );
        putValue( DIAG_PWM_Ch02Duty_float,  ( ( (float )wPWMDuty[2] * 100 ) / 4095 ) );
        putValue( DIAG_PWM_Ch02DutyMax,     wPWMDutyMax[2] );
        putValue( DIAG_PWM_Ch02DutyMin,     wPWMDutyMin[2] );
        putValue( DIAG_PWM_Ch03Freq,        wPWMFreq[3] );
        putValue( DIAG_PWM_Ch03Duty,        wPWMDuty[3] );
        putValue( DIAG_PWM_Ch03Duty_float,  ( ( (float )wPWMDuty[3] * 100 ) / 4095 ) );
        putValue( DIAG_PWM_Ch03DutyMax,     wPWMDutyMax[3] );
        putValue( DIAG_PWM_Ch03DutyMin,     wPWMDutyMin[3] );
        putValue( DIAG_PWM_Ch04Freq,        wPWMFreq[4] );
        putValue( DIAG_PWM_Ch04Duty,        wPWMDuty[4] );
        putValue( DIAG_PWM_Ch04Duty_float,  ( ( (float )wPWMDuty[4] * 100 ) / 4095 ) );
        putValue( DIAG_PWM_Ch04DutyMax,     wPWMDutyMax[4] );
        putValue( DIAG_PWM_Ch04DutyMin,     wPWMDutyMin[4] );
        putValue( DIAG_PWM_Ch05Freq,        wPWMFreq[5] );
        putValue( DIAG_PWM_Ch05Duty,        wPWMDuty[5] );
        putValue( DIAG_PWM_Ch05Duty_float,  ( ( (float )wPWMDuty[5] * 100 ) / 4095 ) );
        putValue( DIAG_PWM_Ch05DutyMax,     wPWMDutyMax[5] );
        putValue( DIAG_PWM_Ch05DutyMin,     wPWMDutyMin[5] );
        putValue( DIAG_PWM_Ch06Freq,        wPWMFreq[6] );
        putValue( DIAG_PWM_Ch06Duty,        wPWMDuty[6] );
        putValue( DIAG_PWM_Ch06Duty_float,  ( ( (float )wPWMDuty[6] * 100 ) / 4095 ) );
        putValue( DIAG_PWM_Ch06DutyMax,     wPWMDutyMax[6] );
        putValue( DIAG_PWM_Ch06DutyMin,     wPWMDutyMin[6] );
        putValue( DIAG_PWM_Ch07Freq,        wPWMFreq[7] );
        putValue( DIAG_PWM_Ch07Duty,        wPWMDuty[7] );
        putValue( DIAG_PWM_Ch07Duty_float,  ( ( (float )wPWMDuty[7] * 100 ) / 4095 ) );
        putValue( DIAG_PWM_Ch07DutyMax,     wPWMDutyMax[7] );
        putValue( DIAG_PWM_Ch07DutyMin,     wPWMDutyMin[7] );
        putValue( DIAG_PWM_Ch08Freq,        wPWMFreq[8] );
        putValue( DIAG_PWM_Ch08Duty,        wPWMDuty[8] );
        putValue( DIAG_PWM_Ch08Duty_float,  ( ( (float )wPWMDuty[8] * 100 ) / 4095 ) );
        putValue( DIAG_PWM_Ch08DutyMax,     wPWMDutyMax[8] );
        putValue( DIAG_PWM_Ch08DutyMin,     wPWMDutyMin[8] );
        putValue( DIAG_PWM_Ch09Freq,        wPWMFreq[9] );
        putValue( DIAG_PWM_Ch09Duty,        wPWMDuty[9] );
        putValue( DIAG_PWM_Ch09Duty_float,  ( ( (float )wPWMDuty[9] * 100 ) / 4095 ) );
        putValue( DIAG_PWM_Ch09DutyMax,     wPWMDutyMax[9] );
        putValue( DIAG_PWM_Ch09DutyMin,     wPWMDutyMin[9] );
        putValue( DIAG_PWM_Ch10Freq,        wPWMFreq[10] );
        putValue( DIAG_PWM_Ch10Duty,        wPWMDuty[10] );
        putValue( DIAG_PWM_Ch10Duty_float,  ( ( (float )wPWMDuty[10] * 100 ) / 4095 ) );
        putValue( DIAG_PWM_Ch10DutyMax,     wPWMDutyMax[10] );
        putValue( DIAG_PWM_Ch10DutyMin,     wPWMDutyMin[10] );
        putValue( DIAG_PWM_Ch11Freq,        wPWMFreq[11] );
        putValue( DIAG_PWM_Ch11Duty,        wPWMDuty[11] );
        putValue( DIAG_PWM_Ch11Duty_float,  ( ( (float )wPWMDuty[11] * 100 ) / 4095 ) );
        putValue( DIAG_PWM_Ch11DutyMax,     wPWMDutyMax[11] );
        putValue( DIAG_PWM_Ch11DutyMin,     wPWMDutyMin[11] );
        putValue( DIAG_PWM_Ch12Freq,        wPWMFreq[12] );
        putValue( DIAG_PWM_Ch12Duty,        wPWMDuty[12] );
        putValue( DIAG_PWM_Ch12Duty_float,  ( ( (float )wPWMDuty[12] * 100 ) / 4095 ) );
        putValue( DIAG_PWM_Ch12DutyMax,     wPWMDutyMax[12] );
        putValue( DIAG_PWM_Ch12DutyMin,     wPWMDutyMin[12] );
        putValue( DIAG_PWM_Ch13Freq,        wPWMFreq[13] );
        putValue( DIAG_PWM_Ch13Duty,        wPWMDuty[13] );
        putValue( DIAG_PWM_Ch13Duty_float,  ( ( (float )wPWMDuty[13] * 100 ) / 4095 ) );
        putValue( DIAG_PWM_Ch13DutyMax,     wPWMDutyMax[13] );
        putValue( DIAG_PWM_Ch13DutyMin,     wPWMDutyMin[13] );
        putValue( DIAG_PWM_StatusBar, "Successful" );
        
        if(getValue( DIAG_CTRL_IC_Type_Selector) == cKI_VS30_EL)
        {
          putValue(DIAG_GPIO_P16_0, (wPWMDuty[5]*100)/4095); 
          putValue(DIAG_GPIO_P16_1, (wPWMDuty[6]*100)/4095);
          putValue(DIAG_GPIO_P16_3, (wPWMDuty[0]*100)/4095);
          putValue(DIAG_GPIO_P16_4, (wPWMDuty[1]*100)/4095);
          putValue(DIAG_GPIO_P16_5, (wPWMDuty[2]*100)/4095);
          putValue(DIAG_GPIO_P16_6, (wPWMDuty[3]*100)/4095);
          putValue(DIAG_GPIO_P16_7, (wPWMDuty[4]*100)/4095);
        }
        else if(getValue( DIAG_CTRL_IC_Type_Selector) == cKI_VS30_HL)
        {
          putValue(DIAG_GPIO_P42_2, (wPWMDuty[0]*100)/4095);
          putValue(DIAG_GPIO_P42_3, (wPWMDuty[1]*100)/4095);
          putValue(DIAG_GPIO_P42_4, (wPWMDuty[2]*100)/4095);
          putValue(DIAG_GPIO_P42_5, (wPWMDuty[3]*100)/4095);
          putValue(DIAG_GPIO_P42_6, (wPWMDuty[4]*100)/4095);
          putValue(DIAG_GPIO_P42_9, (wPWMDuty[12]*100)/4095);
          putValue(DIAG_GPIO_P42_10, (wPWMDuty[13]*100)/4095);
          putValue(DIAG_GPIO_P42_11, (wPWMDuty[5]*100)/4095);
          putValue(DIAG_GPIO_P42_12, (wPWMDuty[6]*100)/4095);
          putValue(DIAG_GPIO_P42_13, (wPWMDuty[7]*100)/4095);
          putValue(DIAG_GPIO_P42_14, (wPWMDuty[8]*100)/4095);
          putValue(DIAG_GPIO_P42_15, (wPWMDuty[9]*100)/4095);
          //putValue(DIAG_GPIO_P3_10, wPWMDuty[10]); //to do
          //putValue(DIAG_GPIO_P3_10, wPWMDuty[11]); //to do
        }
        
    }
    DIAG_CTRL_vStartNewService();
}

PWM_GetValue( byte bChannel )
{
    DiagAktion = 0;
    if( FillCommand( ServicePhys ) ) return;
    rqBuf[0] = 0x31;
    rqBuf[1] = 0x01;
    rqBuf[2] = 0xF0;
    rqBuf[3] = 0x07;
    rqBuf[4] = bChannel;
    bReadPWM_CurrentChannel = bChannel;
    DIAG_SendRequest( SessionPhys, 5);
    DiagAktion = cService_Routine_ReadPWM;
    bQueueWaitForResponce = TRUE;
    putValue( DIAG_PWM_StatusBar, "Warte auf Antwort..." );
    setTimer( tPWM_TimeOutTimer, TimeOut );
}

PWM_InsertAllReadRequestsGPIO()
{
    byte bNextIndex = 0xFE;  // NOP
    
    if(getValue( DIAG_CTRL_IC_Type_Selector) == cKI_VS30_EL)
    {
      DIAG_Queue_InsertCommand( cService_Routine_ReadPWM_Ch00 );//P16_3
      DIAG_Queue_InsertCommand( cService_Routine_ReadPWM_Ch01 );//P16_4
      DIAG_Queue_InsertCommand( cService_Routine_ReadPWM_Ch02 );//P16_5
      DIAG_Queue_InsertCommand( cService_Routine_ReadPWM_Ch03 );//P16_6
      DIAG_Queue_InsertCommand( cService_Routine_ReadPWM_Ch04 );//P16_7
      DIAG_Queue_InsertCommand( cService_Routine_ReadPWM_Ch05 );//P16_0
      DIAG_Queue_InsertCommand( cService_Routine_ReadPWM_Ch06 );//P16_1
    }
    else if(getValue( DIAG_CTRL_IC_Type_Selector) == cKI_VS30_HL)
    {
      DIAG_Queue_InsertCommand( cService_Routine_ReadPWM_Ch00 );//P42_2
      DIAG_Queue_InsertCommand( cService_Routine_ReadPWM_Ch01 );//P42_3
      DIAG_Queue_InsertCommand( cService_Routine_ReadPWM_Ch02 );//P42_4
      DIAG_Queue_InsertCommand( cService_Routine_ReadPWM_Ch03 );//P42_5
      DIAG_Queue_InsertCommand( cService_Routine_ReadPWM_Ch04 );//P42_6
      DIAG_Queue_InsertCommand( cService_Routine_ReadPWM_Ch05 );//P42_11
      DIAG_Queue_InsertCommand( cService_Routine_ReadPWM_Ch06 );//P42_12
      DIAG_Queue_InsertCommand( cService_Routine_ReadPWM_Ch07 );//P42_13
      DIAG_Queue_InsertCommand( cService_Routine_ReadPWM_Ch08 );//P42_14
      DIAG_Queue_InsertCommand( cService_Routine_ReadPWM_Ch09 );//P42_15
      DIAG_Queue_InsertCommand( cService_Routine_ReadPWM_Ch10 );//P3_10
      DIAG_Queue_InsertCommand( cService_Routine_ReadPWM_Ch11 );//P3_11
      DIAG_Queue_InsertCommand( cService_Routine_ReadPWM_Ch12 );//P42_9
      DIAG_Queue_InsertCommand( cService_Routine_ReadPWM_Ch13 );//P42_10
    }
    bNextIndex = 0x09;

    if( bNextIndex == 0x09 )  // not NOP    
    {
        DIAG_Queue_InsertCommand( cService_Routine_ReadPWM_Eval );
    }
}

PWM_InsertAllReadRequests()
{
    byte bNextIndex;

    bNextIndex = 0xFE;  // NOP
    if( getValue( DIAG_PWM_Ch00Activ ))
    {
        DIAG_Queue_InsertCommand( cService_Routine_ReadPWM_Ch00 );
        bNextIndex = 0x09;
    }
    if( getValue( DIAG_PWM_Ch01Activ ))
    {
        DIAG_Queue_InsertCommand( cService_Routine_ReadPWM_Ch01 );
        bNextIndex = 0x09;
    }
    if( getValue( DIAG_PWM_Ch02Activ ))
    {
        DIAG_Queue_InsertCommand( cService_Routine_ReadPWM_Ch02 );
        bNextIndex = 0x09;
    }
    if( getValue( DIAG_PWM_Ch03Activ ))
    {
        DIAG_Queue_InsertCommand( cService_Routine_ReadPWM_Ch03 );
        bNextIndex = 0x09;
    }
    if( getValue( DIAG_PWM_Ch04Activ ))
    {
        DIAG_Queue_InsertCommand( cService_Routine_ReadPWM_Ch04 );
        bNextIndex = 0x09;
    }
    if( getValue( DIAG_PWM_Ch05Activ ))
    {
        DIAG_Queue_InsertCommand( cService_Routine_ReadPWM_Ch05 );
        bNextIndex = 0x09;
    }
    if( getValue( DIAG_PWM_Ch06Activ ))
    {
        DIAG_Queue_InsertCommand( cService_Routine_ReadPWM_Ch06 );
        bNextIndex = 0x09;
    }
    if( getValue( DIAG_PWM_Ch07Activ ) )
    {
        DIAG_Queue_InsertCommand( cService_Routine_ReadPWM_Ch07 );
        bNextIndex = 0x09;
    }
    if( getValue( DIAG_PWM_Ch08Activ ) )
    {
        DIAG_Queue_InsertCommand( cService_Routine_ReadPWM_Ch08 );
        bNextIndex = 0x09;
    }
    if( getValue( DIAG_PWM_Ch09Activ ) )
    {
        DIAG_Queue_InsertCommand( cService_Routine_ReadPWM_Ch09 );
        bNextIndex = 0x09;  // W205 only
    }
    if( getValue( DIAG_PWM_Ch10Activ ) )
    {
        DIAG_Queue_InsertCommand( cService_Routine_ReadPWM_Ch10 );
        bNextIndex = 0x09;  // W205 only
    }
    if( getValue( DIAG_PWM_Ch11Activ ) )
    {
        DIAG_Queue_InsertCommand( cService_Routine_ReadPWM_Ch11 );
        bNextIndex = 0x09;  // W205 only
    }
    if( getValue( DIAG_PWM_Ch12Activ ) )
    {
        DIAG_Queue_InsertCommand( cService_Routine_ReadPWM_Ch12 );
        bNextIndex = 0x09;  // W205 only
    }
    if( getValue( DIAG_PWM_Ch13Activ ) )
    {
        DIAG_Queue_InsertCommand( cService_Routine_ReadPWM_Ch13 );
        bNextIndex = 0x09;  // W205 only
    }
    if( bNextIndex == 0x09 )  // not NOP    
    {
        DIAG_Queue_InsertCommand( cService_Routine_ReadPWM_Eval ); // only if new data requested
               //         PWM_EvalValues( bNextIndex, 0, 0 );
    }
}

PWM_SetDutyValue()
{
    //  2E,FD,03,CNr,Fq-Hi,Fq-MidHi,Fq-MidLo,Fq-Lo
    DiagAktion = 0;
    if( FillCommand( ServicePhys ) ) return;
    rqBuf[0] = 0x2E;
    rqBuf[1] = 0xFD;
    rqBuf[2] = 0x02;
    rqBuf[3] = cPWM_IndexToChannel[bSetDutyChannel_Buffer];
    
    if ((cPWM_IndexToChannel[bSetDutyChannel_Buffer] == LL_ML_DISP_VREF_PWM)|(cPWM_IndexToChannel[bSetDutyChannel_Buffer] == LL_ML_DISP_VLCD_PWM))
    {
          rqBuf[4] = ( wSetDuty_Buffer  >> 8     ) & 0xFF;
          write("%x",rqBuf[4]);
          rqBuf[5] = ( wSetDuty_Buffer           ) & 0xFF;
          write("%x",rqBuf[5]);
    }
    else
    {
          rqBuf[4] = ( wSetDuty_Buffer  >> 4     ) & 0xFF;
          write("%x",rqBuf[4]);
          rqBuf[5] = ( wSetDuty_Buffer  << 4     ) & 0xFF;
          write("%x",rqBuf[5]);
    }

    DIAG_SendRequest( SessionPhys, 6);
    DiagAktion = cService_Routine_WritePWMDuty;
    bQueueWaitForResponce = TRUE;
    putValue( DIAG_PWM_StatusBar, "Warte auf Antwort..." );
    setTimer( tPWM_TimeOutTimer, TimeOut );
}

PWM_SetDutyValue_Ch00()
{
    bSetDutyChannel_Buffer = 0x00;
    wSetDuty_Buffer = getValue( DIAG_PWM_Ch00Duty );
    PWM_SetDutyValue();
}

PWM_SetDutyValue_Ch01()
{
    bSetDutyChannel_Buffer = 0x01;
    wSetDuty_Buffer = getValue( DIAG_PWM_Ch01Duty );
    PWM_SetDutyValue();
}

PWM_SetDutyValue_Ch02()
{
    bSetDutyChannel_Buffer = 0x02;
    wSetDuty_Buffer = getValue( DIAG_PWM_Ch02Duty );
    PWM_SetDutyValue();
}

PWM_SetDutyValue_Ch03()
{
    bSetDutyChannel_Buffer = 0x03;
    wSetDuty_Buffer = getValue( DIAG_PWM_Ch03Duty );
    PWM_SetDutyValue();
}

PWM_SetDutyValue_Ch04()
{
    bSetDutyChannel_Buffer = 0x04;
    wSetDuty_Buffer = getValue( DIAG_PWM_Ch04Duty );
    PWM_SetDutyValue();
}

PWM_SetDutyValue_Ch05()
{
    
    bSetDutyChannel_Buffer = 0x05;    
    wSetDuty_Buffer = getValue( DIAG_PWM_Ch05Duty );
    PWM_SetDutyValue();
}

PWM_SetDutyValue_Ch06()
{   
    bSetDutyChannel_Buffer = 0x06; 
    wSetDuty_Buffer = getValue( DIAG_PWM_Ch06Duty );
    PWM_SetDutyValue();
}

PWM_SetDutyValue_Ch07()
{
    bSetDutyChannel_Buffer = 0x07;
    wSetDuty_Buffer = getValue( DIAG_PWM_Ch07Duty );
    PWM_SetDutyValue();
}

PWM_SetDutyValue_Ch08()
{
    bSetDutyChannel_Buffer = 0x08;
    wSetDuty_Buffer = getValue( DIAG_PWM_Ch08Duty );
    PWM_SetDutyValue();
}

PWM_SetDutyValue_Ch09()
{
    bSetDutyChannel_Buffer = 0x09;
    wSetDuty_Buffer = getValue( DIAG_PWM_Ch09Duty );
    PWM_SetDutyValue();
}

PWM_SetDutyValue_Ch10()
{
    bSetDutyChannel_Buffer = 0x0A;
    wSetDuty_Buffer = getValue( DIAG_PWM_Ch10Duty );
    PWM_SetDutyValue();
}

PWM_SetDutyValue_Ch11()
{
    bSetDutyChannel_Buffer = 0x0B;
    wSetDuty_Buffer = getValue( DIAG_PWM_Ch11Duty );
    PWM_SetDutyValue();
}

PWM_SetDutyValue_Ch12()
{
    bSetDutyChannel_Buffer = 0x0C;
    wSetDuty_Buffer = getValue( DIAG_PWM_Ch12Duty );
    PWM_SetDutyValue();
}

PWM_SetDutyValue_Ch13()
{
    bSetDutyChannel_Buffer = 0x0D;
    wSetDuty_Buffer = getValue( DIAG_PWM_Ch13Duty );
    PWM_SetDutyValue();
}

PWM_SetFreqValue()
{   //  2E,FD,03,CNr,Fq-Hi,Fq-MidHi,Fq-MidLo,Fq-Lo
    DiagAktion = 0;
    if( FillCommand( ServicePhys ) ) return;
    rqBuf[0] = 0x2E;
    rqBuf[1] = 0xFD;
    rqBuf[2] = 0x03;
    rqBuf[3] = bSetFreqChannel_Buffer;
    rqBuf[4] = ( dwSetFreq_Buffer >> 24 ) & 0xFF;
    rqBuf[5] = ( dwSetFreq_Buffer >> 16 ) & 0xFF;
    rqBuf[6] = ( dwSetFreq_Buffer >>  8 ) & 0xFF;
    rqBuf[7] = ( dwSetFreq_Buffer       ) & 0xFF;
    DIAG_SendRequest( SessionPhys, 8);
    DiagAktion = cService_Routine_WritePWMFreq;
    bQueueWaitForResponce = TRUE;
    putValue( DIAG_PWM_StatusBar, "Warte auf Antwort..." );
    setTimer( tPWM_TimeOutTimer, TimeOut );
}

PWM_StopPWMControl()
{
    // 2E,FD,03,CNr,Fq-Hi,Fq-MidHi,Fq-MidLo,Fq-Lo
    DiagAktion = 0;
    if( FillCommand( ServicePhys ) ) return;
    rqBuf[0] = 0x31;
    rqBuf[1] = 0x01;
    rqBuf[2] = 0xF0;
    rqBuf[3] = 0x09;
    DIAG_SendRequest( SessionPhys, 4 );
    DiagAktion = cService_Routine_StopPWMControl;
    bQueueWaitForResponce = TRUE;
    putValue( DIAG_PWM_StatusBar, "Warte auf Antwort..." );
    setTimer( tPWM_TimeOutTimer, TimeOut );
}

SND_EvalStartSoundTest()
{
    if(( rsBuf[0] == 0x71 ) && 
       ( rsBuf[1] == 0x01 ) &&
       ( rsBuf[2] == 0x03 ) &&
       ( rsBuf[3] == 0x02 )    )
    {
        DiagAktion = 0;
        bQueueWaitForResponce = FALSE;
        cancelTimer( tSND_StartControlTimeOutTimer );
        DIAG_CTRL_vStartNewService();
        putValue( DIAG_SND_StatusBar, "Successful" );
    }
    else
        if( AntwortAuswertung( 1, rsBuf[0], rsBuf[2]) )
        {
            DiagAktion = 0;
            bQueueWaitForResponce = FALSE;
            cancelTimer( tSND_StartControlTimeOutTimer );
            DIAG_CTRL_vStartNewService();
            putValue( DIAG_SND_StatusBar, "Error" );
        }
}

SND_EvalStopSoundTest()
{
    if(( rsBuf[0] == 0x71 ) && 
       ( rsBuf[1] == 0x02 ) &&
       ( rsBuf[2] == 0x03 ) &&
       ( rsBuf[3] == 0x02 )    )
    {
        DiagAktion = 0;
        bQueueWaitForResponce = FALSE;
        cancelTimer( tSND_StartControlTimeOutTimer );
        DIAG_CTRL_vStartNewService();
        putValue( DIAG_SND_StatusBar, "Successful" );
    }
    else
        if( AntwortAuswertung( 1, rsBuf[0], rsBuf[2]) )
        {
            DiagAktion = 0;
            bQueueWaitForResponce = FALSE;
            cancelTimer( tSND_StartControlTimeOutTimer );
            DIAG_CTRL_vStartNewService();
            putValue( DIAG_SND_StatusBar, "Error" );
        }
}

SND_EvalVolumeSoundTest()
{
    if(( rsBuf[0] == 0x71 ) && 
       ( rsBuf[1] == 0x01 ) &&
       ( rsBuf[2] == 0x03 ) &&
       ( rsBuf[3] == 0x02 )    )
    {
        DiagAktion = 0;
        bQueueWaitForResponce = FALSE;
        cancelTimer( tSND_VolumeControlTimeOutTimer );
        DIAG_CTRL_vStartNewService();
        putValue( DIAG_SND_StatusBar, "Successful" );
    }
    else
        if( AntwortAuswertung( 1, rsBuf[0], rsBuf[2]) )
        {
            DiagAktion = 0;
            bQueueWaitForResponce = FALSE;
            cancelTimer( tSND_VolumeControlTimeOutTimer );
            DIAG_CTRL_vStartNewService();
            putValue( DIAG_SND_StatusBar, "Error" );
        }
}

SND_EvalStartSoundQTest()
{
    if(( rsBuf[0] == 0x71 ) && 
       ( rsBuf[1] == 0x01 ) &&
       ( rsBuf[2] == 0xF0 ) &&
       ( rsBuf[3] == 0x27 )    )
    {
        DiagAktion = 0;
        bQueueWaitForResponce = FALSE;
        cancelTimer( tSND_StartControlTimeOutTimer );
        DIAG_CTRL_vStartNewService();
        putValue( DIAG_SND_StatusBar, "Successful" );
    }
    else
        if( AntwortAuswertung( 1, rsBuf[0], rsBuf[2]) )
        {
            DiagAktion = 0;
            bQueueWaitForResponce = FALSE;
            cancelTimer( tSND_StartControlTimeOutTimer );
            DIAG_CTRL_vStartNewService();
            putValue( DIAG_SND_StatusBar, "Error" );
        }
}

SND_EvalStopSoundQTest()
{
    if(( rsBuf[0] == 0x71 ) && 
       ( rsBuf[1] == 0x02 ) &&
       ( rsBuf[2] == 0xF0 ) &&
       ( rsBuf[3] == 0x27 )    )
    {
        DiagAktion = 0;
        bQueueWaitForResponce = FALSE;
        cancelTimer( tSND_StartControlTimeOutTimer );
        DIAG_CTRL_vStartNewService();
        putValue( DIAG_SND_StatusBar, "Successful" );
    }
    else
        if( AntwortAuswertung( 1, rsBuf[0], rsBuf[2]) )
        {
            DiagAktion = 0;
            bQueueWaitForResponce = FALSE;
            cancelTimer( tSND_StartControlTimeOutTimer );
            DIAG_CTRL_vStartNewService();
            putValue( DIAG_SND_StatusBar, "Error" );
        }
}

SND_EvalStartSoundDMode()
{
    if(( rsBuf[0] == 0x71 ) && 
       ( rsBuf[1] == 0x01 ) &&
       ( rsBuf[2] == 0xF0 ) &&
       ( rsBuf[3] == 0x28 )    )
    {
        DiagAktion = 0;
        bQueueWaitForResponce = FALSE;
        cancelTimer( tSND_StartControlTimeOutTimer );
        DIAG_CTRL_vStartNewService();
        putValue( DIAG_SND_StatusBar, "Successful" );
    }
    else
        if( AntwortAuswertung( 1, rsBuf[0], rsBuf[2]) )
        {
            DiagAktion = 0;
            bQueueWaitForResponce = FALSE;
            cancelTimer( tSND_StartControlTimeOutTimer );
            DIAG_CTRL_vStartNewService();
            putValue( DIAG_SND_StatusBar, "Error" );
        }
}

SND_EvalStopSoundDMode()
{
    if(( rsBuf[0] == 0x71 ) && 
       ( rsBuf[1] == 0x02 ) &&
       ( rsBuf[2] == 0xF0 ) &&
       ( rsBuf[3] == 0x28 )    )
    {
        DiagAktion = 0;
        bQueueWaitForResponce = FALSE;
        cancelTimer( tSND_StartControlTimeOutTimer );
        DIAG_CTRL_vStartNewService();
        putValue( DIAG_SND_StatusBar, "Successful" );
    }
    else
        if( AntwortAuswertung( 1, rsBuf[0], rsBuf[2]) )
        {
            DiagAktion = 0;
            bQueueWaitForResponce = FALSE;
            cancelTimer( tSND_StartControlTimeOutTimer );
            DIAG_CTRL_vStartNewService();
            putValue( DIAG_SND_StatusBar, "Error" );
        }
}

SND_vStartControl_Send()
{
    DiagAktion = 0;
    if( FillCommand( ServicePhys ) ) return;

    rqBuf[0] = 0x31;
    rqBuf[1] = 0x01;
    rqBuf[2] = 0x03;
    rqBuf[3] = 0x02;
    rqBuf[4] = getValue( DIAG_SND_Sound ) >> 8;
    rqBuf[5] = getValue( DIAG_SND_Sound );
    rqBuf[6] = getValue( DIAG_SND_ChannelPos );
    rqBuf[7] = getValue( DIAG_SND_Volume );
    rqBuf[8] = getValue( DIAG_SND_Option );
    DIAG_SendRequest( SessionPhys, 9);

    DiagAktion = cService_Routine_StartSoundTest;
    bQueueWaitForResponce = TRUE;
    putValue( DIAG_SND_StatusBar, "Warte auf Antwort..." );
    setTimer( tSND_StartControlTimeOutTimer, TimeOut );
}

SND_vStopControl_Send()
{
    DiagAktion = 0;
    if( FillCommand( ServicePhys ) ) return;

    rqBuf[0] = 0x31;
    rqBuf[1] = 0x02;
    rqBuf[2] = 0x03;
    rqBuf[3] = 0x02;
    DIAG_SendRequest( SessionPhys, 4 );

    DiagAktion = cService_Routine_StopSoundTest;
    bQueueWaitForResponce = TRUE;
    putValue( DIAG_SND_StatusBar, "Warte auf Antwort..." );
    setTimer( tSND_StopControlTimeOutTimer, TimeOut );
}

SND_vVolume()
{
    DiagAktion = 0;
    if( FillCommand( ServicePhys ) ) return;

    rqBuf[0] = 0x31;
    rqBuf[1] = 0x01;
    rqBuf[2] = 0x03;
    rqBuf[3] = 0x02;
    rqBuf[4] = getValue( DIAG_SND_Sound ) >> 8;
    rqBuf[5] = getValue( DIAG_SND_Sound );
    rqBuf[6] = getValue( DIAG_SND_ChannelPos );
    rqBuf[7] = getValue( DIAG_SND_Volume );
    rqBuf[8] = getValue( DIAG_SND_Option );
    DIAG_SendRequest( SessionPhys, 9);

    DiagAktion = cService_Routine_StartSoundTest;
    bQueueWaitForResponce = TRUE;
    putValue( DIAG_SND_StatusBar, "Warte auf Antwort..." );
    setTimer( tSND_VolumeControlTimeOutTimer, TimeOut );
}

SND_vStartQControl_Send()
{
    DiagAktion = 0;
    if( FillCommand( ServicePhys ) ) return;

    rqBuf[0] = 0x31;
    rqBuf[1] = 0x01;
    rqBuf[2] = 0xF0;
    rqBuf[3] = 0x27;
    rqBuf[4] = getValue( DIAG_SND_Sound_Q ) >> 8;
    rqBuf[5] = getValue( DIAG_SND_Sound_Q );
    rqBuf[6] = getValue( DIAG_SND_Loop_Q );
    rqBuf[7] = getValue( DIAG_SND_Option_Q );
    DIAG_SendRequest( SessionPhys, 8);

    DiagAktion = cService_Routine_StartSoundQTest;
    bQueueWaitForResponce = TRUE;
    putValue( DIAG_SND_StatusBar, "Warte auf Antwort..." );
    setTimer( tSND_StartControlTimeOutTimer, TimeOut );
}

SND_vStopQControl_Send()
{
    DiagAktion = 0;
    if( FillCommand( ServicePhys ) ) return;

    rqBuf[0] = 0x31;
    rqBuf[1] = 0x02;
    rqBuf[2] = 0xF0;
    rqBuf[3] = 0x27;
    DIAG_SendRequest( SessionPhys, 4 );

    DiagAktion = cService_Routine_StopSoundQTest;
    bQueueWaitForResponce = TRUE;
    putValue( DIAG_SND_StatusBar, "Warte auf Antwort..." );
    setTimer( tSND_StopControlTimeOutTimer, TimeOut );
}

SND_vStartDMControl_Send()
{
    DiagAktion = 0;
    if( FillCommand( ServicePhys ) ) return;

    rqBuf[0] = 0x31;
    rqBuf[1] = 0x01;
    rqBuf[2] = 0xF0;
    rqBuf[3] = 0x28;
    rqBuf[4] = getValue( DIAG_SND_Speed_Q ) >> 8;
    rqBuf[5] = getValue( DIAG_SND_Speed_Q );
    rqBuf[6] = getValue( DIAG_SND_EngRun_Q );
    rqBuf[7] = ((getValue( DIAG_SND_Dfrst_Q ) << 4) + getValue(DIAG_SND_FanLvl_Q));
    rqBuf[8] = getValue( DIAG_SND_OpnLid_Q );
    DIAG_SendRequest( SessionPhys, 9);

    DiagAktion = cService_Routine_StartSoundDMode;
    bQueueWaitForResponce = TRUE;
    putValue( DIAG_SND_StatusBar, "Warte auf Antwort..." );
    setTimer( tSND_StartControlTimeOutTimer, TimeOut );
}

SND_vStopDMControl_Send()
{
    DiagAktion = 0;
    if( FillCommand( ServicePhys ) ) return;

    rqBuf[0] = 0x31;
    rqBuf[1] = 0x02;
    rqBuf[2] = 0xF0;
    rqBuf[3] = 0x28;
    DIAG_SendRequest( SessionPhys, 4 );

    DiagAktion = cService_Routine_StopSoundDMode;
    bQueueWaitForResponce = TRUE;
    putValue( DIAG_SND_StatusBar, "Warte auf Antwort..." );
    setTimer( tSND_StopControlTimeOutTimer, TimeOut );
}

_ByteToBin( byte bValue )
{
    snprintf( DTC_strSymptomBinary, 9, "00000000" );
    if( bValue > 127 )
    {
        DTC_strSymptomBinary[0] = '1';
        bValue -= 128;
    }
    if( bValue > 63 )
    {
        DTC_strSymptomBinary[1] = '1';
        bValue -= 64;
    }
    if( bValue > 31 )
    {
        DTC_strSymptomBinary[2] = '1';
        bValue -= 32;
    }
    if( bValue > 15 )
    {
        DTC_strSymptomBinary[3] = '1';
        bValue -= 16;
    }
    if( bValue > 7 )
    {
        DTC_strSymptomBinary[4] = '1';
        bValue -= 8;
    }
    if( bValue > 3 )
    {
        DTC_strSymptomBinary[5] = '1';
        bValue -= 4;
    }
    if( bValue > 1 )
    {
        DTC_strSymptomBinary[6] = '1';
        bValue -= 2;
    }
    if( bValue > 0 )
    {
        DTC_strSymptomBinary[7] = '1';
        bValue -= 1;
    }
}

/********************************************************************/
/* Diagnose-Funktionen                                              */
/********************************************************************/

on EnvVar DIAG_CTRL_ECU_Selector
{
       ClearGetBuffer();
}

on envVar DHMI__ServiceStatus
{
     ServicePhys = !getValue( this );
}

on envVar DHMI__CmdManBefehlEing
{
  if( getValue( this ) )
  {
    ClearPutBuffer();
    putValue( DIAG_Main_ErrorStatus, "Daten eingeben u. senden" );
    DiagSchreibAktion = 17;
  }
}

On EnvVar DHMI__CmdSpeicherLesen
{
  if( getValue( this ) )
  {
    ClearGetBuffer();
    DiagAktionStart( 14);
  }
}

On envVar DHMI__CmdSpeicherSchreiben
{
       byte Temp[2] = { 0x3B, 0x00 };
     byte Temp_UDS[3] = { 0x2E, 0x00, 0x00 };

       if( getValue( this ) )
       {
         ClearPutBuffer();

         Temp_UDS[1] = getValue( DHMI__AnzeigeBlockNr) >> 8;
         Temp_UDS[2] = getValue( DHMI__AnzeigeBlockNr) & 0xFF;
         putValue( DHMI__PutBuffer, Temp_UDS);
         putValue( DIAG_Main_ErrorStatus, "Daten eingeben u. senden" );
         DiagSchreibAktion = 15;
       }
}

on envVar DHMI__CmdIOControl
{
    byte Temp[1] = { 0x30 };
    byte Temp_UDS[1] = { 0x2F };

    if( getValue( this ) )
    {
        ClearPutBuffer();
        putValue( DHMI__PutBuffer, Temp_UDS );
        putValue( DIAG_Main_ErrorStatus, "Daten eingeben u. senden" );
        DiagSchreibAktion = 16;
    }
}

on envVar DHMI__CmdDatenSenden
{
    if( getValue( this ) )
    {
        BufferAnzahl = ( getValue( DHMI__PutBuffer, rqBuf) );

        if( BufferAnzahl > 0 )
        {
            ClearGetBuffer();
            DiagAktionStart( DiagSchreibAktion );
        }
        else
            putValue( DIAG_Main_ErrorStatus, "Nutzdatenanz. 0 ungültig!" );
    }
}

on envVar DHMI__PutClear
{
  ClearPutBuffer();
  putValue( DIAG_Main_ErrorStatus, "Ok" );
}

on envVar DHMI__COPYBUF
{
     if( getValue( this ) && DiagSchreibAktion )
          BufferAnzahl = ( getValue( DHMI__PutBuffer, rsBuf) );
}

On EnvVar DHMI__BlockNrUp
{
    if( getValue( this ) )
    {
        hilf = getValue( DHMI__AnzeigeBlockNr) + 1;
        if(  hilf > (long)0xFFFF )   hilf = 0;
        putValue( DHMI__AnzeigeBlockNr, hilf);
    }
}

On EnvVar DHMI__BlockNrDown
{
       if( getValue( this ) )
       {
         hilf = getValue( DHMI__AnzeigeBlockNr) - 1;
      if(  hilf < 0)   hilf = (long)0xFFFF;
      putValue( DHMI__AnzeigeBlockNr, (long)hilf);
       }
}

On EnvVar DHMI__AnzeigeBlockNr
{
   if( getValue( this ) > (long)0xFFFF )
       {
      putValue( DHMI__AnzeigeBlockNr, (long)0xFFFF );
         return;
       }

       if( DiagSchreibAktion == 5) rqBuf[1] = getValue( this );
}

void ClearGetBuffer()
{
     PutValue( DHMI__GetBuffer, cleardata, 0);
}

void ClearPutBuffer()
{
     PutValue( DHMI__PutBuffer, cleardata, 0);
}

WEM_ResetWriteCounter_Eval()
{
    if( ( rsBuf[0] == 0x71 ) &&
        ( rsBuf[1] == 0x01 ) &&
        ( rsBuf[2] == 0xF0 ) &&
        ( rsBuf[3] == 0x1A )    )
    {
        DiagAktion = 0;
        cancelTimer( tDTC_ReadTimeOutTimer );
        bQueueWaitForResponce = FALSE;
        putValue( DIAG_DTC_StatusBar, "WEM Reset Write-Counter : Successful" );
        DIAG_CTRL_vStartNewService();
    }
    else
    {
        if( AntwortAuswertung( 1, rsBuf[0], rsBuf[2]) )
        {
            DiagAktion = 0;
            cancelTimer( tDTC_ReadTimeOutTimer );
            bQueueWaitForResponce = FALSE;
            putValue( DIAG_DTC_StatusBar, "negativ responce :  WEM Reset Write-Counter not successful" );
            DIAG_CTRL_vStartNewService();
        }
        else
        {
            cancelTimer( tDTC_ReadTimeOutTimer );
            setTimer( tDTC_ReadTimeOutTimer, TimeOut );
        }
    }
}

WEM_ResetWriteCounter_Trigger()
{   // The function sends a physically addressed read diagnostic information request message.
    DiagAktion = 0;
    if( FillCommand( ServicePhys ) ) return;
    rqBuf[0] = 0x31;
    rqBuf[1] = 0x01;
    rqBuf[2] = 0xF0;
    rqBuf[3] = 0x1A;
    DIAG_SendRequest( SessionPhys, 4);
    DiagAktion = cService_Routine_WemResetWriteCounter;
    bQueueWaitForResponce = TRUE;
    putValue( DIAG_DTC_StatusBar, "Warte auf Antwort..." );
    setTimer( tDTC_ReadTimeOutTimer, TimeOutMid );
}

WEM_StatusLesen_Trigger()
{   // The function sends a physically addressed read diagnostic information request message.
    DiagAktion = 0;
    if( FillCommand( ServicePhys ) ) return;
    rqBuf[0] = 0x22;
    rqBuf[1] = 0x04;
    rqBuf[2] = 0x00;
    write( "WEM_StatusLesen_Trigger execute  " );

    DIAG_SendRequest( SessionPhys, 3);
    DiagAktion = cService_Routine_WemStatusLesen;
    bQueueWaitForResponce = TRUE;
    putValue( DIAG_DTC_StatusBar, "Warte auf Antwort..." );
    setTimer( tDTC_ReadTimeOutTimer, TimeOutMid );
}

WEM_StatusLesen_Eval( byte Laenge )
{
    byte i =0;

//    write( "WEM_StatusLesen_Eval execute  " );

    if( ( rsBuf[0] == 0x62 ) &&
        ( rsBuf[1] == 0x04 ) &&
        ( rsBuf[2] == 0x00 )    )
    {
        cancelTimer( tDTC_ReadTimeOutTimer );
  //  write( "WEM_StatusLesen_Eval execute; pos resp " );
        WenStatusLesen_buffer_length = Laenge - 3;
        for( i = 3; i < Laenge; i++ )
        {
            WenStatusLesen_buffer[i-3] = rsBuf[i];
        }
        WEM_OpenLogFile();

//        WEM_WriteCRLFToLogfile();
        WEM_WriteEntryToLogfile();
        fileClose ( DIAG__lWEMFileFileHandle );
        WemFileOpened = 0;

        DiagAktion = 0;
        bQueueWaitForResponce = FALSE;
        putValue( DIAG_DTC_StatusBar, "WEM Reset Write-Counter : Successful" );
        DIAG_CTRL_vStartNewService();
    }
    else
    {
 //    write( "WEM_StatusLesen_Eval execute; neg resp  " );
        if( AntwortAuswertung( 1, rsBuf[0], rsBuf[2]) )
        {
            DiagAktion = 0;
            cancelTimer( tDTC_ReadTimeOutTimer );
            bQueueWaitForResponce = FALSE;
            putValue( DIAG_DTC_StatusBar, "negativ responce :  WEM Reset Write-Counter not successful" );
            DIAG_CTRL_vStartNewService();
        }
        else
        {
            cancelTimer( tDTC_ReadTimeOutTimer );
            setTimer( tDTC_ReadTimeOutTimer, TimeOut );
        }
    }
}

void WEM_OpenLogFile(void)
{
    char temp[64];
    byte bLength;
    byte bResult;
    byte acLineData[40];
    char cFileName[270] = "\\out_data\\WemStatus_Report";
    char cFilePath[250];
    char cHelp[270];
    long lResult;
    int iFileDialog;
    int i,j,filelnamenlaenge;

    if( WemFileOpened == 1 ) return;   //nur ein Mal öffnen


    // hole aktuelle Zeit
    getLocalTimeString( temp );       // now timeBuffer contains for example. "Fri Aug 21 15:22:24 1998"
    filelnamenlaenge = elcount( cFileName );
    for( i=0; i < ( 8 ); i++)
    {
 //       cFileName[filelnamenlaenge+i] = temp[ i ];
    }

    setWritePath( cFilePath );

    DIAG__lWEMFileFileHandle = OpenFileWrite( cFileName, 2 );//open for write, existing file will be deleted
    if(  DIAG__lWEMFileFileHandle != 0 ) 
    {
        DIAG_LOG__vLogPutStatusText( "FILE OPENED" );
        WEM_vIncrementLifeCount(1);
        WemFileOpened = 1;
        acLineData[0] = 0x0D;
        acLineData[1] = 0x0A;
        // hole aktuelle Zeit
        getLocalTimeString( temp );       // now timeBuffer contains for example. "Fri Aug 21 15:22:24 1998"
        for( i=2; i < 26;i++)    //                                                0  3  6  9  2  5  8  1 3   
        {
            acLineData[i] = temp[i-2];
        }
        acLineData[i] = 0x3B;   // write ";" to line
        i += 1;

        fileWriteBinaryBlock( acLineData, i, DIAG__lWEMFileFileHandle );
//        WEM_WriteCRLFToLogfile();
    }
    else
    {
        DIAG_LOG__vLogPutStatusText( "ERROR: NOT ABLE TO OPEN FILE" );
        WemFileOpened = 0;
        fileClose ( DIAG__lWEMFileFileHandle );
    }
}

WEM_WriteCRLFToLogfile()
{
    int i;
    char temp[64];
    byte bLength;
    byte bResult;
    byte acLineData[40];

    if( DIAG__lWEMFileFileHandle != 0 ) 
    {   // nur wenn File offen ist !!!!
        acLineData[0] = 0x0D;
        acLineData[1] = 0x0A;
        // hole aktuelle Zeit
        getLocalTimeString( temp);       // now timeBuffer contains for example. "Fri Aug 21 15:22:24 1998"
        for( i=2; i < 10;i++)
        {
            acLineData[i] = temp[i+9];
        }
        acLineData[i] = 0x3B;   // write ";" to line
        i += 1;
        fileWriteBinaryBlock ( acLineData, i, DIAG__lWEMFileFileHandle );
    }
}

void WEM_vIncrementLifeCount ( byte bMode )
{
    switch( bMode )
    {
        case 0: DIAG__iWEMFileLifeCount = 0;            break;
        case 1: if( DIAG__iWEMFileLifeCount < 2 )    DIAG__iWEMFileLifeCount++;    else    DIAG__iWEMFileLifeCount = 0;   break;
        default: DIAG__iWEMFileLifeCount = 0;           break;
    }
    putValue( DIAG_LOG_LogFileLife, DIAG__iWEMFileLifeCount );
}

WEM_WriteEntryToLogfile()
{
    int i,j;
    word bLength;
    byte acLineData[400];

    if(  DIAG__lWEMFileFileHandle != 0 ) 
    {   // nur wenn File offen ist !!!!
        i = 0;
        acLineData[i] = 0x3B;   // write ";" to line
        i += 1;
        for( j = 0; j < WenStatusLesen_buffer_length; j++)
        {
            _ByteToHex( WenStatusLesen_buffer[j] );
            acLineData[i] = ByteToHex_value_char1;
            acLineData[i+1] = ByteToHex_value_char2;
            acLineData[i+2] = 0x3B;   // write ";" to line
            i = i+3;
        }
        fileWriteBinaryBlock ( acLineData, i, DIAG__lWEMFileFileHandle );
    }
}

_ByteToHex( byte bValue )
{
    byte help = 0;

//    if( bValue > 15 )
    {
        help = bValue / 16;
        switch( help )
        {
            case  0: ByteToHex_value_char1 = '0'; break;
            case  1: ByteToHex_value_char1 = '1'; break;
            case  2: ByteToHex_value_char1 = '2'; break;
            case  3: ByteToHex_value_char1 = '3'; break;
            case  4: ByteToHex_value_char1 = '4'; break;
            case  5: ByteToHex_value_char1 = '5'; break;
            case  6: ByteToHex_value_char1 = '6'; break;
            case  7: ByteToHex_value_char1 = '7'; break;
            case  8: ByteToHex_value_char1 = '8'; break;
            case  9: ByteToHex_value_char1 = '9'; break;
            case 10: ByteToHex_value_char1 = 'A'; break;
            case 11: ByteToHex_value_char1 = 'B'; break;
            case 12: ByteToHex_value_char1 = 'C'; break;
            case 13: ByteToHex_value_char1 = 'D'; break;
            case 14: ByteToHex_value_char1 = 'E'; break;
            case 15: ByteToHex_value_char1 = 'F'; break;
        }
    }
    help = bValue & 0x0F;
    switch( help )
    {
        case  0: ByteToHex_value_char2 = '0'; break;
        case  1: ByteToHex_value_char2 = '1'; break;
        case  2: ByteToHex_value_char2 = '2'; break;
        case  3: ByteToHex_value_char2 = '3'; break;
        case  4: ByteToHex_value_char2 = '4'; break;
        case  5: ByteToHex_value_char2 = '5'; break;
        case  6: ByteToHex_value_char2 = '6'; break;
        case  7: ByteToHex_value_char2 = '7'; break;
        case  8: ByteToHex_value_char2 = '8'; break;
        case  9: ByteToHex_value_char2 = '9'; break;
        case 10: ByteToHex_value_char2 = 'A'; break;
        case 11: ByteToHex_value_char2 = 'B'; break;
        case 12: ByteToHex_value_char2 = 'C'; break;
        case 13: ByteToHex_value_char2 = 'D'; break;
        case 14: ByteToHex_value_char2 = 'E'; break;
        case 15: ByteToHex_value_char2 = 'F'; break;
    }
}

on envVar DIAG_WEM_ReadStatus_Trigger
{
    if( getValue( this ) )
    {
        DIAG_Queue_InsertCommand( cService_Routine_WemStatusLesen );
        DIAG_CTRL_vStartNewService();
    }
}

on preStop
{
    fileClose ( DIAG__lWEMFileFileHandle );
    WemFileOpened = 0;
}

DIAG_CTRL_Start_DiagSession()
{
    int nECU;

    InitOSEK_TP();
    nECU = getValue( DIAG_CTRL_ECU_Selector );
    OSEKTL_SetRxId( ECUResId[ nECU ] );
    DiagnoseAktiv=1;
    putValue( DIAG_CTRL_Disp_DiagStateOnOff, cActiv );
    cancelTimer( tTesterPresentTimer );
    setTimer( tTesterPresentTimer, FirstTesterPresentTime );
    putValue( DIAG_Main_ErrorStatus, "Diagnose aktiviert." );
    DIAG_CTRL_vStartNewService();
}

DIAG_CTRL_Stop_DiagSession()
{
    cancelTimer( tTesterPresentTimer);
    DiagnoseAktiv=0;
    putValue( DIAG_CTRL_Disp_DiagStateOnOff, cInactiv );
    putValue( DIAG_Main_ErrorStatus, "Diagnose deaktiviert." );
    OSEKTL_SetRxId( 0x7FF );
    DIAG_CTRL_vStartNewService();
}

on envVar DIAG_Optics_All_Night_Max
{
    if( getValue( this ) )
    {
        setTimer( tOptics_LED_Preglow_Timer, 5000 );
        putValue( DIAG_Optics_LED_Status_Hot, 0 );

        DIAG_Queue_InsertCommand( cService_Routine_HardResetPhys );
        DIAG_Queue_InsertCommand( cService_Delay_Timer2000msec );
        DIAG_Queue_InsertCommand( cService_Delay_Timer2000msec );
        DIAG_Queue_InsertCommand( cService_Control_Start_DiagSession );
        DIAG_Queue_InsertCommand( cService_Delay_Timer2000msec );
        DIAG_Queue_InsertCommand( cService_SessionLevel_Supplier );
        DIAG_Queue_InsertCommand( cService_SecLevel_Supplier );
        DIAG_Queue_InsertCommand( cService_Control_Lamptest_On );
        putValue( HMI_ISw_Stat, 4 );
        putValue( Env_VehSpd_X, SpeedoDefault );
        putValue( Env_EngCoolTemp, EngineCoolantTempMax );
        putValue( Env_EngRPM, TachoDefault );
        DIAG_Queue_InsertCommand( cService_Delay_Timer2000msec );
        putValue( HMI_EngRun_Stat, 3 );
        putValue( HMI_TankLvl, 100 );
        putValue( HMI_SwIllLvl_Ctrl_Style, 0 );  // Poti
        putValue( HMI_SwIllLvl_Raw, 254 );
        putValue( HMI_SwIllLvl_Raw, 1 );
        putValue( HMI_SwIllLvl_Raw, 200 );
        putValue( HMI_LgtSens_Night, 1 );
        putValue( HMI_LgtSens_Night2, 1 );
        putValue( HMI_LgtSens_Night3, 1 );
        putValue( DIAG_PWM_Ch00Duty, 0 );  // Telltales HL/HL+
//        DIAG_Queue_InsertCommand( cService_Routine_WritePWMDuty_Ch00 );
        putValue( DIAG_PWM_Ch01Duty, 0 );  // Telltales HL/HL+
//        DIAG_Queue_InsertCommand( cService_Routine_WritePWMDuty_Ch01 );
        putValue( DIAG_PWM_Ch02Duty, 0 );  // Pointers HL/HL+
//        DIAG_Queue_InsertCommand( cService_Routine_WritePWMDuty_Ch02 );
        putValue( DIAG_PWM_Ch03Duty, 0 );  // Dials HL/HL+
//        DIAG_Queue_InsertCommand( cService_Routine_WritePWMDuty_Ch03 );
        putValue( DIAG_PWM_Ch04Duty, 0 );  // Art-ring HL+
//        DIAG_Queue_InsertCommand( cService_Routine_WritePWMDuty_Ch04 );
        putValue( DIAG_PWM_Ch05Duty, 0 );  // Bargraph Fuel HL/HL+
//        DIAG_Queue_InsertCommand( cService_Routine_WritePWMDuty_Ch05 );
        putValue( DIAG_PWM_Ch06Duty, 0 );  // Bargraph Fuel HL/HL+
//        DIAG_Queue_InsertCommand( cService_Routine_WritePWMDuty_Ch06 );
        putValue( DIAG_PWM_Ch10Duty, 4095 ); // Display HL/HL+
//        DIAG_Queue_InsertCommand( cService_Routine_WritePWMDuty_Ch10 );
        putValue( DIAG_PWM_Ch12Duty, 0 );  // Bargraph Temperature HL/HL+
//        DIAG_Queue_InsertCommand( cService_Routine_WritePWMDuty_Ch12 );
        putValue( DIAG_PWM_Ch13Duty, 0 );  // Bargraph Temperature HL/HL+
//        DIAG_Queue_InsertCommand( cService_Routine_WritePWMDuty_Ch13 );
//        putValue( pDemo_DistronicBegin, 50 );
//        putValue( pDemo_DistronicBegin, 5 );
//        putValue( pDemo_DistronicEnd, 51 );
//        putValue( pDemo_DistronicEnd, 251 );
		putvalue(HMI_EVC_6F_ADTR_Avl,1);				// activate distronic config
//		putvalue(HMI_LDC_VSL_On_RDU,1);					// DTR on
		putvalue(HMI_LDC_Spd_Add_RDU,251);	// set DTR value
        putValue( DIAG_DSP_p0, 0 );
        DIAG_Queue_InsertCommand( cService_Routine_StartDisplayTest );
        DIAG_CTRL_vStartNewService();
        putValue( DIAG_Optics_All_Night_Max_Ind, 1 );
        putValue( DIAG_Optics_All_Night_Min_Ind, 0 );
        putValue( DIAG_Optics_All_Day_Ind, 0 );
        putValue( DIAG_Optics_Display_Day_Max_Ind, 0 );
        putValue( DIAG_Optics_Display_Night_Max_Ind, 0 );
        putValue( DIAG_Optics_Display_Night_Min_Ind, 0 );
        putValue( HMI_IP_Brt, 0 );

        setTimer( tOptics_RPM_Reduction_Timer, 4000 );
    }
}

on envVar DIAG_Optics_All_Day
{
    if( getValue( this ) )
    {
        setTimer( tOptics_LED_Preglow_Timer, 5000 );
        putValue( DIAG_Optics_LED_Status_Hot, 0 );

        DIAG_Queue_InsertCommand( cService_Routine_HardResetPhys );
        DIAG_Queue_InsertCommand( cService_Delay_Timer2000msec );
        DIAG_Queue_InsertCommand( cService_Delay_Timer2000msec );
        DIAG_Queue_InsertCommand( cService_Control_Start_DiagSession );
        DIAG_Queue_InsertCommand( cService_Delay_Timer2000msec );
        DIAG_Queue_InsertCommand( cService_SessionLevel_Supplier );
        DIAG_Queue_InsertCommand( cService_SecLevel_Supplier );
        DIAG_Queue_InsertCommand( cService_Control_Lamptest_On );
        putValue( HMI_ISw_Stat, 4 );
        putValue( Env_VehSpd_X, SpeedoDefault );
        putValue( Env_EngRPM, TachoDefault );
        putValue( Env_EngCoolTemp, EngineCoolantTempMax );
        putValue( HMI_TankLvl, 100 );
        putValue( HMI_SwIllLvl_Ctrl_Style, 0 );  // Poti
        putValue( HMI_SwIllLvl_Raw, 254 );
        putValue( HMI_SwIllLvl_Raw, 1 );
        putValue( HMI_SwIllLvl_Raw, 200 );
        putValue( HMI_LgtSens_Night, 0 );
        putValue( HMI_LgtSens_Night2, 0 );
        putValue( HMI_LgtSens_Night3, 0 );
        putValue( DIAG_PWM_Ch00Duty, 0 );  // 
//        DIAG_Queue_InsertCommand( cService_Routine_WritePWMDuty_Ch00 );
        putValue( DIAG_PWM_Ch01Duty, 0 );  // 
//        DIAG_Queue_InsertCommand( cService_Routine_WritePWMDuty_Ch01 );  
        putValue( DIAG_PWM_Ch02Duty, 0 );  // 
//        DIAG_Queue_InsertCommand( cService_Routine_WritePWMDuty_Ch02 );
        putValue( DIAG_PWM_Ch03Duty, 0 );  // 
//        DIAG_Queue_InsertCommand( cService_Routine_WritePWMDuty_Ch03 );
        putValue( DIAG_PWM_Ch04Duty, 0 );  // 
//        DIAG_Queue_InsertCommand( cService_Routine_WritePWMDuty_Ch04 );
        putValue( DIAG_PWM_Ch05Duty, 0 );  // 
//        DIAG_Queue_InsertCommand( cService_Routine_WritePWMDuty_Ch05 );
        putValue( DIAG_PWM_Ch06Duty, 0 );  //  
//        DIAG_Queue_InsertCommand( cService_Routine_WritePWMDuty_Ch06 );
        putValue( DIAG_PWM_Ch07Duty, 0 );  // 
//        DIAG_Queue_InsertCommand( cService_Routine_WritePWMDuty_Ch07 );
        putValue( DIAG_PWM_Ch08Duty, 0 );  // 
//        DIAG_Queue_InsertCommand( cService_Routine_WritePWMDuty_Ch08 );
        putValue( DIAG_PWM_Ch09Duty, 0 );  // 
//        DIAG_Queue_InsertCommand( cService_Routine_WritePWMDuty_Ch09 );
        putValue( DIAG_PWM_Ch10Duty, 4095 );  // 
//        DIAG_Queue_InsertCommand( cService_Routine_WritePWMDuty_Ch10 );
        putValue( DIAG_PWM_Ch11Duty, 0 );  //  
//        DIAG_Queue_InsertCommand( cService_Routine_WritePWMDuty_Ch11 );
        putValue( DIAG_PWM_Ch12Duty, 0 );  //  
//        DIAG_Queue_InsertCommand( cService_Routine_WritePWMDuty_Ch12 );
        putValue( DIAG_PWM_Ch13Duty, 0 );  //  
//        DIAG_Queue_InsertCommand( cService_Routine_WritePWMDuty_Ch13 );
//        putValue( pDemo_DistronicBegin, 50 );
//        putValue( pDemo_DistronicBegin, 5 );
//        putValue( pDemo_DistronicEnd, 51 );
//        putValue( pDemo_DistronicEnd, 251 );
		putvalue(HMI_EVC_6F_ADTR_Avl,1);				// activate distronic config
//		putvalue(HMI_LDC_VSL_On_RDU,1);					// DTR on
		putvalue(HMI_LDC_Spd_Add_RDU,251);	// set DTR value
        putValue( DIAG_DSP_p0, 0 );
        DIAG_Queue_InsertCommand( cService_Routine_StartDisplayTest );
        DIAG_CTRL_vStartNewService();
        putValue( DIAG_Optics_All_Night_Max_Ind, 0 );
        putValue( DIAG_Optics_All_Night_Min_Ind, 0 );
        putValue( DIAG_Optics_All_Day_Ind, 1 );
        putValue( DIAG_Optics_Display_Day_Max_Ind, 0 );
        putValue( DIAG_Optics_Display_Night_Max_Ind, 0 );
        putValue( DIAG_Optics_Display_Night_Min_Ind, 0 );
        putValue( HMI_IP_Brt, 250 );

        setTimer( tOptics_RPM_Reduction_Timer, 4000 );
    }
}

on envVar DIAG_Optics_All_Night_Min
{
    if( getValue( this ) )
    {
        setTimer( tOptics_LED_Preglow_Timer, 5000 );
        putValue( DIAG_Optics_LED_Status_Hot, 0 );

        DIAG_Queue_InsertCommand( cService_Routine_HardResetPhys );
        DIAG_Queue_InsertCommand( cService_Delay_Timer2000msec );
        DIAG_Queue_InsertCommand( cService_Delay_Timer2000msec );
        DIAG_Queue_InsertCommand( cService_Control_Start_DiagSession );
        DIAG_Queue_InsertCommand( cService_Delay_Timer2000msec );
        DIAG_Queue_InsertCommand( cService_SessionLevel_Supplier );
        DIAG_Queue_InsertCommand( cService_SecLevel_Supplier );
        DIAG_Queue_InsertCommand( cService_Control_Lamptest_On );
        putValue( HMI_ISw_Stat, 4 );
        putValue( Env_VehSpd_X, SpeedoDefault );
        putValue( Env_EngRPM, TachoDefault );
        putValue( Env_EngCoolTemp, EngineCoolantTempMin );
        putValue( HMI_TankLvl, 0 );
        putValue( HMI_SwIllLvl_Ctrl_Style, 0 );  // Poti
        putValue( HMI_SwIllLvl_Raw, 254 );
        putValue( HMI_SwIllLvl_Raw, 1 );
        putValue( HMI_SwIllLvl_Raw, 0 );
        putValue( HMI_LgtSens_Night, 1 );
        putValue( HMI_LgtSens_Night2, 1 );
        putValue( HMI_LgtSens_Night3, 1 );
        putValue( DIAG_PWM_Ch00Duty, 0 );  // 
//        DIAG_Queue_InsertCommand( cService_Routine_WritePWMDuty_Ch00 );
        putValue( DIAG_PWM_Ch01Duty, 0 );  // 
//        DIAG_Queue_InsertCommand( cService_Routine_WritePWMDuty_Ch01 );
        putValue( DIAG_PWM_Ch02Duty, 0 );  // 
//        DIAG_Queue_InsertCommand( cService_Routine_WritePWMDuty_Ch02 );
        putValue( DIAG_PWM_Ch03Duty, 0 );  // 
//        DIAG_Queue_InsertCommand( cService_Routine_WritePWMDuty_Ch03 );
        putValue( DIAG_PWM_Ch04Duty, 0 );  // 
//        DIAG_Queue_InsertCommand( cService_Routine_WritePWMDuty_Ch04 );
        putValue( DIAG_PWM_Ch05Duty, 0 );  // 
//        DIAG_Queue_InsertCommand( cService_Routine_WritePWMDuty_Ch05 );
        putValue( DIAG_PWM_Ch06Duty, 0 );  // 
//        DIAG_Queue_InsertCommand( cService_Routine_WritePWMDuty_Ch06 );
        putValue( DIAG_PWM_Ch07Duty, 0 );  // 
//        DIAG_Queue_InsertCommand( cService_Routine_WritePWMDuty_Ch07 );
        putValue( DIAG_PWM_Ch08Duty, 0 );  // 
//        DIAG_Queue_InsertCommand( cService_Routine_WritePWMDuty_Ch08 );
        putValue( DIAG_PWM_Ch09Duty, 0 );  // 
//        DIAG_Queue_InsertCommand( cService_Routine_WritePWMDuty_Ch09 );
        putValue( DIAG_PWM_Ch10Duty, 4095 );  // 
//        DIAG_Queue_InsertCommand( cService_Routine_WritePWMDuty_Ch10 );
        putValue( DIAG_PWM_Ch11Duty, 0 );  // 
//        DIAG_Queue_InsertCommand( cService_Routine_WritePWMDuty_Ch11 );
        putValue( DIAG_PWM_Ch12Duty, 0 );  // 
//        DIAG_Queue_InsertCommand( cService_Routine_WritePWMDuty_Ch12 );
        putValue( DIAG_PWM_Ch13Duty, 0 );  // 
//        DIAG_Queue_InsertCommand( cService_Routine_WritePWMDuty_Ch13 );
//        putValue( pDemo_DistronicBegin, 50 );
//        putValue( pDemo_DistronicBegin, 5 );
//        putValue( pDemo_DistronicEnd, 51 );
//        putValue( pDemo_DistronicEnd, 251 );
		    putvalue(HMI_EVC_6F_ADTR_Avl,1);				// activate distronic config
//		putvalue(HMI_LDC_VSL_On_RDU,1);					// DTR on
		    putvalue(HMI_LDC_Spd_Add_RDU,251);	// set DTR value
        putValue( DIAG_DSP_p0, 0 );
        DIAG_Queue_InsertCommand( cService_Routine_StartDisplayTest );
        DIAG_CTRL_vStartNewService();
        putValue( DIAG_Optics_All_Night_Max_Ind, 0 );
        putValue( DIAG_Optics_All_Night_Min_Ind, 1 );
        putValue( DIAG_Optics_All_Day_Ind, 0 );
        putValue( DIAG_Optics_Display_Day_Max_Ind, 0 );
        putValue( DIAG_Optics_Display_Night_Max_Ind, 0 );
        putValue( DIAG_Optics_Display_Night_Min_Ind, 0 );
        putValue( HMI_IP_Brt, 0 );

        setTimer( tOptics_RPM_Reduction_Timer, 4000 );
    }
}

Routine_Lamptest_On_Trigger()
{
    DiagAktion = 0;
    if( FillCommand( ServicePhys ) ) return;
    rqBuf[0] = 0x31;
    rqBuf[1] = 0x01;
    rqBuf[2] = 0x03;
    rqBuf[3] = 0x05; //used to be 0x0C
    DIAG_SendRequest( SessionPhys, 4);
    DiagAktion = cService_Control_Lamptest_On;
    bQueueWaitForResponce = TRUE;
    putValue( DIAG_Main_ErrorStatus, "Warte auf Antwort..." );
    setTimer( tID_Get_TimeOutTimer, TimeOutMid);
}

Routine_Lamptest_Off_Trigger()
{
    DiagAktion = 0;
    if( FillCommand( ServicePhys ) ) return;
    rqBuf[0] = 0x31;
    rqBuf[1] = 0x02;
    rqBuf[2] = 0x03;  //was 03
    rqBuf[3] = 0x05;  //used to be 0x0C
    DIAG_SendRequest( SessionPhys, 4);
    DiagAktion = cService_Control_Lamptest_Off;
    bQueueWaitForResponce = TRUE;
    putValue( DIAG_Main_ErrorStatus, "Warte auf Antwort..." );
    setTimer( tID_Get_TimeOutTimer, TimeOutMid);
}

Routine_Lamptest_On_Eval()
{
    if(( rsBuf[0] == 0x71 ) && 
       ( rsBuf[1] == 0x01 ) &&
       ( rsBuf[2] == 0x03 ) &&  //was 03
       ( rsBuf[3] == 0x05 ))    //used to be 0x0C
    {
        DiagAktion = 0;
        putValue( DIAG_Main_ErrorStatus, "Successful" );
        bQueueWaitForResponce = FALSE;
        cancelTimer( tLVDS_WriteTimeOutTimer );
    }     
    else
        if( AntwortAuswertung( 1, rsBuf[0], rsBuf[2]) )
        {
            DiagAktion = 0;
            bQueueWaitForResponce = FALSE;
            cancelTimer( tLVDS_WriteTimeOutTimer );
        }
}

Routine_Lamptest_Off_Eval()
{
    if(( rsBuf[0] == 0x71 ) && 
       ( rsBuf[1] == 0x02 ) &&
       ( rsBuf[2] == 0x03 ) &&
       ( rsBuf[3] == 0x0C ))//used to be 0x0C
    {
        DiagAktion = 0;
        putValue( DIAG_Main_ErrorStatus, "Successful" );
        bQueueWaitForResponce = FALSE;
        cancelTimer( tLVDS_WriteTimeOutTimer );
    }     
    else
        if( AntwortAuswertung( 1, rsBuf[0], rsBuf[2]) )
        {
            DiagAktion = 0;
            bQueueWaitForResponce = FALSE;
            cancelTimer( tLVDS_WriteTimeOutTimer );
        }
}

on envVar DIAG_Optics_PointerIlluOff
{
  if( getValue( this ) )
  {
    if(getValue( DIAG_CTRL_IC_Type_Selector) == cKI_VS30_HL)
    {
      putValue( DIAG_PWM_Ch02Duty, 4095 );  // Pointer_Illu_HL
      DIAG_Queue_InsertCommand( cService_Routine_WritePWMDuty_Ch02 );
      DIAG_CTRL_vStartNewService();
    }
    else
    {
      putValue( DIAG_PWM_Ch01Duty, 4095 );  // Pointer_Illu_EL
      DIAG_Queue_InsertCommand( cService_Routine_WritePWMDuty_Ch01 );
      DIAG_CTRL_vStartNewService();
    }
  }
}

on envVar Display_ON_HL
{
  if( getValue( this ) )
  {
    if(getValue( DIAG_CTRL_IC_Type_Selector) == cKI_VS30_HL)
    {
      putValue( DIAG_PWM_Ch10Duty, 4095 );  // Display_Illu_HL
      DIAG_Queue_InsertCommand( cService_Routine_WritePWMDuty_Ch10 );
      DIAG_CTRL_vStartNewService();
    }
  }
}

on envVar DIAG_Optics_Display_Day_Max
{
    if( getValue( this ) )
    {
        setTimer( tOptics_LED_Preglow_Timer, 5000 );
        putValue( DIAG_Optics_LED_Status_Hot, 0 );

        DIAG_Queue_InsertCommand( cService_Routine_HardResetPhys );
        DIAG_Queue_InsertCommand( cService_Delay_Timer2000msec );
        DIAG_Queue_InsertCommand( cService_Delay_Timer2000msec );
        DIAG_Queue_InsertCommand( cService_Control_Start_DiagSession );
        DIAG_Queue_InsertCommand( cService_Delay_Timer2000msec );
        DIAG_Queue_InsertCommand( cService_SessionLevel_Supplier );
        DIAG_Queue_InsertCommand( cService_SecLevel_Supplier );
//        DIAG_Queue_InsertCommand( cService_Control_Lamptest_On );
        putValue( HMI_ISw_Stat, 4 );
        putValue( Env_VehSpd_X, SpeedoDefault );
        putValue( Env_EngRPM, TachoDefault );
        putValue( Env_EngCoolTemp, EngineCoolantTempMin );
        putValue( HMI_TankLvl, 0 );
        putValue( HMI_SwIllLvl_Ctrl_Style, 0 );  // Poti
        putValue( HMI_SwIllLvl_Raw, 254 );
        putValue( HMI_SwIllLvl_Raw, 1 );
        putValue( HMI_SwIllLvl_Raw, 200 );
        putValue( HMI_LgtSens_Night, 0 );
        putValue( HMI_LgtSens_Night2, 0 );
        putValue( HMI_LgtSens_Night3, 0 );
        putValue( DIAG_PWM_Ch00Duty, 0 );  // Telltales HL/HL+
        DIAG_Queue_InsertCommand( cService_Routine_WritePWMDuty_Ch00 );
        putValue( DIAG_PWM_Ch01Duty, 0 );  // Telltales HL/HL+
        DIAG_Queue_InsertCommand( cService_Routine_WritePWMDuty_Ch01 );
        putValue( DIAG_PWM_Ch02Duty, 0 );  // Pointers HL/HL+
        DIAG_Queue_InsertCommand( cService_Routine_WritePWMDuty_Ch02 );
        putValue( DIAG_PWM_Ch03Duty, 0 );  // Dials HL/HL+
        DIAG_Queue_InsertCommand( cService_Routine_WritePWMDuty_Ch03 );
        putValue( DIAG_PWM_Ch04Duty, 0 );  // Art-ring HL+
        DIAG_Queue_InsertCommand( cService_Routine_WritePWMDuty_Ch04 );
        putValue( DIAG_PWM_Ch05Duty, 0 );  // Bargraph Fuel HL/HL+
        DIAG_Queue_InsertCommand( cService_Routine_WritePWMDuty_Ch05 );
        putValue( DIAG_PWM_Ch06Duty, 0 );  // Bargraph Fuel HL/HL+
        DIAG_Queue_InsertCommand( cService_Routine_WritePWMDuty_Ch06 );
        putValue( DIAG_PWM_Ch10Duty, 4095 ); // Display HL/HL+
        DIAG_Queue_InsertCommand( cService_Routine_WritePWMDuty_Ch10 );
        putValue( DIAG_PWM_Ch12Duty, 0 );  // Bargraph Temperature HL/HL+
        DIAG_Queue_InsertCommand( cService_Routine_WritePWMDuty_Ch12 );
        putValue( DIAG_PWM_Ch13Duty, 0 );  // Bargraph Temperature HL/HL+
        DIAG_Queue_InsertCommand( cService_Routine_WritePWMDuty_Ch13 );
        DIAG_Queue_InsertCommand( cService_Routine_StartDisplayTest );
        putValue( pDemo_DistronicBegin, DistronicBeginMax );
        putValue( pDemo_DistronicBegin, DistronicBeginMin );
        putValue( pDemo_DistronicEnd, DistronicEndMin );
        putValue( pDemo_DistronicEnd, DistronicEndMax );
        putValue( pDemo_DistronicBegin, DistronicBeginMax );
        putValue( pDemo_DistronicBegin, DistronicBeginMin );
        putValue( pDemo_DistronicEnd, DistronicEndMin );
        putValue( pDemo_DistronicEnd, DistronicEndMax );
		putvalue(HMI_EVC_6F_ADTR_Avl,1);				// activate distronic config
//		putvalue(HMI_LDC_VSL_On_RDU,1);					// DTR on
		putvalue(HMI_LDC_Spd_Add_RDU,251);	// set DTR value
        putValue( DIAG_DSP_p0, 1 );
        DIAG_Queue_InsertCommand( cService_Routine_StartDisplayTest );
        DIAG_CTRL_vStartNewService();
        putValue( DIAG_Optics_All_Night_Max_Ind, 0 );
        putValue( DIAG_Optics_All_Night_Min_Ind, 0 );
        putValue( DIAG_Optics_All_Day_Ind, 0 );
        putValue( DIAG_Optics_Display_Day_Max_Ind, 1 );
        putValue( DIAG_Optics_Display_Night_Max_Ind, 0 );
        putValue( DIAG_Optics_Display_Night_Min_Ind, 0 );
        putValue( HMI_IP_Brt, 255 );

        setTimer( tOptics_RPM_Reduction_Timer, 4000 );
    }
}

on envVar DIAG_Optics_Display_Night_Max
{
    if( getValue( this ) )
    {
        setTimer( tOptics_LED_Preglow_Timer, 5000 );
        putValue( DIAG_Optics_LED_Status_Hot, 0 );

        DIAG_Queue_InsertCommand( cService_Routine_HardResetPhys );
        DIAG_Queue_InsertCommand( cService_Delay_Timer2000msec );
        DIAG_Queue_InsertCommand( cService_Delay_Timer2000msec );
        DIAG_Queue_InsertCommand( cService_Control_Start_DiagSession );
        DIAG_Queue_InsertCommand( cService_Delay_Timer2000msec );
        DIAG_Queue_InsertCommand( cService_SessionLevel_Supplier );
        DIAG_Queue_InsertCommand( cService_SecLevel_Supplier );
 //       DIAG_Queue_InsertCommand( cService_Control_Lamptest_On );
        putValue( HMI_ISw_Stat, 4 );
        putValue( Env_VehSpd_X, SpeedoDefault );
        putValue( Env_EngRPM, TachoDefault );
        putValue( Env_EngCoolTemp, EngineCoolantTempMin );
        putValue( HMI_TankLvl, 0 );
        putValue( HMI_SwIllLvl_Ctrl_Style, 0 );  // Poti
        putValue( HMI_SwIllLvl_Raw, 254 );
        putValue( HMI_SwIllLvl_Raw, 1 );
        putValue( HMI_SwIllLvl_Raw, 200 );
        putValue( HMI_LgtSens_Night, 1 );
        putValue( HMI_LgtSens_Night2, 1 );
        putValue( HMI_LgtSens_Night3, 1 );
        putValue( DIAG_PWM_Ch00Duty, 0 );  // Telltales HL/HL+
        DIAG_Queue_InsertCommand( cService_Routine_WritePWMDuty_Ch00 );
        putValue( DIAG_PWM_Ch01Duty, 0 );  // Telltales HL/HL+
        DIAG_Queue_InsertCommand( cService_Routine_WritePWMDuty_Ch01 );
        putValue( DIAG_PWM_Ch02Duty, 0 );  // Pointers HL/HL+
        DIAG_Queue_InsertCommand( cService_Routine_WritePWMDuty_Ch02 );
        putValue( DIAG_PWM_Ch03Duty, 0 );  // Dials HL/HL+
        DIAG_Queue_InsertCommand( cService_Routine_WritePWMDuty_Ch03 );
        putValue( DIAG_PWM_Ch04Duty, 0 );  // Art-ring HL+
        DIAG_Queue_InsertCommand( cService_Routine_WritePWMDuty_Ch04 );
        putValue( DIAG_PWM_Ch05Duty, 0 );  // Bargraph Fuel HL/HL+
        DIAG_Queue_InsertCommand( cService_Routine_WritePWMDuty_Ch05 );
        putValue( DIAG_PWM_Ch06Duty, 0 );  // Bargraph Fuel HL/HL+
        DIAG_Queue_InsertCommand( cService_Routine_WritePWMDuty_Ch06 );
        putValue( DIAG_PWM_Ch10Duty, 4095 ); // Display HL/HL+
        DIAG_Queue_InsertCommand( cService_Routine_WritePWMDuty_Ch10 );
        putValue( DIAG_PWM_Ch12Duty, 0 );  // Bargraph Temperature HL/HL+
        DIAG_Queue_InsertCommand( cService_Routine_WritePWMDuty_Ch12 );
        putValue( DIAG_PWM_Ch13Duty, 0 );  // Bargraph Temperature HL/HL+
        DIAG_Queue_InsertCommand( cService_Routine_WritePWMDuty_Ch13 );
        DIAG_Queue_InsertCommand( cService_Routine_StartDisplayTest );
        putValue( pDemo_DistronicBegin, DistronicBeginMax );
        putValue( pDemo_DistronicBegin, DistronicBeginMin );
        putValue( pDemo_DistronicEnd, DistronicEndMin );
        putValue( pDemo_DistronicEnd, DistronicEndMax );
        putValue( pDemo_DistronicBegin, DistronicBeginMax );
        putValue( pDemo_DistronicBegin, DistronicBeginMin );
        putValue( pDemo_DistronicEnd, DistronicEndMin );
        putValue( pDemo_DistronicEnd, DistronicEndMax );
		putvalue(HMI_EVC_6F_ADTR_Avl,1);				// activate distronic config
//		putvalue(HMI_LDC_VSL_On_RDU,1);					// DTR on
		putvalue(HMI_LDC_Spd_Add_RDU,251);	// set DTR value
        putValue( DIAG_DSP_p0, 1 );
        DIAG_Queue_InsertCommand( cService_Routine_StartDisplayTest );
        DIAG_CTRL_vStartNewService();
        putValue( DIAG_Optics_All_Night_Max_Ind, 0 );
        putValue( DIAG_Optics_All_Night_Min_Ind, 0 );
        putValue( DIAG_Optics_All_Day_Ind, 0 );
        putValue( DIAG_Optics_Display_Day_Max_Ind, 0 );
        putValue( DIAG_Optics_Display_Night_Max_Ind, 1 );
        putValue( DIAG_Optics_Display_Night_Min_Ind, 0 );
        putValue( HMI_IP_Brt, 0 );

        setTimer( tOptics_RPM_Reduction_Timer, 4000 );
    }
}

on envVar DIAG_Optics_Display_Night_Min
{
    if( getValue( this ) )
    {
        setTimer( tOptics_LED_Preglow_Timer, 5000 );
        putValue( DIAG_Optics_LED_Status_Hot, 0 );

        DIAG_Queue_InsertCommand( cService_Routine_HardResetPhys );
        DIAG_Queue_InsertCommand( cService_Delay_Timer2000msec );
        DIAG_Queue_InsertCommand( cService_Delay_Timer2000msec );
        DIAG_Queue_InsertCommand( cService_Control_Start_DiagSession );
        DIAG_Queue_InsertCommand( cService_Delay_Timer2000msec );
        DIAG_Queue_InsertCommand( cService_SessionLevel_Supplier );
        DIAG_Queue_InsertCommand( cService_SecLevel_Supplier );
 //       DIAG_Queue_InsertCommand( cService_Control_Lamptest_On );
        putValue( HMI_ISw_Stat, 4 );
        putValue( Env_VehSpd_X, SpeedoDefault );
        putValue( Env_EngRPM, TachoDefault );
        putValue( Env_EngCoolTemp, EngineCoolantTempMin );
        putValue( HMI_TankLvl, 0 );
        putValue( HMI_SwIllLvl_Ctrl_Style, 0 );  // Poti
        putValue( HMI_SwIllLvl_Raw, 254 );
        putValue( HMI_SwIllLvl_Raw, 1 );
        putValue( HMI_SwIllLvl_Raw, 0 );
        putValue( HMI_LgtSens_Night, 1 );
        putValue( HMI_LgtSens_Night2, 1 );
        putValue( HMI_LgtSens_Night3, 1 );
        putValue( DIAG_PWM_Ch00Duty, 0 );  // Telltales HL/HL+
        DIAG_Queue_InsertCommand( cService_Routine_WritePWMDuty_Ch00 );
        putValue( DIAG_PWM_Ch01Duty, 0 );  // Telltales HL/HL+
        DIAG_Queue_InsertCommand( cService_Routine_WritePWMDuty_Ch01 );
        putValue( DIAG_PWM_Ch02Duty, 0 );  // Pointers HL/HL+
        DIAG_Queue_InsertCommand( cService_Routine_WritePWMDuty_Ch02 );
        putValue( DIAG_PWM_Ch03Duty, 0 );  // Dials HL/HL+
        DIAG_Queue_InsertCommand( cService_Routine_WritePWMDuty_Ch03 );
        putValue( DIAG_PWM_Ch04Duty, 0 );  // Art-ring HL+
        DIAG_Queue_InsertCommand( cService_Routine_WritePWMDuty_Ch04 );
        putValue( DIAG_PWM_Ch05Duty, 0 );  // Bargraph Fuel HL/HL+
        DIAG_Queue_InsertCommand( cService_Routine_WritePWMDuty_Ch05 );
        putValue( DIAG_PWM_Ch06Duty, 0 );  // Bargraph Fuel HL/HL+
        DIAG_Queue_InsertCommand( cService_Routine_WritePWMDuty_Ch06 );
        putValue( DIAG_PWM_Ch10Duty, 4095 ); // Display HL/HL+
        DIAG_Queue_InsertCommand( cService_Routine_WritePWMDuty_Ch10 );
        putValue( DIAG_PWM_Ch12Duty, 0 );  // Bargraph Temperature HL/HL+
        DIAG_Queue_InsertCommand( cService_Routine_WritePWMDuty_Ch12 );
        putValue( DIAG_PWM_Ch13Duty, 0 );  // Bargraph Temperature HL/HL+
        DIAG_Queue_InsertCommand( cService_Routine_WritePWMDuty_Ch13 );
        DIAG_Queue_InsertCommand( cService_Routine_StartDisplayTest );
        putValue( pDemo_DistronicBegin, DistronicBeginMax );
        putValue( pDemo_DistronicBegin, DistronicBeginMin );
        putValue( pDemo_DistronicEnd, DistronicEndMin );
        putValue( pDemo_DistronicEnd, DistronicEndMax );
        putValue( pDemo_DistronicBegin, DistronicBeginMax );
        putValue( pDemo_DistronicBegin, DistronicBeginMin );
        putValue( pDemo_DistronicEnd, DistronicEndMin );
        putValue( pDemo_DistronicEnd, DistronicEndMax );
		putvalue(HMI_EVC_6F_ADTR_Avl,1);				// activate distronic config
//		putvalue(HMI_LDC_VSL_On_RDU,1);					// DTR on
		putvalue(HMI_LDC_Spd_Add_RDU,251);	// set DTR value
        putValue( DIAG_DSP_p0, 1 );
        DIAG_Queue_InsertCommand( cService_Routine_StartDisplayTest );
        DIAG_CTRL_vStartNewService();
        putValue( DIAG_Optics_All_Night_Max_Ind, 0 );
        putValue( DIAG_Optics_All_Night_Min_Ind, 0 );
        putValue( DIAG_Optics_All_Day_Ind, 0 );
        putValue( DIAG_Optics_Display_Day_Max_Ind, 0 );
        putValue( DIAG_Optics_Display_Night_Max_Ind, 0 );
        putValue( DIAG_Optics_Display_Night_Min_Ind, 1 );
        putValue( HMI_IP_Brt, 0 );

        setTimer( tOptics_RPM_Reduction_Timer, 4000 );
    }
}

on envVar DIAG_Optics_LED_Preglow_Activate
{
    if( getValue( this ) )
    {
        putValue( DIAG_Optics_LED_Preglow_Timer, 30 );  // 30 Minuten
        setTimer( tOptics_LED_Preglow_Timer, cOptics_LED_Preglow_Timer_1_min );
        putValue( DIAG_Optics_LED_Status_Hot, 0 );

        DIAG_Queue_InsertCommand( cService_Routine_HardResetPhys );
        DIAG_Queue_InsertCommand( cService_Delay_Timer2000msec );
        DIAG_Queue_InsertCommand( cService_Delay_Timer2000msec );
        DIAG_Queue_InsertCommand( cService_Control_Start_DiagSession );
        DIAG_Queue_InsertCommand( cService_Delay_Timer2000msec );
        DIAG_Queue_InsertCommand( cService_SessionLevel_Supplier );
        DIAG_Queue_InsertCommand( cService_SecLevel_Supplier );
        DIAG_Queue_InsertCommand( cService_Control_Lamptest_On );
        putValue( HMI_ISw_Stat, 4 );
        putValue( HMI_PT_Rdy_IndLmp_Rq, 1 );
        putValue( HMI_HybPwr_Disp_Rq, 100 );
        putValue( Env_VehSpd_X, SpeedoDefault );
        putValue( Env_EngCoolTemp, EngineCoolantTempMax );
        putValue( HMI_EngRun_Stat, 3 );
        putValue( Env_EngRPM, TachoDefault );
        putValue( HMI_TankLvl, 100 );
        putValue( HMI_SwIllLvl_Ctrl_Style, 0 );  // Poti
        putValue( HMI_SwIllLvl_Raw, 254 );
        putValue( HMI_SwIllLvl_Raw, 1 );
        putValue( HMI_SwIllLvl_Raw, 200 );
        putValue( HMI_LgtSens_Night, 1 );
        putValue( HMI_LgtSens_Night2, 1 );
        putValue( HMI_LgtSens_Night3, 1 );
      
        if(getValue( DIAG_CTRL_IC_Type_Selector) == cKI_VS30_HL)
        {
          putValue( DIAG_PWM_Ch00Duty, 0 );  // Telltales HL/HL+
          DIAG_Queue_InsertCommand( cService_Routine_WritePWMDuty_Ch00 );
          putValue( DIAG_PWM_Ch01Duty, 0 );  // Telltales HL/HL+
          DIAG_Queue_InsertCommand( cService_Routine_WritePWMDuty_Ch01 );
          putValue( DIAG_PWM_Ch02Duty, 0 );  // Pointers HL/HL+
          DIAG_Queue_InsertCommand( cService_Routine_WritePWMDuty_Ch02 );
          putValue( DIAG_PWM_Ch03Duty, 0 );  // Dials HL/HL+
          DIAG_Queue_InsertCommand( cService_Routine_WritePWMDuty_Ch03 );
          putValue( DIAG_PWM_Ch04Duty, 0 );  // Art-ring HL+
          DIAG_Queue_InsertCommand( cService_Routine_WritePWMDuty_Ch04 );
          putValue( DIAG_PWM_Ch05Duty, 0 );  // Bargraph Fuel HL/HL+
          DIAG_Queue_InsertCommand( cService_Routine_WritePWMDuty_Ch05 );
          putValue( DIAG_PWM_Ch06Duty, 0 );  // Bargraph Fuel HL/HL+
          DIAG_Queue_InsertCommand( cService_Routine_WritePWMDuty_Ch06 );
          putValue( DIAG_PWM_Ch10Duty, 4095 ); // Display HL/HL+
          DIAG_Queue_InsertCommand( cService_Routine_WritePWMDuty_Ch10 );
          putValue( DIAG_PWM_Ch12Duty, 0 );  // Bargraph Temperature HL/HL+
          DIAG_Queue_InsertCommand( cService_Routine_WritePWMDuty_Ch12 );
          putValue( DIAG_PWM_Ch13Duty, 0 );  // Bargraph Temperature HL/HL+
          DIAG_Queue_InsertCommand( cService_Routine_WritePWMDuty_Ch13 );
        }
        else
        {
          putValue( DIAG_PWM_Ch00Duty, 0 );  // Dials LL/ML
          DIAG_Queue_InsertCommand( cService_Routine_WritePWMDuty_Ch00 );
          putValue( DIAG_PWM_Ch01Duty, 0 );  // Pointers LL/ML
          DIAG_Queue_InsertCommand( cService_Routine_WritePWMDuty_Ch01 );
          putValue( DIAG_PWM_Ch02Duty, 0 );  // Telltales LL/ML
          DIAG_Queue_InsertCommand( cService_Routine_WritePWMDuty_Ch02 );
          putValue( DIAG_PWM_Ch03Duty, 0 );  // Telltales LL/ML
          DIAG_Queue_InsertCommand( cService_Routine_WritePWMDuty_Ch03 );
          putValue( DIAG_PWM_Ch04Duty, 0 );  // Display LL/ML
          DIAG_Queue_InsertCommand( cService_Routine_WritePWMDuty_Ch04 );
        }
        putValue( pDemo_DistronicBegin, DistronicBeginMax );
        putValue( pDemo_DistronicBegin, DistronicBeginMin );
        putValue( pDemo_DistronicEnd, DistronicEndMin );
        putValue( pDemo_DistronicEnd, DistronicEndMax );
        putValue( pDemo_DistronicBegin, DistronicBeginMax );
        putValue( pDemo_DistronicBegin, DistronicBeginMin );
        putValue( pDemo_DistronicEnd, DistronicEndMin );
        putValue( pDemo_DistronicEnd, DistronicEndMax );
		    putvalue(HMI_EVC_6F_ADTR_Avl,1);				// activate distronic config
//		putvalue(HMI_LDC_VSL_On_RDU,1);					// DTR on
		    putvalue(HMI_LDC_Spd_Add_RDU,251);	// set DTR value
        putValue( DIAG_DSP_p0, 0 );
        DIAG_Queue_InsertCommand( cService_Routine_StartDisplayTest );
        DIAG_CTRL_vStartNewService();
        putValue( DIAG_Optics_All_Night_Max_Ind, 0 );
        putValue( DIAG_Optics_All_Night_Min_Ind, 0 );
        putValue( DIAG_Optics_All_Day_Ind, 0 );
        putValue( DIAG_Optics_Display_Day_Max_Ind, 0 );
        putValue( DIAG_Optics_Display_Night_Max_Ind, 0 );
        putValue( DIAG_Optics_Display_Night_Min_Ind, 0 );
        putValue( HMI_IP_Brt, 100 );

        setTimer( tOptics_RPM_Reduction_Timer, 4000 );
    }
}

on envVar DIAG_Optics_LED_Preglow_Timer_Reset
{
    putValue( DIAG_Optics_LED_Preglow_Timer, 30 );  // 30 Minuten
    setTimer( tOptics_LED_Preglow_Timer, cOptics_LED_Preglow_Timer_1_min );
    putValue( DIAG_Optics_LED_Status_Hot, 0 );
}

on timer tOptics_LED_Preglow_Timer
{
    byte countdown_timer;

    countdown_timer = getValue( DIAG_Optics_LED_Preglow_Timer );
    if( countdown_timer > 0 )  // count's only minutes !!!
    {
        setTimer( tOptics_LED_Preglow_Timer, cOptics_LED_Preglow_Timer_1_min );
        putValue( DIAG_Optics_LED_Preglow_Timer, countdown_timer - 1 );
        putValue( DIAG_Optics_LED_Status_Hot, 0 );
    }
    if( countdown_timer == 0 )
    {
        putValue( DIAG_Optics_LED_Status_Hot, 1 );
    }
}

on envVar DIAG_Optics_Display_Black
{
    if( getValue( this ) )
    {
        putValue( DIAG_DSP_p0, 1 );
        DIAG_Queue_InsertCommand( cService_Routine_StartDisplayTest );
        DIAG_CTRL_vStartNewService();
    }
}

on envVar DIAG_Optics_Display_White
{
    if( getValue( this ) )
    {
        putValue( DIAG_DSP_p0, 0 );
        DIAG_Queue_InsertCommand( cService_Routine_StartDisplayTest );
        DIAG_CTRL_vStartNewService();
    }
}

on envVar DIAG_Optics_Display_Red
{
    if( getValue( this ) )
    {
        putValue( DIAG_DSP_p0, 2 );
        DIAG_Queue_InsertCommand( cService_Routine_StartDisplayTest );
        DIAG_CTRL_vStartNewService();
    }
}

on envVar DIAG_Optics_Display_Green
{
    if( getValue( this ) )
    {
        putValue( DIAG_DSP_p0, 3 );
        DIAG_Queue_InsertCommand( cService_Routine_StartDisplayTest );
        DIAG_CTRL_vStartNewService();
    }
}

on envVar DIAG_Optics_Display_Blue
{
    if( getValue( this ) )
    {
        putValue( DIAG_DSP_p0, 4 );
        DIAG_Queue_InsertCommand( cService_Routine_StartDisplayTest );
        DIAG_CTRL_vStartNewService();
    }
}

Warp_vReadHUDDataFromFile()
{
    char cHelp[270];
    long lResult;
    int iFileDialog;
    int i,j;

    getValue( DIAG_Warp_WriteHUDFileNameDialog, cWarp_FileName );
    // cFilePath bestimmen
    for( i=elCount(cHelp)-1; i>0; i--)
    {
        if(cHelp[i] == '\\')
        {
            strncpy(cWarp_FilePath, cHelp, i+2 );
            j=0;
            i++;
            for( ; i<250; i++)
                cWarp_FileName[j++] = cHelp[i];
            break;
        }
    }
    write("filename : %s", cWarp_FileName );
}

void Warp_vPutStatusText (char cText[])
{
    putValue( DIAG_Warp_StatusBar, cText );
}

Warp_Data_Vehicle_Write_Trigger()
{
    Warp_vReadVehicleDataFromFile();
    Warp_ReadFileContent();
    Warp_WriteDataToIC( 0x39 );
}

Warp_Data_Clear_HUD_Write_Trigger()
{
    Warp_vReadClearDataFromFile();
    Warp_ReadFileContent();
    Warp_WriteDataToIC( 0x38 );
}

Warp_Data_HUD_Write_Trigger()
{
    Warp_vReadHUDDataFromFile();
    Warp_ReadFileContent();
    Warp_WriteDataToIC( 0x38 );
}

Warp_Data_Write_Eval()
{
    write("Warp_Write_Eval" );
    if(   ( rsBuf[0] == 0x6E ) && 
          ( rsBuf[1] == 0x01 ) &&
        ( ( rsBuf[2] == 0x38 ) || ( rsBuf[2] == 0x39 ) ) )
    {
        DiagAktion = 0;

        putValue( DIAG_Warp_StatusBar, "Successful" );
        bQueueWaitForResponce = FALSE;
        cancelTimer( tWarp_TimeOutTimer );
    }
    else
        if( AntwortAuswertung( 1, rsBuf[0], rsBuf[2]) )
        {
            DiagAktion = 0;
            putValue( DIAG_Warp_StatusBar, "NOT Successful" );
            bQueueWaitForResponce = FALSE;
            cancelTimer( tWarp_TimeOutTimer );
        }
}

byte Warp_ReadFileContent()
{
    long lReadedChars;
    char cStartChar[1];
    char cCharBuffer[3];
    int i;


    Warp_lFileHandle = DIAG_lOpenFileForRead( cWarp_FileName );
    if( Warp_lFileHandle != 0 )
    {
        Warp_vPutStatusText( "FILE OPENED" );
        lReadedChars=0;
        lReadedChars = dllReadNBytes(3, cCharBuffer);
        if(lReadedChars != 3) { dllFClose(); return 0x10;} // empty file
        if(cCharBuffer[0]==' ') // Look for "<space>" as first char in line 
        {
            cCharBuffer[0] = cCharBuffer[1];
            cCharBuffer[1] = cCharBuffer[2];
            lReadedChars=dllReadNBytes(1, cStartChar); // skip <space> at next position
        }
        Warping_data[0] = DIAG_bAsciiToHex( cCharBuffer );
        for( i =1; i<755; i++ )
        {
            lReadedChars = dllReadNBytes(2, cCharBuffer);
            if(lReadedChars != 2 ) { dllFClose(); return 0x13;}  // file not long enough
            Warping_data[i] = DIAG_bAsciiToHex( cCharBuffer );
            lReadedChars=dllReadNBytes(1, cStartChar); // skip <space> at next position
        }
        lReadedChars = dllReadNBytes(2, cCharBuffer);  // read last value, there must be no <space> behind
        if(lReadedChars != 2 ) { dllFClose(); return 0x13;}  // file not long enough
        Warping_data[755] = DIAG_bAsciiToHex( cCharBuffer );
    }
    else
    {
        Warp_vPutStatusText( "ERROR: NOT ABLE TO OPEN FILE" );
        bQueueWaitForResponce = FALSE;
        return 0x12;
    }
    write( "File IN:  0:%X 1:%X 2:%X 3:%X   753:%X 754:%X 755:%X ",Warping_data[0],Warping_data[1],Warping_data[2],Warping_data[3],Warping_data[753],Warping_data[754],Warping_data[755] );
    return 0;  // OK
}

Warp_vReadVehicleDataFromFile()
{
    char cHelp[270];
    long lResult;
    int iFileDialog;
    int i,j;

    getValue( DIAG_Warp_WriteVehicleFileNameDialog, cWarp_FileName );
    // cFilePath bestimmen
    for( i=elCount(cHelp)-1; i>0; i--)
    {
        if(cHelp[i] == '\\')
        {
            strncpy(cWarp_FilePath, cHelp, i+2 );
            j=0;
            i++;
            for( ; i<250; i++)
                cWarp_FileName[j++] = cHelp[i];
            break;
        }
    }
    write("filename : %s", cWarp_FileName );
}

Warp_vReadClearDataFromFile()
{
    char cHelp[270];
    long lResult;
    int iFileDialog;
    int i,j;

    getValue( DIAG_Warp_WriteClearFileNameDialog, cWarp_FileName );
    // cFilePath bestimmen
    for( i=elCount(cHelp)-1; i>0; i--)
    {
        if(cHelp[i] == '\\')
        {
            strncpy(cWarp_FilePath, cHelp, i+2 );
            j=0;
            i++;
            for( ; i<250; i++)
                cWarp_FileName[j++] = cHelp[i];
            break;
        }
    }
    write("filename : %s", cWarp_FileName );
}

Warp_WriteDataToIC( byte DataType )
{
    word j;

    DiagAktion = 0;
    if( FillCommand( ServicePhys ) ) return;
    rqBuf[0] = 0x2E;
    rqBuf[1] = 0x01;
    rqBuf[2] = DataType;
    for( j=0; j<756; j++ )
    {
        rqBuf[j+3] = Warping_data[j];
 //       write( "Data ON BUF:  %d:%X ",j, rqBuf[j] );
    }
    write( "Data ON BUF:  0:%X 1:%X 2:%X 3:%X 4:%X   753:%X 754:%X 755:%X ",rqBuf[0],rqBuf[1],rqBuf[2],rqBuf[3],rqBuf[4],rqBuf[756],rqBuf[757],rqBuf[758] );
    DIAG_SendRequest( SessionPhys, 759 );
    DiagAktion = cService_Control_Warp_Data_Write;
    putValue( DIAG_Warp_StatusBar, "Warte auf Antwort..." );
    setTimer( tWarp_TimeOutTimer, TimeOutLong );
//    bQueueWaitForResponce = TRUE;
}

on timer tWarp_TimeOutTimer
{
    putValue( DIAG_Warp_StatusBar, "Timeout der Antwort!" );
    bQueueWaitForResponce = FALSE;
    DIAG_CTRL_vStartNewService();
}

Warp_Data_Clear_Vehicle_Write_Trigger()
{
    Warp_vReadClearDataFromFile();
    Warp_ReadFileContent();
    Warp_WriteDataToIC( 0x39 );
}

on envVar DIAG_Warp_WriteClearWarpMatrixVehicle
{
    if( getValue( this ) )
    {
        DIAG_Queue_InsertCommand( cService_SessionLevelCheck_Supplier );
        DIAG_Queue_InsertCommand( cService_SessionLevel_Supplier );
        DIAG_Queue_InsertCommand( cService_SecLevel_Supplier );
        DIAG_Queue_InsertCommand( cService_Control_Warp_Data_Clear_Vehicle_Write );
        DIAG_CTRL_vStartNewService();
    }
}

on envVar DIAG_Warp_WriteClearWarpMatrixHUD
{
    if( getValue( this ) )
    {
        DIAG_Queue_InsertCommand( cService_SessionLevelCheck_Supplier );
        DIAG_Queue_InsertCommand( cService_SessionLevel_Supplier );
        DIAG_Queue_InsertCommand( cService_SecLevel_Supplier );
        DIAG_Queue_InsertCommand( cService_Control_Warp_Data_Clear_HUD_Write );
        DIAG_CTRL_vStartNewService();
    }
}

on envVar DIAG_Warp_WriteMatrixVehicle
{
    if( getValue( this ) )
    {
        DIAG_Queue_InsertCommand( cService_SessionLevelCheck_Supplier );
        DIAG_Queue_InsertCommand( cService_SessionLevel_Supplier );
        DIAG_Queue_InsertCommand( cService_SecLevel_Supplier );
        DIAG_Queue_InsertCommand( cService_Control_Warp_Data_Vehicle_Write );
        DIAG_CTRL_vStartNewService();
    }
}

on envVar DIAG_Warp_WriteMatrixHUD
{
    if( getValue( this ) )
    {
        DIAG_Queue_InsertCommand( cService_SessionLevelCheck_Supplier );
        DIAG_Queue_InsertCommand( cService_SessionLevel_Supplier );
        DIAG_Queue_InsertCommand( cService_SecLevel_Supplier );
        DIAG_Queue_InsertCommand( cService_Control_Warp_Data_HUD_Write );
        DIAG_CTRL_vStartNewService();
    }
}

on envVar DIAG_Optics_BargraphOff
{
  if( getValue( this ) )
  {
    if(getValue( DIAG_CTRL_IC_Type_Selector) == cKI_VS30_HL)
    {
      putValue( DIAG_PWM_Ch05Duty, 4095 );  // Bargraph_Fuel_HL_only
      DIAG_Queue_InsertCommand( cService_Routine_WritePWMDuty_Ch05 );
      putValue( DIAG_PWM_Ch06Duty, 4095 );  // Bargraph_Fuel_HL_only
      DIAG_Queue_InsertCommand( cService_Routine_WritePWMDuty_Ch06 );
      putValue( DIAG_PWM_Ch12Duty, 4095 );  // Bargraph_Temperature_HL_only
      DIAG_Queue_InsertCommand( cService_Routine_WritePWMDuty_Ch12 );
      putValue( DIAG_PWM_Ch13Duty, 4095 );  // Bargraph_Temperature_HL_only
      DIAG_Queue_InsertCommand( cService_Routine_WritePWMDuty_Ch13 );
      DIAG_CTRL_vStartNewService();
    }
  }
}

on envVar DIAG_Optics_ScaleIlluOff
{
  if( getValue( this ) )
  {
    if(getValue( DIAG_CTRL_IC_Type_Selector) == cKI_VS30_HL)
    {
      putValue( DIAG_PWM_Ch03Duty, 4095 );  // Dial(Scale)_HL
      DIAG_Queue_InsertCommand( cService_Routine_WritePWMDuty_Ch03 );
      DIAG_CTRL_vStartNewService();
    }
    else
    {
      putValue( DIAG_PWM_Ch00Duty, 4095 );  // Dial(Scale)_EL
      DIAG_Queue_InsertCommand( cService_Routine_WritePWMDuty_Ch00 );
      DIAG_CTRL_vStartNewService();
    }
  }
}

on envVar DIAG_Optics_DisplayOff
{
  if( getValue( this ) )
  {
    if(getValue( DIAG_CTRL_IC_Type_Selector) == cKI_VS30_HL)
    {
      putValue( DIAG_PWM_Ch10Duty, 0 );  // Display_Illu(BackLight)_HL
      DIAG_Queue_InsertCommand( cService_Routine_WritePWMDuty_Ch10 );
      DIAG_CTRL_vStartNewService();
    }
    else
    {
      putValue( DIAG_PWM_Ch04Duty, 4095 );  // Display_Illu(BackLight)_EL
      DIAG_Queue_InsertCommand( cService_Routine_WritePWMDuty_Ch04 );
      DIAG_CTRL_vStartNewService();
    }
  }
}

on envVar DIAG_Optics_TellTaless_PWM_Off
{
  if( getValue( this ) )
  {
    if(getValue( DIAG_CTRL_IC_Type_Selector) == cKI_VS30_HL)
    {
      putValue( DIAG_PWM_Ch00Duty, 4095 );  // Telltales_HL
      DIAG_Queue_InsertCommand( cService_Routine_WritePWMDuty_Ch00 );
      putValue( DIAG_PWM_Ch01Duty, 4095 );  // Telltales_HL
      DIAG_Queue_InsertCommand( cService_Routine_WritePWMDuty_Ch01 );
      DIAG_CTRL_vStartNewService();
    }
    else
    {
      putValue( DIAG_PWM_Ch02Duty, 4095 );  // Telltales_EL
      DIAG_Queue_InsertCommand( cService_Routine_WritePWMDuty_Ch02 );
      putValue( DIAG_PWM_Ch03Duty, 4095 );  // Telltales_EL
      DIAG_Queue_InsertCommand( cService_Routine_WritePWMDuty_Ch03 );
      DIAG_CTRL_vStartNewService();
    }
  }
}

on envVar DIAG_Optics_ART_Off
{
  if( getValue( this ) )
  {
    if(getValue( DIAG_CTRL_IC_Type_Selector) == cKI_VS30_HL)
    {
      putValue( DIAG_PWM_Ch04Duty, 4095 );  // Art_Ring_HL_only 
      DIAG_Queue_InsertCommand( cService_Routine_WritePWMDuty_Ch04 );
      DIAG_CTRL_vStartNewService();
    }
  }
}

on envVar DIAG_Optics_TellTaless_On_Off
{
    if( getValue( this ) )
    {
        DIAG_Queue_InsertCommand( cService_Control_Lamptest_On );
		    putvalue(HMI_EVC_6F_ADTR_Avl,1);				// activate distronic config
//		  putvalue(HMI_LDC_VSL_On_RDU,1);					// DTR on
		    putvalue(HMI_LDC_Spd_Add_RDU,251);	    // set DTR value
        putValue( pDemo_DistronicBegin, DistronicBeginMax );
        putValue( pDemo_DistronicBegin, DistronicBeginMin );
        putValue( pDemo_DistronicEnd, DistronicEndMin );
        putValue( pDemo_DistronicEnd, DistronicEndMax );
    }
    else
    {
        DIAG_Queue_InsertCommand( cService_Control_Lamptest_Off );
        putValue( pDemo_DistronicBegin, 1 );
        putValue( pDemo_DistronicBegin, 0 );
        putValue( pDemo_DistronicEnd, 1 );
        putValue( pDemo_DistronicEnd, 0 );
    }
}

on envVar DIAG_Optics_Bargraph_Active_Passive
{
    if( getValue( this ) == 1 )
    {
        putValue( Env_EngCoolTemp, EngineCoolantTempMax );
        putValue( HMI_TankLvl, 100 );
        putValue( HMI_HybPwr_Disp_Rq, 100 );
    }
    else
    {
        putValue( Env_EngCoolTemp, EngineCoolantTempMin );
        putValue( HMI_TankLvl, 0 );
        putValue( HMI_HybPwr_Disp_Rq, -100 );
    }
}

on timer tOptics_RPM_Reduction_Timer
{
        putValue( Env_EngRPM, TachoDefault );
}

on envVar HMI_with_wo_HU
{
    if(getValue(this) == 0x01)
    {
        putValue(DIAG_MRW_Addr, 0x1031);
        putValue(DIAG_MRW_Length, 0x1);
        putValue(DIAG_MRW_Data000, 0x17); // with HU with ADC screens active
        DIAG_Queue_InsertCommand( cService_Control_Start_DiagSession );
        DIAG_Queue_InsertCommand( cService_Delay_Timer2000msec );
        DIAG_Queue_InsertCommand( cService_SessionLevel_Supplier );
        DIAG_Queue_InsertCommand( cService_SecLevel_Supplier );
        DIAG_Queue_InsertCommand( cService_Routine_MRW_Write );
        DIAG_Queue_InsertCommand( cService_Routine_HardResetPhys );
        DIAG_CTRL_vStartNewService();
    }
    else
    {
        putValue(DIAG_MRW_Addr, 0x1031);
        putValue(DIAG_MRW_Length, 0x1);
        putValue(DIAG_MRW_Data000, 0x07); //wo HU with ADC screens active
        DIAG_Queue_InsertCommand( cService_Control_Start_DiagSession );
        DIAG_Queue_InsertCommand( cService_Delay_Timer2000msec );
        DIAG_Queue_InsertCommand( cService_SessionLevel_Supplier );
        DIAG_Queue_InsertCommand( cService_SecLevel_Supplier );
        DIAG_Queue_InsertCommand( cService_Routine_MRW_Write );
        DIAG_Queue_InsertCommand( cService_Routine_HardResetPhys );
        DIAG_CTRL_vStartNewService();
    }
}  


ID_SDF_AC_SAP_Get()
{
    dword adresse;
    byte bLength;

    adresse = DIAG__cdwMRWStartAdr_AC_IntFlash + SDF_nAdrSAP_Nr_AC;
    bLength = 10;

    DiagAktion = 0;
    if( FillCommand( ServicePhys ) ) return;
    {
        rqBuf[0] = 0x23;
        rqBuf[1] = 0x14;
        rqBuf[2] = ( adresse & 0xFF000000 ) >> 24;
        rqBuf[3] = ( adresse & 0x00FF0000 ) >> 16;
        rqBuf[4] = ( adresse & 0x0000FF00 ) >> 8;
        rqBuf[5] = ( adresse & 0x000000FF );
        rqBuf[6] = bLength;
        DIAG_SendRequest( SessionPhys, 7);
    }
    DiagAktion = cService_Routine_AC_SDF_SAP_Nr;
    bQueueWaitForResponce = TRUE; 
    putValue( DIAG_CAL_StatusBar, "Waiting for answer..." );
    setTimer( tCAL_ReadTimeOutTimer, TimeOut );
}

ID_SDF_AC_SAP_Eval()
{
    char text[12];
    byte i,pos;

    if( rsBuf[0] == 0x63 )
    {
        pos = 1;

        for( i=0;i<10;i++)
        {
            text[ i ] = rsBuf[ pos + i ];
        }
        text[ i ]= '\0';
        putValue( DIAG_ID_SDF_AC_Nr, text );

        DiagAktion = 0;
        putValue( DIAG_Main_ErrorStatus, "Successful" );
        bQueueWaitForResponce = FALSE;
        cancelTimer( tID_Get_TimeOutTimer );
        DIAG_CTRL_vStartNewService();
    }     
    else
        if( AntwortAuswertung( 1, rsBuf[0], rsBuf[2]) )
        {
            DiagAktion = 0;
            bQueueWaitForResponce = FALSE;
            cancelTimer( tID_Get_TimeOutTimer );
            DIAG_CTRL_vStartNewService();
        }

}

ID_GC_EL_SDF_SAP_Get()
{
    dword adresse;
    byte bLength;

    adresse = DIAG__cdwMRWStartAdr_GC_IntFlash + SDF_nAdrSAP_Nr_GC_EL;
    bLength = 10;

    DiagAktion = 0;
    if( FillCommand( ServicePhys ) ) return;
    {
        rqBuf[0] = 0x23;
        rqBuf[1] = 0x14;
        rqBuf[2] = ( adresse & 0xFF000000 ) >> 24;
        rqBuf[3] = ( adresse & 0x00FF0000 ) >> 16;
        rqBuf[4] = ( adresse & 0x0000FF00 ) >> 8;
        rqBuf[5] = ( adresse & 0x000000FF );
        rqBuf[6] = bLength;
        DIAG_SendRequest( SessionPhys, 7);
    }
    DiagAktion = cService_Routine_GC_EL_SDF_SAP_Nr;
    bQueueWaitForResponce = TRUE; 
    putValue( DIAG_CAL_StatusBar, "Waiting for answer..." );
    setTimer( tCAL_ReadTimeOutTimer, TimeOut );
}

ID_SDF_GC_EL_SAP_Eval()
{
    char text[12];
    byte i,pos;

    if( rsBuf[0] == 0x63 )
    {
        pos = 1;

        for( i=0;i<10;i++)
        {
            text[ i ] = rsBuf[ pos + i ];
        }
        text[ i ]= '\0';
        putValue( DIAG_ID_SDF_GC_Nr, text );

        DiagAktion = 0;
        putValue( DIAG_Main_ErrorStatus, "Successful" );
        bQueueWaitForResponce = FALSE;
        cancelTimer( tID_Get_TimeOutTimer );
        DIAG_CTRL_vStartNewService();
    }     
    else
        if( AntwortAuswertung( 1, rsBuf[0], rsBuf[2]) )
        {
            DiagAktion = 0;
            bQueueWaitForResponce = FALSE;
            cancelTimer( tID_Get_TimeOutTimer );
            DIAG_CTRL_vStartNewService();
        }

}

ID_SDF_GC_EL_SAP_Get()
{
    dword adresse;
    byte bLength;

    adresse = DIAG__cdwMRWStartAdr_GC_IntFlash + SDF_nAdrSAP_Nr_GC_EL;
    bLength = 10;

    DiagAktion = 0;
    if( FillCommand( ServicePhys ) ) return;
    {
        rqBuf[0] = 0x23;
        rqBuf[1] = 0x14;
        rqBuf[2] = ( adresse & 0xFF000000 ) >> 24;
        rqBuf[3] = ( adresse & 0x00FF0000 ) >> 16;
        rqBuf[4] = ( adresse & 0x0000FF00 ) >> 8;
        rqBuf[5] = ( adresse & 0x000000FF );
        rqBuf[6] = bLength;
        DIAG_SendRequest( SessionPhys, 7);
    }
    DiagAktion = cService_Routine_GC_EL_SDF_SAP_Nr;
    bQueueWaitForResponce = TRUE; 
    putValue( DIAG_CAL_StatusBar, "Waiting for answer..." );
    setTimer( tCAL_ReadTimeOutTimer, TimeOut );
}

ID_VehManufacturerSparePartNumber_Eval()
{
char ttext[13];
    byte i,pos;

    if(( rsBuf[0] == 0x62 ) && 
       ( rsBuf[1] == 0xF1 ) &&
       ( rsBuf[2] == 0x87 )    )
    {
        pos = 3;

        for( i=0;i<10;i++)
        {
            ttext[ i ] = rsBuf[ pos + i ];
        }
        ttext[ i ]= '\0';
       putValue( DIAG_ID_vehicleManufacturerSparePartNumber, ttext );
	   pos = 13;
        DiagAktion = 0;
        putValue( DIAG_Main_ErrorStatus, "Successful" );
        bQueueWaitForResponce = FALSE;
        cancelTimer( tID_Get_TimeOutTimer );
        DIAG_CTRL_vStartNewService();
    }     
    else
        if( AntwortAuswertung( 1, rsBuf[0], rsBuf[2]) )
        {
            DiagAktion = 0;
            bQueueWaitForResponce = FALSE;
            cancelTimer( tID_Get_TimeOutTimer );
            DIAG_CTRL_vStartNewService();
        }
}

ID_VehManufacturerSparePartNumber_Get()
{
    DiagAktion = 0;
    if( FillCommand( ServicePhys ) ) return;
    rqBuf[0] = 0x22;
    rqBuf[1] = 0xF1;
    rqBuf[2] = 0x87;
    DIAG_SendRequest( SessionPhys, 3);
    DiagAktion = cService_Routine_VehManufacturerSparePartNumber_Get;
    putValue( DIAG_Main_ErrorStatus, "Warte auf Antwort..." );
    setTimer( tID_Get_TimeOutTimer, TimeOutMid);
    bQueueWaitForResponce = TRUE;
}