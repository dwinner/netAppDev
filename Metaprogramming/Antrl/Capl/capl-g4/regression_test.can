/* Include block */
includes
{
    #include "file1.cin"
    #include "file2.cin"
    #include "file3.cin"
}

/* Global variables */
variables
{
    // message declarations
    message * eTemp;
    message EngData EDMsg; // declares EDMsg as type EngData
    multiplexed_message * eTemp;
    multiplexed_message EngData EDMsg;
    mostAmsMessage * eTemp;
    mostAmsMessage EngData EDMsg;
    mostMessage * eTemp;
    mostMessage EngData EDMsg;
    message * all;
    message 100 msg; // CAN message
    msTimer myTimer; // creates a millisecond timer
    message wake-up xxx; // see Chapter 11 on using messages for more detail
    message 100 msg; // creates message 100
    message 0x555 msg1 = {dlc = 1};
    message 0x400 msgA = {dlc=1};
    message 0x100 eTemp = {DLC = 8};
    message 0x100 msg2 = {dlc = 8}; // declare message to send
    message 0x555 msg3 = {dlc=1};    

    // structures
    struct list_el {
       int val;
       struct list_el & next;
    };

    _align(1) struct MyData {
        int i;
        float f;
    };

    struct TopLevelSt
    {
        int first;
        qword second;
        signal * sig;
    };

    // binary digit
    int i = 0b0011;
    int j = 0B1010;

    // Hex variables
    byte y, z;
    y = 0x00;
    z = 0x01;

    // const
    const long kOff = 0;
    const long kOn = 1;

    // data types declarations
    char charVar = 'q';
    char letter_a = "a";
    const byte byteVar = 0b10011001;
    int intVar = 2;
    long longVar = 0x80000;
    const int64 int64Var = longVar;
    float floatVar = 56.0f;
    const double doubleVar = 90.001;
    qword qwordVar = 34;
    word wordVar = (word) qwordVar;

    // timer declarations
    timer simpleTimer;
    timer delayTimer;
    msTimer myTimer; // creates a millisecond timer
    msTimer timer1; // define timer1
    mstimer systemtimetimer;

    // enums
    enum OPTION_1
    {
        ACTIVATED   = 1,
        DEACTIVATED = 0
    };

    enum OPTION_2
    {
        IGN_ON  = 1,
        IGN_OFF = 0
    };

    // misc
    diagRequest diagReq;
    diagResponse diagResp;
    signal someSgn;
    // sysvar outEvent;
    ethernetPacket tcpPack;
    ethernetStatus inetStat;

    // array declarations
    byte binaryArray[16];
    int twoDim[][];
    int threeD[][][];
    
    // type casting
    int sum;
    sum = 1.6 + 1.7;
    sum = (int) 1.6 + (int) 1.7;

    // more arrays
    char alphabet[27] = "ABCDEFGHIJKLMNOPQRSTUVWXYZ";
    int sample_data[4] = { 100, 300, 500, 600 };
    int M[4][5] =
    {
        { 10, 5, -3, 17, 82 },
        { 9, 0, 0, 8, -7 },
        { 32, 20, 1, 0, 14 },
        { 0, 0, 8, 7, 6 }
    };

    // initializers
    int value = 20;
    int value2 = 0x14;
    float value3 = 0.23;
    float value4 = 23E-2;

    char value5 = 'B';
    char value6 = '8';
    char value7 = '?';
    char value8 = 0x42;
    char value9 = 0x38;
    char value10 = 0x3F;

    char value11[30] = "Here’s a string in C and CAPL";
    char value12[19] = "spaces are allowed";
    char value13[31] = "with a tab escape sequence \t";

    char buffer[10];
    
    byte x, y, z;
    z = 3;
    y = 5;
    x = (y < z) ? z : y; // conditional result x = 5
    x = messagename.signalname; // x is assigned a signal value
    
    word LastKey = 0;  
    msTimer KeyReleaseTimer;
}

void unconditionalSample()
{
    int x, y, z;
    while ( x != 0 )
    {
        doThis (x);
        if ( x == 0 )
            break;
        doThat (x);
    }

    while ( x != 0 )
    {
        doThis (x);
        if ( x == 4 )
            continue;
        doThat (x);
    }
}

void qualifiedSample()
{
   int var_DBLookupDefaultValue;

   struct SomeType someValue = DBLookup(lookupSignal(parsedSignal));
   var_DBLookupDefaultValue = (someValue.DefaultValue * someValue.factor) + someValue.offset;
}

dword phys_val(signal * s)
{ 
    return $s.phys;
}

dword raw_val(signal * s) 
{ 
    return $s.raw; 
}

dword raw64_val(signal * s) 
{ 
    return $s.raw64; 
}

dword raw_val_rx(signal * s) 
{ 
    return $s.rx;
}

dword raw_val_txrq(signal * s) 
{ 
    return $s.txrq; 
}

void handleHexValues()
{
   int value; 
   value & 0x0FFF; // clears all unnecessary bits 
}

void iterationStatEx()
{
    int index;
    index = 0;
    while ( number != 0 )
    {
        binaryArray[index++] = number % 10;
        number = number / 10;
    }

    do
    {
        binaryArray[index++] = number % 10;
        number = number / 10;
    }
    while ( number != 0 );

    index = 0;
    for ( ; number != 0; )
    {
        binaryArray[index++] = number % 10;
        number = number / 10;
    }
}

void switchSample()
{
    float value1, value2, result;
    char operator;

    switch ( operator )
    {
        case '+':
            result = value1 + value2;
            break;

        case '-':
        {
            result = value1 - value2;
            break;
        }

        case '*':
            result = value1 * value2;
            break;

        case '/':
        {
            if ( value2 == 0)
                write ("Division by zero!");
            else
                result = value1 / value2;
            break;
        }

        default:
            write ("Unknown operator.");
            break;
    }
}

char funcChar(char charVal, const char constCharVal, char & charRef)
{
}

int funcInt(int charVal, const int constCharVal, int & charRef)
{
}

long funcLong(long charVal, const long constCharVal, long & charRef)
{
}

int64 funcInt64(int64 charVal, const int64 constCharVal, int64 & charRef)
{
}

float funcFloat(float charVal, const float constCharVal, float & charRef)
{
}

double funcDouble(double charVal, const double constCharVal, double & charRef)
{
}

word funcWord(word charVal, const word constCharVal, word & charRef)
{
}

dword funcDword(dword charVal, const dword constCharVal, dword & charRef)
{
}

qword funcQword(qword charVal, const qword constCharVal, qword & charRef)
{
}

struct structType funcStructType(
    struct structType charVal,
    const struct structType constCharVal,
    struct structType & charRef)
{
}

enum enumType funcEnumType(
    enum enumType charVal,
    const enum enumType constCharVal,
    enum enumType & charRef)
{
}

void enumSamples()
{
    enum OPTION_1 opt1;
    enum OPTION_2 opt2;

    opt1 = OPTION_1.ACTIVATED;
    opt2 = OPTION_2.IGN_OFF;
}

on timer delayTimer
{
    message DomeLight dlMsg;
    dlMsg.Status = 0; // turns off dome light
    output(dlMsg);
}

on key 'a' // when the 'a' key is pressed
{
    setTimer(myTimer,20); // set myTimer to 20 ms
    setTimer(timer1, 100); // initialize timer to run for 100 msec
}

on timer myTimer // when myTimer expires (after 20 ms)
{
    setTimer(timer1, 100); // reset the timer
}

on message EDMsg
{
    EDMsg.EngSpeed = 50000; // sets raw value, the same value on the bus
    EDMsg.EngSpeed.phys = 50000; // sets physical value

    msg1.byte(0) = 0x12; // set the data field
    msg1.long(1) = 0x90785634;
    msg1.CarSpeed = 100; // assume CarSpeed occupies the last three bytes
    msg1.CAN = 2;
    output(msg1); // send the message
}

on message eTemp
{
    eTemp.CAN = 2; // set the transmit channel for this message to 2
    int value = eTemp.TIME; // retrieve the time stamp of a message’s last transmission or reception
    eTemp.ID = 100; // set the message identifier to 100 in decimal

    int myValue;

    myvalue = eTemp.WORD(2); // initialize the integer to 0x51FF
    myvalue >>= 4; // shift 0x51FF to the right 4 bits to get 0x51F
    myvalue &= 0xFF; // clears all unnecessary bits to get 0x1F
}

void structExample()
{
    /* defining a struct variable and initializing the elements */
    struct MyData data = {
        i = 42,
        f = 1.32
    };

    /* accessing the struct elements */
    write("i=%d, f=%f", data.i, data.f);
}

testfunction testFunctionName()
{
    write("testFunctionName");
}

export testcase MyCAPL_TC(
    signal * sigToBeSet,
    signal* sigToBeChecked,
    float valToBeSet,
    float valToBeChecked,
    int timeToBeWaited)
{
    // simulation of the 1st signal:
    teststep("", "Stimulation of values - signal '%s' = %.2f",
        sigToBeSet.name,
        valToBeSet);
    $sigToBeSet=valToBeSet;

    // waiting till 2nd signal should be checked:
    testWaitForTimeout(timeToBeWaited);
    teststep("", "Waited for %d ms", timeToBeWaited);

    // evaluating 2nd signal:
    testValidateSignalMatch("", sigToBeChecked, valToBeChecked);
}

testcase TestWakeupKL30 ()
{
}

testcase TestWakeUpCan ()
{
}

void ifElse()
{
    if (this.dir == RX)
    {
        SetLightDsp(this.HeadLight, this.FlashLight);
    }
    else
    {
        write ("Error: LightState TX received by node %NODE_NAME");
    }

    long tmpLightDsp;

    tmpLightDsp = 0;
    if (headLight == kOn)
       tmpLightDsp = 4;

    if (hazardFlasher == kOn)
    {
        tmpLightDsp += 3;
    }
    
    int clock_minutes;
    clock_minutes = clock_minutes + 1;
    if (clock_minutes >= 60) // if true
    {
        clock_minutes = 0;
        // increment hour variable
    }

    if (clock_minutes >= 60) // if true
    {
        clock_minutes = 0;
    }
    else // if false
    {
        clock_minutes = clock_minutes + 1;
    }
}

void bitwiseSample()
{
    byte x, y, z;
    y = 0x0AA; // y = 1010 1010
    z = 0x05A; // z = 0101 1010
    x = y & z; // AND result = 0000 1010
    x = y | z; // OR result = 1111 1010
    x = y ^ z; // XOR result = 1111 0000
    x = y << 1; // shift left result = 0101 0100
    x = y >> 1; // shift right result = 0101 0101
    x = ~y; // 1’s complement result = 0101 0101
}

assignmentOp()
{
    int y, z;
    y = 8;
    z = 4;

    y += z; // Addition. Result: y = 12
    y -= z; // Subtraction. Result: y = 4
    y *= z; // Multiplication. Result: y = 32
    y /= z; // Division. Result: y = 2
    y %= z; // Modulo. Result: y = 0
    y <<= 1; // Left-shift. Result: y = 16
    y &= z; // AND. Result: y = 0 (binary arithmetic)
    y |= z; // OR. Result: y = 12 (binary arithmetic)
    y ^= z; // XOR. Result: y = 12 (binary arithmetic)
}

void conditionalExpr()
{
    int a, b;
    a = b = 1;
    int c = a != b ? 0 : b;
}

void boolExpr()
{
    int a = 2, b = 3;
    byte test = a == 1 && b == 1;
    test = a == 1 || b == 1;
    test = a == 1 ^ b == 1;
    byte test = a == 1 && !(b == 1);
}

void relationalExpr()
{
    int a = 2, b = 3, c;
    byte test;

    test = a < b;
    test = a > b;
    test = a <= b;
    test = a >= b;
    test = a != b;
    test = a == b;

    printf("%s", test);
}

void shiftExpr()
{
    int a = 2, b = 3, c;
    c = a << b;
    c = b >> 2;
}

void additiveExpr()
{
    int a = 1, b = 2;
    int c, d, e ;

    c = a + b;
    d = a - b;
    e = (a - b) / (b * c);
    
    int x,y,z;
    y = 8;
    z = 4;
    x = y + z;  // Addition. Result = 12
    x = y - z;  // Subtraction. Result = 4
    x = y * z;  // Multiplication. Result = 32
    x = y / z;  // Division. Result = 2
    x = z % y;  // Modulo. Result = 4
    x = y++;    // Increment. Result = 9
    x = z--; 
}

void multiplicativeExpr()
{
    int a = 0;
    int b = 0;
    int c, d, e;

    c = a * b;
    d = a / b;
    e = a % b;
}

void unaryExpressions()
{
    int b = 8;
    int a = -b;
    a = +a;
    a = -a;
    a = ~b;
    b = !a;
}

void dotAccess()
{
   struct list_el lst;
   lst.val = 1;
}

int add ( )
{
    int i, sum = 0;

    for ( i = 1; i <= LAST; i++ ) {
      sum += i;
    } /*-for-*/
    printf("sum = %d\n", sum);

    return 0;
}

void dialog ( void )
{
    /* Define default values: */
    int n = 0;
    float x = 0.0;

    /* Define contents of dialog window */
    create_int_dialog_entry("n", n);
    create_float_dialog_entry("x", x);

    /* Create window with name "Setup" and top-left corner at (0,0) */
    set_up_dialog("Setup", 0, 0);

    /* Display the window and read the results */
    read_dialog_window();

    /* Print out the new values */
    printf("n = %d, x = %f\n", n, x);
}

int funcCall(int arg1, char arg2)
{
	a1(arg1);
	a2(arg1, arg2);
	a3();
}

int funcCall2(int arg1, char arg2)
{
	a1(arg1);
	a2(arg1, arg2);
	a3();
	a1(a1());
	a1(a1(), a2(a1(), x1));
}

float complexReturn(float x)
{
    return(1/(1+pow(x,2)));
}

void flow()
{
    int i,n;
    float x0,xn,h,y[20],so,se,ans,x[20];
    printf("\n Enter values of x0,xn,h:\n");
    scanf("%f%f%f",x0,xn,h);
    n=(xn-x0)/h;
    if(n%2==1)
    {
        n=n+1;
    }
    h=(xn-x0)/n;
    printf("\nrefined value of n and h are:%d  %f\n",n,h);
    printf("\n Y values \n");
    for(i=0; i<=n; i++)
    {
        x[i]=x0+i*h;
        y[i]=f(x[i]);
        printf("\n%f\n",y[i]);
    }
    so=0;
    se=0;
    for(i=1; i<n; i++)
    {
        if(i%2==1)
        {
            so=so+y[i];
        }
        else
        {
            se=se+y[i];
        }
    }
    ans=h/3*(y[0]+y[n]+4*so+2*se);
    printf("\nfinal integration is %f",ans);
    getch();
}

typelessFunc()
{
   struct list_el item;

   item & curr, head;
   int i;

   head = NULL;

   for ( i = 1; i <= 10; i++ )
   {
      curr = /*(item )*/malloc(sizeof(item));
      curr->val = i;
      curr->next  = head;
      head = curr;
   }

   curr = head;

   while(curr) {
      printf("%d\n", curr->val);
      curr = curr->next ;
   }
}

void voidFunc (void)
{
    print(a + b*c);
    print(a + b / c);
}

castExample()
{
	a1 = (int)(b1);
	a2 = (CustomType)(b2);
	a5 = b5();
}

main()
{
      printf (_("\
Usage: %s [ignored command line arguments]\n\
  or:  %s OPTION\n\
"),
          program_name, program_name);
}

/* Typeless sections */
on stopMeasurement
{
}

on ethernetStatus Ethernet.*
{
}

on ethernetStatus Ethernet . *
{
}

on ethernetStatus Eth_02.*
{
}

on ethernetStatus *
{
}

on ethernetPacket Ethernet.*
{
}

on ethernetPacket Ethernet . *
{
}

on ethernetPacket Eth_02.*
{
}

on ethernetPacket *
{
}

on preStart
{
}

on start
{
   char date [7];
   char systemtime [7];
   long datetime[9];
   int i;
   char temp[3];
	for(i=0;i<3;i++)
		temp[i]=0;

	getlocaltime(datetime);

	datetime[4]++;	//increment month
	if(datetime[5]>=100)	//later than millenium
		datetime[5]=datetime[5]-100;
	
	//day
	ltoa(datetime[3], temp, 10);
	if(datetime[3]<10){
		date[0]='0';
		date[1]=temp[0];
	}
	else{
		date[0]=temp[0];
		date[1]=temp[1];
	}
	
	//month
	for(i=0;i<3;i++)
		temp[i]=0;
	
	ltoa(datetime[4], temp, 10);
	if(datetime[4]<10){
		date[2]='0';
		date[3]=temp[0];
	}
	else{
		date[2]=temp[0];
		date[3]=temp[1];
	}

	//year
	for(i=0;i<3;i++)
		temp[i]=0;
	
	ltoa(datetime[5], temp, 10);
	if(datetime[5]<10){
		date[4]='0';
		date[5]=temp[0];
	}
	else{
		date[4]=temp[0];
		date[5]=temp[1];
	}
	
	putvalue(env_FSG_date, date);
	settimer(systemtimetimer, 100);
}

on preStop
{
}

on busOn
{
}

on busOff
{
    resetCan();
    write("CAN has been reset due to BUSOFF ( coded version )");
}

on errorFrame
{
    char char_message[26] = "Hello";
    int pretime = 0;
    
    if (this.can == 1 && (timeNow() - pretime) < 100000)
        write("Error frames received less than one second apart on channel 1.");
}

on errorActive
{
}

on errorPassive
{
}

on someVar
{
}

/* Type sections */
on envVar EnvKL15
{
}

on envVar (EnvKL15)
{
}

on envVar ( EnvKL15 )
{
}

on sysvar_update sysvar::ASG_AudioSD::MeImSe_InID
{
}

on sysvar_update DoIP1::ASG_AudioSD::MeImSe_InID
{
}

on sysvar_update DoIP::ClearRxBuf
{
}

on sysvar_update DoIP1 :: ASG_AudioSD::MeImSe_InID
{
}

on sysvar_update DoIP :: ClearRxBuf
{
}

on sysvar sysvar::ASG_AudioSD::MeImSe_InID
{
}

on sysvar DoIP1::ASG_AudioSD::MeImSe_InID
{
}

on sysvar DoIP::ClearRxBuf
{
}

on sysvar DoIP1 :: ASG_AudioSD::MeImSe_InID
{
}

on sysvar DoIP :: ClearRxBuf
{
}

on signal sigTemp
{
}

on signal sigTemp::under
{
}

on signal sigTemp :: under
{
}

on diagResponse a-b
{
}

on diagResponse a - b
{
}

on diagResponse 0x100
{
}

on diagResponse *
{
}

on diagResponse Door.*
{
}

on diagResponse Door . *
{
}

on diagResponse Door.Sessions::*
{
}

on diagResponse Door . Sessions :: *
{
}

on diagRequest a-b
{
}

on diagRequest a - b
{
}

on diagRequest 0x100
{
}

on diagRequest *
{
}

on diagRequest Door.*
{
}

on diagRequest Door . *
{
}

on diagRequest Door.Sessions::*
{
}

on diagRequest Door . Sessions :: *
{
}

/* Message event variants */
on message can2.0x100
{
}

on message 0x1B000000x-0x1B00007Fx
{
}

on message 0x1B000000x-0x1B00007F
{
}

on message 0x1B000000 - 0x1B00007Fx
{
}

on message 0x1B000000x - 0x1B00007Fx
{
}

on message 0x1B000000X-0x1B00007FX
{
}

on message 0x131
{
}

on message 100
{
}

On Message BAPonly::BAPAudi
{
}

on message 0x500-0x57F
{
}

on message 0x500 - 0x57F
{
}

on message 0x1B000000x-0x1B00007Fx
{
}

on message 0x1B000000x - 0x1B00007Fx
{
}

on message Meas_IC_4
{
}

on message simpleMessage
{
}

on message simpleMessage . *
{
}

on message simpleMessage . subMessage
{
}

on message *
{
}

on multiplexed_message can2.0x100
{
}

on multiplexed_message 0x1B000000x-0x1B00007Fx
{
}

on multiplexed_message 0x1B000000x-0x1B00007F
{
}

on multiplexed_message 0x1B000000 - 0x1B00007Fx
{
}

on multiplexed_message 0x1B000000x - 0x1B00007Fx
{
}

on multiplexed_message 0x1B000000X-0x1B00007FX
{
}

on multiplexed_message 0x131
{
}

on multiplexed_message 100
{
}

On multiplexed_message BAPonly::BAPAudi
{
}

on multiplexed_message 0x500-0x57F
{
}

on multiplexed_message 0x500 - 0x57F
{
}

on multiplexed_message 0x1B000000x-0x1B00007Fx
{
}

on multiplexed_message 0x1B000000x - 0x1B00007Fx
{
}

on multiplexed_message Meas_IC_4
{
}

on multiplexed_message simpleMessage
{
}

on multiplexed_message simpleMessage . *
{
}

on multiplexed_message simpleMessage . subMessage
{
}

on multiplexed_message *
{
}

on mostMessage can2.0x100
{
}

on mostMessage 0x1B000000x-0x1B00007Fx
{
}

on mostMessage 0x1B000000x-0x1B00007F
{
}

on mostMessage 0x1B000000 - 0x1B00007Fx
{
}

on mostMessage 0x1B000000x - 0x1B00007Fx
{
}

on mostMessage 0x1B000000X-0x1B00007FX
{
}

on mostMessage 0x131
{
}

on mostMessage 100
{
}

On mostMessage BAPonly::BAPAudi
{
}

on mostMessage 0x500-0x57F
{
}

on mostMessage 0x500 - 0x57F
{
}

on mostMessage 0x1B000000x-0x1B00007Fx
{
}

on mostMessage 0x1B000000x - 0x1B00007Fx
{
}

on mostMessage Meas_IC_4
{
}

on mostMessage simpleMessage
{
}

on mostMessage simpleMessage . *
{
}

on mostMessage simpleMessage . subMessage
{
}

on mostMessage *
{
}

on mostAmsMessage can2.0x100
{
}

on mostAmsMessage 0x1B000000x-0x1B00007Fx
{
}

on mostAmsMessage 0x1B000000x-0x1B00007F
{
}

on mostAmsMessage 0x1B000000 - 0x1B00007Fx
{
}

on mostAmsMessage 0x1B000000x - 0x1B00007Fx
{
}

on mostAmsMessage 0x1B000000X-0x1B00007FX
{
}

on mostAmsMessage 0x131
{
}

on mostAmsMessage 100
{
}

On mostAmsMessage BAPonly::BAPAudi
{
}

on mostAmsMessage 0x500-0x57F
{
}

on mostAmsMessage 0x500 - 0x57F
{
}

on mostAmsMessage 0x1B000000x-0x1B00007Fx
{
}

on mostAmsMessage 0x1B000000x - 0x1B00007Fx
{
}

on mostAmsMessage Meas_IC_4
{
}

on mostAmsMessage simpleMessage
{
}

on mostAmsMessage simpleMessage . *
{
}

on mostAmsMessage simpleMessage . subMessage
{
}

on mostAmsMessage *
{
}

/* Key event variants */
on key 't'
{
}

on key *
{
}

on key F1
{
}

on key PageUp
{
}

on key 0x4F00
{
}

/* Timer variants */
on timer Flow_Control
{
}

on timer ParamTimer (int a, const int b)
{
}

on timer HudTimer.*
{
}

on timer HudTimer . Warning
{
}

on timer HudTimer . Warning.*
{
}

on message 100 // this example triggers all the Logging blocks
{
    writeToLog("Logging starts");
    // this example sets the pre-trigger time before logging to 25 milliseconds:
    setPreTrigger(25);
    trigger(); // start logging
}

on message 555
{
    byte val;
    val = 0;

    /* checks to see if the message was received on CAN channel 1*/
    if (this.CAN == 1)
    {
        // sets "val" to the value of the first data byte in the CAN message
        val = this.byte(0);
    }
}

on timer myTimer // when myTimer expires (after 20 ms)
{
    output(msg); // output the message

    msg1.byte(0) = msg1.byte(0) + 1; // increment the data
    output(msg1); // output message
    setTimer(timer1, 100); // reset the timer

    msgA.byte(0)=msgA.byte(0)-1; // change the data
    output(msgA); // output message
}

on message CAN2.0x100 // for messages with ID equal to 0x100 from CAN channel 2
{
    // print
    write("The message with ID 0x100 is received from CAN channel 2.");
}

on message 0x100 // for messages with ID equal to 100 in hex only
{
    // print
    write("The message with ID 0x100 is received.");
}

on message 0x123
{
    write ("CAN Message 123");
}

on signal sigTemp
{
    write ("Signal Temperature");
}

on timer tmrCycle
{
    write ("within cycle");
}

on key 'a'
{
    write ("Key >a< pressed");
}

on key ' '
{
    write ("Key >a< pressed");
}

on key 0x20
{
    write ("Key >a< pressed");
}

on key F10
{
    write ("Key >a< pressed");
}

on key ctrlF12
{
    write ("Key >a< pressed");
}

on key PageUp
{
    write ("Key >a< pressed");
}

on key Home
{
    write ("Key >a< pressed");
}

on key *
{
    write ("Key >a< pressed");
}

on sysvar sysvar::VTS::Speed::PWMFreq
{
    if (@sysvar::VTS::Speed::PWMFreq > 100)
        TestSupplyTextEvent ("Speed100");
}

testcase TC ()
{
    TestWaitForTextEvent ("Speed100", 2000);
    @sysvar::Lights::LightDisplay = tmpLightDsp;
}

on message EngineState
{
    @sysvar::Engine::EngineSpeedDspMeter = this.EngineSpeed / 1000.0;
}

on message CAN1.*
{
   message CAN2.* msg;
   if(this.dir != rx) return; //important!
   msg = this;
   output(msg);
}

on message CAN2.*
{
   message CAN1.* msg;
   if(this.dir != rx)
   {
       return; //important!
   }    
   
   msg = this;
   output(msg);
}

on key '1'
{
    //To enable all Logging blocks and bypass all
    //triggering conditions:
    startLogging();
    //To enable a specific Logging block and bypass all
    //triggering conditions:
    startLogging("loggingblockname");
    //To enable a specific Logging block with a specific
    //pre-trigger time and bypass all triggering conditions:
    startLogging("loggingblockname", 1000);
}

on key '2'
{
    //To disable all Logging blocks and bypass all
    //triggering conditions:
    stopLogging();
    //To disable a specific Logging block and bypass all
    //triggering conditions:
    stopLogging("loggingblockname");
    //To disable a specific Logging block with a specific
    //post-trigger time and bypass all triggering
    //conditions:
    stopLogging("loggingblockname", 2000);
}

on message *
{
    if (getValue(eChannel))
    {                        
	    if (this.can==1) /*&& (this.dir==TX))*/
	    {                
            this.can=2;                   
		    output(this);
	    }
    }
}

on key PageUp 
{
   @eKeyWheelEventCodeLeft_P1=1;
   LastKey = keypressed();
   if (!isTimerActive(KeyReleaseTimer))
      setTimer(KeyReleaseTimer,100);
}

on key PageDown
{
   @eKeyWheelEventCodeLeft_M1=1;
   LastKey = keypressed();
   if (!isTimerActive(KeyReleaseTimer))
      setTimer(KeyReleaseTimer,100);
}

on key 'm'
{
   @eKeyMenuState=1;
   LastKey = keypressed();
   if (!isTimerActive(KeyReleaseTimer))
      setTimer(KeyReleaseTimer,100);
}

on timer KeyReleaseTimer
{
   write("Release Key: %d",LastKey);
   switch(LastKey)
   {
      case CursorUp   : @eKeyUpState=0;break;//Taste up 
      case CursorDown : @eKeyDownState=0;break;//Taste down
      case CursorRight: @eKeyMenuUpState=0;break;//Taste right
      case CursorLeft : @eKeyMenuDownState=0;break;//Taste left
      case PageUp     : @eKeyWheelEventCodeLeft_P1=0;break;//Taste m
      case PageDown   : @eKeyWheelEventCodeLeft_M1=0;break;//Taste m
      case 0xD        : @eKeyOkWheelLeftState=0; break;//Taste Enter
      case 'm'        : @eKeyMenuState=0;break;//Taste m
      case 'M'        : @eKeyMenuState=0;break;//Taste m
      default: break;
   }
   
   LastKey=0;
   cancelTimer( KeyReleaseTimer );
}

on key 0x4F00
{
   if (@eNMHControllerNodeAwake)
      @eNMHControllerNodeAwake=0;
   else
      @eNMHControllerNodeAwake=1;
}

on key 0x4700
{
   if (@eZAS_Kl_15S==1)
      @eZAS_Kl_15S=0;
   else
      @eZAS_Kl_15S=1;
}

on timer systemtimetimer
{
   char systemtime [7];
   long datetime[9];
   int i;
   char temp[3];

	settimer(systemtimetimer, 1000);

	for(i=0;i<3;i++)
		temp[i]=0;

	getlocaltime(datetime);	

	//hours
	ltoa(datetime[2], temp, 10);

	if(datetime[2]<10){
		systemtime[0]='0';
		systemtime[1]=temp[0];
	}
	else{
		systemtime[0]=temp[0];
		systemtime[1]=temp[1];
	}

	//minutes
	for(i=0;i<3;i++)
		temp[i]=0;

	ltoa(datetime[1], temp, 10);

	if(datetime[1]<10){
		systemtime[2]='0';
		systemtime[3]=temp[0];
	}
	else{
		systemtime[2]=temp[0];
		systemtime[3]=temp[1];
	}

	//seconds
	for(i=0;i<3;i++)
		temp[i]=0;

	ltoa(datetime[0], temp, 10);

	if(datetime[0]<10){
		systemtime[4]='0';
		systemtime[5]=temp[0];
	}
	else{
		systemtime[4]=temp[0];
		systemtime[5]=temp[1];
	}
	
	putvalue(env_FSG_time, systemtime);
}

on envVar LEDSwitch /* Triggered when LED Switch changes */
{
    int val;
    val = getValue(this);
}

void printme (double num)
{
    write("Floating point %f", num);
}

void printme (int num, char units[])
{
    write("%d %s", num, units);
}

on key 'b'
{
    msg1.byte(0)=0xAA;
    output(msg1);
}

on message CAN1.0x500 - 0x57F
{
}

on message CAN1.0x500-0x57F
{
}

on multiplexed_message CAN1.0x500-0x57F
{
}

on multiplexed_message CAN1.0x500 - 0x57F
{
}

on mostMessage CAN1.0x500-0x57F
{
}

on mostMessage CAN1.0x500 - 0x57F
{
}

on mostAmsMessage CAN1.0x500-0x57F
{
}

on mostAmsMessage CAN1.0x500 - 0x57F
{
}

/* ================================ Regression errors ================================
byte funcByte(byte charVal, const byte constCharVal, byte & charRef)
{
}

int & refReturn ( int param1 )
{
}

struct MyStruct & f3 (
   int             param1,
   char            param2
  )
{
}

int refParamsCombined (
   const MyType        &param1,
   int                  param2
  )
  {
  }

MyType1 allRefParamsCustomTypeReturn (
   MyType        &param1,
   int       &     param2
  ) {}
  
on sysvar_update sysvar :: ASG_AudioSD::MeImSe_InID
{
}

on sysvar sysvar :: ASG_AudioSD::MeImSe_InID
{
}
*/