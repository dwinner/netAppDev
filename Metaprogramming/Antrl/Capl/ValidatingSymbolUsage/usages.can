int i = 100;
char ch = 'a';
float x;

/*
variables
{
    int i2 = 100;
}

void sum(int matrix[][])
{
    int i, j;
    int answer;
    answer = 0;

    for (i = 0; i < elCount(matrix); i++)
    {
        for (j = 0; j < elCount(matrix[i]); j++)
        {
            answer += matrix[i][j];
        }
    }

    write("The sum is %d", answer);
}
*/