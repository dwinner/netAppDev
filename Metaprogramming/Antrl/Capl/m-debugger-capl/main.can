struct SomeType
{
    int a;
    int b;
}

variables
{        
    int x = 1;
    struct SomeType y;
}

on start
{
    
}
