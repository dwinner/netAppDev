/*@!Encoding:1252*/
// J. Raab 24.06.14

includes {
  
}

variables {
  
  // messages
  message Traction_SDOreq_LiIoBMS m1;
  message ModuleControl           mc1;
  message SYNC                    mSync;
  message Traction_Heartbeat      msgTractionHB;
  message LiloCharger_Heartbeat   msgChargerHB;
  message DiagRequest_LiIoBMS     mDiag;
  message 0x60D mSDO;
  
  message DispRTC   mDispRTC;
  message Hourmeter mHourmeter;
  message TracPDO4  mTracPDO4;
  message TimeStamp mTimeStamp;
  
  // constants
  const CANopenSlaveNodeId = 0xD;
  
  const syncTime = 10;
  const NumberOfHbBootUps = 11;
  const SendNomVoltDelayValueInMs = 500;
  
  const SDOuploadInitiate = 0x40;
  const SDOdownloadInitiate  = 0x20;

  const SDOAbortTransfer = 0x80;
  const SDOscsMask = 0xE0;
  const SDOCMask = 0x01; 
  const SDOstate_free = 0;
  const SDOstate_UploadInitiateSent = 1;
  const SDOstate_UploadSegmentSent = 2;

  const SDOstate_DownloadInitiateExpeditedSent = 6;
  const SDOstate_DownloadInitiateNormalSent = 7;
  const SDOstate_DownloadDataSent = 8;
  
  byte buffer[32];
  byte segmentedDataBuffer[5000];
  byte indexBuffer[2];
  byte oldState;
  dword SDOerrorCode;
  word lastSentID;
  int SDOstate = 0;
  int i = 0;
  int lastsegDataBufindex = 0;
  
  byte SDOrespSCS;
  byte SDOrespDataSize;
  word SDOrespIndex;
  byte SDOrespSubIndex;
  byte SDONumberofFreeBytes;
  byte SDOexpeditedOrNormal;
  byte SDOdataSize;
  
  byte ChargerHbBootupCount;
  byte TractionHbBootupCount;

  byte SDOuploadSegmentCommand = 0;
  int SDOsecondSegmentOffset = 0;

  // timers
  msTimer syncTimer;
  msTimer TractionHBtimer;
  msTimer ChargerHBtimer;
  msTimer SendInitData;
  
  msTimer TimeInfoTimer;
  byte toggleBytes[2] = {0x70, 0x60};
  byte toggleBit = 0;
  byte timeInfoToggle = 0;
  byte lastSentCanScheme = 0x13;
  dword TruckworkTime = 50;
  long aucSysTime[9];
  byte kaucTageProMonat[13] = {0,31,28,31,30,31,30,31,31,30,31,30,31 };
}

//-----------------------functions----------------------------------------------

void emptyBuffer(void){
  for (i=0; i<32; i++){
    buffer[i] = 0x0;
  }
}

void emptySegDatBuf(void){
  for (i=0; i<32; i++){
    segmentedDataBuffer[i] = 0x0;
  }
}

void writeSDOrequest(word index, byte subIndex, byte SDOcommand, byte valueBuffer [], byte SDOMessageChargerOrTraction ) {
  byte length;
  putValue(SDOabortReason,"-");
  
  if (SDOMessageChargerOrTraction == 1){
    // LiIoCharger_SDOreq_LiIoBMS
    m1.ID = 0x65D;
  }
  else{
    //Traction_SDOreq_LiIoBMS
    m1.ID = 0x60D;
  }
  
  switch(SDOcommand){
    
    case SDOuploadInitiate:
      //status auf SDOuploadInitiateSent setzen
      SDOstate = SDOstate_UploadInitiateSent;
      m1.byte(3) = 0;
      m1.byte(4) = 0;
      m1.byte(5) = 0;
      m1.byte(6) = 0;
      m1.byte(7) = 0;
      break;
      
    case SDOdownloadInitiate: //data tx
      if (getLength(index) == 0){
        // n, e und s = 1; 3 Bytes leer, expedited transfer, size indicated
        SDOcommand = SDOcommand | 0x0F;
        SDOstate = SDOstate_DownloadInitiateExpeditedSent;
        m1.byte(4) = valueBuffer[0];
        m1.byte(3) = 0x0;
        m1.byte(5) = valueBuffer[1];
        m1.byte(6) = valueBuffer[2];
        m1.byte(7) = valueBuffer[3];
        
      }
      else {
        // size indicated
        SDOcommand = SDOdownloadInitiate | 0x1;
        SDOstate = SDOstate_DownloadInitiateNormalSent;
        m1.byte(4) = (byte)getLength(index);
        m1.byte(3) = 0x0;
        m1.byte(5) = 0x0;
        m1.byte(6) = 0x0;
        m1.byte(7) = 0x0;
      }
      break;
      
     case 0x00:
     case 0x15:
      SDOuploadSegmentCommand = toggleBits420(SDOuploadSegmentCommand);

      index = valueBuffer[1 + SDOsecondSegmentOffset]<<8 | valueBuffer[0 + SDOsecondSegmentOffset];
      m1.byte(3) = valueBuffer[2 + SDOsecondSegmentOffset];
      m1.byte(4) = valueBuffer[3 + SDOsecondSegmentOffset];
      m1.byte(5) = valueBuffer[4 + SDOsecondSegmentOffset];
      m1.byte(6) = valueBuffer[5 + SDOsecondSegmentOffset];
      m1.byte(7) = valueBuffer[6 + SDOsecondSegmentOffset];
      
      if (SDOsecondSegmentOffset == 7){
        SDOsecondSegmentOffset = 0;
        SDOstate = SDOstate_free;
        emptyBuffer();
      }
      else {
        SDOsecondSegmentOffset += 7;
      }
      break;
      
    default:
      break;
  }
    
    lastSentID = index;
    m1.byte(0) = SDOcommand;
    m1.byte(1) = index & 0x00FF;
    m1.byte(2) = (index & 0xFF00) >> 8;
    m1.byte(3) = subIndex;
    
//  }
  
  output(m1);
}

//------------------------------------------------------------------------------

void writeModuleControl(int command) {
  mc1.byte(0) = command;
  mc1.byte(1) = CANopenSlaveNodeId;
  output(mc1);
}

//------------------------------------------------------------------------------

byte getLength(word index) {
  int ret;
  switch(index){
    case 0x200f:
      ret = 0xC;
      break;
    case 0x2014:
      ret = 0xC;
      break;
    case 0x2022:
      ret = 0xC;
      break;
    case 0x2023:
      ret = 0xC;
      break;
    default:
      ret = 0x0;
      break;
  }
  return ret;
}
//------------------------------------------------------------------------------

byte toggleBits420(byte toToggle){
 return (toToggle ^ 0x15);
}

//------------------------------------------------------------------------------

void writeNomVoltViaSDO(void){
  emptyBuffer();
  buffer[0] = getValue(NomVoltInValue); // 48dec Nominal Voltage
  writeSDOrequest(0x2270,1, SDOdownloadInitiate,buffer, 0);
}

void writeCanSchemeViaSDO(void) {
    emptybuffer();
    buffer[0] = getValue(CanSchemeTxValue);
    lastSentCanScheme = getValue(CanSchemeTxValue);
    writeSDOrequest(0x300C,1, SDOdownloadInitiate,buffer, getValue(sendCanSchemeFromWhere));
}

//------------------------------------------------------------------------------

on start
{
  setTimerCyclic(TimeInfoTimer, 0, 500);
}

//------------------------------------------------------------------------------

on Timer SendInitData {
  writeNomVoltViaSDO();
  writeCanSchemeViaSDO();
  writeModuleControl(0x1);
}

//------------------------------------------------------------------------------

on Timer TimeInfoTimer
{
  dword dateTime;
  
  if (timeInfoToggle == 0) {
    getLocalTime(aucSysTime);
    dateTime = gulRechneDatumInTicks();
    dateTime -= 3600;
    dateTime -= 86400;
    TruckworkTime++;
  }
  
  if (getValue(normalOperationEnable) == 1) {
    switch(lastSentCanScheme) {
      case 0x13:
        // nur Truckworkinghours
        mHourmeter.DLC = 8;
        mHourmeter.Byte(0) = (TruckworkTime & 0xFF);
        mHourmeter.Byte(1) = (TruckworkTime & 0xFF00) >> 8;
        mHourmeter.Byte(2) = (TruckworkTime & 0xFF0000) >> 16;
        mHourmeter.Byte(3) = (TruckworkTime & 0xFF000000) >> 24;
        //rest dont care
        // every second
        if (timeInfoToggle == 0) {
          output(mHourmeter);
        }
      break;
      case 0x20:
        // hours, disprtc
        mHourmeter.DLC = 4;
        mHourmeter.Byte(0) = (TruckworkTime & 0xFF);
        mHourmeter.Byte(1) = (TruckworkTime & 0xFF00) >> 8;
        mHourmeter.Byte(2) = (TruckworkTime & 0xFF0000) >> 16;
        mHourmeter.Byte(3) = (TruckworkTime & 0xFF000000) >> 24;
        
        mDispRTC.DLC = 8;
        mDispRTC.Byte(0) = aucSysTime[0];
        mDispRTC.Byte(1) = aucSysTime[1];
        mDispRTC.Byte(2) = aucSysTime[2];
        mDispRTC.Byte(3) = aucSysTime[3];
        mDispRTC.Byte(4) = aucSysTime[4] + 1;
        mDispRTC.Byte(5) = aucSysTime[5] - 100;
        // rest dont care
        output(mHourmeter);
        output(mDispRTC);
      break;
      case 0x21:
        // Timestamp, TracPDO4
        mTimeStamp.DLC = 4;
        mTimeStamp.Byte(0) = dateTime;
        mTimeStamp.Byte(1) = dateTime >> 8;
        mTimeStamp.Byte(2) = dateTime >> 16;
        mTimeStamp.Byte(3) = dateTime >> 24;
        
        mTracPDO4.DLC = 8;
        mTracPDO4.Byte(0) = ((TruckworkTime * 360) & 0xFF);
        mTracPDO4.Byte(1) = ((TruckworkTime * 360)& 0xFF00) >> 8;
        mTracPDO4.Byte(2) = ((TruckworkTime * 360) & 0xFF0000) >> 16;
        mTracPDO4.Byte(3) = ((TruckworkTime * 360) & 0xFF000000) >> 24;
        // rest dont care
        if (timeInfoToggle == 0) {
          output(mTimeStamp);
          output(mTracPDO4);
        }
      break;
      case 0x30:
        // Timestamp, TracPDO4
        mTimeStamp.DLC = 4;
        mTimeStamp.Byte(0) = (dateTime & 0xFF);
        mTimeStamp.Byte(1) = (dateTime & 0xFF00) >> 8;
        mTimeStamp.Byte(2) = (dateTime & 0xFF0000) >> 16;
        mTimeStamp.Byte(3) = (dateTime & 0xFF000000) >> 24;
        
        mTracPDO4.DLC = 4;
        mTracPDO4.Byte(0) = ((TruckworkTime * 360) & 0xFF);
        mTracPDO4.Byte(1) = ((TruckworkTime * 360) & 0xFF00) >> 8;
        mTracPDO4.Byte(2) = ((TruckworkTime * 360) & 0xFF0000) >> 16;
        mTracPDO4.Byte(3) = ((TruckworkTime * 360) & 0xFF000000) >> 24;
        if (timeInfoToggle == 0) {
          output(mTimeStamp);
          output(mTracPDO4);
        }
      break;
      default:
      break;
    }
  }
  
  timeInfoToggle = timeInfoToggle ^ 1;
}

//------------------------------------------------------------------------------

on envVar (ODListIndexRaw) {
  word tempVal;
  byte tempBuf[2];
  tempVal =getValue(ODListIndexRaw);
  tempBuf [0] = tempVal >> 8;
  tempBuf [1] = tempVal;
  putValue(ODindex,tempBuf);
}

on envVar (normalOperationEnable) {
    if (getValue(normalOperationEnable) == 1){
      writeModuleControl(0x1);
      writeModuleControl(0x1);
      putValue(syncEnable,1);
      putValue(TractionHbenable,1);
      //putValue(ChargerHBenable,1);
      setTimer(SendInitData, 500);
      
    }
    else {
      putValue(TractionHbenable,0);
      //putValue(ChargerHBenable,0);
      putValue(syncEnable,0);
      putValue(AutoSendNomVoltEnable,0);
    }
}
//------------------------------------------------------------------------------

on envVar(TractionHbenable) {
  if (getValue(TractionHbenable) == 1){
    setTimer(TractionHBtimer, getValue(TractionHBPeriod));
    TractionHbBootupCount = 0;
  }
}

on Timer TractionHBtimer {
  if (getValue(TractionHbenable) == 1){
    setTimer(TractionHBtimer, getValue(TractionHBPeriod));
  }
  
  if (TractionHbBootupCount < NumberOfHbBootUps) {
    TractionHbBootupCount++;
    msgTractionHB.byte(0) = 0x0;
    putValue(TractionHBstate, 0);
    if (TractionHbBootupCount == NumberOfHbBootUps) {
      msgTractionHB.byte(0) = 0x5;
      putValue(TractionHBstate, 5);
    }
  }
  else {
    msgTractionHB.byte(0) = getValue(TractionHBstate);
  }
  
  output(msgTractionHB);
}
//------------------------------------------------------------------------------
on envVar(ChargerHBenable) {
  if (getValue(ChargerHBenable) == 1){
    setTimer(ChargerHBtimer, getValue(ChargerHBPeriod));
    ChargerHbBootupCount = 0;
  }
}

on Timer ChargerHBtimer {
  if (getValue(ChargerHBenable) == 1){
    setTimer(ChargerHBtimer, getValue(ChargerHBPeriod));
  }
    if (ChargerHbBootupCount < NumberOfHbBootUps) {
      ChargerHbBootupCount++;
      msgChargerHB.byte(0) = 0x0;
      putValue(ChargerHBstate, 0);
      
      if (ChargerHbBootupCount == NumberOfHbBootUps){
        msgChargerHB.byte(0) = 0x5;
        putValue(ChargerHBstate, 5);
    }
  }
  else {
    msgChargerHB.byte(0) = getValue(ChargerHBstate);
  }
  output(msgChargerHB);
}
//------------------------------------------------------------------------------

on envVar(syncEnable) {
  setTimer(syncTimer, syncTime);
}

on Timer syncTimer {
  output (mSync);
  if (getValue(syncEnable) == 1) {
  setTimer(syncTimer, syncTime);
  }
}
//------------------------------------------------------------------------------

on envVar(readBatteryOn) {
  if (getValue(readBatteryOn) == 1) {
    emptybuffer();
    buffer[0] = 0;
    writeSDOrequest(0x2200,1, SDOuploadInitiate, buffer, 0); 
  }
}

on envVar(writeBatteryOn) {
  if (getValue(writeBatteryOn) == 1) {
    byte whichMessage;
    emptybuffer();
    buffer[0] = getValue(BatteryCommandON);
    if (buffer[0] == 2) {
      whichMessage = 1;
    }
    else {
      whichMessage = 0;
    }
    writeSDOrequest(0x2200,1, SDOdownloadInitiate, buffer, whichMessage);
  }
}
//------------------------------------------------------------------------------

on envVar(readBatteryOff) {
  if (getValue(readBatteryOff) == 1) {
    emptybuffer();
    writeSDOrequest(0x2200,2, SDOuploadInitiate, buffer,0);
  }
}

on envVar(writeBatteryOff) {
  if (getValue(writeBatteryOff) == 1) {
    byte whichMessage;
    emptybuffer();
    buffer[0] = 1; /* 1 means off*/
    if (getValue(BatteryCommandOFF) == 2) {
      whichMessage = 1;
    }
    else {
      whichMessage = 0;
    }
    writeSDOrequest(0x2200,2, SDOdownloadInitiate, buffer,whichMessage);
  }
}

//------------------------------------------------------------------------------

on EnvVar (readNomVolt) {
  if (getValue(readNomVolt) == 1) {
    emptybuffer();
    writeSDOrequest(0x2270,1, SDOuploadInitiate, buffer, getValue(sendNomVoltFromWhere));
  }
}

on EnvVar (writeNomVolt) {
  if (getValue(writeNomVolt) == 1) {
    emptybuffer();
    buffer[0] = getValue(NomVoltInValue);
    writeSDOrequest(0x2270,1, SDOdownloadInitiate,buffer, getValue(sendNomVoltFromWhere));
  }
}

//------------------------------------------------------------------------------
on EnvVar (readCanScheme) {
  if (getValue(readCanScheme) == 1) {
    emptybuffer();
    writeSDOrequest(0x300C,1, SDOuploadInitiate, buffer, getValue(sendCanSchemeFromWhere));
  }
}

on EnvVar (writeCanScheme) {
  if (getValue(writeCanScheme) == 1) {
    writeCanSchemeViaSDO();
  }
}

//------------------------------------------------------------------------------

on envVar(ReadOD) {
  word localIndex;
  if (getValue(ReadOD) == 1) {
    emptyBuffer();
    getValue(ODindex, indexBuffer);
    localIndex = (indexBuffer[0]<<8 | indexBuffer[1]);
    writeSDOrequest(localIndex, getValue(ODsubIndex), SDOuploadInitiate, buffer, 0);
  }
}
  
on envVar(WriteOD) {
  if (getValue(WriteOD) == 1) {
    word localIndex;
    byte SDOcommand;
    emptyBuffer();
    getValue(ODInOutVal, buffer);
    getValue(ODindex, indexBuffer);
    localIndex = (indexBuffer[0]<<8 | indexBuffer[1]);
    writeSDOrequest(localIndex,getValue(ODsubIndex), SDOdownloadInitiate, buffer,0);
  }
}

//------------------------------------------------------------------------------

on envVar(startNode) {
  if(getValue(this) == 1) {
    writeModuleControl(0x1);
  }
}
on envVar(StartXCP) {
  if(getValue(this) == 1) {
    unlockXcp();
  }
}
on envVar(stopNode) {
  if(getValue(this) == 1) {
    writeModuleControl(0x2);
  }
}
on envVar(resetComm) {
  if(getValue(this) == 1) {
    writeModuleControl(0x82);
  }
}
on envVar(resetNode) {
  if(getValue(this) == 1) {
    writeModuleControl(0x81);
  }
}

on envVar(enterPreop) {
  if(getValue(this) == 1) {
    writeModuleControl(0x80);
  }
}

on envVar(resetECU) {
    if (getValue(resetECU) == 1) {
    emptybuffer();
    buffer[0] = 1;
    writeSDOrequest(0x2201,1, SDOdownloadInitiate,buffer, 0);
  }
}

on envVar(ResetMalfunction) {
    if (getValue(ResetMalfunction) == 1) {
    mDiag.DLC = 8;
    mDiag.BYTE(0) = 0x03;
    mDiag.BYTE(1) = 0x31;
    mDiag.BYTE(2) = 0xE5;
    mDiag.BYTE(3) = 0;
    mDiag.BYTE(4) = 0;
    mDiag.BYTE(5) = 0;
    mDiag.BYTE(6) = 0;
    mDiag.BYTE(7) = 0;
    output(mDiag);
  }
}
void unlockXcp (void)
{
  mSDO.DLC = 8;
  mSDO.Byte(0) = 0x23;
  mSDO.Byte(1) = 0x01;
  mSDO.Byte(2) = 0x42;
  mSDO.Byte(3) = 0x01;
  mSDO.Byte(4) = 0x4A;
  mSDO.Byte(5) = 0x34;
  mSDO.Byte(6) = 0x92;
  mSDO.Byte(7) = 0x7B;
  output(mSDO);
  output(mSDO);
}
//------------------------------------------------------------------------------


byte gbIstJahrEinSchaltjahr(int usJahr)
{
   byte     bRetValue;

   /* Vierhundertjahresregel */
   if ((usJahr % 400) == 0)
   {
      bRetValue = 1;
   }
   /* Hundertjahresregel */
   else if((usJahr % 100) == 0)
   {
      bRetValue = 0;
   }
   /* Vierjahresregel */
   else if((usJahr % 4) == 0)
   {
      bRetValue = 1;
   }
   /* Alle restlichen Jahre */
   else
   {
      bRetValue = 0;
   }

   return bRetValue;
}

//dword gulRechneDatumInTicks(byte ucSecond, byte ucMinute, byte ucHour, byte ucDay, byte ucMonth, int usYear )
dword gulRechneDatumInTicks()
{
  byte ucSecond;
  byte ucMinute;
  byte ucHour;  
  byte ucDay;   
  byte ucMonth; 
  int usYear;  

  byte  bIstSchaltjahr;
  byte  ucSchaltjahrTage;
  byte  ucZaehler;
  int   usJahre;
  int   usTage;
  dword ulTicks_RechneDatumInTicks;

  ucSecond = aucSysTime[0];
  ucMinute = aucSysTime[1];
  ucHour   = aucSysTime[2];
  ucDay    = aucSysTime[3];
  ucMonth  = aucSysTime[4] + 1; 
  usYear   = aucSysTime[5] + 1900 + 30; // canoe referenz ist 1900, fkt nimmt 2000 daher 30 (1970 vs. 2000)
  
  /* Berechne bisher erreichten zusaetzlichen Tage fuer die Schaltjahre */
  ucSchaltjahrTage = 0;
  for(usJahre = usYear; usJahre >= 2000; usJahre--)
  {
    bIstSchaltjahr = gbIstJahrEinSchaltjahr(usJahre);
    if(bIstSchaltjahr == 1)
    {
       ucSchaltjahrTage++;
    }
  }

  bIstSchaltjahr = gbIstJahrEinSchaltjahr(usYear);

  if (  (bIstSchaltjahr == 1) && ( ((ucDay <= 29) && (ucMonth == 2)) ||  (ucMonth == 1)) ) /* noch der Monat Januar ist... */
  {
    /* muss der Tag fuers Schaltjahr wieder abgezogen werden */
    ucSchaltjahrTage--;
  }

  usJahre = usYear - 2000;

  /* Tage von den bisherigen Jahren addieren */
  usTage = usJahre * 365;

  /* Zusaetzliche Tage von den bisherigen Schaltjahren dazuaddieren */
  usTage += ucSchaltjahrTage;

  /*Alle Tage vom aktuellen Jahr aufaddieren */
  for(ucZaehler = 1; ucZaehler < ucMonth; ucZaehler++)
  {
    usTage = usTage + kaucTageProMonat[ucZaehler];
  }
  /* Tage vom aktuellen Monat dazuaddieren */
  usTage += (ucDay - 1);

  /* Berechne die aktuelle Zeit als Zeitstempel in Sekunden */
  ulTicks_RechneDatumInTicks = ((ucMinute * 60) +  (ucHour * 60 * 60) + (ucSecond)+ (usTage * 24 * 60 * 60));

  return ulTicks_RechneDatumInTicks;
}

on message LiIoBMS_SDOresp_Traction   {
  byte SDOcommandTemp;
  SDOrespSCS = this.byte(0) & SDOscsMask;
  SDONumberofFreeBytes = (this.byte(0) & 0x0C)>>2;
  SDOrespDataSize = this.byte(0) & 0x0F;
  SDOrespIndex = (this.byte(2) << 8) | this.byte(1);
  SDOrespSubIndex = (this.byte(3));
  SDOexpeditedOrNormal = (this.byte(0) & 0x2)>>1;
  SDOdataSize = this.byte(0) & 0x1;
  
    switch(SDOrespSCS){
    case 0x40:
      // Response to SDOuploadInitiate (read)
      if (SDOstate == SDOstate_UploadInitiateSent){
        // expedited transfer
        if (SDOexpeditedOrNormal == 1) {
            if ((SDOrespIndex == 0x2200) && (SDOrespSubIndex == 0x1))  {
                putValue(BatteryOnState, this.byte(4));
              }
              else if((SDOrespIndex == 0x2200) && (SDOrespSubIndex == 0x2)){
                putValue(BatteryOffState, this.byte(4));
              }
              else if(SDOrespIndex == 0x2270){
                putValue(NomVoltOutValue, this.byte(4));
              }
              else if(SDOrespIndex == 0x300C)
                putValue(CanSchemeRxValue, this.byte(4));
              else {
                emptyBuffer();
                buffer[3] = this.byte(4);
                buffer[2] = this.byte(5);
                buffer[1] = this.byte(6);
                buffer[0] = this.byte(7);
                putValue(ODInOutVal,buffer);
              }
              SDOstate = SDOstate_free;
        }
        // normal transfer
        else if (SDOexpeditedOrNormal == 0) {
          // Response to SDOuploadInitiate if data > 4 Byte
          emptyBuffer();
          //writeSDOrequest((this.byte(2)<<8 | this.byte(1)),0, 0x60, buffer,0);
          writeSDOrequest(0,0, 0x60, buffer,0);
          SDOstate = SDOstate_UploadSegmentSent;
        }
      }
      break;
     
    case 0x0:
        if (SDOstate == SDOstate_UploadSegmentSent){
          for(i=1; i < (8 - ((this.byte(0) & 0x0E)>>1)); i++){
            segmentedDataBuffer[i-1+lastsegDataBufindex] = this.byte(i);
          }
          lastsegDataBufindex = i-1;
          if ((this.byte(0) & SDOCMask) == 0x00){
            // mehr daten kommen
            emptyBuffer();
            writeSDOrequest(0,0, toggleBytes[toggleBit], buffer,0);
            toggleBit = toggleBit ^ 1;
          }
          else {
            // fertig
            toggleBit = 0;
            putValue(ODInOutVal, segmentedDataBuffer);
            emptySegDatBuf();
            SDOstate = SDOstate_free;
            lastsegDataBufindex = 0;
          }
        }
    break;
    case 0x60:
        if (SDOstate == SDOstate_DownloadInitiateNormalSent){
          emptyBuffer();
          getValue(ODInOutVal,buffer);
          writeSDOrequest(0,0,SDOuploadSegmentCommand,buffer,0);
          SDOstate = SDOstate_DownloadDataSent;
        }
        else if (SDOstate == SDOstate_DownloadInitiateExpeditedSent){
          SDOstate = SDOstate_free;
        }
        break;
    case 0x20:
        if (SDOstate == SDOstate_DownloadDataSent){
          emptyBuffer();
          getValue(ODInOutVal,buffer);
          writeSDOrequest(0,0, SDOuploadSegmentCommand, buffer,0);
        }

        break;

    case SDOAbortTransfer:
          // SDO Abort
          SDOerrorCode = (this.byte(7)<< 24) | (this.byte(6)<< 16) | (this.byte(5)<< 8) | (this.byte(4));
          write ("%x",SDOerrorCode);
          switch (SDOerrorCode) {
            case 0x05030000:
              putValue(SDOabortReason, "Toggle bit not alternated");
              break;
            case 0x05040000:
              putValue(SDOabortReason, "SDO protocol timed out");
              break;
            case 0x05040001:
              putValue(SDOabortReason, "Client/server command specifier not valid or unknown");
              break;
            case 0x05040002:
              putValue(SDOabortReason, "Invalid block size (block mode only)");
              break;
            case 0x05040003:
              putValue(SDOabortReason, "Invalid sequence number (block mode only)");
              break;
            case 0x05040004:
              putValue(SDOabortReason, "CRC error (block mode only)");
              break;
            case 0x05040005:
              putValue(SDOabortReason, "Out of Menory");
              break;
            case 0x06010000:
              putValue(SDOabortReason, "Unsupported access to an object");
              break;
            case 0x06010001:
              putValue(SDOabortReason, "Attempt to read a write only object");
              break;
            case 0x06010002:
              putValue(SDOabortReason, "Attempt to write a read only object");
              break;
            case 0x06020000:
              putValue(SDOabortReason, "Object does not exist in the object dictionary");
              break;
            case 0x06040041:
              putValue(SDOabortReason, "Object can not be mapped to the PDO");
              break;
            case 0x06040042:
              putValue(SDOabortReason, "The number and length of the objects to be mapped wolud exceed PDO length");
              break;
            case 0x06040043:
              putValue(SDOabortReason, "General parameter incompatibility reason");
              break;
            case 0x06040047:
              putValue(SDOabortReason, "General internal incompatibility in the device");
              break;
            case 0x06060000:
              putValue(SDOabortReason, "Access failed due to an hardware error");
              break;
            case 0x06070010:
              putValue(SDOabortReason, "Data type does not match, length of cervice parameter does not match");
              break;
            case 0x06070012:
              putValue(SDOabortReason, "Data type does not match, length of service parameter too high");
              break;
            case 0x06070013:
              putValue(SDOabortReason, "Data type does not match, length of service parameter too low");
              break;
            case 0x06090011:
              putValue(SDOabortReason, "Sub-index does not exist");
              break;
            case 0x06090030:
              putValue(SDOabortReason, "Valule range of parameter exceeded (only for wirte access)");
              break;
            case 0x06090031:
              putValue(SDOabortReason, "Value of parameter wirtten too high");
              break;
            case 0x06090032:
              putValue(SDOabortReason, "Value of parameter written too low");
              break;
            case 0x06090036:
              putValue(SDOabortReason, "Maximum value is less than minimum value");
              break;
            case 0x08000000:
              putValue(SDOabortReason, "general error");
              break;
            case 0x08000020:
              putValue(SDOabortReason, "Data can not be transferred or stored to the application");
              break;
            case 0x08000021:
              putValue(SDOabortReason, "Data can  not be transfered or stored to the application because of local control");
              break;
            case 0x08000022:
              putValue(SDOabortReason, "Data can not be transferred or stored to the application because of the present device state");
              break;
            case 0x08000023:
              putValue(SDOabortReason, "Object dictionary dynamic generation fails or no object dictionary is present");
              break;
            default:
              break;
          }
         break;
       default:
         break;
     }
}

//------------------------------------------------------------------------------

on message LiIoBMS_Heartbt {
  byte currentNMTstate;
  currentNMTstate = this.byte(0);
  
  if (oldState != currentNMTstate) {
    if((oldState == 0x7F) && (currentNMTstate == 0x5) && (getValue(AutoSendNomVoltEnable) == 1)) {
      // statechange PREOP --> OP
      
      //writeNomVoltViaSDO();
      //setTimer(SendNomvoltDelayTimer, SendNomVoltDelayValueInMs);
    }
    oldState = currentNMTstate;
    switch(currentNMTstate) {
      case 0x7F:
        putValue(NMTstate, "PRE-OP");
        setControlColors("CANopenMaster","LindeNMTstateBox",MakeRGB(255,153,0),MakeRGB(0,0,0));
        break;
      case 0x4:
        putValue(NMTstate, "STOPPED");
        setControlColors("CANopenMaster","LindeNMTstateBox",MakeRGB(255,0,0),MakeRGB(0,0,0));
        break;
      case 0x5:
        putValue(NMTstate, "OP");
        setControlColors("CANopenMaster","LindeNMTstateBox",MakeRGB(0,255,0),MakeRGB(0,0,0));
        break;
      default:
        putValue(NMTstate, "?");
        setControlColors("CANopenMaster","LindeNMTstateBox",MakeRGB(255,255,255),MakeRGB(0,0,0));
        break;
    }
    
  } 
}

