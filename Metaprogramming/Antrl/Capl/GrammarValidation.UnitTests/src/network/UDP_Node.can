/*@!Encoding:1252*/
includes
{
}
variables
{
  DWORD udpHandle;
  DWORD transmitterIPdw, transmitterPortdw;
  DWORD receiverIPdw, receiverPortdw;
  CHAR  rxBuffer[1460], txBuffer[1460];
  CHAR  transmitterIPstr[16], transmitterNAMEstr[16];
  CHAR  receiverIPstr[16], receiverNAMEstr[16];
}
on start
{
  ipGetAdapterAddressAsString(1, transmitterIPstr, elcount(transmitterIPstr));
  strncpy(receiverIPstr, "192.168.250.2", elcount(receiverIPstr));
  strncpy(transmitterNAMEstr, "UDP Node B", elcount(transmitterNAMEstr));
  strncpy(receiverNAMEstr, "UDP Node A", elcount(receiverNAMEstr));
  
  transmitterIPdw    = ipGetAddressAsNumber(transmitterIPstr);
  transmitterPortdw  = 51340;//Source Port
  
  receiverIPdw       = ipGetAddressAsNumber(receiverIPstr);
  receiverPortdw     = 54321; //Destination Port
  
  udpHandle  = udpOpen(0, transmitterPortdw);
  udpReceiveFrom(udpHandle, rxBuffer, elcount(rxBuffer));

  OutputToPanel(1, 0);
}

void OnUdpReceiveFrom( dword socket, long result, dword address, dword port, char buffer[], dword size)
{
  strncpy(rxBuffer, buffer, size+1);                    
  udpReceiveFrom(udpHandle, rxBuffer, elcount(rxBuffer));

  OutputToPanel(2, receiverPortdw);
}

on key 'b'
{
  strncpy(txBuffer, "Hello UDP from CANoea", elcount (txBuffer));
  udpSendTo(udpHandle, receiverIPdw, receiverPortdw, txBuffer, strlen(txBuffer)); 
  
  OutputToPanel(3, receiverPortdw);
}

void OutputToPanel(byte msgId, dword port)
{
	char outputMessage[1500];
  
  switch (msgId)
  {
    case 1: snprintf(outputMessage, elcount(outputMessage), "%s", transmitterNAMEstr);
            putValueToControl("UDP Panel", "Client1", outputMessage); 
            snprintf(outputMessage, elcount(outputMessage), "IP:    %s", transmitterIPstr);
            putValueToControl("UDP Panel", "Client2", outputMessage); 
            snprintf(outputMessage, elcount(outputMessage), "Port:  %d", transmitterPortdw);
            putValueToControl("UDP Panel", "Client3", outputMessage); 
            snprintf(outputMessage, elcount(outputMessage), "State: %s", "Listen");
            putValueToControl("UDP Panel", "Client4", outputMessage); break;
    case 2: snprintf(outputMessage, elcount(outputMessage), "State: %s", "Receive");
            putValueToControl("UDP Panel", "Client4", outputMessage);
            snprintf(outputMessage, elcount(outputMessage), "Receive data from %s [%s:%d] at %1.9f", receiverNAMEstr, receiverIPstr, port, timeNowNS()/1000000000);
            putValueToControl("UDP Panel", "Data3", outputMessage);
            snprintf(outputMessage, elcount(outputMessage), "%s", rxBuffer);
            putValueToControl("UDP Panel", "Data4", outputMessage); break;
    case 3: snprintf(outputMessage, elcount(outputMessage), "State: %s", "Send");
            putValueToControl("UDP Panel", "Client4", outputMessage);
            snprintf(outputMessage, elcount(outputMessage), "Send data to %s [%s:%d] at %1.9f", receiverNAMEstr, receiverIPstr, port, timeNowNS()/1000000000);
            putValueToControl("UDP Panel", "Data3", outputMessage);
            snprintf(outputMessage, elcount(outputMessage), "%s", txBuffer);
            putValueToControl("UDP Panel", "Data4", outputMessage); break;
  }
}