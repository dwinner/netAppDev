/*@!Encoding:1252*/
includes
{
  #include "MsgOverTcpClient.cin"
}

variables
{
  
}

on preStart
{
   // vConvertIPv6toArray(ipv6SourceAddrStr, ipv6SourceAddr);
 
   // vConvertIPv6toArray(ipv6DestAddrStr, ipv6DestAddr);  
  

}

