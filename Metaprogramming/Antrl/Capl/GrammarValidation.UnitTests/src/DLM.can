/*@@var:*/
/*
Copyright ( C ) Continental AG 2012



Based on Version  1.0, 12.05.10   from M.Dangelmeyr      IBD im Auftrag von EP/ESE   Daimler AG

Date of creation :  14.04.2011

Created by :                 Hans Jürgen Hipp


Version info

1.0	03.03.2016	Inital versioning introduced HMI_2016_05a database
#VERSION#
#VERSION_END#
*/


variables
{
    const TRUE  =   0xAA;
    const FALSE =   0x00;
    const cManual = 0x00;
    const cAuto =   0xAA;

    msTimer t_DBKomTimer_20ms;      // Timer zum zyklischen Aufruf der DBKom-Task
    int c_tDBKomTimer_20ms = 20;    // msec
    msTimer t_DBKomTimer_5ms;       // Timer zum zyklischen Aufruf der DBKom-Task
    int c_tDBKomTimer_5ms = 5;      // msec


    // BA_DEF_ BO_  "GenMsgSendType" ENUM
    //  0 : cyclicX
    //  1 : spontanX
    //  2 : cyclicIfActiveX
    //  3 : spontanWithDelay
    //  4 : cyclicAndSpontanX
    //  5 : cyclicAndSpontanWithDelay
    //  6 : spontanWithRepitition
    //  7 : cyclicIfActiveAndSpontanWD
    //  8 : cyclicIfActiveFast
    //  9 : cyclicWithRepeatOnDemand
    //  10 : none

// #VAR_DEF#
//  message   DLM_Stat_AR ID: 996 --- Sendeart 0 cyclicX --- 
    message   DLM_Stat_AR _mDLM_Stat_AR;
    int      _DLM_Stat_AR_Timebase;
    int      _DLM_Stat_AR_CycleCount;
    int      _DLM_Stat_AR_StartDelay;
    int      _DLM_Stat_AR_Cnt;
    int      _DLM_Stat_AR_SpontanFlag;

    byte     _DLM_Stat_AR_E2E_Armed;
    byte     _DLM_Stat_AR_CRC_ErrorCnt;
    byte     _DLM_Stat_AR_SQC_TriggPos;
    int      _DLM_Stat_AR_SQC_WrongSeqJump;
    byte     _DLM_Stat_AR_SQC_RepeatedCnt;
    byte     _DLM_Stat_AR_MSG_DropCnt;
    byte     _DLM_Stat_AR_CRC_Offset[16] = { 126,  26, 177,  77, 228, 128,  28, 179,  79, 230, 130,  30, 181,  81, 232, 132 };
    msTimer _tDLM_Stat_AR;

//  message   ROE_DLM ID: 2565819648 --- Sendeart 9 cyclicWithRepeatOnDemand --- 
    message   ROE_DLM _mROE_DLM;
    int      _ROE_DLM_Timebase;
    int      _ROE_DLM_CycleCount;
    int      _ROE_DLM_StartDelay;
    int      _ROE_DLM_Cnt;
    int      _ROE_DLM_MsgRepetitions;

// #VAR_DEF_END#

    Timer t_DoorNMCancelTimer;
    Timer t_KeyInLockNMCancelTimer;
    Timer t_StWhlButtonNMCancelTimer;
    Timer t_WakeWarningNMCancelTimer;
    Timer t_CarClosureNMCancelTimer;
    Timer t_EPKBWarningNMCancelTimer;
    Timer t_IlluNMCancelTimer;
    Timer t_GearIndNMCancelTimer;
    const byte c_NMCancelTimer_05sec = 5;
    const byte c_NMCancelTimer_30sec = 30;

    char buffer[1024], stringbuffer[512];
    int bActiveHelper;    // Hilfsvariable für "Aktive Signale"

//--------------------------------------- AUTOSAR NM ------------------------------------------------

    const byte cAUTO =   0;
    const byte cMANUAL = 1;

    msTimer t_NM_Transmit;
    long  NM_Transmit_Cycle;
    msTimer t_NM_Wait_Bus_Sleep_Time;
    const c_NM_Wait_Bus_Sleep_Time = 1500;
//    msTimer t_NM_Remote_Sleep_Ind_Time;
    const c_NM_Remote_Sleep_Ind_Time = 5000;
    msTimer t_NM_Repeat_Message_Time;
    const c_NM_Repeat_Message_Time = 6000;
    msTimer t_NM_Timeout_Time;
    const c_NM_Timeout_Time = 5000;

    byte NM_Mode = 0;
    const byte cNM_Mode_Init = 0;
    const byte cNM_Mode_Sleep = 1;
    const byte cNM_Mode_Prepare_Bus_Sleep = 2;
    const byte cNM_Mode_Ready_Sleep = 3;
    const byte cNM_Mode_Normal_Operation_State = 4;
    const byte cNM_Mode_RepeatMsg = 5;

    byte boCanNM_Rx_Indication = 0;
    byte boCanNM_Tx_Confirmation = 0;
    byte boCanNM_WaitBusSleep_Timer_Expired = 0;
    byte boCanNM_RepeatMessage_Timer_Expired = 0;
    byte boCanNM_NM_Timeout_Timer_Expired = 0;
    byte boCanNM_RepeatMessage_Requested = 0;

    const word cFLDoorNMRequest =       0x0001;
    const word cFRDoorNMRequest =       0x0002;
    const word cRLDoorNMRequest =       0x0004;
    const word cRRDoorNMRequest =       0x0008;
    const word cAllDoorNMRequest =      0x000F;
    const word cIgnitionNMRequest =     0x0010;
    const word cStWhlButtonNMRequest =  0x0020;
    const word cWakeWarningNMRequest =  0x0040;
    const word cEPKBWarningNMRequest =  0x0080;
    const word cIlluNMRequest =         0x0100;
    const word cCarClosureNMRequest =   0x0200;
    const word cGearIndNMRequest =      0x0400;
    const word cLowBeamNMRequest =      0x0800;

    const word cManualNMRequest =       0x8000;
    const word cAllNMRequest =          0xFFFF;

    const CanNmNodeId_Base =       1280; //  =  00h
    const CanNmNodeId_ARC =           3; //  =  03h
    const CanNmNodeId_APM =          76; //  =  4Ch
    const CanNmNodeId_DLM =          43; //  =  2Bh
    const CanNmNodeId_DRVU =         77; //  =  4Dh
    const CanNmNodeId_EIS =           7; //  =  07h
    const CanNmNodeId_HGW =          27; //  =  07h
    const CanNmNodeId_TGW =          56; //  =  38h
    const CanNmNodeId_RBTM_FR =      64; //  =  40h
    const CanNmNodeId_IC =           65; //  =  41h
    const CanNmNodeId_HUD =          66; //  =  42h
    const CanNmNodeId_NV =           67; //  =  43h
    const CanNmNodeId_RVC_SVS =      68; //  =  44h
    const CanNmNodeId_ORC =          69; //  =  45h
    const CanNmNodeId_RBTM_FL =      71; //  =  47h
    const CanNmNodeId_TPM =          82; //  =  52h

    const CanNmNodeDetectionEnabled =          0; //false
    const CanNmNodeIdEnabled =                 1; //true
    const CanNmUserDataEnabled =               1; //true;
    const CanNmUserDataLentgh =                7;
    const CanNmRepeatMsgIndEnabled =           1; //true;
    const CanNmDevErrorDetect =                0; //false
//    const CanNmUserDataEnabled =             1; //true
    const CanNmRemoteSleepIndEnabled =         0; //false
    const CanNmMsgReducedtime =                80; //ms
    const CanNmPduRxIndicationEnabled =        0; //false
    const CanNmStateChangeIndEnabled =         0; //false
    const CanNmImmediateTxconfEnabled =        0;// false
    const CanNmMsgTimeoutTime =                5000; //ms
    const CanNmPduNidPosition =                0; //CANNM_PDU_BYTE_0;
    const CanNmPduCbvPosition =                0xFF; //ANNM_PDU_OFF;
    const CanNmPduLength =                     8;
    const cCanNmPassiveModeEnabled =           0; //false
    const CanNmBusSynchronizationEnabled =     0; //false
    const CanNmBusLoadReductionEnabled =       1; //true
//    const CanNmRemoteSleepIndEnabled =       0; //false
//    const CanNmNodeDetectionEnabled =        0; //false
    const CanNmComControlEnabled =             1; //true    

    const NmAsrCanMsgStandardCycle =          2000;
    const NmAsrCanMsgCycleOffset_ARC =          30;
    const NmAsrCanMsgReducedTime_ARC =        1030;
    const NmAsrCanMsgCycleOffset_APM =          40;
    const NmAsrCanMsgReducedTime_APM =        1760;
    const NmAsrCanMsgCycleOffset_DLM =          30;
    const NmAsrCanMsgReducedTime_DLM =        1430;
    const NmAsrCanMsgCycleOffset_DRVU =         50;
    const NmAsrCanMsgReducedTime_DRVU =       1770;
    const NmAsrCanMsgCycleOffset_EIS =          70;
    const NmAsrCanMsgReducedTime_EIS =        1070;
    const NmAsrCanMsgCycleOffset_HGW =          30;
    const NmAsrCanMsgReducedTime_HGW =        1270;
    const NmAsrCanMsgCycleOffset_HUD =          20;
    const NmAsrCanMsgReducedTime_HUD =        1660;
    const NmAsrCanMsgCycleOffset_IC =           10;
    const NmAsrCanMsgReducedTime_IC =         1650;
    const NmAsrCanMsgCycleOffset_NV =           30;
    const NmAsrCanMsgReducedTime_NV =         1670;
    const NmAsrCanMsgCycleOffset_ORC =          50;
    const NmAsrCanMsgReducedTime_ORC =        1690;
    const NmAsrCanMsgCycleOffset_RBTM_FL =       0;
    const NmAsrCanMsgReducedTime_RBTM_FL =    1640;
    const NmAsrCanMsgCycleOffset_RBTM_FR =      70;
    const NmAsrCanMsgReducedTime_RBTM_FR =    1710;
    const NmAsrCanMsgCycleOffset_RVC =          40;
    const NmAsrCanMsgReducedTime_RVC =        1680;
    const NmAsrCanMsgCycleOffset_SVS =          40;
    const NmAsrCanMsgReducedTime_SVS =        1680;
    const NmAsrCanMsgCycleOffset_TGW =           0;
    const NmAsrCanMsgReducedTime_TGW =        1560;
    const NmAsrCanMsgCycleOffset_TPM =          20;
    const NmAsrCanMsgReducedTime_TPM =        1820;

    char gECU[12] = "HMI_DLM";

    byte CanNmNodeId =            CanNmNodeId_DLM;
    word NmNodeIdentifier =       CanNmNodeId_Base + CanNmNodeId_DLM;
    word NmAsrCanMsgCycleOffset = NmAsrCanMsgCycleOffset_DLM;
    word NmAsrCanMsgReducedTime = NmAsrCanMsgReducedTime_DLM;
    word NmAsrCanMsgCycleTime =   2000;
    byte NM_Repeat_Message_State_Active = 0;
    byte NM_AutomaticModeActive = 0;

//  message   NM_xxx_AR --- Sendeart cyclicX --- 
    message NM_DLM_AR _mNM_xxx_AR;
    byte _mNM_xxx_Transmit_Allowed = 1;

//--------------------------------------- AUTOSAR NM ------------------------------------------------

    byte  crctable[256] = {
        0x00, 0x1D, 0x3A, 0x27, 0x74, 0x69, 0x4E, 0x53, 0xE8, 0xF5, 0xD2, 0xCF, 0x9C, 0x81, 0xA6, 0xBB,
        0xCD, 0xD0, 0xF7, 0xEA, 0xB9, 0xA4, 0x83, 0x9E, 0x25, 0x38, 0x1F, 0x02, 0x51, 0x4C, 0x6B, 0x76,
        0x87, 0x9A, 0xBD, 0xA0, 0xF3, 0xEE, 0xC9, 0xD4, 0x6F, 0x72, 0x55, 0x48, 0x1B, 0x06, 0x21, 0x3C,
        0x4A, 0x57, 0x70, 0x6D, 0x3E, 0x23, 0x04, 0x19, 0xA2, 0xBF, 0x98, 0x85, 0xD6, 0xCB, 0xEC, 0xF1,
        0x13, 0x0E, 0x29, 0x34, 0x67, 0x7A, 0x5D, 0x40, 0xFB, 0xE6, 0xC1, 0xDC, 0x8F, 0x92, 0xB5, 0xA8,
        0xDE, 0xC3, 0xE4, 0xF9, 0xAA, 0xB7, 0x90, 0x8D, 0x36, 0x2B, 0x0C, 0x11, 0x42, 0x5F, 0x78, 0x65,
        0x94, 0x89, 0xAE, 0xB3, 0xE0, 0xFD, 0xDA, 0xC7, 0x7C, 0x61, 0x46, 0x5B, 0x08, 0x15, 0x32, 0x2F,
        0x59, 0x44, 0x63, 0x7E, 0x2D, 0x30, 0x17, 0x0A, 0xB1, 0xAC, 0x8B, 0x96, 0xC5, 0xD8, 0xFF, 0xE2,
        0x26, 0x3B, 0x1C, 0x01, 0x52, 0x4F, 0x68, 0x75, 0xCE, 0xD3, 0xF4, 0xE9, 0xBA, 0xA7, 0x80, 0x9D,
        0xEB, 0xF6, 0xD1, 0xCC, 0x9F, 0x82, 0xA5, 0xB8, 0x03, 0x1E, 0x39, 0x24, 0x77, 0x6A, 0x4D, 0x50,
        0xA1, 0xBC, 0x9B, 0x86, 0xD5, 0xC8, 0xEF, 0xF2, 0x49, 0x54, 0x73, 0x6E, 0x3D, 0x20, 0x07, 0x1A,
        0x6C, 0x71, 0x56, 0x4B, 0x18, 0x05, 0x22, 0x3F, 0x84, 0x99, 0xBE, 0xA3, 0xF0, 0xED, 0xCA, 0xD7,
        0x35, 0x28, 0x0F, 0x12, 0x41, 0x5C, 0x7B, 0x66, 0xDD, 0xC0, 0xE7, 0xFA, 0xA9, 0xB4, 0x93, 0x8E,
        0xF8, 0xE5, 0xC2, 0xDF, 0x8C, 0x91, 0xB6, 0xAB, 0x10, 0x0D, 0x2A, 0x37, 0x64, 0x79, 0x5E, 0x43,
        0xB2, 0xAF, 0x88, 0x95, 0xC6, 0xDB, 0xFC, 0xE1, 0x5A, 0x47, 0x60, 0x7D, 0x2E, 0x33, 0x14, 0x09,
        0x7F, 0x62, 0x45, 0x58, 0x0B, 0x16, 0x31, 0x2C, 0x97, 0x8A, 0xAD, 0xB0, 0xE3, 0xFE, 0xD9, 0xC4
    };

    byte  crctable_profile02[256] = {
        0x00, 0x2F, 0x5E, 0x71, 0xBC, 0x93, 0xE2, 0xCD, 0x57, 0x78, 0x09, 0x26, 0xEB, 0xC4, 0xB5, 0x9A,
        0xAE, 0x81, 0xF0, 0xDF, 0x12, 0x3D, 0x4C, 0x63, 0xF9, 0xD6, 0xA7, 0x88, 0x45, 0x6A, 0x1B, 0x34,
        0x73, 0x5C, 0x2D, 0x02, 0xCF, 0xE0, 0x91, 0xBE, 0x24, 0x0B, 0x7A, 0x55, 0x98, 0xB7, 0xC6, 0xE9,
        0xDD, 0xF2, 0x83, 0xAC, 0x61, 0x4E, 0x3F, 0x10, 0x8A, 0xA5, 0xD4, 0xFB, 0x36, 0x19, 0x68, 0x47,
        0xE6, 0xC9, 0xB8, 0x97, 0x5A, 0x75, 0x04, 0x2B, 0xB1, 0x9E, 0xEF, 0xC0, 0x0D, 0x22, 0x53, 0x7C,
        0x48, 0x67, 0x16, 0x39, 0xF4, 0xDB, 0xAA, 0x85, 0x1F, 0x30, 0x41, 0x6E, 0xA3, 0x8C, 0xFD, 0xD2,
        0x95, 0xBA, 0xCB, 0xE4, 0x29, 0x06, 0x77, 0x58, 0xC2, 0xED, 0x9C, 0xB3, 0x7E, 0x51, 0x20, 0x0F,
        0x3B, 0x14, 0x65, 0x4A, 0x87, 0xA8, 0xD9, 0xF6, 0x6C, 0x43, 0x32, 0x1D, 0xD0, 0xFF, 0x8E, 0xA1,
        0xE3, 0xCC, 0xBD, 0x92, 0x5F, 0x70, 0x01, 0x2E, 0xB4, 0x9B, 0xEA, 0xC5, 0x08, 0x27, 0x56, 0x79,
        0x4D, 0x62, 0x13, 0x3C, 0xF1, 0xDE, 0xAF, 0x80, 0x1A, 0x35, 0x44, 0x6B, 0xA6, 0x89, 0xF8, 0xD7,
        0x90, 0xBF, 0xCE, 0xE1, 0x2C, 0x03, 0x72, 0x5D, 0xC7, 0xE8, 0x99, 0xB6, 0x7B, 0x54, 0x25, 0x0A,
        0x3E, 0x11, 0x60, 0x4F, 0x82, 0xAD, 0xDC, 0xF3, 0x69, 0x46, 0x37, 0x18, 0xD5, 0xFA, 0x8B, 0xA4,
        0x05, 0x2A, 0x5B, 0x74, 0xB9, 0x96, 0xE7, 0xC8, 0x52, 0x7D, 0x0C, 0x23, 0xEE, 0xC1, 0xB0, 0x9F,
        0xAB, 0x84, 0xF5, 0xDA, 0x17, 0x38, 0x49, 0x66, 0xFC, 0xD3, 0xA2, 0x8D, 0x40, 0x6F, 0x1E, 0x31,
        0x76, 0x59, 0x28, 0x07, 0xCA, 0xE5, 0x94, 0xBB, 0x21, 0x0E, 0x7F, 0x50, 0x9D, 0xB2, 0xC3, 0xEC,
        0xD8, 0xF7, 0x86, 0xA9, 0x64, 0x4B, 0x3A, 0x15, 0x8F, 0xA0, 0xD1, 0xFE, 0x33, 0x1C, 0x6D, 0x42
    };
}
/*@@end*/

/*@@startStart:Start:*/
on start
{
    putValue( HMI__NM_DLM_NM_Request, 0 );  // reset all requests
    _NM_Switch_NM_Mode();
    
    __Init_Msg();
    __Startup_Delay();
    __Reset_E2E_SQC();

    putValue( HMI__NM_DLM_AutomaticModeActive, 0 );
    putValue( HMI__NM_DLM_AutomaticModeActive, 1 );
}
/*@@end*/

/*@@caplFunc:__Init_Msg():*/
__Init_Msg()
{
// #START_INIT#
    DLM_Stat_AR_init();
    ROE_DLM_init();
// #START_INIT_END#
//    ECU_APPL_DLM_1_init();
//    ECU_APPL_DLM_2_init();
//    Meas_DLM_1_init();
    NM_xxx_AR_init();
}
/*@@end*/

/*@@envVar:HMI__STOP_All_MESSAGES_DEFAULT_STARTDELAY:*/
on envVar HMI__STOP_All_MESSAGES_DEFAULT_STARTDELAY
{
    if( getValue( this ) )
    {
        __Init_Msg();
        __Startup_Delay();
    }
}
/*@@end*/

/*@@envVar:HMI__STOP_All_MESSAGES_SET_STARTDELAY:*/
on envVar HMI__STOP_All_MESSAGES_SET_STARTDELAY
{
    if( getValue( this ) )
    {
        __Startup_Delay();
    }
}
/*@@end*/

/*@@caplFunc:__Startup_Delay():*/
__Startup_Delay()
{
//    write(" Delay setzen :__DLM_Startup_Delay");
// #START_DELAY#
    _DLM_Stat_AR_Cnt =   getValue( HMI__STMSGSD_DLM_Stat_AR   ) / _DLM_Stat_AR_Timebase;
    _ROE_DLM_Cnt =              getValue( HMI__STMSGSD_ROE_DLM       )        / _ROE_DLM_Timebase;
// #START_DELAY_END#
}
/*@@end*/

/*@@caplFunc:__Reset_E2E_SQC():*/
__Reset_E2E_SQC()
{
    putValue( HMI_SQC_DLM_Stat, 15 );
//    write(" E2E-simu: Reset SQC to 15 ");
}
/*@@end*/

/*@@timer:t_DBKomTimer_5ms:*/
on Timer t_DBKomTimer_5ms
{
// *** DBKom-Sendefunktion ***
    // timer aufziehen für nächsten Zyklus
    if( getValue( HMI__NM_DLM_CommActive ) |
        getValue( HMI__NM_DLM_RequestBusCom )   )
    {
        setTimer( t_DBKomTimer_5ms, c_tDBKomTimer_5ms );
    }
// #CYC_TIMER_5_MS#
    DLM_Stat_AR_check_output();                   // Botschaft CLkS_Rq_AR                   --- Sendeart 8 cyclicIfActiveFast --- 
// #CYC_TIMER_5_MS_END#
}
/*@@end*/

/*@@timer:t_DBKomTimer_20ms:*/
on Timer t_DBKomTimer_20ms
{
// *** DBKom-Sendefunktion ***
    // timer aufziehen für nächsten Zyklus
    if( getValue( HMI__NM_DLM_CommActive ) |
        getValue( HMI__NM_DLM_RequestBusCom )   )
    {
        setTimer( t_DBKomTimer_20ms, c_tDBKomTimer_20ms );
    }
// #CYC_TIMER_20_MS#
// 5ms    DLM_Stat_AR_check_output();
    ROE_DLM_check_output();
// #CYC_TIMER_20_MS_END#
//    NM_DLM_Stat_AR_AR_check_output();
}
/*@@end*/

/*@@envVar:HMI__SAVE_PANEL_CONFIG_DLM:*/
on EnvVar HMI__SAVE_PANEL_CONFIG_DLM
{
    dword hFile;

    if( getValue(this) )
    {
        write("Saving HMI Panel Variables ...");

        hFile = openFileWrite( "CONFIG\\HMI_PRESETS.ASC", 0 );
        filePutString( "base hex timestamps absolute\n", 31, hFile );

// #MSG_SAVEENVVAR#
        DLM_Stat_AR_saveEnvVars( hFile );
        ROE_DLM_saveEnvVars( hFile );
// #MSG_SAVEENVVAR_END#
 //       NM_DLM_Stat_AR_AR_saveEnvVars( hFile );
        NM_xxx_AR_saveEnvVars( hFile );

        fileClose(hFile );
    }
}
/*@@end*/

/*@@envVar:HMI__STOP_DLM_MESSAGES_OFF:*/
on EnvVar HMI__STOP_DLM_MESSAGES_OFF
{
    if( getValue(this) )
    {
// #MSG_OFF#
        putValue( HMI__STMSG_DLM_Stat_AR, 1 );
        putValue( HMI__STMSG_ROE_DLM, 1 );
// #MSG_OFF_END#
        putValue( HMI__STMSG_NM_DLM_AR, 1 );
    }
}
/*@@end*/

/*@@envVar:HMI__STOP_DLM_MESSAGES_ON:*/
on envVar HMI__STOP_DLM_MESSAGES_ON
{
    if( getValue(this) )
    {
// #MSG_ON#
        putValue( HMI__STMSG_DLM_Stat_AR, 0 );
        putValue( HMI__STMSG_ROE_DLM, 0 );
// #MSG_ON_END#
        putValue( HMI__STMSG_NM_DLM_AR, 0 );
    }
}
/*@@end*/

/*@@busOff:BusOff:*/
on busOff
{
    resetCan();
    write("CAN has been resetted due to BUSOFF    ( coded version )");
}
/*@@end*/

/*@@msg:CAN1.0x500-0x57F:*/
on message CAN1.0x500-0x57F
{
    byte Identifier;

    Identifier = this.byte( 1 );

    if( this.byte( 1 ) == CanNmNodeId )    // check, wether the received NM-Frame is an own one
    {
        boCanNM_Tx_Confirmation = TRUE;    // so it is a TX-confirmation
    }
    else
    {
        boCanNM_Rx_Indication = TRUE;     // else it is a NM-Frame from another ECU
    }
    _NM_Switch_NM_Mode();     // inform the state-mashine
}
/*@@end*/

/*@@timer:t_DoorNMCancelTimer:*/
on timer t_DoorNMCancelTimer
{
    if( getValue( HMI__NM_EIS_AutomaticModeActive ) == 1 )
    {
        _ReleaseCommRequest( 15 );  // all doors reset their requests
    }
}
/*@@end*/

/*@@timer:t_KeyInLockNMCancelTimer:*/
on timer t_KeyInLockNMCancelTimer
{
    if( getValue( HMI__NM_EIS_AutomaticModeActive ) == 1 )
    {
        _ReleaseCommRequest( cIgnitionNMRequest );
    }
}
/*@@end*/

/*@@timer:t_StWhlButtonNMCancelTimer:*/
on timer t_StWhlButtonNMCancelTimer
{
    if( getValue( HMI__NM_EIS_AutomaticModeActive ) == 1 )
    {
        _ReleaseCommRequest( cStWhlButtonNMRequest );  // all keys reset their requests
    }
}
/*@@end*/

/*@@timer:t_WakeWarningNMCancelTimer:*/
on timer t_WakeWarningNMCancelTimer
{
    if( getValue( HMI__NM_EIS_AutomaticModeActive ) == 1 )
    {
        _ReleaseCommRequest( cWakeWarningNMRequest );  // all keys reset their requests
    }
}
/*@@end*/

/*@@timer:t_EPKBWarningNMCancelTimer:*/
on timer t_EPKBWarningNMCancelTimer
{
    if( getValue( HMI__NM_EIS_AutomaticModeActive ) == 1 )
    {
        _ReleaseCommRequest( cEPKBWarningNMRequest );  // all keys reset their requests
    }
}
/*@@end*/

/*@@timer:t_IlluNMCancelTimer:*/
on timer t_IlluNMCancelTimer
{
    if( getValue( HMI__NM_EIS_AutomaticModeActive ) == 1 )
    {
        _ReleaseCommRequest( cIlluNMRequest );  // all keys reset their requests
    }
}
/*@@end*/

/*@@timer:t_CarClosureNMCancelTimer:*/
on timer t_CarClosureNMCancelTimer
{
    if( getValue( HMI__NM_EIS_AutomaticModeActive ) == 1 )
    {
        _ReleaseCommRequest( cCarClosureNMRequest );  // all keys reset their requests
    }
}
/*@@end*/

/*@@timer:t_GearIndNMCancelTimer:*/
on timer t_GearIndNMCancelTimer
{
    if( getValue( HMI__NM_EIS_AutomaticModeActive ) == 1 )
    {
        _ReleaseCommRequest( cGearIndNMRequest );  // all keys reset their requests
    }
}
/*@@end*/

/*@@timer:t_NM_Repeat_Message_Time:*/
on timer t_NM_Repeat_Message_Time
{
    boCanNM_RepeatMessage_Timer_Expired = TRUE;
    _NM_Switch_NM_Mode();     // inform the state-mashine
}
/*@@end*/

/*@@timer:t_NM_Timeout_Time:*/
on timer t_NM_Timeout_Time
{
    boCanNM_NM_Timeout_Timer_Expired = TRUE;
    _NM_Switch_NM_Mode();     // inform the state-mashine
}
/*@@end*/

/*@@timer:t_NM_Transmit:*/
on timer t_NM_Transmit
{
    setTimer( t_NM_Transmit, NM_Transmit_Cycle );
    _mNM_xxx_AR.byte( 1 ) = CanNmNodeId;
    if( _mNM_xxx_Transmit_Allowed )
        output( _mNM_xxx_AR );
}
/*@@end*/

/*@@timer:t_NM_Wait_Bus_Sleep_Time:*/
on timer t_NM_Wait_Bus_Sleep_Time
{
    boCanNM_WaitBusSleep_Timer_Expired = TRUE;
    _NM_Switch_NM_Mode();     // inform the state-mashine
}
/*@@end*/

/*@@caplFunc:NM_xxx_AR_init():*/
NM_xxx_AR_init()
{
    _mNM_xxx_AR.Awake_Diag_Actv.phys = getValue( HMI_Awake_Diag_Actv_DLM );
    _mNM_xxx_AR.Awake_Ignition_On.phys = getValue( HMI_Awake_Ignition_On_DLM );
    _mNM_xxx_AR.Awake_NwSt.phys = getValue( HMI_Awake_NwSt_DLM );
    _mNM_xxx_AR.NM_ActvWakeup.phys = getValue( HMI_NM_ActvWakeup_DLM );
    _mNM_xxx_AR.NM_Coord_Id.phys = getValue( HMI_NM_Coord_Id_DLM );
    _mNM_xxx_AR.NM_Coord_SleepRdy.phys = getValue( HMI_NM_Coord_SleepRdy_DLM );
    _mNM_xxx_AR.NM_PartNw_Info.phys = getValue( HMI_NM_PartNw_Info_DLM );
    _mNM_xxx_AR.NM_RepeatMsg_Rq.phys = getValue( HMI_NM_RepeatMsg_Rq_DLM );
    _mNM_xxx_AR.NM_SrcNode_Id.phys = getValue( HMI_NM_SrcNode_Id_DLM );
    _mNM_xxx_AR.WakeupRsn_DLM.phys = getValue( HMI_WakeupRsn_DLM );
}
/*@@end*/

/*@@caplFunc:NM_xxx_AR_saveEnvVars(dword):*/
NM_xxx_AR_saveEnvVars( dword hFile )
{
    filePutString("\n// Knoten NM_DLM_AR\n", 33, hFile );
    snprintf(buffer, elcount(buffer), "0.0000 HMI__STMSG_NM_DLM_AR := %X\n", getValue( HMI__STMSG_NM_DLM_AR ));		filePutString (buffer, elcount(buffer), hFile);
    snprintf(buffer, elcount(buffer), "0.0000 HMI__STMSGT_NM_DLM_AR := %X\n", getValue( HMI__STMSGT_NM_DLM_AR ));		filePutString (buffer, elcount(buffer), hFile);
    snprintf(buffer, elcount(buffer), "0.0000 HMI_Awake_Diag_Actv := %X\n", getValue( HMI_Awake_Diag_Actv_DLM ) );		filePutString (buffer, elcount(buffer), hFile);
    snprintf(buffer, elcount(buffer), "0.0000 HMI_Awake_Ignition_On := %X\n", getValue( HMI_Awake_Ignition_On_DLM ) );		filePutString (buffer, elcount(buffer), hFile);
    snprintf(buffer, elcount(buffer), "0.0000 HMI_Awake_NwSt := %X\n", getValue( HMI_Awake_NwSt_DLM ) );		filePutString (buffer, elcount(buffer), hFile);
    snprintf(buffer, elcount(buffer), "0.0000 HMI_NM_ActvWakeup := %X\n", getValue( HMI_NM_ActvWakeup_DLM ) );		filePutString (buffer, elcount(buffer), hFile);
    snprintf(buffer, elcount(buffer), "0.0000 HMI_NM_Coord_Id := %X\n", getValue( HMI_NM_Coord_Id_DLM ) );		filePutString (buffer, elcount(buffer), hFile);
    snprintf(buffer, elcount(buffer), "0.0000 HMI_NM_Coord_SleepRdy := %X\n", getValue( HMI_NM_Coord_SleepRdy_DLM ) );		filePutString (buffer, elcount(buffer), hFile);
    snprintf(buffer, elcount(buffer), "0.0000 HMI_NM_PartNw_Info := %X\n", getValue( HMI_NM_PartNw_Info_DLM ) );		filePutString (buffer, elcount(buffer), hFile);
    snprintf(buffer, elcount(buffer), "0.0000 HMI_NM_RepeatMsg_Rq := %X\n", getValue( HMI_NM_RepeatMsg_Rq_DLM ) );		filePutString (buffer, elcount(buffer), hFile);
    snprintf(buffer, elcount(buffer), "0.0000 HMI_NM_SrcNode_Id := %X\n", getValue( HMI_NM_SrcNode_Id_DLM ) );		filePutString (buffer, elcount(buffer), hFile);
    snprintf(buffer, elcount(buffer), "0.0000 HMI_WakeupRsn_DLM := %X\n", getValue( HMI_WakeupRsn_DLM ) );		filePutString (buffer, elcount(buffer), hFile);
}
/*@@end*/

/*@@envVar:HMI__STMSG_NM_DLM_AR:*/
on envVar HMI__STMSG_NM_DLM_AR
{
    if( getValue( this ) == 0 )
        _mNM_xxx_Transmit_Allowed = 1;
    else
        _mNM_xxx_Transmit_Allowed = 0;    
}
/*@@end*/

/*@@envVar:HMI_Awake_Diag_Actv_DLM:*/
on EnvVar HMI_Awake_Diag_Actv_DLM
{
    _mNM_xxx_AR.Awake_Diag_Actv.phys = getValue(this);
}
/*@@end*/

/*@@envVar:HMI_Awake_Ignition_On_DLM:*/
on EnvVar HMI_Awake_Ignition_On_DLM
{
    _mNM_xxx_AR.Awake_Ignition_On.phys = getValue(this);
}
/*@@end*/

/*@@envVar:HMI_Awake_NwSt_DLM:*/
on EnvVar HMI_Awake_NwSt_DLM
{
    _mNM_xxx_AR.Awake_NwSt.phys = getValue(this);
}
/*@@end*/

/*@@envVar:HMI_NM_ActvWakeup_DLM:*/
on EnvVar HMI_NM_ActvWakeup_DLM
{
    _mNM_xxx_AR.NM_ActvWakeup.phys = getValue(this);
}
/*@@end*/

/*@@envVar:HMI_NM_Coord_Id_DLM:*/
on EnvVar HMI_NM_Coord_Id_DLM
{
    _mNM_xxx_AR.NM_Coord_Id.phys = getValue(this);
}
/*@@end*/

/*@@envVar:HMI_NM_Coord_SleepRdy_DLM:*/
on EnvVar HMI_NM_Coord_SleepRdy_DLM
{
    _mNM_xxx_AR.NM_Coord_SleepRdy.phys = getValue(this);
}
/*@@end*/

/*@@envVar:HMI_NM_PartNw_Info_DLM:*/
on EnvVar HMI_NM_PartNw_Info_DLM
{
    _mNM_xxx_AR.NM_PartNw_Info.phys = getValue(this);
}
/*@@end*/

/*@@envVar:HMI_NM_RepeatMsg_Rq_DLM:*/
on EnvVar HMI_NM_RepeatMsg_Rq_DLM
{
    _mNM_xxx_AR.NM_RepeatMsg_Rq.phys = getValue(this);
}
/*@@end*/

/*@@envVar:HMI_NM_SrcNode_Id_DLM:*/
on EnvVar HMI_NM_SrcNode_Id_DLM
{
    _mNM_xxx_AR.NM_SrcNode_Id.phys = getValue(this);
}
/*@@end*/

/*@@envVar:HMI_WakeupRsn_DLM:*/
on EnvVar HMI_WakeupRsn_DLM
{
    _mNM_xxx_AR.WakeupRsn_DLM.phys = getValue(this);
}
/*@@end*/

/*@@caplFunc:_NM_Switch_NM_Mode():*/
_NM_Switch_NM_Mode()
{
    byte bOld_NM_Mode;
    word NM_Request_State;

    bOld_NM_Mode = NM_Mode;
    NM_Request_State = getValue( HMI__NM_DLM_NM_Request );
    switch( NM_Mode )
    {
        case cNM_Mode_Init:                   _NM_Init();
                                              NM_Mode = cNM_Mode_Sleep;
                                              break;
        case cNM_Mode_Sleep:                  if( boCanNM_Rx_Indication == TRUE )
                                              {
                                                  // _NM_NetworkStartIndication();   nothing to do
                                                  // _NM_PassiveStartUp();    is content of _NM_NetworkMode();
                                                  setTimer( t_NM_Transmit, NmAsrCanMsgCycleOffset );    // send NM-Frame delayed
                                                  boCanNM_Rx_Indication = FALSE;
                                                  cancelTimer( t_NM_Timeout_Time );
                                                  setTimer( t_NM_Timeout_Time, c_NM_Timeout_Time );
                                                  setTimer( t_NM_Repeat_Message_Time, c_NM_Repeat_Message_Time );
                                                  NM_Transmit_Cycle = NmAsrCanMsgStandardCycle;
                                                  _NM_NetworkMode();
                                                  NM_Mode = cNM_Mode_RepeatMsg;
                                              }
                                              if( NM_Request_State )
                                              {
                                                  setTimer( t_NM_Transmit, 1 );    //send NM-Franme immediately
                                                  NM_Transmit_Cycle = NmAsrCanMsgStandardCycle;
                                                  cancelTimer( t_NM_Timeout_Time );
                                                  setTimer( t_NM_Timeout_Time, c_NM_Timeout_Time );
                                                  setTimer( t_NM_Repeat_Message_Time, c_NM_Repeat_Message_Time );
                                                  NM_Transmit_Cycle = NmAsrCanMsgStandardCycle;
                                                  _NM_NetworkMode();
                                                  NM_Mode = cNM_Mode_RepeatMsg;
                                              }
                                              break;
        case cNM_Mode_Prepare_Bus_Sleep:      if( boCanNM_WaitBusSleep_Timer_Expired == TRUE )
                                              {
                                                  _NM_BusSleepModeInd();   // set message startup delay
                                                  NM_Mode = cNM_Mode_Sleep;
                                                  boCanNM_WaitBusSleep_Timer_Expired = FALSE;
                                              }
                                              if( boCanNM_NM_Timeout_Timer_Expired == TRUE )
                                                  boCanNM_NM_Timeout_Timer_Expired = FALSE;
                                              if( ( boCanNM_Rx_Indication == TRUE ) ||  NM_Request_State )
                                              {
                                                  boCanNM_Rx_Indication = FALSE;
                                                  if( NM_Request_State )
                                                  {
                                                      setTimer( t_NM_Transmit, 1 );    //send NM-Franme immediately
                                                  }
                                                  cancelTimer( t_NM_Timeout_Time );
                                                  setTimer( t_NM_Timeout_Time, c_NM_Timeout_Time );
                                                  setTimer( t_NM_Repeat_Message_Time, c_NM_Repeat_Message_Time );
                                                  _NM_NetworkMode();
                                                  NM_Transmit_Cycle = NmAsrCanMsgStandardCycle;
                                                  NM_Mode = cNM_Mode_RepeatMsg;
                                              }
                                              break;
        case cNM_Mode_Ready_Sleep:            if( boCanNM_Rx_Indication == TRUE )
                                              {
                                                  cancelTimer( t_NM_Timeout_Time );
                                                  setTimer( t_NM_Timeout_Time, c_NM_Timeout_Time );
                                                  boCanNM_Rx_Indication = FALSE;
                                              }
                                              if( boCanNM_Tx_Confirmation == TRUE )
                                              {
                                                  cancelTimer( t_NM_Timeout_Time );
                                                  setTimer( t_NM_Timeout_Time, c_NM_Timeout_Time );
                                                  boCanNM_Tx_Confirmation = FALSE;
                                              }
                                              if( NM_Request_State )
                                              {
                                                  setTimer( t_NM_Transmit, 1 );    //send NM-Franme immediately
                                                  cancelTimer( t_NM_Timeout_Time );
                                                  setTimer( t_NM_Timeout_Time, c_NM_Timeout_Time );
                                                  NM_Transmit_Cycle = NmAsrCanMsgReducedTime;
                                                  NM_Mode = cNM_Mode_Normal_Operation_State;
                                              }
                                              if( boCanNM_RepeatMessage_Requested == TRUE )
                                              {
                                                  setTimer( t_NM_Transmit, NmAsrCanMsgCycleOffset );    // send NM-Frame delayed
                                                  cancelTimer( t_NM_Timeout_Time );
                                                  setTimer( t_NM_Timeout_Time, c_NM_Timeout_Time );
                                                  setTimer( t_NM_Repeat_Message_Time, c_NM_Repeat_Message_Time );
                                                  NM_Transmit_Cycle = NmAsrCanMsgStandardCycle;
                                                  boCanNM_RepeatMessage_Requested = FALSE;
                                                  NM_Mode = cNM_Mode_RepeatMsg;
                                              }
                                              if( boCanNM_NM_Timeout_Timer_Expired == TRUE )
                                              {
                                                  setTimer( t_NM_Wait_Bus_Sleep_Time, c_NM_Wait_Bus_Sleep_Time );
                                                  _NM_PrepareBusSleepModeInd();    // here t_DBKonTimer is stopped
                                                  NM_Mode = cNM_Mode_Prepare_Bus_Sleep;
                                                  boCanNM_NM_Timeout_Timer_Expired = FALSE;
                                              }
                                              break;
        case cNM_Mode_Normal_Operation_State: if( boCanNM_NM_Timeout_Timer_Expired == TRUE )
                                              {
                                                  setTimer( t_NM_Timeout_Time, c_NM_Timeout_Time );
                                                  // _NM_TimeoutExeption();    // no action to be done
                                                  boCanNM_NM_Timeout_Timer_Expired = FALSE;
                                              }
                                              if( boCanNM_Rx_Indication == TRUE )
                                              {
                                                  cancelTimer( t_NM_Timeout_Time );
                                                  setTimer( t_NM_Timeout_Time, c_NM_Timeout_Time );
                                                  cancelTimer( t_NM_Transmit );
                                                  setTimer( t_NM_Transmit, NmAsrCanMsgReducedTime );
                                                  boCanNM_Rx_Indication = FALSE;
                                              }
                                              if( boCanNM_Tx_Confirmation == TRUE )
                                              {
                                                  cancelTimer( t_NM_Timeout_Time );
                                                  setTimer( t_NM_Timeout_Time, c_NM_Timeout_Time );
                                                  cancelTimer( t_NM_Transmit );
                                                  setTimer( t_NM_Transmit, NmAsrCanMsgStandardCycle );
                                                  boCanNM_Tx_Confirmation = FALSE;
                                              }
                                              if( NM_Request_State == 0 )    //no network requested
                                              {
                                                  cancelTimer( t_NM_Transmit );    // stop NM-Franme immediately
                                                  NM_Mode = cNM_Mode_Ready_Sleep;
                                              }
                                              if( boCanNM_RepeatMessage_Requested == TRUE )
                                              {
                                                  setTimer( t_NM_Transmit, NmAsrCanMsgCycleOffset );    // send NM-Frame delayed
                                                  cancelTimer( t_NM_Timeout_Time );
                                                  setTimer( t_NM_Timeout_Time, c_NM_Timeout_Time );
                                                  setTimer( t_NM_Repeat_Message_Time, c_NM_Repeat_Message_Time );
                                                  boCanNM_RepeatMessage_Requested = FALSE;
                                                  NM_Transmit_Cycle = NmAsrCanMsgStandardCycle;
                                                  NM_Mode = cNM_Mode_RepeatMsg;
                                              }
                                              break;
        case cNM_Mode_RepeatMsg:              if( boCanNM_NM_Timeout_Timer_Expired == TRUE )
                                              {
                                                  setTimer( t_NM_Timeout_Time, c_NM_Timeout_Time );
                                                  boCanNM_NM_Timeout_Timer_Expired = FALSE;
                                              }
                                              if( boCanNM_Rx_Indication == TRUE )
                                              {
                                                  cancelTimer( t_NM_Timeout_Time );
                                                  setTimer( t_NM_Timeout_Time, c_NM_Timeout_Time );
                                                  boCanNM_Rx_Indication = FALSE;
                                              }
                                              if( boCanNM_Tx_Confirmation == TRUE )
                                              {
                                                  cancelTimer( t_NM_Timeout_Time );
                                                  setTimer( t_NM_Timeout_Time, c_NM_Timeout_Time );
                                                  boCanNM_Tx_Confirmation = FALSE;
                                              }
                                              if( boCanNM_RepeatMessage_Timer_Expired == TRUE )
                                              {
                                                  boCanNM_RepeatMessage_Timer_Expired = FALSE;
                                                  if( NM_Request_State )
                                                  {
                                                      NM_Mode = cNM_Mode_Normal_Operation_State;
                                                      NM_Transmit_Cycle = NmAsrCanMsgReducedTime;
                                                  }
                                                  else
                                                  {
                                                      cancelTimer( t_NM_Transmit );    // stop NM-Franme immediately
                                                      NM_Mode = cNM_Mode_Ready_Sleep;
                                                  }
                                              }
                                              break;
    }
    if( bOld_NM_Mode != NM_Mode )
    {
        _Nm_StateChangeNotification( bOld_NM_Mode, NM_Mode );    // does the Trace
        putValue( HMI__NM_DLM_ActualState, NM_Mode );
    }
}
/*@@end*/

/*@@caplFunc:_NM_Init():*/
_NM_Init()
{
    NM_Transmit_Cycle = NmAsrCanMsgStandardCycle;
}
/*@@end*/

/*@@caplFunc:_NM_NetworkMode():*/
_NM_NetworkMode()
{
    setTimer( t_DBKomTimer_5ms, 1 ); //  ms     start CAN-communication immediately
    setTimer( t_DBKomTimer_20ms, 2 ); //  ms     start CAN-communication immediately
    putValue( HMI__NM_DLM_CommActive, 1 );
}
/*@@end*/

/*@@caplFunc:_Nm_BusSleepModeInd():*/
_Nm_BusSleepModeInd()
{
//    write( "_Nm_BusSleepModeInd: Sleep Mode active");
    __Startup_Delay();
    __Reset_E2E_SQC();
}
/*@@end*/

/*@@caplFunc:_Nm_PrepareBusSleepModeInd():*/
void _Nm_PrepareBusSleepModeInd()
{
//    _Trace( "Nm_PrepareBusSleepModeInd", "Prepare Sleep Mode active");
    putValue( HMI__NM_DLM_CommActive, 0 );
    cancelTimer( t_DBKomTimer_5ms );
    cancelTimer( t_DBKomTimer_20ms );
}
/*@@end*/

/*@@caplFunc:_Nm_StateChangeNotification(byte,byte):*/
_Nm_StateChangeNotification( byte previousState, byte currentState )
{
/*
    char line[50];

    snprintf( line, elcount(line ), "Transition from %d to %d", previousState, currentState );
    _Trace( "Nm_StateChangeNotification", "", line );
*/
}
/*@@end*/

/*@@caplFunc:_ReleaseCommRequest(word):*/
_ReleaseCommRequest( word RequestID )
{
    word temp; // actual NM request status

    temp = getValue( HMI__NM_DLM_NM_Request );
    temp &= ~RequestID; // reset NM request 
    putValue( HMI__NM_DLM_NM_Request, temp );
    _NM_Switch_NM_Mode();
}
/*@@end*/

/*@@caplFunc:_SetCommRequest(word):*/
_SetCommRequest( word RequestID )
{
    word temp; // actual NM request status

    temp = getValue( HMI__NM_DLM_NM_Request );
    temp |= RequestID; // set NM request 
    putValue( HMI__NM_DLM_NM_Request, temp );
    _NM_Switch_NM_Mode();
}
/*@@end*/

/*@@caplFunc:_TraceCall(char[],long):*/
void _TraceCall( char functionName[], long callResult )
{
    char line[100];

    if( callResult == 1 )
        snprintf( line, elcount(line ), "calling %s", functionName );
    else
        snprintf( line, elcount(line ), "call to %s failed - wrong state?", functionName );
    _Trace( "", "", line );
}
/*@@end*/

/*@@caplFunc:_Trace(char[],char[]):*/
void _Trace( char functionName[], char info[])
{
    _Trace( functionName, info, "");
}
/*@@end*/

/*@@caplFunc:_Trace(char[],char[],char[],long):*/
void _Trace( char functionName[], char info[], char verbose[], long argument )
{
    char line[100];

    snprintf( line, elcount(line ), verbose, argument );
    _Trace( functionName, info, line );
}
/*@@end*/

/*@@caplFunc:_Trace(char[],char[],char[]):*/
void _Trace( char functionName[], char info[], char verbose[])
{
  char sep[2] = "/";
  sep[0] = functionName[0] ? '/' : 0;
  if( verbose[0])
  {
    write( "[%.3f]%s%s%s: %s", timeNow()/100000.0, gECU
           , sep
           , functionName
           , verbose
           );
  } else
  {
    write( "[%.3f]%s%s%s: %s", timeNow()/100000.0, gECU
           , sep
           , functionName
           , info
           );
  }
}
/*@@end*/

/*@@caplFunc:___Template_Header():*/
___Template_Header()
{
// #FUNCTIONS#
// #FUNCTIONS_END#
// #TIMERS#
// #TIMERS_END#
// #ENVVARS#
// #ENVVARS_END#
}
/*@@end*/

/*@@caplFunc:DLM_Stat_AR_check_output():*/
DLM_Stat_AR_check_output()
{
    if( !getValue( HMI__STMSG_DLM_Stat_AR ) )
    {
    //  message   DLM_Stat_AR ID: 996 --- Sendeart 5 cyclicAndSpontanWithDelay --- 
        _DLM_Stat_AR_Cnt--;
        if( _DLM_Stat_AR_Cnt < 1 )
        {
            DLM_Stat_AR_output(); // Nachricht wg. abgelaufenem Zyklus ausgeben
            _DLM_Stat_AR_SpontanFlag = 0; // Spontan-Flag zurücksetzen
            _DLM_Stat_AR_Cnt = _DLM_Stat_AR_CycleCount; // Zyklus-Zähler zurücksetzen
        }
        else if( _DLM_Stat_AR_SpontanFlag)
        {
         //   DLM_Stat_AR_output(); // Nachricht wg. spontaner Änderung ausgeben
            _DLM_Stat_AR_SpontanFlag = 0; // Spontan-Flag zurücksetzen
        }
    }
}
/*@@end*/

/*@@caplFunc:DLM_Stat_AR_init():*/
DLM_Stat_AR_init()
{   /* Botschaft DLM_Stat_AR ID: 996 --- Sendeart 0 cyclicX --- 
BA_ "ApplMessage" BO_ 996 0;
BA_ "NmAsrMessage" BO_ 996 0;
BA_ "GenMsgMinAcceptLength" BO_ 996 8;
BA_ "GenMsgILSupport" BO_ 996 1;
BA_ "DiagState" BO_ 996 0;
BA_ "DiagRequest" BO_ 996 0;
BA_ "DiagResponse" BO_ 996 0;
BA_ "GenMsgStartValue" BO_ 996 "0";
BA_ "GenMsgStartDelayTime" BO_ 996 0;
BA_ "GenMsgCycleTime" BO_ 996 100;
BA_ "GenMsgSendType" BO_ 996 0;
    */
    _DLM_Stat_AR_Timebase =      c_tDBKomTimer_5ms;
    _DLM_Stat_AR_CycleCount =    100 / _DLM_Stat_AR_Timebase;
    _DLM_Stat_AR_StartDelay =      0 / _DLM_Stat_AR_Timebase;
    _DLM_Stat_AR_Cnt = _DLM_Stat_AR_StartDelay;
    _DLM_Stat_AR_SpontanFlag = 0;

    putValue( HMI__STMSGSD_DLM_Stat_AR, _DLM_Stat_AR_StartDelay * _DLM_Stat_AR_Timebase );
    putValue( HMI__STMSGCT_DLM_Stat_AR, _DLM_Stat_AR_CycleCount * _DLM_Stat_AR_Timebase );

    _mDLM_Stat_AR.DiffLk_F_Stat_DLM.phys = getValue( HMI_DiffLk_F_Stat_DLM );
    _mDLM_Stat_AR.DiffLk_M_Stat_DLM.phys = getValue( HMI_DiffLk_M_Stat_DLM );
    _mDLM_Stat_AR.DiffLk_R_Stat_DLM.phys = getValue( HMI_DiffLk_R_Stat_DLM );
    _mDLM_Stat_AR.DLM_Msg1_Disp_Rq.phys = getValue( HMI_DLM_Msg1_Disp_Rq );
    _mDLM_Stat_AR.DLM_Msg2_Disp_Rq.phys = getValue( HMI_DLM_Msg2_Disp_Rq );
    _mDLM_Stat_AR.DLM_Msg3_Disp_Rq.phys = getValue( HMI_DLM_Msg3_Disp_Rq );
    _mDLM_Stat_AR.DLM_Msg4_Disp_Rq.phys = getValue( HMI_DLM_Msg4_Disp_Rq );
    _mDLM_Stat_AR.DLM_Msg5_Disp_Rq.phys = getValue( HMI_DLM_Msg5_Disp_Rq );
    _mDLM_Stat_AR.DLM_Msg6_Disp_Rq.phys = getValue( HMI_DLM_Msg6_Disp_Rq );
    _mDLM_Stat_AR.DLM_Msg7_Disp_Rq.phys = getValue( HMI_DLM_Msg7_Disp_Rq );
    _mDLM_Stat_AR.DLM_Msg8_Disp_Rq.phys = getValue( HMI_DLM_Msg8_Disp_Rq );
    _mDLM_Stat_AR.RLDS_RoofRack_Stat.phys = getValue( HMI_RLDS_RoofRack_Stat );
    _mDLM_Stat_AR.Rsrv01_DLM_Stat.phys = getValue( HMI_Rsrv01_DLM_Stat );
    _mDLM_Stat_AR.Rsrv02_DLM_Stat.phys = getValue( HMI_Rsrv02_DLM_Stat );
}
/*@@end*/

/*@@caplFunc:DLM_Stat_AR_output():*/
DLM_Stat_AR_output()
{
    byte crc;
    byte SQC_help;

    SQC_help = getValue( HMI_SQC_DLM_Stat ); //get copy of actual EnvVar
    if( !getValue( HMI_SQC_DLM_Stat_Auto ) ) // automatic SQC-calculation active ?
    {
        if( SQC_help == _DLM_Stat_AR_SQC_TriggPos ) // start injection of error when trigger reached
        {
            _DLM_Stat_AR_E2E_Armed = 1;   // run
            putValue( HMI_E2E_DLM_Stat_State, 1 );
        }
        // calculate new sequence counter
        
        if( ( _DLM_Stat_AR_SQC_WrongSeqJump != 0 ) &&
            ( _DLM_Stat_AR_E2E_Armed == 1        )    )
        {
            SQC_help = SQC_help + 16 + _DLM_Stat_AR_SQC_WrongSeqJump;
            if( SQC_help > 15 )
                SQC_help = SQC_help - 16;
            if( SQC_help > 15 )
                SQC_help = SQC_help - 16;
            _DLM_Stat_AR_SQC_WrongSeqJump = 0;
        }
        
        if( ( _DLM_Stat_AR_SQC_RepeatedCnt ) &&
            ( _DLM_Stat_AR_E2E_Armed == 1  )    )
        {
            _DLM_Stat_AR_SQC_RepeatedCnt--;
        }
        else
        {
            if( SQC_help >= 15 ) SQC_help = 0;
            else SQC_help++;
        }
            
        putValue( HMI_SQC_DLM_Stat, SQC_help );
    }
    _mDLM_Stat_AR.SQC_DLM_Stat = SQC_help;

    if( getValue( HMI_CRC_DLM_Stat_Profile_02 ) )
    {
        if( !getValue( HMI_CRC_DLM_Stat_Auto ) )
        {   // CRC according Profile_02 ( W213 )
            // berechne crc
            crc = 0xFF;
//          crc = crctable_profile02[ crc ^ _mDLM_Stat_AR.byte( 0 ) ];  CRC
            crc = crctable_profile02[ crc ^ _mDLM_Stat_AR.byte( 1 ) ];
            crc = crctable_profile02[ crc ^ _mDLM_Stat_AR.byte( 2 ) ];
//            crc = crctable_profile02[ crc ^ _mDLM_Stat_AR.byte( 3 ) ];
//            crc = crctable_profile02[ crc ^ _mDLM_Stat_AR.byte( 4 ) ];
//            crc = crctable_profile02[ crc ^ _mDLM_Stat_AR.byte( 5 ) ];
//            crc = crctable_profile02[ crc ^ _mDLM_Stat_AR.byte( 6 ) ];
//            crc = crctable_profile02[ crc ^ _mDLM_Stat_AR.byte( 7 ) ];
            crc = crctable_profile02[ crc ^ _DLM_Stat_AR_CRC_Offset[ _mDLM_Stat_AR.SQC_DLM_Stat ] ]; // load offset
            crc = (crc ^ 0xFF);
            
            if( ( _DLM_Stat_AR_CRC_ErrorCnt   && ( _DLM_Stat_AR_E2E_Armed == 1   ) ) ||
                ( getValue( HMI_CRC_DLM_Stat_Invalid )                                         )    )
            {
                crc++;
                if( _DLM_Stat_AR_CRC_ErrorCnt > 0 )
                    _DLM_Stat_AR_CRC_ErrorCnt--; 
            }
            _mDLM_Stat_AR.CRC_DLM_Stat = crc;
            putValue( HMI_CRC_DLM_Stat, crc );
        }
        else
            _mDLM_Stat_AR.CRC_DLM_Stat = getValue( HMI_CRC_DLM_Stat );
    }
    else
    {
        if( !getValue( HMI_CRC_DLM_Stat_Auto ) )
        {   // CRC according to SAE1850 ( W222 )
            // berechne crc
            crc = 0xFF;
//            crc = crctable[crc ^ _mDLM_Stat_AR.byte( 0 )];  CRC
            crc = crctable[crc ^ _mDLM_Stat_AR.byte( 1 )];
            crc = crctable[crc ^ _mDLM_Stat_AR.byte( 2 )];
//            crc = crctable[crc ^ _mDLM_Stat_AR.byte( 3 )];
//            crc = crctable[crc ^ _mDLM_Stat_AR.byte( 4 )];
//            crc = crctable[crc ^ _mDLM_Stat_AR.byte( 5 )];
//            crc = crctable[crc ^ _mDLM_Stat_AR.byte( 6 )];
//            crc = crctable[crc ^ _mDLM_Stat_AR.byte( 7 )];
            crc = (crc ^ 0xFF);
            if( ( _DLM_Stat_AR_CRC_ErrorCnt   && ( _DLM_Stat_AR_E2E_Armed == 1   ) ) ||
                ( getValue( HMI_CRC_DLM_Stat_Invalid )                                         )    )
            {
                crc++;
                if( _DLM_Stat_AR_CRC_ErrorCnt > 0 )
                    _DLM_Stat_AR_CRC_ErrorCnt--; 
            }
            _mDLM_Stat_AR.CRC_DLM_Stat = crc;
            putValue( HMI_CRC_DLM_Stat, crc );
        }
        else
            _mDLM_Stat_AR.CRC_DLM_Stat = getValue( HMI_CRC_DLM_Stat );
    }
    if( ( _DLM_Stat_AR_MSG_DropCnt > 0 ) &&
        ( _DLM_Stat_AR_E2E_Armed == 1  )    )
    {
        _DLM_Stat_AR_MSG_DropCnt--;  // do not send message
    }
    else
        output( _mDLM_Stat_AR );
        
    if( _DLM_Stat_AR_E2E_Armed == 1 )
    {
        if ( ( _DLM_Stat_AR_MSG_DropCnt == 0      ) &&
             ( _DLM_Stat_AR_CRC_ErrorCnt == 0     ) &&
             ( _DLM_Stat_AR_SQC_RepeatedCnt == 0  ) &&
             ( _DLM_Stat_AR_SQC_WrongSeqJump == 0 )    )
        {
            _DLM_Stat_AR_E2E_Armed = 0; // no further influence, injetion completed
            putValue( HMI_E2E_DLM_Stat_State, 0 );
        }
    }
}
/*@@end*/

/*@@caplFunc:DLM_Stat_AR_saveEnvVars(dword):*/
DLM_Stat_AR_saveEnvVars( dword hFile )
{
    filePutString("\n// Knoten EIS: DLM_Stat_AR\n", 36, hFile );
    snprintf( buffer, elcount( buffer ), "0.0000 HMI__STMSG_DLM_Stat_AR := %X\n", getValue( HMI__STMSG_DLM_Stat_AR ) );        filePutString ( buffer, elcount( buffer ), hFile );
    snprintf( buffer, elcount( buffer ), "0.0000 HMI__STMSGT_DLM_Stat_AR := %X\n", getValue( HMI__STMSGT_DLM_Stat_AR ) );        filePutString ( buffer, elcount( buffer ), hFile );
    snprintf( buffer, elcount( buffer ), "0.0000 HMI_DiffLk_F_Stat_DLM := %X\n", getValue( HMI_DiffLk_F_Stat_DLM ) );        filePutString ( buffer, elcount( buffer ), hFile );
    snprintf( buffer, elcount( buffer ), "0.0000 HMI_DiffLk_M_Stat_DLM := %X\n", getValue( HMI_DiffLk_M_Stat_DLM ) );        filePutString ( buffer, elcount( buffer ), hFile );
    snprintf( buffer, elcount( buffer ), "0.0000 HMI_DiffLk_R_Stat_DLM := %X\n", getValue( HMI_DiffLk_R_Stat_DLM ) );        filePutString ( buffer, elcount( buffer ), hFile );
    snprintf( buffer, elcount( buffer ), "0.0000 HMI_DLM_Msg1_Disp_Rq := %X\n", getValue( HMI_DLM_Msg1_Disp_Rq ) );        filePutString ( buffer, elcount( buffer ), hFile );
    snprintf( buffer, elcount( buffer ), "0.0000 HMI_DLM_Msg2_Disp_Rq := %X\n", getValue( HMI_DLM_Msg2_Disp_Rq ) );        filePutString ( buffer, elcount( buffer ), hFile );
    snprintf( buffer, elcount( buffer ), "0.0000 HMI_DLM_Msg3_Disp_Rq := %X\n", getValue( HMI_DLM_Msg3_Disp_Rq ) );        filePutString ( buffer, elcount( buffer ), hFile );
    snprintf( buffer, elcount( buffer ), "0.0000 HMI_DLM_Msg4_Disp_Rq := %X\n", getValue( HMI_DLM_Msg4_Disp_Rq ) );        filePutString ( buffer, elcount( buffer ), hFile );
    snprintf( buffer, elcount( buffer ), "0.0000 HMI_DLM_Msg5_Disp_Rq := %X\n", getValue( HMI_DLM_Msg5_Disp_Rq ) );        filePutString ( buffer, elcount( buffer ), hFile );
    snprintf( buffer, elcount( buffer ), "0.0000 HMI_DLM_Msg6_Disp_Rq := %X\n", getValue( HMI_DLM_Msg6_Disp_Rq ) );        filePutString ( buffer, elcount( buffer ), hFile );
    snprintf( buffer, elcount( buffer ), "0.0000 HMI_DLM_Msg7_Disp_Rq := %X\n", getValue( HMI_DLM_Msg7_Disp_Rq ) );        filePutString ( buffer, elcount( buffer ), hFile );
    snprintf( buffer, elcount( buffer ), "0.0000 HMI_DLM_Msg8_Disp_Rq := %X\n", getValue( HMI_DLM_Msg8_Disp_Rq ) );        filePutString ( buffer, elcount( buffer ), hFile );
    snprintf( buffer, elcount( buffer ), "0.0000 HMI_RLDS_RoofRack_Stat := %X\n", getValue( HMI_RLDS_RoofRack_Stat ) );        filePutString ( buffer, elcount( buffer ), hFile );
    snprintf( buffer, elcount( buffer ), "0.0000 HMI_Rsrv01_DLM_Stat := %X\n", getValue( HMI_Rsrv01_DLM_Stat ) );        filePutString ( buffer, elcount( buffer ), hFile );
    snprintf( buffer, elcount( buffer ), "0.0000 HMI_Rsrv02_DLM_Stat := %X\n", getValue( HMI_Rsrv02_DLM_Stat ) );        filePutString ( buffer, elcount( buffer ), hFile );
}
/*@@end*/

/*@@timer:_tDLM_Stat_AR:*/
on timer _tDLM_Stat_AR
{
    putValue( HMI__STMSG_DLM_Stat_AR, 0 );
}
/*@@end*/

/*@@envVar:HMI__STMSG_DLM_Stat_AR:*/
on EnvVar HMI__STMSG_DLM_Stat_AR
{
    long tDelay;
    if( getValue( this ) == 2 )
    {
        tDelay = getValue( HMI__STMSGT_DLM_Stat_AR );
        if( tDelay > 0)    
            setTimer( _tDLM_Stat_AR, tDelay );
        else
            putValue( HMI__STMSG_DLM_Stat_AR, 0 );
    }
}
/*@@end*/

/*@@envVar:HMI_E2E_DLM_Stat_Inject:*/
on envVar HMI_E2E_DLM_Stat_Inject
{
    if( getValue( this ) )
    {
        _DLM_Stat_AR_CRC_ErrorCnt = getValue( HMI_CRC_DLM_Stat_ErrorCount );
        _DLM_Stat_AR_SQC_TriggPos = getValue( HMI_SQC_DLM_Stat_TriggerPosition );
        _DLM_Stat_AR_SQC_WrongSeqJump = getValue( HMI_SQC_DLM_Stat_WrongSeq );
        _DLM_Stat_AR_SQC_RepeatedCnt = getValue( HMI_SQC_DLM_Stat_Repeated );
        _DLM_Stat_AR_MSG_DropCnt = getValue( HMI_SQC_DLM_Stat_MSG_DropCnt );
        putValue( HMI_E2E_DLM_Stat_State, 2 );
        _DLM_Stat_AR_E2E_Armed = 2;  //armed
    }
}
/*@@end*/

/*@@envVar:HMI__STMSGCT_DLM_Stat_AR:*/
on EnvVar HMI__STMSGCT_DLM_Stat_AR
{
    if( getValue( this ) > 0 )
    {
        _DLM_Stat_AR_CycleCount = getValue( this ) / _DLM_Stat_AR_Timebase;     // set cycle counter to initial value
        _DLM_Stat_AR_SpontanFlag = 1;
    }
}
/*@@end*/

/*@@envVar:HMI__STMSG_PO_Adblue_Disp_Rq_AR:*/
on envVar HMI__STMSG_PO_Adblue_Disp_Rq_AR
{
    if( getValue( this ) )
        openPanel("Adblue_Disp_Rq_AR");
}
/*@@end*/

/*@@envVar:HMI_DiffLk_F_Stat_DLM:*/
on EnvVar HMI_DiffLk_F_Stat_DLM
{
    _mDLM_Stat_AR.DiffLk_F_Stat_DLM.phys = getValue(this);
    _DLM_Stat_AR_SpontanFlag = 1;
}
/*@@end*/

/*@@envVar:HMI_DiffLk_M_Stat_DLM:*/
on EnvVar HMI_DiffLk_M_Stat_DLM
{
    _mDLM_Stat_AR.DiffLk_M_Stat_DLM.phys = getValue(this);
    _DLM_Stat_AR_SpontanFlag = 1;
}
/*@@end*/

/*@@envVar:HMI_DiffLk_R_Stat_DLM:*/
on EnvVar HMI_DiffLk_R_Stat_DLM
{
    _mDLM_Stat_AR.DiffLk_R_Stat_DLM.phys = getValue(this);
    _DLM_Stat_AR_SpontanFlag = 1;
}
/*@@end*/

/*@@envVar:HMI_DLM_Msg1_Disp_Rq:*/
on EnvVar HMI_DLM_Msg1_Disp_Rq
{
    _mDLM_Stat_AR.DLM_Msg1_Disp_Rq.phys = getValue(this);
    _DLM_Stat_AR_SpontanFlag = 1;
}
/*@@end*/

/*@@envVar:HMI_DLM_Msg2_Disp_Rq:*/
on EnvVar HMI_DLM_Msg2_Disp_Rq
{
    _mDLM_Stat_AR.DLM_Msg2_Disp_Rq.phys = getValue(this);
    _DLM_Stat_AR_SpontanFlag = 1;
}
/*@@end*/

/*@@envVar:HMI_DLM_Msg3_Disp_Rq:*/
on EnvVar HMI_DLM_Msg3_Disp_Rq
{
    _mDLM_Stat_AR.DLM_Msg3_Disp_Rq.phys = getValue(this);
    _DLM_Stat_AR_SpontanFlag = 1;
}
/*@@end*/

/*@@envVar:HMI_DLM_Msg4_Disp_Rq:*/
on EnvVar HMI_DLM_Msg4_Disp_Rq
{
    _mDLM_Stat_AR.DLM_Msg4_Disp_Rq.phys = getValue(this);
    _DLM_Stat_AR_SpontanFlag = 1;
}
/*@@end*/

/*@@envVar:HMI_DLM_Msg5_Disp_Rq:*/
on EnvVar HMI_DLM_Msg5_Disp_Rq
{
    _mDLM_Stat_AR.DLM_Msg5_Disp_Rq.phys = getValue(this);
    _DLM_Stat_AR_SpontanFlag = 1;
}
/*@@end*/

/*@@envVar:HMI_DLM_Msg6_Disp_Rq:*/
on EnvVar HMI_DLM_Msg6_Disp_Rq
{
    _mDLM_Stat_AR.DLM_Msg6_Disp_Rq.phys = getValue(this);
    _DLM_Stat_AR_SpontanFlag = 1;
}
/*@@end*/

/*@@envVar:HMI_DLM_Msg7_Disp_Rq:*/
on EnvVar HMI_DLM_Msg7_Disp_Rq
{
    _mDLM_Stat_AR.DLM_Msg7_Disp_Rq.phys = getValue(this);
    _DLM_Stat_AR_SpontanFlag = 1;
}
/*@@end*/

/*@@envVar:HMI_DLM_Msg8_Disp_Rq:*/
on EnvVar HMI_DLM_Msg8_Disp_Rq
{
    _mDLM_Stat_AR.DLM_Msg8_Disp_Rq.phys = getValue(this);
    _DLM_Stat_AR_SpontanFlag = 1;
}
/*@@end*/

/*@@envVar:HMI_RLDS_RoofRack_Stat:*/
on EnvVar HMI_RLDS_RoofRack_Stat
{
    _mDLM_Stat_AR.RLDS_RoofRack_Stat.phys = getValue(this);
    _DLM_Stat_AR_SpontanFlag = 1;
}
/*@@end*/

/*@@envVar:HMI_Rsrv01_DLM_Stat:*/
on EnvVar HMI_Rsrv01_DLM_Stat
{
    _mDLM_Stat_AR.Rsrv01_DLM_Stat.phys = getValue(this);
    _DLM_Stat_AR_SpontanFlag = 1;
}
/*@@end*/

/*@@envVar:HMI_Rsrv02_DLM_Stat:*/
on EnvVar HMI_Rsrv02_DLM_Stat
{
    _mDLM_Stat_AR.Rsrv02_DLM_Stat.phys = getValue(this);
    _DLM_Stat_AR_SpontanFlag = 1;
}
/*@@end*/

/*@@caplFunc:ROE_DLM_check_output():*/
void ROE_DLM_check_output()
{
    if (!getValue( HMI__STMSG_ROE_DLM))
    {
        // Botschaft ROE_DLM --- Sendeart 9 cyclicWithRepeatOnDemand --- 
        if( _ROE_DLM_Cnt > 0 )
        {
            _ROE_DLM_Cnt--;
            if( _ROE_DLM_Cnt < 1 )
            {
                // Nachricht wg. abgelaufenem Zyklus ausgeben
                ROE_DLM_output();
                _ROE_DLM_MsgRepetitions--;
               if( _ROE_DLM_MsgRepetitions > 0 ) _ROE_DLM_Cnt = _ROE_DLM_CycleCount;
            }
        }
    }
}
/*@@end*/

/*@@caplFunc:ROE_DLM_init():*/
ROE_DLM_init()
{   /* Botschaft ROE_DLM ID: 2565810944 --- Sendeart 9 cyclicWithRepeatOnDemand --- 
BA_ "ApplMessage" BO_ 2565810944 0;
BA_ "NmAsrMessage" BO_ 2565810944 0;
BA_ "GenMsgMinAcceptLength" BO_ 2565810944 8;
BA_ "GenMsgILSupport" BO_ 2565810944 1;
BA_ "DiagState" BO_ 2565810944 0;
BA_ "DiagRequest" BO_ 2565810944 0;
BA_ "DiagResponse" BO_ 2565810944 0;
BA_ "GenMsgStartValue" BO_ 2565810944 "0";
BA_ "GenMsgDelayTime" BO_ 2565810944 5;
BA_ "GenMsgNrOfRepetitions" BO_ 2565810944 0;
BA_ "GenMsgCycleTime" BO_ 2565810944 200;
BA_ "GenMsgSendType" BO_ 2565810944 9;
    */
    _ROE_DLM_Timebase =         c_tDBKomTimer_20ms;
    _ROE_DLM_CycleCount =     200 / _ROE_DLM_Timebase;
    _ROE_DLM_StartDelay =       5 / _ROE_DLM_Timebase;
    _ROE_DLM_Cnt = _ROE_DLM_StartDelay;
    _ROE_DLM_MsgRepetitions = 0;

    putValue( HMI__STMSGSD_ROE_DLM, _ROE_DLM_StartDelay * _ROE_DLM_Timebase);

    _mROE_DLM.ROE_DTC_DLM.phys = getValue( HMI_ROE_DTC_DLM );
    _mROE_DLM.ROE_DTC_Stat_DLM.phys = getValue( HMI_ROE_DTC_Stat_DLM );
    _mROE_DLM.ROE_Header_DLM.phys = getValue( HMI_ROE_Header_DLM );
}
/*@@end*/

/*@@caplFunc:ROE_DLM_output():*/
ROE_DLM_output(void)
{
    output( _mROE_DLM );
}
/*@@end*/

/*@@caplFunc:ROE_DLM_restart(int):*/
void ROE_DLM_restart(int nNumRepetitions)
{
    if (nNumRepetitions > _ROE_DLM_MsgRepetitions)
    {
        if (_ROE_DLM_MsgRepetitions < 1)
            _ROE_DLM_Cnt = 1;
        _ROE_DLM_MsgRepetitions = nNumRepetitions;
    }
}
/*@@end*/

/*@@caplFunc:ROE_DLM_saveEnvVars(dword):*/
ROE_DLM_saveEnvVars( dword hFile )
{
    filePutString("\n// Knoten ROE_APM\n", 33, hFile );
    snprintf(buffer, elcount(buffer), "0.0000 HMI__STMSG_ROE_DLM := %X\n", getValue( HMI__STMSG_ROE_DLM ));		filePutString (buffer, elcount(buffer), hFile);
    snprintf(buffer, elcount(buffer), "0.0000 HMI__STMSGT_ROE_DLM := %X\n", getValue( HMI__STMSGT_ROE_DLM ));		filePutString (buffer, elcount(buffer), hFile);
    snprintf(buffer, elcount(buffer), "0.0000 HMI_ROE_Header_DLM := %X\n", getValue( HMI_ROE_Header_DLM ) );		filePutString (buffer, elcount(buffer), hFile);
    snprintf(buffer, elcount(buffer), "0.0000 HMI_ROE_DTC_Stat_DLM := %X\n", getValue( HMI_ROE_DTC_Stat_DLM ) );		filePutString (buffer, elcount(buffer), hFile);
    snprintf(buffer, elcount(buffer), "0.0000 HMI_ROE_DTC_DLM := %X\n", getValue( HMI_ROE_DTC_DLM ) );		filePutString (buffer, elcount(buffer), hFile);
}
/*@@end*/

/*@@envVar:HMI_ROE_Header_DLM:*/
on EnvVar HMI_ROE_Header_DLM
{
    _mROE_DLM.ROE_Header_DLM.phys = getValue(this);
    ROE_DLM_restart(1);
}
/*@@end*/

/*@@envVar:HMI_ROE_DTC_Stat_DLM:*/
on EnvVar HMI_ROE_DTC_Stat_DLM
{
    _mROE_DLM.ROE_DTC_Stat_DLM.phys = getValue(this);
    ROE_DLM_restart(1);
}
/*@@end*/

/*@@envVar:HMI_ROE_DTC_DLM:*/
on EnvVar HMI_ROE_DTC_DLM
{
    _mROE_DLM.ROE_DTC_DLM.phys = getValue(this);
    ROE_DLM_restart(1);
}
/*@@end*/

