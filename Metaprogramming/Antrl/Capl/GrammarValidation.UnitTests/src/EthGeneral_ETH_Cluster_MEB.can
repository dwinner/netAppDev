/*@!Encoding:1252*/
includes
{
  // Import required CAPL include files
  //--- begin generated part --- Block start #Hdr_Includes#; do not delete this line and do not add application code in this code block!
  /* #ChannelStart# |ETH1| #BusStart# |ETH_Cluster_MEB| */
  /* #ChannelEnd# |ETH1| #BusEnd# |ETH_Cluster_MEB| */
  //--- end generated part --- Block end #Hdr_Includes#; do not delete this line! Add application code below this line.
  //--- begin generated part --- Block start #Body_Includes#; do not delete this line and do not add application code in this code block!
  /* #ChannelStart# |ETH1| #BusStart# |ETH_Cluster_MEB| */
  #include "..\..\CAPL\WakeupLine_Eth1.cin"
  /* #ChannelEnd# |ETH1| #BusEnd# |ETH_Cluster_MEB| */
  //--- end generated part --- Block end #Body_Includes#; do not delete this line! Add application code below this line.
}

variables
{
  // Define global variables for this CAPL file

  /*--- #GenHeader Begin# --- begin generated comment ---
  | Generated on Monday, Juli 01, 2019, 15:12:56
  | By ModelGenerator for VAG 1.0.0.4, ModelGeneratorVAGDLL 1.1.0.34
  | Package VAG 3.1.2
  | Target Bus: ETH_Cluster_MEB; Channel: ETH1; DB Cluster: ETH_Cluster_MEB;
  | From Database: E3_1_1_MEB_V10.06F_AR421_20190621_Kombi.arxml
  | CANoe Version 11.0.96.0
    --- #GenHeader End  # --- end generated comment --- */

  char gECU[256] = "EthGeneral_ETH_Cluster_MEB";
  //--- begin generated part --- Block start #Hdr_GlobalVariables#; do not delete this line and do not add application code in this code block!
  /* #ChannelStart# |ETH1| #BusStart# |ETH_Cluster_MEB| */
  /* #ChannelEnd# |ETH1| #BusEnd# |ETH_Cluster_MEB| */
  //--- end generated part --- Block end #Hdr_GlobalVariables#; do not delete this line! Add application code below this line.
  //--- begin generated part --- Block start #Body_GlobalVariables#; do not delete this line and do not add application code in this code block!
  /* #ChannelStart# |ETH1| #BusStart# |ETH_Cluster_MEB| */
  int gETH1Channel = 1;
  /* #ChannelEnd# |ETH1| #BusEnd# |ETH_Cluster_MEB| */
  //--- end generated part --- Block end #Body_GlobalVariables#; do not delete this line! Add application code below this line.
}

on preStart
{
  // Initialize CAPL includes and node's modules/DLLs
  //--- begin generated part --- Block start #Hdr_OnInit#; do not delete this line and do not add application code in this code block!
  /* #ChannelStart# |ETH1| #BusStart# |ETH_Cluster_MEB| */
  /* #ChannelEnd# |ETH1| #BusEnd# |ETH_Cluster_MEB| */
  //--- end generated part --- Block end #Hdr_OnInit#; do not delete this line! Add application code below this line.
  //--- begin generated part --- Block start #Body_OnInit#; do not delete this line and do not add application code in this code block!
  /* #ChannelStart# |ETH1| #BusStart# |ETH_Cluster_MEB| */
  /* #ChannelEnd# |ETH1| #BusEnd# |ETH_Cluster_MEB| */
  //--- end generated part --- Block end #Body_OnInit#; do not delete this line! Add application code below this line.
}

on start
{
  // Start CAPL includes and node's modules/DLLs
  //--- begin generated part --- Block start #Hdr_OnStart#; do not delete this line and do not add application code in this code block!
  /* #ChannelStart# |ETH1| #BusStart# |ETH_Cluster_MEB| */
  /* #ChannelEnd# |ETH1| #BusEnd# |ETH_Cluster_MEB| */
  //--- end generated part --- Block end #Hdr_OnStart#; do not delete this line! Add application code below this line.
  //--- begin generated part --- Block start #Body_OnStart#; do not delete this line and do not add application code in this code block!
  /* #ChannelStart# |ETH1| #BusStart# |ETH_Cluster_MEB| */
  /* #ChannelEnd# |ETH1| #BusEnd# |ETH_Cluster_MEB| */
  //--- end generated part --- Block end #Body_OnStart#; do not delete this line! Add application code below this line.
}

on preStop
{
  // Prepare stopping
  //--- begin generated part --- Block start #Hdr_OnStopping#; do not delete this line and do not add application code in this code block!
  /* #ChannelStart# |ETH1| #BusStart# |ETH_Cluster_MEB| */
  /* #ChannelEnd# |ETH1| #BusEnd# |ETH_Cluster_MEB| */
  //--- end generated part --- Block end #Hdr_OnStopping#; do not delete this line! Add application code below this line.
  //--- begin generated part --- Block start #Body_OnStopping#; do not delete this line and do not add application code in this code block!
  /* #ChannelStart# |ETH1| #BusStart# |ETH_Cluster_MEB| */
  /* #ChannelEnd# |ETH1| #BusEnd# |ETH_Cluster_MEB| */
  //--- end generated part --- Block end #Body_OnStopping#; do not delete this line! Add application code below this line.
}

on stopMeasurement
{
  // Stop actions
  //--- begin generated part --- Block start #Hdr_OnStop#; do not delete this line and do not add application code in this code block!
  /* #ChannelStart# |ETH1| #BusStart# |ETH_Cluster_MEB| */
  /* #ChannelEnd# |ETH1| #BusEnd# |ETH_Cluster_MEB| */
  //--- end generated part --- Block end #Hdr_OnStop#; do not delete this line! Add application code below this line.
  //--- begin generated part --- Block start #Body_OnStop#; do not delete this line and do not add application code in this code block!
  /* #ChannelStart# |ETH1| #BusStart# |ETH_Cluster_MEB| */
  /* #ChannelEnd# |ETH1| #BusEnd# |ETH_Cluster_MEB| */
  //--- end generated part --- Block end #Body_OnStop#; do not delete this line! Add application code below this line.
}

on envVar EnvKlemme15
{
  // Handle system state variable
  //--- begin generated part --- Block start #Hdr_KL15_EnvKlemme15#; do not delete this line and do not add application code in this code block!
  /* #ChannelStart# |ETH1| #BusStart# |ETH_Cluster_MEB| */
  /* #ChannelEnd# |ETH1| #BusEnd# |ETH_Cluster_MEB| */
  //--- end generated part --- Block end #Hdr_KL15_EnvKlemme15#; do not delete this line! Add application code below this line.
  //--- begin generated part --- Block start #Body_KL15_EnvKlemme15#; do not delete this line and do not add application code in this code block!
  /* #ChannelStart# |ETH1| #BusStart# |ETH_Cluster_MEB| */
  /* #ChannelEnd# |ETH1| #BusEnd# |ETH_Cluster_MEB| */
  //--- end generated part --- Block end #Body_KL15_EnvKlemme15#; do not delete this line! Add application code below this line.
}

on envVar EnvStartWithoutSending
{
  // Handle system state variable
  //--- begin generated part --- Block start #Hdr_StartManner_EnvStartWithoutSending#; do not delete this line and do not add application code in this code block!
  /* #ChannelStart# |ETH1| #BusStart# |ETH_Cluster_MEB| */
  /* #ChannelEnd# |ETH1| #BusEnd# |ETH_Cluster_MEB| */
  //--- end generated part --- Block end #Hdr_StartManner_EnvStartWithoutSending#; do not delete this line! Add application code below this line.
  //--- begin generated part --- Block start #Body_StartManner_EnvStartWithoutSending#; do not delete this line and do not add application code in this code block!
  /* #ChannelStart# |ETH1| #BusStart# |ETH_Cluster_MEB| */
  /* #ChannelEnd# |ETH1| #BusEnd# |ETH_Cluster_MEB| */
  //--- end generated part --- Block end #Body_StartManner_EnvStartWithoutSending#; do not delete this line! Add application code below this line.
}

on EthernetStatus *
{
  // Possibly propagate Ethernet status
  //--- begin generated part --- Block start #Hdr_OnEthernetStatus#; do not delete this line and do not add application code in this code block!
  /* #ChannelStart# |ETH1| #BusStart# |ETH_Cluster_MEB| */
  /* #ChannelEnd# |ETH1| #BusEnd# |ETH_Cluster_MEB| */
  //--- end generated part --- Block end #Hdr_OnEthernetStatus#; do not delete this line! Add application code below this line.
  //--- begin generated part --- Block start #Body_OnEthernetStatus#; do not delete this line and do not add application code in this code block!
  /* #ChannelStart# |ETH1| #BusStart# |ETH_Cluster_MEB| */
  /* #ChannelEnd# |ETH1| #BusEnd# |ETH_Cluster_MEB| */
  //--- end generated part --- Block end #Body_OnEthernetStatus#; do not delete this line! Add application code below this line.
}

on EthernetPacket *
{
  // Possibly propagate any received Ethernet packet
  //--- begin generated part --- Block start #Hdr_OnEthernetPacket#; do not delete this line and do not add application code in this code block!
  /* #ChannelStart# |ETH1| #BusStart# |ETH_Cluster_MEB| */
  /* #ChannelEnd# |ETH1| #BusEnd# |ETH_Cluster_MEB| */
  //--- end generated part --- Block end #Hdr_OnEthernetPacket#; do not delete this line! Add application code below this line.
  //--- begin generated part --- Block start #Body_OnEthernetPacket#; do not delete this line and do not add application code in this code block!
  /* #ChannelStart# |ETH1| #BusStart# |ETH_Cluster_MEB| */
  /* #ChannelEnd# |ETH1| #BusEnd# |ETH_Cluster_MEB| */
  //--- end generated part --- Block end #Body_OnEthernetPacket#; do not delete this line! Add application code below this line.
}

//--- begin generated part --- Block start <#Helper_Functions#> do not delete this line and do not add application code in this code block!
/* #ChannelStart# |ETH1| #BusStart# |ETH_Cluster_MEB| */
/* #ChannelEnd# |ETH1| #BusEnd# |ETH_Cluster_MEB| */
//--- end generated part --- Block end <#Helper_Functions#> do not delete this line! Add application code below this line.

//--- begin generated part --- Block start <#SysVar_Handler#> do not delete this line and do not add application code in this code block!
/* #ChannelStart# |ETH1| #BusStart# |ETH_Cluster_MEB| */
/* #ChannelEnd# |ETH1| #BusEnd# |ETH_Cluster_MEB| */
//--- end generated part --- Block end <#SysVar_Handler#> do not delete this line! Add application code below this line.

//--- begin generated part --- Block start <#MsgUpdateFcns#> do not delete this line and do not add application code in this code block!
/* #ChannelStart# |ETH1| #BusStart# |ETH_Cluster_MEB| */
/* #ChannelEnd# |ETH1| #BusEnd# |ETH_Cluster_MEB| */
//--- end generated part --- Block end <#MsgUpdateFcns#> do not delete this line! Add application code below this line.

