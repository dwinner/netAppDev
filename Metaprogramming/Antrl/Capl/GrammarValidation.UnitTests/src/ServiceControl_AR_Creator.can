/*@!Encoding:1252*/

variables
{
  msTimer tSend_ServiceDiscovery_Offer_ICAS1Gateway;     // fd53:7cb8:383:3::10
  byte    buffer[2000];
  word    i, j, k, l;
  
  word    tag_dataID;
  char    buffer_MAC[18];
  byte    buffer_ipv6[16];
  byte    buffer_uuid[16];
  char    buffer_char[100];
  dword   ipv6_len;
  byte    ret;
  char    someip_buffer[5000];
  
  
  // Service ACC
  word    ACC_payload_length_notifications;
  byte    ACC_payload_buffer_notifications[1000];
  word    ACC_payload_length_info;
  byte    ACC_payload_buffer_info[2000];
  word    ACC_payload_length_relevantObjects;
  byte    ACC_payload_buffer_relevantObjects[1000];
  word    ACC_payload_length_targetDistances;
  byte    ACC_payload_buffer_targetDistances[1000];
  word    ACC_payload_length_velocities;
  byte    ACC_payload_buffer_velocities[1000];
  word    ACC_payload_length_additionalInformation;
  byte    ACC_payload_buffer_additionalInformation[1000];
  
  word    ACC_array_notifications_array_element_length[10];
  word    ACC_array_notifications_struct_element_length;
  dword   ACC_array_notifications_type[10];
	dword   ACC_array_notifications_value[10];
  word    ACC_array_info_array_element_length[10];
  word    ACC_array_info_struct_element_length;
  dword   ACC_array_info_elementId[10];
	dword   ACC_array_info_functionOnDemandStatus[10];
	dword   ACC_array_info_distanceIndexPhysicalValue[10];
	dword   ACC_array_info_distanceIndexLogicalValue[10];
	dword   ACC_array_info_distanceIndexValueType[10];
	dword   ACC_array_info_statusGraMode[10];
	dword   ACC_array_info_maxDistanceScale[10];
	dword   ACC_array_info_statusObjectAccentuation[10];
	dword   ACC_array_info_situationalPrioritization[10];
	dword   ACC_array_info_statusEndOfTrafficJam[10];
	dword   ACC_array_info_statusIcon[10];
	dword   ACC_array_info_statusACC[10];
	dword   ACC_array_info_configuredVelocityReached[10];
	dword   ACC_array_info_hintsAdditionalDisplay[10];
	dword   ACC_array_info_accStatusDisplay[10];
	dword   ACC_array_info_lightAssistant[10];
	dword   ACC_array_info_overtakingPrevention[10];
	dword   ACC_array_info_tempolimit[10];
  word    ACC_array_relevantObjects_array_element_length[10];
  word    ACC_array_relevantObjects_struct_element_length;
	dword   ACC_array_relevantObjects_type[10];
	float   ACC_array_relevantObjects_distanceToObject[10];
	dword   ACC_array_relevantObjects_distanceToObjectValueType[10];
	dword   ACC_array_relevantObjects_objectType[10];
	dword   ACC_array_relevantObjects_videoID[10];
	dword   ACC_array_relevantObjects_videoIDValueType[10];
	float   ACC_array_relevantObjects_longitudinalDistanceToObject[10];
	dword   ACC_array_relevantObjects_longitudinalDistanceToObjectValueType[10];
	float   ACC_array_relevantObjects_lateralDistanceToObject[10];
	dword   ACC_array_relevantObjects_lateralDistanceToObjectValueType[10];
  word    ACC_array_targetDistances_array_element_length[10];
  word    ACC_array_targetDistances_struct_element_length;
	dword   ACC_array_targetDistances_type[10];
	float   ACC_array_targetDistances_distancePhysicalValue[10];
	dword   ACC_array_targetDistances_distanceValueType[10];
	dword   ACC_array_targetDistances_setTimeGap[10];
	dword   ACC_array_targetDistances_displayTimeGap[10];
  word    ACC_array_velocities_array_element_length[10];
  word    ACC_array_velocities_struct_element_length;
	dword   ACC_array_velocities_type[10];
	float   ACC_array_velocities_velocityPhysicalValue[10];
	dword   ACC_array_velocities_velocityValueType[10];
  word    ACC_array_additionalInformation_array_element_length[10];
  word    ACC_array_additionalInformation_struct_element_length;
	dword   ACC_array_additionalInformation_elementId[10];
	dword   ACC_array_additionalInformation_acaDisplayStatus[10];
	dword   ACC_array_additionalInformation_additionalDisplayObject[10];
	dword   ACC_array_additionalInformation_coloredStatusIcon[10];
	dword   ACC_array_additionalInformation_coloredRelevantObject[10];
	dword   ACC_array_additionalInformation_unitTempolimit[10];
	dword   ACC_array_additionalInformation_displayLightSpeedometerType[10];
	dword   ACC_array_additionalInformation_displayLightSpeedometerStatus[10];
	dword   ACC_array_additionalInformation_configuredVelocityColor[10];
  
  byte    ACC_array_notifications_available_functions[10];
  byte    ACC_array_notifications_type_available[10];
  byte    ACC_array_notifications_value_available[10];
  byte    ACC_array_info_available_functions[10];
  byte    ACC_array_info_elementId_available[10];
  byte    ACC_array_info_functionOnDemandStatus_available[10];
  byte    ACC_array_info_distanceIndexPhysicalValue_available[10];
  byte    ACC_array_info_distanceIndexLogicalValue_available[10];
  byte    ACC_array_info_distanceIndexValueType_available[10];
  byte    ACC_array_info_statusGraMode_available[10];
  byte    ACC_array_info_maxDistanceScale_available[10];
  byte    ACC_array_info_statusObjectAccentuation_available[10];
  byte    ACC_array_info_situationalPrioritization_available[10];
  byte    ACC_array_info_statusEndOfTrafficJam_available[10];
  byte    ACC_array_info_statusIcon_available[10];
  byte    ACC_array_info_statusACC_available[10];
  byte    ACC_array_info_configuredVelocityReached_available[10];
  byte    ACC_array_info_hintsAdditionalDisplay_available[10];
  byte    ACC_array_info_accStatusDisplay_available[10];
  byte    ACC_array_info_lightAssistant_available[10];
  byte    ACC_array_info_overtakingPrevention_available[10];
  byte    ACC_array_info_tempolimit_available[10];
  byte    ACC_array_relevantObjects_available_functions[10];
  byte    ACC_array_relevantObjects_type_available[10];
  byte    ACC_array_relevantObjects_distanceToObject_available[10];
  byte    ACC_array_relevantObjects_distanceToObjectValueType_available[10];
  byte    ACC_array_relevantObjects_objectType_available[10];
  byte    ACC_array_relevantObjects_videoID_available[10];
  byte    ACC_array_relevantObjects_videoIDValueType_available[10];
  byte    ACC_array_relevantObjects_longitudinalDistanceToObject_available[10];
  byte    ACC_array_relevantObjects_longitudinalDistanceToObjectValueType_available[10];
  byte    ACC_array_relevantObjects_lateralDistanceToObject_available[10];
  byte    ACC_array_relevantObjects_lateralDistanceToObjectValueType_available[10];
  byte    ACC_array_targetDistances_available_functions[10];
  byte    ACC_array_targetDistances_type_available[10];
  byte    ACC_array_targetDistances_distancePhysicalValue_available[10];
  byte    ACC_array_targetDistances_distanceValueType_available[10];
  byte    ACC_array_targetDistances_setTimeGap_available[10];
  byte    ACC_array_targetDistances_displayTimeGap_available[10];
  byte    ACC_array_velocities_available_functions[10];
  byte    ACC_array_velocities_type_available[10];
  byte    ACC_array_velocities_velocityPhysicalValue_available[10];
  byte    ACC_array_velocities_velocityValueType_available[10];
  byte    ACC_array_additionalInformation_available_functions[10];
  byte    ACC_array_additionalInformation_elementId_available[10];
  byte    ACC_array_additionalInformation_acaDisplayStatus_available[10];
  byte    ACC_array_additionalInformation_additionalDisplayObject_available[10];
  byte    ACC_array_additionalInformation_coloredStatusIcon_available[10];
  byte    ACC_array_additionalInformation_coloredRelevantObject_available[10];
  byte    ACC_array_additionalInformation_unitTempolimit_available[10];
  byte    ACC_array_additionalInformation_displayLightSpeedometerType_available[10];
  byte    ACC_array_additionalInformation_displayLightSpeedometerStatus_available[10];
  byte    ACC_array_additionalInformation_configuredVelocityColor_available[10];
    
  mstimer ACC_Segmentation_delay;
  word    ACC_Segmentation_Method_ID;
  
  mstimer tACC_Notification_notifications_Send;
  mstimer tACC_Notification_info_Send;
  mstimer tACC_Notification_relevantObjects_Send;
  mstimer tACC_Notification_targetDistances_Send;
  mstimer tACC_Notification_velocities_Send;
  mstimer tACC_Notification_additionalInformation_Send;
  
  
  // Service AWV
  word    AWV_payload_length_notifications;
  byte    AWV_payload_buffer_notifications[1000];
  word    AWV_payload_length_info;
  byte    AWV_payload_buffer_info[1000];
  
  word    AWV_array_notifications_array_element_length[10];
  word    AWV_array_notifications_struct_element_length;
  dword   AWV_array_notifications_type[10];
	dword   AWV_array_notifications_value[10];
  word    AWV_array_info_array_element_length[10];
  word    AWV_array_info_struct_element_length;
	dword   AWV_array_info_elementId[10];
	dword   AWV_array_info_timeGap[10];
	dword   AWV_array_info_cameraObjectId[10];
	dword   AWV_array_info_cameraObjectIdValueType[10];
  
  byte    AWV_array_notifications_available_functions[10];
  byte    AWV_array_notifications_type_available[10];
  byte    AWV_array_notifications_value_available[10];
  byte    AWV_array_info_available_functions[10];
  byte    AWV_array_info_elementId_available[10];
  byte    AWV_array_info_timeGap_available[10];
  byte    AWV_array_info_cameraObjectId_available[10];
  byte    AWV_array_info_cameraObjectIdValueType_available[10];
  
  mstimer AWV_Segmentation_delay;
  word    AWV_Segmentation_Method_ID;
  
  mstimer tAWV_Notification_notifications_Send;
  mstimer tAWV_Notification_info_Send;
  
  
  // Service LaneAssist
  word    LaneAssist_payload_length_notifications;
  byte    LaneAssist_payload_buffer_notifications[1000];
  
  word    LaneAssist_array_notifications_array_element_length[10];
  word    LaneAssist_array_notifications_struct_element_length;
  dword   LaneAssist_array_notifications_type[10];
	dword   LaneAssist_array_notifications_value[10];
  
  byte    LaneAssist_array_notifications_available_functions[10];
  byte    LaneAssist_array_notifications_type_available[10];
  byte    LaneAssist_array_notifications_value_available[10];

  mstimer LaneAssist_Segmentation_delay;
  word    LaneAssist_Segmentation_Method_ID;
  
  mstimer tLaneAssist_Notification_notifications_Send;
  
  
  // Service TravelAssist  
  word    TravelAssist_payload_length_notifications;
  byte    TravelAssist_payload_buffer_notifications[1000];
  word    TravelAssist_payload_length_lanes;
  byte    TravelAssist_payload_buffer_lanes[1000];
  word    TravelAssist_payload_length_curveParameters;
  byte    TravelAssist_payload_buffer_curveParameters[1000];
  word    TravelAssist_payload_length_info;
  byte    TravelAssist_payload_buffer_info[1000];
  word    TravelAssist_payload_length_relevantObjects;
  byte    TravelAssist_payload_buffer_relevantObjects[1000];
  
  word    TravelAssist_array_notifications_array_element_length[10];
  word    TravelAssist_array_notifications_struct_element_length;
  dword   TravelAssist_array_notifications_type[10];
	dword   TravelAssist_array_notifications_value[10];
  word    TravelAssist_array_lanes_array_element_length[10];
  word    TravelAssist_array_lanes_struct_element_length;
	dword   TravelAssist_array_lanes_type[10];
	dword   TravelAssist_array_lanes_laneType[10];
	float   TravelAssist_array_lanes_transversalDistance[10];
  word    TravelAssist_array_curveParameters_array_element_length[10];
  word    TravelAssist_array_curveParameters_struct_element_length;
	dword   TravelAssist_array_curveParameters_type[10];
	float   TravelAssist_array_curveParameters_firstSegmentYawAngle[10];
	dword   TravelAssist_array_curveParameters_firstSegmentCurvature[10];
	float   TravelAssist_array_curveParameters_secondSegmentBeginning[10];
	dword   TravelAssist_array_curveParameters_secondSegmentCurvature[10];
	float   TravelAssist_array_curveParameters_firstSegmentTransversalDistance[10];
  word    TravelAssist_array_info_array_element_length[10];
  word    TravelAssist_array_info_struct_element_length;
	dword   TravelAssist_array_info_elementId[10];
	float   TravelAssist_array_info_zoomLevel[10];
	byte    TravelAssist_array_info_laneChangeToLeft[10];
	byte    TravelAssist_array_info_laneChangeToRight[10];
	byte    TravelAssist_array_info_egoTrajectoryValid[10];
	byte    TravelAssist_array_info_zoomLevelActivated[10];
	float   TravelAssist_array_info_trajectoryForecast[10];
	byte    TravelAssist_array_info_curveWarning[10];
  word    TravelAssist_array_relevantObjects_array_element_length[10];
  word    TravelAssist_array_relevantObjects_struct_element_length;
	dword   TravelAssist_array_relevantObjects_type[10];
	float   TravelAssist_array_relevantObjects_longitudinalDistance[10];
	float   TravelAssist_array_relevantObjects_percentagePosition[10];
	dword   TravelAssist_array_relevantObjects_laneMapping[10];
	dword   TravelAssist_array_relevantObjects_objectType[10];
	byte    TravelAssist_array_relevantObjects_isTransversalControlActive[10];
	byte    TravelAssist_array_relevantObjects_isLongitudinalControlActive[10];
  
  byte    TravelAssist_array_notifications_available_functions[10];
	byte    TravelAssist_array_notifications_type_available[10];
	byte    TravelAssist_array_notifications_value_available[10];
  byte    TravelAssist_array_lanes_available_functions[10];
	byte    TravelAssist_array_lanes_type_available[10];
	byte    TravelAssist_array_lanes_laneType_available[10];
	byte    TravelAssist_array_lanes_transversalDistance_available[10];
  byte    TravelAssist_array_curveParameters_available_functions[10];
	byte    TravelAssist_array_curveParameters_type_available[10];
	byte    TravelAssist_array_curveParameters_firstSegmentYawAngle_available[10];
	byte    TravelAssist_array_curveParameters_firstSegmentCurvature_available[10];
	byte    TravelAssist_array_curveParameters_secondSegmentBeginning_available[10];
	byte    TravelAssist_array_curveParameters_secondSegmentCurvature_available[10];
	byte    TravelAssist_array_curveParameters_firstSegmentTransversalDistance_available[10];
  byte    TravelAssist_array_info_available_functions[10];
	byte    TravelAssist_array_info_elementId_available[10];
	byte    TravelAssist_array_info_zoomLevel_available[10];
	byte    TravelAssist_array_info_laneChangeToLeft_available[10];
	byte    TravelAssist_array_info_laneChangeToRight_available[10];
	byte    TravelAssist_array_info_egoTrajectoryValid_available[10];
	byte    TravelAssist_array_info_zoomLevelActivated_available[10];
	byte    TravelAssist_array_info_trajectoryForecast_available[10];
	byte    TravelAssist_array_info_curveWarning_available[10];
  byte    TravelAssist_array_relevantObjects_available_functions[10];
	byte    TravelAssist_array_relevantObjects_type_available[10];
	byte    TravelAssist_array_relevantObjects_longitudinalDistance_available[10];
	byte    TravelAssist_array_relevantObjects_percentagePosition_available[10];
	byte    TravelAssist_array_relevantObjects_laneMapping_available[10];
	byte    TravelAssist_array_relevantObjects_objectType_available[10];
	byte    TravelAssist_array_relevantObjects_isTransversalControlActive_available[10];
	byte    TravelAssist_array_relevantObjects_isLongitudinalControlActive_available[10];
  
  mstimer TravelAssist_Segmentation_delay;
  word    TravelAssist_Segmentation_Method_ID;
  
  mstimer tTravelAssist_Notification_notifications_Send;
  mstimer tTravelAssist_Notification_lanes_Send;
  mstimer tTravelAssist_Notification_curveParameters_Send;
  mstimer tTravelAssist_Notification_info_Send;
  mstimer tTravelAssist_Notification_relevantObjects_Send;
  
  
  // Service Odometry
  word    Odometry_payload_length_speeds;
  byte    Odometry_payload_buffer_speeds[1000];
  word    Odometry_payload_length_velocities;
  byte    Odometry_payload_buffer_velocities[1000];
  word    Odometry_payload_length_pose2D;
  byte    Odometry_payload_buffer_pose2D[1000];
  word    Odometry_payload_length_additionalVehicleMotionInformations;
  byte    Odometry_payload_buffer_additionalVehicleMotionInformations[1000];
  word    Odometry_payload_length_wheelCorrections;
  byte    Odometry_payload_buffer_wheelCorrections[1000];
  word    Odometry_payload_length_accelerations;
  byte    Odometry_payload_buffer_accelerations[1000];
  word    Odometry_payload_length_angularRates;
  byte    Odometry_payload_buffer_angularRates[1000];
  
  word    Odometry_array_speeds_array_element_length[10];
  word    Odometry_array_speeds_struct_element_length;
  dword   Odometry_array_speeds_type[10];
	float   Odometry_array_speeds_value[10];
	dword   Odometry_array_speeds_confidence[10];
	qword   Odometry_array_speeds_timestamp[10];
  word    Odometry_array_velocities_array_element_length[10];
  word    Odometry_array_velocities_struct_element_length;
  dword   Odometry_array_velocities_type[10];
	qword   Odometry_array_velocities_timestamp[10];
	float   Odometry_array_velocities_value[10];
	float   Odometry_array_velocities_variance[10];
	dword   Odometry_array_velocities_confidence[10];
  word    Odometry_array_pose2D_array_element_length[10];
  word    Odometry_array_pose2D_struct_element_length;
	qword   Odometry_array_pose2D_timestamp[10];
	double  Odometry_array_pose2D_positionX[10];
	double  Odometry_array_pose2D_positionY[10];
	float   Odometry_array_pose2D_yawAngle[10];
	float   Odometry_array_pose2D_positionXVariance[10];
	float   Odometry_array_pose2D_positionYVariance[10];
	float   Odometry_array_pose2D_yawAngleVariance[10];
	dword   Odometry_array_pose2D_pose2dConfidence[10];
  word    Odometry_array_additionalVehicleMotionInformations_array_element_length[10];
  word    Odometry_array_additionalVehicleMotionInformations_struct_element_length;
	qword   Odometry_array_additionalVehicleMotionInformations_timestamp[10];
	float   Odometry_array_additionalVehicleMotionInformations_drivingDirectionProbabilityRange[10];
	dword   Odometry_array_additionalVehicleMotionInformations_drivingDirectionProbabilityRangeConfidence[10];
	float   Odometry_array_additionalVehicleMotionInformations_standStillProbabilityRange[10];
	dword   Odometry_array_additionalVehicleMotionInformations_standStillProbabilityRangeConfidence[10];
  word    Odometry_array_wheelCorrections_array_element_length[10];
  word    Odometry_array_wheelCorrections_struct_element_length;
	qword   Odometry_array_wheelCorrections_timestamp[10];
	float   Odometry_array_wheelCorrections_wheelCorrectionFactorFrontLeft[10];
	float   Odometry_array_wheelCorrections_wheelCorrectionFactorFrontRight[10];
	float   Odometry_array_wheelCorrections_wheelCorrectionFactorRearLeft[10];
	float   Odometry_array_wheelCorrections_wheelCorrectionFactorRearRight[10];
	byte    Odometry_array_wheelCorrections_wheelCorrectionFactorEstimatorStatus[10];
	dword   Odometry_array_wheelCorrections_wheelCorrectionFactorEstimatorStatusConfidence[10];
	dword   Odometry_array_wheelCorrections_wheelCorrectionFactorFrontLeftConfidence[10];
	dword   Odometry_array_wheelCorrections_wheelCorrectionFactorFrontRightConfidence[10];
	dword   Odometry_array_wheelCorrections_wheelCorrectionFactoRearLeftConfidence[10];
	dword   Odometry_array_wheelCorrections_wheelCorrectionFactoRearRightConfidence[10];
	word    Odometry_array_wheelCorrections_wheelCircumferenceStatic[10];
	dword   Odometry_array_wheelCorrections_wheelCircumferenceStaticConfidence[10];
  word    Odometry_array_accelerations_array_element_length[10];
  word    Odometry_array_accelerations_struct_element_length;
	dword   Odometry_array_accelerations_type[10];
	qword   Odometry_array_accelerations_timestamp[10];
	float   Odometry_array_accelerations_acceleration[10];
	float   Odometry_array_accelerations_variance[10];
	dword   Odometry_array_accelerations_confidence[10];
  word    Odometry_array_angularRates_array_element_length[10];
  word    Odometry_array_angularRates_struct_element_length;
	dword   Odometry_array_angularRates_type[10];
	qword   Odometry_array_angularRates_timestamp[10];
	float   Odometry_array_angularRates_angularrate[10];
	float   Odometry_array_angularRates_variance[10];
	dword   Odometry_array_angularRates_confidence[10];
  
  byte    Odometry_array_speeds_available_functions[10];
	byte    Odometry_array_speeds_type_available[10];
	byte    Odometry_array_speeds_value_available[10];
	byte    Odometry_array_speeds_confidence_available[10];
	byte    Odometry_array_speeds_timestamp_available[10];
  byte    Odometry_array_velocities_available_functions[10];
	byte    Odometry_array_velocities_type_available[10];
	byte    Odometry_array_velocities_timestamp_available[10];
	byte    Odometry_array_velocities_value_available[10];
	byte    Odometry_array_velocities_variance_available[10];
	byte    Odometry_array_velocities_confidence_available[10];
  byte    Odometry_array_pose2D_available_functions[10];
	byte    Odometry_array_pose2D_timestamp_available[10];
	byte    Odometry_array_pose2D_positionX_available[10];
	byte    Odometry_array_pose2D_positionY_available[10];
	byte    Odometry_array_pose2D_yawAngle_available[10];
	byte    Odometry_array_pose2D_positionXVariance_available[10];
	byte    Odometry_array_pose2D_positionYVariance_available[10];
	byte    Odometry_array_pose2D_yawAngleVariance_available[10];
	byte    Odometry_array_pose2D_pose2dConfidence_available[10];
  byte    Odometry_array_additionalVehicleMotionInformations_available_functions[10];
	byte    Odometry_array_additionalVehicleMotionInformations_timestamp_available[10];
	byte    Odometry_array_additionalVehicleMotionInformations_drivingDirectionProbabilityRange_available[10];
	byte    Odometry_array_additionalVehicleMotionInformations_drivingDirectionProbabilityRangeConfidence_available[10];
	byte    Odometry_array_additionalVehicleMotionInformations_standStillProbabilityRange_available[10];
	byte    Odometry_array_additionalVehicleMotionInformations_standStillProbabilityRangeConfidence_available[10];
  byte    Odometry_array_wheelCorrections_available_functions[10];
	byte    Odometry_array_wheelCorrections_timestamp_available[10];
	byte    Odometry_array_wheelCorrections_wheelCorrectionFactorFrontLeft_available[10];
	byte    Odometry_array_wheelCorrections_wheelCorrectionFactorFrontRight_available[10];
	byte    Odometry_array_wheelCorrections_wheelCorrectionFactorRearLeft_available[10];
	byte    Odometry_array_wheelCorrections_wheelCorrectionFactorRearRight_available[10];
	byte    Odometry_array_wheelCorrections_wheelCorrectionFactorEstimatorStatus_available[10];
	byte    Odometry_array_wheelCorrections_wheelCorrectionFactorEstimatorStatusConfidence_available[10];
	byte    Odometry_array_wheelCorrections_wheelCorrectionFactorFrontLeftConfidence_available[10];
	byte    Odometry_array_wheelCorrections_wheelCorrectionFactorFrontRightConfidence_available[10];
	byte    Odometry_array_wheelCorrections_wheelCorrectionFactoRearLeftConfidence_available[10];
	byte    Odometry_array_wheelCorrections_wheelCorrectionFactoRearRightConfidence_available[10];
	byte    Odometry_array_wheelCorrections_wheelCircumferenceStatic_available[10];
	byte    Odometry_array_wheelCorrections_wheelCircumferenceStaticConfidence_available[10];
  byte    Odometry_array_accelerations_available_functions[10];
	byte    Odometry_array_accelerations_type_available[10];
	byte    Odometry_array_accelerations_timestamp_available[10];
	byte    Odometry_array_accelerations_acceleration_available[10];
	byte    Odometry_array_accelerations_variance_available[10];
	byte    Odometry_array_accelerations_confidence_available[10];
  byte    Odometry_array_angularRates_available_functions[10];
	byte    Odometry_array_angularRates_type_available[10];
	byte    Odometry_array_angularRates_timestamp_available[10];
	byte    Odometry_array_angularRates_angularrate_available[10];
	byte    Odometry_array_angularRates_variance_available[10];
	byte    Odometry_array_angularRates_confidence_available[10];
  
  mstimer Odometry_Segmentation_delay;
  word    Odometry_Segmentation_Method_ID;
  
  mstimer tOdometry_Notification_speeds_Send;
  mstimer tOdometry_Notification_velocities_Send;
  mstimer tOdometry_Notification_pose2D_Send;
  mstimer tOdometry_Notification_additionalVehicleMotionInformations_Send;
  mstimer tOdometry_Notification_wheelCorrections_Send;
  mstimer tOdometry_Notification_accelerations_Send;
  mstimer tOdometry_Notification_angularRates_Send;
  
  
  // Service OccupantPresence
  word    OccupantPresence_payload_length_driverPresenceStatus;
  byte    OccupantPresence_payload_buffer_driverPresenceStatus[1000];
  word    OccupantPresence_payload_length_occupantPresenceStatus;
  byte    OccupantPresence_payload_buffer_occupantPresenceStatus[1000];
  
  word    OccupantPresence_array_driverPresenceStatus_array_element_length[10];
  word    OccupantPresence_array_driverPresenceStatus_struct_element_length;
  dword   OccupantPresence_array_driverPresenceStatus_elementId[10];
	dword   OccupantPresence_array_driverPresenceStatus_driverState[10];
	dword   OccupantPresence_array_driverPresenceStatus_comfortReadyStatus[10];
  word    OccupantPresence_array_occupantPresenceStatus_array_element_length[10];
  word    OccupantPresence_array_occupantPresenceStatus_struct_element_length;
	dword   OccupantPresence_array_occupantPresenceStatus_occupantId[10];
	dword   OccupantPresence_array_occupantPresenceStatus_occupantState[10];
  
  byte    OccupantPresence_array_driverPresenceStatus_available_functions[10];
  byte    OccupantPresence_array_driverPresenceStatus_elementId_available[10];
  byte    OccupantPresence_array_driverPresenceStatus_driverState_available[10];
  byte    OccupantPresence_array_driverPresenceStatus_comfortReadyStatus_available[10];
  byte    OccupantPresence_array_occupantPresenceStatus_available_functions[10];
  byte    OccupantPresence_array_occupantPresenceStatus_occupantId_available[10];
  byte    OccupantPresence_array_occupantPresenceStatus_occupantState_available[10];
  
  mstimer OccupantPresence_Segmentation_delay;
  word    OccupantPresence_Segmentation_Method_ID;
  
  mstimer tOccupantPresence_Notification_driverPresenceStatus_Send;
  mstimer tOccupantPresence_Notification_occupantPresenceStatus_Send;
  
  
  // Service VehicleBasicData
  word    VehicleBasicData_payload_length_installations;
  byte    VehicleBasicData_payload_buffer_installations[1000];
  word    VehicleBasicData_payload_length_variants;
  byte    VehicleBasicData_payload_buffer_variants[1000];
  word    VehicleBasicData_payload_length_parameters;
  byte    VehicleBasicData_payload_buffer_parameters[1000];
  
  word    VehicleBasicData_array_installations_array_element_length[10];
  word    VehicleBasicData_array_installations_struct_element_length;
  dword   VehicleBasicData_array_installations_elementId[10];
	byte    VehicleBasicData_array_installations_rainSensor[10];
	byte    VehicleBasicData_array_installations_exteriorSound[10];
	byte    VehicleBasicData_array_installations_allWheelDrive[10];
	byte    VehicleBasicData_array_installations_speedLimiterButton[10];
	dword   VehicleBasicData_array_installations_rearSeatOccupiedSensor[10];
  word    VehicleBasicData_array_variants_array_element_length[10];
  word    VehicleBasicData_array_variants_struct_element_length;
	dword   VehicleBasicData_array_variants_elementId[10];
	dword   VehicleBasicData_array_variants_adaptiveCruiseControlType[10];
	dword   VehicleBasicData_array_variants_engineType[10];
	dword   VehicleBasicData_array_variants_steeringWheelPosition[10];
	dword   VehicleBasicData_array_variants_fuelType[10];
	dword   VehicleBasicData_array_variants_hybridType[10];
  word    VehicleBasicData_array_parameters_array_element_length[10];
  word    VehicleBasicData_array_parameters_struct_element_length;
	dword   VehicleBasicData_array_parameters_elementId[10];
	dword   VehicleBasicData_array_parameters_tyreCircumference[10];
  
  byte    VehicleBasicData_array_installations_available_functions[10];
  byte    VehicleBasicData_array_installations_elementId_available[10];
  byte    VehicleBasicData_array_installations_rainSensor_available[10];
  byte    VehicleBasicData_array_installations_exteriorSound_available[10];
  byte    VehicleBasicData_array_installations_allWheelDrive_available[10];
  byte    VehicleBasicData_array_installations_speedLimiterButton_available[10];
  byte    VehicleBasicData_array_installations_rearSeatOccupiedSensor_available[10];
  byte    VehicleBasicData_array_variants_available_functions[10];
  byte    VehicleBasicData_array_variants_elementId_available[10];
  byte    VehicleBasicData_array_variants_adaptiveCruiseControlType_available[10];
  byte    VehicleBasicData_array_variants_engineType_available[10];
  byte    VehicleBasicData_array_variants_steeringWheelPosition_available[10];
  byte    VehicleBasicData_array_variants_fuelType_available[10];
  byte    VehicleBasicData_array_variants_hybridType_available[10];
  byte    VehicleBasicData_array_parameters_available_functions[10];
  byte    VehicleBasicData_array_parameters_elementId_available[10];
  byte    VehicleBasicData_array_parameters_tyreCircumference_available[10];
  
  mstimer VehicleBasicData_Segmentation_delay;
  word    VehicleBasicData_Segmentation_Method_ID;
  
  mstimer tVehicleBasicData_Notification_installations_Send;
  mstimer tVehicleBasicData_Notification_variants_Send;
  mstimer tVehicleBasicData_Notification_parameters_Send;
  
  
  // Service Powertrain
  word    Powertrain_payload_length_notifications;
  byte    Powertrain_payload_buffer_notifications[1000];
  word    Powertrain_payload_length_displayValues;
  byte    Powertrain_payload_buffer_displayValues[1000];
  word    Powertrain_payload_length_status;
  byte    Powertrain_payload_buffer_status[1000];
  
  word    Powertrain_array_notifications_array_element_length[10];
  word    Powertrain_array_notifications_struct_element_length;
  dword   Powertrain_array_notifications_type[10];
  dword   Powertrain_array_notifications_value[10];
  word    Powertrain_array_displayValues_array_element_length[10];
  word    Powertrain_array_displayValues_struct_element_length;
	dword   Powertrain_array_displayValues_elementId[10];
	dword   Powertrain_array_displayValues_gearShiftPosition[10];
	dword   Powertrain_array_displayValues_recuperationLevel[10];
	byte    Powertrain_array_displayValues_isPowertrainActive[10];
	byte    Powertrain_array_displayValues_isShiftLockActive[10];
  word    Powertrain_array_status_array_element_length[10];
  word    Powertrain_array_status_struct_element_length;
	dword   Powertrain_array_status_elementId[10];
	byte    Powertrain_array_status_isKickDown[10];
	dword   Powertrain_array_status_gearShiftPositionTarget[10];
	dword   Powertrain_array_status_powertrainAndPropulsionState[10];
  
  byte    Powertrain_array_notifications_available_functions[10];
	byte    Powertrain_array_notifications_type_available[10];
	byte    Powertrain_array_notifications_value_available[10];
  byte    Powertrain_array_displayValues_available_functions[10];
	byte    Powertrain_array_displayValues_elementId_available[10];
	byte    Powertrain_array_displayValues_gearShiftPosition_available[10];
	byte    Powertrain_array_displayValues_recuperationLevel_available[10];
	byte    Powertrain_array_displayValues_isPowertrainActive_available[10];
	byte    Powertrain_array_displayValues_isShiftLockActive_available[10];
  byte    Powertrain_array_status_available_functions[10];
	byte    Powertrain_array_status_elementId_available[10];
	byte    Powertrain_array_status_isKickDown_available[10];
	byte    Powertrain_array_status_gearShiftPositionTarget_available[10];
	byte    Powertrain_array_status_powertrainAndPropulsionState_available[10];
  
  mstimer Powertrain_Segmentation_delay;
  word    Powertrain_Segmentation_Method_ID;
  
  mstimer tPowertrain_Notification_notifications_Send;
  mstimer tPowertrain_Notification_displayValues_Send;
  mstimer tPowertrain_Notification_status_Send;
  
  
  
  
  const   max_number_of_offered_services_by_ICAS1Gateway = 8;
  byte    servicediscovery_offer_ICAS1Gateway_entries_array_type[max_number_of_offered_services_by_ICAS1Gateway];
  byte    servicediscovery_offer_ICAS1Gateway_entries_array_index_1st_options[max_number_of_offered_services_by_ICAS1Gateway];
  byte    servicediscovery_offer_ICAS1Gateway_entries_array_index_2nd_options[max_number_of_offered_services_by_ICAS1Gateway];
  byte    servicediscovery_offer_ICAS1Gateway_entries_array_nr_of_opt_1[max_number_of_offered_services_by_ICAS1Gateway];
  byte    servicediscovery_offer_ICAS1Gateway_entries_array_nr_of_opt_2[max_number_of_offered_services_by_ICAS1Gateway];
  word    servicediscovery_offer_ICAS1Gateway_entries_array_service_id[max_number_of_offered_services_by_ICAS1Gateway];
  word    servicediscovery_offer_ICAS1Gateway_entries_array_instance_id[max_number_of_offered_services_by_ICAS1Gateway];
  byte    servicediscovery_offer_ICAS1Gateway_entries_array_major_version[max_number_of_offered_services_by_ICAS1Gateway];
  dword   servicediscovery_offer_ICAS1Gateway_entries_array_ttl[max_number_of_offered_services_by_ICAS1Gateway];
  dword   servicediscovery_offer_ICAS1Gateway_entries_array_minor_version[max_number_of_offered_services_by_ICAS1Gateway];
  
  byte    servicediscovery_sub_rx_entries_array_type[20];
  byte    servicediscovery_sub_rx_entries_array_index_1st_options[20];
  byte    servicediscovery_sub_rx_entries_array_index_2nd_options[20];
  byte    servicediscovery_sub_rx_entries_array_nr_of_opt_1[20];
  byte    servicediscovery_sub_rx_entries_array_nr_of_opt_2[20];
  word    servicediscovery_sub_rx_entries_array_service_id[20];
  word    servicediscovery_sub_rx_entries_array_instance_id[20];
  byte    servicediscovery_sub_rx_entries_array_major_version[20];
  dword   servicediscovery_sub_rx_entries_array_ttl[20];
  word    servicediscovery_sub_rx_entries_array_counter[20];
  word    servicediscovery_sub_rx_entries_array_eventgroup_id[20];
  
  dword   temp_converttodword;
  qword   temp_converttoqword;
  dword   temp_64bit_high;
  dword   temp_64bit_low;
  
  byte    number_of_offered_services_by_ICAS1Gateway;
  byte    service_counter;
  byte    number_of_entries_array_elements;
    
  byte    UDP_Segments_total;
  byte    UDP_Segments_left;
  
  byte    seg_id_flag;
}

on start
{
  @Send_ServiceDiscovery_Offer                                           = 1;
  @Send_ServiceDiscovery_Offer_Time                                      = 1000;
  @Send_ServiceDiscovery_Offer_AutomaticReply                            = 0;
  
  // Ethernet Packet
  putValue (ServiceDiscovery_EthernetPacket_MAC_Source_ICAS1Gateway,     "02:7D:FA:00:10:00");
  putValue (ServiceDiscovery_EthernetPacket_MAC_Destination_SD,          "33:33:00:04:00:00");
  putValue (ServiceDiscovery_EthernetPacket_MAC_Destination,             "00:22:A0:B9:04:1C");
  @ServiceDiscovery_EthernetPacket_VLAN_TPID                             = 0x8100;
  @ServiceDiscovery_EthernetPacket_VLAN_TCI                              = 0x6003;
  @ServiceDiscovery_EthernetPacket_Type                                  = 0x86DD;
                                                                         
  // IPv6 Packet                                                         
  @ServiceDiscovery_IPv6Packet_Version                                   = 6;
  @ServiceDiscovery_IPv6Packet_Traffic_Class                             = 0;
  @ServiceDiscovery_IPv6Packet_Flow_Label                                = 0;
  @ServiceDiscovery_IPv6Packet_Payload_Length                            = 64; // wird automatisch berechnet
  @ServiceDiscovery_IPv6Packet_Next_Header                               = 17; // UDP
  @ServiceDiscovery_IPv6Packet_Hop_Limit                                 = 64;
  @ServiceDiscovery_IPv6Packet_IP_Source_ICAS1Gateway_01                 = 0xFD53; // "fd53:7cb8:383:3::10"
  @ServiceDiscovery_IPv6Packet_IP_Source_ICAS1Gateway_02                 = 0x7CB8;
  @ServiceDiscovery_IPv6Packet_IP_Source_ICAS1Gateway_03                 = 0x0383;
  @ServiceDiscovery_IPv6Packet_IP_Source_ICAS1Gateway_04                 = 0x0003;
  @ServiceDiscovery_IPv6Packet_IP_Source_ICAS1Gateway_05                 = 0x0000;
  @ServiceDiscovery_IPv6Packet_IP_Source_ICAS1Gateway_06                 = 0x0000;
  @ServiceDiscovery_IPv6Packet_IP_Source_ICAS1Gateway_07                 = 0x0000;
  @ServiceDiscovery_IPv6Packet_IP_Source_ICAS1Gateway_08                 = 0x0010;
  @ServiceDiscovery_IPv6Packet_IP_Destination_Multicast_01               = 0xFF14; // "ff14::4:0"
  @ServiceDiscovery_IPv6Packet_IP_Destination_Multicast_02               = 0x0000;
  @ServiceDiscovery_IPv6Packet_IP_Destination_Multicast_03               = 0x0000;
  @ServiceDiscovery_IPv6Packet_IP_Destination_Multicast_04               = 0x0000;
  @ServiceDiscovery_IPv6Packet_IP_Destination_Multicast_05               = 0x0000;
  @ServiceDiscovery_IPv6Packet_IP_Destination_Multicast_06               = 0x0000;
  @ServiceDiscovery_IPv6Packet_IP_Destination_Multicast_07               = 0x0004;
  @ServiceDiscovery_IPv6Packet_IP_Destination_Multicast_08               = 0x0000;
  @ServiceDiscovery_IPv6Packet_IP_Destination_Unicast_01                 = 0xFD53; // "fd53:7cb8:383:3::73"
  @ServiceDiscovery_IPv6Packet_IP_Destination_Unicast_02                 = 0x7CB8;
  @ServiceDiscovery_IPv6Packet_IP_Destination_Unicast_03                 = 0x0383;
  @ServiceDiscovery_IPv6Packet_IP_Destination_Unicast_04                 = 0x0003;
  @ServiceDiscovery_IPv6Packet_IP_Destination_Unicast_05                 = 0x0000;
  @ServiceDiscovery_IPv6Packet_IP_Destination_Unicast_06                 = 0x0000;
  @ServiceDiscovery_IPv6Packet_IP_Destination_Unicast_07                 = 0x0000;
  @ServiceDiscovery_IPv6Packet_IP_Destination_Unicast_08                 = 0x0073;
  
  // UDP Packet
  @ServiceDiscovery_UDPPacket_Port_Source                                = 30490;
  @ServiceDiscovery_UDPPacket_Port_Destination                           = 30490;
  @ServiceDiscovery_UDPPacket_Length                                     = 64; // wird automatisch berechnet
  //@ServiceDiscovery_UDPPacket_Checksum                                 = 0; // wird automatisch berechnet
  
  @ServiceDiscovery_SOMEIPPacket_Request_ID_Session_ID                   = 0;
  
  // SOMEIPPacket
  @ServiceDiscovery_SOMEIPPacket_Offer_ICAS1Gateway_Message_ID_Service_ID             = 0xFFFF;
  @ServiceDiscovery_SOMEIPPacket_Offer_ICAS1Gateway_Message_ID_Method_ID              = 0x8100;
  @ServiceDiscovery_SOMEIPPacket_Offer_ICAS1Gateway_Length                            = 32;
  @ServiceDiscovery_SOMEIPPacket_Offer_ICAS1Gateway_Request_ID_Client_ID              = 0;
  @ServiceDiscovery_SOMEIPPacket_Offer_ICAS1Gateway_Protocol_Version                  = 1;
  @ServiceDiscovery_SOMEIPPacket_Offer_ICAS1Gateway_Interface_Version                 = 1;
  @ServiceDiscovery_SOMEIPPacket_Offer_ICAS1Gateway_Message_Type                      = 2; // 0x00 REQUEST / 0x01 REQUEST_NO_RETURN / 0x02 NOTIFICATION / 0x80 RESPONSE / 0x81 ERROR / 0x42 NOTIFICATION_ACK
  @ServiceDiscovery_SOMEIPPacket_Offer_ICAS1Gateway_Return_Code                       = 0;
  @ServiceDiscovery_SOMEIPPacket_Offer_ICAS1Gateway_Flags                             = 0x80;
  @ServiceDiscovery_SOMEIPPacket_Offer_ICAS1Gateway_Entries_Array_Element             = 0;
  @ServiceDiscovery_SOMEIPPacket_Offer_ICAS1Gateway_Entries_Array_Type                = 0;
  @ServiceDiscovery_SOMEIPPacket_Offer_ICAS1Gateway_Entries_Array_Index_1st_options   = 0;
  @ServiceDiscovery_SOMEIPPacket_Offer_ICAS1Gateway_Entries_Array_Index_2nd_options   = 0;
  @ServiceDiscovery_SOMEIPPacket_Offer_ICAS1Gateway_Entries_Array_Nr_of_opt_1         = 0;
  @ServiceDiscovery_SOMEIPPacket_Offer_ICAS1Gateway_Entries_Array_Nr_of_opt_2         = 0;
  @ServiceDiscovery_SOMEIPPacket_Offer_ICAS1Gateway_Entries_Array_Service_ID          = 0;
  @ServiceDiscovery_SOMEIPPacket_Offer_ICAS1Gateway_Entries_Array_Instance_ID         = 0;
  @ServiceDiscovery_SOMEIPPacket_Offer_ICAS1Gateway_Entries_Array_Major_Version       = 0;
  @ServiceDiscovery_SOMEIPPacket_Offer_ICAS1Gateway_Entries_Array_TTL                 = 0;
  @ServiceDiscovery_SOMEIPPacket_Offer_ICAS1Gateway_Entries_Array_Minor_Version       = 0;
  @ServiceDiscovery_SOMEIPPacket_Offer_ICAS1Gateway_Options_Array_On_Off              = 1;
  @ServiceDiscovery_SOMEIPPacket_Offer_ICAS1Gateway_Options_Array_Length              = 0;
  @ServiceDiscovery_SOMEIPPacket_Offer_ICAS1Gateway_Options_Array_Option1_Length      = 21;
  @ServiceDiscovery_SOMEIPPacket_Offer_ICAS1Gateway_Options_Array_Option1_Type        = 6;
  @ServiceDiscovery_SOMEIPPacket_Offer_ICAS1Gateway_Options_Array_Option1_IPv6_01     = 0xFD53; // "fd53:7cb8:383:3::10"
  @ServiceDiscovery_SOMEIPPacket_Offer_ICAS1Gateway_Options_Array_Option1_IPv6_02     = 0x7CB8;
  @ServiceDiscovery_SOMEIPPacket_Offer_ICAS1Gateway_Options_Array_Option1_IPv6_03     = 0x0383;
  @ServiceDiscovery_SOMEIPPacket_Offer_ICAS1Gateway_Options_Array_Option1_IPv6_04     = 0x0003;
  @ServiceDiscovery_SOMEIPPacket_Offer_ICAS1Gateway_Options_Array_Option1_IPv6_05     = 0x0000;
  @ServiceDiscovery_SOMEIPPacket_Offer_ICAS1Gateway_Options_Array_Option1_IPv6_06     = 0x0000;
  @ServiceDiscovery_SOMEIPPacket_Offer_ICAS1Gateway_Options_Array_Option1_IPv6_07     = 0x0000;
  @ServiceDiscovery_SOMEIPPacket_Offer_ICAS1Gateway_Options_Array_Option1_IPv6_08     = 0x0010;
  @ServiceDiscovery_SOMEIPPacket_Offer_ICAS1Gateway_Options_Array_Option1_L4_Proto    = 17; // UDP
  @ServiceDiscovery_SOMEIPPacket_Offer_ICAS1Gateway_Options_Array_Option1_Port_Number = 30490;
  
  @ServiceDiscovery_SOMEIPPacket_SubACK_ICAS1Gateway_Message_ID_Service_ID             = 0xFFFF;
  @ServiceDiscovery_SOMEIPPacket_SubACK_ICAS1Gateway_Message_ID_Method_ID              = 0x8100;
  @ServiceDiscovery_SOMEIPPacket_SubACK_ICAS1Gateway_Length                            = 36;
  @ServiceDiscovery_SOMEIPPacket_SubACK_ICAS1Gateway_Request_ID_Client_ID              = 0;
  @ServiceDiscovery_SOMEIPPacket_SubACK_ICAS1Gateway_Protocol_Version                  = 1;
  @ServiceDiscovery_SOMEIPPacket_SubACK_ICAS1Gateway_Interface_Version                 = 1;
  @ServiceDiscovery_SOMEIPPacket_SubACK_ICAS1Gateway_Message_Type                      = 2; // 0x00 REQUEST / 0x01 REQUEST_NO_RETURN / 0x02 NOTIFICATION / 0x80 RESPONSE / 0x81 ERROR / 0x42 NOTIFICATION_ACK
  @ServiceDiscovery_SOMEIPPacket_SubACK_ICAS1Gateway_Return_Code                       = 0;
  @ServiceDiscovery_SOMEIPPacket_SubACK_ICAS1Gateway_Flags                             = 0x40;
  @ServiceDiscovery_SOMEIPPacket_SubACK_ICAS1Gateway_Entries_Array_Length              = 16;
  @ServiceDiscovery_SOMEIPPacket_SubACK_ICAS1Gateway_Entries_Array_Type                = 7; // SubscribeAck
  @ServiceDiscovery_SOMEIPPacket_SubACK_ICAS1Gateway_Entries_Array_Index_1st_options   = 0;
  @ServiceDiscovery_SOMEIPPacket_SubACK_ICAS1Gateway_Entries_Array_Index_2nd_options   = 0;
  @ServiceDiscovery_SOMEIPPacket_SubACK_ICAS1Gateway_Entries_Array_Nr_of_opt_1         = 1;
  @ServiceDiscovery_SOMEIPPacket_SubACK_ICAS1Gateway_Entries_Array_Nr_of_opt_2         = 0;
  @ServiceDiscovery_SOMEIPPacket_SubACK_ICAS1Gateway_Entries_Array_Service_ID          = 0;
  @ServiceDiscovery_SOMEIPPacket_SubACK_ICAS1Gateway_Entries_Array_Instance_ID         = 0;
  @ServiceDiscovery_SOMEIPPacket_SubACK_ICAS1Gateway_Entries_Array_Major_Version       = 0;
  @ServiceDiscovery_SOMEIPPacket_SubACK_ICAS1Gateway_Entries_Array_TTL                 = 0;
  @ServiceDiscovery_SOMEIPPacket_SubACK_ICAS1Gateway_Entries_Array_Counter             = 0;
  @ServiceDiscovery_SOMEIPPacket_SubACK_ICAS1Gateway_Entries_Array_Eventgroup_ID       = 0; // Platzhalter, wird nach Anfrage befüllt
  @ServiceDiscovery_SOMEIPPacket_SubACK_ICAS1Gateway_Options_Array_Length              = 24;
  @ServiceDiscovery_SOMEIPPacket_SubACK_ICAS1Gateway_Options_Array_Option1_Length      = 21;
  @ServiceDiscovery_SOMEIPPacket_SubACK_ICAS1Gateway_Options_Array_Option1_Type        = 0x16;
  @ServiceDiscovery_SOMEIPPacket_SubACK_ICAS1Gateway_Options_Array_Option1_IPv6_01     = 0xFD53; // "fd53:7cb8:383:3::10"
  @ServiceDiscovery_SOMEIPPacket_SubACK_ICAS1Gateway_Options_Array_Option1_IPv6_02     = 0x7CB8;
  @ServiceDiscovery_SOMEIPPacket_SubACK_ICAS1Gateway_Options_Array_Option1_IPv6_03     = 0x0383;
  @ServiceDiscovery_SOMEIPPacket_SubACK_ICAS1Gateway_Options_Array_Option1_IPv6_04     = 0x0003;
  @ServiceDiscovery_SOMEIPPacket_SubACK_ICAS1Gateway_Options_Array_Option1_IPv6_05     = 0x0000;
  @ServiceDiscovery_SOMEIPPacket_SubACK_ICAS1Gateway_Options_Array_Option1_IPv6_06     = 0x0000;
  @ServiceDiscovery_SOMEIPPacket_SubACK_ICAS1Gateway_Options_Array_Option1_IPv6_07     = 0x0000;
  @ServiceDiscovery_SOMEIPPacket_SubACK_ICAS1Gateway_Options_Array_Option1_IPv6_08     = 0x0010;
  @ServiceDiscovery_SOMEIPPacket_SubACK_ICAS1Gateway_Options_Array_Option1_L4_Proto    = 17; // UDP
  @ServiceDiscovery_SOMEIPPacket_SubACK_ICAS1Gateway_Options_Array_Option1_Port_Number = 30490;
    
  
  
  // Service ACC //
  @ACC_Notification_Port_Source                                                 = 42810;
  @ACC_Notification_Port_Destination                                            = 42810;
  @ACC_Notification_Message_ID_Service_ID                                       = 0x6010;
  @ACC_Notification_Message_ID_Method_ID                                        = 0; // Platzhalter
  @ACC_Notification_Length                                                      = 0; // Platzhalter
  @ACC_Notification_Request_ID_Client_ID                                        = 0;
  @ACC_Notification_Protocol_Version                                            = 1;
  @ACC_Notification_Interface_Version                                           = 6;
  @ACC_Notification_Message_Type                                                = 2; // 0x02 NOTIFICATION
  @ACC_Notification_Return_Code                                                 = 0;
  
  @ACC_Notification_Message_ID_Method_ID_notifications                          = 0xC010;
  @ACC_Notification_Message_ID_Method_ID_info                                   = 0xC020;
  @ACC_Notification_Message_ID_Method_ID_relevantObjects                        = 0xC030;
  @ACC_Notification_Message_ID_Method_ID_targetDistances                        = 0xC040;
  @ACC_Notification_Message_ID_Method_ID_velocities                             = 0xC050;
  @ACC_Notification_Message_ID_Method_ID_additionalInformation                  = 0xC060;

  @ACC_Notification_notifications_Element_TotalNum                              = 1;
  @ACC_Notification_notifications_Element                                       = 0;
  @ACC_Notification_info_Element_TotalNum                                       = 1;
  @ACC_Notification_info_Element                                                = 0;
  @ACC_Notification_relevantObjects_Element_TotalNum                            = 1;
  @ACC_Notification_relevantObjects_Element                                     = 0;
  @ACC_Notification_targetDistances_Element_TotalNum                            = 1;
  @ACC_Notification_targetDistances_Element                                     = 0;
  @ACC_Notification_velocities_Element_TotalNum                                 = 1;
  @ACC_Notification_velocities_Element                                          = 0;
  @ACC_Notification_additionalInformation_Element_TotalNum                      = 1;
  @ACC_Notification_additionalInformation_Element                               = 0;
  
  @ACC_SubscribeStatus_notifications                                            = 0;
  @ACC_SubscribeStatus_info                                                     = 0;
  @ACC_SubscribeStatus_relevantObjects                                          = 0;
  @ACC_SubscribeStatus_targetDistances                                          = 0;
  @ACC_SubscribeStatus_velocities                                               = 0;
  @ACC_SubscribeStatus_additionalInformation                                    = 0;
  
  @ACC_Notification_notifications_Send_cyclic                                   = 0;
  @ACC_Notification_notifications_Send_cyclic_cycletime                         = 100;
  @ACC_Notification_info_Send_cyclic                                            = 0;
  @ACC_Notification_info_Send_cyclic_cycletime                                  = 100;
  @ACC_Notification_relevantObjects_Send_cyclic                                 = 0;
  @ACC_Notification_relevantObjects_Send_cyclic_cycletime                       = 100;
  @ACC_Notification_targetDistances_Send_cyclic                                 = 0;
  @ACC_Notification_targetDistances_Send_cyclic_cycletime                       = 100;
  @ACC_Notification_velocities_Send_cyclic                                      = 0;
  @ACC_Notification_velocities_Send_cyclic_cycletime                            = 100;
  @ACC_Notification_additionalInformation_Send_cyclic                           = 0;
  @ACC_Notification_additionalInformation_Send_cyclic_cycletime                 = 100;
  
  for (k=0;k<10;k++)
  {
    ACC_array_notifications_type_available[k]                                    = 1;
    ACC_array_notifications_value_available[k]                                   = 1;
    ACC_array_info_elementId_available[k]                                        = 1;
    ACC_array_info_functionOnDemandStatus_available[k]                           = 1;
    ACC_array_info_distanceIndexPhysicalValue_available[k]                       = 1;
    ACC_array_info_distanceIndexLogicalValue_available[k]                        = 1;
    ACC_array_info_distanceIndexValueType_available[k]                           = 1;
    ACC_array_info_statusGraMode_available[k]                                    = 1;
    ACC_array_info_maxDistanceScale_available[k]                                 = 1;
    ACC_array_info_statusObjectAccentuation_available[k]                         = 1;
    ACC_array_info_situationalPrioritization_available[k]                        = 1;
    ACC_array_info_statusEndOfTrafficJam_available[k]                            = 1;
    ACC_array_info_statusIcon_available[k]                                       = 1;
    ACC_array_info_statusACC_available[k]                                        = 1;
    ACC_array_info_configuredVelocityReached_available[k]                        = 1;
    ACC_array_info_hintsAdditionalDisplay_available[k]                           = 1;
    ACC_array_info_accStatusDisplay_available[k]                                 = 1;
    ACC_array_info_lightAssistant_available[k]                                   = 1;
    ACC_array_info_overtakingPrevention_available[k]                             = 1;
    ACC_array_info_tempolimit_available[k]                                       = 1;
    ACC_array_relevantObjects_type_available[k]                                  = 1;
    ACC_array_relevantObjects_distanceToObject_available[k]                      = 1;
    ACC_array_relevantObjects_distanceToObjectValueType_available[k]             = 1;
    ACC_array_relevantObjects_objectType_available[k]                            = 1;
    ACC_array_relevantObjects_videoID_available[k]                               = 1;
    ACC_array_relevantObjects_videoIDValueType_available[k]                      = 1;
    ACC_array_relevantObjects_longitudinalDistanceToObject_available[k]          = 1;
    ACC_array_relevantObjects_longitudinalDistanceToObjectValueType_available[k] = 1;
    ACC_array_relevantObjects_lateralDistanceToObject_available[k]               = 1;
    ACC_array_relevantObjects_lateralDistanceToObjectValueType_available[k]      = 1;
    ACC_array_targetDistances_type_available[k]                                  = 1;
    ACC_array_targetDistances_distancePhysicalValue_available[k]                 = 1;
    ACC_array_targetDistances_distanceValueType_available[k]                     = 1;
    ACC_array_targetDistances_setTimeGap_available[k]                            = 1;
    ACC_array_targetDistances_displayTimeGap_available[k]                        = 1;
    ACC_array_velocities_type_available[k]                                       = 1;
    ACC_array_velocities_velocityPhysicalValue_available[k]                      = 1;
    ACC_array_velocities_velocityValueType_available[k]                          = 1;
    ACC_array_additionalInformation_elementId_available[k]                       = 1;
    ACC_array_additionalInformation_acaDisplayStatus_available[k]                = 1;
    ACC_array_additionalInformation_additionalDisplayObject_available[k]         = 1;
    ACC_array_additionalInformation_coloredStatusIcon_available[k]               = 1;
    ACC_array_additionalInformation_coloredRelevantObject_available[k]           = 1;
    ACC_array_additionalInformation_unitTempolimit_available[k]                  = 1;
    ACC_array_additionalInformation_displayLightSpeedometerType_available[k]     = 1;
    ACC_array_additionalInformation_displayLightSpeedometerStatus_available[k]   = 1;
    ACC_array_additionalInformation_configuredVelocityColor_available[k]         = 1;
  }
  
  
  // Service AWV //
  @AWV_Notification_Port_Source                                                 = 42810;
  @AWV_Notification_Port_Destination                                            = 42810;
  @AWV_Notification_Message_ID_Service_ID                                       = 0x6011;
  @AWV_Notification_Message_ID_Method_ID                                        = 0; // Platzhalter
  @AWV_Notification_Length                                                      = 0; // Platzhalter
  @AWV_Notification_Request_ID_Client_ID                                        = 0;
  @AWV_Notification_Protocol_Version                                            = 1;
  @AWV_Notification_Interface_Version                                           = 3;
  @AWV_Notification_Message_Type                                                = 2; // 0x02 NOTIFICATION
  @AWV_Notification_Return_Code                                                 = 0;
  
  @AWV_Notification_Message_ID_Method_ID_notifications                          = 0xC010;
  @AWV_Notification_Message_ID_Method_ID_info                                   = 0xC020;
  
  @AWV_Notification_notifications_Element_TotalNum                              = 1;
  @AWV_Notification_notifications_Element                                       = 0;
  @AWV_Notification_info_Element_TotalNum                                       = 1;
  @AWV_Notification_info_Element                                                = 0;

  @AWV_SubscribeStatus_notifications                                            = 0;
  @AWV_SubscribeStatus_info                                                     = 0;
  
  @AWV_Notification_notifications_Send_cyclic                                   = 0;
  @AWV_Notification_notifications_Send_cyclic_cycletime                         = 100;
  @AWV_Notification_info_Send_cyclic                                            = 0;
  @AWV_Notification_info_Send_cyclic_cycletime                                  = 100;
  
  for (k=0;k<10;k++)
  {
    AWV_array_notifications_type_available[k]                                   = 1;
    AWV_array_notifications_value_available[k]                                  = 1;
    AWV_array_info_elementId_available[k]                                       = 1;
    AWV_array_info_timeGap_available[k]                                         = 1;
    AWV_array_info_cameraObjectId_available[k]                                  = 1;
    AWV_array_info_cameraObjectIdValueType_available[k]                         = 1;
  }
  
  
  // Service LaneAssist //
  @LaneAssist_Notification_Port_Source                                          = 42810;
  @LaneAssist_Notification_Port_Destination                                     = 42810;
  @LaneAssist_Notification_Message_ID_Service_ID                                = 0x6012;
  @LaneAssist_Notification_Message_ID_Method_ID                                 = 0; // Platzhalter
  @LaneAssist_Notification_Length                                               = 0; // Platzhalter
  @LaneAssist_Notification_Request_ID_Client_ID                                 = 0;
  @LaneAssist_Notification_Protocol_Version                                     = 1;
  @LaneAssist_Notification_Interface_Version                                    = 2;
  @LaneAssist_Notification_Message_Type                                         = 2; // 0x02 NOTIFICATION
  @LaneAssist_Notification_Return_Code                                          = 0;
  
  @LaneAssist_Notification_Message_ID_Method_ID_notifications                   = 0xC010;
  
  @LaneAssist_Notification_notifications_Element_TotalNum                       = 1;
  @LaneAssist_Notification_notifications_Element                                = 0;
  
  @LaneAssist_SubscribeStatus_notifications                                     = 0;
  
  @LaneAssist_Notification_notifications_Send_cyclic                            = 0;
  @LaneAssist_Notification_notifications_Send_cyclic_cycletime                  = 100;
  
  for (k=0;k<10;k++)
  {
    LaneAssist_array_notifications_type_available[k]                            = 1;
    LaneAssist_array_notifications_value_available[k]                           = 1;
  }

  
  // Service TravelAssist //
  @TravelAssist_Notification_Port_Source                                        = 42810;
  @TravelAssist_Notification_Port_Destination                                   = 42810;
  @TravelAssist_Notification_Message_ID_Service_ID                              = 0x6015;
  @TravelAssist_Notification_Message_ID_Method_ID                               = 0; // Platzhalter
  @TravelAssist_Notification_Length                                             = 0; // Platzhalter
  @TravelAssist_Notification_Request_ID_Client_ID                               = 0;
  @TravelAssist_Notification_Protocol_Version                                   = 1;
  @TravelAssist_Notification_Interface_Version                                  = 3;
  @TravelAssist_Notification_Message_Type                                       = 2; // 0x02 NOTIFICATION
  @TravelAssist_Notification_Return_Code                                        = 0;
  
  @TravelAssist_Notification_Message_ID_Method_ID_notifications                 = 0xC010;
  @TravelAssist_Notification_Message_ID_Method_ID_lanes                         = 0xC020;
  @TravelAssist_Notification_Message_ID_Method_ID_curveParameters               = 0xC030;
  @TravelAssist_Notification_Message_ID_Method_ID_info                          = 0xC040;
  @TravelAssist_Notification_Message_ID_Method_ID_relevantObjects               = 0xC050;
  
  @TravelAssist_Notification_notifications_Element_TotalNum                     = 1;
  @TravelAssist_Notification_notifications_Element                              = 0;
  @TravelAssist_Notification_lanes_Element_TotalNum                             = 1;
  @TravelAssist_Notification_lanes_Element                                      = 0;
  @TravelAssist_Notification_curveParameters_Element_TotalNum                   = 1;
  @TravelAssist_Notification_curveParameters_Element                            = 0;
  @TravelAssist_Notification_info_Element_TotalNum                              = 1;
  @TravelAssist_Notification_info_Element                                       = 0;
  @TravelAssist_Notification_relevantObjects_Element_TotalNum                   = 1;
  @TravelAssist_Notification_relevantObjects_Element                            = 0;
  
  @TravelAssist_SubscribeStatus_notifications                                   = 0;
  @TravelAssist_SubscribeStatus_lanes                                           = 0;
  @TravelAssist_SubscribeStatus_curveParameters                                 = 0;
  @TravelAssist_SubscribeStatus_info                                            = 0;
  @TravelAssist_SubscribeStatus_relevantObjects                                 = 0;
  
  @TravelAssist_Notification_notifications_Send_cyclic                          = 0;
  @TravelAssist_Notification_notifications_Send_cyclic_cycletime                = 100;
  @TravelAssist_Notification_lanes_Send_cyclic                                  = 0;
  @TravelAssist_Notification_lanes_Send_cyclic_cycletime                        = 100;
  @TravelAssist_Notification_curveParameters_Send_cyclic                        = 0;
  @TravelAssist_Notification_curveParameters_Send_cyclic_cycletime              = 100;
  @TravelAssist_Notification_info_Send_cyclic                                   = 0;
  @TravelAssist_Notification_info_Send_cyclic_cycletime                         = 100;
  @TravelAssist_Notification_relevantObjects_Send_cyclic                        = 0;
  @TravelAssist_Notification_relevantObjects_Send_cyclic_cycletime              = 100;
  
  for (k=0;k<10;k++)
  {
    TravelAssist_array_notifications_type_available[k]                              = 1;
    TravelAssist_array_notifications_value_available[k]                             = 1;
    TravelAssist_array_lanes_type_available[k]                                      = 1;
    TravelAssist_array_lanes_laneType_available[k]                                  = 1;
    TravelAssist_array_lanes_transversalDistance_available[k]                       = 1;
    TravelAssist_array_curveParameters_type_available[k]                            = 1;
    TravelAssist_array_curveParameters_firstSegmentYawAngle_available[k]            = 1;
    TravelAssist_array_curveParameters_firstSegmentCurvature_available[k]           = 1;
    TravelAssist_array_curveParameters_secondSegmentBeginning_available[k]          = 1;
    TravelAssist_array_curveParameters_secondSegmentCurvature_available[k]          = 1;
    TravelAssist_array_curveParameters_firstSegmentTransversalDistance_available[k] = 1;
    TravelAssist_array_info_elementId_available[k]                                  = 1;
    TravelAssist_array_info_zoomLevel_available[k]                                  = 1;
    TravelAssist_array_info_laneChangeToLeft_available[k]                           = 1;
    TravelAssist_array_info_laneChangeToRight_available[k]                          = 1;
    TravelAssist_array_info_egoTrajectoryValid_available[k]                         = 1;
    TravelAssist_array_info_zoomLevelActivated_available[k]                         = 1;
    TravelAssist_array_info_trajectoryForecast_available[k]                         = 1;
    TravelAssist_array_info_curveWarning_available[k]                               = 1;
    TravelAssist_array_relevantObjects_type_available[k]                            = 1;
    TravelAssist_array_relevantObjects_longitudinalDistance_available[k]            = 1;
    TravelAssist_array_relevantObjects_percentagePosition_available[k]              = 1;
    TravelAssist_array_relevantObjects_laneMapping_available[k]                     = 1;
    TravelAssist_array_relevantObjects_objectType_available[k]                      = 1;
    TravelAssist_array_relevantObjects_isTransversalControlActive_available[k]      = 1;
    TravelAssist_array_relevantObjects_isLongitudinalControlActive_available[k]     = 1;
  }
  
  
  // Service Odometry //
  @Odometry_Notification_Port_Source                                                 = 42810;
  @Odometry_Notification_Port_Destination                                            = 42810;
  @Odometry_Notification_Message_ID_Service_ID                                       = 0x6017;
  @Odometry_Notification_Message_ID_Method_ID                                        = 0; // Platzhalter
  @Odometry_Notification_Length                                                      = 0; // Platzhalter
  @Odometry_Notification_Request_ID_Client_ID                                        = 0;
  @Odometry_Notification_Protocol_Version                                            = 1;
  @Odometry_Notification_Interface_Version                                           = 3;
  @Odometry_Notification_Message_Type                                                = 2; // 0x02 NOTIFICATION
  @Odometry_Notification_Return_Code                                                 = 0;
  
  @Odometry_Notification_Message_ID_Method_ID_speeds                                 = 0xC010;
  @Odometry_Notification_Message_ID_Method_ID_velocities                             = 0xC020;
  @Odometry_Notification_Message_ID_Method_ID_pose2D                                 = 0xC030;
  @Odometry_Notification_Message_ID_Method_ID_additionalVehicleMotionInformations    = 0xC040;
  @Odometry_Notification_Message_ID_Method_ID_wheelCorrections                       = 0xC050;
  @Odometry_Notification_Message_ID_Method_ID_accelerations                          = 0xC060;
  @Odometry_Notification_Message_ID_Method_ID_angularRates                           = 0xC070;

  @Odometry_Notification_speeds_Element_TotalNum                                     = 1;
  @Odometry_Notification_speeds_Element                                              = 0;
  @Odometry_Notification_velocities_Element_TotalNum                                 = 1;
  @Odometry_Notification_velocities_Element                                          = 0;
  @Odometry_Notification_pose2D_Element_TotalNum                                     = 1;
  @Odometry_Notification_pose2D_Element                                              = 0;
  @Odometry_Notification_additionalVehicleMotionInformations_Element_TotalNum        = 1;
  @Odometry_Notification_additionalVehicleMotionInformations_Element                 = 0;
  @Odometry_Notification_wheelCorrections_Element_TotalNum                           = 1;
  @Odometry_Notification_wheelCorrections_Element                                    = 0;
  @Odometry_Notification_accelerations_Element_TotalNum                              = 1;
  @Odometry_Notification_accelerations_Element                                       = 0;
  @Odometry_Notification_angularRates_Element_TotalNum                               = 1;
  @Odometry_Notification_angularRates_Element                                        = 0;
  
  @Odometry_SubscribeStatus_speeds                                                   = 0;
  @Odometry_SubscribeStatus_velocities                                               = 0;
  @Odometry_SubscribeStatus_pose2D                                                   = 0;
  @Odometry_SubscribeStatus_additionalVehicleMotionInformations                      = 0;
  @Odometry_SubscribeStatus_wheelCorrections                                         = 0;
  @Odometry_SubscribeStatus_accelerations                                            = 0;
  @Odometry_SubscribeStatus_angularRates                                             = 0;
  
  @Odometry_Notification_speeds_Send_cyclic                                          = 0;
  @Odometry_Notification_speeds_Send_cyclic_cycletime                                = 100;
  @Odometry_Notification_velocities_Send_cyclic                                      = 0;
  @Odometry_Notification_velocities_Send_cyclic_cycletime                            = 100;
  @Odometry_Notification_pose2D_Send_cyclic                                          = 0;
  @Odometry_Notification_pose2D_Send_cyclic_cycletime                                = 100;
  @Odometry_Notification_additionalVehicleMotionInformations_Send_cyclic             = 0;
  @Odometry_Notification_additionalVehicleMotionInformations_Send_cyclic_cycletime   = 100;
  @Odometry_Notification_wheelCorrections_Send_cyclic                                = 0;
  @Odometry_Notification_wheelCorrections_Send_cyclic_cycletime                      = 100;
  @Odometry_Notification_accelerations_Send_cyclic                                   = 0;
  @Odometry_Notification_accelerations_Send_cyclic_cycletime                         = 100;
  @Odometry_Notification_angularRates_Send_cyclic                                    = 0;
  @Odometry_Notification_angularRates_Send_cyclic_cycletime                          = 100;
  
  for (k=0;k<10;k++)
  {
    Odometry_array_speeds_type_available[k]                                                                    = 1;
    Odometry_array_speeds_value_available[k]                                                                   = 1;
    Odometry_array_speeds_confidence_available[k]                                                              = 1;
    Odometry_array_speeds_timestamp_available[k]                                                               = 1;
    Odometry_array_velocities_type_available[k]                                                                = 1;
    Odometry_array_velocities_timestamp_available[k]                                                           = 1;
    Odometry_array_velocities_value_available[k]                                                               = 1;
    Odometry_array_velocities_variance_available[k]                                                            = 1;
    Odometry_array_velocities_confidence_available[k]                                                          = 1;
    Odometry_array_pose2D_timestamp_available[k]                                                               = 1;
    Odometry_array_pose2D_positionX_available[k]                                                               = 1;
    Odometry_array_pose2D_positionY_available[k]                                                               = 1;
    Odometry_array_pose2D_yawAngle_available[k]                                                                = 1;
    Odometry_array_pose2D_positionXVariance_available[k]                                                       = 1;
    Odometry_array_pose2D_positionYVariance_available[k]                                                       = 1;
    Odometry_array_pose2D_yawAngleVariance_available[k]                                                        = 1;
    Odometry_array_pose2D_pose2dConfidence_available[k]                                                        = 1;
    Odometry_array_additionalVehicleMotionInformations_timestamp_available[k]                                  = 1;
    Odometry_array_additionalVehicleMotionInformations_drivingDirectionProbabilityRange_available[k]           = 1;
    Odometry_array_additionalVehicleMotionInformations_drivingDirectionProbabilityRangeConfidence_available[k] = 1;
    Odometry_array_additionalVehicleMotionInformations_standStillProbabilityRange_available[k]                 = 1;
    Odometry_array_additionalVehicleMotionInformations_standStillProbabilityRangeConfidence_available[k]       = 1;
    Odometry_array_wheelCorrections_timestamp_available[k]                                                     = 1;
    Odometry_array_wheelCorrections_wheelCorrectionFactorFrontLeft_available[k]                                = 1;
    Odometry_array_wheelCorrections_wheelCorrectionFactorFrontRight_available[k]                               = 1;
    Odometry_array_wheelCorrections_wheelCorrectionFactorRearLeft_available[k]                                 = 1;
    Odometry_array_wheelCorrections_wheelCorrectionFactorRearRight_available[k]                                = 1;
    Odometry_array_wheelCorrections_wheelCorrectionFactorEstimatorStatus_available[k]                          = 1;
    Odometry_array_wheelCorrections_wheelCorrectionFactorEstimatorStatusConfidence_available[k]                = 1;
    Odometry_array_wheelCorrections_wheelCorrectionFactorFrontLeftConfidence_available[k]                      = 1;
    Odometry_array_wheelCorrections_wheelCorrectionFactorFrontRightConfidence_available[k]                     = 1;
    Odometry_array_wheelCorrections_wheelCorrectionFactoRearLeftConfidence_available[k]                        = 1;
    Odometry_array_wheelCorrections_wheelCorrectionFactoRearRightConfidence_available[k]                       = 1;
    Odometry_array_wheelCorrections_wheelCircumferenceStatic_available[k]                                      = 1;
    Odometry_array_wheelCorrections_wheelCircumferenceStaticConfidence_available[k]                            = 1;
    Odometry_array_accelerations_type_available[k]                                                             = 1;
    Odometry_array_accelerations_timestamp_available[k]                                                        = 1;
    Odometry_array_accelerations_acceleration_available[k]                                                     = 1;
    Odometry_array_accelerations_variance_available[k]                                                         = 1;
    Odometry_array_accelerations_confidence_available[k]                                                       = 1;
    Odometry_array_angularRates_type_available[k]                                                              = 1;
    Odometry_array_angularRates_timestamp_available[k]                                                         = 1;
    Odometry_array_angularRates_angularrate_available[k]                                                       = 1;
    Odometry_array_angularRates_variance_available[k]                                                          = 1;
    Odometry_array_angularRates_confidence_available[k]                                                        = 1;
  }
  
  
  // Service OccupantPresence //
  @OccupantPresence_Notification_Port_Source                                         = 42810;
  @OccupantPresence_Notification_Port_Destination                                    = 42810;
  @OccupantPresence_Notification_Message_ID_Service_ID                               = 0x6028;
  @OccupantPresence_Notification_Message_ID_Method_ID                                = 0; // Platzhalter
  @OccupantPresence_Notification_Length                                              = 0; // Platzhalter
  @OccupantPresence_Notification_Request_ID_Client_ID                                = 0;
  @OccupantPresence_Notification_Protocol_Version                                    = 1;
  @OccupantPresence_Notification_Interface_Version                                   = 3;
  @OccupantPresence_Notification_Message_Type                                        = 2; // 0x02 NOTIFICATION
  @OccupantPresence_Notification_Return_Code                                         = 0;
  
  @OccupantPresence_Notification_Message_ID_Method_ID_driverPresenceStatus           = 0xC010;
  @OccupantPresence_Notification_Message_ID_Method_ID_occupantPresenceStatus         = 0xC020;

  @OccupantPresence_Notification_driverPresenceStatus_Element_TotalNum               = 1;
  @OccupantPresence_Notification_driverPresenceStatus_Element                        = 0;
  @OccupantPresence_Notification_occupantPresenceStatus_Element_TotalNum             = 1;
  @OccupantPresence_Notification_occupantPresenceStatus_Element                      = 0;

  @OccupantPresence_SubscribeStatus_driverPresenceStatus                             = 0;
  @OccupantPresence_SubscribeStatus_occupantPresenceStatus                           = 0;
  
  @OccupantPresence_Notification_driverPresenceStatus_Send_cyclic                    = 0;
  @OccupantPresence_Notification_driverPresenceStatus_Send_cyclic_cycletime          = 100;
  @OccupantPresence_Notification_occupantPresenceStatus_Send_cyclic                  = 0;
  @OccupantPresence_Notification_occupantPresenceStatus_Send_cyclic_cycletime        = 100;
  
  for (k=0;k<10;k++)
  {
    OccupantPresence_array_driverPresenceStatus_elementId_available[k]               = 1;
    OccupantPresence_array_driverPresenceStatus_driverState_available[k]             = 1;
    OccupantPresence_array_driverPresenceStatus_comfortReadyStatus_available[k]      = 1;
    OccupantPresence_array_occupantPresenceStatus_occupantId_available[k]            = 1;
    OccupantPresence_array_occupantPresenceStatus_occupantState_available[k]         = 1;
  }

  
  // Service VehicleBasicData //
  @VehicleBasicData_Notification_Port_Source                                         = 42810;
  @VehicleBasicData_Notification_Port_Destination                                    = 42810;
  @VehicleBasicData_Notification_Message_ID_Service_ID                               = 0x604D;
  @VehicleBasicData_Notification_Message_ID_Method_ID                                = 0; // Platzhalter
  @VehicleBasicData_Notification_Length                                              = 0; // Platzhalter
  @VehicleBasicData_Notification_Request_ID_Client_ID                                = 0;
  @VehicleBasicData_Notification_Protocol_Version                                    = 1;
  @VehicleBasicData_Notification_Interface_Version                                   = 2;
  @VehicleBasicData_Notification_Message_Type                                        = 2; // 0x02 NOTIFICATION
  @VehicleBasicData_Notification_Return_Code                                         = 0;
  
  @VehicleBasicData_Notification_Message_ID_Method_ID_installations                  = 0xC010;
  @VehicleBasicData_Notification_Message_ID_Method_ID_variants                       = 0xC020;
  @VehicleBasicData_Notification_Message_ID_Method_ID_parameters                     = 0xC030;
  
  @VehicleBasicData_Notification_installations_Element_TotalNum                      = 1;
  @VehicleBasicData_Notification_installations_Element                               = 0;
  @VehicleBasicData_Notification_variants_Element_TotalNum                           = 1;
  @VehicleBasicData_Notification_variants_Element                                    = 0;
  @VehicleBasicData_Notification_parameters_Element_TotalNum                         = 1;
  @VehicleBasicData_Notification_parameters_Element                                  = 0;
  
  @VehicleBasicData_SubscribeStatus_installations                                    = 0;
  @VehicleBasicData_SubscribeStatus_variants                                         = 0;
  @VehicleBasicData_SubscribeStatus_parameters                                       = 0;
  
  @VehicleBasicData_Notification_installations_Send_cyclic                           = 0;
  @VehicleBasicData_Notification_installations_Send_cyclic_cycletime                 = 100;
  @VehicleBasicData_Notification_variants_Send_cyclic                                = 0;
  @VehicleBasicData_Notification_variants_Send_cyclic_cycletime                      = 100;
  @VehicleBasicData_Notification_parameters_Send_cyclic                              = 0;
  @VehicleBasicData_Notification_parameters_Send_cyclic_cycletime                    = 100;
  
  for (k=0;k<10;k++)
  {
    VehicleBasicData_array_installations_elementId_available[k]                      = 1;
    VehicleBasicData_array_installations_rainSensor_available[k]                     = 1;
    VehicleBasicData_array_installations_exteriorSound_available[k]                  = 1;
    VehicleBasicData_array_installations_allWheelDrive_available[k]                  = 1;
    VehicleBasicData_array_installations_speedLimiterButton_available[k]             = 1;
    VehicleBasicData_array_installations_rearSeatOccupiedSensor_available[k]         = 1;
    VehicleBasicData_array_variants_elementId_available[k]                           = 1;
    VehicleBasicData_array_variants_adaptiveCruiseControlType_available[k]           = 1;
    VehicleBasicData_array_variants_engineType_available[k]                          = 1;
    VehicleBasicData_array_variants_steeringWheelPosition_available[k]               = 1;
    VehicleBasicData_array_variants_fuelType_available[k]                            = 1;
    VehicleBasicData_array_variants_hybridType_available[k]                          = 1;
    VehicleBasicData_array_parameters_elementId_available[k]                         = 1;
    VehicleBasicData_array_parameters_tyreCircumference_available[k]                 = 1;
  }
  
  
  // Service Powertrain //
  @Powertrain_Notification_Port_Source                                         = 42810;
  @Powertrain_Notification_Port_Destination                                    = 42810;
  @Powertrain_Notification_Message_ID_Service_ID                               = 0x6050;
  @Powertrain_Notification_Message_ID_Method_ID                                = 0; // Platzhalter
  @Powertrain_Notification_Length                                              = 0; // Platzhalter
  @Powertrain_Notification_Request_ID_Client_ID                                = 0;
  @Powertrain_Notification_Protocol_Version                                    = 1;
  @Powertrain_Notification_Interface_Version                                   = 2;
  @Powertrain_Notification_Message_Type                                        = 2; // 0x02 NOTIFICATION
  @Powertrain_Notification_Return_Code                                         = 0;
  
  @Powertrain_Notification_Message_ID_Method_ID_notifications                  = 0xC010;
  @Powertrain_Notification_Message_ID_Method_ID_displayValues                  = 0xC020;
  @Powertrain_Notification_Message_ID_Method_ID_status                         = 0xC030;
  
  @Powertrain_Notification_notifications_Element_TotalNum                      = 1;
  @Powertrain_Notification_notifications_Element                               = 0;
  @Powertrain_Notification_displayValues_Element_TotalNum                      = 1;
  @Powertrain_Notification_displayValues_Element                               = 0;
  @Powertrain_Notification_status_Element_TotalNum                             = 1;
  @Powertrain_Notification_status_Element                                      = 0;
  
  @Powertrain_SubscribeStatus_notifications                                    = 0;
  @Powertrain_SubscribeStatus_displayValues                                    = 0;
  @Powertrain_SubscribeStatus_status                                           = 0;
  
  @Powertrain_Notification_notifications_Send_cyclic                           = 0;
  @Powertrain_Notification_notifications_Send_cyclic_cycletime                 = 100;
  @Powertrain_Notification_displayValues_Send_cyclic                           = 0;
  @Powertrain_Notification_displayValues_Send_cyclic_cycletime                 = 100;
  @Powertrain_Notification_status_Send_cyclic                                  = 0;
  @Powertrain_Notification_status_Send_cyclic_cycletime                        = 100;
  
  for (k=0;k<10;k++)
  {
    Powertrain_array_notifications_type_available[k]                           = 1;
    Powertrain_array_notifications_value_available[k]                          = 1;
    Powertrain_array_displayValues_elementId_available[k]                      = 1;
    Powertrain_array_displayValues_gearShiftPosition_available[k]              = 1;
    Powertrain_array_displayValues_recuperationLevel_available[k]              = 1;
    Powertrain_array_displayValues_isPowertrainActive_available[k]             = 1;
    Powertrain_array_displayValues_isShiftLockActive_available[k]              = 1;
    Powertrain_array_status_elementId_available[k]                             = 1;
    Powertrain_array_status_isKickDown_available[k]                            = 1;
    Powertrain_array_status_gearShiftPositionTarget_available[k]               = 1;
    Powertrain_array_status_powertrainAndPropulsionState_available[k]          = 1;
  }
  
  
  
  callAllOnEnvVar();
}

on envVar Send_ServiceDiscovery_Offer
{
  if (@this == 1)
  {
    settimercyclic (tSend_ServiceDiscovery_Offer_ICAS1Gateway, @Send_ServiceDiscovery_Offer_Time);
  }
  else
  {
    canceltimer (tSend_ServiceDiscovery_Offer_ICAS1Gateway);
  }
}

on timer tSend_ServiceDiscovery_Offer_ICAS1Gateway
{
  Send_ServiceDiscovery_Offer_Service_ICAS1Gateway();
}

Send_ServiceDiscovery_Offer_Service_ICAS1Gateway()
{
  ethernetPacket EthPaket;
  
  number_of_offered_services_by_ICAS1Gateway = @ServiceDiscovery_Offer_Service_ACC
                                             + @ServiceDiscovery_Offer_Service_AWV
                                             + @ServiceDiscovery_Offer_Service_LaneAssist
                                             + @ServiceDiscovery_Offer_Service_Odometry
                                             + @ServiceDiscovery_Offer_Service_TravelAssist
                                             + @ServiceDiscovery_Offer_Service_OccupantPresence
                                             + @ServiceDiscovery_Offer_Service_VehicleBasicData
                                             + @ServiceDiscovery_Offer_Service_Powertrain;
  
  if (@Env_GlobalAppl == 1 && number_of_offered_services_by_ICAS1Gateway > 0)
  {
    if ((@ServiceDiscovery_SOMEIPPacket_Offer_ICAS1Gateway_Entries_Array_Element > 0) && (@ServiceDiscovery_SOMEIPPacket_Offer_ICAS1Gateway_Entries_Array_Element >= number_of_offered_services_by_ICAS1Gateway))
      @ServiceDiscovery_SOMEIPPacket_Offer_ICAS1Gateway_Entries_Array_Element = number_of_offered_services_by_ICAS1Gateway-1;
    

    // Ethernet Packet - MAC Source address
    getvalue (ServiceDiscovery_EthernetPacket_MAC_Source_ICAS1Gateway, buffer_MAC);
    //EthPaket.source.ParseAddress ( buffer_MAC );
    EthPaket.source = ethGetMacAddressAsNumber (buffer_MAC);
    
    // Ethernet Packet - MAC Destination address
    getvalue (ServiceDiscovery_EthernetPacket_MAC_Destination_SD, buffer_MAC);
    //EthPaket.destination.ParseAddress ( buffer_MAC );
    EthPaket.destination = ethGetMacAddressAsNumber (buffer_MAC);
    
    // Ethernet Packet - VLAN
    EthPaket.SetVlan (@ServiceDiscovery_EthernetPacket_VLAN_TPID, @ServiceDiscovery_EthernetPacket_VLAN_TCI);
    
    // Ethernet Packet - Type
    //EthPaket.ipv6.type = @EthernetPacket_Type;
    if (@ServiceDiscovery_EthernetPacket_Type == 0x86DD) EthPaket.ipv6.Init();
    
    
    // IPv6 Packet - Version
    EthPaket.ipv6.version = @ServiceDiscovery_IPv6Packet_Version;

    // IPv6 Packet - Traffic Class
    EthPaket.ipv6.class = @ServiceDiscovery_IPv6Packet_Traffic_Class;
    
    // IPv6 Packet - Flow Label
    EthPaket.ipv6.flow = @ServiceDiscovery_IPv6Packet_Flow_Label;
    
    // IPv6 Packet - Payload_Length
    EthPaket.ipv6.length = @ServiceDiscovery_IPv6Packet_Payload_Length;
    
    // IPv6 Packet - Next Header
    EthPaket.ipv6.next = @ServiceDiscovery_IPv6Packet_Next_Header;
    if (@ServiceDiscovery_IPv6Packet_Next_Header == 6) EthPaket.tcp.Init();
    if (@ServiceDiscovery_IPv6Packet_Next_Header == 17) EthPaket.udp.Init();
    
    // IPv6 Packet - Hop Limit
    EthPaket.ipv6.hopLimit = @ServiceDiscovery_IPv6Packet_Hop_Limit;

    // IPv6 Packet - IPv6 Destination address    // TODO: char array zu byte array
    buffer_ipv6[0]  = @ServiceDiscovery_IPv6Packet_IP_Destination_Multicast_01>>8 & 0xFF;
    buffer_ipv6[1]  = @ServiceDiscovery_IPv6Packet_IP_Destination_Multicast_01    & 0xFF;
    buffer_ipv6[2]  = @ServiceDiscovery_IPv6Packet_IP_Destination_Multicast_02>>8 & 0xFF;
    buffer_ipv6[3]  = @ServiceDiscovery_IPv6Packet_IP_Destination_Multicast_02    & 0xFF;
    buffer_ipv6[4]  = @ServiceDiscovery_IPv6Packet_IP_Destination_Multicast_03>>8 & 0xFF;
    buffer_ipv6[5]  = @ServiceDiscovery_IPv6Packet_IP_Destination_Multicast_03    & 0xFF;
    buffer_ipv6[6]  = @ServiceDiscovery_IPv6Packet_IP_Destination_Multicast_04>>8 & 0xFF;
    buffer_ipv6[7]  = @ServiceDiscovery_IPv6Packet_IP_Destination_Multicast_04    & 0xFF;
    buffer_ipv6[8]  = @ServiceDiscovery_IPv6Packet_IP_Destination_Multicast_05>>8 & 0xFF;
    buffer_ipv6[9]  = @ServiceDiscovery_IPv6Packet_IP_Destination_Multicast_05    & 0xFF;
    buffer_ipv6[10] = @ServiceDiscovery_IPv6Packet_IP_Destination_Multicast_06>>8 & 0xFF;
    buffer_ipv6[11] = @ServiceDiscovery_IPv6Packet_IP_Destination_Multicast_06    & 0xFF;
    buffer_ipv6[12] = @ServiceDiscovery_IPv6Packet_IP_Destination_Multicast_07>>8 & 0xFF;
    buffer_ipv6[13] = @ServiceDiscovery_IPv6Packet_IP_Destination_Multicast_07    & 0xFF;
    buffer_ipv6[14] = @ServiceDiscovery_IPv6Packet_IP_Destination_Multicast_08>>8 & 0xFF;
    buffer_ipv6[15] = @ServiceDiscovery_IPv6Packet_IP_Destination_Multicast_08    & 0xFF;
    EthPaket.ipv6.destination.SetData ( 0, buffer_ipv6, elcount(buffer_ipv6) );

    // IPv6 Packet - IPv6 Source address    // TODO: char array zu byte array
    buffer_ipv6[0]  = @ServiceDiscovery_IPv6Packet_IP_Source_ICAS1Gateway_01>>8 & 0xFF;
    buffer_ipv6[1]  = @ServiceDiscovery_IPv6Packet_IP_Source_ICAS1Gateway_01    & 0xFF;
    buffer_ipv6[2]  = @ServiceDiscovery_IPv6Packet_IP_Source_ICAS1Gateway_02>>8 & 0xFF;
    buffer_ipv6[3]  = @ServiceDiscovery_IPv6Packet_IP_Source_ICAS1Gateway_02    & 0xFF;
    buffer_ipv6[4]  = @ServiceDiscovery_IPv6Packet_IP_Source_ICAS1Gateway_03>>8 & 0xFF;
    buffer_ipv6[5]  = @ServiceDiscovery_IPv6Packet_IP_Source_ICAS1Gateway_03    & 0xFF;
    buffer_ipv6[6]  = @ServiceDiscovery_IPv6Packet_IP_Source_ICAS1Gateway_04>>8 & 0xFF;
    buffer_ipv6[7]  = @ServiceDiscovery_IPv6Packet_IP_Source_ICAS1Gateway_04    & 0xFF;
    buffer_ipv6[8]  = @ServiceDiscovery_IPv6Packet_IP_Source_ICAS1Gateway_05>>8 & 0xFF;
    buffer_ipv6[9]  = @ServiceDiscovery_IPv6Packet_IP_Source_ICAS1Gateway_05    & 0xFF;
    buffer_ipv6[10] = @ServiceDiscovery_IPv6Packet_IP_Source_ICAS1Gateway_06>>8 & 0xFF;
    buffer_ipv6[11] = @ServiceDiscovery_IPv6Packet_IP_Source_ICAS1Gateway_06    & 0xFF;
    buffer_ipv6[12] = @ServiceDiscovery_IPv6Packet_IP_Source_ICAS1Gateway_07>>8 & 0xFF;
    buffer_ipv6[13] = @ServiceDiscovery_IPv6Packet_IP_Source_ICAS1Gateway_07    & 0xFF;
    buffer_ipv6[14] = @ServiceDiscovery_IPv6Packet_IP_Source_ICAS1Gateway_08>>8 & 0xFF;
    buffer_ipv6[15] = @ServiceDiscovery_IPv6Packet_IP_Source_ICAS1Gateway_08    & 0xFF;
    EthPaket.ipv6.source.SetData ( 0, buffer_ipv6, elcount(buffer_ipv6) );

    
    // UDP Packet - Source Port
    EthPaket.udp.source = @ServiceDiscovery_UDPPacket_Port_Source;
    
    // UDP Packet - Destination Port
    EthPaket.udp.destination = @ServiceDiscovery_UDPPacket_Port_Destination;
    
    // UDP Packet - Length
    EthPaket.udp.length = @ServiceDiscovery_UDPPacket_Length;
    
    
    // SOME/IP Packet aus Rohdaten zusammenbauen (buffer array)
    i=0;
    
    // SOME/IP Packet - Message ID, Service ID [16 bit]
    buffer[i++] = @ServiceDiscovery_SOMEIPPacket_Offer_ICAS1Gateway_Message_ID_Service_ID>>8 & 0xFF;
    buffer[i++] = @ServiceDiscovery_SOMEIPPacket_Offer_ICAS1Gateway_Message_ID_Service_ID    & 0xFF;
    
    // SOME/IP Packet - Message ID, Message ID [16 bit]
    buffer[i++] = @ServiceDiscovery_SOMEIPPacket_Offer_ICAS1Gateway_Message_ID_Method_ID>>8 & 0xFF;
    buffer[i++] = @ServiceDiscovery_SOMEIPPacket_Offer_ICAS1Gateway_Message_ID_Method_ID    & 0xFF;
    
    // SOME/IP Packet - Length [32 bit]
    @ServiceDiscovery_SOMEIPPacket_Offer_ICAS1Gateway_Length = 16 + (16 * number_of_offered_services_by_ICAS1Gateway) + 4 + @ServiceDiscovery_SOMEIPPacket_Offer_ICAS1Gateway_Options_Array_On_Off * 24;
    buffer[i++] = @ServiceDiscovery_SOMEIPPacket_Offer_ICAS1Gateway_Length>>24 & 0xFF;
    buffer[i++] = @ServiceDiscovery_SOMEIPPacket_Offer_ICAS1Gateway_Length>>16 & 0xFF;
    buffer[i++] = @ServiceDiscovery_SOMEIPPacket_Offer_ICAS1Gateway_Length>> 8 & 0xFF;
    buffer[i++] = @ServiceDiscovery_SOMEIPPacket_Offer_ICAS1Gateway_Length     & 0xFF;
    
    // SOME/IP Packet - Request ID, Client ID [16 bit]
    buffer[i++] = @ServiceDiscovery_SOMEIPPacket_Offer_ICAS1Gateway_Request_ID_Client_ID>>8 & 0xFF;
    buffer[i++] = @ServiceDiscovery_SOMEIPPacket_Offer_ICAS1Gateway_Request_ID_Client_ID    & 0xFF;
    
    // SOME/IP Packet - Request ID, Session ID) [16 bit]
    @ServiceDiscovery_SOMEIPPacket_Request_ID_Session_ID = @ServiceDiscovery_SOMEIPPacket_Request_ID_Session_ID + 1;
    if (@ServiceDiscovery_SOMEIPPacket_Request_ID_Session_ID == 0x10000) @ServiceDiscovery_SOMEIPPacket_Request_ID_Session_ID = 1;
    
    buffer[i++] = @ServiceDiscovery_SOMEIPPacket_Request_ID_Session_ID>>8 & 0xFF;
    buffer[i++] = @ServiceDiscovery_SOMEIPPacket_Request_ID_Session_ID    & 0xFF;
    
    // SOME/IP Packet - Protocol Version [8 bit]
    buffer[i++] = @ServiceDiscovery_SOMEIPPacket_Offer_ICAS1Gateway_Protocol_Version;
    
    // SOME/IP Packet - Interface Version [8 bit]
    buffer[i++] = @ServiceDiscovery_SOMEIPPacket_Offer_ICAS1Gateway_Interface_Version;

    // SOME/IP Packet - Message Type [8 bit]
    buffer[i++] = @ServiceDiscovery_SOMEIPPacket_Offer_ICAS1Gateway_Message_Type;
      
    // SOME/IP Packet - Return Code [8 bit]
    buffer[i++] = @ServiceDiscovery_SOMEIPPacket_Offer_ICAS1Gateway_Return_Code;
    
    // SOME/IP Packet - Flags [8 bit]
    buffer[i++] = @ServiceDiscovery_SOMEIPPacket_Offer_ICAS1Gateway_Flags;
    
    // SOME/IP Packet - Reserved [24 bit]
    buffer[i++] = 0x00;
    buffer[i++] = 0x00;
    buffer[i++] = 0x00;
    
    
    // SOME/IP Packet - Entries Array
    
    // SOME/IP Packet - Entries Array - Length [32 bit]
    @ServiceDiscovery_SOMEIPPacket_Offer_ICAS1Gateway_Entries_Array_Length = 16 * number_of_offered_services_by_ICAS1Gateway;
    buffer[i++] = @ServiceDiscovery_SOMEIPPacket_Offer_ICAS1Gateway_Entries_Array_Length>>24 & 0xFF;
    buffer[i++] = @ServiceDiscovery_SOMEIPPacket_Offer_ICAS1Gateway_Entries_Array_Length>>16 & 0xFF;
    buffer[i++] = @ServiceDiscovery_SOMEIPPacket_Offer_ICAS1Gateway_Entries_Array_Length>> 8 & 0xFF;
    buffer[i++] = @ServiceDiscovery_SOMEIPPacket_Offer_ICAS1Gateway_Entries_Array_Length     & 0xFF;
    
    service_counter = 0;
      
    if (@ServiceDiscovery_Offer_Service_ACC == 1 && service_counter < number_of_offered_services_by_ICAS1Gateway)
    {
      servicediscovery_offer_ICAS1Gateway_entries_array_type[service_counter]                 = 1; // Offer
      servicediscovery_offer_ICAS1Gateway_entries_array_index_1st_options[service_counter]    = 0;
      servicediscovery_offer_ICAS1Gateway_entries_array_index_2nd_options[service_counter]    = 0;
      servicediscovery_offer_ICAS1Gateway_entries_array_nr_of_opt_1[service_counter]          = @ServiceDiscovery_SOMEIPPacket_Offer_ICAS1Gateway_Options_Array_On_Off;
      servicediscovery_offer_ICAS1Gateway_entries_array_nr_of_opt_2[service_counter]          = 0;
      servicediscovery_offer_ICAS1Gateway_entries_array_service_id[service_counter]           = 0x6010;
      servicediscovery_offer_ICAS1Gateway_entries_array_instance_id[service_counter]          = 1;
      servicediscovery_offer_ICAS1Gateway_entries_array_major_version[service_counter]        = 6;
      servicediscovery_offer_ICAS1Gateway_entries_array_ttl[service_counter]                  = 5;
      servicediscovery_offer_ICAS1Gateway_entries_array_minor_version[service_counter]        = 0;

      service_counter++;
    }
    
    if (@ServiceDiscovery_Offer_Service_AWV == 1 && service_counter < number_of_offered_services_by_ICAS1Gateway)
    {
      servicediscovery_offer_ICAS1Gateway_entries_array_type[service_counter]                 = 1; // Offer
      servicediscovery_offer_ICAS1Gateway_entries_array_index_1st_options[service_counter]    = 0;
      servicediscovery_offer_ICAS1Gateway_entries_array_index_2nd_options[service_counter]    = 0;
      servicediscovery_offer_ICAS1Gateway_entries_array_nr_of_opt_1[service_counter]          = @ServiceDiscovery_SOMEIPPacket_Offer_ICAS1Gateway_Options_Array_On_Off;
      servicediscovery_offer_ICAS1Gateway_entries_array_nr_of_opt_2[service_counter]          = 0;
      servicediscovery_offer_ICAS1Gateway_entries_array_service_id[service_counter]           = 0x6011;
      servicediscovery_offer_ICAS1Gateway_entries_array_instance_id[service_counter]          = 1;
      servicediscovery_offer_ICAS1Gateway_entries_array_major_version[service_counter]        = 3;
      servicediscovery_offer_ICAS1Gateway_entries_array_ttl[service_counter]                  = 5;
      servicediscovery_offer_ICAS1Gateway_entries_array_minor_version[service_counter]        = 0;

      service_counter++;
    }
    
    if (@ServiceDiscovery_Offer_Service_LaneAssist == 1 && service_counter < number_of_offered_services_by_ICAS1Gateway)
    {
      servicediscovery_offer_ICAS1Gateway_entries_array_type[service_counter]                 = 1; // Offer
      servicediscovery_offer_ICAS1Gateway_entries_array_index_1st_options[service_counter]    = 0;
      servicediscovery_offer_ICAS1Gateway_entries_array_index_2nd_options[service_counter]    = 0;
      servicediscovery_offer_ICAS1Gateway_entries_array_nr_of_opt_1[service_counter]          = @ServiceDiscovery_SOMEIPPacket_Offer_ICAS1Gateway_Options_Array_On_Off;
      servicediscovery_offer_ICAS1Gateway_entries_array_nr_of_opt_2[service_counter]          = 0;
      servicediscovery_offer_ICAS1Gateway_entries_array_service_id[service_counter]           = 0x6012;
      servicediscovery_offer_ICAS1Gateway_entries_array_instance_id[service_counter]          = 1;
      servicediscovery_offer_ICAS1Gateway_entries_array_major_version[service_counter]        = 2;
      servicediscovery_offer_ICAS1Gateway_entries_array_ttl[service_counter]                  = 5;
      servicediscovery_offer_ICAS1Gateway_entries_array_minor_version[service_counter]        = 0;

      service_counter++;
    }
    
    if (@ServiceDiscovery_Offer_Service_TravelAssist == 1 && service_counter < number_of_offered_services_by_ICAS1Gateway)
    {
      servicediscovery_offer_ICAS1Gateway_entries_array_type[service_counter]                 = 1; // Offer
      servicediscovery_offer_ICAS1Gateway_entries_array_index_1st_options[service_counter]    = 0;
      servicediscovery_offer_ICAS1Gateway_entries_array_index_2nd_options[service_counter]    = 0;
      servicediscovery_offer_ICAS1Gateway_entries_array_nr_of_opt_1[service_counter]          = @ServiceDiscovery_SOMEIPPacket_Offer_ICAS1Gateway_Options_Array_On_Off;
      servicediscovery_offer_ICAS1Gateway_entries_array_nr_of_opt_2[service_counter]          = 0;
      servicediscovery_offer_ICAS1Gateway_entries_array_service_id[service_counter]           = 0x6015;
      servicediscovery_offer_ICAS1Gateway_entries_array_instance_id[service_counter]          = 1;
      servicediscovery_offer_ICAS1Gateway_entries_array_major_version[service_counter]        = 3;
      servicediscovery_offer_ICAS1Gateway_entries_array_ttl[service_counter]                  = 5;
      servicediscovery_offer_ICAS1Gateway_entries_array_minor_version[service_counter]        = 0;

      service_counter++;
    }
    
    if (@ServiceDiscovery_Offer_Service_Odometry == 1 && service_counter < number_of_offered_services_by_ICAS1Gateway)
    {
      servicediscovery_offer_ICAS1Gateway_entries_array_type[service_counter]                 = 1; // Offer
      servicediscovery_offer_ICAS1Gateway_entries_array_index_1st_options[service_counter]    = 0;
      servicediscovery_offer_ICAS1Gateway_entries_array_index_2nd_options[service_counter]    = 0;
      servicediscovery_offer_ICAS1Gateway_entries_array_nr_of_opt_1[service_counter]          = @ServiceDiscovery_SOMEIPPacket_Offer_ICAS1Gateway_Options_Array_On_Off;
      servicediscovery_offer_ICAS1Gateway_entries_array_nr_of_opt_2[service_counter]          = 0;
      servicediscovery_offer_ICAS1Gateway_entries_array_service_id[service_counter]           = 0x6017;
      servicediscovery_offer_ICAS1Gateway_entries_array_instance_id[service_counter]          = 1;
      servicediscovery_offer_ICAS1Gateway_entries_array_major_version[service_counter]        = 3;
      servicediscovery_offer_ICAS1Gateway_entries_array_ttl[service_counter]                  = 5;
      servicediscovery_offer_ICAS1Gateway_entries_array_minor_version[service_counter]        = 0;

      service_counter++;
    }
    
    if (@ServiceDiscovery_Offer_Service_OccupantPresence == 1 && service_counter < number_of_offered_services_by_ICAS1Gateway)
    {
      servicediscovery_offer_ICAS1Gateway_entries_array_type[service_counter]                 = 1; // Offer
      servicediscovery_offer_ICAS1Gateway_entries_array_index_1st_options[service_counter]    = 0;
      servicediscovery_offer_ICAS1Gateway_entries_array_index_2nd_options[service_counter]    = 0;
      servicediscovery_offer_ICAS1Gateway_entries_array_nr_of_opt_1[service_counter]          = @ServiceDiscovery_SOMEIPPacket_Offer_ICAS1Gateway_Options_Array_On_Off;
      servicediscovery_offer_ICAS1Gateway_entries_array_nr_of_opt_2[service_counter]          = 0;
      servicediscovery_offer_ICAS1Gateway_entries_array_service_id[service_counter]           = 0x6028;
      servicediscovery_offer_ICAS1Gateway_entries_array_instance_id[service_counter]          = 1;
      servicediscovery_offer_ICAS1Gateway_entries_array_major_version[service_counter]        = 3;
      servicediscovery_offer_ICAS1Gateway_entries_array_ttl[service_counter]                  = 5;
      servicediscovery_offer_ICAS1Gateway_entries_array_minor_version[service_counter]        = 0;

      service_counter++;
    }
    
    if (@ServiceDiscovery_Offer_Service_VehicleBasicData == 1 && service_counter < number_of_offered_services_by_ICAS1Gateway)
    {
      servicediscovery_offer_ICAS1Gateway_entries_array_type[service_counter]                 = 1; // Offer
      servicediscovery_offer_ICAS1Gateway_entries_array_index_1st_options[service_counter]    = 0;
      servicediscovery_offer_ICAS1Gateway_entries_array_index_2nd_options[service_counter]    = 0;
      servicediscovery_offer_ICAS1Gateway_entries_array_nr_of_opt_1[service_counter]          = @ServiceDiscovery_SOMEIPPacket_Offer_ICAS1Gateway_Options_Array_On_Off;
      servicediscovery_offer_ICAS1Gateway_entries_array_nr_of_opt_2[service_counter]          = 0;
      servicediscovery_offer_ICAS1Gateway_entries_array_service_id[service_counter]           = 0x604D;
      servicediscovery_offer_ICAS1Gateway_entries_array_instance_id[service_counter]          = 1;
      servicediscovery_offer_ICAS1Gateway_entries_array_major_version[service_counter]        = 2;
      servicediscovery_offer_ICAS1Gateway_entries_array_ttl[service_counter]                  = 5;
      servicediscovery_offer_ICAS1Gateway_entries_array_minor_version[service_counter]        = 0;

      service_counter++;
    }
    
    if (@ServiceDiscovery_Offer_Service_Powertrain == 1 && service_counter < number_of_offered_services_by_ICAS1Gateway)
    {
      servicediscovery_offer_ICAS1Gateway_entries_array_type[service_counter]                 = 1; // Offer
      servicediscovery_offer_ICAS1Gateway_entries_array_index_1st_options[service_counter]    = 0;
      servicediscovery_offer_ICAS1Gateway_entries_array_index_2nd_options[service_counter]    = 0;
      servicediscovery_offer_ICAS1Gateway_entries_array_nr_of_opt_1[service_counter]          = @ServiceDiscovery_SOMEIPPacket_Offer_ICAS1Gateway_Options_Array_On_Off;
      servicediscovery_offer_ICAS1Gateway_entries_array_nr_of_opt_2[service_counter]          = 0;
      servicediscovery_offer_ICAS1Gateway_entries_array_service_id[service_counter]           = 0x6050;
      servicediscovery_offer_ICAS1Gateway_entries_array_instance_id[service_counter]          = 1;
      servicediscovery_offer_ICAS1Gateway_entries_array_major_version[service_counter]        = 2;
      servicediscovery_offer_ICAS1Gateway_entries_array_ttl[service_counter]                  = 5;
      servicediscovery_offer_ICAS1Gateway_entries_array_minor_version[service_counter]        = 1;

      service_counter++;
    }
    
    if (number_of_offered_services_by_ICAS1Gateway == 0)
    {
      servicediscovery_offer_ICAS1Gateway_entries_array_type[service_counter]                 = 0;
      servicediscovery_offer_ICAS1Gateway_entries_array_index_1st_options[service_counter]    = 0;
      servicediscovery_offer_ICAS1Gateway_entries_array_index_2nd_options[service_counter]    = 0;
      servicediscovery_offer_ICAS1Gateway_entries_array_nr_of_opt_1[service_counter]          = 0;
      servicediscovery_offer_ICAS1Gateway_entries_array_nr_of_opt_2[service_counter]          = 0;
      servicediscovery_offer_ICAS1Gateway_entries_array_service_id[service_counter]           = 0;
      servicediscovery_offer_ICAS1Gateway_entries_array_instance_id[service_counter]          = 0;
      servicediscovery_offer_ICAS1Gateway_entries_array_major_version[service_counter]        = 0;
      servicediscovery_offer_ICAS1Gateway_entries_array_ttl[service_counter]                  = 0;
      servicediscovery_offer_ICAS1Gateway_entries_array_minor_version[service_counter]        = 0;

      service_counter++;
    }
      
    for (j = 0; j < number_of_offered_services_by_ICAS1Gateway; j++)
    {
      // SOME/IP Packet - Entries Array - Type [8 bit]
      buffer[i++] = servicediscovery_offer_ICAS1Gateway_entries_array_type[j];
      
      // SOME/IP Packet - Entries Array - Index 1st options [8 bit]
      buffer[i++] = servicediscovery_offer_ICAS1Gateway_entries_array_index_1st_options[j];
      
      // SOME/IP Packet - Entries Array - Index 2nd options [8 bit]
      buffer[i++] = servicediscovery_offer_ICAS1Gateway_entries_array_index_2nd_options[j];
      
      // SOME/IP Packet - Entries Array - # of opt 1 [4 bit] / # of opt 2 [4 bit]
      buffer[i++] = (((servicediscovery_offer_ICAS1Gateway_entries_array_nr_of_opt_1[j]*16)) + (servicediscovery_offer_ICAS1Gateway_entries_array_nr_of_opt_2[j]));
      
      // SOME/IP Packet - Entries Array - Service ID [16 bit]
      buffer[i++] = servicediscovery_offer_ICAS1Gateway_entries_array_service_id[j]>> 8 & 0xFF;
      buffer[i++] = servicediscovery_offer_ICAS1Gateway_entries_array_service_id[j]     & 0xFF;

      // SOME/IP Packet - Entries Array - Instance ID [16 bit]
      buffer[i++] = servicediscovery_offer_ICAS1Gateway_entries_array_instance_id[j]>> 8 & 0xFF;
      buffer[i++] = servicediscovery_offer_ICAS1Gateway_entries_array_instance_id[j]     & 0xFF;
      
      // SOME/IP Packet - Entries Array - Major Version [8 bit]
      buffer[i++] = servicediscovery_offer_ICAS1Gateway_entries_array_major_version[j];
      
      // SOME/IP Packet - Entries Array - TTL [24 bit]
      buffer[i++] = servicediscovery_offer_ICAS1Gateway_entries_array_ttl[j]>>16 & 0xFF;
      buffer[i++] = servicediscovery_offer_ICAS1Gateway_entries_array_ttl[j]>> 8 & 0xFF;
      buffer[i++] = servicediscovery_offer_ICAS1Gateway_entries_array_ttl[j]     & 0xFF;
      
      // SOME/IP Packet - Entries Array - Minor Version [32 bit]
      buffer[i++] = servicediscovery_offer_ICAS1Gateway_entries_array_minor_version[j]>>24 & 0xFF;
      buffer[i++] = servicediscovery_offer_ICAS1Gateway_entries_array_minor_version[j]>>16 & 0xFF;
      buffer[i++] = servicediscovery_offer_ICAS1Gateway_entries_array_minor_version[j]>> 8 & 0xFF;
      buffer[i++] = servicediscovery_offer_ICAS1Gateway_entries_array_minor_version[j]     & 0xFF;
    }
    
    //SOME/IP Packet - Options Array - Length [32 bit]
    buffer[i++] = @ServiceDiscovery_SOMEIPPacket_Offer_ICAS1Gateway_Options_Array_Length>>24 & 0xFF;
    buffer[i++] = @ServiceDiscovery_SOMEIPPacket_Offer_ICAS1Gateway_Options_Array_Length>>16 & 0xFF;
    buffer[i++] = @ServiceDiscovery_SOMEIPPacket_Offer_ICAS1Gateway_Options_Array_Length>> 8 & 0xFF;
    buffer[i++] = @ServiceDiscovery_SOMEIPPacket_Offer_ICAS1Gateway_Options_Array_Length     & 0xFF;
    
    if (@ServiceDiscovery_SOMEIPPacket_Offer_ICAS1Gateway_Options_Array_On_Off == 1)
    {
      //SOME/IP Packet - Options Array - Option1 Length [16 bit]
      buffer[i++] = @ServiceDiscovery_SOMEIPPacket_Offer_ICAS1Gateway_Options_Array_Option1_Length>> 8 & 0xFF;
      buffer[i++] = @ServiceDiscovery_SOMEIPPacket_Offer_ICAS1Gateway_Options_Array_Option1_Length     & 0xFF;
      
      //SOME/IP Packet - Options Array - Option1 Type [8 bit]
      buffer[i++] = @ServiceDiscovery_SOMEIPPacket_Offer_ICAS1Gateway_Options_Array_Option1_Type & 0xFF;
      
      //SOME/IP Packet - Options Array - Reserved [8 bit]
      buffer[i++] = 0x00;
      
      //SOME/IP Packet - Options Array - Option1 IPv6 Address
      buffer[i++] = @ServiceDiscovery_SOMEIPPacket_Offer_ICAS1Gateway_Options_Array_Option1_IPv6_01>>8 & 0xFF;
      buffer[i++] = @ServiceDiscovery_SOMEIPPacket_Offer_ICAS1Gateway_Options_Array_Option1_IPv6_01    & 0xFF;
      buffer[i++] = @ServiceDiscovery_SOMEIPPacket_Offer_ICAS1Gateway_Options_Array_Option1_IPv6_02>>8 & 0xFF;
      buffer[i++] = @ServiceDiscovery_SOMEIPPacket_Offer_ICAS1Gateway_Options_Array_Option1_IPv6_02    & 0xFF;
      buffer[i++] = @ServiceDiscovery_SOMEIPPacket_Offer_ICAS1Gateway_Options_Array_Option1_IPv6_03>>8 & 0xFF;
      buffer[i++] = @ServiceDiscovery_SOMEIPPacket_Offer_ICAS1Gateway_Options_Array_Option1_IPv6_03    & 0xFF;
      buffer[i++] = @ServiceDiscovery_SOMEIPPacket_Offer_ICAS1Gateway_Options_Array_Option1_IPv6_04>>8 & 0xFF;
      buffer[i++] = @ServiceDiscovery_SOMEIPPacket_Offer_ICAS1Gateway_Options_Array_Option1_IPv6_04    & 0xFF;
      buffer[i++] = @ServiceDiscovery_SOMEIPPacket_Offer_ICAS1Gateway_Options_Array_Option1_IPv6_05>>8 & 0xFF;
      buffer[i++] = @ServiceDiscovery_SOMEIPPacket_Offer_ICAS1Gateway_Options_Array_Option1_IPv6_05    & 0xFF;
      buffer[i++] = @ServiceDiscovery_SOMEIPPacket_Offer_ICAS1Gateway_Options_Array_Option1_IPv6_06>>8 & 0xFF;
      buffer[i++] = @ServiceDiscovery_SOMEIPPacket_Offer_ICAS1Gateway_Options_Array_Option1_IPv6_06    & 0xFF;
      buffer[i++] = @ServiceDiscovery_SOMEIPPacket_Offer_ICAS1Gateway_Options_Array_Option1_IPv6_07>>8 & 0xFF;
      buffer[i++] = @ServiceDiscovery_SOMEIPPacket_Offer_ICAS1Gateway_Options_Array_Option1_IPv6_07    & 0xFF;
      buffer[i++] = @ServiceDiscovery_SOMEIPPacket_Offer_ICAS1Gateway_Options_Array_Option1_IPv6_08>>8 & 0xFF;
      buffer[i++] = @ServiceDiscovery_SOMEIPPacket_Offer_ICAS1Gateway_Options_Array_Option1_IPv6_08    & 0xFF;
      
      //SOME/IP Packet - Options Array - Reserved [8 bit]
      buffer[i++] = 0x00;
      
      //SOME/IP Packet - Options Array - Option1 L4-Proto [8 bit]
      buffer[i++] = @ServiceDiscovery_SOMEIPPacket_Offer_ICAS1Gateway_Options_Array_Option1_L4_Proto;
      
      //SOME/IP Packet - Options Array - Option1 Port Number [16 bit]
      buffer[i++] = @ServiceDiscovery_SOMEIPPacket_Offer_ICAS1Gateway_Options_Array_Option1_Port_Number>> 8 & 0xFF;
      buffer[i++] = @ServiceDiscovery_SOMEIPPacket_Offer_ICAS1Gateway_Options_Array_Option1_Port_Number     & 0xFF;
    }
    
    ServiceDiscovery_SOMEIPPacket_Offer_ICAS1Gateway_Entries_Array_update();

    // Rohdaten in UDP Paket schreiben
    EthPaket.udp.SetData( 0, buffer, i );

    // calculate UDP and IPv6 checksum and send Ethernet packet
    EthPaket.CompletePacket();
    output( EthPaket );
  }
}

on envVar ServiceDiscovery_SOMEIPPacket_Offer_ICAS1Gateway_Entries_Array_Element_Next
{
  if (@this == 1 && @ServiceDiscovery_SOMEIPPacket_Offer_ICAS1Gateway_Entries_Array_Element < number_of_offered_services_by_ICAS1Gateway-1)
  {
    @ServiceDiscovery_SOMEIPPacket_Offer_ICAS1Gateway_Entries_Array_Element = @ServiceDiscovery_SOMEIPPacket_Offer_ICAS1Gateway_Entries_Array_Element + 1;
    ServiceDiscovery_SOMEIPPacket_Offer_ICAS1Gateway_Entries_Array_update();
  }
}

on envVar ServiceDiscovery_SOMEIPPacket_Offer_ICAS1Gateway_Entries_Array_Element_Previous
{
  if (@this == 1 && @ServiceDiscovery_SOMEIPPacket_Offer_ICAS1Gateway_Entries_Array_Element > 0)
  {
    @ServiceDiscovery_SOMEIPPacket_Offer_ICAS1Gateway_Entries_Array_Element = @ServiceDiscovery_SOMEIPPacket_Offer_ICAS1Gateway_Entries_Array_Element - 1;
    ServiceDiscovery_SOMEIPPacket_Offer_ICAS1Gateway_Entries_Array_update();
  }
}

ServiceDiscovery_SOMEIPPacket_Offer_ICAS1Gateway_Entries_Array_update()
{
  @ServiceDiscovery_SOMEIPPacket_Offer_ICAS1Gateway_Entries_Array_Type              = servicediscovery_offer_ICAS1Gateway_entries_array_type[@ServiceDiscovery_SOMEIPPacket_Offer_ICAS1Gateway_Entries_Array_Element];
  @ServiceDiscovery_SOMEIPPacket_Offer_ICAS1Gateway_Entries_Array_Index_1st_options = servicediscovery_offer_ICAS1Gateway_entries_array_index_1st_options[@ServiceDiscovery_SOMEIPPacket_Offer_ICAS1Gateway_Entries_Array_Element];
  @ServiceDiscovery_SOMEIPPacket_Offer_ICAS1Gateway_Entries_Array_Index_2nd_options = servicediscovery_offer_ICAS1Gateway_entries_array_index_2nd_options[@ServiceDiscovery_SOMEIPPacket_Offer_ICAS1Gateway_Entries_Array_Element];
  @ServiceDiscovery_SOMEIPPacket_Offer_ICAS1Gateway_Entries_Array_Nr_of_opt_1       = servicediscovery_offer_ICAS1Gateway_entries_array_nr_of_opt_1[@ServiceDiscovery_SOMEIPPacket_Offer_ICAS1Gateway_Entries_Array_Element];
  @ServiceDiscovery_SOMEIPPacket_Offer_ICAS1Gateway_Entries_Array_Nr_of_opt_2       = servicediscovery_offer_ICAS1Gateway_entries_array_nr_of_opt_2[@ServiceDiscovery_SOMEIPPacket_Offer_ICAS1Gateway_Entries_Array_Element];
  @ServiceDiscovery_SOMEIPPacket_Offer_ICAS1Gateway_Entries_Array_Service_ID        = servicediscovery_offer_ICAS1Gateway_entries_array_service_id[@ServiceDiscovery_SOMEIPPacket_Offer_ICAS1Gateway_Entries_Array_Element];
  @ServiceDiscovery_SOMEIPPacket_Offer_ICAS1Gateway_Entries_Array_Instance_ID       = servicediscovery_offer_ICAS1Gateway_entries_array_instance_id[@ServiceDiscovery_SOMEIPPacket_Offer_ICAS1Gateway_Entries_Array_Element];
  @ServiceDiscovery_SOMEIPPacket_Offer_ICAS1Gateway_Entries_Array_Major_Version     = servicediscovery_offer_ICAS1Gateway_entries_array_major_version[@ServiceDiscovery_SOMEIPPacket_Offer_ICAS1Gateway_Entries_Array_Element];
  @ServiceDiscovery_SOMEIPPacket_Offer_ICAS1Gateway_Entries_Array_TTL               = servicediscovery_offer_ICAS1Gateway_entries_array_ttl[@ServiceDiscovery_SOMEIPPacket_Offer_ICAS1Gateway_Entries_Array_Element];
  @ServiceDiscovery_SOMEIPPacket_Offer_ICAS1Gateway_Entries_Array_Minor_Version     = servicediscovery_offer_ICAS1Gateway_entries_array_minor_version[@ServiceDiscovery_SOMEIPPacket_Offer_ICAS1Gateway_Entries_Array_Element];
}

on envVar ServiceDiscovery_SOMEIPPacket_Offer_ICAS1Gateway_Entries_Array_Type
{
  servicediscovery_offer_ICAS1Gateway_entries_array_type[@ServiceDiscovery_SOMEIPPacket_Offer_ICAS1Gateway_Entries_Array_Element] = @this;
}
on envVar ServiceDiscovery_SOMEIPPacket_Offer_ICAS1Gateway_Entries_Array_Index_1st_options
{
  servicediscovery_offer_ICAS1Gateway_entries_array_index_1st_options[@ServiceDiscovery_SOMEIPPacket_Offer_ICAS1Gateway_Entries_Array_Element] = @this;
}
on envVar ServiceDiscovery_SOMEIPPacket_Offer_ICAS1Gateway_Entries_Array_Index_2nd_options
{
  servicediscovery_offer_ICAS1Gateway_entries_array_index_2nd_options[@ServiceDiscovery_SOMEIPPacket_Offer_ICAS1Gateway_Entries_Array_Element] = @this;
}
on envVar ServiceDiscovery_SOMEIPPacket_Offer_ICAS1Gateway_Entries_Array_Nr_of_opt_1
{
  servicediscovery_offer_ICAS1Gateway_entries_array_nr_of_opt_1[@ServiceDiscovery_SOMEIPPacket_Offer_ICAS1Gateway_Entries_Array_Element] = @this;
}
on envVar ServiceDiscovery_SOMEIPPacket_Offer_ICAS1Gateway_Entries_Array_Nr_of_opt_2
{
  servicediscovery_offer_ICAS1Gateway_entries_array_nr_of_opt_2[@ServiceDiscovery_SOMEIPPacket_Offer_ICAS1Gateway_Entries_Array_Element] = @this;
}
on envVar ServiceDiscovery_SOMEIPPacket_Offer_ICAS1Gateway_Entries_Array_Service_ID
{
  servicediscovery_offer_ICAS1Gateway_entries_array_service_id[@ServiceDiscovery_SOMEIPPacket_Offer_ICAS1Gateway_Entries_Array_Element] = @this;
}
on envVar ServiceDiscovery_SOMEIPPacket_Offer_ICAS1Gateway_Entries_Array_Instance_ID
{
  servicediscovery_offer_ICAS1Gateway_entries_array_instance_id[@ServiceDiscovery_SOMEIPPacket_Offer_ICAS1Gateway_Entries_Array_Element] = @this;
}
on envVar ServiceDiscovery_SOMEIPPacket_Offer_ICAS1Gateway_Entries_Array_Major_Version
{
  servicediscovery_offer_ICAS1Gateway_entries_array_major_version[@ServiceDiscovery_SOMEIPPacket_Offer_ICAS1Gateway_Entries_Array_Element] = @this;
}
on envVar ServiceDiscovery_SOMEIPPacket_Offer_ICAS1Gateway_Entries_Array_TTL
{
  servicediscovery_offer_ICAS1Gateway_entries_array_ttl[@ServiceDiscovery_SOMEIPPacket_Offer_ICAS1Gateway_Entries_Array_Element] = @this;
}
on envVar ServiceDiscovery_SOMEIPPacket_Offer_ICAS1Gateway_Entries_Array_Minor_Version
{
  servicediscovery_offer_ICAS1Gateway_entries_array_minor_version[@ServiceDiscovery_SOMEIPPacket_Offer_ICAS1Gateway_Entries_Array_Element] = @this;
}

on envVar ServiceDiscovery_SOMEIPPacket_Offer_ICAS1Gateway_Options_Array_On_Off
{
  if (@this == 0)
  {
    @ServiceDiscovery_SOMEIPPacket_Offer_ICAS1Gateway_Options_Array_Length      = 0;
    @ServiceDiscovery_SOMEIPPacket_Offer_ICAS1Gateway_Entries_Array_Nr_of_opt_1 = 0;
  }
  
  if (@this == 1)
  {
    @ServiceDiscovery_SOMEIPPacket_Offer_ICAS1Gateway_Options_Array_Length      = 24;
    @ServiceDiscovery_SOMEIPPacket_Offer_ICAS1Gateway_Entries_Array_Nr_of_opt_1 = 1;
  }
}










Send_ServiceDiscovery_SubscribeACK_ICAS1Gateway ()
{
  ethernetPacket EthPaket;
  
  // Ethernet Packet - MAC Source address
  getvalue (ServiceDiscovery_EthernetPacket_MAC_Source_ICAS1Gateway, buffer_MAC);
  //EthPaket.source.ParseAddress ( buffer_MAC );
  EthPaket.source = ethGetMacAddressAsNumber (buffer_MAC);
  
  // Ethernet Packet - MAC Destination address
  getvalue (ServiceDiscovery_EthernetPacket_MAC_Destination, buffer_MAC);
  //EthPaket.destination.ParseAddress ( buffer_MAC );
  EthPaket.destination = ethGetMacAddressAsNumber (buffer_MAC);
  
  // Ethernet Packet - VLAN
  EthPaket.SetVlan (@ServiceDiscovery_EthernetPacket_VLAN_TPID, @ServiceDiscovery_EthernetPacket_VLAN_TCI);
  
  // Ethernet Packet - Type
  //EthPaket.ipv6.type = @EthernetPacket_Type;
  if (@ServiceDiscovery_EthernetPacket_Type == 0x86DD) EthPaket.ipv6.Init();
  
  
  // IPv6 Packet - Version
  EthPaket.ipv6.version = @ServiceDiscovery_IPv6Packet_Version;

  // IPv6 Packet - Traffic Class
  EthPaket.ipv6.class = @ServiceDiscovery_IPv6Packet_Traffic_Class;
  
  // IPv6 Packet - Flow Label
  EthPaket.ipv6.flow = @ServiceDiscovery_IPv6Packet_Flow_Label;
  
  // IPv6 Packet - Payload_Length
  EthPaket.ipv6.length = @ServiceDiscovery_IPv6Packet_Payload_Length;
  
  // IPv6 Packet - Next Header
  EthPaket.ipv6.next = @ServiceDiscovery_IPv6Packet_Next_Header;
  if (@ServiceDiscovery_IPv6Packet_Next_Header == 6) EthPaket.tcp.Init();
  if (@ServiceDiscovery_IPv6Packet_Next_Header == 17) EthPaket.udp.Init();
  
  // IPv6 Packet - Hop Limit
  EthPaket.ipv6.hopLimit = @ServiceDiscovery_IPv6Packet_Hop_Limit;

  // IPv6 Packet - IPv6 Destination address    // TODO: char array zu byte array
  buffer_ipv6[0]  = @ServiceDiscovery_IPv6Packet_IP_Destination_Unicast_01>>8 & 0xFF;
  buffer_ipv6[1]  = @ServiceDiscovery_IPv6Packet_IP_Destination_Unicast_01    & 0xFF;
  buffer_ipv6[2]  = @ServiceDiscovery_IPv6Packet_IP_Destination_Unicast_02>>8 & 0xFF;
  buffer_ipv6[3]  = @ServiceDiscovery_IPv6Packet_IP_Destination_Unicast_02    & 0xFF;
  buffer_ipv6[4]  = @ServiceDiscovery_IPv6Packet_IP_Destination_Unicast_03>>8 & 0xFF;
  buffer_ipv6[5]  = @ServiceDiscovery_IPv6Packet_IP_Destination_Unicast_03    & 0xFF;
  buffer_ipv6[6]  = @ServiceDiscovery_IPv6Packet_IP_Destination_Unicast_04>>8 & 0xFF;
  buffer_ipv6[7]  = @ServiceDiscovery_IPv6Packet_IP_Destination_Unicast_04    & 0xFF;
  buffer_ipv6[8]  = @ServiceDiscovery_IPv6Packet_IP_Destination_Unicast_05>>8 & 0xFF;
  buffer_ipv6[9]  = @ServiceDiscovery_IPv6Packet_IP_Destination_Unicast_05    & 0xFF;
  buffer_ipv6[10] = @ServiceDiscovery_IPv6Packet_IP_Destination_Unicast_06>>8 & 0xFF;
  buffer_ipv6[11] = @ServiceDiscovery_IPv6Packet_IP_Destination_Unicast_06    & 0xFF;
  buffer_ipv6[12] = @ServiceDiscovery_IPv6Packet_IP_Destination_Unicast_07>>8 & 0xFF;
  buffer_ipv6[13] = @ServiceDiscovery_IPv6Packet_IP_Destination_Unicast_07    & 0xFF;
  buffer_ipv6[14] = @ServiceDiscovery_IPv6Packet_IP_Destination_Unicast_08>>8 & 0xFF;
  buffer_ipv6[15] = @ServiceDiscovery_IPv6Packet_IP_Destination_Unicast_08    & 0xFF;
  EthPaket.ipv6.destination.SetData ( 0, buffer_ipv6, elcount(buffer_ipv6) );

  // IPv6 Packet - IPv6 Source address    // TODO: char array zu byte array
  buffer_ipv6[0]  = @ServiceDiscovery_IPv6Packet_IP_Source_ICAS1Gateway_01>>8 & 0xFF;
  buffer_ipv6[1]  = @ServiceDiscovery_IPv6Packet_IP_Source_ICAS1Gateway_01    & 0xFF;
  buffer_ipv6[2]  = @ServiceDiscovery_IPv6Packet_IP_Source_ICAS1Gateway_02>>8 & 0xFF;
  buffer_ipv6[3]  = @ServiceDiscovery_IPv6Packet_IP_Source_ICAS1Gateway_02    & 0xFF;
  buffer_ipv6[4]  = @ServiceDiscovery_IPv6Packet_IP_Source_ICAS1Gateway_03>>8 & 0xFF;
  buffer_ipv6[5]  = @ServiceDiscovery_IPv6Packet_IP_Source_ICAS1Gateway_03    & 0xFF;
  buffer_ipv6[6]  = @ServiceDiscovery_IPv6Packet_IP_Source_ICAS1Gateway_04>>8 & 0xFF;
  buffer_ipv6[7]  = @ServiceDiscovery_IPv6Packet_IP_Source_ICAS1Gateway_04    & 0xFF;
  buffer_ipv6[8]  = @ServiceDiscovery_IPv6Packet_IP_Source_ICAS1Gateway_05>>8 & 0xFF;
  buffer_ipv6[9]  = @ServiceDiscovery_IPv6Packet_IP_Source_ICAS1Gateway_05    & 0xFF;
  buffer_ipv6[10] = @ServiceDiscovery_IPv6Packet_IP_Source_ICAS1Gateway_06>>8 & 0xFF;
  buffer_ipv6[11] = @ServiceDiscovery_IPv6Packet_IP_Source_ICAS1Gateway_06    & 0xFF;
  buffer_ipv6[12] = @ServiceDiscovery_IPv6Packet_IP_Source_ICAS1Gateway_07>>8 & 0xFF;
  buffer_ipv6[13] = @ServiceDiscovery_IPv6Packet_IP_Source_ICAS1Gateway_07    & 0xFF;
  buffer_ipv6[14] = @ServiceDiscovery_IPv6Packet_IP_Source_ICAS1Gateway_08>>8 & 0xFF;
  buffer_ipv6[15] = @ServiceDiscovery_IPv6Packet_IP_Source_ICAS1Gateway_08    & 0xFF;
  EthPaket.ipv6.source.SetData ( 0, buffer_ipv6, elcount(buffer_ipv6) );

  
  // UDP Packet - Source Port
  EthPaket.udp.source = @ServiceDiscovery_UDPPacket_Port_Source;
  
  // UDP Packet - Destination Port
  EthPaket.udp.destination = @ServiceDiscovery_UDPPacket_Port_Destination;
  
  // UDP Packet - Length
  EthPaket.udp.length = @ServiceDiscovery_UDPPacket_Length;
  
  
  // SOME/IP Packet aus Rohdaten zusammenbauen (buffer array)
  i=0;
  
  // SOME/IP Packet - Message ID, Service ID [16 bit]
  buffer[i++] = @ServiceDiscovery_SOMEIPPacket_SubACK_ICAS1Gateway_Message_ID_Service_ID>>8 & 0xFF;
  buffer[i++] = @ServiceDiscovery_SOMEIPPacket_SubACK_ICAS1Gateway_Message_ID_Service_ID    & 0xFF;
  
  // SOME/IP Packet - Message ID, Message ID [16 bit]
  buffer[i++] = @ServiceDiscovery_SOMEIPPacket_SubACK_ICAS1Gateway_Message_ID_Method_ID>>8 & 0xFF;
  buffer[i++] = @ServiceDiscovery_SOMEIPPacket_SubACK_ICAS1Gateway_Message_ID_Method_ID    & 0xFF;
  
  // SOME/IP Packet - Length [32 bit]
  @ServiceDiscovery_SOMEIPPacket_SubACK_ICAS1Gateway_Length = 16 + (16 * number_of_entries_array_elements) + 28;
  buffer[i++] = @ServiceDiscovery_SOMEIPPacket_SubACK_ICAS1Gateway_Length>>24 & 0xFF;
  buffer[i++] = @ServiceDiscovery_SOMEIPPacket_SubACK_ICAS1Gateway_Length>>16 & 0xFF;
  buffer[i++] = @ServiceDiscovery_SOMEIPPacket_SubACK_ICAS1Gateway_Length>> 8 & 0xFF;
  buffer[i++] = @ServiceDiscovery_SOMEIPPacket_SubACK_ICAS1Gateway_Length     & 0xFF;
  
  // SOME/IP Packet - Request ID, Client ID [16 bit]
  buffer[i++] = @ServiceDiscovery_SOMEIPPacket_SubACK_ICAS1Gateway_Request_ID_Client_ID>>8 & 0xFF;
  buffer[i++] = @ServiceDiscovery_SOMEIPPacket_SubACK_ICAS1Gateway_Request_ID_Client_ID    & 0xFF;
  
  // SOME/IP Packet - Request ID, Session ID) [16 bit]
  @ServiceDiscovery_SOMEIPPacket_Request_ID_Session_ID = @ServiceDiscovery_SOMEIPPacket_Request_ID_Session_ID + 1;
  if (@ServiceDiscovery_SOMEIPPacket_Request_ID_Session_ID == 0x10000) @ServiceDiscovery_SOMEIPPacket_Request_ID_Session_ID = 1;
  
  buffer[i++] = @ServiceDiscovery_SOMEIPPacket_Request_ID_Session_ID>>8 & 0xFF;
  buffer[i++] = @ServiceDiscovery_SOMEIPPacket_Request_ID_Session_ID    & 0xFF;
  
  // SOME/IP Packet - Protocol Version [8 bit]
  buffer[i++] = @ServiceDiscovery_SOMEIPPacket_SubACK_ICAS1Gateway_Protocol_Version;
  
  // SOME/IP Packet - Interface Version [8 bit]
  buffer[i++] = @ServiceDiscovery_SOMEIPPacket_SubACK_ICAS1Gateway_Interface_Version;

  // SOME/IP Packet - Message Type [8 bit]
  buffer[i++] = @ServiceDiscovery_SOMEIPPacket_SubACK_ICAS1Gateway_Message_Type;
    
  // SOME/IP Packet - Return Code [8 bit]
  buffer[i++] = @ServiceDiscovery_SOMEIPPacket_SubACK_ICAS1Gateway_Return_Code;
  
  // SOME/IP Packet - Flags [8 bit]
  buffer[i++] = @ServiceDiscovery_SOMEIPPacket_SubACK_ICAS1Gateway_Flags;
  
  // SOME/IP Packet - Reserved [24 bit]
  buffer[i++] = 0x00;
  buffer[i++] = 0x00;
  buffer[i++] = 0x00;


  // SOME/IP Packet - Entries Array - Length [32 bit]
  @ServiceDiscovery_SOMEIPPacket_SubACK_ICAS1Gateway_Entries_Array_Length = 16 * number_of_entries_array_elements;
  buffer[i++] = @ServiceDiscovery_SOMEIPPacket_SubACK_ICAS1Gateway_Entries_Array_Length>>24 & 0xFF;
  buffer[i++] = @ServiceDiscovery_SOMEIPPacket_SubACK_ICAS1Gateway_Entries_Array_Length>>16 & 0xFF;
  buffer[i++] = @ServiceDiscovery_SOMEIPPacket_SubACK_ICAS1Gateway_Entries_Array_Length>> 8 & 0xFF;
  buffer[i++] = @ServiceDiscovery_SOMEIPPacket_SubACK_ICAS1Gateway_Entries_Array_Length     & 0xFF;
  
  for (j=0; j < number_of_entries_array_elements; j++)
  {
    // SOME/IP Packet - Entries Array - Type [8 bit]
    buffer[i++] = servicediscovery_sub_rx_entries_array_type[j]+1;
    
    // SOME/IP Packet - Entries Array - Index 1st options [8 bit]
    buffer[i++] = 0; //servicediscovery_sub_rx_entries_array_index_1st_options[j];
    
    // SOME/IP Packet - Entries Array - Index 2nd options [8 bit]
    buffer[i++] = 0; //servicediscovery_sub_rx_entries_array_index_2nd_options[j];
    
    // SOME/IP Packet - Entries Array - # of opt 1 [4 bit] / # of opt 2 [4 bit]
    buffer[i++] = 1*16;//(((servicediscovery_sub_rx_entries_array_nr_of_opt_1[j]*16)) + (servicediscovery_sub_rx_entries_array_nr_of_opt_2[j]));
    
    // SOME/IP Packet - Entries Array - Service ID [16 bit]
    buffer[i++] = servicediscovery_sub_rx_entries_array_service_id[j]>> 8 & 0xFF;
    buffer[i++] = servicediscovery_sub_rx_entries_array_service_id[j]     & 0xFF;

    // SOME/IP Packet - Entries Array - Instance ID [16 bit]
    buffer[i++] = servicediscovery_sub_rx_entries_array_instance_id[j]>> 8 & 0xFF;
    buffer[i++] = servicediscovery_sub_rx_entries_array_instance_id[j]     & 0xFF;
    
    // SOME/IP Packet - Entries Array - Major Version [8 bit]
    buffer[i++] = servicediscovery_sub_rx_entries_array_major_version[j];
    
    // SOME/IP Packet - Entries Array - TTL [24 bit]
    buffer[i++] = servicediscovery_sub_rx_entries_array_ttl[j]>>16 & 0xFF;
    buffer[i++] = servicediscovery_sub_rx_entries_array_ttl[j]>> 8 & 0xFF;
    buffer[i++] = servicediscovery_sub_rx_entries_array_ttl[j]     & 0xFF;
    
    // SOME/IP Packet - Entries Array - Reserved [12 bit] + Counter [4 bit]
    buffer[i++] = 0x00;
    buffer[i++] = servicediscovery_sub_rx_entries_array_counter[j] & 0x0F;
    
    // SOME/IP Packet - Entries Array - Eventgroup ID
    buffer[i++] = servicediscovery_sub_rx_entries_array_eventgroup_id[j]>> 8 & 0xFF;
    buffer[i++] = servicediscovery_sub_rx_entries_array_eventgroup_id[j]     & 0xFF;
    
    
    // aktive Funktionen auswerten
    
    // Service ACC
    if (servicediscovery_sub_rx_entries_array_service_id[j] == 0x6010)
    {
      if (servicediscovery_sub_rx_entries_array_eventgroup_id[j] == 0xC010) @ACC_SubscribeStatus_notifications         = 1;
      if (servicediscovery_sub_rx_entries_array_eventgroup_id[j] == 0xC020) @ACC_SubscribeStatus_info                  = 1;
      if (servicediscovery_sub_rx_entries_array_eventgroup_id[j] == 0xC030) @ACC_SubscribeStatus_relevantObjects       = 1;
      if (servicediscovery_sub_rx_entries_array_eventgroup_id[j] == 0xC040) @ACC_SubscribeStatus_targetDistances       = 1;
      if (servicediscovery_sub_rx_entries_array_eventgroup_id[j] == 0xC050) @ACC_SubscribeStatus_velocities            = 1;
      if (servicediscovery_sub_rx_entries_array_eventgroup_id[j] == 0xC060) @ACC_SubscribeStatus_additionalInformation = 1;
    }
    
    // Service AWV
    if (servicediscovery_sub_rx_entries_array_service_id[j] == 0x6011)
    {
      if (servicediscovery_sub_rx_entries_array_eventgroup_id[j] == 0xC010) @AWV_SubscribeStatus_notifications = 1;
      if (servicediscovery_sub_rx_entries_array_eventgroup_id[j] == 0xC020) @AWV_SubscribeStatus_info          = 1;
    }
    
    // Service LaneAssist
    if (servicediscovery_sub_rx_entries_array_service_id[j] == 0x6012)
    {
      if (servicediscovery_sub_rx_entries_array_eventgroup_id[j] == 0xC010) @LaneAssist_SubscribeStatus_notifications = 1;
    }
    
    // Service TravelAssist
    if (servicediscovery_sub_rx_entries_array_service_id[j] == 0x6015)
    {
      if (servicediscovery_sub_rx_entries_array_eventgroup_id[j] == 0xC010) @TravelAssist_SubscribeStatus_notifications   = 1;
      if (servicediscovery_sub_rx_entries_array_eventgroup_id[j] == 0xC020) @TravelAssist_SubscribeStatus_lanes           = 1;
      if (servicediscovery_sub_rx_entries_array_eventgroup_id[j] == 0xC030) @TravelAssist_SubscribeStatus_curveParameters = 1;
      if (servicediscovery_sub_rx_entries_array_eventgroup_id[j] == 0xC040) @TravelAssist_SubscribeStatus_info            = 1;
      if (servicediscovery_sub_rx_entries_array_eventgroup_id[j] == 0xC050) @TravelAssist_SubscribeStatus_relevantObjects = 1;
    }
    
    // Service Odometry
    if (servicediscovery_sub_rx_entries_array_service_id[j] == 0x6017)
    {
      if (servicediscovery_sub_rx_entries_array_eventgroup_id[j] == 0xC010) @Odometry_SubscribeStatus_speeds                              = 1;
      if (servicediscovery_sub_rx_entries_array_eventgroup_id[j] == 0xC020) @Odometry_SubscribeStatus_velocities                          = 1;
      if (servicediscovery_sub_rx_entries_array_eventgroup_id[j] == 0xC030) @Odometry_SubscribeStatus_additionalVehicleMotionInformations = 1;
      if (servicediscovery_sub_rx_entries_array_eventgroup_id[j] == 0xC040) @Odometry_SubscribeStatus_wheelCorrections                    = 1;
      if (servicediscovery_sub_rx_entries_array_eventgroup_id[j] == 0xC050) @Odometry_SubscribeStatus_accelerations                       = 1;
      if (servicediscovery_sub_rx_entries_array_eventgroup_id[j] == 0xC060) @Odometry_SubscribeStatus_angularRates                        = 1;
    }
    
    // Service OccupantPresence
    if (servicediscovery_sub_rx_entries_array_service_id[j] == 0x6028)
    {
      if (servicediscovery_sub_rx_entries_array_eventgroup_id[j] == 0xC010) @OccupantPresence_SubscribeStatus_driverPresenceStatus   = 1;
      if (servicediscovery_sub_rx_entries_array_eventgroup_id[j] == 0xC020) @OccupantPresence_SubscribeStatus_occupantPresenceStatus = 1;
    }
    
    // Service VehicleBasicData
    if (servicediscovery_sub_rx_entries_array_service_id[j] == 0x604D)
    {
      if (servicediscovery_sub_rx_entries_array_eventgroup_id[j] == 0xC010) @VehicleBasicData_SubscribeStatus_installations = 1;
      if (servicediscovery_sub_rx_entries_array_eventgroup_id[j] == 0xC020) @VehicleBasicData_SubscribeStatus_variants      = 1;
      if (servicediscovery_sub_rx_entries_array_eventgroup_id[j] == 0xC030) @VehicleBasicData_SubscribeStatus_parameters    = 1;
    }
    
    // Service Powertrain
    if (servicediscovery_sub_rx_entries_array_service_id[j] == 0x6050)
    {
      if (servicediscovery_sub_rx_entries_array_eventgroup_id[j] == 0xC010) @Powertrain_SubscribeStatus_notifications = 1;
      if (servicediscovery_sub_rx_entries_array_eventgroup_id[j] == 0xC020) @Powertrain_SubscribeStatus_displayValues = 1;
      if (servicediscovery_sub_rx_entries_array_eventgroup_id[j] == 0xC030) @Powertrain_SubscribeStatus_status        = 1;
    }
  }
  
  
  //SOME/IP Packet - Options Array - Length [32 bit]
  buffer[i++] = @ServiceDiscovery_SOMEIPPacket_SubACK_ICAS1Gateway_Options_Array_Length>>24 & 0xFF;
  buffer[i++] = @ServiceDiscovery_SOMEIPPacket_SubACK_ICAS1Gateway_Options_Array_Length>>16 & 0xFF;
  buffer[i++] = @ServiceDiscovery_SOMEIPPacket_SubACK_ICAS1Gateway_Options_Array_Length>> 8 & 0xFF;
  buffer[i++] = @ServiceDiscovery_SOMEIPPacket_SubACK_ICAS1Gateway_Options_Array_Length     & 0xFF;

  //SOME/IP Packet - Options Array - Option1 Length [16 bit]
  buffer[i++] = @ServiceDiscovery_SOMEIPPacket_SubACK_ICAS1Gateway_Options_Array_Option1_Length>> 8 & 0xFF;
  buffer[i++] = @ServiceDiscovery_SOMEIPPacket_SubACK_ICAS1Gateway_Options_Array_Option1_Length     & 0xFF;
  
  //SOME/IP Packet - Options Array - Option1 Type [8 bit]
  buffer[i++] = @ServiceDiscovery_SOMEIPPacket_SubACK_ICAS1Gateway_Options_Array_Option1_Type & 0xFF;
  
  //SOME/IP Packet - Options Array - Reserved [8 bit]
  buffer[i++] = 0x00;
  
  //SOME/IP Packet - Options Array - Option1 IPv6 Address
  buffer[i++] = @ServiceDiscovery_SOMEIPPacket_SubACK_ICAS1Gateway_Options_Array_Option1_IPv6_01>>8 & 0xFF;
  buffer[i++] = @ServiceDiscovery_SOMEIPPacket_SubACK_ICAS1Gateway_Options_Array_Option1_IPv6_01    & 0xFF;
  buffer[i++] = @ServiceDiscovery_SOMEIPPacket_SubACK_ICAS1Gateway_Options_Array_Option1_IPv6_02>>8 & 0xFF;
  buffer[i++] = @ServiceDiscovery_SOMEIPPacket_SubACK_ICAS1Gateway_Options_Array_Option1_IPv6_02    & 0xFF;
  buffer[i++] = @ServiceDiscovery_SOMEIPPacket_SubACK_ICAS1Gateway_Options_Array_Option1_IPv6_03>>8 & 0xFF;
  buffer[i++] = @ServiceDiscovery_SOMEIPPacket_SubACK_ICAS1Gateway_Options_Array_Option1_IPv6_03    & 0xFF;
  buffer[i++] = @ServiceDiscovery_SOMEIPPacket_SubACK_ICAS1Gateway_Options_Array_Option1_IPv6_04>>8 & 0xFF;
  buffer[i++] = @ServiceDiscovery_SOMEIPPacket_SubACK_ICAS1Gateway_Options_Array_Option1_IPv6_04    & 0xFF;
  buffer[i++] = @ServiceDiscovery_SOMEIPPacket_SubACK_ICAS1Gateway_Options_Array_Option1_IPv6_05>>8 & 0xFF;
  buffer[i++] = @ServiceDiscovery_SOMEIPPacket_SubACK_ICAS1Gateway_Options_Array_Option1_IPv6_05    & 0xFF;
  buffer[i++] = @ServiceDiscovery_SOMEIPPacket_SubACK_ICAS1Gateway_Options_Array_Option1_IPv6_06>>8 & 0xFF;
  buffer[i++] = @ServiceDiscovery_SOMEIPPacket_SubACK_ICAS1Gateway_Options_Array_Option1_IPv6_06    & 0xFF;
  buffer[i++] = @ServiceDiscovery_SOMEIPPacket_SubACK_ICAS1Gateway_Options_Array_Option1_IPv6_07>>8 & 0xFF;
  buffer[i++] = @ServiceDiscovery_SOMEIPPacket_SubACK_ICAS1Gateway_Options_Array_Option1_IPv6_07    & 0xFF;
  buffer[i++] = @ServiceDiscovery_SOMEIPPacket_SubACK_ICAS1Gateway_Options_Array_Option1_IPv6_08>>8 & 0xFF;
  buffer[i++] = @ServiceDiscovery_SOMEIPPacket_SubACK_ICAS1Gateway_Options_Array_Option1_IPv6_08    & 0xFF;
  
  //SOME/IP Packet - Options Array - Reserved [8 bit]
  buffer[i++] = 0x00;
  
  //SOME/IP Packet - Options Array - Option1 L4-Proto [8 bit]
  buffer[i++] = @ServiceDiscovery_SOMEIPPacket_SubACK_ICAS1Gateway_Options_Array_Option1_L4_Proto;
  
  //SOME/IP Packet - Options Array - Option1 Port Number [16 bit]
  buffer[i++] = @ServiceDiscovery_SOMEIPPacket_SubACK_ICAS1Gateway_Options_Array_Option1_Port_Number>> 8 & 0xFF;
  buffer[i++] = @ServiceDiscovery_SOMEIPPacket_SubACK_ICAS1Gateway_Options_Array_Option1_Port_Number     & 0xFF;
  
  // Rohdaten in UDP Paket schreiben
  EthPaket.udp.SetData( 0, buffer, i );

  // calculate UDP and IPv6 checksum and send Ethernet packet
  EthPaket.CompletePacket();
  output( EthPaket );
}








/////////////////////////////////////////////////
////////////////// Service ACC //////////////////
/////////////////////////////////////////////////

on envVar ServiceDiscovery_Offer_Service_ACC
{
  Send_ServiceDiscovery_Offer_Service_ICAS1Gateway();
}

on envVar ACC_Notification_notifications_Send
{
  if (@this == 1)
  {
    UDP_Segments_total = @ACC_Notification_Length_notifications/1404 + 1;
    UDP_Segments_left  = UDP_Segments_total;
    
    if (UDP_Segments_total > 1) seg_id_flag = 1;
    else                        seg_id_flag = 0;
    
    Send_Service_ACC_Notification (0xC010 & 0x0000FFFF);
  }
}
on envVar ACC_Notification_notifications_Send_cyclic
{
  if (@this == 1)
    setTimercyclic (tACC_Notification_notifications_Send, @ACC_Notification_notifications_Send_cyclic_cycletime);
  else
    cancelTimer (tACC_Notification_notifications_Send);
}
on envVar ACC_Notification_notifications_Send_cyclic_cycletime
{
  if (@ACC_Notification_notifications_Send_cyclic == 1)
  {
    cancelTimer (tACC_Notification_notifications_Send);
    setTimercyclic (tACC_Notification_notifications_Send, @this);
  }
}
on timer tACC_Notification_notifications_Send
{
  UDP_Segments_total = @ACC_Notification_Length_notifications/1404 + 1;
  UDP_Segments_left  = UDP_Segments_total;
  
  if (UDP_Segments_total > 1) seg_id_flag = 1;
  else                        seg_id_flag = 0;
    
  Send_Service_ACC_Notification (0xC010 & 0x0000FFFF);
}

on envVar ACC_Notification_info_Send
{
  if (@this == 1)
  {
    UDP_Segments_total = @ACC_Notification_Length_info/1404 + 1;
    UDP_Segments_left  = UDP_Segments_total;
    
    if (UDP_Segments_total > 1) seg_id_flag = 1;
    else                        seg_id_flag = 0;
    
    Send_Service_ACC_Notification (0xC020 & 0x0000FFFF);
  }
}
on envVar ACC_Notification_info_Send_cyclic
{
  if (@this == 1)
    setTimercyclic (tACC_Notification_info_Send, @ACC_Notification_info_Send_cyclic_cycletime);
  else
    cancelTimer (tACC_Notification_info_Send);
}
on envVar ACC_Notification_info_Send_cyclic_cycletime
{
  if (@ACC_Notification_info_Send_cyclic == 1)
  {
    cancelTimer (tACC_Notification_info_Send);
    setTimercyclic (tACC_Notification_info_Send, @this);
  }
}
on timer tACC_Notification_info_Send
{
  UDP_Segments_total = @ACC_Notification_Length_info/1404 + 1;
  UDP_Segments_left  = UDP_Segments_total;
  
  if (UDP_Segments_total > 1) seg_id_flag = 1;
  else                        seg_id_flag = 0;
    
  Send_Service_ACC_Notification (0xC020 & 0x0000FFFF);
}

on envVar ACC_Notification_relevantObjects_Send
{
  if (@this == 1)
  {
    UDP_Segments_total = @ACC_Notification_Length_relevantObjects/1404 + 1;
    UDP_Segments_left  = UDP_Segments_total;
    
    if (UDP_Segments_total > 1) seg_id_flag = 1;
    else                        seg_id_flag = 0;
    
    Send_Service_ACC_Notification (0xC030 & 0x0000FFFF);
  }
}
on envVar ACC_Notification_relevantObjects_Send_cyclic
{
  if (@this == 1)
    setTimercyclic (tACC_Notification_relevantObjects_Send, @ACC_Notification_relevantObjects_Send_cyclic_cycletime);
  else
    cancelTimer (tACC_Notification_relevantObjects_Send);
}
on envVar ACC_Notification_relevantObjects_Send_cyclic_cycletime
{
  if (@ACC_Notification_relevantObjects_Send_cyclic == 1)
  {
    cancelTimer (tACC_Notification_relevantObjects_Send);
    setTimercyclic (tACC_Notification_relevantObjects_Send, @this);
  }
}
on timer tACC_Notification_relevantObjects_Send
{
  UDP_Segments_total = @ACC_Notification_Length_relevantObjects/1404 + 1;
  UDP_Segments_left  = UDP_Segments_total;
  
  if (UDP_Segments_total > 1) seg_id_flag = 1;
  else                        seg_id_flag = 0;
    
  Send_Service_ACC_Notification (0xC030 & 0x0000FFFF);
}

on envVar ACC_Notification_targetDistances_Send
{
  if (@this == 1)
  {
    UDP_Segments_total = @ACC_Notification_Length_targetDistances/1404 + 1;
    UDP_Segments_left  = UDP_Segments_total;
    
    if (UDP_Segments_total > 1) seg_id_flag = 1;
    else                        seg_id_flag = 0;
    
    Send_Service_ACC_Notification (0xC040 & 0x0000FFFF);
  }
}
on envVar ACC_Notification_targetDistances_Send_cyclic
{
  if (@this == 1)
    setTimercyclic (tACC_Notification_targetDistances_Send, @ACC_Notification_targetDistances_Send_cyclic_cycletime);
  else
    cancelTimer (tACC_Notification_targetDistances_Send);
}
on envVar ACC_Notification_targetDistances_Send_cyclic_cycletime
{
  if (@ACC_Notification_targetDistances_Send_cyclic == 1)
  {
    cancelTimer (tACC_Notification_targetDistances_Send);
    setTimercyclic (tACC_Notification_targetDistances_Send, @this);
  }
}
on timer tACC_Notification_targetDistances_Send
{
  UDP_Segments_total = @ACC_Notification_Length_targetDistances/1404 + 1;
  UDP_Segments_left  = UDP_Segments_total;
  
  if (UDP_Segments_total > 1) seg_id_flag = 1;
  else                        seg_id_flag = 0;
    
  Send_Service_ACC_Notification (0xC040 & 0x0000FFFF);
}

on envVar ACC_Notification_velocities_Send
{
  if (@this == 1)
  {
    UDP_Segments_total = @ACC_Notification_Length_velocities/1404 + 1;
    UDP_Segments_left  = UDP_Segments_total;
    
    if (UDP_Segments_total > 1) seg_id_flag = 1;
    else                        seg_id_flag = 0;
    
    Send_Service_ACC_Notification (0xC050 & 0x0000FFFF);
  }
}
on envVar ACC_Notification_velocities_Send_cyclic
{
  if (@this == 1)
    setTimercyclic (tACC_Notification_velocities_Send, @ACC_Notification_velocities_Send_cyclic_cycletime);
  else
    cancelTimer (tACC_Notification_velocities_Send);
}
on envVar ACC_Notification_velocities_Send_cyclic_cycletime
{
  if (@ACC_Notification_velocities_Send_cyclic == 1)
  {
    cancelTimer (tACC_Notification_velocities_Send);
    setTimercyclic (tACC_Notification_velocities_Send, @this);
  }
}
on timer tACC_Notification_velocities_Send
{
  UDP_Segments_total = @ACC_Notification_Length_velocities/1404 + 1;
  UDP_Segments_left  = UDP_Segments_total;
  
  if (UDP_Segments_total > 1) seg_id_flag = 1;
  else                        seg_id_flag = 0;
    
  Send_Service_ACC_Notification (0xC050 & 0x0000FFFF);
}

on envVar ACC_Notification_additionalInformation_Send
{
  if (@this == 1)
  {
    UDP_Segments_total = @ACC_Notification_Length_additionalInformation/1404 + 1;
    UDP_Segments_left  = UDP_Segments_total;
    
    if (UDP_Segments_total > 1) seg_id_flag = 1;
    else                        seg_id_flag = 0;
    
    Send_Service_ACC_Notification (0xC060 & 0x0000FFFF);
  }
}
on envVar ACC_Notification_additionalInformation_Send_cyclic
{
  if (@this == 1)
    setTimercyclic (tACC_Notification_additionalInformation_Send, @ACC_Notification_additionalInformation_Send_cyclic_cycletime);
  else
    cancelTimer (tACC_Notification_additionalInformation_Send);
}
on envVar ACC_Notification_additionalInformation_Send_cyclic_cycletime
{
  if (@ACC_Notification_additionalInformation_Send_cyclic == 1)
  {
    cancelTimer (tACC_Notification_additionalInformation_Send);
    setTimercyclic (tACC_Notification_additionalInformation_Send, @this);
  }
}
on timer tACC_Notification_additionalInformation_Send
{
  UDP_Segments_total = @ACC_Notification_Length_additionalInformation/1404 + 1;
  UDP_Segments_left  = UDP_Segments_total;
  
  if (UDP_Segments_total > 1) seg_id_flag = 1;
  else                        seg_id_flag = 0;
    
  Send_Service_ACC_Notification (0xC060 & 0x0000FFFF);
}


Send_Service_ACC_Notification (word MethodID)
{
  ethernetPacket EthPaket;

  // Ethernet Packet - MAC Source address
  getvalue (ServiceDiscovery_EthernetPacket_MAC_Source_ICAS1Gateway, buffer_MAC);
  //EthPaket.source.ParseAddress ( buffer_MAC );
  EthPaket.source = ethGetMacAddressAsNumber (buffer_MAC);
  
  // Ethernet Packet - MAC Destination address
  getvalue (ServiceDiscovery_EthernetPacket_MAC_Destination, buffer_MAC);
  //EthPaket.destination.ParseAddress ( buffer_MAC );
  EthPaket.destination = ethGetMacAddressAsNumber (buffer_MAC);
  
  // Ethernet Packet - VLAN
  EthPaket.SetVlan (@ServiceDiscovery_EthernetPacket_VLAN_TPID, @ServiceDiscovery_EthernetPacket_VLAN_TCI);
  
  // Ethernet Packet - Type
  //EthPaket.ipv6.type = @EthernetPacket_Type;
  if (@ServiceDiscovery_EthernetPacket_Type == 0x86DD) EthPaket.ipv6.Init();
  
  
  // IPv6 Packet - Version
  EthPaket.ipv6.version = @ServiceDiscovery_IPv6Packet_Version;

  // IPv6 Packet - Traffic Class
  EthPaket.ipv6.class = @ServiceDiscovery_IPv6Packet_Traffic_Class;
  
  // IPv6 Packet - Flow Label
  EthPaket.ipv6.flow = @ServiceDiscovery_IPv6Packet_Flow_Label;
  
  // IPv6 Packet - Payload_Length
  EthPaket.ipv6.length = @ServiceDiscovery_IPv6Packet_Payload_Length;
  
  // IPv6 Packet - Next Header
  EthPaket.ipv6.next = @ServiceDiscovery_IPv6Packet_Next_Header;
  if (@ServiceDiscovery_IPv6Packet_Next_Header == 6) EthPaket.tcp.Init();
  if (@ServiceDiscovery_IPv6Packet_Next_Header == 17) EthPaket.udp.Init();
  
  // IPv6 Packet - Hop Limit
  EthPaket.ipv6.hopLimit = @ServiceDiscovery_IPv6Packet_Hop_Limit;

  // IPv6 Packet - IPv6 Destination address    // TODO: char array zu byte array
  buffer_ipv6[0]  = @ServiceDiscovery_IPv6Packet_IP_Destination_Unicast_01>>8 & 0xFF;
  buffer_ipv6[1]  = @ServiceDiscovery_IPv6Packet_IP_Destination_Unicast_01    & 0xFF;
  buffer_ipv6[2]  = @ServiceDiscovery_IPv6Packet_IP_Destination_Unicast_02>>8 & 0xFF;
  buffer_ipv6[3]  = @ServiceDiscovery_IPv6Packet_IP_Destination_Unicast_02    & 0xFF;
  buffer_ipv6[4]  = @ServiceDiscovery_IPv6Packet_IP_Destination_Unicast_03>>8 & 0xFF;
  buffer_ipv6[5]  = @ServiceDiscovery_IPv6Packet_IP_Destination_Unicast_03    & 0xFF;
  buffer_ipv6[6]  = @ServiceDiscovery_IPv6Packet_IP_Destination_Unicast_04>>8 & 0xFF;
  buffer_ipv6[7]  = @ServiceDiscovery_IPv6Packet_IP_Destination_Unicast_04    & 0xFF;
  buffer_ipv6[8]  = @ServiceDiscovery_IPv6Packet_IP_Destination_Unicast_05>>8 & 0xFF;
  buffer_ipv6[9]  = @ServiceDiscovery_IPv6Packet_IP_Destination_Unicast_05    & 0xFF;
  buffer_ipv6[10] = @ServiceDiscovery_IPv6Packet_IP_Destination_Unicast_06>>8 & 0xFF;
  buffer_ipv6[11] = @ServiceDiscovery_IPv6Packet_IP_Destination_Unicast_06    & 0xFF;
  buffer_ipv6[12] = @ServiceDiscovery_IPv6Packet_IP_Destination_Unicast_07>>8 & 0xFF;
  buffer_ipv6[13] = @ServiceDiscovery_IPv6Packet_IP_Destination_Unicast_07    & 0xFF;
  buffer_ipv6[14] = @ServiceDiscovery_IPv6Packet_IP_Destination_Unicast_08>>8 & 0xFF;
  buffer_ipv6[15] = @ServiceDiscovery_IPv6Packet_IP_Destination_Unicast_08    & 0xFF;
  EthPaket.ipv6.destination.SetData ( 0, buffer_ipv6, elcount(buffer_ipv6) );

  // IPv6 Packet - IPv6 Source address    // TODO: char array zu byte array
  buffer_ipv6[0]  = @ServiceDiscovery_IPv6Packet_IP_Source_ICAS1Gateway_01>>8 & 0xFF;
  buffer_ipv6[1]  = @ServiceDiscovery_IPv6Packet_IP_Source_ICAS1Gateway_01    & 0xFF;
  buffer_ipv6[2]  = @ServiceDiscovery_IPv6Packet_IP_Source_ICAS1Gateway_02>>8 & 0xFF;
  buffer_ipv6[3]  = @ServiceDiscovery_IPv6Packet_IP_Source_ICAS1Gateway_02    & 0xFF;
  buffer_ipv6[4]  = @ServiceDiscovery_IPv6Packet_IP_Source_ICAS1Gateway_03>>8 & 0xFF;
  buffer_ipv6[5]  = @ServiceDiscovery_IPv6Packet_IP_Source_ICAS1Gateway_03    & 0xFF;
  buffer_ipv6[6]  = @ServiceDiscovery_IPv6Packet_IP_Source_ICAS1Gateway_04>>8 & 0xFF;
  buffer_ipv6[7]  = @ServiceDiscovery_IPv6Packet_IP_Source_ICAS1Gateway_04    & 0xFF;
  buffer_ipv6[8]  = @ServiceDiscovery_IPv6Packet_IP_Source_ICAS1Gateway_05>>8 & 0xFF;
  buffer_ipv6[9]  = @ServiceDiscovery_IPv6Packet_IP_Source_ICAS1Gateway_05    & 0xFF;
  buffer_ipv6[10] = @ServiceDiscovery_IPv6Packet_IP_Source_ICAS1Gateway_06>>8 & 0xFF;
  buffer_ipv6[11] = @ServiceDiscovery_IPv6Packet_IP_Source_ICAS1Gateway_06    & 0xFF;
  buffer_ipv6[12] = @ServiceDiscovery_IPv6Packet_IP_Source_ICAS1Gateway_07>>8 & 0xFF;
  buffer_ipv6[13] = @ServiceDiscovery_IPv6Packet_IP_Source_ICAS1Gateway_07    & 0xFF;
  buffer_ipv6[14] = @ServiceDiscovery_IPv6Packet_IP_Source_ICAS1Gateway_08>>8 & 0xFF;
  buffer_ipv6[15] = @ServiceDiscovery_IPv6Packet_IP_Source_ICAS1Gateway_08    & 0xFF;
  EthPaket.ipv6.source.SetData ( 0, buffer_ipv6, elcount(buffer_ipv6) );

  
  // UDP Packet - Source Port
  EthPaket.udp.source = @ACC_Notification_Port_Source;
  
  // UDP Packet - Destination Port
  EthPaket.udp.destination = @ACC_Notification_Port_Destination;
  
  // UDP Packet - Length
  EthPaket.udp.length = @ServiceDiscovery_UDPPacket_Length;
  
  
  // SOME/IP Packet aus Rohdaten zusammenbauen (buffer array)
  i=0;
  
  // SOME/IP Packet - Message ID, Service ID [16 bit]
  buffer[i++] = @ACC_Notification_Message_ID_Service_ID>>8 & 0xFF;
  buffer[i++] = @ACC_Notification_Message_ID_Service_ID    & 0xFF;
  
  // SOME/IP Packet - Message ID, Message ID [16 bit]
  switch (MethodID)
  {
    case 0xC010: @ACC_Notification_Message_ID_Method_ID = @ACC_Notification_Message_ID_Method_ID_notifications; break;
    case 0xC020: @ACC_Notification_Message_ID_Method_ID = @ACC_Notification_Message_ID_Method_ID_info; break;
    case 0xC030: @ACC_Notification_Message_ID_Method_ID = @ACC_Notification_Message_ID_Method_ID_relevantObjects; break;
    case 0xC040: @ACC_Notification_Message_ID_Method_ID = @ACC_Notification_Message_ID_Method_ID_targetDistances; break;
    case 0xC050: @ACC_Notification_Message_ID_Method_ID = @ACC_Notification_Message_ID_Method_ID_velocities; break;
    case 0xC060: @ACC_Notification_Message_ID_Method_ID = @ACC_Notification_Message_ID_Method_ID_additionalInformation; break;
  }
  buffer[i++] = @ACC_Notification_Message_ID_Method_ID>>8 & 0xFF;
  buffer[i++] = @ACC_Notification_Message_ID_Method_ID    & 0xFF;
  
  // SOME/IP Packet - Length [32 bit]
  if (UDP_Segments_total == 1)
  {
    switch (MethodID)
    {
      case 0xC010: @ACC_Notification_Length = @ACC_Notification_Length_notifications; break;
      case 0xC020: @ACC_Notification_Length = @ACC_Notification_Length_info; break;
      case 0xC030: @ACC_Notification_Length = @ACC_Notification_Length_relevantObjects; break;
      case 0xC040: @ACC_Notification_Length = @ACC_Notification_Length_targetDistances; break;
      case 0xC050: @ACC_Notification_Length = @ACC_Notification_Length_velocities; break;
      case 0xC060: @ACC_Notification_Length = @ACC_Notification_Length_additionalInformation; break;
    }
  }
  else
  {
    if (UDP_Segments_left > 1)
    {
      switch (MethodID)
      {
        case 0xC010: @ACC_Notification_Length = 1404; break;
        case 0xC020: @ACC_Notification_Length = 1404; break;
        case 0xC030: @ACC_Notification_Length = 1404; break;
        case 0xC040: @ACC_Notification_Length = 1404; break;
        case 0xC050: @ACC_Notification_Length = 1404; break;
        case 0xC060: @ACC_Notification_Length = 1404; break;
      }
    }
    else
    {
      switch (MethodID)
      {
        case 0xC010: @ACC_Notification_Length = ACC_payload_length_notifications         - 1404*(UDP_Segments_total-UDP_Segments_left) + 24; break;
        case 0xC020: @ACC_Notification_Length = ACC_payload_length_info                  - 1404*(UDP_Segments_total-UDP_Segments_left) + 24; break;
        case 0xC030: @ACC_Notification_Length = ACC_payload_length_relevantObjects       - 1404*(UDP_Segments_total-UDP_Segments_left) + 24; break;
        case 0xC040: @ACC_Notification_Length = ACC_payload_length_targetDistances       - 1404*(UDP_Segments_total-UDP_Segments_left) + 24; break;
        case 0xC050: @ACC_Notification_Length = ACC_payload_length_velocities            - 1404*(UDP_Segments_total-UDP_Segments_left) + 24; break;
        case 0xC060: @ACC_Notification_Length = ACC_payload_length_additionalInformation - 1404*(UDP_Segments_total-UDP_Segments_left) + 24; break;
      }
    }
  }
  buffer[i++] = @ACC_Notification_Length>>24 & 0xFF;
  buffer[i++] = @ACC_Notification_Length>>16 & 0xFF;
  buffer[i++] = @ACC_Notification_Length>> 8 & 0xFF;
  buffer[i++] = @ACC_Notification_Length     & 0xFF;
  
  // SOME/IP Packet - Request ID, Client ID [16 bit]
  buffer[i++] = @ACC_Notification_Request_ID_Client_ID>>8 & 0xFF;
  buffer[i++] = @ACC_Notification_Request_ID_Client_ID    & 0xFF;
  
  // SOME/IP Packet - Request ID, Session ID) [16 bit]
  if ((UDP_Segments_total == 1) || (seg_id_flag == 1))
  {
    @ServiceDiscovery_SOMEIPPacket_Notification_Request_ID_Session_ID = @ServiceDiscovery_SOMEIPPacket_Notification_Request_ID_Session_ID + 1;
    if (@ServiceDiscovery_SOMEIPPacket_Notification_Request_ID_Session_ID == 0x10000) @ServiceDiscovery_SOMEIPPacket_Notification_Request_ID_Session_ID = 1;
    seg_id_flag = 0;
  }
  
  buffer[i++] = @ServiceDiscovery_SOMEIPPacket_Notification_Request_ID_Session_ID>>8 & 0xFF;
  buffer[i++] = @ServiceDiscovery_SOMEIPPacket_Notification_Request_ID_Session_ID    & 0xFF;
  
  // SOME/IP Packet - Protocol Version [8 bit]
  buffer[i++] = @ACC_Notification_Protocol_Version;
  
  // SOME/IP Packet - Interface Version [8 bit]
  buffer[i++] = @ACC_Notification_Interface_Version;
  
  // SOME/IP Packet - Message Type [8 bit]
  buffer[i++] = @ACC_Notification_Message_Type;
  
  // SOME/IP Packet - Return Code [8 bit]
  buffer[i++] = @ACC_Notification_Return_Code;
  
  
  if (UDP_Segments_total > 1)
  {
    if (UDP_Segments_left >= 0)
    { 
      // Message Type neu setzen
      buffer[i-2] = @ACC_Notification_Message_Type + 0x20;
      
      // Offset (16byte Schritte, 1392/16 = 87)
      @ACC_Notification_Offset = 87 * (UDP_Segments_total - UDP_Segments_left);
      
      // More Segments Flag
      if (UDP_Segments_left > 1) @ACC_Notification_More_Segments_Flag = 1;
      else                       @ACC_Notification_More_Segments_Flag = 0;
      
      buffer[i++] =   @ACC_Notification_Offset>>20 & 0xFF;
      buffer[i++] =   @ACC_Notification_Offset>>12 & 0xFF;
      buffer[i++] =   @ACC_Notification_Offset>>4  & 0xFF;
      buffer[i++] = ((@ACC_Notification_Offset<<4) & 0xF0) + (@ACC_Notification_More_Segments_Flag & 0x01);
    }
  }
  
  UDP_Segments_left--;
  
  ////// notifications notifier //////
  if (MethodID == 0xC010)
  {
    if (UDP_Segments_total == 1)
    {
      for (j=0; j<ACC_payload_length_notifications; j++)
        buffer[i++] = ACC_payload_buffer_notifications[j];
    }
    else
    {
      if (UDP_Segments_left >= 1)
      {
        for (j=(UDP_Segments_total-UDP_Segments_left-1)*1392; j<(UDP_Segments_total-UDP_Segments_left)*1392; j++)
          buffer[i++] = ACC_payload_buffer_notifications[j];
      }
      else
      {
        for (j=(UDP_Segments_total-(UDP_Segments_left+1))*1392; j<ACC_payload_length_notifications; j++)
          buffer[i++] = ACC_payload_buffer_notifications[j];
      }
    }
  }
  
  ////// info notifier //////
  if (MethodID == 0xC020)
  {
    if (UDP_Segments_total == 1)
    {
      for (j=0; j<ACC_payload_length_info; j++)
        buffer[i++] = ACC_payload_buffer_info[j];
    }
    else
    {
      if (UDP_Segments_left >= 1)
      {
        for (j=(UDP_Segments_total-UDP_Segments_left-1)*1392; j<(UDP_Segments_total-UDP_Segments_left)*1392; j++)
          buffer[i++] = ACC_payload_buffer_info[j];
      }
      else
      {
        for (j=(UDP_Segments_total-(UDP_Segments_left+1))*1392; j<ACC_payload_length_info; j++)
          buffer[i++] = ACC_payload_buffer_info[j];
      }
    }
  }
  
  ////// relevantObjects notifier //////
  if (MethodID == 0xC030)
  {
    if (UDP_Segments_total == 1)
    {
      for (j=0; j<ACC_payload_length_relevantObjects; j++)
        buffer[i++] = ACC_payload_buffer_relevantObjects[j];
    }
    else
    {
      if (UDP_Segments_left >= 1)
      {
        for (j=(UDP_Segments_total-UDP_Segments_left-1)*1392; j<(UDP_Segments_total-UDP_Segments_left)*1392; j++)
          buffer[i++] = ACC_payload_buffer_relevantObjects[j];
      }
      else
      {
        for (j=(UDP_Segments_total-(UDP_Segments_left+1))*1392; j<ACC_payload_length_relevantObjects; j++)
          buffer[i++] = ACC_payload_buffer_relevantObjects[j];
      }
    }
  }
  
  ////// targetDistances notifier //////
  if (MethodID == 0xC040)
  {
    if (UDP_Segments_total == 1)
    {
      for (j=0; j<ACC_payload_length_targetDistances; j++)
        buffer[i++] = ACC_payload_buffer_targetDistances[j];
    }
    else
    {
      if (UDP_Segments_left >= 1)
      {
        for (j=(UDP_Segments_total-UDP_Segments_left-1)*1392; j<(UDP_Segments_total-UDP_Segments_left)*1392; j++)
          buffer[i++] = ACC_payload_buffer_targetDistances[j];
      }
      else
      {
        for (j=(UDP_Segments_total-(UDP_Segments_left+1))*1392; j<ACC_payload_length_targetDistances; j++)
          buffer[i++] = ACC_payload_buffer_targetDistances[j];
      }
    }
  }
  
  ////// velocities notifier //////
  if (MethodID == 0xC050)
  {
    if (UDP_Segments_total == 1)
    {
      for (j=0; j<ACC_payload_length_velocities; j++)
        buffer[i++] = ACC_payload_buffer_velocities[j];
    }
    else
    {
      if (UDP_Segments_left >= 1)
      {
        for (j=(UDP_Segments_total-UDP_Segments_left-1)*1392; j<(UDP_Segments_total-UDP_Segments_left)*1392; j++)
          buffer[i++] = ACC_payload_buffer_velocities[j];
      }
      else
      {
        for (j=(UDP_Segments_total-(UDP_Segments_left+1))*1392; j<ACC_payload_length_velocities; j++)
          buffer[i++] = ACC_payload_buffer_velocities[j];
      }
    }
  }
  
  ////// additionalInformation notifier //////
  if (MethodID == 0xC060)
  {
    if (UDP_Segments_total == 1)
    {
      for (j=0; j<ACC_payload_length_additionalInformation; j++)
        buffer[i++] = ACC_payload_buffer_additionalInformation[j];
    }
    else
    {
      if (UDP_Segments_left >= 1)
      {
        for (j=(UDP_Segments_total-UDP_Segments_left-1)*1392; j<(UDP_Segments_total-UDP_Segments_left)*1392; j++)
          buffer[i++] = ACC_payload_buffer_additionalInformation[j];
      }
      else
      {
        for (j=(UDP_Segments_total-(UDP_Segments_left+1))*1392; j<ACC_payload_length_additionalInformation; j++)
          buffer[i++] = ACC_payload_buffer_additionalInformation[j];
      }
    }
  }
  
  
  // Rohdaten in UDP Paket schreiben
  EthPaket.udp.SetData( 0, buffer, i );

  // calculate UDP and IPv6 checksum and send Ethernet packet
  EthPaket.CompletePacket();
  output( EthPaket );
  
  // prüfen ob alle Segemente gesendet wurden, sonst senden erneut aufrufen
  ACC_Segmentation_Method_ID = MethodID;
  if (UDP_Segments_left>0)
    settimer(ACC_Segmentation_delay, 50);
}

on timer ACC_Segmentation_delay
{
  Send_Service_ACC_Notification (ACC_Segmentation_Method_ID);
}






////////// notifications Notification //////////

on envVar ACC_Notification_LengthIndicator_Struct_notifications
{
  ACC_Notification_notifications();
}
on envVar ACC_Notification_LengthIndicator_Element_notifications
{
  ACC_Notification_notifications();
}
on envVar ACC_Notification_notifications_type
{
  ACC_array_notifications_type[@ACC_Notification_notifications_Element] = @this;
  ACC_Notification_notifications();
}
on envVar ACC_Notification_notifications_value
{
  ACC_array_notifications_value[@ACC_Notification_notifications_Element] = @this;
  ACC_Notification_notifications();
}
on envVar ACC_Notification_notifications_type_available
{
  ACC_array_notifications_type_available[@ACC_Notification_notifications_Element] = @this;
  ACC_Notification_notifications();
}
on envVar ACC_Notification_notifications_value_available
{
  ACC_array_notifications_value_available[@ACC_Notification_notifications_Element] = @this;
  ACC_Notification_notifications();
}
on envVar ACC_Notification_notifications_Payload
{
  ACC_Notification_notifications_update();
}


ACC_Notification_notifications()
{
  word payload_counter = 0;
  word start_pos       = 0;
  word element_length  = 0;
  
  // Length Indicator Struct - Platzhalter
  payload_counter = 0+4;
  start_pos = 0;
  
  for (j=0; j<@ACC_Notification_notifications_Element_TotalNum; j++)
  {
    ACC_array_notifications_available_functions[j] = ACC_array_notifications_type_available[j]
                                                   + ACC_array_notifications_value_available[j];
    
    // Length Indicator Element - Platzhalter
    if (ACC_array_notifications_available_functions[j] > 0)
    {
      start_pos = payload_counter;
      payload_counter = payload_counter + 4;
    }
    else 
      start_pos = payload_counter;
    
    
    // 0 type (enum32)
    if (ACC_array_notifications_type_available[j] == 1)
    {
      tag_dataID = 0;
      ACC_payload_buffer_notifications[payload_counter++] = 2 * 16 /* Wiretype = 2  =^ 32 Bit */ + ((tag_dataID>>8) & 0x0F) /* DataID High Part */ ;
      ACC_payload_buffer_notifications[payload_counter++] = tag_dataID & 0xFF /* DataID Low Part */ ;
      
      ACC_payload_buffer_notifications[payload_counter++] = ACC_array_notifications_type[j]>>24 & 0xFF;
      ACC_payload_buffer_notifications[payload_counter++] = ACC_array_notifications_type[j]>>16 & 0xFF;
      ACC_payload_buffer_notifications[payload_counter++] = ACC_array_notifications_type[j]>> 8 & 0xFF;
      ACC_payload_buffer_notifications[payload_counter++] = ACC_array_notifications_type[j]     & 0xFF;
    }
    
    
    // 1 value (uint32)
    if (ACC_array_notifications_value_available[j] == 1)
    {
      tag_dataID = 1;
      ACC_payload_buffer_notifications[payload_counter++] = 2 * 16 /* Wiretype = 2  =^ 32 Bit */ + ((tag_dataID>>8) & 0x0F) /* DataID High Part */ ;
      ACC_payload_buffer_notifications[payload_counter++] = tag_dataID & 0xFF /* DataID Low Part */ ;
      
      ACC_payload_buffer_notifications[payload_counter++] = ACC_array_notifications_value[j]>>24 & 0xFF;
      ACC_payload_buffer_notifications[payload_counter++] = ACC_array_notifications_value[j]>>16 & 0xFF;
      ACC_payload_buffer_notifications[payload_counter++] = ACC_array_notifications_value[j]>> 8 & 0xFF;
      ACC_payload_buffer_notifications[payload_counter++] = ACC_array_notifications_value[j]     & 0xFF;
    }
    
    
    //Element Length
    element_length = payload_counter-start_pos;
    if (element_length >0) ACC_array_notifications_array_element_length[j] = element_length - 4;
    else                   ACC_array_notifications_array_element_length[j] = element_length;
    
    ACC_payload_buffer_notifications[start_pos++] = ACC_array_notifications_array_element_length[j]>>24 & 0xFF;
    ACC_payload_buffer_notifications[start_pos++] = ACC_array_notifications_array_element_length[j]>>16 & 0xFF;
    ACC_payload_buffer_notifications[start_pos++] = ACC_array_notifications_array_element_length[j]>> 8 & 0xFF;
    ACC_payload_buffer_notifications[start_pos++] = ACC_array_notifications_array_element_length[j]     & 0xFF;
    
    if (ACC_array_notifications_array_element_length[j] == 0) payload_counter = payload_counter+4;
  }
  
  
  // Struct Length
  ACC_array_notifications_struct_element_length = 4*@ACC_Notification_notifications_Element_TotalNum;

  for (k=0;k<@ACC_Notification_notifications_Element_TotalNum;k++)
    ACC_array_notifications_struct_element_length = ACC_array_notifications_struct_element_length + ACC_array_notifications_array_element_length[k];
  
  ACC_payload_buffer_notifications[0] = ACC_array_notifications_struct_element_length>>24 & 0xFF;
  ACC_payload_buffer_notifications[1] = ACC_array_notifications_struct_element_length>>16 & 0xFF;
  ACC_payload_buffer_notifications[2] = ACC_array_notifications_struct_element_length>> 8 & 0xFF;
  ACC_payload_buffer_notifications[3] = ACC_array_notifications_struct_element_length     & 0xFF;


  ACC_payload_length_notifications = ACC_array_notifications_struct_element_length+4;
  putvalue(ACC_Notification_notifications_Payload, ACC_payload_buffer_notifications, ACC_payload_length_notifications);
}

on envVar ACC_Notification_notifications_Element_TotalNum
{
  if (@this == 0) @this =  1;
  if (@this > 10) @this = 10;
  
  ACC_Notification_notifications();
  ACC_Notification_notifications_update();
}

on envVar ACC_Notification_notifications_Element
{
  ACC_Notification_notifications_update();
}

on envVar ACC_Notification_notifications_Element_Next
{
  if (@this == 1 && @ACC_Notification_notifications_Element < @ACC_Notification_notifications_Element_TotalNum - 1)
  {
    @ACC_Notification_notifications_Element = @ACC_Notification_notifications_Element + 1;
    ACC_Notification_notifications_update();
  }
}

on envVar ACC_Notification_notifications_Element_Previous
{
  if (@this == 1 && @ACC_Notification_notifications_Element > 0)
  {
    @ACC_Notification_notifications_Element = @ACC_Notification_notifications_Element - 1;
    ACC_Notification_notifications_update();
  }
}

ACC_Notification_notifications_update()
{
  @ACC_Notification_LengthIndicator_Element_notifications = ACC_array_notifications_array_element_length[@ACC_Notification_notifications_Element];
  @ACC_Notification_LengthIndicator_Struct_notifications  = ACC_array_notifications_struct_element_length;
  @ACC_Notification_Length_notifications                  = ACC_payload_length_notifications+8;
  
  @ACC_Notification_notifications_type  = ACC_array_notifications_type[@ACC_Notification_notifications_Element];
  @ACC_Notification_notifications_value = ACC_array_notifications_value[@ACC_Notification_notifications_Element];
  
  @ACC_Notification_notifications_type_available  = ACC_array_notifications_type_available[@ACC_Notification_notifications_Element];
  @ACC_Notification_notifications_value_available = ACC_array_notifications_value_available[@ACC_Notification_notifications_Element];
}






////////// info Notification //////////

on envVar ACC_Notification_LengthIndicator_Struct_info
{
  ACC_Notification_info();
}
on envVar ACC_Notification_LengthIndicator_Element_info
{
  ACC_Notification_info();
}
on envVar ACC_Notification_info_elementId
{
  ACC_array_info_elementId[@ACC_Notification_info_Element] = @this;
  ACC_Notification_info();
}
on envVar ACC_Notification_info_functionOnDemandStatus
{
  ACC_array_info_functionOnDemandStatus[@ACC_Notification_info_Element] = @this;
  ACC_Notification_info();
}
on envVar ACC_Notification_info_distanceIndexPhysicalValue
{
  ACC_array_info_distanceIndexPhysicalValue[@ACC_Notification_info_Element] = @this;
  ACC_Notification_info();
}
on envVar ACC_Notification_info_distanceIndexLogicalValue
{
  ACC_array_info_distanceIndexLogicalValue[@ACC_Notification_info_Element] = @this;
  ACC_Notification_info();
}
on envVar ACC_Notification_info_distanceIndexValueType
{
  ACC_array_info_distanceIndexValueType[@ACC_Notification_info_Element] = @this;
  ACC_Notification_info();
}
on envVar ACC_Notification_info_statusGraMode
{
  ACC_array_info_statusGraMode[@ACC_Notification_info_Element] = @this;
  ACC_Notification_info();
}
on envVar ACC_Notification_info_maxDistanceScale
{
  ACC_array_info_maxDistanceScale[@ACC_Notification_info_Element] = @this;
  ACC_Notification_info();
}
on envVar ACC_Notification_info_statusObjectAccentuation
{
  ACC_array_info_statusObjectAccentuation[@ACC_Notification_info_Element] = @this;
  ACC_Notification_info();
}
on envVar ACC_Notification_info_situationalPrioritization
{
  ACC_array_info_situationalPrioritization[@ACC_Notification_info_Element] = @this;
  ACC_Notification_info();
}
on envVar ACC_Notification_info_statusEndOfTrafficJam
{
  ACC_array_info_statusEndOfTrafficJam[@ACC_Notification_info_Element] = @this;
  ACC_Notification_info();
}
on envVar ACC_Notification_info_statusIcon
{
  ACC_array_info_statusIcon[@ACC_Notification_info_Element] = @this;
  ACC_Notification_info();
}
on envVar ACC_Notification_info_statusACC
{
  ACC_array_info_statusACC[@ACC_Notification_info_Element] = @this;
  ACC_Notification_info();
}
on envVar ACC_Notification_info_configuredVelocityReached
{
  ACC_array_info_configuredVelocityReached[@ACC_Notification_info_Element] = @this;
  ACC_Notification_info();
}
on envVar ACC_Notification_info_hintsAdditionalDisplay
{
  ACC_array_info_hintsAdditionalDisplay[@ACC_Notification_info_Element] = @this;
  ACC_Notification_info();
}
on envVar ACC_Notification_info_accStatusDisplay
{
  ACC_array_info_accStatusDisplay[@ACC_Notification_info_Element] = @this;
  ACC_Notification_info();
}
on envVar ACC_Notification_info_lightAssistant
{
  ACC_array_info_lightAssistant[@ACC_Notification_info_Element] = @this;
  ACC_Notification_info();
}
on envVar ACC_Notification_info_overtakingPrevention
{
  ACC_array_info_overtakingPrevention[@ACC_Notification_info_Element] = @this;
  ACC_Notification_info();
}
on envVar ACC_Notification_info_tempolimit
{
  ACC_array_info_tempolimit[@ACC_Notification_info_Element] = @this;
  ACC_Notification_info();
}
on envVar ACC_Notification_info_elementId_available
{
  ACC_array_info_elementId_available[@ACC_Notification_info_Element] = @this;
  ACC_Notification_info();
}
on envVar ACC_Notification_info_functionOnDemandStatus_available
{
  ACC_array_info_functionOnDemandStatus_available[@ACC_Notification_info_Element] = @this;
  ACC_Notification_info();
}
on envVar ACC_Notification_info_distanceIndexPhysicalValue_available
{
  ACC_array_info_distanceIndexPhysicalValue_available[@ACC_Notification_info_Element] = @this;
  ACC_Notification_info();
}
on envVar ACC_Notification_info_distanceIndexLogicalValue_available
{
  ACC_array_info_distanceIndexLogicalValue_available[@ACC_Notification_info_Element] = @this;
  ACC_Notification_info();
}
on envVar ACC_Notification_info_distanceIndexValueType_available
{
  ACC_array_info_distanceIndexValueType_available[@ACC_Notification_info_Element] = @this;
  ACC_Notification_info();
}
on envVar ACC_Notification_info_statusGraMode_available
{
  ACC_array_info_statusGraMode_available[@ACC_Notification_info_Element] = @this;
  ACC_Notification_info();
}
on envVar ACC_Notification_info_maxDistanceScale_available
{
  ACC_array_info_maxDistanceScale_available[@ACC_Notification_info_Element] = @this;
  ACC_Notification_info();
}
on envVar ACC_Notification_info_statusObjectAccentuation_available
{
  ACC_array_info_statusObjectAccentuation_available[@ACC_Notification_info_Element] = @this;
  ACC_Notification_info();
}
on envVar ACC_Notification_info_situationalPrioritization_available
{
  ACC_array_info_situationalPrioritization_available[@ACC_Notification_info_Element] = @this;
  ACC_Notification_info();
}
on envVar ACC_Notification_info_statusEndOfTrafficJam_available
{
  ACC_array_info_statusEndOfTrafficJam_available[@ACC_Notification_info_Element] = @this;
  ACC_Notification_info();
}
on envVar ACC_Notification_info_statusIcon_available
{
  ACC_array_info_statusIcon_available[@ACC_Notification_info_Element] = @this;
  ACC_Notification_info();
}
on envVar ACC_Notification_info_statusACC_available
{
  ACC_array_info_statusACC_available[@ACC_Notification_info_Element] = @this;
  ACC_Notification_info();
}
on envVar ACC_Notification_info_configuredVelocityReached_available
{
  ACC_array_info_configuredVelocityReached_available[@ACC_Notification_info_Element] = @this;
  ACC_Notification_info();
}
on envVar ACC_Notification_info_hintsAdditionalDisplay_available
{
  ACC_array_info_hintsAdditionalDisplay_available[@ACC_Notification_info_Element] = @this;
  ACC_Notification_info();
}
on envVar ACC_Notification_info_accStatusDisplay_available
{
  ACC_array_info_accStatusDisplay_available[@ACC_Notification_info_Element] = @this;
  ACC_Notification_info();
}
on envVar ACC_Notification_info_lightAssistant_available
{
  ACC_array_info_lightAssistant_available[@ACC_Notification_info_Element] = @this;
  ACC_Notification_info();
}
on envVar ACC_Notification_info_overtakingPrevention_available
{
  ACC_array_info_overtakingPrevention_available[@ACC_Notification_info_Element] = @this;
  ACC_Notification_info();
}
on envVar ACC_Notification_info_tempolimit_available
{
  ACC_array_info_tempolimit_available[@ACC_Notification_info_Element] = @this;
  ACC_Notification_info();
}
on envVar ACC_Notification_info_Payload
{
  ACC_Notification_info_update();
}


ACC_Notification_info()
{
  word payload_counter = 0;
  word start_pos       = 0;
  word element_length  = 0;
  
  // Length Indicator Struct - Platzhalter
  payload_counter = 0+4;
  start_pos = 0;
  
  for (j=0; j<@ACC_Notification_info_Element_TotalNum; j++)
  {
    ACC_array_info_available_functions[j] = ACC_array_info_elementId_available[j]
                                          + ACC_array_info_functionOnDemandStatus_available[j]
                                          + ACC_array_info_distanceIndexPhysicalValue_available[j]
                                          + ACC_array_info_distanceIndexLogicalValue_available[j]
																	        + ACC_array_info_distanceIndexValueType_available[j]
																	        + ACC_array_info_statusGraMode_available[j]
															            + ACC_array_info_maxDistanceScale_available[j]
    													            + ACC_array_info_statusObjectAccentuation_available[j]
    													            + ACC_array_info_situationalPrioritization_available[j]
    													            + ACC_array_info_statusEndOfTrafficJam_available[j]
    													            + ACC_array_info_statusIcon_available[j]
    													            + ACC_array_info_statusACC_available[j]
    													            + ACC_array_info_configuredVelocityReached_available[j]
    													            + ACC_array_info_hintsAdditionalDisplay_available[j]
    													            + ACC_array_info_accStatusDisplay_available[j]
    													            + ACC_array_info_lightAssistant_available[j]
    													            + ACC_array_info_overtakingPrevention_available[j]
                                          + ACC_array_info_tempolimit_available[j];
    
    // Length Indicator Element - Platzhalter
    if (ACC_array_info_available_functions[j] > 0)
    {
      start_pos = payload_counter;
      payload_counter = payload_counter + 4;
    }
    else 
      start_pos = payload_counter;
    
    // 0 elementId (uint32)
    if (ACC_array_info_elementId_available[j] == 1)
    {
      tag_dataID = 0;
      ACC_payload_buffer_info[payload_counter++] = 2 * 16 /* Wiretype = 2  =^ 32 Bit */ + ((tag_dataID>>8) & 0x0F) /* DataID High Part */ ;
      ACC_payload_buffer_info[payload_counter++] = tag_dataID & 0xFF /* DataID Low Part */ ;
      
      ACC_payload_buffer_info[payload_counter++] = ACC_array_info_elementId[j]>>24 & 0xFF;
      ACC_payload_buffer_info[payload_counter++] = ACC_array_info_elementId[j]>>16 & 0xFF;
      ACC_payload_buffer_info[payload_counter++] = ACC_array_info_elementId[j]>> 8 & 0xFF;
      ACC_payload_buffer_info[payload_counter++] = ACC_array_info_elementId[j]     & 0xFF;
    }
    
    
    // 1 functionOnDemandStatus (enum32)
    if (ACC_array_info_functionOnDemandStatus_available[j] == 1)
    {
      tag_dataID = 1;
      ACC_payload_buffer_info[payload_counter++] = 2 * 16 /* Wiretype = 2  =^ 32 Bit */ + ((tag_dataID>>8) & 0x0F) /* DataID High Part */ ;
      ACC_payload_buffer_info[payload_counter++] = tag_dataID & 0xFF /* DataID Low Part */ ;
      
      ACC_payload_buffer_info[payload_counter++] = ACC_array_info_functionOnDemandStatus[j]>>24 & 0xFF;
      ACC_payload_buffer_info[payload_counter++] = ACC_array_info_functionOnDemandStatus[j]>>16 & 0xFF;
      ACC_payload_buffer_info[payload_counter++] = ACC_array_info_functionOnDemandStatus[j]>> 8 & 0xFF;
      ACC_payload_buffer_info[payload_counter++] = ACC_array_info_functionOnDemandStatus[j]     & 0xFF;
    }
    
    
    // 2 distanceIndexPhysicalValue (uint32)
    if (ACC_array_info_distanceIndexPhysicalValue_available[j] == 1)
    {
      tag_dataID = 2;
      ACC_payload_buffer_info[payload_counter++] = 2 * 16 /* Wiretype = 2  =^ 32 Bit */ + ((tag_dataID>>8) & 0x0F) /* DataID High Part */ ;
      ACC_payload_buffer_info[payload_counter++] = tag_dataID & 0xFF /* DataID Low Part */ ;
      
      ACC_payload_buffer_info[payload_counter++] = ACC_array_info_distanceIndexPhysicalValue[j]>>24 & 0xFF;
      ACC_payload_buffer_info[payload_counter++] = ACC_array_info_distanceIndexPhysicalValue[j]>>16 & 0xFF;
      ACC_payload_buffer_info[payload_counter++] = ACC_array_info_distanceIndexPhysicalValue[j]>> 8 & 0xFF;
      ACC_payload_buffer_info[payload_counter++] = ACC_array_info_distanceIndexPhysicalValue[j]     & 0xFF;
    }
    
    
    // 3 distanceIndexLogicalValue (uint32)
    if (ACC_array_info_distanceIndexLogicalValue_available[j] == 1)
    {
      tag_dataID = 3;
      ACC_payload_buffer_info[payload_counter++] = 2 * 16 /* Wiretype = 2  =^ 32 Bit */ + ((tag_dataID>>8) & 0x0F) /* DataID High Part */ ;
      ACC_payload_buffer_info[payload_counter++] = tag_dataID & 0xFF /* DataID Low Part */ ;
      
      ACC_payload_buffer_info[payload_counter++] = ACC_array_info_distanceIndexLogicalValue[j]>>24 & 0xFF;
      ACC_payload_buffer_info[payload_counter++] = ACC_array_info_distanceIndexLogicalValue[j]>>16 & 0xFF;
      ACC_payload_buffer_info[payload_counter++] = ACC_array_info_distanceIndexLogicalValue[j]>> 8 & 0xFF;
      ACC_payload_buffer_info[payload_counter++] = ACC_array_info_distanceIndexLogicalValue[j]     & 0xFF;
    }
    
    
    // 4 distanceIndexValueType (enum32)
    if (ACC_array_info_distanceIndexValueType_available[j] == 1)
    {
      tag_dataID = 4;
      ACC_payload_buffer_info[payload_counter++] = 2 * 16 /* Wiretype = 2  =^ 32 Bit */ + ((tag_dataID>>8) & 0x0F) /* DataID High Part */ ;
      ACC_payload_buffer_info[payload_counter++] = tag_dataID & 0xFF /* DataID Low Part */ ;
      
      ACC_payload_buffer_info[payload_counter++] = ACC_array_info_distanceIndexValueType[j]>>24 & 0xFF;
      ACC_payload_buffer_info[payload_counter++] = ACC_array_info_distanceIndexValueType[j]>>16 & 0xFF;
      ACC_payload_buffer_info[payload_counter++] = ACC_array_info_distanceIndexValueType[j]>> 8 & 0xFF;
      ACC_payload_buffer_info[payload_counter++] = ACC_array_info_distanceIndexValueType[j]     & 0xFF;
    }
    
    
    // 5 statusGraMode (enum32)
    if (ACC_array_info_statusGraMode_available[j] == 1)
    {
      tag_dataID = 5;
      ACC_payload_buffer_info[payload_counter++] = 2 * 16 /* Wiretype = 2  =^ 32 Bit */ + ((tag_dataID>>8) & 0x0F) /* DataID High Part */ ;
      ACC_payload_buffer_info[payload_counter++] = tag_dataID & 0xFF /* DataID Low Part */ ;
      
      ACC_payload_buffer_info[payload_counter++] = ACC_array_info_statusGraMode[j]>>24 & 0xFF;
      ACC_payload_buffer_info[payload_counter++] = ACC_array_info_statusGraMode[j]>>16 & 0xFF;
      ACC_payload_buffer_info[payload_counter++] = ACC_array_info_statusGraMode[j]>> 8 & 0xFF;
      ACC_payload_buffer_info[payload_counter++] = ACC_array_info_statusGraMode[j]     & 0xFF;
    }
    
    
    // 6 maxDistanceScale (uint32)
    if (ACC_array_info_maxDistanceScale_available[j] == 1)
    {
      tag_dataID = 6;
      ACC_payload_buffer_info[payload_counter++] = 2 * 16 /* Wiretype = 2  =^ 32 Bit */ + ((tag_dataID>>8) & 0x0F) /* DataID High Part */ ;
      ACC_payload_buffer_info[payload_counter++] = tag_dataID & 0xFF /* DataID Low Part */ ;
      
      ACC_payload_buffer_info[payload_counter++] = ACC_array_info_maxDistanceScale[j]>>24 & 0xFF;
      ACC_payload_buffer_info[payload_counter++] = ACC_array_info_maxDistanceScale[j]>>16 & 0xFF;
      ACC_payload_buffer_info[payload_counter++] = ACC_array_info_maxDistanceScale[j]>> 8 & 0xFF;
      ACC_payload_buffer_info[payload_counter++] = ACC_array_info_maxDistanceScale[j]     & 0xFF;
    }
    
    // 7 statusObjectAccentuation (enum32)
    if (ACC_array_info_statusObjectAccentuation_available[j] == 1)
    {
      tag_dataID = 7;
      ACC_payload_buffer_info[payload_counter++] = 2 * 16 /* Wiretype = 2  =^ 32 Bit */ + ((tag_dataID>>8) & 0x0F) /* DataID High Part */ ;
      ACC_payload_buffer_info[payload_counter++] = tag_dataID & 0xFF /* DataID Low Part */ ;
      
      ACC_payload_buffer_info[payload_counter++] = ACC_array_info_statusObjectAccentuation[j]>>24 & 0xFF;
      ACC_payload_buffer_info[payload_counter++] = ACC_array_info_statusObjectAccentuation[j]>>16 & 0xFF;
      ACC_payload_buffer_info[payload_counter++] = ACC_array_info_statusObjectAccentuation[j]>> 8 & 0xFF;
      ACC_payload_buffer_info[payload_counter++] = ACC_array_info_statusObjectAccentuation[j]     & 0xFF;
    }
    
    
    // 8 situationalPrioritization (enum32)
    if (ACC_array_info_situationalPrioritization_available[j] == 1)
    {
      tag_dataID = 8;
      ACC_payload_buffer_info[payload_counter++] = 2 * 16 /* Wiretype = 2  =^ 32 Bit */ + ((tag_dataID>>8) & 0x0F) /* DataID High Part */ ;
      ACC_payload_buffer_info[payload_counter++] = tag_dataID & 0xFF /* DataID Low Part */ ;
      
      ACC_payload_buffer_info[payload_counter++] = ACC_array_info_situationalPrioritization[j]>>24 & 0xFF;
      ACC_payload_buffer_info[payload_counter++] = ACC_array_info_situationalPrioritization[j]>>16 & 0xFF;
      ACC_payload_buffer_info[payload_counter++] = ACC_array_info_situationalPrioritization[j]>> 8 & 0xFF;
      ACC_payload_buffer_info[payload_counter++] = ACC_array_info_situationalPrioritization[j]     & 0xFF;
    }
    
    // 9 statusEndOfTrafficJam (enum32)
    if (ACC_array_info_statusEndOfTrafficJam_available[j] == 1)
    {
      tag_dataID = 9;
      ACC_payload_buffer_info[payload_counter++] = 2 * 16 /* Wiretype = 2  =^ 32 Bit */ + ((tag_dataID>>8) & 0x0F) /* DataID High Part */ ;
      ACC_payload_buffer_info[payload_counter++] = tag_dataID & 0xFF /* DataID Low Part */ ;
      
      ACC_payload_buffer_info[payload_counter++] = ACC_array_info_statusEndOfTrafficJam[j]>>24 & 0xFF;
      ACC_payload_buffer_info[payload_counter++] = ACC_array_info_statusEndOfTrafficJam[j]>>16 & 0xFF;
      ACC_payload_buffer_info[payload_counter++] = ACC_array_info_statusEndOfTrafficJam[j]>> 8 & 0xFF;
      ACC_payload_buffer_info[payload_counter++] = ACC_array_info_statusEndOfTrafficJam[j]     & 0xFF;
    }
    
    
    // 10 statusIcon (enum32)
    if (ACC_array_info_statusIcon_available[j] == 1)
    {
      tag_dataID = 10;
      ACC_payload_buffer_info[payload_counter++] = 2 * 16 /* Wiretype = 2  =^ 32 Bit */ + ((tag_dataID>>8) & 0x0F) /* DataID High Part */ ;
      ACC_payload_buffer_info[payload_counter++] = tag_dataID & 0xFF /* DataID Low Part */ ;
      
      ACC_payload_buffer_info[payload_counter++] = ACC_array_info_statusIcon[j]>>24 & 0xFF;
      ACC_payload_buffer_info[payload_counter++] = ACC_array_info_statusIcon[j]>>16 & 0xFF;
      ACC_payload_buffer_info[payload_counter++] = ACC_array_info_statusIcon[j]>> 8 & 0xFF;
      ACC_payload_buffer_info[payload_counter++] = ACC_array_info_statusIcon[j]     & 0xFF;
    }
    
    
    // 11 statusACC (enum32)
    if (ACC_array_info_statusACC_available[j] == 1)
    {
      tag_dataID = 11;
      ACC_payload_buffer_info[payload_counter++] = 2 * 16 /* Wiretype = 2  =^ 32 Bit */ + ((tag_dataID>>8) & 0x0F) /* DataID High Part */ ;
      ACC_payload_buffer_info[payload_counter++] = tag_dataID & 0xFF /* DataID Low Part */ ;
      
      ACC_payload_buffer_info[payload_counter++] = ACC_array_info_statusACC[j]>>24 & 0xFF;
      ACC_payload_buffer_info[payload_counter++] = ACC_array_info_statusACC[j]>>16 & 0xFF;
      ACC_payload_buffer_info[payload_counter++] = ACC_array_info_statusACC[j]>> 8 & 0xFF;
      ACC_payload_buffer_info[payload_counter++] = ACC_array_info_statusACC[j]     & 0xFF;
    }
    
    
    // 12 configuredVelocityReached (enum32)
    if (ACC_array_info_configuredVelocityReached_available[j] == 1)
    {
      tag_dataID = 12;
      ACC_payload_buffer_info[payload_counter++] = 2 * 16 /* Wiretype = 2  =^ 32 Bit */ + ((tag_dataID>>8) & 0x0F) /* DataID High Part */ ;
      ACC_payload_buffer_info[payload_counter++] = tag_dataID & 0xFF /* DataID Low Part */ ;
      
      ACC_payload_buffer_info[payload_counter++] = ACC_array_info_configuredVelocityReached[j]>>24 & 0xFF;
      ACC_payload_buffer_info[payload_counter++] = ACC_array_info_configuredVelocityReached[j]>>16 & 0xFF;
      ACC_payload_buffer_info[payload_counter++] = ACC_array_info_configuredVelocityReached[j]>> 8 & 0xFF;
      ACC_payload_buffer_info[payload_counter++] = ACC_array_info_configuredVelocityReached[j]     & 0xFF;
    }
    
    
    // 13 statusACC (enum32)
    if (ACC_array_info_statusACC_available[j] == 1)
    {
      tag_dataID = 13;
      ACC_payload_buffer_info[payload_counter++] = 2 * 16 /* Wiretype = 2  =^ 32 Bit */ + ((tag_dataID>>8) & 0x0F) /* DataID High Part */ ;
      ACC_payload_buffer_info[payload_counter++] = tag_dataID & 0xFF /* DataID Low Part */ ;
      
      ACC_payload_buffer_info[payload_counter++] = ACC_array_info_hintsAdditionalDisplay[j]>>24 & 0xFF;
      ACC_payload_buffer_info[payload_counter++] = ACC_array_info_hintsAdditionalDisplay[j]>>16 & 0xFF;
      ACC_payload_buffer_info[payload_counter++] = ACC_array_info_hintsAdditionalDisplay[j]>> 8 & 0xFF;
      ACC_payload_buffer_info[payload_counter++] = ACC_array_info_hintsAdditionalDisplay[j]     & 0xFF;
    }
    
    
    // 14 accStatusDisplay (enum32)
    if (ACC_array_info_accStatusDisplay_available[j] == 1)
    {
      tag_dataID = 14;
      ACC_payload_buffer_info[payload_counter++] = 2 * 16 /* Wiretype = 2  =^ 32 Bit */ + ((tag_dataID>>8) & 0x0F) /* DataID High Part */ ;
      ACC_payload_buffer_info[payload_counter++] = tag_dataID & 0xFF /* DataID Low Part */ ;
      
      ACC_payload_buffer_info[payload_counter++] = ACC_array_info_accStatusDisplay[j]>>24 & 0xFF;
      ACC_payload_buffer_info[payload_counter++] = ACC_array_info_accStatusDisplay[j]>>16 & 0xFF;
      ACC_payload_buffer_info[payload_counter++] = ACC_array_info_accStatusDisplay[j]>> 8 & 0xFF;
      ACC_payload_buffer_info[payload_counter++] = ACC_array_info_accStatusDisplay[j]     & 0xFF;
    }
    
    
    // 15 lightAssistant (enum32)
    if (ACC_array_info_lightAssistant_available[j] == 1)
    {
      tag_dataID = 15;
      ACC_payload_buffer_info[payload_counter++] = 2 * 16 /* Wiretype = 2  =^ 32 Bit */ + ((tag_dataID>>8) & 0x0F) /* DataID High Part */ ;
      ACC_payload_buffer_info[payload_counter++] = tag_dataID & 0xFF /* DataID Low Part */ ;
      
      ACC_payload_buffer_info[payload_counter++] = ACC_array_info_lightAssistant[j]>>24 & 0xFF;
      ACC_payload_buffer_info[payload_counter++] = ACC_array_info_lightAssistant[j]>>16 & 0xFF;
      ACC_payload_buffer_info[payload_counter++] = ACC_array_info_lightAssistant[j]>> 8 & 0xFF;
      ACC_payload_buffer_info[payload_counter++] = ACC_array_info_lightAssistant[j]     & 0xFF;
    }
    
    
    // 16 overtakingPrevention (enum32)
    if (ACC_array_info_overtakingPrevention_available[j] == 1)
    {
      tag_dataID = 16;
      ACC_payload_buffer_info[payload_counter++] = 2 * 16 /* Wiretype = 2  =^ 32 Bit */ + ((tag_dataID>>8) & 0x0F) /* DataID High Part */ ;
      ACC_payload_buffer_info[payload_counter++] = tag_dataID & 0xFF /* DataID Low Part */ ;
      
      ACC_payload_buffer_info[payload_counter++] = ACC_array_info_overtakingPrevention[j]>>24 & 0xFF;
      ACC_payload_buffer_info[payload_counter++] = ACC_array_info_overtakingPrevention[j]>>16 & 0xFF;
      ACC_payload_buffer_info[payload_counter++] = ACC_array_info_overtakingPrevention[j]>> 8 & 0xFF;
      ACC_payload_buffer_info[payload_counter++] = ACC_array_info_overtakingPrevention[j]     & 0xFF;
    }
    
    
    // 17 tempolimit (enum32)
    if (ACC_array_info_tempolimit_available[j] == 1)
    {
      tag_dataID = 17;
      ACC_payload_buffer_info[payload_counter++] = 2 * 16 /* Wiretype = 2  =^ 32 Bit */ + ((tag_dataID>>8) & 0x0F) /* DataID High Part */ ;
      ACC_payload_buffer_info[payload_counter++] = tag_dataID & 0xFF /* DataID Low Part */ ;
      
      ACC_payload_buffer_info[payload_counter++] = ACC_array_info_tempolimit[j]>>24 & 0xFF;
      ACC_payload_buffer_info[payload_counter++] = ACC_array_info_tempolimit[j]>>16 & 0xFF;
      ACC_payload_buffer_info[payload_counter++] = ACC_array_info_tempolimit[j]>> 8 & 0xFF;
      ACC_payload_buffer_info[payload_counter++] = ACC_array_info_tempolimit[j]     & 0xFF;
    }
    
    
    //Element Length
    element_length = payload_counter-start_pos;
    if (element_length >0) ACC_array_info_array_element_length[j] = element_length - 4;
    else                   ACC_array_info_array_element_length[j] = element_length;
    
    ACC_payload_buffer_info[start_pos++] = ACC_array_info_array_element_length[j]>>24 & 0xFF;
    ACC_payload_buffer_info[start_pos++] = ACC_array_info_array_element_length[j]>>16 & 0xFF;
    ACC_payload_buffer_info[start_pos++] = ACC_array_info_array_element_length[j]>> 8 & 0xFF;
    ACC_payload_buffer_info[start_pos++] = ACC_array_info_array_element_length[j]     & 0xFF;
    
    if (ACC_array_info_array_element_length[j] == 0) payload_counter = payload_counter+4;
  }
  
  // Struct Length
  ACC_array_info_struct_element_length = 4*@ACC_Notification_info_Element_TotalNum;

  for (k=0;k<@ACC_Notification_info_Element_TotalNum;k++)
    ACC_array_info_struct_element_length = ACC_array_info_struct_element_length + ACC_array_info_array_element_length[k];
  
  ACC_payload_buffer_info[0] = ACC_array_info_struct_element_length>>24 & 0xFF;
  ACC_payload_buffer_info[1] = ACC_array_info_struct_element_length>>16 & 0xFF;
  ACC_payload_buffer_info[2] = ACC_array_info_struct_element_length>> 8 & 0xFF;
  ACC_payload_buffer_info[3] = ACC_array_info_struct_element_length     & 0xFF;


  ACC_payload_length_info = ACC_array_info_struct_element_length+4;
  putvalue(ACC_Notification_info_Payload, ACC_payload_buffer_info, ACC_payload_length_info);
}

on envVar ACC_Notification_info_Element_TotalNum
{
  if (@this == 0) @this =  1;
  if (@this > 10) @this = 10;
  
  ACC_Notification_info();
  ACC_Notification_info_update();
}

on envVar ACC_Notification_info_Element
{
  ACC_Notification_info_update();
}

on envVar ACC_Notification_info_Element_Next
{
  if (@this == 1 && @ACC_Notification_info_Element < @ACC_Notification_info_Element_TotalNum - 1)
  {
    @ACC_Notification_info_Element = @ACC_Notification_info_Element + 1;
    ACC_Notification_info_update();
  }
}

on envVar ACC_Notification_info_Element_Previous
{
  if (@this == 1 && @ACC_Notification_info_Element > 0)
  {
    @ACC_Notification_info_Element = @ACC_Notification_info_Element - 1;
    ACC_Notification_info_update();
  }
}

ACC_Notification_info_update()
{
  @ACC_Notification_LengthIndicator_Element_info = ACC_array_info_array_element_length[@ACC_Notification_info_Element];
  @ACC_Notification_LengthIndicator_Struct_info  = ACC_array_info_struct_element_length;
  @ACC_Notification_Length_info                  = ACC_payload_length_info+8;
  
  @ACC_Notification_info_elementId                  = ACC_array_info_elementId[@ACC_Notification_info_Element];
  @ACC_Notification_info_functionOnDemandStatus     = ACC_array_info_functionOnDemandStatus[@ACC_Notification_info_Element];
  @ACC_Notification_info_distanceIndexPhysicalValue = ACC_array_info_distanceIndexPhysicalValue[@ACC_Notification_info_Element];
  @ACC_Notification_info_distanceIndexLogicalValue  = ACC_array_info_distanceIndexLogicalValue[@ACC_Notification_info_Element];
  @ACC_Notification_info_distanceIndexValueType     = ACC_array_info_distanceIndexValueType[@ACC_Notification_info_Element];
  @ACC_Notification_info_statusGraMode              = ACC_array_info_statusGraMode[@ACC_Notification_info_Element];
  @ACC_Notification_info_maxDistanceScale           = ACC_array_info_maxDistanceScale[@ACC_Notification_info_Element];
  @ACC_Notification_info_statusObjectAccentuation   = ACC_array_info_statusObjectAccentuation[@ACC_Notification_info_Element];
  @ACC_Notification_info_situationalPrioritization  = ACC_array_info_situationalPrioritization[@ACC_Notification_info_Element];
  @ACC_Notification_info_statusEndOfTrafficJam      = ACC_array_info_statusEndOfTrafficJam[@ACC_Notification_info_Element];
  @ACC_Notification_info_statusIcon                 = ACC_array_info_statusIcon[@ACC_Notification_info_Element];
  @ACC_Notification_info_statusACC                  = ACC_array_info_statusACC[@ACC_Notification_info_Element];
  @ACC_Notification_info_configuredVelocityReached  = ACC_array_info_configuredVelocityReached[@ACC_Notification_info_Element];
  @ACC_Notification_info_hintsAdditionalDisplay     = ACC_array_info_hintsAdditionalDisplay[@ACC_Notification_info_Element];
  @ACC_Notification_info_accStatusDisplay           = ACC_array_info_accStatusDisplay[@ACC_Notification_info_Element];
  @ACC_Notification_info_lightAssistant             = ACC_array_info_lightAssistant[@ACC_Notification_info_Element];
  @ACC_Notification_info_overtakingPrevention       = ACC_array_info_overtakingPrevention[@ACC_Notification_info_Element];
  @ACC_Notification_info_tempolimit                 = ACC_array_info_tempolimit[@ACC_Notification_info_Element];
  
  @ACC_Notification_info_elementId_available                  = ACC_array_info_elementId_available[@ACC_Notification_info_Element];
  @ACC_Notification_info_functionOnDemandStatus_available     = ACC_array_info_functionOnDemandStatus_available[@ACC_Notification_info_Element];
  @ACC_Notification_info_distanceIndexPhysicalValue_available = ACC_array_info_distanceIndexPhysicalValue_available[@ACC_Notification_info_Element];
  @ACC_Notification_info_distanceIndexLogicalValue_available  = ACC_array_info_distanceIndexLogicalValue_available[@ACC_Notification_info_Element];
  @ACC_Notification_info_distanceIndexValueType_available     = ACC_array_info_distanceIndexValueType_available[@ACC_Notification_info_Element];
  @ACC_Notification_info_statusGraMode_available              = ACC_array_info_statusGraMode_available[@ACC_Notification_info_Element];
  @ACC_Notification_info_maxDistanceScale_available           = ACC_array_info_maxDistanceScale_available[@ACC_Notification_info_Element];
  @ACC_Notification_info_statusObjectAccentuation_available   = ACC_array_info_statusObjectAccentuation_available[@ACC_Notification_info_Element];
  @ACC_Notification_info_situationalPrioritization_available  = ACC_array_info_situationalPrioritization_available[@ACC_Notification_info_Element];
  @ACC_Notification_info_statusEndOfTrafficJam_available      = ACC_array_info_statusEndOfTrafficJam_available[@ACC_Notification_info_Element];
  @ACC_Notification_info_statusIcon_available                 = ACC_array_info_statusIcon_available[@ACC_Notification_info_Element];
  @ACC_Notification_info_statusACC_available                  = ACC_array_info_statusACC_available[@ACC_Notification_info_Element];
  @ACC_Notification_info_configuredVelocityReached_available  = ACC_array_info_configuredVelocityReached_available[@ACC_Notification_info_Element];
  @ACC_Notification_info_hintsAdditionalDisplay_available     = ACC_array_info_hintsAdditionalDisplay_available[@ACC_Notification_info_Element];
  @ACC_Notification_info_accStatusDisplay_available           = ACC_array_info_accStatusDisplay_available[@ACC_Notification_info_Element];
  @ACC_Notification_info_lightAssistant_available             = ACC_array_info_lightAssistant_available[@ACC_Notification_info_Element];
  @ACC_Notification_info_overtakingPrevention_available       = ACC_array_info_overtakingPrevention_available[@ACC_Notification_info_Element];
  @ACC_Notification_info_tempolimit_available                 = ACC_array_info_tempolimit_available[@ACC_Notification_info_Element];
}






////////// relevantObjects Notification //////////

on envVar ACC_Notification_LengthIndicator_Struct_relevantObjects
{
  ACC_Notification_relevantObjects();
}
on envVar ACC_Notification_LengthIndicator_Element_relevantObjects
{
  ACC_Notification_relevantObjects();
}
on envVar ACC_Notification_relevantObjects_type
{
  ACC_array_relevantObjects_type[@ACC_Notification_relevantObjects_Element] = @this;
  ACC_Notification_relevantObjects();
}
on envVar ACC_Notification_relevantObjects_distanceToObject
{
  ACC_array_relevantObjects_distanceToObject[@ACC_Notification_relevantObjects_Element] = @this;
  ACC_Notification_relevantObjects();
}
on envVar ACC_Notification_relevantObjects_distanceToObjectValueType
{
  ACC_array_relevantObjects_distanceToObjectValueType[@ACC_Notification_relevantObjects_Element] = @this;
  ACC_Notification_relevantObjects();
}
on envVar ACC_Notification_relevantObjects_objectType
{
  ACC_array_relevantObjects_objectType[@ACC_Notification_relevantObjects_Element] = @this;
  ACC_Notification_relevantObjects();
}
on envVar ACC_Notification_relevantObjects_videoID
{
  ACC_array_relevantObjects_videoID[@ACC_Notification_relevantObjects_Element] = @this;
  ACC_Notification_relevantObjects();
}
on envVar ACC_Notification_relevantObjects_videoIDValueType
{
  ACC_array_relevantObjects_videoIDValueType[@ACC_Notification_relevantObjects_Element] = @this;
  ACC_Notification_relevantObjects();
}
on envVar ACC_Notification_relevantObjects_longitudinalDistanceToObject
{
  ACC_array_relevantObjects_longitudinalDistanceToObject[@ACC_Notification_relevantObjects_Element] = @this;
  ACC_Notification_relevantObjects();
}
on envVar ACC_Notification_relevantObjects_longitudinalDistanceToObjectValueType
{
  ACC_array_relevantObjects_longitudinalDistanceToObjectValueType[@ACC_Notification_relevantObjects_Element] = @this;
  ACC_Notification_relevantObjects();
}
on envVar ACC_Notification_relevantObjects_lateralDistanceToObject
{
  ACC_array_relevantObjects_lateralDistanceToObject[@ACC_Notification_relevantObjects_Element] = @this;
  ACC_Notification_relevantObjects();
}
on envVar ACC_Notification_relevantObjects_lateralDistanceToObjectValueType
{
  ACC_array_relevantObjects_lateralDistanceToObjectValueType[@ACC_Notification_relevantObjects_Element] = @this;
  ACC_Notification_relevantObjects();
}
on envVar ACC_Notification_relevantObjects_type_available
{
  ACC_array_relevantObjects_type_available[@ACC_Notification_relevantObjects_Element] = @this;
  ACC_Notification_relevantObjects();
}
on envVar ACC_Notification_relevantObjects_distanceToObject_available
{
  ACC_array_relevantObjects_distanceToObject_available[@ACC_Notification_relevantObjects_Element] = @this;
  ACC_Notification_relevantObjects();
}
on envVar ACC_Notification_relevantObjects_distanceToObjectValueType_available
{
  ACC_array_relevantObjects_distanceToObjectValueType_available[@ACC_Notification_relevantObjects_Element] = @this;
  ACC_Notification_relevantObjects();
}
on envVar ACC_Notification_relevantObjects_objectType_available
{
  ACC_array_relevantObjects_objectType_available[@ACC_Notification_relevantObjects_Element] = @this;
  ACC_Notification_relevantObjects();
}
on envVar ACC_Notification_relevantObjects_videoID_available
{
  ACC_array_relevantObjects_videoID_available[@ACC_Notification_relevantObjects_Element] = @this;
  ACC_Notification_relevantObjects();
}
on envVar ACC_Notification_relevantObjects_videoIDValueType_available
{
  ACC_array_relevantObjects_videoIDValueType_available[@ACC_Notification_relevantObjects_Element] = @this;
  ACC_Notification_relevantObjects();
}
on envVar ACC_Notification_relevantObjects_longitudinalDistanceToObject_available
{
  ACC_array_relevantObjects_longitudinalDistanceToObject_available[@ACC_Notification_relevantObjects_Element] = @this;
  ACC_Notification_relevantObjects();
}
on envVar ACC_Notification_relevantObjects_longitudinalDistanceToObjectValueType_available
{
  ACC_array_relevantObjects_longitudinalDistanceToObjectValueType_available[@ACC_Notification_relevantObjects_Element] = @this;
  ACC_Notification_relevantObjects();
}
on envVar ACC_Notification_relevantObjects_lateralDistanceToObject_available
{
  ACC_array_relevantObjects_lateralDistanceToObject_available[@ACC_Notification_relevantObjects_Element] = @this;
  ACC_Notification_relevantObjects();
}
on envVar ACC_Notification_relevantObjects_lateralDistanceToObjectValueType_available
{
  ACC_array_relevantObjects_lateralDistanceToObjectValueType_available[@ACC_Notification_relevantObjects_Element] = @this;
  ACC_Notification_relevantObjects();
}
on envVar ACC_Notification_relevantObjects_Payload
{
  ACC_Notification_relevantObjects_update();
}


ACC_Notification_relevantObjects()
{
  word payload_counter = 0;
  word start_pos       = 0;
  word element_length  = 0;
  
  // Length Indicator Struct - Platzhalter
  payload_counter = 0+4;
  start_pos = 0;
  
  for (j=0; j<@ACC_Notification_relevantObjects_Element_TotalNum; j++)
  {
    ACC_array_relevantObjects_available_functions[j] = ACC_array_relevantObjects_type_available[j]
                                                     + ACC_array_relevantObjects_distanceToObject_available[j]
                                                     + ACC_array_relevantObjects_distanceToObjectValueType_available[j]
                                                     + ACC_array_relevantObjects_objectType_available[j]
                                                     + ACC_array_relevantObjects_videoID_available[j]
                                                     + ACC_array_relevantObjects_videoIDValueType_available[j]
                                                     + ACC_array_relevantObjects_longitudinalDistanceToObject_available[j]
                                                     + ACC_array_relevantObjects_longitudinalDistanceToObjectValueType_available[j]
                                                     + ACC_array_relevantObjects_lateralDistanceToObject_available[j]
                                                     + ACC_array_relevantObjects_lateralDistanceToObjectValueType_available[j];
    
    // Length Indicator Element - Platzhalter
    if (ACC_array_relevantObjects_available_functions[j] > 0)
    {
      start_pos = payload_counter;
      payload_counter = payload_counter + 4;
    }
    else 
      start_pos = payload_counter;
    
    
    // 0 type (enum32)
    if (ACC_array_relevantObjects_type_available[j] == 1)
    {
      tag_dataID = 0;
      ACC_payload_buffer_relevantObjects[payload_counter++] = 2 * 16 /* Wiretype = 2  =^ 32 Bit */ + ((tag_dataID>>8) & 0x0F) /* DataID High Part */ ;
      ACC_payload_buffer_relevantObjects[payload_counter++] = tag_dataID & 0xFF /* DataID Low Part */ ;
      
      ACC_payload_buffer_relevantObjects[payload_counter++] = ACC_array_relevantObjects_type[j]>>24 & 0xFF;
      ACC_payload_buffer_relevantObjects[payload_counter++] = ACC_array_relevantObjects_type[j]>>16 & 0xFF;
      ACC_payload_buffer_relevantObjects[payload_counter++] = ACC_array_relevantObjects_type[j]>> 8 & 0xFF;
      ACC_payload_buffer_relevantObjects[payload_counter++] = ACC_array_relevantObjects_type[j]     & 0xFF;
    }
    
    
    // 1 distanceToObject (float32)
    if (ACC_array_relevantObjects_distanceToObject_available[j] == 1)
    {
      tag_dataID = 1;
      ACC_payload_buffer_relevantObjects[payload_counter++] = 2 * 16 /* Wiretype = 2  =^ 32 Bit */ + ((tag_dataID>>8) & 0x0F) /* DataID High Part */ ;
      ACC_payload_buffer_relevantObjects[payload_counter++] = tag_dataID & 0xFF /* DataID Low Part */ ;
      
      temp_converttodword = interpretAsDword (ACC_array_relevantObjects_distanceToObject[j]);
      ACC_payload_buffer_relevantObjects[payload_counter++] = temp_converttodword>>24 & 0xFF;
      ACC_payload_buffer_relevantObjects[payload_counter++] = temp_converttodword>>16 & 0xFF;
      ACC_payload_buffer_relevantObjects[payload_counter++] = temp_converttodword>> 8 & 0xFF;
      ACC_payload_buffer_relevantObjects[payload_counter++] = temp_converttodword     & 0xFF;
    }
    
    
    // 2 distanceToObjectValueType (enum32)
    if (ACC_array_relevantObjects_distanceToObjectValueType_available[j] == 1)
    {
      tag_dataID = 2;
      ACC_payload_buffer_relevantObjects[payload_counter++] = 2 * 16 /* Wiretype = 2  =^ 32 Bit */ + ((tag_dataID>>8) & 0x0F) /* DataID High Part */ ;
      ACC_payload_buffer_relevantObjects[payload_counter++] = tag_dataID & 0xFF /* DataID Low Part */ ;
      
      ACC_payload_buffer_relevantObjects[payload_counter++] = ACC_array_relevantObjects_distanceToObjectValueType[j]>>24 & 0xFF;
      ACC_payload_buffer_relevantObjects[payload_counter++] = ACC_array_relevantObjects_distanceToObjectValueType[j]>>16 & 0xFF;
      ACC_payload_buffer_relevantObjects[payload_counter++] = ACC_array_relevantObjects_distanceToObjectValueType[j]>> 8 & 0xFF;
      ACC_payload_buffer_relevantObjects[payload_counter++] = ACC_array_relevantObjects_distanceToObjectValueType[j]     & 0xFF;
    }
    
    
    // 3 existiert nicht
    
    
    // 4 objectType (enum32)
    if (ACC_array_relevantObjects_objectType_available[j] == 1)
    {
      tag_dataID = 4;
      ACC_payload_buffer_relevantObjects[payload_counter++] = 2 * 16 /* Wiretype = 2  =^ 32 Bit */ + ((tag_dataID>>8) & 0x0F) /* DataID High Part */ ;
      ACC_payload_buffer_relevantObjects[payload_counter++] = tag_dataID & 0xFF /* DataID Low Part */ ;
      
      ACC_payload_buffer_relevantObjects[payload_counter++] = ACC_array_relevantObjects_objectType[j]>>24 & 0xFF;
      ACC_payload_buffer_relevantObjects[payload_counter++] = ACC_array_relevantObjects_objectType[j]>>16 & 0xFF;
      ACC_payload_buffer_relevantObjects[payload_counter++] = ACC_array_relevantObjects_objectType[j]>> 8 & 0xFF;
      ACC_payload_buffer_relevantObjects[payload_counter++] = ACC_array_relevantObjects_objectType[j]     & 0xFF;
    }
    
    
    // 5 videoID (uint32)
    if (ACC_array_relevantObjects_videoID_available[j] == 1)
    {
      tag_dataID = 5;
      ACC_payload_buffer_relevantObjects[payload_counter++] = 2 * 16 /* Wiretype = 2  =^ 32 Bit */ + ((tag_dataID>>8) & 0x0F) /* DataID High Part */ ;
      ACC_payload_buffer_relevantObjects[payload_counter++] = tag_dataID & 0xFF /* DataID Low Part */ ;
      
      ACC_payload_buffer_relevantObjects[payload_counter++] = ACC_array_relevantObjects_videoID[j]>>24 & 0xFF;
      ACC_payload_buffer_relevantObjects[payload_counter++] = ACC_array_relevantObjects_videoID[j]>>16 & 0xFF;
      ACC_payload_buffer_relevantObjects[payload_counter++] = ACC_array_relevantObjects_videoID[j]>> 8 & 0xFF;
      ACC_payload_buffer_relevantObjects[payload_counter++] = ACC_array_relevantObjects_videoID[j]     & 0xFF;
    }
    
    
    // 6 videoIDValueType (enum32)
    if (ACC_array_relevantObjects_videoIDValueType_available[j] == 1)
    {
      tag_dataID = 6;
      ACC_payload_buffer_relevantObjects[payload_counter++] = 2 * 16 /* Wiretype = 2  =^ 32 Bit */ + ((tag_dataID>>8) & 0x0F) /* DataID High Part */ ;
      ACC_payload_buffer_relevantObjects[payload_counter++] = tag_dataID & 0xFF /* DataID Low Part */ ;
      
      ACC_payload_buffer_relevantObjects[payload_counter++] = ACC_array_relevantObjects_videoIDValueType[j]>>24 & 0xFF;
      ACC_payload_buffer_relevantObjects[payload_counter++] = ACC_array_relevantObjects_videoIDValueType[j]>>16 & 0xFF;
      ACC_payload_buffer_relevantObjects[payload_counter++] = ACC_array_relevantObjects_videoIDValueType[j]>> 8 & 0xFF;
      ACC_payload_buffer_relevantObjects[payload_counter++] = ACC_array_relevantObjects_videoIDValueType[j]     & 0xFF;
    }
    
    
    // 7 longitudinalDistanceToObject (float32)
    if (ACC_array_relevantObjects_longitudinalDistanceToObject_available[j] == 1)
    {
      tag_dataID = 7;
      ACC_payload_buffer_relevantObjects[payload_counter++] = 2 * 16 /* Wiretype = 2  =^ 32 Bit */ + ((tag_dataID>>8) & 0x0F) /* DataID High Part */ ;
      ACC_payload_buffer_relevantObjects[payload_counter++] = tag_dataID & 0xFF /* DataID Low Part */ ;
      
      temp_converttodword = interpretAsDword (ACC_array_relevantObjects_longitudinalDistanceToObject[j]);
      ACC_payload_buffer_relevantObjects[payload_counter++] = temp_converttodword>>24 & 0xFF;
      ACC_payload_buffer_relevantObjects[payload_counter++] = temp_converttodword>>16 & 0xFF;
      ACC_payload_buffer_relevantObjects[payload_counter++] = temp_converttodword>> 8 & 0xFF;
      ACC_payload_buffer_relevantObjects[payload_counter++] = temp_converttodword     & 0xFF;
    }
    
    
    // 8 type (enum32)
    if (ACC_array_relevantObjects_type_available[j] == 1)
    {
      tag_dataID = 8;
      ACC_payload_buffer_relevantObjects[payload_counter++] = 2 * 16 /* Wiretype = 2  =^ 32 Bit */ + ((tag_dataID>>8) & 0x0F) /* DataID High Part */ ;
      ACC_payload_buffer_relevantObjects[payload_counter++] = tag_dataID & 0xFF /* DataID Low Part */ ;
      
      ACC_payload_buffer_relevantObjects[payload_counter++] = ACC_array_relevantObjects_longitudinalDistanceToObjectValueType[j]>>24 & 0xFF;
      ACC_payload_buffer_relevantObjects[payload_counter++] = ACC_array_relevantObjects_longitudinalDistanceToObjectValueType[j]>>16 & 0xFF;
      ACC_payload_buffer_relevantObjects[payload_counter++] = ACC_array_relevantObjects_longitudinalDistanceToObjectValueType[j]>> 8 & 0xFF;
      ACC_payload_buffer_relevantObjects[payload_counter++] = ACC_array_relevantObjects_longitudinalDistanceToObjectValueType[j]     & 0xFF;
    }
    
    
    // 9 lateralDistanceToObject (float32)
    if (ACC_array_relevantObjects_lateralDistanceToObject_available[j] == 1)
    {
      tag_dataID = 9;
      ACC_payload_buffer_relevantObjects[payload_counter++] = 2 * 16 /* Wiretype = 2  =^ 32 Bit */ + ((tag_dataID>>8) & 0x0F) /* DataID High Part */ ;
      ACC_payload_buffer_relevantObjects[payload_counter++] = tag_dataID & 0xFF /* DataID Low Part */ ;
      
      temp_converttodword = interpretAsDword (ACC_array_relevantObjects_lateralDistanceToObject[j]);
      ACC_payload_buffer_relevantObjects[payload_counter++] = temp_converttodword>>24 & 0xFF;
      ACC_payload_buffer_relevantObjects[payload_counter++] = temp_converttodword>>16 & 0xFF;
      ACC_payload_buffer_relevantObjects[payload_counter++] = temp_converttodword>> 8 & 0xFF;
      ACC_payload_buffer_relevantObjects[payload_counter++] = temp_converttodword     & 0xFF;
    }
    
    
    // 10 lateralDistanceToObjectValueType (enum32)
    if (ACC_array_relevantObjects_lateralDistanceToObjectValueType_available[j] == 1)
    {
      tag_dataID = 10;
      ACC_payload_buffer_relevantObjects[payload_counter++] = 2 * 16 /* Wiretype = 2  =^ 32 Bit */ + ((tag_dataID>>8) & 0x0F) /* DataID High Part */ ;
      ACC_payload_buffer_relevantObjects[payload_counter++] = tag_dataID & 0xFF /* DataID Low Part */ ;
      
      ACC_payload_buffer_relevantObjects[payload_counter++] = ACC_array_relevantObjects_lateralDistanceToObjectValueType[j]>>24 & 0xFF;
      ACC_payload_buffer_relevantObjects[payload_counter++] = ACC_array_relevantObjects_lateralDistanceToObjectValueType[j]>>16 & 0xFF;
      ACC_payload_buffer_relevantObjects[payload_counter++] = ACC_array_relevantObjects_lateralDistanceToObjectValueType[j]>> 8 & 0xFF;
      ACC_payload_buffer_relevantObjects[payload_counter++] = ACC_array_relevantObjects_lateralDistanceToObjectValueType[j]     & 0xFF;
    }
    
    
    //Element Length
    element_length = payload_counter-start_pos;
    if (element_length >0) ACC_array_relevantObjects_array_element_length[j] = element_length - 4;
    else                   ACC_array_relevantObjects_array_element_length[j] = element_length;
    
    ACC_payload_buffer_relevantObjects[start_pos++] = ACC_array_relevantObjects_array_element_length[j]>>24 & 0xFF;
    ACC_payload_buffer_relevantObjects[start_pos++] = ACC_array_relevantObjects_array_element_length[j]>>16 & 0xFF;
    ACC_payload_buffer_relevantObjects[start_pos++] = ACC_array_relevantObjects_array_element_length[j]>> 8 & 0xFF;
    ACC_payload_buffer_relevantObjects[start_pos++] = ACC_array_relevantObjects_array_element_length[j]     & 0xFF;
    
    if (ACC_array_relevantObjects_array_element_length[j] == 0) payload_counter = payload_counter+4;
  }
  
  // Struct Length
  ACC_array_relevantObjects_struct_element_length = 4*@ACC_Notification_relevantObjects_Element_TotalNum;

  for (k=0;k<@ACC_Notification_relevantObjects_Element_TotalNum;k++)
    ACC_array_relevantObjects_struct_element_length = ACC_array_relevantObjects_struct_element_length + ACC_array_relevantObjects_array_element_length[k];
  
  ACC_payload_buffer_relevantObjects[0] = ACC_array_relevantObjects_struct_element_length>>24 & 0xFF;
  ACC_payload_buffer_relevantObjects[1] = ACC_array_relevantObjects_struct_element_length>>16 & 0xFF;
  ACC_payload_buffer_relevantObjects[2] = ACC_array_relevantObjects_struct_element_length>> 8 & 0xFF;
  ACC_payload_buffer_relevantObjects[3] = ACC_array_relevantObjects_struct_element_length     & 0xFF;


  ACC_payload_length_relevantObjects = ACC_array_relevantObjects_struct_element_length+4;
  putvalue(ACC_Notification_relevantObjects_Payload, ACC_payload_buffer_relevantObjects, ACC_payload_length_relevantObjects);
}

on envVar ACC_Notification_relevantObjects_Element_TotalNum
{
  if (@this == 0) @this =  1;
  if (@this > 10) @this = 10;
  
  ACC_Notification_relevantObjects();
  ACC_Notification_relevantObjects_update();
}

on envVar ACC_Notification_relevantObjects_Element
{
  ACC_Notification_relevantObjects_update();
}

on envVar ACC_Notification_relevantObjects_Element_Next
{
  if (@this == 1 && @ACC_Notification_relevantObjects_Element < @ACC_Notification_relevantObjects_Element_TotalNum - 1)
  {
    @ACC_Notification_relevantObjects_Element = @ACC_Notification_relevantObjects_Element + 1;
    ACC_Notification_relevantObjects_update();
  }
}

on envVar ACC_Notification_relevantObjects_Element_Previous
{
  if (@this == 1 && @ACC_Notification_relevantObjects_Element > 0)
  {
    @ACC_Notification_relevantObjects_Element = @ACC_Notification_relevantObjects_Element - 1;
    ACC_Notification_relevantObjects_update();
  }
}

ACC_Notification_relevantObjects_update()
{
  @ACC_Notification_LengthIndicator_Element_relevantObjects = ACC_array_relevantObjects_array_element_length[@ACC_Notification_relevantObjects_Element];
  @ACC_Notification_LengthIndicator_Struct_relevantObjects  = ACC_array_relevantObjects_struct_element_length;
  @ACC_Notification_Length_relevantObjects                  = ACC_payload_length_relevantObjects+8;
  
  @ACC_Notification_relevantObjects_type                                  = ACC_array_relevantObjects_type[@ACC_Notification_relevantObjects_Element];
  @ACC_Notification_relevantObjects_distanceToObject                      = ACC_array_relevantObjects_distanceToObject[@ACC_Notification_relevantObjects_Element];
  @ACC_Notification_relevantObjects_distanceToObjectValueType             = ACC_array_relevantObjects_distanceToObjectValueType[@ACC_Notification_relevantObjects_Element];
  @ACC_Notification_relevantObjects_objectType                            = ACC_array_relevantObjects_objectType[@ACC_Notification_relevantObjects_Element];
  @ACC_Notification_relevantObjects_videoID                               = ACC_array_relevantObjects_videoID[@ACC_Notification_relevantObjects_Element];
  @ACC_Notification_relevantObjects_videoIDValueType                      = ACC_array_relevantObjects_videoIDValueType[@ACC_Notification_relevantObjects_Element];
  @ACC_Notification_relevantObjects_longitudinalDistanceToObject          = ACC_array_relevantObjects_longitudinalDistanceToObject[@ACC_Notification_relevantObjects_Element];
  @ACC_Notification_relevantObjects_longitudinalDistanceToObjectValueType = ACC_array_relevantObjects_longitudinalDistanceToObjectValueType[@ACC_Notification_relevantObjects_Element];
  @ACC_Notification_relevantObjects_lateralDistanceToObject               = ACC_array_relevantObjects_lateralDistanceToObject[@ACC_Notification_relevantObjects_Element];
  @ACC_Notification_relevantObjects_lateralDistanceToObjectValueType      = ACC_array_relevantObjects_lateralDistanceToObjectValueType[@ACC_Notification_relevantObjects_Element];
  
  @ACC_Notification_relevantObjects_type_available                                  = ACC_array_relevantObjects_type_available[@ACC_Notification_relevantObjects_Element];
  @ACC_Notification_relevantObjects_distanceToObject_available                      = ACC_array_relevantObjects_distanceToObject_available[@ACC_Notification_relevantObjects_Element];
  @ACC_Notification_relevantObjects_distanceToObjectValueType_available             = ACC_array_relevantObjects_distanceToObjectValueType_available[@ACC_Notification_relevantObjects_Element];
  @ACC_Notification_relevantObjects_objectType_available                            = ACC_array_relevantObjects_objectType_available[@ACC_Notification_relevantObjects_Element];
  @ACC_Notification_relevantObjects_videoID_available                               = ACC_array_relevantObjects_videoID_available[@ACC_Notification_relevantObjects_Element];
  @ACC_Notification_relevantObjects_videoIDValueType_available                      = ACC_array_relevantObjects_videoIDValueType_available[@ACC_Notification_relevantObjects_Element];
  @ACC_Notification_relevantObjects_longitudinalDistanceToObject_available          = ACC_array_relevantObjects_longitudinalDistanceToObject_available[@ACC_Notification_relevantObjects_Element];
  @ACC_Notification_relevantObjects_longitudinalDistanceToObjectValueType_available = ACC_array_relevantObjects_longitudinalDistanceToObjectValueType_available[@ACC_Notification_relevantObjects_Element];
  @ACC_Notification_relevantObjects_lateralDistanceToObject_available               = ACC_array_relevantObjects_lateralDistanceToObject_available[@ACC_Notification_relevantObjects_Element];
  @ACC_Notification_relevantObjects_lateralDistanceToObjectValueType_available      = ACC_array_relevantObjects_lateralDistanceToObjectValueType_available[@ACC_Notification_relevantObjects_Element];
}








////////// targetDistances Notification //////////

on envVar ACC_Notification_LengthIndicator_Struct_targetDistances
{
  ACC_Notification_targetDistances();
}
on envVar ACC_Notification_LengthIndicator_Element_targetDistances
{
  ACC_Notification_targetDistances();
}
on envVar ACC_Notification_targetDistances_type
{
  ACC_array_targetDistances_type[@ACC_Notification_targetDistances_Element] = @this;
  ACC_Notification_targetDistances();
}
on envVar ACC_Notification_targetDistances_distancePhysicalValue
{
  ACC_array_targetDistances_distancePhysicalValue[@ACC_Notification_targetDistances_Element] = @this;
  ACC_Notification_targetDistances();
}
on envVar ACC_Notification_targetDistances_distanceValueType
{
  ACC_array_targetDistances_distanceValueType[@ACC_Notification_targetDistances_Element] = @this;
  ACC_Notification_targetDistances();
}
on envVar ACC_Notification_targetDistances_setTimeGap
{
  ACC_array_targetDistances_setTimeGap[@ACC_Notification_targetDistances_Element] = @this;
  ACC_Notification_targetDistances();
}
on envVar ACC_Notification_targetDistances_displayTimeGap
{
  ACC_array_targetDistances_displayTimeGap[@ACC_Notification_targetDistances_Element] = @this;
  ACC_Notification_targetDistances();
}
on envVar ACC_Notification_targetDistances_type_available
{
  ACC_array_targetDistances_type_available[@ACC_Notification_targetDistances_Element] = @this;
  ACC_Notification_targetDistances();
}
on envVar ACC_Notification_targetDistances_distancePhysicalValue_available
{
  ACC_array_targetDistances_distancePhysicalValue_available[@ACC_Notification_targetDistances_Element] = @this;
  ACC_Notification_targetDistances();
}
on envVar ACC_Notification_targetDistances_distanceValueType_available
{
  ACC_array_targetDistances_distanceValueType_available[@ACC_Notification_targetDistances_Element] = @this;
  ACC_Notification_targetDistances();
}
on envVar ACC_Notification_targetDistances_setTimeGap_available
{
  ACC_array_targetDistances_setTimeGap_available[@ACC_Notification_targetDistances_Element] = @this;
  ACC_Notification_targetDistances();
}
on envVar ACC_Notification_targetDistances_displayTimeGap_available
{
  ACC_array_targetDistances_displayTimeGap_available[@ACC_Notification_targetDistances_Element] = @this;
  ACC_Notification_targetDistances();
}
on envVar ACC_Notification_targetDistances_Payload
{
  ACC_Notification_targetDistances_update();
}


ACC_Notification_targetDistances()
{
  word payload_counter = 0;
  word start_pos       = 0;
  word element_length  = 0;
  
  // Length Indicator Struct - Platzhalter
  payload_counter = 0+4;
  start_pos = 0;
  
  for (j=0; j<@ACC_Notification_targetDistances_Element_TotalNum; j++)
  {
    ACC_array_targetDistances_available_functions[j] = ACC_array_targetDistances_type_available[j]
                                                     + ACC_array_targetDistances_distancePhysicalValue_available[j]
                                                     + ACC_array_targetDistances_distanceValueType_available[j]
                                                     + ACC_array_targetDistances_setTimeGap_available[j]
                                                     + ACC_array_targetDistances_displayTimeGap_available[j];
    
    // Length Indicator Element - Platzhalter
    if (ACC_array_targetDistances_available_functions[j] > 0)
    {
      start_pos = payload_counter;
      payload_counter = payload_counter + 4;
    }
    else 
      start_pos = payload_counter;
    
    
    // 0 type (enum32)
    if (ACC_array_targetDistances_type_available[j] == 1)
    {
      tag_dataID = 0;
      ACC_payload_buffer_targetDistances[payload_counter++] = 2 * 16 /* Wiretype = 2  =^ 32 Bit */ + ((tag_dataID>>8) & 0x0F) /* DataID High Part */ ;
      ACC_payload_buffer_targetDistances[payload_counter++] = tag_dataID & 0xFF /* DataID Low Part */ ;
      
      ACC_payload_buffer_targetDistances[payload_counter++] = ACC_array_targetDistances_type[j]>>24 & 0xFF;
      ACC_payload_buffer_targetDistances[payload_counter++] = ACC_array_targetDistances_type[j]>>16 & 0xFF;
      ACC_payload_buffer_targetDistances[payload_counter++] = ACC_array_targetDistances_type[j]>> 8 & 0xFF;
      ACC_payload_buffer_targetDistances[payload_counter++] = ACC_array_targetDistances_type[j]     & 0xFF;
    }
    
    
    // 1 distancePhysicalValue (float32)
    if (ACC_array_targetDistances_distancePhysicalValue_available[j] == 1)
    {
      tag_dataID = 1;
      ACC_payload_buffer_targetDistances[payload_counter++] = 2 * 16 /* Wiretype = 2  =^ 32 Bit */ + ((tag_dataID>>8) & 0x0F) /* DataID High Part */ ;
      ACC_payload_buffer_targetDistances[payload_counter++] = tag_dataID & 0xFF /* DataID Low Part */ ;
      
      temp_converttodword = interpretAsDword (ACC_array_targetDistances_distancePhysicalValue[j]);
      ACC_payload_buffer_targetDistances[payload_counter++] = temp_converttodword>>24 & 0xFF;
      ACC_payload_buffer_targetDistances[payload_counter++] = temp_converttodword>>16 & 0xFF;
      ACC_payload_buffer_targetDistances[payload_counter++] = temp_converttodword>> 8 & 0xFF;
      ACC_payload_buffer_targetDistances[payload_counter++] = temp_converttodword     & 0xFF;
    }
    
    
    // 2 distanceValueType (enum32)
    if (ACC_array_targetDistances_distanceValueType_available[j] == 1)
    {
      tag_dataID = 2;
      ACC_payload_buffer_targetDistances[payload_counter++] = 2 * 16 /* Wiretype = 2  =^ 32 Bit */ + ((tag_dataID>>8) & 0x0F) /* DataID High Part */ ;
      ACC_payload_buffer_targetDistances[payload_counter++] = tag_dataID & 0xFF /* DataID Low Part */ ;
      
      ACC_payload_buffer_targetDistances[payload_counter++] = ACC_array_targetDistances_distanceValueType[j]>>24 & 0xFF;
      ACC_payload_buffer_targetDistances[payload_counter++] = ACC_array_targetDistances_distanceValueType[j]>>16 & 0xFF;
      ACC_payload_buffer_targetDistances[payload_counter++] = ACC_array_targetDistances_distanceValueType[j]>> 8 & 0xFF;
      ACC_payload_buffer_targetDistances[payload_counter++] = ACC_array_targetDistances_distanceValueType[j]     & 0xFF;
    }
    
    
    // 3 setTimeGap (enum32)
    if (ACC_array_targetDistances_setTimeGap_available[j] == 1)
    {
      tag_dataID = 3;
      ACC_payload_buffer_targetDistances[payload_counter++] = 2 * 16 /* Wiretype = 2  =^ 32 Bit */ + ((tag_dataID>>8) & 0x0F) /* DataID High Part */ ;
      ACC_payload_buffer_targetDistances[payload_counter++] = tag_dataID & 0xFF /* DataID Low Part */ ;
      
      ACC_payload_buffer_targetDistances[payload_counter++] = ACC_array_targetDistances_setTimeGap[j]>>24 & 0xFF;
      ACC_payload_buffer_targetDistances[payload_counter++] = ACC_array_targetDistances_setTimeGap[j]>>16 & 0xFF;
      ACC_payload_buffer_targetDistances[payload_counter++] = ACC_array_targetDistances_setTimeGap[j]>> 8 & 0xFF;
      ACC_payload_buffer_targetDistances[payload_counter++] = ACC_array_targetDistances_setTimeGap[j]     & 0xFF;
    }
    
    
    // 4 displayTimeGap (enum32)
    if (ACC_array_targetDistances_displayTimeGap_available[j] == 1)
    {
      tag_dataID = 4;
      ACC_payload_buffer_targetDistances[payload_counter++] = 2 * 16 /* Wiretype = 2  =^ 32 Bit */ + ((tag_dataID>>8) & 0x0F) /* DataID High Part */ ;
      ACC_payload_buffer_targetDistances[payload_counter++] = tag_dataID & 0xFF /* DataID Low Part */ ;
      
      ACC_payload_buffer_targetDistances[payload_counter++] = ACC_array_targetDistances_displayTimeGap[j]>>24 & 0xFF;
      ACC_payload_buffer_targetDistances[payload_counter++] = ACC_array_targetDistances_displayTimeGap[j]>>16 & 0xFF;
      ACC_payload_buffer_targetDistances[payload_counter++] = ACC_array_targetDistances_displayTimeGap[j]>> 8 & 0xFF;
      ACC_payload_buffer_targetDistances[payload_counter++] = ACC_array_targetDistances_displayTimeGap[j]     & 0xFF;
    }
    
    
    //Element Length
    element_length = payload_counter-start_pos;
    if (element_length >0) ACC_array_targetDistances_array_element_length[j] = element_length - 4;
    else                   ACC_array_targetDistances_array_element_length[j] = element_length;
    
    ACC_payload_buffer_targetDistances[start_pos++] = ACC_array_targetDistances_array_element_length[j]>>24 & 0xFF;
    ACC_payload_buffer_targetDistances[start_pos++] = ACC_array_targetDistances_array_element_length[j]>>16 & 0xFF;
    ACC_payload_buffer_targetDistances[start_pos++] = ACC_array_targetDistances_array_element_length[j]>> 8 & 0xFF;
    ACC_payload_buffer_targetDistances[start_pos++] = ACC_array_targetDistances_array_element_length[j]     & 0xFF;
    
    if (ACC_array_targetDistances_array_element_length[j] == 0) payload_counter = payload_counter+4;
  }
  
  // Struct Length
  ACC_array_targetDistances_struct_element_length = 4*@ACC_Notification_targetDistances_Element_TotalNum;

  for (k=0;k<@ACC_Notification_targetDistances_Element_TotalNum;k++)
    ACC_array_targetDistances_struct_element_length = ACC_array_targetDistances_struct_element_length + ACC_array_targetDistances_array_element_length[k];
  
  ACC_payload_buffer_targetDistances[0] = ACC_array_targetDistances_struct_element_length>>24 & 0xFF;
  ACC_payload_buffer_targetDistances[1] = ACC_array_targetDistances_struct_element_length>>16 & 0xFF;
  ACC_payload_buffer_targetDistances[2] = ACC_array_targetDistances_struct_element_length>> 8 & 0xFF;
  ACC_payload_buffer_targetDistances[3] = ACC_array_targetDistances_struct_element_length     & 0xFF;


  ACC_payload_length_targetDistances = ACC_array_targetDistances_struct_element_length+4;
  putvalue(ACC_Notification_targetDistances_Payload, ACC_payload_buffer_targetDistances, ACC_payload_length_targetDistances);
}

on envVar ACC_Notification_targetDistances_Element_TotalNum
{
  if (@this == 0) @this =  1;
  if (@this > 10) @this = 10;
  
  ACC_Notification_targetDistances();
  ACC_Notification_targetDistances_update();
}

on envVar ACC_Notification_targetDistances_Element
{
  ACC_Notification_targetDistances_update();
}

on envVar ACC_Notification_targetDistances_Element_Next
{
  if (@this == 1 && @ACC_Notification_targetDistances_Element < @ACC_Notification_targetDistances_Element_TotalNum - 1)
  {
    @ACC_Notification_targetDistances_Element = @ACC_Notification_targetDistances_Element + 1;
    ACC_Notification_targetDistances_update();
  }
}

on envVar ACC_Notification_targetDistances_Element_Previous
{
  if (@this == 1 && @ACC_Notification_targetDistances_Element > 0)
  {
    @ACC_Notification_targetDistances_Element = @ACC_Notification_targetDistances_Element - 1;
    ACC_Notification_targetDistances_update();
  }
}

ACC_Notification_targetDistances_update()
{
  @ACC_Notification_LengthIndicator_Element_targetDistances = ACC_array_targetDistances_array_element_length[@ACC_Notification_targetDistances_Element];
  @ACC_Notification_LengthIndicator_Struct_targetDistances  = ACC_array_targetDistances_struct_element_length;
  @ACC_Notification_Length_targetDistances                  = ACC_payload_length_targetDistances+8;
  
  @ACC_Notification_targetDistances_type                  = ACC_array_targetDistances_type[@ACC_Notification_targetDistances_Element];
  @ACC_Notification_targetDistances_distancePhysicalValue = ACC_array_targetDistances_distancePhysicalValue[@ACC_Notification_targetDistances_Element];
  @ACC_Notification_targetDistances_distanceValueType     = ACC_array_targetDistances_distanceValueType[@ACC_Notification_targetDistances_Element];
  @ACC_Notification_targetDistances_setTimeGap            = ACC_array_targetDistances_setTimeGap[@ACC_Notification_targetDistances_Element];
  @ACC_Notification_targetDistances_displayTimeGap        = ACC_array_targetDistances_displayTimeGap[@ACC_Notification_targetDistances_Element];
  
  @ACC_Notification_targetDistances_type_available                  = ACC_array_targetDistances_type_available[@ACC_Notification_targetDistances_Element];
  @ACC_Notification_targetDistances_distancePhysicalValue_available = ACC_array_targetDistances_distancePhysicalValue_available[@ACC_Notification_targetDistances_Element];
  @ACC_Notification_targetDistances_distanceValueType_available     = ACC_array_targetDistances_distanceValueType_available[@ACC_Notification_targetDistances_Element];
  @ACC_Notification_targetDistances_setTimeGap_available            = ACC_array_targetDistances_setTimeGap_available[@ACC_Notification_targetDistances_Element];
  @ACC_Notification_targetDistances_displayTimeGap_available        = ACC_array_targetDistances_displayTimeGap_available[@ACC_Notification_targetDistances_Element];
}








////////// velocities Notification //////////

on envVar ACC_Notification_LengthIndicator_Struct_velocities
{
  ACC_Notification_velocities();
}
on envVar ACC_Notification_LengthIndicator_Element_velocities
{
  ACC_Notification_velocities();
}
on envVar ACC_Notification_velocities_type
{
  ACC_array_velocities_type[@ACC_Notification_velocities_Element] = @this;
  ACC_Notification_velocities();
}
on envVar ACC_Notification_velocities_velocityPhysicalValue
{
  ACC_array_velocities_velocityPhysicalValue[@ACC_Notification_velocities_Element] = @this;
  ACC_Notification_velocities();
}
on envVar ACC_Notification_velocities_velocityValueType
{
  ACC_array_velocities_velocityValueType[@ACC_Notification_velocities_Element] = @this;
  ACC_Notification_velocities();
}
on envVar ACC_Notification_velocities_type_available
{
  ACC_array_velocities_type_available[@ACC_Notification_velocities_Element] = @this;
  ACC_Notification_velocities();
}
on envVar ACC_Notification_velocities_velocityPhysicalValue_available
{
  ACC_array_velocities_velocityPhysicalValue_available[@ACC_Notification_velocities_Element] = @this;
  ACC_Notification_velocities();
}
on envVar ACC_Notification_velocities_velocityValueType_available
{
  ACC_array_velocities_velocityValueType_available[@ACC_Notification_velocities_Element] = @this;
  ACC_Notification_velocities();
}
on envVar ACC_Notification_velocities_Payload
{
  ACC_Notification_velocities_update();
}


ACC_Notification_velocities()
{
  word payload_counter = 0;
  word start_pos       = 0;
  word element_length  = 0;
  
  // Length Indicator Struct - Platzhalter
  payload_counter = 0+4;
  start_pos = 0;
  
  for (j=0; j<@ACC_Notification_velocities_Element_TotalNum; j++)
  {
    ACC_array_velocities_available_functions[j] = ACC_array_velocities_type_available[j]
                                                + ACC_array_velocities_velocityPhysicalValue_available[j]
                                                + ACC_array_velocities_velocityValueType_available[j];
    
    // Length Indicator Element - Platzhalter
    if (ACC_array_velocities_available_functions[j] > 0)
    {
      start_pos = payload_counter;
      payload_counter = payload_counter + 4;
    }
    else 
      start_pos = payload_counter;
    
    // 0 type (enum32)
    if (ACC_array_velocities_type_available[j] == 1)
    {
      tag_dataID = 0;
      ACC_payload_buffer_velocities[payload_counter++] = 2 * 16 /* Wiretype = 2  =^ 32 Bit */ + ((tag_dataID>>8) & 0x0F) /* DataID High Part */ ;
      ACC_payload_buffer_velocities[payload_counter++] = tag_dataID & 0xFF /* DataID Low Part */ ;
      
      ACC_payload_buffer_velocities[payload_counter++] = ACC_array_velocities_type[j]>>24 & 0xFF;
      ACC_payload_buffer_velocities[payload_counter++] = ACC_array_velocities_type[j]>>16 & 0xFF;
      ACC_payload_buffer_velocities[payload_counter++] = ACC_array_velocities_type[j]>> 8 & 0xFF;
      ACC_payload_buffer_velocities[payload_counter++] = ACC_array_velocities_type[j]     & 0xFF;
    }
    
    
    // 1 velocityPhysicalValue (float32)
    if (ACC_array_velocities_velocityPhysicalValue_available[j] == 1)
    {
      tag_dataID = 1;
      ACC_payload_buffer_velocities[payload_counter++] = 2 * 16 /* Wiretype = 2  =^ 32 Bit */ + ((tag_dataID>>8) & 0x0F) /* DataID High Part */ ;
      ACC_payload_buffer_velocities[payload_counter++] = tag_dataID & 0xFF /* DataID Low Part */ ;
      
      temp_converttodword = interpretAsDword (ACC_array_velocities_velocityPhysicalValue[j]);
      ACC_payload_buffer_velocities[payload_counter++] = temp_converttodword>>24 & 0xFF;
      ACC_payload_buffer_velocities[payload_counter++] = temp_converttodword>>16 & 0xFF;
      ACC_payload_buffer_velocities[payload_counter++] = temp_converttodword>> 8 & 0xFF;
      ACC_payload_buffer_velocities[payload_counter++] = temp_converttodword     & 0xFF;
    }
    
    
    // 2 velocityValueType (enum32)
    if (ACC_array_velocities_velocityValueType_available[j] == 1)
    {
      tag_dataID = 2;
      ACC_payload_buffer_velocities[payload_counter++] = 2 * 16 /* Wiretype = 2  =^ 32 Bit */ + ((tag_dataID>>8) & 0x0F) /* DataID High Part */ ;
      ACC_payload_buffer_velocities[payload_counter++] = tag_dataID & 0xFF /* DataID Low Part */ ;
      
      ACC_payload_buffer_velocities[payload_counter++] = ACC_array_velocities_velocityValueType[j]>>24 & 0xFF;
      ACC_payload_buffer_velocities[payload_counter++] = ACC_array_velocities_velocityValueType[j]>>16 & 0xFF;
      ACC_payload_buffer_velocities[payload_counter++] = ACC_array_velocities_velocityValueType[j]>> 8 & 0xFF;
      ACC_payload_buffer_velocities[payload_counter++] = ACC_array_velocities_velocityValueType[j]     & 0xFF;
    }
    
    
    //Element Length
    element_length = payload_counter-start_pos;
    if (element_length >0) ACC_array_velocities_array_element_length[j] = element_length - 4;
    else                   ACC_array_velocities_array_element_length[j] = element_length;
    
    ACC_payload_buffer_velocities[start_pos++] = ACC_array_velocities_array_element_length[j]>>24 & 0xFF;
    ACC_payload_buffer_velocities[start_pos++] = ACC_array_velocities_array_element_length[j]>>16 & 0xFF;
    ACC_payload_buffer_velocities[start_pos++] = ACC_array_velocities_array_element_length[j]>> 8 & 0xFF;
    ACC_payload_buffer_velocities[start_pos++] = ACC_array_velocities_array_element_length[j]     & 0xFF;
    
    if (ACC_array_velocities_array_element_length[j] == 0) payload_counter = payload_counter+4;
  }
  
  // Struct Length
  ACC_array_velocities_struct_element_length = 4*@ACC_Notification_velocities_Element_TotalNum;

  for (k=0;k<@ACC_Notification_velocities_Element_TotalNum;k++)
    ACC_array_velocities_struct_element_length = ACC_array_velocities_struct_element_length + ACC_array_velocities_array_element_length[k];
  
  ACC_payload_buffer_velocities[0] = ACC_array_velocities_struct_element_length>>24 & 0xFF;
  ACC_payload_buffer_velocities[1] = ACC_array_velocities_struct_element_length>>16 & 0xFF;
  ACC_payload_buffer_velocities[2] = ACC_array_velocities_struct_element_length>> 8 & 0xFF;
  ACC_payload_buffer_velocities[3] = ACC_array_velocities_struct_element_length     & 0xFF;


  ACC_payload_length_velocities = ACC_array_velocities_struct_element_length+4;
  putvalue(ACC_Notification_velocities_Payload, ACC_payload_buffer_velocities, ACC_payload_length_velocities);
}

on envVar ACC_Notification_velocities_Element_TotalNum
{
  if (@this == 0) @this =  1;
  if (@this > 10) @this = 10;
  
  ACC_Notification_velocities();
  ACC_Notification_velocities_update();
}

on envVar ACC_Notification_velocities_Element
{
  ACC_Notification_velocities_update();
}

on envVar ACC_Notification_velocities_Element_Next
{
  if (@this == 1 && @ACC_Notification_velocities_Element < @ACC_Notification_velocities_Element_TotalNum - 1)
  {
    @ACC_Notification_velocities_Element = @ACC_Notification_velocities_Element + 1;
    ACC_Notification_velocities_update();
  }
}

on envVar ACC_Notification_velocities_Element_Previous
{
  if (@this == 1 && @ACC_Notification_velocities_Element > 0)
  {
    @ACC_Notification_velocities_Element = @ACC_Notification_velocities_Element - 1;
    ACC_Notification_velocities_update();
  }
}

ACC_Notification_velocities_update()
{
  @ACC_Notification_LengthIndicator_Element_velocities = ACC_array_velocities_array_element_length[@ACC_Notification_velocities_Element];
  @ACC_Notification_LengthIndicator_Struct_velocities  = ACC_array_velocities_struct_element_length;
  @ACC_Notification_Length_velocities                  = ACC_payload_length_velocities+8;
  
  @ACC_Notification_velocities_type                  = ACC_array_velocities_type[@ACC_Notification_velocities_Element];
  @ACC_Notification_velocities_velocityPhysicalValue = ACC_array_velocities_velocityPhysicalValue[@ACC_Notification_velocities_Element];
  @ACC_Notification_velocities_velocityValueType     = ACC_array_velocities_velocityValueType[@ACC_Notification_velocities_Element];
  
  @ACC_Notification_velocities_type_available                  = ACC_array_velocities_type_available[@ACC_Notification_velocities_Element];
  @ACC_Notification_velocities_velocityPhysicalValue_available = ACC_array_velocities_velocityPhysicalValue_available[@ACC_Notification_velocities_Element];
  @ACC_Notification_velocities_velocityValueType_available     = ACC_array_velocities_velocityValueType_available[@ACC_Notification_velocities_Element];
}







////////// additionalInformation Notification //////////

on envVar ACC_Notification_LengthIndicator_Struct_additionalInformation
{
  ACC_Notification_additionalInformation();
}
on envVar ACC_Notification_LengthIndicator_Element_additionalInformation
{
  ACC_Notification_additionalInformation();
}
on envVar ACC_Notification_additionalInformation_elementId
{
  ACC_array_additionalInformation_elementId[@ACC_Notification_additionalInformation_Element] = @this;
  ACC_Notification_additionalInformation();
}
on envVar ACC_Notification_additionalInformation_acaDisplayStatus
{
  ACC_array_additionalInformation_acaDisplayStatus[@ACC_Notification_additionalInformation_Element] = @this;
  ACC_Notification_additionalInformation();
}
on envVar ACC_Notification_additionalInformation_additionalDisplayObject
{
  ACC_array_additionalInformation_additionalDisplayObject[@ACC_Notification_additionalInformation_Element] = @this;
  ACC_Notification_additionalInformation();
}
on envVar ACC_Notification_additionalInformation_coloredStatusIcon
{
  ACC_array_additionalInformation_coloredStatusIcon[@ACC_Notification_additionalInformation_Element] = @this;
  ACC_Notification_additionalInformation();
}
on envVar ACC_Notification_additionalInformation_coloredRelevantObject
{
  ACC_array_additionalInformation_coloredRelevantObject[@ACC_Notification_additionalInformation_Element] = @this;
  ACC_Notification_additionalInformation();
}
on envVar ACC_Notification_additionalInformation_unitTempolimit
{
  ACC_array_additionalInformation_unitTempolimit[@ACC_Notification_additionalInformation_Element] = @this;
  ACC_Notification_additionalInformation();
}
on envVar ACC_Notification_additionalInformation_displayLightSpeedometerType
{
  ACC_array_additionalInformation_displayLightSpeedometerType[@ACC_Notification_additionalInformation_Element] = @this;
  ACC_Notification_additionalInformation();
}
on envVar ACC_Notification_additionalInformation_displayLightSpeedometerStatus
{
  ACC_array_additionalInformation_displayLightSpeedometerStatus[@ACC_Notification_additionalInformation_Element] = @this;
  ACC_Notification_additionalInformation();
}
on envVar ACC_Notification_additionalInformation_configuredVelocityColor
{
  ACC_array_additionalInformation_configuredVelocityColor[@ACC_Notification_additionalInformation_Element] = @this;
  ACC_Notification_additionalInformation();
}
on envVar ACC_Notification_additionalInformation_elementId_available
{
  ACC_array_additionalInformation_elementId_available[@ACC_Notification_additionalInformation_Element] = @this;
  ACC_Notification_additionalInformation();
}
on envVar ACC_Notification_additionalInformation_acaDisplayStatus_available
{
  ACC_array_additionalInformation_acaDisplayStatus_available[@ACC_Notification_additionalInformation_Element] = @this;
  ACC_Notification_additionalInformation();
}
on envVar ACC_Notification_additionalInformation_additionalDisplayObject_available
{
  ACC_array_additionalInformation_additionalDisplayObject_available[@ACC_Notification_additionalInformation_Element] = @this;
  ACC_Notification_additionalInformation();
}
on envVar ACC_Notification_additionalInformation_coloredStatusIcon_available
{
  ACC_array_additionalInformation_coloredStatusIcon_available[@ACC_Notification_additionalInformation_Element] = @this;
  ACC_Notification_additionalInformation();
}
on envVar ACC_Notification_additionalInformation_coloredRelevantObject_available
{
  ACC_array_additionalInformation_coloredRelevantObject_available[@ACC_Notification_additionalInformation_Element] = @this;
  ACC_Notification_additionalInformation();
}
on envVar ACC_Notification_additionalInformation_unitTempolimit_available
{
  ACC_array_additionalInformation_unitTempolimit_available[@ACC_Notification_additionalInformation_Element] = @this;
  ACC_Notification_additionalInformation();
}
on envVar ACC_Notification_additionalInformation_displayLightSpeedometerType_available
{
  ACC_array_additionalInformation_displayLightSpeedometerType_available[@ACC_Notification_additionalInformation_Element] = @this;
  ACC_Notification_additionalInformation();
}
on envVar ACC_Notification_additionalInformation_displayLightSpeedometerStatus_available
{
  ACC_array_additionalInformation_displayLightSpeedometerStatus_available[@ACC_Notification_additionalInformation_Element] = @this;
  ACC_Notification_additionalInformation();
}
on envVar ACC_Notification_additionalInformation_configuredVelocityColor_available
{
  ACC_array_additionalInformation_configuredVelocityColor_available[@ACC_Notification_additionalInformation_Element] = @this;
  ACC_Notification_additionalInformation();
}
on envVar ACC_Notification_additionalInformation_Payload
{
  ACC_Notification_additionalInformation_update();
}


ACC_Notification_additionalInformation()
{
  word payload_counter = 0;
  word start_pos       = 0;
  word element_length  = 0;
  
  // Length Indicator Struct - Platzhalter
  payload_counter = 0+4;
  start_pos = 0;
  
  for (j=0; j<@ACC_Notification_additionalInformation_Element_TotalNum; j++)
  {
    ACC_array_additionalInformation_available_functions[j] = ACC_array_additionalInformation_elementId_available[j]
                                                           + ACC_array_additionalInformation_acaDisplayStatus_available[j]
                                                           + ACC_array_additionalInformation_additionalDisplayObject_available[j]
                                                           + ACC_array_additionalInformation_coloredStatusIcon_available[j]
                                                           + ACC_array_additionalInformation_coloredRelevantObject_available[j]
                                                           + ACC_array_additionalInformation_unitTempolimit_available[j]
                                                           + ACC_array_additionalInformation_displayLightSpeedometerType_available[j]
                                                           + ACC_array_additionalInformation_displayLightSpeedometerStatus_available[j]
                                                           + ACC_array_additionalInformation_configuredVelocityColor_available[j];
    
    // Length Indicator Element - Platzhalter
    if (ACC_array_additionalInformation_available_functions[j] > 0)
    {
      start_pos = payload_counter;
      payload_counter = payload_counter + 4;
    }
    else 
      start_pos = payload_counter;
    
    
    // 0 elementId (uint32)
    if (ACC_array_additionalInformation_elementId_available[j] == 1)
    {
      tag_dataID = 0;
      ACC_payload_buffer_additionalInformation[payload_counter++] = 2 * 16 /* Wiretype = 2  =^ 32 Bit */ + ((tag_dataID>>8) & 0x0F) /* DataID High Part */ ;
      ACC_payload_buffer_additionalInformation[payload_counter++] = tag_dataID & 0xFF /* DataID Low Part */ ;
      
      ACC_payload_buffer_additionalInformation[payload_counter++] = ACC_array_additionalInformation_elementId[j]>>24 & 0xFF;
      ACC_payload_buffer_additionalInformation[payload_counter++] = ACC_array_additionalInformation_elementId[j]>>16 & 0xFF;
      ACC_payload_buffer_additionalInformation[payload_counter++] = ACC_array_additionalInformation_elementId[j]>> 8 & 0xFF;
      ACC_payload_buffer_additionalInformation[payload_counter++] = ACC_array_additionalInformation_elementId[j]     & 0xFF;
    }
    
    
    // 1 acaDisplayStatus (enum32)
    if (ACC_array_additionalInformation_acaDisplayStatus_available[j] == 1)
    {
      tag_dataID = 1;
      ACC_payload_buffer_additionalInformation[payload_counter++] = 2 * 16 /* Wiretype = 2  =^ 32 Bit */ + ((tag_dataID>>8) & 0x0F) /* DataID High Part */ ;
      ACC_payload_buffer_additionalInformation[payload_counter++] = tag_dataID & 0xFF /* DataID Low Part */ ;
      
      ACC_payload_buffer_additionalInformation[payload_counter++] = ACC_array_additionalInformation_acaDisplayStatus[j]>>24 & 0xFF;
      ACC_payload_buffer_additionalInformation[payload_counter++] = ACC_array_additionalInformation_acaDisplayStatus[j]>>16 & 0xFF;
      ACC_payload_buffer_additionalInformation[payload_counter++] = ACC_array_additionalInformation_acaDisplayStatus[j]>> 8 & 0xFF;
      ACC_payload_buffer_additionalInformation[payload_counter++] = ACC_array_additionalInformation_acaDisplayStatus[j]     & 0xFF;
    }
    
    
    // 2 additionalDisplayObject (enum32)
    if (ACC_array_additionalInformation_additionalDisplayObject_available[j] == 1)
    {
      tag_dataID = 2;
      ACC_payload_buffer_additionalInformation[payload_counter++] = 2 * 16 /* Wiretype = 2  =^ 32 Bit */ + ((tag_dataID>>8) & 0x0F) /* DataID High Part */ ;
      ACC_payload_buffer_additionalInformation[payload_counter++] = tag_dataID & 0xFF /* DataID Low Part */ ;
      
      ACC_payload_buffer_additionalInformation[payload_counter++] = ACC_array_additionalInformation_additionalDisplayObject[j]>>24 & 0xFF;
      ACC_payload_buffer_additionalInformation[payload_counter++] = ACC_array_additionalInformation_additionalDisplayObject[j]>>16 & 0xFF;
      ACC_payload_buffer_additionalInformation[payload_counter++] = ACC_array_additionalInformation_additionalDisplayObject[j]>> 8 & 0xFF;
      ACC_payload_buffer_additionalInformation[payload_counter++] = ACC_array_additionalInformation_additionalDisplayObject[j]     & 0xFF;
    }
    
    
    // 3 coloredStatusIcon (enum32)
    if (ACC_array_additionalInformation_coloredStatusIcon_available[j] == 1)
    {
      tag_dataID = 3;
      ACC_payload_buffer_additionalInformation[payload_counter++] = 2 * 16 /* Wiretype = 2  =^ 32 Bit */ + ((tag_dataID>>8) & 0x0F) /* DataID High Part */ ;
      ACC_payload_buffer_additionalInformation[payload_counter++] = tag_dataID & 0xFF /* DataID Low Part */ ;
      
      ACC_payload_buffer_additionalInformation[payload_counter++] = ACC_array_additionalInformation_coloredStatusIcon[j]>>24 & 0xFF;
      ACC_payload_buffer_additionalInformation[payload_counter++] = ACC_array_additionalInformation_coloredStatusIcon[j]>>16 & 0xFF;
      ACC_payload_buffer_additionalInformation[payload_counter++] = ACC_array_additionalInformation_coloredStatusIcon[j]>> 8 & 0xFF;
      ACC_payload_buffer_additionalInformation[payload_counter++] = ACC_array_additionalInformation_coloredStatusIcon[j]     & 0xFF;
    }
    
    
    // 4 coloredRelevantObject (enum32)
    if (ACC_array_additionalInformation_coloredRelevantObject_available[j] == 1)
    {
      tag_dataID = 4;
      ACC_payload_buffer_additionalInformation[payload_counter++] = 2 * 16 /* Wiretype = 2  =^ 32 Bit */ + ((tag_dataID>>8) & 0x0F) /* DataID High Part */ ;
      ACC_payload_buffer_additionalInformation[payload_counter++] = tag_dataID & 0xFF /* DataID Low Part */ ;
      
      ACC_payload_buffer_additionalInformation[payload_counter++] = ACC_array_additionalInformation_coloredRelevantObject[j]>>24 & 0xFF;
      ACC_payload_buffer_additionalInformation[payload_counter++] = ACC_array_additionalInformation_coloredRelevantObject[j]>>16 & 0xFF;
      ACC_payload_buffer_additionalInformation[payload_counter++] = ACC_array_additionalInformation_coloredRelevantObject[j]>> 8 & 0xFF;
      ACC_payload_buffer_additionalInformation[payload_counter++] = ACC_array_additionalInformation_coloredRelevantObject[j]     & 0xFF;
    }
    
    
    // 5 coloredRelevantObject (enum32)
    if (ACC_array_additionalInformation_coloredRelevantObject_available[j] == 1)
    {
      tag_dataID = 5;
      ACC_payload_buffer_additionalInformation[payload_counter++] = 2 * 16 /* Wiretype = 2  =^ 32 Bit */ + ((tag_dataID>>8) & 0x0F) /* DataID High Part */ ;
      ACC_payload_buffer_additionalInformation[payload_counter++] = tag_dataID & 0xFF /* DataID Low Part */ ;
      
      ACC_payload_buffer_additionalInformation[payload_counter++] = ACC_array_additionalInformation_unitTempolimit[j]>>24 & 0xFF;
      ACC_payload_buffer_additionalInformation[payload_counter++] = ACC_array_additionalInformation_unitTempolimit[j]>>16 & 0xFF;
      ACC_payload_buffer_additionalInformation[payload_counter++] = ACC_array_additionalInformation_unitTempolimit[j]>> 8 & 0xFF;
      ACC_payload_buffer_additionalInformation[payload_counter++] = ACC_array_additionalInformation_unitTempolimit[j]     & 0xFF;
    }
    
    
    // 6 coloredRelevantObject (enum32)
    if (ACC_array_additionalInformation_coloredRelevantObject_available[j] == 1)
    {
      tag_dataID = 6;
      ACC_payload_buffer_additionalInformation[payload_counter++] = 2 * 16 /* Wiretype = 2  =^ 32 Bit */ + ((tag_dataID>>8) & 0x0F) /* DataID High Part */ ;
      ACC_payload_buffer_additionalInformation[payload_counter++] = tag_dataID & 0xFF /* DataID Low Part */ ;
      
      ACC_payload_buffer_additionalInformation[payload_counter++] = ACC_array_additionalInformation_displayLightSpeedometerType[j]>>24 & 0xFF;
      ACC_payload_buffer_additionalInformation[payload_counter++] = ACC_array_additionalInformation_displayLightSpeedometerType[j]>>16 & 0xFF;
      ACC_payload_buffer_additionalInformation[payload_counter++] = ACC_array_additionalInformation_displayLightSpeedometerType[j]>> 8 & 0xFF;
      ACC_payload_buffer_additionalInformation[payload_counter++] = ACC_array_additionalInformation_displayLightSpeedometerType[j]     & 0xFF;
    }
    
    
    // 7 displayLightSpeedometerStatus (enum32)
    if (ACC_array_additionalInformation_displayLightSpeedometerStatus_available[j] == 1)
    {
      tag_dataID = 7;
      ACC_payload_buffer_additionalInformation[payload_counter++] = 2 * 16 /* Wiretype = 2  =^ 32 Bit */ + ((tag_dataID>>8) & 0x0F) /* DataID High Part */ ;
      ACC_payload_buffer_additionalInformation[payload_counter++] = tag_dataID & 0xFF /* DataID Low Part */ ;
      
      ACC_payload_buffer_additionalInformation[payload_counter++] = ACC_array_additionalInformation_displayLightSpeedometerStatus[j]>>24 & 0xFF;
      ACC_payload_buffer_additionalInformation[payload_counter++] = ACC_array_additionalInformation_displayLightSpeedometerStatus[j]>>16 & 0xFF;
      ACC_payload_buffer_additionalInformation[payload_counter++] = ACC_array_additionalInformation_displayLightSpeedometerStatus[j]>> 8 & 0xFF;
      ACC_payload_buffer_additionalInformation[payload_counter++] = ACC_array_additionalInformation_displayLightSpeedometerStatus[j]     & 0xFF;
    }
    
    
    // 8 configuredVelocityColor (enum32)
    if (ACC_array_additionalInformation_configuredVelocityColor_available[j] == 1)
    {
      tag_dataID = 4;
      ACC_payload_buffer_additionalInformation[payload_counter++] = 2 * 16 /* Wiretype = 2  =^ 32 Bit */ + ((tag_dataID>>8) & 0x0F) /* DataID High Part */ ;
      ACC_payload_buffer_additionalInformation[payload_counter++] = tag_dataID & 0xFF /* DataID Low Part */ ;
      
      ACC_payload_buffer_additionalInformation[payload_counter++] = ACC_array_additionalInformation_configuredVelocityColor[j]>>24 & 0xFF;
      ACC_payload_buffer_additionalInformation[payload_counter++] = ACC_array_additionalInformation_configuredVelocityColor[j]>>16 & 0xFF;
      ACC_payload_buffer_additionalInformation[payload_counter++] = ACC_array_additionalInformation_configuredVelocityColor[j]>> 8 & 0xFF;
      ACC_payload_buffer_additionalInformation[payload_counter++] = ACC_array_additionalInformation_configuredVelocityColor[j]     & 0xFF;
    }
    
    
    //Element Length
    element_length = payload_counter-start_pos;
    if (element_length >0) ACC_array_additionalInformation_array_element_length[j] = element_length - 4;
    else                   ACC_array_additionalInformation_array_element_length[j] = element_length;
    
    ACC_payload_buffer_additionalInformation[start_pos++] = ACC_array_additionalInformation_array_element_length[j]>>24 & 0xFF;
    ACC_payload_buffer_additionalInformation[start_pos++] = ACC_array_additionalInformation_array_element_length[j]>>16 & 0xFF;
    ACC_payload_buffer_additionalInformation[start_pos++] = ACC_array_additionalInformation_array_element_length[j]>> 8 & 0xFF;
    ACC_payload_buffer_additionalInformation[start_pos++] = ACC_array_additionalInformation_array_element_length[j]     & 0xFF;
    
    if (ACC_array_additionalInformation_array_element_length[j] == 0) payload_counter = payload_counter+4;
  }
  
  // Struct Length
  ACC_array_additionalInformation_struct_element_length = 4*@ACC_Notification_additionalInformation_Element_TotalNum;

  for (k=0;k<@ACC_Notification_additionalInformation_Element_TotalNum;k++)
    ACC_array_additionalInformation_struct_element_length = ACC_array_additionalInformation_struct_element_length + ACC_array_additionalInformation_array_element_length[k];
  
  ACC_payload_buffer_additionalInformation[0] = ACC_array_additionalInformation_struct_element_length>>24 & 0xFF;
  ACC_payload_buffer_additionalInformation[1] = ACC_array_additionalInformation_struct_element_length>>16 & 0xFF;
  ACC_payload_buffer_additionalInformation[2] = ACC_array_additionalInformation_struct_element_length>> 8 & 0xFF;
  ACC_payload_buffer_additionalInformation[3] = ACC_array_additionalInformation_struct_element_length     & 0xFF;


  ACC_payload_length_additionalInformation = ACC_array_additionalInformation_struct_element_length+4;
  putvalue(ACC_Notification_additionalInformation_Payload, ACC_payload_buffer_additionalInformation, ACC_payload_length_additionalInformation);
}

on envVar ACC_Notification_additionalInformation_Element_TotalNum
{
  if (@this == 0) @this =  1;
  if (@this > 10) @this = 10;
  
  ACC_Notification_additionalInformation();
  ACC_Notification_additionalInformation_update();
}

on envVar ACC_Notification_additionalInformation_Element
{
  ACC_Notification_additionalInformation_update();
}

on envVar ACC_Notification_additionalInformation_Element_Next
{
  if (@this == 1 && @ACC_Notification_additionalInformation_Element < @ACC_Notification_additionalInformation_Element_TotalNum - 1)
  {
    @ACC_Notification_additionalInformation_Element = @ACC_Notification_additionalInformation_Element + 1;
    ACC_Notification_additionalInformation_update();
  }
}

on envVar ACC_Notification_additionalInformation_Element_Previous
{
  if (@this == 1 && @ACC_Notification_additionalInformation_Element > 0)
  {
    @ACC_Notification_additionalInformation_Element = @ACC_Notification_additionalInformation_Element - 1;
    ACC_Notification_additionalInformation_update();
  }
}

ACC_Notification_additionalInformation_update()
{
  @ACC_Notification_LengthIndicator_Element_additionalInformation = ACC_array_additionalInformation_array_element_length[@ACC_Notification_additionalInformation_Element];
  @ACC_Notification_LengthIndicator_Struct_additionalInformation  = ACC_array_additionalInformation_struct_element_length;
  @ACC_Notification_Length_additionalInformation                  = ACC_payload_length_additionalInformation+8;
  
  @ACC_Notification_additionalInformation_elementId                     = ACC_array_additionalInformation_elementId[@ACC_Notification_additionalInformation_Element];
  @ACC_Notification_additionalInformation_acaDisplayStatus              = ACC_array_additionalInformation_acaDisplayStatus[@ACC_Notification_additionalInformation_Element];
  @ACC_Notification_additionalInformation_additionalDisplayObject       = ACC_array_additionalInformation_additionalDisplayObject[@ACC_Notification_additionalInformation_Element];
  @ACC_Notification_additionalInformation_coloredStatusIcon             = ACC_array_additionalInformation_coloredStatusIcon[@ACC_Notification_additionalInformation_Element];
  @ACC_Notification_additionalInformation_coloredRelevantObject         = ACC_array_additionalInformation_coloredRelevantObject[@ACC_Notification_additionalInformation_Element];
  @ACC_Notification_additionalInformation_unitTempolimit                = ACC_array_additionalInformation_unitTempolimit[@ACC_Notification_additionalInformation_Element];
  @ACC_Notification_additionalInformation_displayLightSpeedometerType   = ACC_array_additionalInformation_displayLightSpeedometerType[@ACC_Notification_additionalInformation_Element];
  @ACC_Notification_additionalInformation_displayLightSpeedometerStatus = ACC_array_additionalInformation_displayLightSpeedometerStatus[@ACC_Notification_additionalInformation_Element];
  @ACC_Notification_additionalInformation_configuredVelocityColor       = ACC_array_additionalInformation_configuredVelocityColor[@ACC_Notification_additionalInformation_Element];
  
  @ACC_Notification_additionalInformation_elementId_available                     = ACC_array_additionalInformation_elementId_available[@ACC_Notification_additionalInformation_Element];
  @ACC_Notification_additionalInformation_acaDisplayStatus_available              = ACC_array_additionalInformation_acaDisplayStatus_available[@ACC_Notification_additionalInformation_Element];
  @ACC_Notification_additionalInformation_additionalDisplayObject_available       = ACC_array_additionalInformation_additionalDisplayObject_available[@ACC_Notification_additionalInformation_Element];
  @ACC_Notification_additionalInformation_coloredStatusIcon_available             = ACC_array_additionalInformation_coloredStatusIcon_available[@ACC_Notification_additionalInformation_Element];
  @ACC_Notification_additionalInformation_coloredRelevantObject_available         = ACC_array_additionalInformation_coloredRelevantObject_available[@ACC_Notification_additionalInformation_Element];
  @ACC_Notification_additionalInformation_unitTempolimit_available                = ACC_array_additionalInformation_unitTempolimit_available[@ACC_Notification_additionalInformation_Element];
  @ACC_Notification_additionalInformation_displayLightSpeedometerType_available   = ACC_array_additionalInformation_displayLightSpeedometerType_available[@ACC_Notification_additionalInformation_Element];
  @ACC_Notification_additionalInformation_displayLightSpeedometerStatus_available = ACC_array_additionalInformation_displayLightSpeedometerStatus_available[@ACC_Notification_additionalInformation_Element];
  @ACC_Notification_additionalInformation_configuredVelocityColor_available       = ACC_array_additionalInformation_configuredVelocityColor_available[@ACC_Notification_additionalInformation_Element];
}







/////////////////////////////////////////////////
////////////////// Service AWV //////////////////
/////////////////////////////////////////////////

on envVar ServiceDiscovery_Offer_Service_AWV
{
  Send_ServiceDiscovery_Offer_Service_ICAS1Gateway();
}

on envVar AWV_Notification_notifications_Send
{
  if (@this == 1)
  {
    UDP_Segments_total = @AWV_Notification_Length_notifications/1404 + 1;
    UDP_Segments_left  = UDP_Segments_total;
    
    if (UDP_Segments_total > 1) seg_id_flag = 1;
    else                        seg_id_flag = 0;
    
    Send_Service_AWV_Notification (0xC010 & 0x0000FFFF);
  }
}
on envVar AWV_Notification_notifications_Send_cyclic
{
  if (@this == 1)
    setTimercyclic (tAWV_Notification_notifications_Send, @AWV_Notification_notifications_Send_cyclic_cycletime);
  else
    cancelTimer (tAWV_Notification_notifications_Send);
}
on envVar AWV_Notification_notifications_Send_cyclic_cycletime
{
  if (@AWV_Notification_notifications_Send_cyclic == 1)
  {
    cancelTimer (tAWV_Notification_notifications_Send);
    setTimercyclic (tAWV_Notification_notifications_Send, @this);
  }
}
on timer tAWV_Notification_notifications_Send
{
  UDP_Segments_total = @AWV_Notification_Length_notifications/1404 + 1;
  UDP_Segments_left  = UDP_Segments_total;
  
  if (UDP_Segments_total > 1) seg_id_flag = 1;
  else                        seg_id_flag = 0;
    
  Send_Service_AWV_Notification (0xC010 & 0x0000FFFF);
}

on envVar AWV_Notification_info_Send
{
  if (@this == 1)
  {
    UDP_Segments_total = @AWV_Notification_Length_info/1404 + 1;
    UDP_Segments_left  = UDP_Segments_total;
    
    if (UDP_Segments_total > 1) seg_id_flag = 1;
    else                        seg_id_flag = 0;
    
    Send_Service_AWV_Notification (0xC020 & 0x0000FFFF);
  }
}
on envVar AWV_Notification_info_Send_cyclic
{
  if (@this == 1)
    setTimercyclic (tAWV_Notification_info_Send, @AWV_Notification_info_Send_cyclic_cycletime);
  else
    cancelTimer (tAWV_Notification_info_Send);
}
on envVar AWV_Notification_info_Send_cyclic_cycletime
{
  if (@AWV_Notification_info_Send_cyclic == 1)
  {
    cancelTimer (tAWV_Notification_info_Send);
    setTimercyclic (tAWV_Notification_info_Send, @this);
  }
}
on timer tAWV_Notification_info_Send
{
  UDP_Segments_total = @AWV_Notification_Length_info/1404 + 1;
  UDP_Segments_left  = UDP_Segments_total;
  
  if (UDP_Segments_total > 1) seg_id_flag = 1;
  else                        seg_id_flag = 0;
    
  Send_Service_AWV_Notification (0xC020 & 0x0000FFFF);
}


Send_Service_AWV_Notification (word MethodID)
{
  ethernetPacket EthPaket;

  // Ethernet Packet - MAC Source address
  getvalue (ServiceDiscovery_EthernetPacket_MAC_Source_ICAS1Gateway, buffer_MAC);
  //EthPaket.source.ParseAddress ( buffer_MAC );
  EthPaket.source = ethGetMacAddressAsNumber (buffer_MAC);
  
  // Ethernet Packet - MAC Destination address
  getvalue (ServiceDiscovery_EthernetPacket_MAC_Destination, buffer_MAC);
  //EthPaket.destination.ParseAddress ( buffer_MAC );
  EthPaket.destination = ethGetMacAddressAsNumber (buffer_MAC);
  
  // Ethernet Packet - VLAN
  EthPaket.SetVlan (@ServiceDiscovery_EthernetPacket_VLAN_TPID, @ServiceDiscovery_EthernetPacket_VLAN_TCI);
  
  // Ethernet Packet - Type
  //EthPaket.ipv6.type = @EthernetPacket_Type;
  if (@ServiceDiscovery_EthernetPacket_Type == 0x86DD) EthPaket.ipv6.Init();
  
  
  // IPv6 Packet - Version
  EthPaket.ipv6.version = @ServiceDiscovery_IPv6Packet_Version;

  // IPv6 Packet - Traffic Class
  EthPaket.ipv6.class = @ServiceDiscovery_IPv6Packet_Traffic_Class;
  
  // IPv6 Packet - Flow Label
  EthPaket.ipv6.flow = @ServiceDiscovery_IPv6Packet_Flow_Label;
  
  // IPv6 Packet - Payload_Length
  EthPaket.ipv6.length = @ServiceDiscovery_IPv6Packet_Payload_Length;
  
  // IPv6 Packet - Next Header
  EthPaket.ipv6.next = @ServiceDiscovery_IPv6Packet_Next_Header;
  if (@ServiceDiscovery_IPv6Packet_Next_Header == 6) EthPaket.tcp.Init();
  if (@ServiceDiscovery_IPv6Packet_Next_Header == 17) EthPaket.udp.Init();
  
  // IPv6 Packet - Hop Limit
  EthPaket.ipv6.hopLimit = @ServiceDiscovery_IPv6Packet_Hop_Limit;

  // IPv6 Packet - IPv6 Destination address    // TODO: char array zu byte array
  buffer_ipv6[0]  = @ServiceDiscovery_IPv6Packet_IP_Destination_Unicast_01>>8 & 0xFF;
  buffer_ipv6[1]  = @ServiceDiscovery_IPv6Packet_IP_Destination_Unicast_01    & 0xFF;
  buffer_ipv6[2]  = @ServiceDiscovery_IPv6Packet_IP_Destination_Unicast_02>>8 & 0xFF;
  buffer_ipv6[3]  = @ServiceDiscovery_IPv6Packet_IP_Destination_Unicast_02    & 0xFF;
  buffer_ipv6[4]  = @ServiceDiscovery_IPv6Packet_IP_Destination_Unicast_03>>8 & 0xFF;
  buffer_ipv6[5]  = @ServiceDiscovery_IPv6Packet_IP_Destination_Unicast_03    & 0xFF;
  buffer_ipv6[6]  = @ServiceDiscovery_IPv6Packet_IP_Destination_Unicast_04>>8 & 0xFF;
  buffer_ipv6[7]  = @ServiceDiscovery_IPv6Packet_IP_Destination_Unicast_04    & 0xFF;
  buffer_ipv6[8]  = @ServiceDiscovery_IPv6Packet_IP_Destination_Unicast_05>>8 & 0xFF;
  buffer_ipv6[9]  = @ServiceDiscovery_IPv6Packet_IP_Destination_Unicast_05    & 0xFF;
  buffer_ipv6[10] = @ServiceDiscovery_IPv6Packet_IP_Destination_Unicast_06>>8 & 0xFF;
  buffer_ipv6[11] = @ServiceDiscovery_IPv6Packet_IP_Destination_Unicast_06    & 0xFF;
  buffer_ipv6[12] = @ServiceDiscovery_IPv6Packet_IP_Destination_Unicast_07>>8 & 0xFF;
  buffer_ipv6[13] = @ServiceDiscovery_IPv6Packet_IP_Destination_Unicast_07    & 0xFF;
  buffer_ipv6[14] = @ServiceDiscovery_IPv6Packet_IP_Destination_Unicast_08>>8 & 0xFF;
  buffer_ipv6[15] = @ServiceDiscovery_IPv6Packet_IP_Destination_Unicast_08    & 0xFF;
  EthPaket.ipv6.destination.SetData ( 0, buffer_ipv6, elcount(buffer_ipv6) );

  // IPv6 Packet - IPv6 Source address    // TODO: char array zu byte array
  buffer_ipv6[0]  = @ServiceDiscovery_IPv6Packet_IP_Source_ICAS1Gateway_01>>8 & 0xFF;
  buffer_ipv6[1]  = @ServiceDiscovery_IPv6Packet_IP_Source_ICAS1Gateway_01    & 0xFF;
  buffer_ipv6[2]  = @ServiceDiscovery_IPv6Packet_IP_Source_ICAS1Gateway_02>>8 & 0xFF;
  buffer_ipv6[3]  = @ServiceDiscovery_IPv6Packet_IP_Source_ICAS1Gateway_02    & 0xFF;
  buffer_ipv6[4]  = @ServiceDiscovery_IPv6Packet_IP_Source_ICAS1Gateway_03>>8 & 0xFF;
  buffer_ipv6[5]  = @ServiceDiscovery_IPv6Packet_IP_Source_ICAS1Gateway_03    & 0xFF;
  buffer_ipv6[6]  = @ServiceDiscovery_IPv6Packet_IP_Source_ICAS1Gateway_04>>8 & 0xFF;
  buffer_ipv6[7]  = @ServiceDiscovery_IPv6Packet_IP_Source_ICAS1Gateway_04    & 0xFF;
  buffer_ipv6[8]  = @ServiceDiscovery_IPv6Packet_IP_Source_ICAS1Gateway_05>>8 & 0xFF;
  buffer_ipv6[9]  = @ServiceDiscovery_IPv6Packet_IP_Source_ICAS1Gateway_05    & 0xFF;
  buffer_ipv6[10] = @ServiceDiscovery_IPv6Packet_IP_Source_ICAS1Gateway_06>>8 & 0xFF;
  buffer_ipv6[11] = @ServiceDiscovery_IPv6Packet_IP_Source_ICAS1Gateway_06    & 0xFF;
  buffer_ipv6[12] = @ServiceDiscovery_IPv6Packet_IP_Source_ICAS1Gateway_07>>8 & 0xFF;
  buffer_ipv6[13] = @ServiceDiscovery_IPv6Packet_IP_Source_ICAS1Gateway_07    & 0xFF;
  buffer_ipv6[14] = @ServiceDiscovery_IPv6Packet_IP_Source_ICAS1Gateway_08>>8 & 0xFF;
  buffer_ipv6[15] = @ServiceDiscovery_IPv6Packet_IP_Source_ICAS1Gateway_08    & 0xFF;
  EthPaket.ipv6.source.SetData ( 0, buffer_ipv6, elcount(buffer_ipv6) );

  
  // UDP Packet - Source Port
  EthPaket.udp.source = @AWV_Notification_Port_Source;
  
  // UDP Packet - Destination Port
  EthPaket.udp.destination = @AWV_Notification_Port_Destination;
  
  // UDP Packet - Length
  EthPaket.udp.length = @ServiceDiscovery_UDPPacket_Length;
  
  
  // SOME/IP Packet aus Rohdaten zusammenbauen (buffer array)
  i=0;
  
  // SOME/IP Packet - Message ID, Service ID [16 bit]
  buffer[i++] = @AWV_Notification_Message_ID_Service_ID>>8 & 0xFF;
  buffer[i++] = @AWV_Notification_Message_ID_Service_ID    & 0xFF;
  
  // SOME/IP Packet - Message ID, Message ID [16 bit]
  switch (MethodID)
  {
    case 0xC010: @AWV_Notification_Message_ID_Method_ID = @AWV_Notification_Message_ID_Method_ID_notifications; break;
    case 0xC020: @AWV_Notification_Message_ID_Method_ID = @AWV_Notification_Message_ID_Method_ID_info; break;
  }
  buffer[i++] = @AWV_Notification_Message_ID_Method_ID>>8 & 0xFF;
  buffer[i++] = @AWV_Notification_Message_ID_Method_ID    & 0xFF;
  
  // SOME/IP Packet - Length [32 bit]
  if (UDP_Segments_total == 1)
  {
    switch (MethodID)
    {
      case 0xC010: @AWV_Notification_Length = @AWV_Notification_Length_notifications; break;
      case 0xC020: @AWV_Notification_Length = @AWV_Notification_Length_info; break;
    }
  }
  else
  {
    if (UDP_Segments_left > 1)
    {
      switch (MethodID)
      {
        case 0xC010: @AWV_Notification_Length = 1404; break;
        case 0xC020: @AWV_Notification_Length = 1404; break;
      }
    }
    else
    {
      switch (MethodID)
      {
        case 0xC010: @AWV_Notification_Length = AWV_payload_length_notifications - 1404*(UDP_Segments_total-UDP_Segments_left) + 24; break;
        case 0xC020: @AWV_Notification_Length = AWV_payload_length_info          - 1404*(UDP_Segments_total-UDP_Segments_left) + 24; break;
      }
    }
  }
  buffer[i++] = @AWV_Notification_Length>>24 & 0xFF;
  buffer[i++] = @AWV_Notification_Length>>16 & 0xFF;
  buffer[i++] = @AWV_Notification_Length>> 8 & 0xFF;
  buffer[i++] = @AWV_Notification_Length     & 0xFF;
  
  // SOME/IP Packet - Request ID, Client ID [16 bit]
  buffer[i++] = @AWV_Notification_Request_ID_Client_ID>>8 & 0xFF;
  buffer[i++] = @AWV_Notification_Request_ID_Client_ID    & 0xFF;
  
  // SOME/IP Packet - Request ID, Session ID) [16 bit]
  if ((UDP_Segments_total == 1) || (seg_id_flag == 1))
  {
    @ServiceDiscovery_SOMEIPPacket_Notification_Request_ID_Session_ID = @ServiceDiscovery_SOMEIPPacket_Notification_Request_ID_Session_ID + 1;
    if (@ServiceDiscovery_SOMEIPPacket_Notification_Request_ID_Session_ID == 0x10000) @ServiceDiscovery_SOMEIPPacket_Notification_Request_ID_Session_ID = 1;
    seg_id_flag = 0;
  }
  
  buffer[i++] = @ServiceDiscovery_SOMEIPPacket_Notification_Request_ID_Session_ID>>8 & 0xFF;
  buffer[i++] = @ServiceDiscovery_SOMEIPPacket_Notification_Request_ID_Session_ID    & 0xFF;
  
  // SOME/IP Packet - Protocol Version [8 bit]
  buffer[i++] = @AWV_Notification_Protocol_Version;
  
  // SOME/IP Packet - Interface Version [8 bit]
  buffer[i++] = @AWV_Notification_Interface_Version;
  
  // SOME/IP Packet - Message Type [8 bit]
  buffer[i++] = @AWV_Notification_Message_Type;
  
  // SOME/IP Packet - Return Code [8 bit]
  buffer[i++] = @AWV_Notification_Return_Code;
  
  
  if (UDP_Segments_total > 1)
  {
    if (UDP_Segments_left >= 0)
    { 
      // Message Type neu setzen
      buffer[i-2] = @AWV_Notification_Message_Type + 0x20;
      
      // Offset (16byte Schritte, 1392/16 = 87)
      @AWV_Notification_Offset = 87 * (UDP_Segments_total - UDP_Segments_left);
      
      // More Segments Flag
      if (UDP_Segments_left > 1) @AWV_Notification_More_Segments_Flag = 1;
      else                       @AWV_Notification_More_Segments_Flag = 0;
      
      buffer[i++] =   @AWV_Notification_Offset>>20 & 0xFF;
      buffer[i++] =   @AWV_Notification_Offset>>12 & 0xFF;
      buffer[i++] =   @AWV_Notification_Offset>>4  & 0xFF;
      buffer[i++] = ((@AWV_Notification_Offset<<4) & 0xF0) + (@AWV_Notification_More_Segments_Flag & 0x01);
    }
  }
  
  UDP_Segments_left--;
  
  ////// notifications notifier //////
  if (MethodID == 0xC010)
  {
    if (UDP_Segments_total == 1)
    {
      for (j=0; j<AWV_payload_length_notifications; j++)
        buffer[i++] = AWV_payload_buffer_notifications[j];
    }
    else
    {
      if (UDP_Segments_left >= 1)
      {
        for (j=(UDP_Segments_total-UDP_Segments_left-1)*1392; j<(UDP_Segments_total-UDP_Segments_left)*1392; j++)
          buffer[i++] = AWV_payload_buffer_notifications[j];
      }
      else
      {
        for (j=(UDP_Segments_total-(UDP_Segments_left+1))*1392; j<AWV_payload_length_notifications; j++)
          buffer[i++] = AWV_payload_buffer_notifications[j];
      }
    }
  }
  
  ////// info notifier //////
  if (MethodID == 0xC020)
  {
    if (UDP_Segments_total == 1)
    {
      for (j=0; j<AWV_payload_length_info; j++)
        buffer[i++] = AWV_payload_buffer_info[j];
    }
    else
    {
      if (UDP_Segments_left >= 1)
      {
        for (j=(UDP_Segments_total-UDP_Segments_left-1)*1392; j<(UDP_Segments_total-UDP_Segments_left)*1392; j++)
          buffer[i++] = AWV_payload_buffer_info[j];
      }
      else
      {
        for (j=(UDP_Segments_total-(UDP_Segments_left+1))*1392; j<AWV_payload_length_info; j++)
          buffer[i++] = AWV_payload_buffer_info[j];
      }
    }
  }
  
  
  // Rohdaten in UDP Paket schreiben
  EthPaket.udp.SetData( 0, buffer, i );

  // calculate UDP and IPv6 checksum and send Ethernet packet
  EthPaket.CompletePacket();
  output( EthPaket );
  
  // prüfen ob alle Segemente gesendet wurden, sonst senden erneut aufrufen
  AWV_Segmentation_Method_ID = MethodID;
  if (UDP_Segments_left>0)
    settimer(AWV_Segmentation_delay, 50);
}

on timer AWV_Segmentation_delay
{
  Send_Service_AWV_Notification (AWV_Segmentation_Method_ID);
}






////////// notifications Notification //////////

on envVar AWV_Notification_LengthIndicator_Struct_notifications
{
  AWV_Notification_notifications();
}
on envVar AWV_Notification_LengthIndicator_Element_notifications
{
  AWV_Notification_notifications();
}
on envVar AWV_Notification_notifications_type
{
  AWV_array_notifications_type[@AWV_Notification_notifications_Element] = @this;
  AWV_Notification_notifications();
}
on envVar AWV_Notification_notifications_value
{
  AWV_array_notifications_value[@AWV_Notification_notifications_Element] = @this;
  AWV_Notification_notifications();
}
on envVar AWV_Notification_notifications_type_available
{
  AWV_array_notifications_type_available[@AWV_Notification_notifications_Element] = @this;
  AWV_Notification_notifications();
}
on envVar AWV_Notification_notifications_value_available
{
  AWV_array_notifications_value_available[@AWV_Notification_notifications_Element] = @this;
  AWV_Notification_notifications();
}
on envVar AWV_Notification_notifications_Payload
{
  AWV_Notification_notifications_update();
}


AWV_Notification_notifications()
{
  word payload_counter = 0;
  word start_pos       = 0;
  word element_length  = 0;
  
  // Length Indicator Struct - Platzhalter
  payload_counter = 0+4;
  start_pos = 0;
  
  for (j=0; j<@AWV_Notification_notifications_Element_TotalNum; j++)
  {
    AWV_array_notifications_available_functions[j] = AWV_array_notifications_type_available[j]
                                                   + AWV_array_notifications_value_available[j];
    
    // Length Indicator Element - Platzhalter
    if (AWV_array_notifications_available_functions[j] > 0)
    {
      start_pos = payload_counter;
      payload_counter = payload_counter + 4;
    }
    else 
      start_pos = payload_counter;
    
    
    // 0 type (enum32)
    if (AWV_array_notifications_type_available[j] == 1)
    {
      tag_dataID = 0;
      AWV_payload_buffer_notifications[payload_counter++] = 2 * 16 /* Wiretype = 2  =^ 32 Bit */ + ((tag_dataID>>8) & 0x0F) /* DataID High Part */ ;
      AWV_payload_buffer_notifications[payload_counter++] = tag_dataID & 0xFF /* DataID Low Part */ ;
      
      AWV_payload_buffer_notifications[payload_counter++] = AWV_array_notifications_type[j]>>24 & 0xFF;
      AWV_payload_buffer_notifications[payload_counter++] = AWV_array_notifications_type[j]>>16 & 0xFF;
      AWV_payload_buffer_notifications[payload_counter++] = AWV_array_notifications_type[j]>> 8 & 0xFF;
      AWV_payload_buffer_notifications[payload_counter++] = AWV_array_notifications_type[j]     & 0xFF;
    }
    
    
    // 1 value (uint32)
    if (AWV_array_notifications_value_available[j] == 1)
    {
      tag_dataID = 1;
      AWV_payload_buffer_notifications[payload_counter++] = 2 * 16 /* Wiretype = 2  =^ 32 Bit */ + ((tag_dataID>>8) & 0x0F) /* DataID High Part */ ;
      AWV_payload_buffer_notifications[payload_counter++] = tag_dataID & 0xFF /* DataID Low Part */ ;
      
      AWV_payload_buffer_notifications[payload_counter++] = AWV_array_notifications_value[j]>>24 & 0xFF;
      AWV_payload_buffer_notifications[payload_counter++] = AWV_array_notifications_value[j]>>16 & 0xFF;
      AWV_payload_buffer_notifications[payload_counter++] = AWV_array_notifications_value[j]>> 8 & 0xFF;
      AWV_payload_buffer_notifications[payload_counter++] = AWV_array_notifications_value[j]     & 0xFF;
    }
    
    
    //Element Length
    element_length = payload_counter-start_pos;
    if (element_length >0) AWV_array_notifications_array_element_length[j] = element_length - 4;
    else                   AWV_array_notifications_array_element_length[j] = element_length;
    
    AWV_payload_buffer_notifications[start_pos++] = AWV_array_notifications_array_element_length[j]>>24 & 0xFF;
    AWV_payload_buffer_notifications[start_pos++] = AWV_array_notifications_array_element_length[j]>>16 & 0xFF;
    AWV_payload_buffer_notifications[start_pos++] = AWV_array_notifications_array_element_length[j]>> 8 & 0xFF;
    AWV_payload_buffer_notifications[start_pos++] = AWV_array_notifications_array_element_length[j]     & 0xFF;
    
    if (AWV_array_notifications_array_element_length[j] == 0) payload_counter = payload_counter+4;
  }
  
  // Struct Length
  AWV_array_notifications_struct_element_length = 4*@AWV_Notification_notifications_Element_TotalNum;

  for (k=0;k<@AWV_Notification_notifications_Element_TotalNum;k++)
    AWV_array_notifications_struct_element_length = AWV_array_notifications_struct_element_length + AWV_array_notifications_array_element_length[k];
  
  AWV_payload_buffer_notifications[0] = AWV_array_notifications_struct_element_length>>24 & 0xFF;
  AWV_payload_buffer_notifications[1] = AWV_array_notifications_struct_element_length>>16 & 0xFF;
  AWV_payload_buffer_notifications[2] = AWV_array_notifications_struct_element_length>> 8 & 0xFF;
  AWV_payload_buffer_notifications[3] = AWV_array_notifications_struct_element_length     & 0xFF;


  AWV_payload_length_notifications = AWV_array_notifications_struct_element_length+4;
  putvalue(AWV_Notification_notifications_Payload, AWV_payload_buffer_notifications, AWV_payload_length_notifications);
}

on envVar AWV_Notification_notifications_Element_TotalNum
{
  if (@this == 0) @this =  1;
  if (@this > 10) @this = 10;
  
  AWV_Notification_notifications();
  AWV_Notification_notifications_update();
}

on envVar AWV_Notification_notifications_Element
{
  AWV_Notification_notifications_update();
}

on envVar AWV_Notification_notifications_Element_Next
{
  if (@this == 1 && @AWV_Notification_notifications_Element < @AWV_Notification_notifications_Element_TotalNum - 1)
  {
    @AWV_Notification_notifications_Element = @AWV_Notification_notifications_Element + 1;
    AWV_Notification_notifications_update();
  }
}

on envVar AWV_Notification_notifications_Element_Previous
{
  if (@this == 1 && @AWV_Notification_notifications_Element > 0)
  {
    @AWV_Notification_notifications_Element = @AWV_Notification_notifications_Element - 1;
    AWV_Notification_notifications_update();
  }
}

AWV_Notification_notifications_update()
{
  @AWV_Notification_LengthIndicator_Element_notifications = AWV_array_notifications_array_element_length[@AWV_Notification_notifications_Element];
  @AWV_Notification_LengthIndicator_Struct_notifications  = AWV_array_notifications_struct_element_length;
  @AWV_Notification_Length_notifications                  = AWV_payload_length_notifications+8;
  
  @AWV_Notification_notifications_type  = AWV_array_notifications_type[@AWV_Notification_notifications_Element];
  @AWV_Notification_notifications_value = AWV_array_notifications_value[@AWV_Notification_notifications_Element];
  
  @AWV_Notification_notifications_type_available  = AWV_array_notifications_type_available[@AWV_Notification_notifications_Element];
  @AWV_Notification_notifications_value_available = AWV_array_notifications_value_available[@AWV_Notification_notifications_Element];
}






////////// info Notification //////////

on envVar AWV_Notification_LengthIndicator_Struct_info
{
  AWV_Notification_info();
}
on envVar AWV_Notification_LengthIndicator_Element_info
{
  AWV_Notification_info();
}
on envVar AWV_Notification_info_elementId
{
  AWV_array_info_elementId[@AWV_Notification_info_Element] = @this;
  AWV_Notification_info();
}
on envVar AWV_Notification_info_timeGap
{
  AWV_array_info_timeGap[@AWV_Notification_info_Element] = @this;
  AWV_Notification_info();
}
on envVar AWV_Notification_info_cameraObjectId
{
  AWV_array_info_cameraObjectId[@AWV_Notification_info_Element] = @this;
  AWV_Notification_info();
}
on envVar AWV_Notification_info_cameraObjectIdValueType
{
  AWV_array_info_cameraObjectIdValueType[@AWV_Notification_info_Element] = @this;
  AWV_Notification_info();
}
on envVar AWV_Notification_info_elementId_available
{
  AWV_array_info_elementId_available[@AWV_Notification_info_Element] = @this;
  AWV_Notification_info();
}
on envVar AWV_Notification_info_timeGap_available
{
  AWV_array_info_timeGap_available[@AWV_Notification_info_Element] = @this;
  AWV_Notification_info();
}
on envVar AWV_Notification_info_cameraObjectId_available
{
  AWV_array_info_cameraObjectId_available[@AWV_Notification_info_Element] = @this;
  AWV_Notification_info();
}
on envVar AWV_Notification_info_cameraObjectIdValueType_available
{
  AWV_array_info_cameraObjectIdValueType_available[@AWV_Notification_info_Element] = @this;
  AWV_Notification_info();
}
on envVar AWV_Notification_info_Payload
{
  AWV_Notification_info_update();
}


AWV_Notification_info()
{
  word payload_counter = 0;
  word start_pos       = 0;
  word element_length  = 0;
  
  // Length Indicator Struct - Platzhalter
  payload_counter = 0+4;
  start_pos = 0;
  
  for (j=0; j<@AWV_Notification_info_Element_TotalNum; j++)
  {
    AWV_array_info_available_functions[j] = AWV_array_info_elementId_available[j]
                                          + AWV_array_info_timeGap_available[j]
                                          + AWV_array_info_cameraObjectId_available[j]
                                          + AWV_array_info_cameraObjectIdValueType_available[j];
    
    // Length Indicator Element - Platzhalter
    if (AWV_array_info_available_functions[j] > 0)
    {
      start_pos = payload_counter;
      payload_counter = payload_counter + 4;
    }
    else 
      start_pos = payload_counter;
    
    
    // 0 elementId (uint32)
    if (AWV_array_info_elementId_available[j] == 1)
    {
      tag_dataID = 0;
      AWV_payload_buffer_info[payload_counter++] = 2 * 16 /* Wiretype = 2  =^ 32 Bit */ + ((tag_dataID>>8) & 0x0F) /* DataID High Part */ ;
      AWV_payload_buffer_info[payload_counter++] = tag_dataID & 0xFF /* DataID Low Part */ ;
      
      AWV_payload_buffer_info[payload_counter++] = AWV_array_info_elementId[j]>>24 & 0xFF;
      AWV_payload_buffer_info[payload_counter++] = AWV_array_info_elementId[j]>>16 & 0xFF;
      AWV_payload_buffer_info[payload_counter++] = AWV_array_info_elementId[j]>> 8 & 0xFF;
      AWV_payload_buffer_info[payload_counter++] = AWV_array_info_elementId[j]     & 0xFF;
    }
    
    
    // 1 timeGap (enum32)
    if (AWV_array_info_timeGap_available[j] == 1)
    {
      tag_dataID = 1;
      AWV_payload_buffer_info[payload_counter++] = 2 * 16 /* Wiretype = 2  =^ 32 Bit */ + ((tag_dataID>>8) & 0x0F) /* DataID High Part */ ;
      AWV_payload_buffer_info[payload_counter++] = tag_dataID & 0xFF /* DataID Low Part */ ;
      
      AWV_payload_buffer_info[payload_counter++] = AWV_array_info_timeGap[j]>>24 & 0xFF;
      AWV_payload_buffer_info[payload_counter++] = AWV_array_info_timeGap[j]>>16 & 0xFF;
      AWV_payload_buffer_info[payload_counter++] = AWV_array_info_timeGap[j]>> 8 & 0xFF;
      AWV_payload_buffer_info[payload_counter++] = AWV_array_info_timeGap[j]     & 0xFF;
    }
    
    
    // 2 cameraObjectId (uint32)
    if (AWV_array_info_cameraObjectId_available[j] == 1)
    {
      tag_dataID = 2;
      AWV_payload_buffer_info[payload_counter++] = 2 * 16 /* Wiretype = 2  =^ 32 Bit */ + ((tag_dataID>>8) & 0x0F) /* DataID High Part */ ;
      AWV_payload_buffer_info[payload_counter++] = tag_dataID & 0xFF /* DataID Low Part */ ;
      
      AWV_payload_buffer_info[payload_counter++] = AWV_array_info_cameraObjectId[j]>>24 & 0xFF;
      AWV_payload_buffer_info[payload_counter++] = AWV_array_info_cameraObjectId[j]>>16 & 0xFF;
      AWV_payload_buffer_info[payload_counter++] = AWV_array_info_cameraObjectId[j]>> 8 & 0xFF;
      AWV_payload_buffer_info[payload_counter++] = AWV_array_info_cameraObjectId[j]     & 0xFF;
    }
    
    
    // 3 cameraObjectIdValueType (enum32)
    if (AWV_array_info_cameraObjectIdValueType_available[j] == 1)
    {
      tag_dataID = 3;
      AWV_payload_buffer_info[payload_counter++] = 2 * 16 /* Wiretype = 2  =^ 32 Bit */ + ((tag_dataID>>8) & 0x0F) /* DataID High Part */ ;
      AWV_payload_buffer_info[payload_counter++] = tag_dataID & 0xFF /* DataID Low Part */ ;
      
      AWV_payload_buffer_info[payload_counter++] = AWV_array_info_cameraObjectIdValueType[j]>>24 & 0xFF;
      AWV_payload_buffer_info[payload_counter++] = AWV_array_info_cameraObjectIdValueType[j]>>16 & 0xFF;
      AWV_payload_buffer_info[payload_counter++] = AWV_array_info_cameraObjectIdValueType[j]>> 8 & 0xFF;
      AWV_payload_buffer_info[payload_counter++] = AWV_array_info_cameraObjectIdValueType[j]     & 0xFF;
    }
    
    
    //Element Length
    element_length = payload_counter-start_pos;
    if (element_length >0) AWV_array_info_array_element_length[j] = element_length - 4;
    else                   AWV_array_info_array_element_length[j] = element_length;
    
    AWV_payload_buffer_info[start_pos++] = AWV_array_info_array_element_length[j]>>24 & 0xFF;
    AWV_payload_buffer_info[start_pos++] = AWV_array_info_array_element_length[j]>>16 & 0xFF;
    AWV_payload_buffer_info[start_pos++] = AWV_array_info_array_element_length[j]>> 8 & 0xFF;
    AWV_payload_buffer_info[start_pos++] = AWV_array_info_array_element_length[j]     & 0xFF;
    
    if (AWV_array_info_array_element_length[j] == 0) payload_counter = payload_counter+4;
  }
  
  // Struct Length
  AWV_array_info_struct_element_length = 4*@AWV_Notification_info_Element_TotalNum;

  for (k=0;k<@AWV_Notification_info_Element_TotalNum;k++)
    AWV_array_info_struct_element_length = AWV_array_info_struct_element_length + AWV_array_info_array_element_length[k];
  
  AWV_payload_buffer_info[0] = AWV_array_info_struct_element_length>>24 & 0xFF;
  AWV_payload_buffer_info[1] = AWV_array_info_struct_element_length>>16 & 0xFF;
  AWV_payload_buffer_info[2] = AWV_array_info_struct_element_length>> 8 & 0xFF;
  AWV_payload_buffer_info[3] = AWV_array_info_struct_element_length     & 0xFF;


  AWV_payload_length_info = AWV_array_info_struct_element_length+4;
  putvalue(AWV_Notification_info_Payload, AWV_payload_buffer_info, AWV_payload_length_info);
}

on envVar AWV_Notification_info_Element_TotalNum
{
  if (@this == 0) @this =  1;
  if (@this > 10) @this = 10;
  
  AWV_Notification_info();
  AWV_Notification_info_update();
}

on envVar AWV_Notification_info_Element
{
  AWV_Notification_info_update();
}

on envVar AWV_Notification_info_Element_Next
{
  if (@this == 1 && @AWV_Notification_info_Element < @AWV_Notification_info_Element_TotalNum - 1)
  {
    @AWV_Notification_info_Element = @AWV_Notification_info_Element + 1;
    AWV_Notification_info_update();
  }
}

on envVar AWV_Notification_info_Element_Previous
{
  if (@this == 1 && @AWV_Notification_info_Element > 0)
  {
    @AWV_Notification_info_Element = @AWV_Notification_info_Element - 1;
    AWV_Notification_info_update();
  }
}

AWV_Notification_info_update()
{
  @AWV_Notification_LengthIndicator_Element_info = AWV_array_info_array_element_length[@AWV_Notification_info_Element];
  @AWV_Notification_LengthIndicator_Struct_info  = AWV_array_info_struct_element_length;
  @AWV_Notification_Length_info                  = AWV_payload_length_info+8;
  
  @AWV_Notification_info_elementId               = AWV_array_info_elementId[@AWV_Notification_info_Element];
  @AWV_Notification_info_timeGap                 = AWV_array_info_timeGap[@AWV_Notification_info_Element];
  @AWV_Notification_info_cameraObjectId          = AWV_array_info_cameraObjectId[@AWV_Notification_info_Element];
  @AWV_Notification_info_cameraObjectIdValueType = AWV_array_info_cameraObjectIdValueType[@AWV_Notification_info_Element];
  
  @AWV_Notification_info_elementId_available               = AWV_array_info_elementId_available[@AWV_Notification_info_Element];
  @AWV_Notification_info_timeGap_available                 = AWV_array_info_timeGap_available[@AWV_Notification_info_Element];
  @AWV_Notification_info_cameraObjectId_available          = AWV_array_info_cameraObjectId_available[@AWV_Notification_info_Element];
  @AWV_Notification_info_cameraObjectIdValueType_available = AWV_array_info_cameraObjectIdValueType_available[@AWV_Notification_info_Element];
}










////////////////////////////////////////////////////////
////////////////// Service LaneAssist //////////////////
////////////////////////////////////////////////////////

on envVar ServiceDiscovery_Offer_Service_LaneAssist
{
  Send_ServiceDiscovery_Offer_Service_ICAS1Gateway();
}

on envVar LaneAssist_Notification_notifications_Send
{
  if (@this == 1)
  {
    UDP_Segments_total = @LaneAssist_Notification_Length_notifications/1404 + 1;
    UDP_Segments_left  = UDP_Segments_total;
    
    if (UDP_Segments_total > 1) seg_id_flag = 1;
    else                        seg_id_flag = 0;
    
    Send_Service_LaneAssist_Notification (0xC010 & 0x0000FFFF);
  }
}
on envVar LaneAssist_Notification_notifications_Send_cyclic
{
  if (@this == 1)
    setTimercyclic (tLaneAssist_Notification_notifications_Send, @LaneAssist_Notification_notifications_Send_cyclic_cycletime);
  else
    cancelTimer (tLaneAssist_Notification_notifications_Send);
}
on envVar LaneAssist_Notification_notifications_Send_cyclic_cycletime
{
  if (@LaneAssist_Notification_notifications_Send_cyclic == 1)
  {
    cancelTimer (tLaneAssist_Notification_notifications_Send);
    setTimercyclic (tLaneAssist_Notification_notifications_Send, @this);
  }
}
on timer tLaneAssist_Notification_notifications_Send
{
  UDP_Segments_total = @LaneAssist_Notification_Length_notifications/1404 + 1;
  UDP_Segments_left  = UDP_Segments_total;
  
  if (UDP_Segments_total > 1) seg_id_flag = 1;
  else                        seg_id_flag = 0;
    
  Send_Service_LaneAssist_Notification (0xC010 & 0x0000FFFF);
}


Send_Service_LaneAssist_Notification (word MethodID)
{
  ethernetPacket EthPaket;

  // Ethernet Packet - MAC Source address
  getvalue (ServiceDiscovery_EthernetPacket_MAC_Source_ICAS1Gateway, buffer_MAC);
  //EthPaket.source.ParseAddress ( buffer_MAC );
  EthPaket.source = ethGetMacAddressAsNumber (buffer_MAC);
  
  // Ethernet Packet - MAC Destination address
  getvalue (ServiceDiscovery_EthernetPacket_MAC_Destination, buffer_MAC);
  //EthPaket.destination.ParseAddress ( buffer_MAC );
  EthPaket.destination = ethGetMacAddressAsNumber (buffer_MAC);
  
  // Ethernet Packet - VLAN
  EthPaket.SetVlan (@ServiceDiscovery_EthernetPacket_VLAN_TPID, @ServiceDiscovery_EthernetPacket_VLAN_TCI);
  
  // Ethernet Packet - Type
  //EthPaket.ipv6.type = @EthernetPacket_Type;
  if (@ServiceDiscovery_EthernetPacket_Type == 0x86DD) EthPaket.ipv6.Init();
  
  
  // IPv6 Packet - Version
  EthPaket.ipv6.version = @ServiceDiscovery_IPv6Packet_Version;

  // IPv6 Packet - Traffic Class
  EthPaket.ipv6.class = @ServiceDiscovery_IPv6Packet_Traffic_Class;
  
  // IPv6 Packet - Flow Label
  EthPaket.ipv6.flow = @ServiceDiscovery_IPv6Packet_Flow_Label;
  
  // IPv6 Packet - Payload_Length
  EthPaket.ipv6.length = @ServiceDiscovery_IPv6Packet_Payload_Length;
  
  // IPv6 Packet - Next Header
  EthPaket.ipv6.next = @ServiceDiscovery_IPv6Packet_Next_Header;
  if (@ServiceDiscovery_IPv6Packet_Next_Header == 6) EthPaket.tcp.Init();
  if (@ServiceDiscovery_IPv6Packet_Next_Header == 17) EthPaket.udp.Init();
  
  // IPv6 Packet - Hop Limit
  EthPaket.ipv6.hopLimit = @ServiceDiscovery_IPv6Packet_Hop_Limit;

  // IPv6 Packet - IPv6 Destination address    // TODO: char array zu byte array
  buffer_ipv6[0]  = @ServiceDiscovery_IPv6Packet_IP_Destination_Unicast_01>>8 & 0xFF;
  buffer_ipv6[1]  = @ServiceDiscovery_IPv6Packet_IP_Destination_Unicast_01    & 0xFF;
  buffer_ipv6[2]  = @ServiceDiscovery_IPv6Packet_IP_Destination_Unicast_02>>8 & 0xFF;
  buffer_ipv6[3]  = @ServiceDiscovery_IPv6Packet_IP_Destination_Unicast_02    & 0xFF;
  buffer_ipv6[4]  = @ServiceDiscovery_IPv6Packet_IP_Destination_Unicast_03>>8 & 0xFF;
  buffer_ipv6[5]  = @ServiceDiscovery_IPv6Packet_IP_Destination_Unicast_03    & 0xFF;
  buffer_ipv6[6]  = @ServiceDiscovery_IPv6Packet_IP_Destination_Unicast_04>>8 & 0xFF;
  buffer_ipv6[7]  = @ServiceDiscovery_IPv6Packet_IP_Destination_Unicast_04    & 0xFF;
  buffer_ipv6[8]  = @ServiceDiscovery_IPv6Packet_IP_Destination_Unicast_05>>8 & 0xFF;
  buffer_ipv6[9]  = @ServiceDiscovery_IPv6Packet_IP_Destination_Unicast_05    & 0xFF;
  buffer_ipv6[10] = @ServiceDiscovery_IPv6Packet_IP_Destination_Unicast_06>>8 & 0xFF;
  buffer_ipv6[11] = @ServiceDiscovery_IPv6Packet_IP_Destination_Unicast_06    & 0xFF;
  buffer_ipv6[12] = @ServiceDiscovery_IPv6Packet_IP_Destination_Unicast_07>>8 & 0xFF;
  buffer_ipv6[13] = @ServiceDiscovery_IPv6Packet_IP_Destination_Unicast_07    & 0xFF;
  buffer_ipv6[14] = @ServiceDiscovery_IPv6Packet_IP_Destination_Unicast_08>>8 & 0xFF;
  buffer_ipv6[15] = @ServiceDiscovery_IPv6Packet_IP_Destination_Unicast_08    & 0xFF;
  EthPaket.ipv6.destination.SetData ( 0, buffer_ipv6, elcount(buffer_ipv6) );

  // IPv6 Packet - IPv6 Source address    // TODO: char array zu byte array
  buffer_ipv6[0]  = @ServiceDiscovery_IPv6Packet_IP_Source_ICAS1Gateway_01>>8 & 0xFF;
  buffer_ipv6[1]  = @ServiceDiscovery_IPv6Packet_IP_Source_ICAS1Gateway_01    & 0xFF;
  buffer_ipv6[2]  = @ServiceDiscovery_IPv6Packet_IP_Source_ICAS1Gateway_02>>8 & 0xFF;
  buffer_ipv6[3]  = @ServiceDiscovery_IPv6Packet_IP_Source_ICAS1Gateway_02    & 0xFF;
  buffer_ipv6[4]  = @ServiceDiscovery_IPv6Packet_IP_Source_ICAS1Gateway_03>>8 & 0xFF;
  buffer_ipv6[5]  = @ServiceDiscovery_IPv6Packet_IP_Source_ICAS1Gateway_03    & 0xFF;
  buffer_ipv6[6]  = @ServiceDiscovery_IPv6Packet_IP_Source_ICAS1Gateway_04>>8 & 0xFF;
  buffer_ipv6[7]  = @ServiceDiscovery_IPv6Packet_IP_Source_ICAS1Gateway_04    & 0xFF;
  buffer_ipv6[8]  = @ServiceDiscovery_IPv6Packet_IP_Source_ICAS1Gateway_05>>8 & 0xFF;
  buffer_ipv6[9]  = @ServiceDiscovery_IPv6Packet_IP_Source_ICAS1Gateway_05    & 0xFF;
  buffer_ipv6[10] = @ServiceDiscovery_IPv6Packet_IP_Source_ICAS1Gateway_06>>8 & 0xFF;
  buffer_ipv6[11] = @ServiceDiscovery_IPv6Packet_IP_Source_ICAS1Gateway_06    & 0xFF;
  buffer_ipv6[12] = @ServiceDiscovery_IPv6Packet_IP_Source_ICAS1Gateway_07>>8 & 0xFF;
  buffer_ipv6[13] = @ServiceDiscovery_IPv6Packet_IP_Source_ICAS1Gateway_07    & 0xFF;
  buffer_ipv6[14] = @ServiceDiscovery_IPv6Packet_IP_Source_ICAS1Gateway_08>>8 & 0xFF;
  buffer_ipv6[15] = @ServiceDiscovery_IPv6Packet_IP_Source_ICAS1Gateway_08    & 0xFF;
  EthPaket.ipv6.source.SetData ( 0, buffer_ipv6, elcount(buffer_ipv6) );

  
  // UDP Packet - Source Port
  EthPaket.udp.source = @LaneAssist_Notification_Port_Source;
  
  // UDP Packet - Destination Port
  EthPaket.udp.destination = @LaneAssist_Notification_Port_Destination;
  
  // UDP Packet - Length
  EthPaket.udp.length = @ServiceDiscovery_UDPPacket_Length;
  
  
  // SOME/IP Packet aus Rohdaten zusammenbauen (buffer array)
  i=0;
  
  // SOME/IP Packet - Message ID, Service ID [16 bit]
  buffer[i++] = @LaneAssist_Notification_Message_ID_Service_ID>>8 & 0xFF;
  buffer[i++] = @LaneAssist_Notification_Message_ID_Service_ID    & 0xFF;
  
  // SOME/IP Packet - Message ID, Message ID [16 bit]
  switch (MethodID)
  {
    case 0xC010: @LaneAssist_Notification_Message_ID_Method_ID = @LaneAssist_Notification_Message_ID_Method_ID_notifications; break;
  }
  buffer[i++] = @LaneAssist_Notification_Message_ID_Method_ID>>8 & 0xFF;
  buffer[i++] = @LaneAssist_Notification_Message_ID_Method_ID    & 0xFF;
  
  // SOME/IP Packet - Length [32 bit]
  if (UDP_Segments_total == 1)
  {
    switch (MethodID)
    {
      case 0xC010: @LaneAssist_Notification_Length = @LaneAssist_Notification_Length_notifications; break;
    }
  }
  else
  {
    if (UDP_Segments_left > 1)
    {
      switch (MethodID)
      {
        case 0xC010: @LaneAssist_Notification_Length = 1404; break;
      }
    }
    else
    {
      switch (MethodID)
      {
        case 0xC010: @LaneAssist_Notification_Length = LaneAssist_payload_length_notifications - 1404*(UDP_Segments_total-UDP_Segments_left) + 24; break;
      }
    }
  }
  buffer[i++] = @LaneAssist_Notification_Length>>24 & 0xFF;
  buffer[i++] = @LaneAssist_Notification_Length>>16 & 0xFF;
  buffer[i++] = @LaneAssist_Notification_Length>> 8 & 0xFF;
  buffer[i++] = @LaneAssist_Notification_Length     & 0xFF;
  
  // SOME/IP Packet - Request ID, Client ID [16 bit]
  buffer[i++] = @LaneAssist_Notification_Request_ID_Client_ID>>8 & 0xFF;
  buffer[i++] = @LaneAssist_Notification_Request_ID_Client_ID    & 0xFF;
  
  // SOME/IP Packet - Request ID, Session ID) [16 bit]
  if ((UDP_Segments_total == 1) || (seg_id_flag == 1))
  {
    @ServiceDiscovery_SOMEIPPacket_Notification_Request_ID_Session_ID = @ServiceDiscovery_SOMEIPPacket_Notification_Request_ID_Session_ID + 1;
    if (@ServiceDiscovery_SOMEIPPacket_Notification_Request_ID_Session_ID == 0x10000) @ServiceDiscovery_SOMEIPPacket_Notification_Request_ID_Session_ID = 1;
    seg_id_flag = 0;
  }
  
  buffer[i++] = @ServiceDiscovery_SOMEIPPacket_Notification_Request_ID_Session_ID>>8 & 0xFF;
  buffer[i++] = @ServiceDiscovery_SOMEIPPacket_Notification_Request_ID_Session_ID    & 0xFF;
  
  // SOME/IP Packet - Protocol Version [8 bit]
  buffer[i++] = @LaneAssist_Notification_Protocol_Version;
  
  // SOME/IP Packet - Interface Version [8 bit]
  buffer[i++] = @LaneAssist_Notification_Interface_Version;
  
  // SOME/IP Packet - Message Type [8 bit]
  buffer[i++] = @LaneAssist_Notification_Message_Type;
  
  // SOME/IP Packet - Return Code [8 bit]
  buffer[i++] = @LaneAssist_Notification_Return_Code;
  
  
  if (UDP_Segments_total > 1)
  {
    if (UDP_Segments_left >= 0)
    { 
      // Message Type neu setzen
      buffer[i-2] = @LaneAssist_Notification_Message_Type + 0x20;
      
      // Offset (16byte Schritte, 1392/16 = 87)
      @LaneAssist_Notification_Offset = 87 * (UDP_Segments_total - UDP_Segments_left);
      
      // More Segments Flag
      if (UDP_Segments_left > 1) @LaneAssist_Notification_More_Segments_Flag = 1;
      else                       @LaneAssist_Notification_More_Segments_Flag = 0;
      
      buffer[i++] =   @LaneAssist_Notification_Offset>>20 & 0xFF;
      buffer[i++] =   @LaneAssist_Notification_Offset>>12 & 0xFF;
      buffer[i++] =   @LaneAssist_Notification_Offset>>4  & 0xFF;
      buffer[i++] = ((@LaneAssist_Notification_Offset<<4) & 0xF0) + (@LaneAssist_Notification_More_Segments_Flag & 0x01);
    }
  }
  
  UDP_Segments_left--;
  
  ////// notifications notifier //////
  if (MethodID == 0xC010)
  {
    if (UDP_Segments_total == 1)
    {
      for (j=0; j<LaneAssist_payload_length_notifications; j++)
        buffer[i++] = LaneAssist_payload_buffer_notifications[j];
    }
    else
    {
      if (UDP_Segments_left >= 1)
      {
        for (j=(UDP_Segments_total-UDP_Segments_left-1)*1392; j<(UDP_Segments_total-UDP_Segments_left)*1392; j++)
          buffer[i++] = LaneAssist_payload_buffer_notifications[j];
      }
      else
      {
        for (j=(UDP_Segments_total-(UDP_Segments_left+1))*1392; j<LaneAssist_payload_length_notifications; j++)
          buffer[i++] = LaneAssist_payload_buffer_notifications[j];
      }
    }
  }
  
  
  // Rohdaten in UDP Paket schreiben
  EthPaket.udp.SetData( 0, buffer, i );

  // calculate UDP and IPv6 checksum and send Ethernet packet
  EthPaket.CompletePacket();
  output( EthPaket );
  
  // prüfen ob alle Segemente gesendet wurden, sonst senden erneut aufrufen
  LaneAssist_Segmentation_Method_ID = MethodID;
  if (UDP_Segments_left>0)
    settimer(LaneAssist_Segmentation_delay, 50);
}

on timer LaneAssist_Segmentation_delay
{
  Send_Service_LaneAssist_Notification (LaneAssist_Segmentation_Method_ID);
}






////////// notifications Notification //////////

on envVar LaneAssist_Notification_LengthIndicator_Struct_notifications
{
  LaneAssist_Notification_notifications();
}
on envVar LaneAssist_Notification_LengthIndicator_Element_notifications
{
  LaneAssist_Notification_notifications();
}
on envVar LaneAssist_Notification_notifications_type
{
  LaneAssist_array_notifications_type[@LaneAssist_Notification_notifications_Element] = @this;
  LaneAssist_Notification_notifications();
}
on envVar LaneAssist_Notification_notifications_value
{
  LaneAssist_array_notifications_value[@LaneAssist_Notification_notifications_Element] = @this;
  LaneAssist_Notification_notifications();
}
on envVar LaneAssist_Notification_notifications_type_available
{
  LaneAssist_array_notifications_type_available[@LaneAssist_Notification_notifications_Element] = @this;
  LaneAssist_Notification_notifications();
}
on envVar LaneAssist_Notification_notifications_value_available
{
  LaneAssist_array_notifications_value_available[@LaneAssist_Notification_notifications_Element] = @this;
  LaneAssist_Notification_notifications();
}
on envVar LaneAssist_Notification_notifications_Payload
{
  LaneAssist_Notification_notifications_update();
}


LaneAssist_Notification_notifications()
{
  word payload_counter = 0;
  word start_pos       = 0;
  word element_length  = 0;
  
  // Length Indicator Struct - Platzhalter
  payload_counter = 0+4;
  start_pos = 0;
  
  for (j=0; j<@LaneAssist_Notification_notifications_Element_TotalNum; j++)
  {
    LaneAssist_array_notifications_available_functions[j] = LaneAssist_array_notifications_type_available[j]
                                                          + LaneAssist_array_notifications_value_available[j];
    
    // Length Indicator Element - Platzhalter
    if (LaneAssist_array_notifications_available_functions[j] > 0)
    {
      start_pos = payload_counter;
      payload_counter = payload_counter + 4;
    }
    else 
      start_pos = payload_counter;
    
    
    // 0 type (enum32)
    if (LaneAssist_array_notifications_type_available[j] == 1)
    {
      tag_dataID = 0;
      LaneAssist_payload_buffer_notifications[payload_counter++] = 2 * 16 /* Wiretype = 2  =^ 32 Bit */ + ((tag_dataID>>8) & 0x0F) /* DataID High Part */ ;
      LaneAssist_payload_buffer_notifications[payload_counter++] = tag_dataID & 0xFF /* DataID Low Part */ ;
      
      LaneAssist_payload_buffer_notifications[payload_counter++] = LaneAssist_array_notifications_type[j]>>24 & 0xFF;
      LaneAssist_payload_buffer_notifications[payload_counter++] = LaneAssist_array_notifications_type[j]>>16 & 0xFF;
      LaneAssist_payload_buffer_notifications[payload_counter++] = LaneAssist_array_notifications_type[j]>> 8 & 0xFF;
      LaneAssist_payload_buffer_notifications[payload_counter++] = LaneAssist_array_notifications_type[j]     & 0xFF;
    }
    
    
    // 1 value (uint32)
    if (LaneAssist_array_notifications_value_available[j] == 1)
    {
      tag_dataID = 1;
      LaneAssist_payload_buffer_notifications[payload_counter++] = 2 * 16 /* Wiretype = 2  =^ 32 Bit */ + ((tag_dataID>>8) & 0x0F) /* DataID High Part */ ;
      LaneAssist_payload_buffer_notifications[payload_counter++] = tag_dataID & 0xFF /* DataID Low Part */ ;
      
      LaneAssist_payload_buffer_notifications[payload_counter++] = LaneAssist_array_notifications_value[j]>>24 & 0xFF;
      LaneAssist_payload_buffer_notifications[payload_counter++] = LaneAssist_array_notifications_value[j]>>16 & 0xFF;
      LaneAssist_payload_buffer_notifications[payload_counter++] = LaneAssist_array_notifications_value[j]>> 8 & 0xFF;
      LaneAssist_payload_buffer_notifications[payload_counter++] = LaneAssist_array_notifications_value[j]     & 0xFF;
    }
    
    
    //Element Length
    element_length = payload_counter-start_pos;
    if (element_length >0) LaneAssist_array_notifications_array_element_length[j] = element_length - 4;
    else                   LaneAssist_array_notifications_array_element_length[j] = element_length;
    
    LaneAssist_payload_buffer_notifications[start_pos++] = LaneAssist_array_notifications_array_element_length[j]>>24 & 0xFF;
    LaneAssist_payload_buffer_notifications[start_pos++] = LaneAssist_array_notifications_array_element_length[j]>>16 & 0xFF;
    LaneAssist_payload_buffer_notifications[start_pos++] = LaneAssist_array_notifications_array_element_length[j]>> 8 & 0xFF;
    LaneAssist_payload_buffer_notifications[start_pos++] = LaneAssist_array_notifications_array_element_length[j]     & 0xFF;
    
    if (LaneAssist_array_notifications_array_element_length[j] == 0) payload_counter = payload_counter+4;
  }
  
  // Struct Length
  LaneAssist_array_notifications_struct_element_length = 4*@LaneAssist_Notification_notifications_Element_TotalNum;

  for (k=0;k<@LaneAssist_Notification_notifications_Element_TotalNum;k++)
    LaneAssist_array_notifications_struct_element_length = LaneAssist_array_notifications_struct_element_length + LaneAssist_array_notifications_array_element_length[k];
  
  LaneAssist_payload_buffer_notifications[0] = LaneAssist_array_notifications_struct_element_length>>24 & 0xFF;
  LaneAssist_payload_buffer_notifications[1] = LaneAssist_array_notifications_struct_element_length>>16 & 0xFF;
  LaneAssist_payload_buffer_notifications[2] = LaneAssist_array_notifications_struct_element_length>> 8 & 0xFF;
  LaneAssist_payload_buffer_notifications[3] = LaneAssist_array_notifications_struct_element_length     & 0xFF;


  LaneAssist_payload_length_notifications = LaneAssist_array_notifications_struct_element_length+4;
  putvalue(LaneAssist_Notification_notifications_Payload, LaneAssist_payload_buffer_notifications, LaneAssist_payload_length_notifications);
}

on envVar LaneAssist_Notification_notifications_Element_TotalNum
{
  if (@this == 0) @this =  1;
  if (@this > 10) @this = 10;
  
  LaneAssist_Notification_notifications();
  LaneAssist_Notification_notifications_update();
}

on envVar LaneAssist_Notification_notifications_Element
{
  LaneAssist_Notification_notifications_update();
}

on envVar LaneAssist_Notification_notifications_Element_Next
{
  if (@this == 1 && @LaneAssist_Notification_notifications_Element < @LaneAssist_Notification_notifications_Element_TotalNum - 1)
  {
    @LaneAssist_Notification_notifications_Element = @LaneAssist_Notification_notifications_Element + 1;
    LaneAssist_Notification_notifications_update();
  }
}

on envVar LaneAssist_Notification_notifications_Element_Previous
{
  if (@this == 1 && @LaneAssist_Notification_notifications_Element > 0)
  {
    @LaneAssist_Notification_notifications_Element = @LaneAssist_Notification_notifications_Element - 1;
    LaneAssist_Notification_notifications_update();
  }
}

LaneAssist_Notification_notifications_update()
{
  @LaneAssist_Notification_LengthIndicator_Element_notifications = LaneAssist_array_notifications_array_element_length[@LaneAssist_Notification_notifications_Element];
  @LaneAssist_Notification_LengthIndicator_Struct_notifications  = LaneAssist_array_notifications_struct_element_length;
  @LaneAssist_Notification_Length_notifications                  = LaneAssist_payload_length_notifications+8;
  
  @LaneAssist_Notification_notifications_type  = LaneAssist_array_notifications_type[@LaneAssist_Notification_notifications_Element];
  @LaneAssist_Notification_notifications_value = LaneAssist_array_notifications_value[@LaneAssist_Notification_notifications_Element];
  
  @LaneAssist_Notification_notifications_type_available  = LaneAssist_array_notifications_type_available[@LaneAssist_Notification_notifications_Element];
  @LaneAssist_Notification_notifications_value_available = LaneAssist_array_notifications_value_available[@LaneAssist_Notification_notifications_Element];
}








//////////////////////////////////////////////////////////
////////////////// Service TravelAssist //////////////////
//////////////////////////////////////////////////////////

on envVar ServiceDiscovery_Offer_Service_TravelAssist
{
  Send_ServiceDiscovery_Offer_Service_ICAS1Gateway();
}

on envVar TravelAssist_Notification_notifications_Send
{
  if (@this == 1)
  {
    UDP_Segments_total = @TravelAssist_Notification_Length_notifications/1404 + 1;
    UDP_Segments_left  = UDP_Segments_total;
    
    if (UDP_Segments_total > 1) seg_id_flag = 1;
    else                        seg_id_flag = 0;
    
    Send_Service_TravelAssist_Notification (0xC010 & 0x0000FFFF);
  }
}
on envVar TravelAssist_Notification_notifications_Send_cyclic
{
  if (@this == 1)
    setTimercyclic (tTravelAssist_Notification_notifications_Send, @TravelAssist_Notification_notifications_Send_cyclic_cycletime);
  else
    cancelTimer (tTravelAssist_Notification_notifications_Send);
}
on envVar TravelAssist_Notification_notifications_Send_cyclic_cycletime
{
  if (@TravelAssist_Notification_notifications_Send_cyclic == 1)
  {
    cancelTimer (tTravelAssist_Notification_notifications_Send);
    setTimercyclic (tTravelAssist_Notification_notifications_Send, @this);
  }
}
on timer tTravelAssist_Notification_notifications_Send
{
  UDP_Segments_total = @TravelAssist_Notification_Length_notifications/1404 + 1;
  UDP_Segments_left  = UDP_Segments_total;
  
  if (UDP_Segments_total > 1) seg_id_flag = 1;
  else                        seg_id_flag = 0;
    
  Send_Service_TravelAssist_Notification (0xC010 & 0x0000FFFF);
}

on envVar TravelAssist_Notification_lanes_Send
{
  if (@this == 1)
  {
    UDP_Segments_total = @TravelAssist_Notification_Length_lanes/1404 + 1;
    UDP_Segments_left  = UDP_Segments_total;
    
    if (UDP_Segments_total > 1) seg_id_flag = 1;
    else                        seg_id_flag = 0;
    
    Send_Service_TravelAssist_Notification (0xC020 & 0x0000FFFF);
  }
}
on envVar TravelAssist_Notification_lanes_Send_cyclic
{
  if (@this == 1)
    setTimercyclic (tTravelAssist_Notification_lanes_Send, @TravelAssist_Notification_lanes_Send_cyclic_cycletime);
  else
    cancelTimer (tTravelAssist_Notification_lanes_Send);
}
on envVar TravelAssist_Notification_lanes_Send_cyclic_cycletime
{
  if (@TravelAssist_Notification_lanes_Send_cyclic == 1)
  {
    cancelTimer (tTravelAssist_Notification_lanes_Send);
    setTimercyclic (tTravelAssist_Notification_lanes_Send, @this);
  }
}
on timer tTravelAssist_Notification_lanes_Send
{
  UDP_Segments_total = @TravelAssist_Notification_Length_lanes/1404 + 1;
  UDP_Segments_left  = UDP_Segments_total;
  
  if (UDP_Segments_total > 1) seg_id_flag = 1;
  else                        seg_id_flag = 0;
    
  Send_Service_TravelAssist_Notification (0xC020 & 0x0000FFFF);
}

on envVar TravelAssist_Notification_curveParameters_Send
{
  if (@this == 1)
  {
    UDP_Segments_total = @TravelAssist_Notification_Length_curveParameters/1404 + 1;
    UDP_Segments_left  = UDP_Segments_total;
    
    if (UDP_Segments_total > 1) seg_id_flag = 1;
    else                        seg_id_flag = 0;
    
    Send_Service_TravelAssist_Notification (0xC030 & 0x0000FFFF);
  }
}
on envVar TravelAssist_Notification_curveParameters_Send_cyclic
{
  if (@this == 1)
    setTimercyclic (tTravelAssist_Notification_curveParameters_Send, @TravelAssist_Notification_curveParameters_Send_cyclic_cycletime);
  else
    cancelTimer (tTravelAssist_Notification_curveParameters_Send);
}
on envVar TravelAssist_Notification_curveParameters_Send_cyclic_cycletime
{
  if (@TravelAssist_Notification_curveParameters_Send_cyclic == 1)
  {
    cancelTimer (tTravelAssist_Notification_curveParameters_Send);
    setTimercyclic (tTravelAssist_Notification_curveParameters_Send, @this);
  }
}
on timer tTravelAssist_Notification_curveParameters_Send
{
  UDP_Segments_total = @TravelAssist_Notification_Length_curveParameters/1404 + 1;
  UDP_Segments_left  = UDP_Segments_total;
  
  if (UDP_Segments_total > 1) seg_id_flag = 1;
  else                        seg_id_flag = 0;
    
  Send_Service_TravelAssist_Notification (0xC030 & 0x0000FFFF);
}

on envVar TravelAssist_Notification_info_Send
{
  if (@this == 1)
  {
    UDP_Segments_total = @TravelAssist_Notification_Length_info/1404 + 1;
    UDP_Segments_left  = UDP_Segments_total;
    
    if (UDP_Segments_total > 1) seg_id_flag = 1;
    else                        seg_id_flag = 0;
    
    Send_Service_TravelAssist_Notification (0xC040 & 0x0000FFFF);
  }
}
on envVar TravelAssist_Notification_info_Send_cyclic
{
  if (@this == 1)
    setTimercyclic (tTravelAssist_Notification_info_Send, @TravelAssist_Notification_info_Send_cyclic_cycletime);
  else
    cancelTimer (tTravelAssist_Notification_info_Send);
}
on envVar TravelAssist_Notification_info_Send_cyclic_cycletime
{
  if (@TravelAssist_Notification_info_Send_cyclic == 1)
  {
    cancelTimer (tTravelAssist_Notification_info_Send);
    setTimercyclic (tTravelAssist_Notification_info_Send, @this);
  }
}
on timer tTravelAssist_Notification_info_Send
{
  UDP_Segments_total = @TravelAssist_Notification_Length_info/1404 + 1;
  UDP_Segments_left  = UDP_Segments_total;
  
  if (UDP_Segments_total > 1) seg_id_flag = 1;
  else                        seg_id_flag = 0;
    
  Send_Service_TravelAssist_Notification (0xC040 & 0x0000FFFF);
}

on envVar TravelAssist_Notification_relevantObjects_Send
{
  if (@this == 1)
  {
    UDP_Segments_total = @TravelAssist_Notification_Length_relevantObjects/1404 + 1;
    UDP_Segments_left  = UDP_Segments_total;
    
    if (UDP_Segments_total > 1) seg_id_flag = 1;
    else                        seg_id_flag = 0;
    
    Send_Service_TravelAssist_Notification (0xC050 & 0x0000FFFF);
  }
}
on envVar TravelAssist_Notification_relevantObjects_Send_cyclic
{
  if (@this == 1)
    setTimercyclic (tTravelAssist_Notification_relevantObjects_Send, @TravelAssist_Notification_relevantObjects_Send_cyclic_cycletime);
  else
    cancelTimer (tTravelAssist_Notification_relevantObjects_Send);
}
on envVar TravelAssist_Notification_relevantObjects_Send_cyclic_cycletime
{
  if (@TravelAssist_Notification_relevantObjects_Send_cyclic == 1)
  {
    cancelTimer (tTravelAssist_Notification_relevantObjects_Send);
    setTimercyclic (tTravelAssist_Notification_relevantObjects_Send, @this);
  }
}
on timer tTravelAssist_Notification_relevantObjects_Send
{
  UDP_Segments_total = @TravelAssist_Notification_Length_relevantObjects/1404 + 1;
  UDP_Segments_left  = UDP_Segments_total;
  
  if (UDP_Segments_total > 1) seg_id_flag = 1;
  else                        seg_id_flag = 0;
    
  Send_Service_TravelAssist_Notification (0xC050 & 0x0000FFFF);
}


Send_Service_TravelAssist_Notification (word MethodID)
{
  ethernetPacket EthPaket;

  // Ethernet Packet - MAC Source address
  getvalue (ServiceDiscovery_EthernetPacket_MAC_Source_ICAS1Gateway, buffer_MAC);
  //EthPaket.source.ParseAddress ( buffer_MAC );
  EthPaket.source = ethGetMacAddressAsNumber (buffer_MAC);
  
  // Ethernet Packet - MAC Destination address
  getvalue (ServiceDiscovery_EthernetPacket_MAC_Destination, buffer_MAC);
  //EthPaket.destination.ParseAddress ( buffer_MAC );
  EthPaket.destination = ethGetMacAddressAsNumber (buffer_MAC);
  
  // Ethernet Packet - VLAN
  EthPaket.SetVlan (@ServiceDiscovery_EthernetPacket_VLAN_TPID, @ServiceDiscovery_EthernetPacket_VLAN_TCI);
  
  // Ethernet Packet - Type
  //EthPaket.ipv6.type = @EthernetPacket_Type;
  if (@ServiceDiscovery_EthernetPacket_Type == 0x86DD) EthPaket.ipv6.Init();
  
  
  // IPv6 Packet - Version
  EthPaket.ipv6.version = @ServiceDiscovery_IPv6Packet_Version;

  // IPv6 Packet - Traffic Class
  EthPaket.ipv6.class = @ServiceDiscovery_IPv6Packet_Traffic_Class;
  
  // IPv6 Packet - Flow Label
  EthPaket.ipv6.flow = @ServiceDiscovery_IPv6Packet_Flow_Label;
  
  // IPv6 Packet - Payload_Length
  EthPaket.ipv6.length = @ServiceDiscovery_IPv6Packet_Payload_Length;
  
  // IPv6 Packet - Next Header
  EthPaket.ipv6.next = @ServiceDiscovery_IPv6Packet_Next_Header;
  if (@ServiceDiscovery_IPv6Packet_Next_Header == 6) EthPaket.tcp.Init();
  if (@ServiceDiscovery_IPv6Packet_Next_Header == 17) EthPaket.udp.Init();
  
  // IPv6 Packet - Hop Limit
  EthPaket.ipv6.hopLimit = @ServiceDiscovery_IPv6Packet_Hop_Limit;

  // IPv6 Packet - IPv6 Destination address    // TODO: char array zu byte array
  buffer_ipv6[0]  = @ServiceDiscovery_IPv6Packet_IP_Destination_Unicast_01>>8 & 0xFF;
  buffer_ipv6[1]  = @ServiceDiscovery_IPv6Packet_IP_Destination_Unicast_01    & 0xFF;
  buffer_ipv6[2]  = @ServiceDiscovery_IPv6Packet_IP_Destination_Unicast_02>>8 & 0xFF;
  buffer_ipv6[3]  = @ServiceDiscovery_IPv6Packet_IP_Destination_Unicast_02    & 0xFF;
  buffer_ipv6[4]  = @ServiceDiscovery_IPv6Packet_IP_Destination_Unicast_03>>8 & 0xFF;
  buffer_ipv6[5]  = @ServiceDiscovery_IPv6Packet_IP_Destination_Unicast_03    & 0xFF;
  buffer_ipv6[6]  = @ServiceDiscovery_IPv6Packet_IP_Destination_Unicast_04>>8 & 0xFF;
  buffer_ipv6[7]  = @ServiceDiscovery_IPv6Packet_IP_Destination_Unicast_04    & 0xFF;
  buffer_ipv6[8]  = @ServiceDiscovery_IPv6Packet_IP_Destination_Unicast_05>>8 & 0xFF;
  buffer_ipv6[9]  = @ServiceDiscovery_IPv6Packet_IP_Destination_Unicast_05    & 0xFF;
  buffer_ipv6[10] = @ServiceDiscovery_IPv6Packet_IP_Destination_Unicast_06>>8 & 0xFF;
  buffer_ipv6[11] = @ServiceDiscovery_IPv6Packet_IP_Destination_Unicast_06    & 0xFF;
  buffer_ipv6[12] = @ServiceDiscovery_IPv6Packet_IP_Destination_Unicast_07>>8 & 0xFF;
  buffer_ipv6[13] = @ServiceDiscovery_IPv6Packet_IP_Destination_Unicast_07    & 0xFF;
  buffer_ipv6[14] = @ServiceDiscovery_IPv6Packet_IP_Destination_Unicast_08>>8 & 0xFF;
  buffer_ipv6[15] = @ServiceDiscovery_IPv6Packet_IP_Destination_Unicast_08    & 0xFF;
  EthPaket.ipv6.destination.SetData ( 0, buffer_ipv6, elcount(buffer_ipv6) );

  // IPv6 Packet - IPv6 Source address    // TODO: char array zu byte array
  buffer_ipv6[0]  = @ServiceDiscovery_IPv6Packet_IP_Source_ICAS1Gateway_01>>8 & 0xFF;
  buffer_ipv6[1]  = @ServiceDiscovery_IPv6Packet_IP_Source_ICAS1Gateway_01    & 0xFF;
  buffer_ipv6[2]  = @ServiceDiscovery_IPv6Packet_IP_Source_ICAS1Gateway_02>>8 & 0xFF;
  buffer_ipv6[3]  = @ServiceDiscovery_IPv6Packet_IP_Source_ICAS1Gateway_02    & 0xFF;
  buffer_ipv6[4]  = @ServiceDiscovery_IPv6Packet_IP_Source_ICAS1Gateway_03>>8 & 0xFF;
  buffer_ipv6[5]  = @ServiceDiscovery_IPv6Packet_IP_Source_ICAS1Gateway_03    & 0xFF;
  buffer_ipv6[6]  = @ServiceDiscovery_IPv6Packet_IP_Source_ICAS1Gateway_04>>8 & 0xFF;
  buffer_ipv6[7]  = @ServiceDiscovery_IPv6Packet_IP_Source_ICAS1Gateway_04    & 0xFF;
  buffer_ipv6[8]  = @ServiceDiscovery_IPv6Packet_IP_Source_ICAS1Gateway_05>>8 & 0xFF;
  buffer_ipv6[9]  = @ServiceDiscovery_IPv6Packet_IP_Source_ICAS1Gateway_05    & 0xFF;
  buffer_ipv6[10] = @ServiceDiscovery_IPv6Packet_IP_Source_ICAS1Gateway_06>>8 & 0xFF;
  buffer_ipv6[11] = @ServiceDiscovery_IPv6Packet_IP_Source_ICAS1Gateway_06    & 0xFF;
  buffer_ipv6[12] = @ServiceDiscovery_IPv6Packet_IP_Source_ICAS1Gateway_07>>8 & 0xFF;
  buffer_ipv6[13] = @ServiceDiscovery_IPv6Packet_IP_Source_ICAS1Gateway_07    & 0xFF;
  buffer_ipv6[14] = @ServiceDiscovery_IPv6Packet_IP_Source_ICAS1Gateway_08>>8 & 0xFF;
  buffer_ipv6[15] = @ServiceDiscovery_IPv6Packet_IP_Source_ICAS1Gateway_08    & 0xFF;
  EthPaket.ipv6.source.SetData ( 0, buffer_ipv6, elcount(buffer_ipv6) );

  
  // UDP Packet - Source Port
  EthPaket.udp.source = @TravelAssist_Notification_Port_Source;
  
  // UDP Packet - Destination Port
  EthPaket.udp.destination = @TravelAssist_Notification_Port_Destination;
  
  // UDP Packet - Length
  EthPaket.udp.length = @ServiceDiscovery_UDPPacket_Length;
  
  
  // SOME/IP Packet aus Rohdaten zusammenbauen (buffer array)
  i=0;
  
  // SOME/IP Packet - Message ID, Service ID [16 bit]
  buffer[i++] = @TravelAssist_Notification_Message_ID_Service_ID>>8 & 0xFF;
  buffer[i++] = @TravelAssist_Notification_Message_ID_Service_ID    & 0xFF;
  
  // SOME/IP Packet - Message ID, Message ID [16 bit]
  switch (MethodID)
  {
    case 0xC010: @TravelAssist_Notification_Message_ID_Method_ID = @TravelAssist_Notification_Message_ID_Method_ID_notifications; break;
    case 0xC020: @TravelAssist_Notification_Message_ID_Method_ID = @TravelAssist_Notification_Message_ID_Method_ID_lanes; break;
    case 0xC030: @TravelAssist_Notification_Message_ID_Method_ID = @TravelAssist_Notification_Message_ID_Method_ID_curveParameters; break;
    case 0xC040: @TravelAssist_Notification_Message_ID_Method_ID = @TravelAssist_Notification_Message_ID_Method_ID_info; break;
    case 0xC050: @TravelAssist_Notification_Message_ID_Method_ID = @TravelAssist_Notification_Message_ID_Method_ID_relevantObjects; break;
  }
  buffer[i++] = @TravelAssist_Notification_Message_ID_Method_ID>>8 & 0xFF;
  buffer[i++] = @TravelAssist_Notification_Message_ID_Method_ID    & 0xFF;
  
  // SOME/IP Packet - Length [32 bit]
  if (UDP_Segments_total == 1)
  {
    switch (MethodID)
    {
      case 0xC010: @TravelAssist_Notification_Length = @TravelAssist_Notification_Length_notifications; break;
      case 0xC020: @TravelAssist_Notification_Length = @TravelAssist_Notification_Length_lanes; break;
      case 0xC030: @TravelAssist_Notification_Length = @TravelAssist_Notification_Length_curveParameters; break;
      case 0xC040: @TravelAssist_Notification_Length = @TravelAssist_Notification_Length_info; break;
      case 0xC050: @TravelAssist_Notification_Length = @TravelAssist_Notification_Length_relevantObjects; break;
    }
  }
  else
  {
    if (UDP_Segments_left > 1)
    {
      switch (MethodID)
      {
        case 0xC010: @TravelAssist_Notification_Length = 1404; break;
        case 0xC020: @TravelAssist_Notification_Length = 1404; break;
        case 0xC030: @TravelAssist_Notification_Length = 1404; break;
        case 0xC040: @TravelAssist_Notification_Length = 1404; break;
        case 0xC050: @TravelAssist_Notification_Length = 1404; break;
      }
    }
    else
    {
      switch (MethodID)
      {
        case 0xC010: @TravelAssist_Notification_Length = TravelAssist_payload_length_notifications   - 1404*(UDP_Segments_total-UDP_Segments_left) + 24; break;
        case 0xC020: @TravelAssist_Notification_Length = TravelAssist_payload_length_lanes           - 1404*(UDP_Segments_total-UDP_Segments_left) + 24; break;
        case 0xC030: @TravelAssist_Notification_Length = TravelAssist_payload_length_curveParameters - 1404*(UDP_Segments_total-UDP_Segments_left) + 24; break;
        case 0xC040: @TravelAssist_Notification_Length = TravelAssist_payload_length_info             - 1404*(UDP_Segments_total-UDP_Segments_left) + 24; break;
        case 0xC050: @TravelAssist_Notification_Length = TravelAssist_payload_length_relevantObjects - 1404*(UDP_Segments_total-UDP_Segments_left) + 24; break;
      }
    }
  }
  buffer[i++] = @TravelAssist_Notification_Length>>24 & 0xFF;
  buffer[i++] = @TravelAssist_Notification_Length>>16 & 0xFF;
  buffer[i++] = @TravelAssist_Notification_Length>> 8 & 0xFF;
  buffer[i++] = @TravelAssist_Notification_Length     & 0xFF;
  
  // SOME/IP Packet - Request ID, Client ID [16 bit]
  buffer[i++] = @TravelAssist_Notification_Request_ID_Client_ID>>8 & 0xFF;
  buffer[i++] = @TravelAssist_Notification_Request_ID_Client_ID    & 0xFF;
  
  // SOME/IP Packet - Request ID, Session ID) [16 bit]
  if ((UDP_Segments_total == 1) || (seg_id_flag == 1))
  {
    @ServiceDiscovery_SOMEIPPacket_Notification_Request_ID_Session_ID = @ServiceDiscovery_SOMEIPPacket_Notification_Request_ID_Session_ID + 1;
    if (@ServiceDiscovery_SOMEIPPacket_Notification_Request_ID_Session_ID == 0x10000) @ServiceDiscovery_SOMEIPPacket_Notification_Request_ID_Session_ID = 1;
    seg_id_flag = 0;
  }
  
  buffer[i++] = @ServiceDiscovery_SOMEIPPacket_Notification_Request_ID_Session_ID>>8 & 0xFF;
  buffer[i++] = @ServiceDiscovery_SOMEIPPacket_Notification_Request_ID_Session_ID    & 0xFF;
  
  // SOME/IP Packet - Protocol Version [8 bit]
  buffer[i++] = @TravelAssist_Notification_Protocol_Version;
  
  // SOME/IP Packet - Interface Version [8 bit]
  buffer[i++] = @TravelAssist_Notification_Interface_Version;
  
  // SOME/IP Packet - Message Type [8 bit]
  buffer[i++] = @TravelAssist_Notification_Message_Type;
  
  // SOME/IP Packet - Return Code [8 bit]
  buffer[i++] = @TravelAssist_Notification_Return_Code;
  
  
  if (UDP_Segments_total > 1)
  {
    if (UDP_Segments_left >= 0)
    { 
      // Message Type neu setzen
      buffer[i-2] = @TravelAssist_Notification_Message_Type + 0x20;
      
      // Offset (16byte Schritte, 1392/16 = 87)
      @TravelAssist_Notification_Offset = 87 * (UDP_Segments_total - UDP_Segments_left);
      
      // More Segments Flag
      if (UDP_Segments_left > 1) @TravelAssist_Notification_More_Segments_Flag = 1;
      else                       @TravelAssist_Notification_More_Segments_Flag = 0;
      
      buffer[i++] =   @TravelAssist_Notification_Offset>>20 & 0xFF;
      buffer[i++] =   @TravelAssist_Notification_Offset>>12 & 0xFF;
      buffer[i++] =   @TravelAssist_Notification_Offset>>4  & 0xFF;
      buffer[i++] = ((@TravelAssist_Notification_Offset<<4) & 0xF0) + (@TravelAssist_Notification_More_Segments_Flag & 0x01);
    }
  }
  
  UDP_Segments_left--;
  
  ////// notifications notifier //////
  if (MethodID == 0xC010)
  {
    if (UDP_Segments_total == 1)
    {
      for (j=0; j<TravelAssist_payload_length_notifications; j++)
        buffer[i++] = TravelAssist_payload_buffer_notifications[j];
    }
    else
    {
      if (UDP_Segments_left >= 1)
      {
        for (j=(UDP_Segments_total-UDP_Segments_left-1)*1392; j<(UDP_Segments_total-UDP_Segments_left)*1392; j++)
          buffer[i++] = TravelAssist_payload_buffer_notifications[j];
      }
      else
      {
        for (j=(UDP_Segments_total-(UDP_Segments_left+1))*1392; j<TravelAssist_payload_length_notifications; j++)
          buffer[i++] = TravelAssist_payload_buffer_notifications[j];
      }
    }
  }
  
  ////// lanes notifier //////
  if (MethodID == 0xC020)
  {
    if (UDP_Segments_total == 1)
    {
      for (j=0; j<TravelAssist_payload_length_lanes; j++)
        buffer[i++] = TravelAssist_payload_buffer_lanes[j];
    }
    else
    {
      if (UDP_Segments_left >= 1)
      {
        for (j=(UDP_Segments_total-UDP_Segments_left-1)*1392; j<(UDP_Segments_total-UDP_Segments_left)*1392; j++)
          buffer[i++] = TravelAssist_payload_buffer_lanes[j];
      }
      else
      {
        for (j=(UDP_Segments_total-(UDP_Segments_left+1))*1392; j<TravelAssist_payload_length_lanes; j++)
          buffer[i++] = TravelAssist_payload_buffer_lanes[j];
      }
    }
  }
  
  ////// curveParameters notifier //////
  if (MethodID == 0xC030)
  {
    if (UDP_Segments_total == 1)
    {
      for (j=0; j<TravelAssist_payload_length_curveParameters; j++)
        buffer[i++] = TravelAssist_payload_buffer_curveParameters[j];
    }
    else
    {
      if (UDP_Segments_left >= 1)
      {
        for (j=(UDP_Segments_total-UDP_Segments_left-1)*1392; j<(UDP_Segments_total-UDP_Segments_left)*1392; j++)
          buffer[i++] = TravelAssist_payload_buffer_curveParameters[j];
      }
      else
      {
        for (j=(UDP_Segments_total-(UDP_Segments_left+1))*1392; j<TravelAssist_payload_length_curveParameters; j++)
          buffer[i++] = TravelAssist_payload_buffer_curveParameters[j];
      }
    }
  }
  
  ////// info notifier //////
  if (MethodID == 0xC040)
  {
    if (UDP_Segments_total == 1)
    {
      for (j=0; j<TravelAssist_payload_length_info; j++)
        buffer[i++] = TravelAssist_payload_buffer_info[j];
    }
    else
    {
      if (UDP_Segments_left >= 1)
      {
        for (j=(UDP_Segments_total-UDP_Segments_left-1)*1392; j<(UDP_Segments_total-UDP_Segments_left)*1392; j++)
          buffer[i++] = TravelAssist_payload_buffer_info[j];
      }
      else
      {
        for (j=(UDP_Segments_total-(UDP_Segments_left+1))*1392; j<TravelAssist_payload_length_info; j++)
          buffer[i++] = TravelAssist_payload_buffer_info[j];
      }
    }
  }
  
  ////// relevantObjects notifier //////
  if (MethodID == 0xC050)
  {
    if (UDP_Segments_total == 1)
    {
      for (j=0; j<TravelAssist_payload_length_relevantObjects; j++)
        buffer[i++] = TravelAssist_payload_buffer_relevantObjects[j];
    }
    else
    {
      if (UDP_Segments_left >= 1)
      {
        for (j=(UDP_Segments_total-UDP_Segments_left-1)*1392; j<(UDP_Segments_total-UDP_Segments_left)*1392; j++)
          buffer[i++] = TravelAssist_payload_buffer_relevantObjects[j];
      }
      else
      {
        for (j=(UDP_Segments_total-(UDP_Segments_left+1))*1392; j<TravelAssist_payload_length_relevantObjects; j++)
          buffer[i++] = TravelAssist_payload_buffer_relevantObjects[j];
      }
    }
  }
   
  
  // Rohdaten in UDP Paket schreiben
  EthPaket.udp.SetData( 0, buffer, i );

  // calculate UDP and IPv6 checksum and send Ethernet packet
  EthPaket.CompletePacket();
  output( EthPaket );
  
  // prüfen ob alle Segemente gesendet wurden, sonst senden erneut aufrufen
  TravelAssist_Segmentation_Method_ID = MethodID;
  if (UDP_Segments_left>0)
    settimer(TravelAssist_Segmentation_delay, 50);
}

on timer TravelAssist_Segmentation_delay
{
  Send_Service_TravelAssist_Notification (TravelAssist_Segmentation_Method_ID);
}






////////// notifications Notification //////////

on envVar TravelAssist_Notification_LengthIndicator_Struct_notifications
{
  TravelAssist_Notification_notifications();
}
on envVar TravelAssist_Notification_LengthIndicator_Element_notifications
{
  TravelAssist_Notification_notifications();
}
on envVar TravelAssist_Notification_notifications_type
{
  TravelAssist_array_notifications_type[@TravelAssist_Notification_notifications_Element] = @this;
  TravelAssist_Notification_notifications();
}
on envVar TravelAssist_Notification_notifications_value
{
  TravelAssist_array_notifications_value[@TravelAssist_Notification_notifications_Element] = @this;
  TravelAssist_Notification_notifications();
}
on envVar TravelAssist_Notification_notifications_type_available
{
  TravelAssist_array_notifications_type_available[@TravelAssist_Notification_notifications_Element] = @this;
  TravelAssist_Notification_notifications();
}
on envVar TravelAssist_Notification_notifications_value_available
{
  TravelAssist_array_notifications_value_available[@TravelAssist_Notification_notifications_Element] = @this;
  TravelAssist_Notification_notifications();
}
on envVar TravelAssist_Notification_notifications_Payload
{
  TravelAssist_Notification_notifications_update();
}


TravelAssist_Notification_notifications()
{
  word payload_counter = 0;
  word start_pos       = 0;
  word element_length  = 0;
  
  // Length Indicator Struct - Platzhalter
  payload_counter = 0+4;
  start_pos = 0;
  
  for (j=0; j<@TravelAssist_Notification_notifications_Element_TotalNum; j++)
  {
    TravelAssist_array_notifications_available_functions[j] = TravelAssist_array_notifications_type_available[j]
                                                            + TravelAssist_array_notifications_value_available[j];
    
    // Length Indicator Element - Platzhalter
    if (TravelAssist_array_notifications_available_functions[j] > 0)
    {
      start_pos = payload_counter;
      payload_counter = payload_counter + 4;
    }
    else 
      start_pos = payload_counter;
    
    
    // 0 type (enum32)
    if (TravelAssist_array_notifications_type_available[j] == 1)
    {
      tag_dataID = 0;
      TravelAssist_payload_buffer_notifications[payload_counter++] = 2 * 16 /* Wiretype = 2  =^ 32 Bit */ + ((tag_dataID>>8) & 0x0F) /* DataID High Part */ ;
      TravelAssist_payload_buffer_notifications[payload_counter++] = tag_dataID & 0xFF /* DataID Low Part */ ;
      
      TravelAssist_payload_buffer_notifications[payload_counter++] = TravelAssist_array_notifications_type[j]>>24 & 0xFF;
      TravelAssist_payload_buffer_notifications[payload_counter++] = TravelAssist_array_notifications_type[j]>>16 & 0xFF;
      TravelAssist_payload_buffer_notifications[payload_counter++] = TravelAssist_array_notifications_type[j]>> 8 & 0xFF;
      TravelAssist_payload_buffer_notifications[payload_counter++] = TravelAssist_array_notifications_type[j]     & 0xFF;
    }
    
    
    // 1 value (uint32)
    if (TravelAssist_array_notifications_value_available[j] == 1)
    {
      tag_dataID = 1;
      TravelAssist_payload_buffer_notifications[payload_counter++] = 2 * 16 /* Wiretype = 2  =^ 32 Bit */ + ((tag_dataID>>8) & 0x0F) /* DataID High Part */ ;
      TravelAssist_payload_buffer_notifications[payload_counter++] = tag_dataID & 0xFF /* DataID Low Part */ ;
      
      TravelAssist_payload_buffer_notifications[payload_counter++] = TravelAssist_array_notifications_value[j]>>24 & 0xFF;
      TravelAssist_payload_buffer_notifications[payload_counter++] = TravelAssist_array_notifications_value[j]>>16 & 0xFF;
      TravelAssist_payload_buffer_notifications[payload_counter++] = TravelAssist_array_notifications_value[j]>> 8 & 0xFF;
      TravelAssist_payload_buffer_notifications[payload_counter++] = TravelAssist_array_notifications_value[j]     & 0xFF;
    }
    
    
    //Element Length
    element_length = payload_counter-start_pos;
    if (element_length >0) TravelAssist_array_notifications_array_element_length[j] = element_length - 4;
    else                   TravelAssist_array_notifications_array_element_length[j] = element_length;
    
    TravelAssist_payload_buffer_notifications[start_pos++] = TravelAssist_array_notifications_array_element_length[j]>>24 & 0xFF;
    TravelAssist_payload_buffer_notifications[start_pos++] = TravelAssist_array_notifications_array_element_length[j]>>16 & 0xFF;
    TravelAssist_payload_buffer_notifications[start_pos++] = TravelAssist_array_notifications_array_element_length[j]>> 8 & 0xFF;
    TravelAssist_payload_buffer_notifications[start_pos++] = TravelAssist_array_notifications_array_element_length[j]     & 0xFF;
    
    if (TravelAssist_array_notifications_array_element_length[j] == 0) payload_counter = payload_counter+4;
  }
  
  // Struct Length
  TravelAssist_array_notifications_struct_element_length = 4*@TravelAssist_Notification_notifications_Element_TotalNum;

  for (k=0;k<@TravelAssist_Notification_notifications_Element_TotalNum;k++)
    TravelAssist_array_notifications_struct_element_length = TravelAssist_array_notifications_struct_element_length + TravelAssist_array_notifications_array_element_length[k];
  
  TravelAssist_payload_buffer_notifications[0] = TravelAssist_array_notifications_struct_element_length>>24 & 0xFF;
  TravelAssist_payload_buffer_notifications[1] = TravelAssist_array_notifications_struct_element_length>>16 & 0xFF;
  TravelAssist_payload_buffer_notifications[2] = TravelAssist_array_notifications_struct_element_length>> 8 & 0xFF;
  TravelAssist_payload_buffer_notifications[3] = TravelAssist_array_notifications_struct_element_length     & 0xFF;


  TravelAssist_payload_length_notifications = TravelAssist_array_notifications_struct_element_length+4;
  putvalue(TravelAssist_Notification_notifications_Payload, TravelAssist_payload_buffer_notifications, TravelAssist_payload_length_notifications);
}

on envVar TravelAssist_Notification_notifications_Element_TotalNum
{
  if (@this == 0) @this =  1;
  if (@this > 10) @this = 10;
  
  TravelAssist_Notification_notifications();
  TravelAssist_Notification_notifications_update();
}

on envVar TravelAssist_Notification_notifications_Element
{
  TravelAssist_Notification_notifications_update();
}

on envVar TravelAssist_Notification_notifications_Element_Next
{
  if (@this == 1 && @TravelAssist_Notification_notifications_Element < @TravelAssist_Notification_notifications_Element_TotalNum - 1)
  {
    @TravelAssist_Notification_notifications_Element = @TravelAssist_Notification_notifications_Element + 1;
    TravelAssist_Notification_notifications_update();
  }
}

on envVar TravelAssist_Notification_notifications_Element_Previous
{
  if (@this == 1 && @TravelAssist_Notification_notifications_Element > 0)
  {
    @TravelAssist_Notification_notifications_Element = @TravelAssist_Notification_notifications_Element - 1;
    TravelAssist_Notification_notifications_update();
  }
}

TravelAssist_Notification_notifications_update()
{
  @TravelAssist_Notification_LengthIndicator_Element_notifications = TravelAssist_array_notifications_array_element_length[@TravelAssist_Notification_notifications_Element];
  @TravelAssist_Notification_LengthIndicator_Struct_notifications  = TravelAssist_array_notifications_struct_element_length;
  @TravelAssist_Notification_Length_notifications                  = TravelAssist_payload_length_notifications+8;
  
  @TravelAssist_Notification_notifications_type  = TravelAssist_array_notifications_type[@TravelAssist_Notification_notifications_Element];
  @TravelAssist_Notification_notifications_value = TravelAssist_array_notifications_value[@TravelAssist_Notification_notifications_Element];
  
  @TravelAssist_Notification_notifications_type_available  = TravelAssist_array_notifications_type_available[@TravelAssist_Notification_notifications_Element];
  @TravelAssist_Notification_notifications_value_available = TravelAssist_array_notifications_value_available[@TravelAssist_Notification_notifications_Element];
}






////////// lanes Notification //////////

on envVar TravelAssist_Notification_LengthIndicator_Struct_lanes
{
  TravelAssist_Notification_lanes();
}
on envVar TravelAssist_Notification_LengthIndicator_Element_lanes
{
  TravelAssist_Notification_lanes();
}
on envVar TravelAssist_Notification_lanes_type
{
  TravelAssist_array_lanes_type[@TravelAssist_Notification_lanes_Element] = @this;
  TravelAssist_Notification_lanes();
}
on envVar TravelAssist_Notification_lanes_laneType
{
  TravelAssist_array_lanes_laneType[@TravelAssist_Notification_lanes_Element] = @this;
  TravelAssist_Notification_lanes();
}
on envVar TravelAssist_Notification_lanes_transversalDistance
{
  TravelAssist_array_lanes_transversalDistance[@TravelAssist_Notification_lanes_Element] = @this;
  TravelAssist_Notification_lanes();
}
on envVar TravelAssist_Notification_lanes_type_available
{
  TravelAssist_array_lanes_type_available[@TravelAssist_Notification_lanes_Element] = @this;
  TravelAssist_Notification_lanes();
}
on envVar TravelAssist_Notification_lanes_laneType_available
{
  TravelAssist_array_lanes_laneType_available[@TravelAssist_Notification_lanes_Element] = @this;
  TravelAssist_Notification_lanes();
}
on envVar TravelAssist_Notification_lanes_transversalDistance_available
{
  TravelAssist_array_lanes_transversalDistance_available[@TravelAssist_Notification_lanes_Element] = @this;
  TravelAssist_Notification_lanes();
}
on envVar TravelAssist_Notification_lanes_Payload
{
  TravelAssist_Notification_lanes_update();
}


TravelAssist_Notification_lanes()
{
  word payload_counter = 0;
  word start_pos       = 0;
  word element_length  = 0;
  
  // Length Indicator Struct - Platzhalter
  payload_counter = 0+4;
  start_pos = 0;
  
  for (j=0; j<@TravelAssist_Notification_lanes_Element_TotalNum; j++)
  {
    TravelAssist_array_lanes_available_functions[j] = TravelAssist_array_lanes_type_available[j]
                                                    + TravelAssist_array_lanes_laneType_available[j]
                                                    + TravelAssist_array_lanes_transversalDistance_available[j];
    
    // Length Indicator Element - Platzhalter
    if (TravelAssist_array_lanes_available_functions[j] > 0)
    {
      start_pos = payload_counter;
      payload_counter = payload_counter + 4;
    }
    else 
      start_pos = payload_counter;
    
    
    // 0 type (enum32)
    if (TravelAssist_array_lanes_type_available[j] == 1)
    {
      tag_dataID = 0;
      TravelAssist_payload_buffer_lanes[payload_counter++] = 2 * 16 /* Wiretype = 2  =^ 32 Bit */ + ((tag_dataID>>8) & 0x0F) /* DataID High Part */ ;
      TravelAssist_payload_buffer_lanes[payload_counter++] = tag_dataID & 0xFF /* DataID Low Part */ ;
      
      TravelAssist_payload_buffer_lanes[payload_counter++] = TravelAssist_array_lanes_type[j]>>24 & 0xFF;
      TravelAssist_payload_buffer_lanes[payload_counter++] = TravelAssist_array_lanes_type[j]>>16 & 0xFF;
      TravelAssist_payload_buffer_lanes[payload_counter++] = TravelAssist_array_lanes_type[j]>> 8 & 0xFF;
      TravelAssist_payload_buffer_lanes[payload_counter++] = TravelAssist_array_lanes_type[j]     & 0xFF;
    }
    
    
    // 1 laneType (enum32)
    if (TravelAssist_array_lanes_laneType_available[j] == 1)
    {
      tag_dataID = 1;
      TravelAssist_payload_buffer_lanes[payload_counter++] = 2 * 16 /* Wiretype = 2  =^ 32 Bit */ + ((tag_dataID>>8) & 0x0F) /* DataID High Part */ ;
      TravelAssist_payload_buffer_lanes[payload_counter++] = tag_dataID & 0xFF /* DataID Low Part */ ;
      
      TravelAssist_payload_buffer_lanes[payload_counter++] = TravelAssist_array_lanes_laneType[j]>>24 & 0xFF;
      TravelAssist_payload_buffer_lanes[payload_counter++] = TravelAssist_array_lanes_laneType[j]>>16 & 0xFF;
      TravelAssist_payload_buffer_lanes[payload_counter++] = TravelAssist_array_lanes_laneType[j]>> 8 & 0xFF;
      TravelAssist_payload_buffer_lanes[payload_counter++] = TravelAssist_array_lanes_laneType[j]     & 0xFF;
    }
    
    
    // 2 transversalDistance (float32)
    if (TravelAssist_array_lanes_transversalDistance_available[j] == 1)
    {
      tag_dataID = 2;
      TravelAssist_payload_buffer_lanes[payload_counter++] = 2 * 16 /* Wiretype = 2  =^ 32 Bit */ + ((tag_dataID>>8) & 0x0F) /* DataID High Part */ ;
      TravelAssist_payload_buffer_lanes[payload_counter++] = tag_dataID & 0xFF /* DataID Low Part */ ;
      
      temp_converttodword = interpretAsDword (TravelAssist_array_lanes_transversalDistance[j]);
      TravelAssist_payload_buffer_lanes[payload_counter++] = temp_converttodword>>24 & 0xFF;
      TravelAssist_payload_buffer_lanes[payload_counter++] = temp_converttodword>>16 & 0xFF;
      TravelAssist_payload_buffer_lanes[payload_counter++] = temp_converttodword>> 8 & 0xFF;
      TravelAssist_payload_buffer_lanes[payload_counter++] = temp_converttodword     & 0xFF;
    }
    
    
    //Element Length
    element_length = payload_counter-start_pos;
    if (element_length >0) TravelAssist_array_lanes_array_element_length[j] = element_length - 4;
    else                   TravelAssist_array_lanes_array_element_length[j] = element_length;
    
    TravelAssist_payload_buffer_lanes[start_pos++] = TravelAssist_array_lanes_array_element_length[j]>>24 & 0xFF;
    TravelAssist_payload_buffer_lanes[start_pos++] = TravelAssist_array_lanes_array_element_length[j]>>16 & 0xFF;
    TravelAssist_payload_buffer_lanes[start_pos++] = TravelAssist_array_lanes_array_element_length[j]>> 8 & 0xFF;
    TravelAssist_payload_buffer_lanes[start_pos++] = TravelAssist_array_lanes_array_element_length[j]     & 0xFF;
    
    if (TravelAssist_array_lanes_array_element_length[j] == 0) payload_counter = payload_counter+4;
  }
  
  // Struct Length
  TravelAssist_array_lanes_struct_element_length = 4*@TravelAssist_Notification_lanes_Element_TotalNum;

  for (k=0;k<@TravelAssist_Notification_lanes_Element_TotalNum;k++)
    TravelAssist_array_lanes_struct_element_length = TravelAssist_array_lanes_struct_element_length + TravelAssist_array_lanes_array_element_length[k];
  
  TravelAssist_payload_buffer_lanes[0] = TravelAssist_array_lanes_struct_element_length>>24 & 0xFF;
  TravelAssist_payload_buffer_lanes[1] = TravelAssist_array_lanes_struct_element_length>>16 & 0xFF;
  TravelAssist_payload_buffer_lanes[2] = TravelAssist_array_lanes_struct_element_length>> 8 & 0xFF;
  TravelAssist_payload_buffer_lanes[3] = TravelAssist_array_lanes_struct_element_length     & 0xFF;


  TravelAssist_payload_length_lanes = TravelAssist_array_lanes_struct_element_length+4;
  putvalue(TravelAssist_Notification_lanes_Payload, TravelAssist_payload_buffer_lanes, TravelAssist_payload_length_lanes);
}

on envVar TravelAssist_Notification_lanes_Element_TotalNum
{
  if (@this == 0) @this =  1;
  if (@this > 10) @this = 10;
  
  TravelAssist_Notification_lanes();
  TravelAssist_Notification_lanes_update();
}

on envVar TravelAssist_Notification_lanes_Element
{
  TravelAssist_Notification_lanes_update();
}

on envVar TravelAssist_Notification_lanes_Element_Next
{
  if (@this == 1 && @TravelAssist_Notification_lanes_Element < @TravelAssist_Notification_lanes_Element_TotalNum - 1)
  {
    @TravelAssist_Notification_lanes_Element = @TravelAssist_Notification_lanes_Element + 1;
    TravelAssist_Notification_lanes_update();
  }
}

on envVar TravelAssist_Notification_lanes_Element_Previous
{
  if (@this == 1 && @TravelAssist_Notification_lanes_Element > 0)
  {
    @TravelAssist_Notification_lanes_Element = @TravelAssist_Notification_lanes_Element - 1;
    TravelAssist_Notification_lanes_update();
  }
}
TravelAssist_Notification_lanes_update()
{
  @TravelAssist_Notification_LengthIndicator_Element_lanes = TravelAssist_array_lanes_array_element_length[@TravelAssist_Notification_lanes_Element];
  @TravelAssist_Notification_LengthIndicator_Struct_lanes  = TravelAssist_array_lanes_struct_element_length;
  @TravelAssist_Notification_Length_lanes                  = TravelAssist_payload_length_lanes+8;
  
  @TravelAssist_Notification_lanes_type                = TravelAssist_array_lanes_type[@TravelAssist_Notification_lanes_Element];
  @TravelAssist_Notification_lanes_laneType            = TravelAssist_array_lanes_laneType[@TravelAssist_Notification_lanes_Element];
  @TravelAssist_Notification_lanes_transversalDistance = TravelAssist_array_lanes_transversalDistance[@TravelAssist_Notification_lanes_Element];
  
  @TravelAssist_Notification_lanes_type_available                = TravelAssist_array_lanes_type_available[@TravelAssist_Notification_lanes_Element];
  @TravelAssist_Notification_lanes_laneType_available            = TravelAssist_array_lanes_laneType_available[@TravelAssist_Notification_lanes_Element];
  @TravelAssist_Notification_lanes_transversalDistance_available = TravelAssist_array_lanes_transversalDistance_available[@TravelAssist_Notification_lanes_Element];
}






////////// curveParameters Notification //////////

on envVar TravelAssist_Notification_LengthIndicator_Struct_curveParameters
{
  TravelAssist_Notification_curveParameters();
}
on envVar TravelAssist_Notification_LengthIndicator_Element_curveParameters
{
  TravelAssist_Notification_curveParameters();
}
on envVar TravelAssist_Notification_curveParameters_type
{
  TravelAssist_array_curveParameters_type[@TravelAssist_Notification_curveParameters_Element] = @this;
  TravelAssist_Notification_curveParameters();
}
on envVar TravelAssist_Notification_curveParameters_firstSegmentYawAngle
{
  TravelAssist_array_curveParameters_firstSegmentYawAngle[@TravelAssist_Notification_curveParameters_Element] = @this;
  TravelAssist_Notification_curveParameters();
}
on envVar TravelAssist_Notification_curveParameters_firstSegmentCurvature
{
  TravelAssist_array_curveParameters_firstSegmentCurvature[@TravelAssist_Notification_curveParameters_Element] = @this;
  TravelAssist_Notification_curveParameters();
}
on envVar TravelAssist_Notification_curveParameters_secondSegmentBeginning
{
  TravelAssist_array_curveParameters_secondSegmentBeginning[@TravelAssist_Notification_curveParameters_Element] = @this;
  TravelAssist_Notification_curveParameters();
}
on envVar TravelAssist_Notification_curveParameters_secondSegmentCurvature
{
  TravelAssist_array_curveParameters_secondSegmentCurvature[@TravelAssist_Notification_curveParameters_Element] = @this;
  TravelAssist_Notification_curveParameters();
}
on envVar TravelAssist_Notification_curveParameters_firstSegmentTransversalDistance
{
  TravelAssist_array_curveParameters_firstSegmentTransversalDistance[@TravelAssist_Notification_curveParameters_Element] = @this;
  TravelAssist_Notification_curveParameters();
}
on envVar TravelAssist_Notification_curveParameters_type_available
{
  TravelAssist_array_curveParameters_type_available[@TravelAssist_Notification_curveParameters_Element] = @this;
  TravelAssist_Notification_curveParameters();
}
on envVar TravelAssist_Notification_curveParameters_firstSegmentYawAngle_available
{
  TravelAssist_array_curveParameters_firstSegmentYawAngle_available[@TravelAssist_Notification_curveParameters_Element] = @this;
  TravelAssist_Notification_curveParameters();
}
on envVar TravelAssist_Notification_curveParameters_firstSegmentCurvature_available
{
  TravelAssist_array_curveParameters_firstSegmentCurvature_available[@TravelAssist_Notification_curveParameters_Element] = @this;
  TravelAssist_Notification_curveParameters();
}
on envVar TravelAssist_Notification_curveParameters_secondSegmentBeginning_available
{
  TravelAssist_array_curveParameters_secondSegmentBeginning_available[@TravelAssist_Notification_curveParameters_Element] = @this;
  TravelAssist_Notification_curveParameters();
}
on envVar TravelAssist_Notification_curveParameters_secondSegmentCurvature_available
{
  TravelAssist_array_curveParameters_secondSegmentCurvature_available[@TravelAssist_Notification_curveParameters_Element] = @this;
  TravelAssist_Notification_curveParameters();
}
on envVar TravelAssist_Notification_curveParameters_firstSegmentTransversalDistance_available
{
  TravelAssist_array_curveParameters_firstSegmentTransversalDistance_available[@TravelAssist_Notification_curveParameters_Element] = @this;
  TravelAssist_Notification_curveParameters();
}
on envVar TravelAssist_Notification_curveParameters_Payload
{
  TravelAssist_Notification_curveParameters_update();
}


TravelAssist_Notification_curveParameters()
{
  word payload_counter = 0;
  word start_pos       = 0;
  word element_length  = 0;
  
  // Length Indicator Struct - Platzhalter
  payload_counter = 0+4;
  start_pos = 0;
  
  for (j=0; j<@TravelAssist_Notification_curveParameters_Element_TotalNum; j++)
  {
    TravelAssist_array_curveParameters_available_functions[j] = TravelAssist_array_curveParameters_type_available[j]
                                                              + TravelAssist_array_curveParameters_firstSegmentYawAngle_available[j]
                                                              + TravelAssist_array_curveParameters_firstSegmentCurvature_available[j]
                                                              + TravelAssist_array_curveParameters_secondSegmentBeginning_available[j]
                                                              + TravelAssist_array_curveParameters_secondSegmentCurvature_available[j]
                                                              + TravelAssist_array_curveParameters_firstSegmentTransversalDistance_available[j];
    
    // Length Indicator Element - Platzhalter
    if (TravelAssist_array_curveParameters_available_functions[j] > 0)
    {
      start_pos = payload_counter;
      payload_counter = payload_counter + 4;
    }
    else 
      start_pos = payload_counter;
    
    
    // 0 type (enum32)
    if (TravelAssist_array_curveParameters_type_available[j] == 1)
    {
      tag_dataID = 0;
      TravelAssist_payload_buffer_curveParameters[payload_counter++] = 2 * 16 /* Wiretype = 2  =^ 32 Bit */ + ((tag_dataID>>8) & 0x0F) /* DataID High Part */ ;
      TravelAssist_payload_buffer_curveParameters[payload_counter++] = tag_dataID & 0xFF /* DataID Low Part */ ;
      
      TravelAssist_payload_buffer_curveParameters[payload_counter++] = TravelAssist_array_curveParameters_type[j]>>24 & 0xFF;
      TravelAssist_payload_buffer_curveParameters[payload_counter++] = TravelAssist_array_curveParameters_type[j]>>16 & 0xFF;
      TravelAssist_payload_buffer_curveParameters[payload_counter++] = TravelAssist_array_curveParameters_type[j]>> 8 & 0xFF;
      TravelAssist_payload_buffer_curveParameters[payload_counter++] = TravelAssist_array_curveParameters_type[j]     & 0xFF;
    }
    
    
    // 1 firstSegmentYawAngle (float32)
    if (TravelAssist_array_curveParameters_firstSegmentYawAngle_available[j] == 1)
    {
      tag_dataID = 1;
      TravelAssist_payload_buffer_curveParameters[payload_counter++] = 2 * 16 /* Wiretype = 2  =^ 32 Bit */ + ((tag_dataID>>8) & 0x0F) /* DataID High Part */ ;
      TravelAssist_payload_buffer_curveParameters[payload_counter++] = tag_dataID & 0xFF /* DataID Low Part */ ;
      
      temp_converttodword = interpretAsDword (TravelAssist_array_curveParameters_firstSegmentYawAngle[j]);
      TravelAssist_payload_buffer_curveParameters[payload_counter++] = temp_converttodword>>24 & 0xFF;
      TravelAssist_payload_buffer_curveParameters[payload_counter++] = temp_converttodword>>16 & 0xFF;
      TravelAssist_payload_buffer_curveParameters[payload_counter++] = temp_converttodword>> 8 & 0xFF;
      TravelAssist_payload_buffer_curveParameters[payload_counter++] = temp_converttodword     & 0xFF;
    }
    
    
    // 2 firstSegmentCurvature (sint32)
    if (TravelAssist_array_curveParameters_firstSegmentCurvature_available[j] == 1)
    {
      tag_dataID = 2;
      TravelAssist_payload_buffer_curveParameters[payload_counter++] = 2 * 16 /* Wiretype = 2  =^ 32 Bit */ + ((tag_dataID>>8) & 0x0F) /* DataID High Part */ ;
      TravelAssist_payload_buffer_curveParameters[payload_counter++] = tag_dataID & 0xFF /* DataID Low Part */ ;
      
      TravelAssist_payload_buffer_curveParameters[payload_counter++] = TravelAssist_array_curveParameters_firstSegmentCurvature[j]>>24 & 0xFF;
      TravelAssist_payload_buffer_curveParameters[payload_counter++] = TravelAssist_array_curveParameters_firstSegmentCurvature[j]>>16 & 0xFF;
      TravelAssist_payload_buffer_curveParameters[payload_counter++] = TravelAssist_array_curveParameters_firstSegmentCurvature[j]>> 8 & 0xFF;
      TravelAssist_payload_buffer_curveParameters[payload_counter++] = TravelAssist_array_curveParameters_firstSegmentCurvature[j]     & 0xFF;
    }
    
    
    // 3 secondSegmentBeginning (float32)
    if (TravelAssist_array_curveParameters_secondSegmentBeginning_available[j] == 1)
    {
      tag_dataID = 3;
      TravelAssist_payload_buffer_curveParameters[payload_counter++] = 2 * 16 /* Wiretype = 2  =^ 32 Bit */ + ((tag_dataID>>8) & 0x0F) /* DataID High Part */ ;
      TravelAssist_payload_buffer_curveParameters[payload_counter++] = tag_dataID & 0xFF /* DataID Low Part */ ;
      
      temp_converttodword = interpretAsDword (TravelAssist_array_curveParameters_secondSegmentBeginning[j]);
      TravelAssist_payload_buffer_curveParameters[payload_counter++] = temp_converttodword>>24 & 0xFF;
      TravelAssist_payload_buffer_curveParameters[payload_counter++] = temp_converttodword>>16 & 0xFF;
      TravelAssist_payload_buffer_curveParameters[payload_counter++] = temp_converttodword>> 8 & 0xFF;
      TravelAssist_payload_buffer_curveParameters[payload_counter++] = temp_converttodword     & 0xFF;
    }
    
    
    // 4 secondSegmentCurvature (sint32)
    if (TravelAssist_array_curveParameters_secondSegmentCurvature_available[j] == 1)
    {
      tag_dataID = 4;
      TravelAssist_payload_buffer_curveParameters[payload_counter++] = 2 * 16 /* Wiretype = 2  =^ 32 Bit */ + ((tag_dataID>>8) & 0x0F) /* DataID High Part */ ;
      TravelAssist_payload_buffer_curveParameters[payload_counter++] = tag_dataID & 0xFF /* DataID Low Part */ ;
      
      TravelAssist_payload_buffer_curveParameters[payload_counter++] = TravelAssist_array_curveParameters_secondSegmentCurvature[j]>>24 & 0xFF;
      TravelAssist_payload_buffer_curveParameters[payload_counter++] = TravelAssist_array_curveParameters_secondSegmentCurvature[j]>>16 & 0xFF;
      TravelAssist_payload_buffer_curveParameters[payload_counter++] = TravelAssist_array_curveParameters_secondSegmentCurvature[j]>> 8 & 0xFF;
      TravelAssist_payload_buffer_curveParameters[payload_counter++] = TravelAssist_array_curveParameters_secondSegmentCurvature[j]     & 0xFF;
    }
    
    
    // 5 firstSegmentTransversalDistance (float32)
    if (TravelAssist_array_curveParameters_firstSegmentTransversalDistance_available[j] == 1)
    {
      tag_dataID = 5;
      TravelAssist_payload_buffer_curveParameters[payload_counter++] = 2 * 16 /* Wiretype = 2  =^ 32 Bit */ + ((tag_dataID>>8) & 0x0F) /* DataID High Part */ ;
      TravelAssist_payload_buffer_curveParameters[payload_counter++] = tag_dataID & 0xFF /* DataID Low Part */ ;
      
      temp_converttodword = interpretAsDword (TravelAssist_array_curveParameters_firstSegmentTransversalDistance[j]);
      TravelAssist_payload_buffer_curveParameters[payload_counter++] = temp_converttodword>>24 & 0xFF;
      TravelAssist_payload_buffer_curveParameters[payload_counter++] = temp_converttodword>>16 & 0xFF;
      TravelAssist_payload_buffer_curveParameters[payload_counter++] = temp_converttodword>> 8 & 0xFF;
      TravelAssist_payload_buffer_curveParameters[payload_counter++] = temp_converttodword     & 0xFF;
    }
    
    
    //Element Length
    element_length = payload_counter-start_pos;
    if (element_length >0) TravelAssist_array_curveParameters_array_element_length[j] = element_length - 4;
    else                   TravelAssist_array_curveParameters_array_element_length[j] = element_length;
    
    TravelAssist_payload_buffer_curveParameters[start_pos++] = TravelAssist_array_curveParameters_array_element_length[j]>>24 & 0xFF;
    TravelAssist_payload_buffer_curveParameters[start_pos++] = TravelAssist_array_curveParameters_array_element_length[j]>>16 & 0xFF;
    TravelAssist_payload_buffer_curveParameters[start_pos++] = TravelAssist_array_curveParameters_array_element_length[j]>> 8 & 0xFF;
    TravelAssist_payload_buffer_curveParameters[start_pos++] = TravelAssist_array_curveParameters_array_element_length[j]     & 0xFF;
    
    if (TravelAssist_array_curveParameters_array_element_length[j] == 0) payload_counter = payload_counter+4;
  }
  
  // Struct Length
  TravelAssist_array_curveParameters_struct_element_length = 4*@TravelAssist_Notification_curveParameters_Element_TotalNum;

  for (k=0;k<@TravelAssist_Notification_curveParameters_Element_TotalNum;k++)
    TravelAssist_array_curveParameters_struct_element_length = TravelAssist_array_curveParameters_struct_element_length + TravelAssist_array_curveParameters_array_element_length[k];
  
  TravelAssist_payload_buffer_curveParameters[0] = TravelAssist_array_curveParameters_struct_element_length>>24 & 0xFF;
  TravelAssist_payload_buffer_curveParameters[1] = TravelAssist_array_curveParameters_struct_element_length>>16 & 0xFF;
  TravelAssist_payload_buffer_curveParameters[2] = TravelAssist_array_curveParameters_struct_element_length>> 8 & 0xFF;
  TravelAssist_payload_buffer_curveParameters[3] = TravelAssist_array_curveParameters_struct_element_length     & 0xFF;


  TravelAssist_payload_length_curveParameters = TravelAssist_array_curveParameters_struct_element_length+4;
  putvalue(TravelAssist_Notification_curveParameters_Payload, TravelAssist_payload_buffer_curveParameters, TravelAssist_payload_length_curveParameters);
}

on envVar TravelAssist_Notification_curveParameters_Element_TotalNum
{
  if (@this == 0) @this =  1;
  if (@this > 10) @this = 10;
  
  TravelAssist_Notification_curveParameters();
  TravelAssist_Notification_curveParameters_update();
}

on envVar TravelAssist_Notification_curveParameters_Element
{
  TravelAssist_Notification_curveParameters_update();
}

on envVar TravelAssist_Notification_curveParameters_Element_Next
{
  if (@this == 1 && @TravelAssist_Notification_curveParameters_Element < @TravelAssist_Notification_curveParameters_Element_TotalNum - 1)
  {
    @TravelAssist_Notification_curveParameters_Element = @TravelAssist_Notification_curveParameters_Element + 1;
    TravelAssist_Notification_curveParameters_update();
  }
}

on envVar TravelAssist_Notification_curveParameters_Element_Previous
{
  if (@this == 1 && @TravelAssist_Notification_curveParameters_Element > 0)
  {
    @TravelAssist_Notification_curveParameters_Element = @TravelAssist_Notification_curveParameters_Element - 1;
    TravelAssist_Notification_curveParameters_update();
  }
}

TravelAssist_Notification_curveParameters_update()
{
  @TravelAssist_Notification_LengthIndicator_Element_curveParameters = TravelAssist_array_curveParameters_array_element_length[@TravelAssist_Notification_curveParameters_Element];
  @TravelAssist_Notification_LengthIndicator_Struct_curveParameters  = TravelAssist_array_curveParameters_struct_element_length;
  @TravelAssist_Notification_Length_curveParameters                  = TravelAssist_payload_length_curveParameters+8;
  
  @TravelAssist_Notification_curveParameters_type                            = TravelAssist_array_curveParameters_type[@TravelAssist_Notification_curveParameters_Element];
  @TravelAssist_Notification_curveParameters_firstSegmentYawAngle            = TravelAssist_array_curveParameters_firstSegmentYawAngle[@TravelAssist_Notification_curveParameters_Element];
  @TravelAssist_Notification_curveParameters_firstSegmentCurvature           = TravelAssist_array_curveParameters_firstSegmentCurvature[@TravelAssist_Notification_curveParameters_Element];
  @TravelAssist_Notification_curveParameters_secondSegmentBeginning          = TravelAssist_array_curveParameters_secondSegmentBeginning[@TravelAssist_Notification_curveParameters_Element];
  @TravelAssist_Notification_curveParameters_secondSegmentCurvature          = TravelAssist_array_curveParameters_secondSegmentCurvature[@TravelAssist_Notification_curveParameters_Element];
  @TravelAssist_Notification_curveParameters_firstSegmentTransversalDistance = TravelAssist_array_curveParameters_firstSegmentTransversalDistance[@TravelAssist_Notification_curveParameters_Element];
  
  @TravelAssist_Notification_curveParameters_type_available                            = TravelAssist_array_curveParameters_type_available[@TravelAssist_Notification_curveParameters_Element];
  @TravelAssist_Notification_curveParameters_firstSegmentYawAngle_available            = TravelAssist_array_curveParameters_firstSegmentYawAngle_available[@TravelAssist_Notification_curveParameters_Element];
  @TravelAssist_Notification_curveParameters_firstSegmentCurvature_available           = TravelAssist_array_curveParameters_firstSegmentCurvature_available[@TravelAssist_Notification_curveParameters_Element];
  @TravelAssist_Notification_curveParameters_secondSegmentBeginning_available          = TravelAssist_array_curveParameters_secondSegmentBeginning_available[@TravelAssist_Notification_curveParameters_Element];
  @TravelAssist_Notification_curveParameters_secondSegmentCurvature_available          = TravelAssist_array_curveParameters_secondSegmentCurvature_available[@TravelAssist_Notification_curveParameters_Element];
  @TravelAssist_Notification_curveParameters_firstSegmentTransversalDistance_available = TravelAssist_array_curveParameters_firstSegmentTransversalDistance_available[@TravelAssist_Notification_curveParameters_Element];
}








////////// info Notification //////////

on envVar TravelAssist_Notification_LengthIndicator_Struct_info
{
  TravelAssist_Notification_info();
}
on envVar TravelAssist_Notification_LengthIndicator_Element_info
{
  TravelAssist_Notification_info();
}
on envVar TravelAssist_Notification_info_elementId
{
  TravelAssist_array_info_elementId[@TravelAssist_Notification_info_Element] = @this;
  TravelAssist_Notification_info();
}
on envVar TravelAssist_Notification_info_zoomLevel
{
  TravelAssist_array_info_zoomLevel[@TravelAssist_Notification_info_Element] = @this;
  TravelAssist_Notification_info();
}
on envVar TravelAssist_Notification_info_laneChangeToLeft
{
  TravelAssist_array_info_laneChangeToLeft[@TravelAssist_Notification_info_Element] = @this;
  TravelAssist_Notification_info();
}
on envVar TravelAssist_Notification_info_laneChangeToRight
{
  TravelAssist_array_info_laneChangeToRight[@TravelAssist_Notification_info_Element] = @this;
  TravelAssist_Notification_info();
}
on envVar TravelAssist_Notification_info_egoTrajectoryValid
{
  TravelAssist_array_info_egoTrajectoryValid[@TravelAssist_Notification_info_Element] = @this;
  TravelAssist_Notification_info();
}
on envVar TravelAssist_Notification_info_zoomLevelActivated
{
  TravelAssist_array_info_zoomLevelActivated[@TravelAssist_Notification_info_Element] = @this;
  TravelAssist_Notification_info();
}
on envVar TravelAssist_Notification_info_trajectoryForecast
{
  TravelAssist_array_info_trajectoryForecast[@TravelAssist_Notification_info_Element] = @this;
  TravelAssist_Notification_info();
}
on envVar TravelAssist_Notification_info_curveWarning
{
  TravelAssist_array_info_curveWarning[@TravelAssist_Notification_info_Element] = @this;
  TravelAssist_Notification_info();
}
on envVar TravelAssist_Notification_info_elementId_available
{
  TravelAssist_array_info_elementId_available[@TravelAssist_Notification_info_Element] = @this;
  TravelAssist_Notification_info();
}
on envVar TravelAssist_Notification_info_zoomLevel_available
{
  TravelAssist_array_info_zoomLevel_available[@TravelAssist_Notification_info_Element] = @this;
  TravelAssist_Notification_info();
}
on envVar TravelAssist_Notification_info_laneChangeToLeft_available
{
  TravelAssist_array_info_laneChangeToLeft_available[@TravelAssist_Notification_info_Element] = @this;
  TravelAssist_Notification_info();
}
on envVar TravelAssist_Notification_info_laneChangeToRight_available
{
  TravelAssist_array_info_laneChangeToRight_available[@TravelAssist_Notification_info_Element] = @this;
  TravelAssist_Notification_info();
}
on envVar TravelAssist_Notification_info_egoTrajectoryValid_available
{
  TravelAssist_array_info_egoTrajectoryValid_available[@TravelAssist_Notification_info_Element] = @this;
  TravelAssist_Notification_info();
}
on envVar TravelAssist_Notification_info_zoomLevelActivated_available
{
  TravelAssist_array_info_zoomLevelActivated_available[@TravelAssist_Notification_info_Element] = @this;
  TravelAssist_Notification_info();
}
on envVar TravelAssist_Notification_info_trajectoryForecast_available
{
  TravelAssist_array_info_trajectoryForecast_available[@TravelAssist_Notification_info_Element] = @this;
  TravelAssist_Notification_info();
}
on envVar TravelAssist_Notification_info_curveWarning_available
{
  TravelAssist_array_info_curveWarning_available[@TravelAssist_Notification_info_Element] = @this;
  TravelAssist_Notification_info();
}
on envVar TravelAssist_Notification_info_Payload
{
  TravelAssist_Notification_info_update();
}


TravelAssist_Notification_info()
{
  word payload_counter = 0;
  word start_pos       = 0;
  word element_length  = 0;
  
  // Length Indicator Struct - Platzhalter
  payload_counter = 0+4;
  start_pos = 0;
  
  for (j=0; j<@TravelAssist_Notification_info_Element_TotalNum; j++)
  {
    TravelAssist_array_info_available_functions[j] = TravelAssist_array_info_elementId_available[j]
                                                   + TravelAssist_array_info_zoomLevel_available[j]
                                                   + TravelAssist_array_info_laneChangeToLeft_available[j]
                                                   + TravelAssist_array_info_laneChangeToRight_available[j]
                                                   + TravelAssist_array_info_egoTrajectoryValid_available[j]
                                                   + TravelAssist_array_info_zoomLevelActivated_available[j]
                                                   + TravelAssist_array_info_trajectoryForecast_available[j];
    
    // Length Indicator Element - Platzhalter
    if (TravelAssist_array_info_available_functions[j] > 0)
    {
      start_pos = payload_counter;
      payload_counter = payload_counter + 4;
    }
    else 
      start_pos = payload_counter;
    
    
    // 0 elementId (uint32)
    if (TravelAssist_array_info_elementId_available[j] == 1)
    {
      tag_dataID = 0;
      TravelAssist_payload_buffer_info[payload_counter++] = 2 * 16 /* Wiretype = 2  =^ 32 Bit */ + ((tag_dataID>>8) & 0x0F) /* DataID High Part */ ;
      TravelAssist_payload_buffer_info[payload_counter++] = tag_dataID & 0xFF /* DataID Low Part */ ;
      
      TravelAssist_payload_buffer_info[payload_counter++] = TravelAssist_array_info_elementId[j]>>24 & 0xFF;
      TravelAssist_payload_buffer_info[payload_counter++] = TravelAssist_array_info_elementId[j]>>16 & 0xFF;
      TravelAssist_payload_buffer_info[payload_counter++] = TravelAssist_array_info_elementId[j]>> 8 & 0xFF;
      TravelAssist_payload_buffer_info[payload_counter++] = TravelAssist_array_info_elementId[j]     & 0xFF;
    }
    
    
    // 1 zoomLevel (float32)
    if (TravelAssist_array_info_zoomLevel_available[j] == 1)
    {
      tag_dataID = 1;
      TravelAssist_payload_buffer_info[payload_counter++] = 2 * 16 /* Wiretype = 2  =^ 32 Bit */ + ((tag_dataID>>8) & 0x0F) /* DataID High Part */ ;
      TravelAssist_payload_buffer_info[payload_counter++] = tag_dataID & 0xFF /* DataID Low Part */ ;
      
      temp_converttodword = interpretAsDword (TravelAssist_array_info_zoomLevel[j]);
      TravelAssist_payload_buffer_info[payload_counter++] = temp_converttodword>>24 & 0xFF;
      TravelAssist_payload_buffer_info[payload_counter++] = temp_converttodword>>16 & 0xFF;
      TravelAssist_payload_buffer_info[payload_counter++] = temp_converttodword>> 8 & 0xFF;
      TravelAssist_payload_buffer_info[payload_counter++] = temp_converttodword     & 0xFF;
    }
    
    
    // 2 laneChangeToLeft (boolean)
    if (TravelAssist_array_info_laneChangeToLeft_available[j] == 1)
    {
      tag_dataID = 2;
      TravelAssist_payload_buffer_info[payload_counter++] = 0 * 16 /* Wiretype = 0  =^ 8 Bit */ + ((tag_dataID>>8) & 0x0F) /* DataID High Part */ ;
      TravelAssist_payload_buffer_info[payload_counter++] = tag_dataID & 0xFF /* DataID Low Part */ ;
      
      TravelAssist_payload_buffer_info[payload_counter++] = TravelAssist_array_info_laneChangeToLeft[j] & 0xFF;
    }
    
    
    // 3 laneChangeToRight (boolean)
    if (TravelAssist_array_info_laneChangeToRight_available[j] == 1)
    {
      tag_dataID = 3;
      TravelAssist_payload_buffer_info[payload_counter++] = 0 * 16 /* Wiretype = 0  =^ 8 Bit */ + ((tag_dataID>>8) & 0x0F) /* DataID High Part */ ;
      TravelAssist_payload_buffer_info[payload_counter++] = tag_dataID & 0xFF /* DataID Low Part */ ;
      
      TravelAssist_payload_buffer_info[payload_counter++] = TravelAssist_array_info_laneChangeToRight[j] & 0xFF;
    }
    
    
    // 4 egoTrajectoryValid (boolean)
    if (TravelAssist_array_info_egoTrajectoryValid_available[j] == 1)
    {
      tag_dataID = 4;
      TravelAssist_payload_buffer_info[payload_counter++] = 0 * 16 /* Wiretype = 0  =^ 8 Bit */ + ((tag_dataID>>8) & 0x0F) /* DataID High Part */ ;
      TravelAssist_payload_buffer_info[payload_counter++] = tag_dataID & 0xFF /* DataID Low Part */ ;
      
      TravelAssist_payload_buffer_info[payload_counter++] = TravelAssist_array_info_egoTrajectoryValid[j] & 0xFF;
    }
    
    
    // 5 zoomLevelActivated (boolean)
    if (TravelAssist_array_info_zoomLevelActivated_available[j] == 1)
    {
      tag_dataID = 5;
      TravelAssist_payload_buffer_info[payload_counter++] = 0 * 16 /* Wiretype = 0  =^ 8 Bit */ + ((tag_dataID>>8) & 0x0F) /* DataID High Part */ ;
      TravelAssist_payload_buffer_info[payload_counter++] = tag_dataID & 0xFF /* DataID Low Part */ ;
      
      TravelAssist_payload_buffer_info[payload_counter++] = TravelAssist_array_info_zoomLevelActivated[j] & 0xFF;
    }
    

    // 6 trajectoryForecast (float32)
    if (TravelAssist_array_info_trajectoryForecast_available[j] == 1)
    {
      tag_dataID = 6;
      TravelAssist_payload_buffer_info[payload_counter++] = 2 * 16 /* Wiretype = 2  =^ 32 Bit */ + ((tag_dataID>>8) & 0x0F) /* DataID High Part */ ;
      TravelAssist_payload_buffer_info[payload_counter++] = tag_dataID & 0xFF /* DataID Low Part */ ;
      
      temp_converttodword = interpretAsDword (TravelAssist_array_info_trajectoryForecast[j]);
      TravelAssist_payload_buffer_info[payload_counter++] = temp_converttodword>>24 & 0xFF;
      TravelAssist_payload_buffer_info[payload_counter++] = temp_converttodword>>16 & 0xFF;
      TravelAssist_payload_buffer_info[payload_counter++] = temp_converttodword>> 8 & 0xFF;
      TravelAssist_payload_buffer_info[payload_counter++] = temp_converttodword     & 0xFF;
    }
    
    
    // 7 curveWarning (boolean)
    if (TravelAssist_array_info_curveWarning_available[j] == 1)
    {
      tag_dataID = 7;
      TravelAssist_payload_buffer_info[payload_counter++] = 0 * 16 /* Wiretype = 0  =^ 8 Bit */ + ((tag_dataID>>8) & 0x0F) /* DataID High Part */ ;
      TravelAssist_payload_buffer_info[payload_counter++] = tag_dataID & 0xFF /* DataID Low Part */ ;
      
      TravelAssist_payload_buffer_info[payload_counter++] = TravelAssist_array_info_curveWarning[j] & 0xFF;
    }
    
    
    //Element Length
    element_length = payload_counter-start_pos;
    if (element_length >0) TravelAssist_array_info_array_element_length[j] = element_length - 4;
    else                   TravelAssist_array_info_array_element_length[j] = element_length;
    
    TravelAssist_payload_buffer_info[start_pos++] = TravelAssist_array_info_array_element_length[j]>>24 & 0xFF;
    TravelAssist_payload_buffer_info[start_pos++] = TravelAssist_array_info_array_element_length[j]>>16 & 0xFF;
    TravelAssist_payload_buffer_info[start_pos++] = TravelAssist_array_info_array_element_length[j]>> 8 & 0xFF;
    TravelAssist_payload_buffer_info[start_pos++] = TravelAssist_array_info_array_element_length[j]     & 0xFF;
    
    if (TravelAssist_array_info_array_element_length[j] == 0) payload_counter = payload_counter+4;
  }
  
  // Struct Length
  TravelAssist_array_info_struct_element_length = 4*@TravelAssist_Notification_info_Element_TotalNum;

  for (k=0;k<@TravelAssist_Notification_info_Element_TotalNum;k++)
    TravelAssist_array_info_struct_element_length = TravelAssist_array_info_struct_element_length + TravelAssist_array_info_array_element_length[k];
  
  TravelAssist_payload_buffer_info[0] = TravelAssist_array_info_struct_element_length>>24 & 0xFF;
  TravelAssist_payload_buffer_info[1] = TravelAssist_array_info_struct_element_length>>16 & 0xFF;
  TravelAssist_payload_buffer_info[2] = TravelAssist_array_info_struct_element_length>> 8 & 0xFF;
  TravelAssist_payload_buffer_info[3] = TravelAssist_array_info_struct_element_length     & 0xFF;


  TravelAssist_payload_length_info = TravelAssist_array_info_struct_element_length+4;
  putvalue(TravelAssist_Notification_info_Payload, TravelAssist_payload_buffer_info, TravelAssist_payload_length_info);
}

on envVar TravelAssist_Notification_info_Element_TotalNum
{
  if (@this == 0) @this =  1;
  if (@this > 10) @this = 10;
  
  TravelAssist_Notification_info();
  TravelAssist_Notification_info_update();
}

on envVar TravelAssist_Notification_info_Element
{
  TravelAssist_Notification_info_update();
}

on envVar TravelAssist_Notification_info_Element_Next
{
  if (@this == 1 && @TravelAssist_Notification_info_Element < @TravelAssist_Notification_info_Element_TotalNum - 1)
  {
    @TravelAssist_Notification_info_Element = @TravelAssist_Notification_info_Element + 1;
    TravelAssist_Notification_info_update();
  }
}

on envVar TravelAssist_Notification_info_Element_Previous
{
  if (@this == 1 && @TravelAssist_Notification_info_Element > 0)
  {
    @TravelAssist_Notification_info_Element = @TravelAssist_Notification_info_Element - 1;
    TravelAssist_Notification_info_update();
  }
}

TravelAssist_Notification_info_update()
{
  @TravelAssist_Notification_LengthIndicator_Element_info = TravelAssist_array_info_array_element_length[@TravelAssist_Notification_info_Element];
  @TravelAssist_Notification_LengthIndicator_Struct_info  = TravelAssist_array_info_struct_element_length;
  @TravelAssist_Notification_Length_info                  = TravelAssist_payload_length_info+8;
  
  @TravelAssist_Notification_info_elementId          = TravelAssist_array_info_elementId[@TravelAssist_Notification_info_Element];
  @TravelAssist_Notification_info_zoomLevel          = TravelAssist_array_info_zoomLevel[@TravelAssist_Notification_info_Element];
  @TravelAssist_Notification_info_laneChangeToLeft   = TravelAssist_array_info_laneChangeToLeft[@TravelAssist_Notification_info_Element];
  @TravelAssist_Notification_info_laneChangeToRight  = TravelAssist_array_info_laneChangeToRight[@TravelAssist_Notification_info_Element];
  @TravelAssist_Notification_info_egoTrajectoryValid = TravelAssist_array_info_egoTrajectoryValid[@TravelAssist_Notification_info_Element];
  @TravelAssist_Notification_info_zoomLevelActivated = TravelAssist_array_info_zoomLevelActivated[@TravelAssist_Notification_info_Element];
  @TravelAssist_Notification_info_trajectoryForecast = TravelAssist_array_info_trajectoryForecast[@TravelAssist_Notification_info_Element];
  @TravelAssist_Notification_info_curveWarning       = TravelAssist_array_info_curveWarning[@TravelAssist_Notification_info_Element];
  
  @TravelAssist_Notification_info_elementId_available          = TravelAssist_array_info_elementId_available[@TravelAssist_Notification_info_Element];
  @TravelAssist_Notification_info_zoomLevel_available          = TravelAssist_array_info_zoomLevel_available[@TravelAssist_Notification_info_Element];
  @TravelAssist_Notification_info_laneChangeToLeft_available   = TravelAssist_array_info_laneChangeToLeft_available[@TravelAssist_Notification_info_Element];
  @TravelAssist_Notification_info_laneChangeToRight_available  = TravelAssist_array_info_laneChangeToRight_available[@TravelAssist_Notification_info_Element];
  @TravelAssist_Notification_info_egoTrajectoryValid_available = TravelAssist_array_info_egoTrajectoryValid_available[@TravelAssist_Notification_info_Element];
  @TravelAssist_Notification_info_zoomLevelActivated_available = TravelAssist_array_info_zoomLevelActivated_available[@TravelAssist_Notification_info_Element];
  @TravelAssist_Notification_info_trajectoryForecast_available = TravelAssist_array_info_trajectoryForecast_available[@TravelAssist_Notification_info_Element];
  @TravelAssist_Notification_info_curveWarning_available       = TravelAssist_array_info_curveWarning_available[@TravelAssist_Notification_info_Element];
}






////////// relevantObjects Notification //////////

on envVar TravelAssist_Notification_LengthIndicator_Struct_relevantObjects
{
  TravelAssist_Notification_relevantObjects();
}
on envVar TravelAssist_Notification_LengthIndicator_Element_relevantObjects
{
  TravelAssist_Notification_relevantObjects();
}
on envVar TravelAssist_Notification_relevantObjects_type
{
  TravelAssist_array_relevantObjects_type[@TravelAssist_Notification_relevantObjects_Element] = @this;
  TravelAssist_Notification_relevantObjects();
}
on envVar TravelAssist_Notification_relevantObjects_longitudinalDistance
{
  TravelAssist_array_relevantObjects_longitudinalDistance[@TravelAssist_Notification_relevantObjects_Element] = @this;
  TravelAssist_Notification_relevantObjects();
}
on envVar TravelAssist_Notification_relevantObjects_percentagePosition
{
  TravelAssist_array_relevantObjects_percentagePosition[@TravelAssist_Notification_relevantObjects_Element] = @this;
  TravelAssist_Notification_relevantObjects();
}
on envVar TravelAssist_Notification_relevantObjects_laneMapping
{
  TravelAssist_array_relevantObjects_laneMapping[@TravelAssist_Notification_relevantObjects_Element] = @this;
  TravelAssist_Notification_relevantObjects();
}
on envVar TravelAssist_Notification_relevantObjects_objectType
{
  TravelAssist_array_relevantObjects_objectType[@TravelAssist_Notification_relevantObjects_Element] = @this;
  TravelAssist_Notification_relevantObjects();
}
on envVar TravelAssist_Notification_relevantObjects_isTransversalControlActive
{
  TravelAssist_array_relevantObjects_isTransversalControlActive[@TravelAssist_Notification_relevantObjects_Element] = @this;
  TravelAssist_Notification_relevantObjects();
}
on envVar TravelAssist_Notification_relevantObjects_isLongitudinalControlActive
{
  TravelAssist_array_relevantObjects_isLongitudinalControlActive[@TravelAssist_Notification_relevantObjects_Element] = @this;
  TravelAssist_Notification_relevantObjects();
}
on envVar TravelAssist_Notification_relevantObjects_type_available
{
  TravelAssist_array_relevantObjects_type_available[@TravelAssist_Notification_relevantObjects_Element] = @this;
  TravelAssist_Notification_relevantObjects();
}
on envVar TravelAssist_Notification_relevantObjects_longitudinalDistance_available
{
  TravelAssist_array_relevantObjects_longitudinalDistance_available[@TravelAssist_Notification_relevantObjects_Element] = @this;
  TravelAssist_Notification_relevantObjects();
}
on envVar TravelAssist_Notification_relevantObjects_percentagePosition_available
{
  TravelAssist_array_relevantObjects_percentagePosition_available[@TravelAssist_Notification_relevantObjects_Element] = @this;
  TravelAssist_Notification_relevantObjects();
}
on envVar TravelAssist_Notification_relevantObjects_laneMapping_available
{
  TravelAssist_array_relevantObjects_laneMapping_available[@TravelAssist_Notification_relevantObjects_Element] = @this;
  TravelAssist_Notification_relevantObjects();
}
on envVar TravelAssist_Notification_relevantObjects_objectType_available
{
  TravelAssist_array_relevantObjects_objectType_available[@TravelAssist_Notification_relevantObjects_Element] = @this;
  TravelAssist_Notification_relevantObjects();
}
on envVar TravelAssist_Notification_relevantObjects_isTransversalControlActive_available
{
  TravelAssist_array_relevantObjects_isTransversalControlActive_available[@TravelAssist_Notification_relevantObjects_Element] = @this;
  TravelAssist_Notification_relevantObjects();
}
on envVar TravelAssist_Notification_relevantObjects_isLongitudinalControlActive_available
{
  TravelAssist_array_relevantObjects_isLongitudinalControlActive_available[@TravelAssist_Notification_relevantObjects_Element] = @this;
  TravelAssist_Notification_relevantObjects();
}
on envVar TravelAssist_Notification_relevantObjects_Payload
{
  TravelAssist_Notification_relevantObjects_update();
}


TravelAssist_Notification_relevantObjects()
{
  word payload_counter = 0;
  word start_pos       = 0;
  word element_length  = 0;
  
  // Length Indicator Struct - Platzhalter
  payload_counter = 0+4;
  start_pos = 0;
  
  for (j=0; j<@TravelAssist_Notification_relevantObjects_Element_TotalNum; j++)
  {
    TravelAssist_array_relevantObjects_available_functions[j] = TravelAssist_array_relevantObjects_type_available[j]
                                                              + TravelAssist_array_relevantObjects_longitudinalDistance_available[j]
                                                              + TravelAssist_array_relevantObjects_percentagePosition_available[j]
                                                              + TravelAssist_array_relevantObjects_laneMapping_available[j]
                                                              + TravelAssist_array_relevantObjects_objectType_available[j]
                                                              + TravelAssist_array_relevantObjects_isTransversalControlActive_available[j]
                                                              + TravelAssist_array_relevantObjects_isLongitudinalControlActive_available[j];
    
    // Length Indicator Element - Platzhalter
    if (TravelAssist_array_relevantObjects_available_functions[j] > 0)
    {
      start_pos = payload_counter;
      payload_counter = payload_counter + 4;
    }
    else 
      start_pos = payload_counter;
    
    
    // 0 type (enum32)
    if (TravelAssist_array_relevantObjects_type_available[j] == 1)
    {
      tag_dataID = 0;
      TravelAssist_payload_buffer_relevantObjects[payload_counter++] = 2 * 16 /* Wiretype = 2  =^ 32 Bit */ + ((tag_dataID>>8) & 0x0F) /* DataID High Part */ ;
      TravelAssist_payload_buffer_relevantObjects[payload_counter++] = tag_dataID & 0xFF /* DataID Low Part */ ;
      
      TravelAssist_payload_buffer_relevantObjects[payload_counter++] = TravelAssist_array_relevantObjects_type[j]>>24 & 0xFF;
      TravelAssist_payload_buffer_relevantObjects[payload_counter++] = TravelAssist_array_relevantObjects_type[j]>>16 & 0xFF;
      TravelAssist_payload_buffer_relevantObjects[payload_counter++] = TravelAssist_array_relevantObjects_type[j]>> 8 & 0xFF;
      TravelAssist_payload_buffer_relevantObjects[payload_counter++] = TravelAssist_array_relevantObjects_type[j]     & 0xFF;
    }
    
    
    // 1 longitudinalDistance (float32)
    if (TravelAssist_array_relevantObjects_longitudinalDistance_available[j] == 1)
    {
      tag_dataID = 1;
      TravelAssist_payload_buffer_relevantObjects[payload_counter++] = 2 * 16 /* Wiretype = 2  =^ 32 Bit */ + ((tag_dataID>>8) & 0x0F) /* DataID High Part */ ;
      TravelAssist_payload_buffer_relevantObjects[payload_counter++] = tag_dataID & 0xFF /* DataID Low Part */ ;
      
      temp_converttodword = interpretAsDword (TravelAssist_array_relevantObjects_longitudinalDistance[j]);
      TravelAssist_payload_buffer_relevantObjects[payload_counter++] = temp_converttodword>>24 & 0xFF;
      TravelAssist_payload_buffer_relevantObjects[payload_counter++] = temp_converttodword>>16 & 0xFF;
      TravelAssist_payload_buffer_relevantObjects[payload_counter++] = temp_converttodword>> 8 & 0xFF;
      TravelAssist_payload_buffer_relevantObjects[payload_counter++] = temp_converttodword     & 0xFF;
    }
    
    
    // 2 percentagePosition (float32)
    if (TravelAssist_array_relevantObjects_percentagePosition_available[j] == 1)
    {
      tag_dataID = 2;
      TravelAssist_payload_buffer_relevantObjects[payload_counter++] = 2 * 16 /* Wiretype = 2  =^ 32 Bit */ + ((tag_dataID>>8) & 0x0F) /* DataID High Part */ ;
      TravelAssist_payload_buffer_relevantObjects[payload_counter++] = tag_dataID & 0xFF /* DataID Low Part */ ;
      
      temp_converttodword = interpretAsDword (TravelAssist_array_relevantObjects_percentagePosition[j]);
      TravelAssist_payload_buffer_relevantObjects[payload_counter++] = temp_converttodword>>24 & 0xFF;
      TravelAssist_payload_buffer_relevantObjects[payload_counter++] = temp_converttodword>>16 & 0xFF;
      TravelAssist_payload_buffer_relevantObjects[payload_counter++] = temp_converttodword>> 8 & 0xFF;
      TravelAssist_payload_buffer_relevantObjects[payload_counter++] = temp_converttodword     & 0xFF;
    }
    
    
    // 3 laneMapping (enum32)
    if (TravelAssist_array_relevantObjects_laneMapping_available[j] == 1)
    {
      tag_dataID = 3;
      TravelAssist_payload_buffer_relevantObjects[payload_counter++] = 2 * 16 /* Wiretype = 2  =^ 32 Bit */ + ((tag_dataID>>8) & 0x0F) /* DataID High Part */ ;
      TravelAssist_payload_buffer_relevantObjects[payload_counter++] = tag_dataID & 0xFF /* DataID Low Part */ ;
      
      TravelAssist_payload_buffer_relevantObjects[payload_counter++] = TravelAssist_array_relevantObjects_laneMapping[j]>>24 & 0xFF;
      TravelAssist_payload_buffer_relevantObjects[payload_counter++] = TravelAssist_array_relevantObjects_laneMapping[j]>>16 & 0xFF;
      TravelAssist_payload_buffer_relevantObjects[payload_counter++] = TravelAssist_array_relevantObjects_laneMapping[j]>> 8 & 0xFF;
      TravelAssist_payload_buffer_relevantObjects[payload_counter++] = TravelAssist_array_relevantObjects_laneMapping[j]     & 0xFF;
    }
    
    
    // 4 objectType (enum32)
    if (TravelAssist_array_relevantObjects_objectType_available[j] == 1)
    {
      tag_dataID = 4;
      TravelAssist_payload_buffer_relevantObjects[payload_counter++] = 2 * 16 /* Wiretype = 2  =^ 32 Bit */ + ((tag_dataID>>8) & 0x0F) /* DataID High Part */ ;
      TravelAssist_payload_buffer_relevantObjects[payload_counter++] = tag_dataID & 0xFF /* DataID Low Part */ ;
      
      TravelAssist_payload_buffer_relevantObjects[payload_counter++] = TravelAssist_array_relevantObjects_objectType[j]>>24 & 0xFF;
      TravelAssist_payload_buffer_relevantObjects[payload_counter++] = TravelAssist_array_relevantObjects_objectType[j]>>16 & 0xFF;
      TravelAssist_payload_buffer_relevantObjects[payload_counter++] = TravelAssist_array_relevantObjects_objectType[j]>> 8 & 0xFF;
      TravelAssist_payload_buffer_relevantObjects[payload_counter++] = TravelAssist_array_relevantObjects_objectType[j]     & 0xFF;
    }
    
    
    // 5 isTransversalControlActive (boolean)
    if (TravelAssist_array_relevantObjects_isTransversalControlActive_available[j] == 1)
    {
      tag_dataID = 5;
      TravelAssist_payload_buffer_relevantObjects[payload_counter++] = 0 * 16 /* Wiretype = 0  =^ 8 Bit */ + ((tag_dataID>>8) & 0x0F) /* DataID High Part */ ;
      TravelAssist_payload_buffer_relevantObjects[payload_counter++] = tag_dataID & 0xFF /* DataID Low Part */ ;
      
      TravelAssist_payload_buffer_relevantObjects[payload_counter++] = TravelAssist_array_relevantObjects_isTransversalControlActive[j] & 0xFF;
    }
    
    // 6 isLongitudinalControlActive (boolean)
    if (TravelAssist_array_relevantObjects_isLongitudinalControlActive_available[j] == 1)
    {
      tag_dataID = 6;
      TravelAssist_payload_buffer_relevantObjects[payload_counter++] = 0 * 16 /* Wiretype = 0  =^ 8 Bit */ + ((tag_dataID>>8) & 0x0F) /* DataID High Part */ ;
      TravelAssist_payload_buffer_relevantObjects[payload_counter++] = tag_dataID & 0xFF /* DataID Low Part */ ;
      
      TravelAssist_payload_buffer_relevantObjects[payload_counter++] = TravelAssist_array_relevantObjects_isLongitudinalControlActive[j] & 0xFF;
    }
    
    
    //Element Length
    element_length = payload_counter-start_pos;
    if (element_length >0) TravelAssist_array_relevantObjects_array_element_length[j] = element_length - 4;
    else                   TravelAssist_array_relevantObjects_array_element_length[j] = element_length;
    
    TravelAssist_payload_buffer_relevantObjects[start_pos++] = TravelAssist_array_relevantObjects_array_element_length[j]>>24 & 0xFF;
    TravelAssist_payload_buffer_relevantObjects[start_pos++] = TravelAssist_array_relevantObjects_array_element_length[j]>>16 & 0xFF;
    TravelAssist_payload_buffer_relevantObjects[start_pos++] = TravelAssist_array_relevantObjects_array_element_length[j]>> 8 & 0xFF;
    TravelAssist_payload_buffer_relevantObjects[start_pos++] = TravelAssist_array_relevantObjects_array_element_length[j]     & 0xFF;
    
    if (TravelAssist_array_relevantObjects_array_element_length[j] == 0) payload_counter = payload_counter+4;
  }
  
  // Struct Length
  TravelAssist_array_relevantObjects_struct_element_length = 4*@TravelAssist_Notification_relevantObjects_Element_TotalNum;

  for (k=0;k<@TravelAssist_Notification_relevantObjects_Element_TotalNum;k++)
    TravelAssist_array_relevantObjects_struct_element_length = TravelAssist_array_relevantObjects_struct_element_length + TravelAssist_array_relevantObjects_array_element_length[k];
  
  TravelAssist_payload_buffer_relevantObjects[0] = TravelAssist_array_relevantObjects_struct_element_length>>24 & 0xFF;
  TravelAssist_payload_buffer_relevantObjects[1] = TravelAssist_array_relevantObjects_struct_element_length>>16 & 0xFF;
  TravelAssist_payload_buffer_relevantObjects[2] = TravelAssist_array_relevantObjects_struct_element_length>> 8 & 0xFF;
  TravelAssist_payload_buffer_relevantObjects[3] = TravelAssist_array_relevantObjects_struct_element_length     & 0xFF;


  TravelAssist_payload_length_relevantObjects = TravelAssist_array_relevantObjects_struct_element_length+4;
  putvalue(TravelAssist_Notification_relevantObjects_Payload, TravelAssist_payload_buffer_relevantObjects, TravelAssist_payload_length_relevantObjects);
}

on envVar TravelAssist_Notification_relevantObjects_Element_TotalNum
{
  if (@this == 0) @this =  1;
  if (@this > 10) @this = 10;
  
  TravelAssist_Notification_relevantObjects();
  TravelAssist_Notification_relevantObjects_update();
}

on envVar TravelAssist_Notification_relevantObjects_Element
{
  TravelAssist_Notification_relevantObjects_update();
}

on envVar TravelAssist_Notification_relevantObjects_Element_Next
{
  if (@this == 1 && @TravelAssist_Notification_relevantObjects_Element < @TravelAssist_Notification_relevantObjects_Element_TotalNum - 1)
  {
    @TravelAssist_Notification_relevantObjects_Element = @TravelAssist_Notification_relevantObjects_Element + 1;
    TravelAssist_Notification_relevantObjects_update();
  }
}

on envVar TravelAssist_Notification_relevantObjects_Element_Previous
{
  if (@this == 1 && @TravelAssist_Notification_relevantObjects_Element > 0)
  {
    @TravelAssist_Notification_relevantObjects_Element = @TravelAssist_Notification_relevantObjects_Element - 1;
    TravelAssist_Notification_relevantObjects_update();
  }
}

TravelAssist_Notification_relevantObjects_update()
{
  @TravelAssist_Notification_LengthIndicator_Element_relevantObjects = TravelAssist_array_relevantObjects_array_element_length[@TravelAssist_Notification_relevantObjects_Element];
  @TravelAssist_Notification_LengthIndicator_Struct_relevantObjects  = TravelAssist_array_relevantObjects_struct_element_length;
  @TravelAssist_Notification_Length_relevantObjects                  = TravelAssist_payload_length_relevantObjects+8;
  
  @TravelAssist_Notification_relevantObjects_type                        = TravelAssist_array_relevantObjects_type[@TravelAssist_Notification_relevantObjects_Element];
  @TravelAssist_Notification_relevantObjects_longitudinalDistance        = TravelAssist_array_relevantObjects_longitudinalDistance[@TravelAssist_Notification_relevantObjects_Element];
  @TravelAssist_Notification_relevantObjects_percentagePosition          = TravelAssist_array_relevantObjects_percentagePosition[@TravelAssist_Notification_relevantObjects_Element];
  @TravelAssist_Notification_relevantObjects_laneMapping                 = TravelAssist_array_relevantObjects_laneMapping[@TravelAssist_Notification_relevantObjects_Element];
  @TravelAssist_Notification_relevantObjects_objectType                  = TravelAssist_array_relevantObjects_objectType[@TravelAssist_Notification_relevantObjects_Element];
  @TravelAssist_Notification_relevantObjects_isTransversalControlActive  = TravelAssist_array_relevantObjects_isTransversalControlActive[@TravelAssist_Notification_relevantObjects_Element];
  @TravelAssist_Notification_relevantObjects_isLongitudinalControlActive = TravelAssist_array_relevantObjects_isLongitudinalControlActive[@TravelAssist_Notification_relevantObjects_Element];
  
  @TravelAssist_Notification_relevantObjects_type_available                        = TravelAssist_array_relevantObjects_type_available[@TravelAssist_Notification_relevantObjects_Element];
  @TravelAssist_Notification_relevantObjects_longitudinalDistance_available        = TravelAssist_array_relevantObjects_longitudinalDistance_available[@TravelAssist_Notification_relevantObjects_Element];
  @TravelAssist_Notification_relevantObjects_percentagePosition_available          = TravelAssist_array_relevantObjects_percentagePosition_available[@TravelAssist_Notification_relevantObjects_Element];
  @TravelAssist_Notification_relevantObjects_laneMapping_available                 = TravelAssist_array_relevantObjects_laneMapping_available[@TravelAssist_Notification_relevantObjects_Element];
  @TravelAssist_Notification_relevantObjects_objectType_available                  = TravelAssist_array_relevantObjects_objectType_available[@TravelAssist_Notification_relevantObjects_Element];
  @TravelAssist_Notification_relevantObjects_isTransversalControlActive_available  = TravelAssist_array_relevantObjects_isTransversalControlActive_available[@TravelAssist_Notification_relevantObjects_Element];
  @TravelAssist_Notification_relevantObjects_isLongitudinalControlActive_available = TravelAssist_array_relevantObjects_isLongitudinalControlActive_available[@TravelAssist_Notification_relevantObjects_Element];
}







//////////////////////////////////////////////////////
////////////////// Service Odometry //////////////////
//////////////////////////////////////////////////////

on envVar ServiceDiscovery_Offer_Service_Odometry
{
  Send_ServiceDiscovery_Offer_Service_ICAS1Gateway();
}

on envVar Odometry_Notification_speeds_Send
{
  if (@this == 1)
  {
    UDP_Segments_total = @Odometry_Notification_Length_speeds/1404 + 1;
    UDP_Segments_left  = UDP_Segments_total;
    
    if (UDP_Segments_total > 1) seg_id_flag = 1;
    else                        seg_id_flag = 0;
    
    Send_Service_Odometry_Notification (0xC010 & 0x0000FFFF);
  }
}
on envVar Odometry_Notification_speeds_Send_cyclic
{
  if (@this == 1)
    setTimercyclic (tOdometry_Notification_speeds_Send, @Odometry_Notification_speeds_Send_cyclic_cycletime);
  else
    cancelTimer (tOdometry_Notification_speeds_Send);
}
on envVar Odometry_Notification_speeds_Send_cyclic_cycletime
{
  if (@Odometry_Notification_speeds_Send_cyclic == 1)
  {
    cancelTimer (tOdometry_Notification_speeds_Send);
    setTimercyclic (tOdometry_Notification_speeds_Send, @this);
  }
}
on timer tOdometry_Notification_speeds_Send
{
  UDP_Segments_total = @Odometry_Notification_Length_speeds/1404 + 1;
  UDP_Segments_left  = UDP_Segments_total;
  
  if (UDP_Segments_total > 1) seg_id_flag = 1;
  else                        seg_id_flag = 0;
    
  Send_Service_Odometry_Notification (0xC010 & 0x0000FFFF);
}

on envVar Odometry_Notification_velocities_Send
{
  if (@this == 1)
  {
    UDP_Segments_total = @Odometry_Notification_Length_velocities/1404 + 1;
    UDP_Segments_left  = UDP_Segments_total;
    
    if (UDP_Segments_total > 1) seg_id_flag = 1;
    else                        seg_id_flag = 0;
    
    Send_Service_Odometry_Notification (0xC020 & 0x0000FFFF);
  }
}
on envVar Odometry_Notification_velocities_Send_cyclic
{
  if (@this == 1)
    setTimercyclic (tOdometry_Notification_velocities_Send, @Odometry_Notification_velocities_Send_cyclic_cycletime);
  else
    cancelTimer (tOdometry_Notification_velocities_Send);
}
on envVar Odometry_Notification_velocities_Send_cyclic_cycletime
{
  if (@Odometry_Notification_velocities_Send_cyclic == 1)
  {
    cancelTimer (tOdometry_Notification_velocities_Send);
    setTimercyclic (tOdometry_Notification_velocities_Send, @this);
  }
}
on timer tOdometry_Notification_velocities_Send
{
  UDP_Segments_total = @Odometry_Notification_Length_velocities/1404 + 1;
  UDP_Segments_left  = UDP_Segments_total;
  
  if (UDP_Segments_total > 1) seg_id_flag = 1;
  else                        seg_id_flag = 0;
    
  Send_Service_Odometry_Notification (0xC020 & 0x0000FFFF);
}

on envVar Odometry_Notification_pose2D_Send
{
  if (@this == 1)
  {
    UDP_Segments_total = @Odometry_Notification_Length_pose2D/1404 + 1;
    UDP_Segments_left  = UDP_Segments_total;
    
    if (UDP_Segments_total > 1) seg_id_flag = 1;
    else                        seg_id_flag = 0;
    
    Send_Service_Odometry_Notification (0xC030 & 0x0000FFFF);
  }
}
on envVar Odometry_Notification_pose2D_Send_cyclic
{
  if (@this == 1)
    setTimercyclic (tOdometry_Notification_pose2D_Send, @Odometry_Notification_pose2D_Send_cyclic_cycletime);
  else
    cancelTimer (tOdometry_Notification_pose2D_Send);
}
on envVar Odometry_Notification_pose2D_Send_cyclic_cycletime
{
  if (@Odometry_Notification_pose2D_Send_cyclic == 1)
  {
    cancelTimer (tOdometry_Notification_pose2D_Send);
    setTimercyclic (tOdometry_Notification_pose2D_Send, @this);
  }
}
on timer tOdometry_Notification_pose2D_Send
{
  UDP_Segments_total = @Odometry_Notification_Length_pose2D/1404 + 1;
  UDP_Segments_left  = UDP_Segments_total;
  
  if (UDP_Segments_total > 1) seg_id_flag = 1;
  else                        seg_id_flag = 0;
    
  Send_Service_Odometry_Notification (0xC030 & 0x0000FFFF);
}

on envVar Odometry_Notification_additionalVehicleMotionInformations_Send
{
  if (@this == 1)
  {
    UDP_Segments_total = @Odometry_Notification_Length_additionalVehicleMotionInformations/1404 + 1;
    UDP_Segments_left  = UDP_Segments_total;
    
    if (UDP_Segments_total > 1) seg_id_flag = 1;
    else                        seg_id_flag = 0;
    
    Send_Service_Odometry_Notification (0xC040 & 0x0000FFFF);
  }
}
on envVar Odometry_Notification_additionalVehicleMotionInformations_Send_cyclic
{
  if (@this == 1)
    setTimercyclic (tOdometry_Notification_additionalVehicleMotionInformations_Send, @Odometry_Notification_additionalVehicleMotionInformations_Send_cyclic_cycletime);
  else
    cancelTimer (tOdometry_Notification_additionalVehicleMotionInformations_Send);
}
on envVar Odometry_Notification_additionalVehicleMotionInformations_Send_cyclic_cycletime
{
  if (@Odometry_Notification_additionalVehicleMotionInformations_Send_cyclic == 1)
  {
    cancelTimer (tOdometry_Notification_additionalVehicleMotionInformations_Send);
    setTimercyclic (tOdometry_Notification_additionalVehicleMotionInformations_Send, @this);
  }
}
on timer tOdometry_Notification_additionalVehicleMotionInformations_Send
{
  UDP_Segments_total = @Odometry_Notification_Length_additionalVehicleMotionInformations/1404 + 1;
  UDP_Segments_left  = UDP_Segments_total;
  
  if (UDP_Segments_total > 1) seg_id_flag = 1;
  else                        seg_id_flag = 0;
    
  Send_Service_Odometry_Notification (0xC040 & 0x0000FFFF);
}

on envVar Odometry_Notification_wheelCorrections_Send
{
  if (@this == 1)
  {
    UDP_Segments_total = @Odometry_Notification_Length_wheelCorrections/1404 + 1;
    UDP_Segments_left  = UDP_Segments_total;
    
    if (UDP_Segments_total > 1) seg_id_flag = 1;
    else                        seg_id_flag = 0;
    
    Send_Service_Odometry_Notification (0xC050 & 0x0000FFFF);
  }
}
on envVar Odometry_Notification_wheelCorrections_Send_cyclic
{
  if (@this == 1)
    setTimercyclic (tOdometry_Notification_wheelCorrections_Send, @Odometry_Notification_wheelCorrections_Send_cyclic_cycletime);
  else
    cancelTimer (tOdometry_Notification_wheelCorrections_Send);
}
on envVar Odometry_Notification_wheelCorrections_Send_cyclic_cycletime
{
  if (@Odometry_Notification_wheelCorrections_Send_cyclic == 1)
  {
    cancelTimer (tOdometry_Notification_wheelCorrections_Send);
    setTimercyclic (tOdometry_Notification_wheelCorrections_Send, @this);
  }
}
on timer tOdometry_Notification_wheelCorrections_Send
{
  UDP_Segments_total = @Odometry_Notification_Length_wheelCorrections/1404 + 1;
  UDP_Segments_left  = UDP_Segments_total;
  
  if (UDP_Segments_total > 1) seg_id_flag = 1;
  else                        seg_id_flag = 0;
    
  Send_Service_Odometry_Notification (0xC050 & 0x0000FFFF);
}

on envVar Odometry_Notification_accelerations_Send
{
  if (@this == 1)
  {
    UDP_Segments_total = @Odometry_Notification_Length_accelerations/1404 + 1;
    UDP_Segments_left  = UDP_Segments_total;
    
    if (UDP_Segments_total > 1) seg_id_flag = 1;
    else                        seg_id_flag = 0;
    
    Send_Service_Odometry_Notification (0xC060 & 0x0000FFFF);
  }
}
on envVar Odometry_Notification_accelerations_Send_cyclic
{
  if (@this == 1)
    setTimercyclic (tOdometry_Notification_accelerations_Send, @Odometry_Notification_accelerations_Send_cyclic_cycletime);
  else
    cancelTimer (tOdometry_Notification_accelerations_Send);
}
on envVar Odometry_Notification_accelerations_Send_cyclic_cycletime
{
  if (@Odometry_Notification_accelerations_Send_cyclic == 1)
  {
    cancelTimer (tOdometry_Notification_accelerations_Send);
    setTimercyclic (tOdometry_Notification_accelerations_Send, @this);
  }
}
on timer tOdometry_Notification_accelerations_Send
{
  UDP_Segments_total = @Odometry_Notification_Length_accelerations/1404 + 1;
  UDP_Segments_left  = UDP_Segments_total;
  
  if (UDP_Segments_total > 1) seg_id_flag = 1;
  else                        seg_id_flag = 0;
    
  Send_Service_Odometry_Notification (0xC060 & 0x0000FFFF);
}

on envVar Odometry_Notification_angularRates_Send
{
  if (@this == 1)
  {
    UDP_Segments_total = @Odometry_Notification_Length_angularRates/1404 + 1;
    UDP_Segments_left  = UDP_Segments_total;
    
    if (UDP_Segments_total > 1) seg_id_flag = 1;
    else                        seg_id_flag = 0;
    
    Send_Service_Odometry_Notification (0xC070 & 0x0000FFFF);
  }
}
on envVar Odometry_Notification_angularRates_Send_cyclic
{
  if (@this == 1)
    setTimercyclic (tOdometry_Notification_angularRates_Send, @Odometry_Notification_angularRates_Send_cyclic_cycletime);
  else
    cancelTimer (tOdometry_Notification_angularRates_Send);
}
on envVar Odometry_Notification_angularRates_Send_cyclic_cycletime
{
  if (@Odometry_Notification_angularRates_Send_cyclic == 1)
  {
    cancelTimer (tOdometry_Notification_angularRates_Send);
    setTimercyclic (tOdometry_Notification_angularRates_Send, @this);
  }
}
on timer tOdometry_Notification_angularRates_Send
{
  UDP_Segments_total = @Odometry_Notification_Length_angularRates/1404 + 1;
  UDP_Segments_left  = UDP_Segments_total;
  
  if (UDP_Segments_total > 1) seg_id_flag = 1;
  else                        seg_id_flag = 0;
    
  Send_Service_Odometry_Notification (0xC070 & 0x0000FFFF);
}


Send_Service_Odometry_Notification (word MethodID)
{
  ethernetPacket EthPaket;

  // Ethernet Packet - MAC Source address
  getvalue (ServiceDiscovery_EthernetPacket_MAC_Source_ICAS1Gateway, buffer_MAC);
  //EthPaket.source.ParseAddress ( buffer_MAC );
  EthPaket.source = ethGetMacAddressAsNumber (buffer_MAC);
  
  // Ethernet Packet - MAC Destination address
  getvalue (ServiceDiscovery_EthernetPacket_MAC_Destination, buffer_MAC);
  //EthPaket.destination.ParseAddress ( buffer_MAC );
  EthPaket.destination = ethGetMacAddressAsNumber (buffer_MAC);
  
  // Ethernet Packet - VLAN
  EthPaket.SetVlan (@ServiceDiscovery_EthernetPacket_VLAN_TPID, @ServiceDiscovery_EthernetPacket_VLAN_TCI);
  
  // Ethernet Packet - Type
  //EthPaket.ipv6.type = @EthernetPacket_Type;
  if (@ServiceDiscovery_EthernetPacket_Type == 0x86DD) EthPaket.ipv6.Init();
  
  
  // IPv6 Packet - Version
  EthPaket.ipv6.version = @ServiceDiscovery_IPv6Packet_Version;

  // IPv6 Packet - Traffic Class
  EthPaket.ipv6.class = @ServiceDiscovery_IPv6Packet_Traffic_Class;
  
  // IPv6 Packet - Flow Label
  EthPaket.ipv6.flow = @ServiceDiscovery_IPv6Packet_Flow_Label;
  
  // IPv6 Packet - Payload_Length
  EthPaket.ipv6.length = @ServiceDiscovery_IPv6Packet_Payload_Length;
  
  // IPv6 Packet - Next Header
  EthPaket.ipv6.next = @ServiceDiscovery_IPv6Packet_Next_Header;
  if (@ServiceDiscovery_IPv6Packet_Next_Header == 6) EthPaket.tcp.Init();
  if (@ServiceDiscovery_IPv6Packet_Next_Header == 17) EthPaket.udp.Init();
  
  // IPv6 Packet - Hop Limit
  EthPaket.ipv6.hopLimit = @ServiceDiscovery_IPv6Packet_Hop_Limit;

  // IPv6 Packet - IPv6 Destination address    // TODO: char array zu byte array
  buffer_ipv6[0]  = @ServiceDiscovery_IPv6Packet_IP_Destination_Unicast_01>>8 & 0xFF;
  buffer_ipv6[1]  = @ServiceDiscovery_IPv6Packet_IP_Destination_Unicast_01    & 0xFF;
  buffer_ipv6[2]  = @ServiceDiscovery_IPv6Packet_IP_Destination_Unicast_02>>8 & 0xFF;
  buffer_ipv6[3]  = @ServiceDiscovery_IPv6Packet_IP_Destination_Unicast_02    & 0xFF;
  buffer_ipv6[4]  = @ServiceDiscovery_IPv6Packet_IP_Destination_Unicast_03>>8 & 0xFF;
  buffer_ipv6[5]  = @ServiceDiscovery_IPv6Packet_IP_Destination_Unicast_03    & 0xFF;
  buffer_ipv6[6]  = @ServiceDiscovery_IPv6Packet_IP_Destination_Unicast_04>>8 & 0xFF;
  buffer_ipv6[7]  = @ServiceDiscovery_IPv6Packet_IP_Destination_Unicast_04    & 0xFF;
  buffer_ipv6[8]  = @ServiceDiscovery_IPv6Packet_IP_Destination_Unicast_05>>8 & 0xFF;
  buffer_ipv6[9]  = @ServiceDiscovery_IPv6Packet_IP_Destination_Unicast_05    & 0xFF;
  buffer_ipv6[10] = @ServiceDiscovery_IPv6Packet_IP_Destination_Unicast_06>>8 & 0xFF;
  buffer_ipv6[11] = @ServiceDiscovery_IPv6Packet_IP_Destination_Unicast_06    & 0xFF;
  buffer_ipv6[12] = @ServiceDiscovery_IPv6Packet_IP_Destination_Unicast_07>>8 & 0xFF;
  buffer_ipv6[13] = @ServiceDiscovery_IPv6Packet_IP_Destination_Unicast_07    & 0xFF;
  buffer_ipv6[14] = @ServiceDiscovery_IPv6Packet_IP_Destination_Unicast_08>>8 & 0xFF;
  buffer_ipv6[15] = @ServiceDiscovery_IPv6Packet_IP_Destination_Unicast_08    & 0xFF;
  EthPaket.ipv6.destination.SetData ( 0, buffer_ipv6, elcount(buffer_ipv6) );

  // IPv6 Packet - IPv6 Source address    // TODO: char array zu byte array
  buffer_ipv6[0]  = @ServiceDiscovery_IPv6Packet_IP_Source_ICAS1Gateway_01>>8 & 0xFF;
  buffer_ipv6[1]  = @ServiceDiscovery_IPv6Packet_IP_Source_ICAS1Gateway_01    & 0xFF;
  buffer_ipv6[2]  = @ServiceDiscovery_IPv6Packet_IP_Source_ICAS1Gateway_02>>8 & 0xFF;
  buffer_ipv6[3]  = @ServiceDiscovery_IPv6Packet_IP_Source_ICAS1Gateway_02    & 0xFF;
  buffer_ipv6[4]  = @ServiceDiscovery_IPv6Packet_IP_Source_ICAS1Gateway_03>>8 & 0xFF;
  buffer_ipv6[5]  = @ServiceDiscovery_IPv6Packet_IP_Source_ICAS1Gateway_03    & 0xFF;
  buffer_ipv6[6]  = @ServiceDiscovery_IPv6Packet_IP_Source_ICAS1Gateway_04>>8 & 0xFF;
  buffer_ipv6[7]  = @ServiceDiscovery_IPv6Packet_IP_Source_ICAS1Gateway_04    & 0xFF;
  buffer_ipv6[8]  = @ServiceDiscovery_IPv6Packet_IP_Source_ICAS1Gateway_05>>8 & 0xFF;
  buffer_ipv6[9]  = @ServiceDiscovery_IPv6Packet_IP_Source_ICAS1Gateway_05    & 0xFF;
  buffer_ipv6[10] = @ServiceDiscovery_IPv6Packet_IP_Source_ICAS1Gateway_06>>8 & 0xFF;
  buffer_ipv6[11] = @ServiceDiscovery_IPv6Packet_IP_Source_ICAS1Gateway_06    & 0xFF;
  buffer_ipv6[12] = @ServiceDiscovery_IPv6Packet_IP_Source_ICAS1Gateway_07>>8 & 0xFF;
  buffer_ipv6[13] = @ServiceDiscovery_IPv6Packet_IP_Source_ICAS1Gateway_07    & 0xFF;
  buffer_ipv6[14] = @ServiceDiscovery_IPv6Packet_IP_Source_ICAS1Gateway_08>>8 & 0xFF;
  buffer_ipv6[15] = @ServiceDiscovery_IPv6Packet_IP_Source_ICAS1Gateway_08    & 0xFF;
  EthPaket.ipv6.source.SetData ( 0, buffer_ipv6, elcount(buffer_ipv6) );

  
  // UDP Packet - Source Port
  EthPaket.udp.source = @Odometry_Notification_Port_Source;
  
  // UDP Packet - Destination Port
  EthPaket.udp.destination = @Odometry_Notification_Port_Destination;
  
  // UDP Packet - Length
  EthPaket.udp.length = @ServiceDiscovery_UDPPacket_Length;
  
  
  // SOME/IP Packet aus Rohdaten zusammenbauen (buffer array)
  i=0;
  
  // SOME/IP Packet - Message ID, Service ID [16 bit]
  buffer[i++] = @Odometry_Notification_Message_ID_Service_ID>>8 & 0xFF;
  buffer[i++] = @Odometry_Notification_Message_ID_Service_ID    & 0xFF;
  
  // SOME/IP Packet - Message ID, Message ID [16 bit]
  switch (MethodID)
  {
    case 0xC010: @Odometry_Notification_Message_ID_Method_ID = @Odometry_Notification_Message_ID_Method_ID_speeds; break;
    case 0xC020: @Odometry_Notification_Message_ID_Method_ID = @Odometry_Notification_Message_ID_Method_ID_velocities; break;
    case 0xC030: @Odometry_Notification_Message_ID_Method_ID = @Odometry_Notification_Message_ID_Method_ID_pose2D; break;
    case 0xC040: @Odometry_Notification_Message_ID_Method_ID = @Odometry_Notification_Message_ID_Method_ID_additionalVehicleMotionInformations; break;
    case 0xC050: @Odometry_Notification_Message_ID_Method_ID = @Odometry_Notification_Message_ID_Method_ID_wheelCorrections; break;
    case 0xC060: @Odometry_Notification_Message_ID_Method_ID = @Odometry_Notification_Message_ID_Method_ID_accelerations; break;
    case 0xC070: @Odometry_Notification_Message_ID_Method_ID = @Odometry_Notification_Message_ID_Method_ID_angularRates; break;
  }
  buffer[i++] = @Odometry_Notification_Message_ID_Method_ID>>8 & 0xFF;
  buffer[i++] = @Odometry_Notification_Message_ID_Method_ID    & 0xFF;
  
  // SOME/IP Packet - Length [32 bit]
  if (UDP_Segments_total == 1)
  {
    switch (MethodID)
    {
      case 0xC010: @Odometry_Notification_Length = @Odometry_Notification_Length_speeds; break;
      case 0xC020: @Odometry_Notification_Length = @Odometry_Notification_Length_velocities; break;
      case 0xC030: @Odometry_Notification_Length = @Odometry_Notification_Length_pose2D; break;
      case 0xC040: @Odometry_Notification_Length = @Odometry_Notification_Length_additionalVehicleMotionInformations; break;
      case 0xC050: @Odometry_Notification_Length = @Odometry_Notification_Length_wheelCorrections; break;
      case 0xC060: @Odometry_Notification_Length = @Odometry_Notification_Length_accelerations; break;
      case 0xC070: @Odometry_Notification_Length = @Odometry_Notification_Length_angularRates; break;
    }
  }
  else
  {
    if (UDP_Segments_left > 1)
    {
      switch (MethodID)
      {
        case 0xC010: @Odometry_Notification_Length = 1404; break;
        case 0xC020: @Odometry_Notification_Length = 1404; break;
        case 0xC030: @Odometry_Notification_Length = 1404; break;
        case 0xC040: @Odometry_Notification_Length = 1404; break;
        case 0xC050: @Odometry_Notification_Length = 1404; break;
        case 0xC060: @Odometry_Notification_Length = 1404; break;
        case 0xC070: @Odometry_Notification_Length = 1404; break;
      }
    }
    else
    {
      switch (MethodID)
      {
        case 0xC010: @Odometry_Notification_Length = Odometry_payload_length_speeds                              - 1404*(UDP_Segments_total-UDP_Segments_left) + 24; break;
        case 0xC020: @Odometry_Notification_Length = Odometry_payload_length_velocities                          - 1404*(UDP_Segments_total-UDP_Segments_left) + 24; break;
        case 0xC030: @Odometry_Notification_Length = Odometry_payload_length_pose2D                              - 1404*(UDP_Segments_total-UDP_Segments_left) + 24; break;
        case 0xC040: @Odometry_Notification_Length = Odometry_payload_length_additionalVehicleMotionInformations - 1404*(UDP_Segments_total-UDP_Segments_left) + 24; break;
        case 0xC050: @Odometry_Notification_Length = Odometry_payload_length_wheelCorrections                    - 1404*(UDP_Segments_total-UDP_Segments_left) + 24; break;
        case 0xC060: @Odometry_Notification_Length = Odometry_payload_length_accelerations                       - 1404*(UDP_Segments_total-UDP_Segments_left) + 24; break;
        case 0xC070: @Odometry_Notification_Length = Odometry_payload_length_angularRates                        - 1404*(UDP_Segments_total-UDP_Segments_left) + 24; break;
      }
    }
  }
  buffer[i++] = @Odometry_Notification_Length>>24 & 0xFF;
  buffer[i++] = @Odometry_Notification_Length>>16 & 0xFF;
  buffer[i++] = @Odometry_Notification_Length>> 8 & 0xFF;
  buffer[i++] = @Odometry_Notification_Length     & 0xFF;
  
  // SOME/IP Packet - Request ID, Client ID [16 bit]
  buffer[i++] = @Odometry_Notification_Request_ID_Client_ID>>8 & 0xFF;
  buffer[i++] = @Odometry_Notification_Request_ID_Client_ID    & 0xFF;
  
  // SOME/IP Packet - Request ID, Session ID) [16 bit]
  if ((UDP_Segments_total == 1) || (seg_id_flag == 1))
  {
    @ServiceDiscovery_SOMEIPPacket_Notification_Request_ID_Session_ID = @ServiceDiscovery_SOMEIPPacket_Notification_Request_ID_Session_ID + 1;
    if (@ServiceDiscovery_SOMEIPPacket_Notification_Request_ID_Session_ID == 0x10000) @ServiceDiscovery_SOMEIPPacket_Notification_Request_ID_Session_ID = 1;
    seg_id_flag = 0;
  }
  
  buffer[i++] = @ServiceDiscovery_SOMEIPPacket_Notification_Request_ID_Session_ID>>8 & 0xFF;
  buffer[i++] = @ServiceDiscovery_SOMEIPPacket_Notification_Request_ID_Session_ID    & 0xFF;
  
  // SOME/IP Packet - Protocol Version [8 bit]
  buffer[i++] = @Odometry_Notification_Protocol_Version;
  
  // SOME/IP Packet - Interface Version [8 bit]
  buffer[i++] = @Odometry_Notification_Interface_Version;
  
  // SOME/IP Packet - Message Type [8 bit]
  buffer[i++] = @Odometry_Notification_Message_Type;
  
  // SOME/IP Packet - Return Code [8 bit]
  buffer[i++] = @Odometry_Notification_Return_Code;
  
  
  if (UDP_Segments_total > 1)
  {
    if (UDP_Segments_left >= 0)
    { 
      // Message Type neu setzen
      buffer[i-2] = @Odometry_Notification_Message_Type + 0x20;
      
      // Offset (16byte Schritte, 1392/16 = 87)
      @Odometry_Notification_Offset = 87 * (UDP_Segments_total - UDP_Segments_left);
      
      // More Segments Flag
      if (UDP_Segments_left > 1) @Odometry_Notification_More_Segments_Flag = 1;
      else                       @Odometry_Notification_More_Segments_Flag = 0;
      
      buffer[i++] =   @Odometry_Notification_Offset>>20 & 0xFF;
      buffer[i++] =   @Odometry_Notification_Offset>>12 & 0xFF;
      buffer[i++] =   @Odometry_Notification_Offset>>4  & 0xFF;
      buffer[i++] = ((@Odometry_Notification_Offset<<4) & 0xF0) + (@Odometry_Notification_More_Segments_Flag & 0x01);
    }
  }
  
  UDP_Segments_left--;
  
  ////// speeds notifier //////
  if (MethodID == 0xC010)
  {
    if (UDP_Segments_total == 1)
    {
      for (j=0; j<Odometry_payload_length_speeds; j++)
        buffer[i++] = Odometry_payload_buffer_speeds[j];
    }
    else
    {
      if (UDP_Segments_left >= 1)
      {
        for (j=(UDP_Segments_total-UDP_Segments_left-1)*1392; j<(UDP_Segments_total-UDP_Segments_left)*1392; j++)
          buffer[i++] = Odometry_payload_buffer_speeds[j];
      }
      else
      {
        for (j=(UDP_Segments_total-(UDP_Segments_left+1))*1392; j<Odometry_payload_length_speeds; j++)
          buffer[i++] = Odometry_payload_buffer_speeds[j];
      }
    }
  }
  
  ////// velocities notifier //////
  if (MethodID == 0xC020)
  {
    if (UDP_Segments_total == 1)
    {
      for (j=0; j<Odometry_payload_length_velocities; j++)
        buffer[i++] = Odometry_payload_buffer_velocities[j];
    }
    else
    {
      if (UDP_Segments_left >= 1)
      {
        for (j=(UDP_Segments_total-UDP_Segments_left-1)*1392; j<(UDP_Segments_total-UDP_Segments_left)*1392; j++)
          buffer[i++] = Odometry_payload_buffer_velocities[j];
      }
      else
      {
        for (j=(UDP_Segments_total-(UDP_Segments_left+1))*1392; j<Odometry_payload_length_velocities; j++)
          buffer[i++] = Odometry_payload_buffer_velocities[j];
      }
    }
  }
  
  ////// pose2D notifier //////
  if (MethodID == 0xC030)
  {
    if (UDP_Segments_total == 1)
    {
      for (j=0; j<Odometry_payload_length_pose2D; j++)
        buffer[i++] = Odometry_payload_buffer_pose2D[j];
    }
    else
    {
      if (UDP_Segments_left >= 1)
      {
        for (j=(UDP_Segments_total-UDP_Segments_left-1)*1392; j<(UDP_Segments_total-UDP_Segments_left)*1392; j++)
          buffer[i++] = Odometry_payload_buffer_pose2D[j];
      }
      else
      {
        for (j=(UDP_Segments_total-(UDP_Segments_left+1))*1392; j<Odometry_payload_length_pose2D; j++)
          buffer[i++] = Odometry_payload_buffer_pose2D[j];
      }
    }
  }
  
  ////// additionalVehicleMotionInformations notifier //////
  if (MethodID == 0xC040)
  {
    if (UDP_Segments_total == 1)
    {
      for (j=0; j<Odometry_payload_length_additionalVehicleMotionInformations; j++)
        buffer[i++] = Odometry_payload_buffer_additionalVehicleMotionInformations[j];
    }
    else
    {
      if (UDP_Segments_left >= 1)
      {
        for (j=(UDP_Segments_total-UDP_Segments_left-1)*1392; j<(UDP_Segments_total-UDP_Segments_left)*1392; j++)
          buffer[i++] = Odometry_payload_buffer_additionalVehicleMotionInformations[j];
      }
      else
      {
        for (j=(UDP_Segments_total-(UDP_Segments_left+1))*1392; j<Odometry_payload_length_additionalVehicleMotionInformations; j++)
          buffer[i++] = Odometry_payload_buffer_additionalVehicleMotionInformations[j];
      }
    }
  }
  
  ////// wheelCorrections notifier //////
  if (MethodID == 0xC050)
  {
    if (UDP_Segments_total == 1)
    {
      for (j=0; j<Odometry_payload_length_wheelCorrections; j++)
        buffer[i++] = Odometry_payload_buffer_wheelCorrections[j];
    }
    else
    {
      if (UDP_Segments_left >= 1)
      {
        for (j=(UDP_Segments_total-UDP_Segments_left-1)*1392; j<(UDP_Segments_total-UDP_Segments_left)*1392; j++)
          buffer[i++] = Odometry_payload_buffer_wheelCorrections[j];
      }
      else
      {
        for (j=(UDP_Segments_total-(UDP_Segments_left+1))*1392; j<Odometry_payload_length_wheelCorrections; j++)
          buffer[i++] = Odometry_payload_buffer_wheelCorrections[j];
      }
    }
  }
  
  ////// accelerations notifier //////
  if (MethodID == 0xC060)
  {
    if (UDP_Segments_total == 1)
    {
      for (j=0; j<Odometry_payload_length_accelerations; j++)
        buffer[i++] = Odometry_payload_buffer_accelerations[j];
    }
    else
    {
      if (UDP_Segments_left >= 1)
      {
        for (j=(UDP_Segments_total-UDP_Segments_left-1)*1392; j<(UDP_Segments_total-UDP_Segments_left)*1392; j++)
          buffer[i++] = Odometry_payload_buffer_accelerations[j];
      }
      else
      {
        for (j=(UDP_Segments_total-(UDP_Segments_left+1))*1392; j<Odometry_payload_length_accelerations; j++)
          buffer[i++] = Odometry_payload_buffer_accelerations[j];
      }
    }
  }
  
  ////// angularRates notifier //////
  if (MethodID == 0xC070)
  {
    if (UDP_Segments_total == 1)
    {
      for (j=0; j<Odometry_payload_length_angularRates; j++)
        buffer[i++] = Odometry_payload_buffer_angularRates[j];
    }
    else
    {
      if (UDP_Segments_left >= 1)
      {
        for (j=(UDP_Segments_total-UDP_Segments_left-1)*1392; j<(UDP_Segments_total-UDP_Segments_left)*1392; j++)
          buffer[i++] = Odometry_payload_buffer_angularRates[j];
      }
      else
      {
        for (j=(UDP_Segments_total-(UDP_Segments_left+1))*1392; j<Odometry_payload_length_angularRates; j++)
          buffer[i++] = Odometry_payload_buffer_angularRates[j];
      }
    }
  }
  
  
  // Rohdaten in UDP Paket schreiben
  EthPaket.udp.SetData( 0, buffer, i );

  // calculate UDP and IPv6 checksum and send Ethernet packet
  EthPaket.CompletePacket();
  output( EthPaket );
  
  // prüfen ob alle Segemente gesendet wurden, sonst senden erneut aufrufen
  Odometry_Segmentation_Method_ID = MethodID;
  if (UDP_Segments_left>0)
    settimer(Odometry_Segmentation_delay, 50);
}

on timer Odometry_Segmentation_delay
{
  Send_Service_Odometry_Notification (Odometry_Segmentation_Method_ID);
}






////////// speeds Notification //////////

on envVar Odometry_Notification_LengthIndicator_Struct_speeds
{
  Odometry_Notification_speeds();
}
on envVar Odometry_Notification_LengthIndicator_Element_speeds
{
  Odometry_Notification_speeds();
}
on envVar Odometry_Notification_speeds_type
{
  Odometry_array_speeds_type[@Odometry_Notification_speeds_Element] = @this;
  Odometry_Notification_speeds();
}
on envVar Odometry_Notification_speeds_value
{
  Odometry_array_speeds_value[@Odometry_Notification_speeds_Element] = @this;
  Odometry_Notification_speeds();
}
on envVar Odometry_Notification_speeds_confidence
{
  Odometry_array_speeds_confidence[@Odometry_Notification_speeds_Element] = @this;
  Odometry_Notification_speeds();
}
on envVar Odometry_Notification_speeds_timestamp
{
  Odometry_array_speeds_timestamp[@Odometry_Notification_speeds_Element] = @this;
  Odometry_Notification_speeds();
}
on envVar Odometry_Notification_speeds_type_available
{
  Odometry_array_speeds_type_available[@Odometry_Notification_speeds_Element] = @this;
  Odometry_Notification_speeds();
}
on envVar Odometry_Notification_speeds_value_available
{
  Odometry_array_speeds_value_available[@Odometry_Notification_speeds_Element] = @this;
  Odometry_Notification_speeds();
}
on envVar Odometry_Notification_speeds_confidence_available
{
  Odometry_array_speeds_confidence_available[@Odometry_Notification_speeds_Element] = @this;
  Odometry_Notification_speeds();
}
on envVar Odometry_Notification_speeds_timestamp_available
{
  Odometry_array_speeds_timestamp_available[@Odometry_Notification_speeds_Element] = @this;
  Odometry_Notification_speeds();
}
on envVar Odometry_Notification_speeds_Payload
{
  Odometry_Notification_speeds_update();
}


Odometry_Notification_speeds()
{
  word payload_counter = 0;
  word start_pos       = 0;
  word element_length  = 0;
  
  // Length Indicator Struct - Platzhalter
  payload_counter = 0+4;
  start_pos = 0;
  
  for (j=0; j<@Odometry_Notification_speeds_Element_TotalNum; j++)
  {
    Odometry_array_speeds_available_functions[j] = Odometry_array_speeds_type_available[j]
                                                 + Odometry_array_speeds_value_available[j]
                                                 + Odometry_array_speeds_confidence_available[j]
                                                 + Odometry_array_speeds_timestamp_available[j];
    
    // Length Indicator Element - Platzhalter
    if (Odometry_array_speeds_available_functions[j] > 0)
    {
      start_pos = payload_counter;
      payload_counter = payload_counter + 4;
    }
    else 
      start_pos = payload_counter;
    
    
    // 0 type (enum32)
    if (Odometry_array_speeds_type_available[j] == 1)
    {
      tag_dataID = 0;
      Odometry_payload_buffer_speeds[payload_counter++] = 2 * 16 /* Wiretype = 2  =^ 32 Bit */ + ((tag_dataID>>8) & 0x0F) /* DataID High Part */ ;
      Odometry_payload_buffer_speeds[payload_counter++] = tag_dataID & 0xFF /* DataID Low Part */ ;
      
      Odometry_payload_buffer_speeds[payload_counter++] = Odometry_array_speeds_type[j]>>24 & 0xFF;
      Odometry_payload_buffer_speeds[payload_counter++] = Odometry_array_speeds_type[j]>>16 & 0xFF;
      Odometry_payload_buffer_speeds[payload_counter++] = Odometry_array_speeds_type[j]>> 8 & 0xFF;
      Odometry_payload_buffer_speeds[payload_counter++] = Odometry_array_speeds_type[j]     & 0xFF;
    }
    
    
    // 1 value (float32)
    if (Odometry_array_speeds_value_available[j] == 1)
    {
      tag_dataID = 1;
      Odometry_payload_buffer_speeds[payload_counter++] = 2 * 16 /* Wiretype = 2  =^ 32 Bit */ + ((tag_dataID>>8) & 0x0F) /* DataID High Part */ ;
      Odometry_payload_buffer_speeds[payload_counter++] = tag_dataID & 0xFF /* DataID Low Part */ ;
      
      temp_converttodword = interpretAsDword (Odometry_array_speeds_value[j]);
      Odometry_payload_buffer_speeds[payload_counter++] = temp_converttodword>>24 & 0xFF;
      Odometry_payload_buffer_speeds[payload_counter++] = temp_converttodword>>16 & 0xFF;
      Odometry_payload_buffer_speeds[payload_counter++] = temp_converttodword>> 8 & 0xFF;
      Odometry_payload_buffer_speeds[payload_counter++] = temp_converttodword     & 0xFF;
    }
    
    
    // 2 confidence (enum32)
    if (Odometry_array_speeds_confidence_available[j] == 1)
    {
      tag_dataID = 2;
      Odometry_payload_buffer_speeds[payload_counter++] = 2 * 16 /* Wiretype = 2  =^ 32 Bit */ + ((tag_dataID>>8) & 0x0F) /* DataID High Part */ ;
      Odometry_payload_buffer_speeds[payload_counter++] = tag_dataID & 0xFF /* DataID Low Part */ ;
      
      Odometry_payload_buffer_speeds[payload_counter++] = Odometry_array_speeds_confidence[j]>>24 & 0xFF;
      Odometry_payload_buffer_speeds[payload_counter++] = Odometry_array_speeds_confidence[j]>>16 & 0xFF;
      Odometry_payload_buffer_speeds[payload_counter++] = Odometry_array_speeds_confidence[j]>> 8 & 0xFF;
      Odometry_payload_buffer_speeds[payload_counter++] = Odometry_array_speeds_confidence[j]     & 0xFF;
    }
    
    
    // 3 timestamp (uint64)
    if (Odometry_array_speeds_timestamp_available[j] == 1)
    {
      tag_dataID = 3;
      Odometry_payload_buffer_speeds[payload_counter++] = 3 * 16 /* Wiretype = 3  =^ 64 Bit */ + ((tag_dataID>>8) & 0x0F) /* DataID High Part */ ;
      Odometry_payload_buffer_speeds[payload_counter++] = tag_dataID & 0xFF /* DataID Low Part */ ;
      
      temp_64bit_low  = Odometry_array_speeds_timestamp[j]     & 0x00000000FFFFFFFF;
      temp_64bit_high = Odometry_array_speeds_timestamp[j]>>32 & 0x00000000FFFFFFFF;
      
      Odometry_payload_buffer_speeds[payload_counter++] = temp_64bit_high>>24 & 0xFF;
      Odometry_payload_buffer_speeds[payload_counter++] = temp_64bit_high>>16 & 0xFF;
      Odometry_payload_buffer_speeds[payload_counter++] = temp_64bit_high>> 8 & 0xFF;
      Odometry_payload_buffer_speeds[payload_counter++] = temp_64bit_high     & 0xFF;
      Odometry_payload_buffer_speeds[payload_counter++] = temp_64bit_low>>24  & 0xFF;
      Odometry_payload_buffer_speeds[payload_counter++] = temp_64bit_low>>16  & 0xFF;
      Odometry_payload_buffer_speeds[payload_counter++] = temp_64bit_low>> 8  & 0xFF;
      Odometry_payload_buffer_speeds[payload_counter++] = temp_64bit_low      & 0xFF;
    }
    
    //Element Length
    element_length = payload_counter-start_pos;
    if (element_length >0) Odometry_array_speeds_array_element_length[j] = element_length - 4;
    else                   Odometry_array_speeds_array_element_length[j] = element_length;
    
    Odometry_payload_buffer_speeds[start_pos++] = Odometry_array_speeds_array_element_length[j]>>24 & 0xFF;
    Odometry_payload_buffer_speeds[start_pos++] = Odometry_array_speeds_array_element_length[j]>>16 & 0xFF;
    Odometry_payload_buffer_speeds[start_pos++] = Odometry_array_speeds_array_element_length[j]>> 8 & 0xFF;
    Odometry_payload_buffer_speeds[start_pos++] = Odometry_array_speeds_array_element_length[j]     & 0xFF;
    
    if (Odometry_array_speeds_array_element_length[j] == 0) payload_counter = payload_counter+4;
  }
  
  // Struct Length
  Odometry_array_speeds_struct_element_length = 4*@Odometry_Notification_speeds_Element_TotalNum;

  for (k=0;k<@Odometry_Notification_speeds_Element_TotalNum;k++)
   Odometry_array_speeds_struct_element_length = Odometry_array_speeds_struct_element_length + Odometry_array_speeds_array_element_length[k];
  
  Odometry_payload_buffer_speeds[0] = Odometry_array_speeds_struct_element_length>>24 & 0xFF;
  Odometry_payload_buffer_speeds[1] = Odometry_array_speeds_struct_element_length>>16 & 0xFF;
  Odometry_payload_buffer_speeds[2] = Odometry_array_speeds_struct_element_length>> 8 & 0xFF;
  Odometry_payload_buffer_speeds[3] = Odometry_array_speeds_struct_element_length     & 0xFF;


  Odometry_payload_length_speeds = Odometry_array_speeds_struct_element_length+4;
  putvalue(Odometry_Notification_speeds_Payload, Odometry_payload_buffer_speeds, Odometry_payload_length_speeds);
}

on envVar Odometry_Notification_speeds_Element_TotalNum
{
  if (@this == 0) @this =  1;
  if (@this > 10) @this = 10;
  
  Odometry_Notification_speeds();
  Odometry_Notification_speeds_update();
}

on envVar Odometry_Notification_speeds_Element
{
  Odometry_Notification_speeds_update();
}

on envVar Odometry_Notification_speeds_Element_Next
{
  if (@this == 1 && @Odometry_Notification_speeds_Element < @Odometry_Notification_speeds_Element_TotalNum - 1)
  {
    @Odometry_Notification_speeds_Element = @Odometry_Notification_speeds_Element + 1;
    Odometry_Notification_speeds_update();
  }
}

on envVar Odometry_Notification_speeds_Element_Previous
{
  if (@this == 1 && @Odometry_Notification_speeds_Element > 0)
  {
    @Odometry_Notification_speeds_Element = @Odometry_Notification_speeds_Element - 1;
    Odometry_Notification_speeds_update();
  }
}

Odometry_Notification_speeds_update()
{
  @Odometry_Notification_LengthIndicator_Element_speeds = Odometry_array_speeds_array_element_length[@Odometry_Notification_speeds_Element];
  @Odometry_Notification_LengthIndicator_Struct_speeds  = Odometry_array_speeds_struct_element_length;
  @Odometry_Notification_Length_speeds                  = Odometry_payload_length_speeds+8;
  
  @Odometry_Notification_speeds_type       = Odometry_array_speeds_type[@Odometry_Notification_speeds_Element];
  @Odometry_Notification_speeds_value      = Odometry_array_speeds_value[@Odometry_Notification_speeds_Element];
  @Odometry_Notification_speeds_confidence = Odometry_array_speeds_confidence[@Odometry_Notification_speeds_Element];
  @Odometry_Notification_speeds_timestamp  = Odometry_array_speeds_timestamp[@Odometry_Notification_speeds_Element];
  
  @Odometry_Notification_speeds_type_available       = Odometry_array_speeds_type_available[@Odometry_Notification_speeds_Element];
  @Odometry_Notification_speeds_value_available      = Odometry_array_speeds_value_available[@Odometry_Notification_speeds_Element];
  @Odometry_Notification_speeds_confidence_available = Odometry_array_speeds_confidence_available[@Odometry_Notification_speeds_Element];
  @Odometry_Notification_speeds_timestamp_available  = Odometry_array_speeds_timestamp_available[@Odometry_Notification_speeds_Element];
}






////////// velocities Notification //////////

on envVar Odometry_Notification_LengthIndicator_Struct_velocities
{
  Odometry_Notification_velocities();
}
on envVar Odometry_Notification_LengthIndicator_Element_velocities
{
  Odometry_Notification_velocities();
}
on envVar Odometry_Notification_velocities_type
{
  Odometry_array_velocities_type[@Odometry_Notification_velocities_Element] = @this;
  Odometry_Notification_velocities();
}
on envVar Odometry_Notification_velocities_timestamp
{
  Odometry_array_velocities_timestamp[@Odometry_Notification_velocities_Element] = @this;
  Odometry_Notification_velocities();
}
on envVar Odometry_Notification_velocities_value
{
  Odometry_array_velocities_value[@Odometry_Notification_velocities_Element] = @this;
  Odometry_Notification_velocities();
}
on envVar Odometry_Notification_velocities_variance
{
  Odometry_array_velocities_variance[@Odometry_Notification_velocities_Element] = @this;
  Odometry_Notification_velocities();
}
on envVar Odometry_Notification_velocities_confidence
{
  Odometry_array_velocities_confidence[@Odometry_Notification_velocities_Element] = @this;
  Odometry_Notification_velocities();
}
on envVar Odometry_Notification_velocities_type_available
{
  Odometry_array_velocities_type_available[@Odometry_Notification_velocities_Element] = @this;
  Odometry_Notification_velocities();
}
on envVar Odometry_Notification_velocities_timestamp_available
{
  Odometry_array_velocities_timestamp_available[@Odometry_Notification_velocities_Element] = @this;
  Odometry_Notification_velocities();
}
on envVar Odometry_Notification_velocities_value_available
{
  Odometry_array_velocities_value_available[@Odometry_Notification_velocities_Element] = @this;
  Odometry_Notification_velocities();
}
on envVar Odometry_Notification_velocities_variance_available
{
  Odometry_array_velocities_variance_available[@Odometry_Notification_velocities_Element] = @this;
  Odometry_Notification_velocities();
}
on envVar Odometry_Notification_velocities_confidence_available
{
  Odometry_array_velocities_confidence_available[@Odometry_Notification_velocities_Element] = @this;
  Odometry_Notification_velocities();
}
on envVar Odometry_Notification_velocities_Payload
{
  Odometry_Notification_velocities_update();
}


Odometry_Notification_velocities()
{
  word payload_counter = 0;
  word start_pos       = 0;
  word element_length  = 0;
  
  // Length Indicator Struct - Platzhalter
  payload_counter = 0+4;
  start_pos = 0;
  
  for (j=0; j<@Odometry_Notification_velocities_Element_TotalNum; j++)
  {
    Odometry_array_velocities_available_functions[j] = Odometry_array_velocities_type_available[j]
                                                     + Odometry_array_velocities_timestamp_available[j]
                                                     + Odometry_array_velocities_value_available[j]
                                                     + Odometry_array_velocities_variance_available[j]
                                                     + Odometry_array_velocities_confidence_available[j];
    
    // Length Indicator Element - Platzhalter
    if (Odometry_array_velocities_available_functions[j] > 0)
    {
      start_pos = payload_counter;
      payload_counter = payload_counter + 4;
    }
    else 
      start_pos = payload_counter;
    
    
    // 0 type (enum32)
    if (Odometry_array_velocities_type_available[j] == 1)
    {
      tag_dataID = 0;
      Odometry_payload_buffer_velocities[payload_counter++] = 2 * 16 /* Wiretype = 2  =^ 32 Bit */ + ((tag_dataID>>8) & 0x0F) /* DataID High Part */ ;
      Odometry_payload_buffer_velocities[payload_counter++] = tag_dataID & 0xFF /* DataID Low Part */ ;
      
      Odometry_payload_buffer_velocities[payload_counter++] = Odometry_array_velocities_type[j]>>24 & 0xFF;
      Odometry_payload_buffer_velocities[payload_counter++] = Odometry_array_velocities_type[j]>>16 & 0xFF;
      Odometry_payload_buffer_velocities[payload_counter++] = Odometry_array_velocities_type[j]>> 8 & 0xFF;
      Odometry_payload_buffer_velocities[payload_counter++] = Odometry_array_velocities_type[j]     & 0xFF;
    }
    
    
    // 1 timestamp (uint64)
    if (Odometry_array_velocities_timestamp_available[j] == 1)
    {
      tag_dataID = 1;
      Odometry_payload_buffer_velocities[payload_counter++] = 3 * 16 /* Wiretype = 3  =^ 64 Bit */ + ((tag_dataID>>8) & 0x0F) /* DataID High Part */ ;
      Odometry_payload_buffer_velocities[payload_counter++] = tag_dataID & 0xFF /* DataID Low Part */ ;
      
      temp_64bit_low  = Odometry_array_velocities_timestamp[j]     & 0x00000000FFFFFFFF;
      temp_64bit_high = Odometry_array_velocities_timestamp[j]>>32 & 0x00000000FFFFFFFF;
      
      Odometry_payload_buffer_velocities[payload_counter++] = temp_64bit_high>>24 & 0xFF;
      Odometry_payload_buffer_velocities[payload_counter++] = temp_64bit_high>>16 & 0xFF;
      Odometry_payload_buffer_velocities[payload_counter++] = temp_64bit_high>> 8 & 0xFF;
      Odometry_payload_buffer_velocities[payload_counter++] = temp_64bit_high     & 0xFF;
      Odometry_payload_buffer_velocities[payload_counter++] = temp_64bit_low>>24  & 0xFF;
      Odometry_payload_buffer_velocities[payload_counter++] = temp_64bit_low>>16  & 0xFF;
      Odometry_payload_buffer_velocities[payload_counter++] = temp_64bit_low>> 8  & 0xFF;
      Odometry_payload_buffer_velocities[payload_counter++] = temp_64bit_low      & 0xFF;
    }
        
    
    // 2 value (float32)
    if (Odometry_array_velocities_value_available[j] == 1)
    {
      tag_dataID = 2;
      Odometry_payload_buffer_velocities[payload_counter++] = 2 * 16 /* Wiretype = 2  =^ 32 Bit */ + ((tag_dataID>>8) & 0x0F) /* DataID High Part */ ;
      Odometry_payload_buffer_velocities[payload_counter++] = tag_dataID & 0xFF /* DataID Low Part */ ;
      
      temp_converttodword = interpretAsDword (Odometry_array_velocities_value[j]);
      Odometry_payload_buffer_velocities[payload_counter++] = temp_converttodword>>24 & 0xFF;
      Odometry_payload_buffer_velocities[payload_counter++] = temp_converttodword>>16 & 0xFF;
      Odometry_payload_buffer_velocities[payload_counter++] = temp_converttodword>> 8 & 0xFF;
      Odometry_payload_buffer_velocities[payload_counter++] = temp_converttodword     & 0xFF;
    }
    
    
    // 3 variance (float32)
    if (Odometry_array_velocities_variance_available[j] == 1)
    {
      tag_dataID = 3;
      Odometry_payload_buffer_velocities[payload_counter++] = 2 * 16 /* Wiretype = 2  =^ 32 Bit */ + ((tag_dataID>>8) & 0x0F) /* DataID High Part */ ;
      Odometry_payload_buffer_velocities[payload_counter++] = tag_dataID & 0xFF /* DataID Low Part */ ;
      
      temp_converttodword = interpretAsDword (Odometry_array_velocities_variance[j]);
      Odometry_payload_buffer_velocities[payload_counter++] = temp_converttodword>>24 & 0xFF;
      Odometry_payload_buffer_velocities[payload_counter++] = temp_converttodword>>16 & 0xFF;
      Odometry_payload_buffer_velocities[payload_counter++] = temp_converttodword>> 8 & 0xFF;
      Odometry_payload_buffer_velocities[payload_counter++] = temp_converttodword     & 0xFF;
    }
    
    
    // 4 confidence (enum32)
    if (Odometry_array_velocities_confidence_available[j] == 1)
    {
      tag_dataID = 4;
      Odometry_payload_buffer_velocities[payload_counter++] = 2 * 16 /* Wiretype = 2  =^ 32 Bit */ + ((tag_dataID>>8) & 0x0F) /* DataID High Part */ ;
      Odometry_payload_buffer_velocities[payload_counter++] = tag_dataID & 0xFF /* DataID Low Part */ ;
      
      Odometry_payload_buffer_velocities[payload_counter++] = Odometry_array_velocities_confidence[j]>>24 & 0xFF;
      Odometry_payload_buffer_velocities[payload_counter++] = Odometry_array_velocities_confidence[j]>>16 & 0xFF;
      Odometry_payload_buffer_velocities[payload_counter++] = Odometry_array_velocities_confidence[j]>> 8 & 0xFF;
      Odometry_payload_buffer_velocities[payload_counter++] = Odometry_array_velocities_confidence[j]     & 0xFF;
    }
    
    //Element Length
    element_length = payload_counter-start_pos;
    if (element_length >0) Odometry_array_velocities_array_element_length[j] = element_length - 4;
    else                   Odometry_array_velocities_array_element_length[j] = element_length;
    
    Odometry_payload_buffer_velocities[start_pos++] = Odometry_array_velocities_array_element_length[j]>>24 & 0xFF;
    Odometry_payload_buffer_velocities[start_pos++] = Odometry_array_velocities_array_element_length[j]>>16 & 0xFF;
    Odometry_payload_buffer_velocities[start_pos++] = Odometry_array_velocities_array_element_length[j]>> 8 & 0xFF;
    Odometry_payload_buffer_velocities[start_pos++] = Odometry_array_velocities_array_element_length[j]     & 0xFF;
    
    if (Odometry_array_velocities_array_element_length[j] == 0) payload_counter = payload_counter+4;
  }
  
  // Struct Length
  Odometry_array_velocities_struct_element_length = 4*@Odometry_Notification_velocities_Element_TotalNum;

  for (k=0;k<@Odometry_Notification_velocities_Element_TotalNum;k++)
   Odometry_array_velocities_struct_element_length = Odometry_array_velocities_struct_element_length + Odometry_array_velocities_array_element_length[k];
  
  Odometry_payload_buffer_velocities[0] = Odometry_array_velocities_struct_element_length>>24 & 0xFF;
  Odometry_payload_buffer_velocities[1] = Odometry_array_velocities_struct_element_length>>16 & 0xFF;
  Odometry_payload_buffer_velocities[2] = Odometry_array_velocities_struct_element_length>> 8 & 0xFF;
  Odometry_payload_buffer_velocities[3] = Odometry_array_velocities_struct_element_length     & 0xFF;


  Odometry_payload_length_velocities = Odometry_array_velocities_struct_element_length+4;
  putvalue(Odometry_Notification_velocities_Payload, Odometry_payload_buffer_velocities, Odometry_payload_length_velocities);
}

on envVar Odometry_Notification_velocities_Element_TotalNum
{
  if (@this == 0) @this =  1;
  if (@this > 10) @this = 10;
  
  Odometry_Notification_velocities();
  Odometry_Notification_velocities_update();
}

on envVar Odometry_Notification_velocities_Element
{
  Odometry_Notification_velocities_update();
}

on envVar Odometry_Notification_velocities_Element_Next
{
  if (@this == 1 && @Odometry_Notification_velocities_Element < @Odometry_Notification_velocities_Element_TotalNum - 1)
  {
    @Odometry_Notification_velocities_Element = @Odometry_Notification_velocities_Element + 1;
    Odometry_Notification_velocities_update();
  }
}

on envVar Odometry_Notification_velocities_Element_Previous
{
  if (@this == 1 && @Odometry_Notification_velocities_Element > 0)
  {
    @Odometry_Notification_velocities_Element = @Odometry_Notification_velocities_Element - 1;
    Odometry_Notification_velocities_update();
  }
}
Odometry_Notification_velocities_update()
{
  @Odometry_Notification_LengthIndicator_Element_velocities = Odometry_array_velocities_array_element_length[@Odometry_Notification_velocities_Element];
  @Odometry_Notification_LengthIndicator_Struct_velocities  = Odometry_array_velocities_struct_element_length;
  @Odometry_Notification_Length_velocities                  = Odometry_payload_length_velocities+8;
  
  @Odometry_Notification_velocities_type       = Odometry_array_velocities_type[@Odometry_Notification_velocities_Element];
  @Odometry_Notification_velocities_timestamp  = Odometry_array_velocities_timestamp[@Odometry_Notification_velocities_Element];
  @Odometry_Notification_velocities_value      = Odometry_array_velocities_value[@Odometry_Notification_velocities_Element];
  @Odometry_Notification_velocities_variance   = Odometry_array_velocities_variance[@Odometry_Notification_velocities_Element];
  @Odometry_Notification_velocities_confidence = Odometry_array_velocities_confidence[@Odometry_Notification_velocities_Element];
  
  @Odometry_Notification_velocities_type_available       = Odometry_array_velocities_type_available[@Odometry_Notification_velocities_Element];
  @Odometry_Notification_velocities_timestamp_available  = Odometry_array_velocities_timestamp_available[@Odometry_Notification_velocities_Element];
  @Odometry_Notification_velocities_value_available      = Odometry_array_velocities_value_available[@Odometry_Notification_velocities_Element];
  @Odometry_Notification_velocities_variance_available   = Odometry_array_velocities_variance_available[@Odometry_Notification_velocities_Element];
  @Odometry_Notification_velocities_confidence_available = Odometry_array_velocities_confidence_available[@Odometry_Notification_velocities_Element];
}






////////// pose2D Notification //////////

on envVar Odometry_Notification_LengthIndicator_Struct_pose2D
{
  Odometry_Notification_pose2D();
}
on envVar Odometry_Notification_LengthIndicator_Element_pose2D
{
  Odometry_Notification_pose2D();
}
on envVar Odometry_Notification_pose2D_timestamp
{
  Odometry_array_pose2D_timestamp[@Odometry_Notification_pose2D_Element] = @this;
  Odometry_Notification_pose2D();
}
on envVar Odometry_Notification_pose2D_positionX
{
  Odometry_array_pose2D_positionX[@Odometry_Notification_pose2D_Element] = @this;
  Odometry_Notification_pose2D();
}
on envVar Odometry_Notification_pose2D_positionY
{
  Odometry_array_pose2D_positionY[@Odometry_Notification_pose2D_Element] = @this;
  Odometry_Notification_pose2D();
}
on envVar Odometry_Notification_pose2D_yawAngle
{
  Odometry_array_pose2D_yawAngle[@Odometry_Notification_pose2D_Element] = @this;
  Odometry_Notification_pose2D();
}
on envVar Odometry_Notification_pose2D_positionXVariance
{
  Odometry_array_pose2D_positionXVariance[@Odometry_Notification_pose2D_Element] = @this;
  Odometry_Notification_pose2D();
}
on envVar Odometry_Notification_pose2D_positionYVariance
{
  Odometry_array_pose2D_positionYVariance[@Odometry_Notification_pose2D_Element] = @this;
  Odometry_Notification_pose2D();
}
on envVar Odometry_Notification_pose2D_yawAngleVariance
{
  Odometry_array_pose2D_yawAngleVariance[@Odometry_Notification_pose2D_Element] = @this;
  Odometry_Notification_pose2D();
}
on envVar Odometry_Notification_pose2D_pose2dConfidence
{
  Odometry_array_pose2D_pose2dConfidence[@Odometry_Notification_pose2D_Element] = @this;
  Odometry_Notification_pose2D();
}
on envVar Odometry_Notification_pose2D_timestamp_available
{
  Odometry_array_pose2D_timestamp_available[@Odometry_Notification_pose2D_Element] = @this;
  Odometry_Notification_pose2D();
}
on envVar Odometry_Notification_pose2D_positionX_available
{
  Odometry_array_pose2D_positionX_available[@Odometry_Notification_pose2D_Element] = @this;
  Odometry_Notification_pose2D();
}
on envVar Odometry_Notification_pose2D_positionY_available
{
  Odometry_array_pose2D_positionY_available[@Odometry_Notification_pose2D_Element] = @this;
  Odometry_Notification_pose2D();
}
on envVar Odometry_Notification_pose2D_yawAngle_available
{
  Odometry_array_pose2D_yawAngle_available[@Odometry_Notification_pose2D_Element] = @this;
  Odometry_Notification_pose2D();
}
on envVar Odometry_Notification_pose2D_positionXVariance_available
{
  Odometry_array_pose2D_positionXVariance_available[@Odometry_Notification_pose2D_Element] = @this;
  Odometry_Notification_pose2D();
}
on envVar Odometry_Notification_pose2D_positionYVariance_available
{
  Odometry_array_pose2D_positionYVariance_available[@Odometry_Notification_pose2D_Element] = @this;
  Odometry_Notification_pose2D();
}
on envVar Odometry_Notification_pose2D_yawAngleVariance_available
{
  Odometry_array_pose2D_yawAngleVariance_available[@Odometry_Notification_pose2D_Element] = @this;
  Odometry_Notification_pose2D();
}
on envVar Odometry_Notification_pose2D_pose2dConfidence_available
{
  Odometry_array_pose2D_pose2dConfidence_available[@Odometry_Notification_pose2D_Element] = @this;
  Odometry_Notification_pose2D();
}
on envVar Odometry_Notification_pose2D_Payload
{
  Odometry_Notification_pose2D_update();
}


Odometry_Notification_pose2D()
{
  word payload_counter = 0;
  word start_pos       = 0;
  word element_length  = 0;
  
  // Length Indicator Struct - Platzhalter
  payload_counter = 0+4;
  start_pos = 0;
  
  for (j=0; j<@Odometry_Notification_pose2D_Element_TotalNum; j++)
  {
    Odometry_array_pose2D_available_functions[j] = Odometry_array_pose2D_timestamp_available[j]
                                                 + Odometry_array_pose2D_positionX_available[j]
                                                 + Odometry_array_pose2D_positionY_available[j]
                                                 + Odometry_array_pose2D_yawAngle_available[j]
                                                 + Odometry_array_pose2D_positionXVariance_available[j]
                                                 + Odometry_array_pose2D_positionYVariance_available[j]
                                                 + Odometry_array_pose2D_yawAngleVariance_available[j]
                                                 + Odometry_array_pose2D_pose2dConfidence_available[j];
    
    // Length Indicator Element - Platzhalter
    if (Odometry_array_pose2D_available_functions[j] > 0)
    {
      start_pos = payload_counter;
      payload_counter = payload_counter + 4;
    }
    else 
      start_pos = payload_counter;
    
    
    // 0 timestamp (uint64)
    if (Odometry_array_pose2D_timestamp_available[j] == 1)
    {
      tag_dataID = 0;
      Odometry_payload_buffer_pose2D[payload_counter++] = 3 * 16 /* Wiretype = 3  =^ 64 Bit */ + ((tag_dataID>>8) & 0x0F) /* DataID High Part */ ;
      Odometry_payload_buffer_pose2D[payload_counter++] = tag_dataID & 0xFF /* DataID Low Part */ ;
      
      temp_64bit_low  = Odometry_array_pose2D_timestamp[j]     & 0x00000000FFFFFFFF;
      temp_64bit_high = Odometry_array_pose2D_timestamp[j]>>32 & 0x00000000FFFFFFFF;
      
      Odometry_payload_buffer_pose2D[payload_counter++] = temp_64bit_high>>24 & 0xFF;
      Odometry_payload_buffer_pose2D[payload_counter++] = temp_64bit_high>>16 & 0xFF;
      Odometry_payload_buffer_pose2D[payload_counter++] = temp_64bit_high>> 8 & 0xFF;
      Odometry_payload_buffer_pose2D[payload_counter++] = temp_64bit_high     & 0xFF;
      Odometry_payload_buffer_pose2D[payload_counter++] = temp_64bit_low>>24  & 0xFF;
      Odometry_payload_buffer_pose2D[payload_counter++] = temp_64bit_low>>16  & 0xFF;
      Odometry_payload_buffer_pose2D[payload_counter++] = temp_64bit_low>> 8  & 0xFF;
      Odometry_payload_buffer_pose2D[payload_counter++] = temp_64bit_low      & 0xFF;
    }
    
    
    // 1 positionX (double64)
    if (Odometry_array_pose2D_positionX_available[j] == 1)
    {
      tag_dataID = 1;
      Odometry_payload_buffer_pose2D[payload_counter++] = 3 * 16 /* Wiretype = 3  =^ 64 Bit */ + ((tag_dataID>>8) & 0x0F) /* DataID High Part */ ;
      Odometry_payload_buffer_pose2D[payload_counter++] = tag_dataID & 0xFF /* DataID Low Part */ ;
      
      temp_converttoqword = interpretAsQword (Odometry_array_pose2D_positionX[j]);
      temp_64bit_low  = temp_converttoqword     & 0x00000000FFFFFFFF;
      temp_64bit_high = temp_converttoqword>>32 & 0x00000000FFFFFFFF;
      
      Odometry_payload_buffer_pose2D[payload_counter++] = temp_64bit_high>>24 & 0xFF;
      Odometry_payload_buffer_pose2D[payload_counter++] = temp_64bit_high>>16 & 0xFF;
      Odometry_payload_buffer_pose2D[payload_counter++] = temp_64bit_high>> 8 & 0xFF;
      Odometry_payload_buffer_pose2D[payload_counter++] = temp_64bit_high     & 0xFF;
      Odometry_payload_buffer_pose2D[payload_counter++] = temp_64bit_low>>24  & 0xFF;
      Odometry_payload_buffer_pose2D[payload_counter++] = temp_64bit_low>>16  & 0xFF;
      Odometry_payload_buffer_pose2D[payload_counter++] = temp_64bit_low>> 8  & 0xFF;
      Odometry_payload_buffer_pose2D[payload_counter++] = temp_64bit_low      & 0xFF;
    }
    
    
    // 2 positionY (double64)
    if (Odometry_array_pose2D_positionY_available[j] == 1)
    {
      tag_dataID = 2;
      Odometry_payload_buffer_pose2D[payload_counter++] = 3 * 16 /* Wiretype = 3  =^ 64 Bit */ + ((tag_dataID>>8) & 0x0F) /* DataID High Part */ ;
      Odometry_payload_buffer_pose2D[payload_counter++] = tag_dataID & 0xFF /* DataID Low Part */ ;
      
      temp_converttoqword = interpretAsQword (Odometry_array_pose2D_positionY[j]);
      temp_64bit_low  = temp_converttoqword     & 0x00000000FFFFFFFF;
      temp_64bit_high = temp_converttoqword>>32 & 0x00000000FFFFFFFF;
      Odometry_payload_buffer_pose2D[payload_counter++] = temp_64bit_high>>24 & 0xFF;
      Odometry_payload_buffer_pose2D[payload_counter++] = temp_64bit_high>>16 & 0xFF;
      Odometry_payload_buffer_pose2D[payload_counter++] = temp_64bit_high>> 8 & 0xFF;
      Odometry_payload_buffer_pose2D[payload_counter++] = temp_64bit_high     & 0xFF;
      Odometry_payload_buffer_pose2D[payload_counter++] = temp_64bit_low>>24  & 0xFF;
      Odometry_payload_buffer_pose2D[payload_counter++] = temp_64bit_low>>16  & 0xFF;
      Odometry_payload_buffer_pose2D[payload_counter++] = temp_64bit_low>> 8  & 0xFF;
      Odometry_payload_buffer_pose2D[payload_counter++] = temp_64bit_low      & 0xFF;
    }
    
    
    // 3 yawAngle (float32)
    if (Odometry_array_pose2D_yawAngle_available[j] == 1)
    {
      tag_dataID = 3;
      Odometry_payload_buffer_pose2D[payload_counter++] = 2 * 16 /* Wiretype = 2  =^ 32 Bit */ + ((tag_dataID>>8) & 0x0F) /* DataID High Part */ ;
      Odometry_payload_buffer_pose2D[payload_counter++] = tag_dataID & 0xFF /* DataID Low Part */ ;
      
      temp_converttodword = interpretAsDword (Odometry_array_pose2D_yawAngle[j]);
      Odometry_payload_buffer_pose2D[payload_counter++] = temp_converttodword>>24 & 0xFF;
      Odometry_payload_buffer_pose2D[payload_counter++] = temp_converttodword>>16 & 0xFF;
      Odometry_payload_buffer_pose2D[payload_counter++] = temp_converttodword>> 8 & 0xFF;
      Odometry_payload_buffer_pose2D[payload_counter++] = temp_converttodword     & 0xFF;
    }
    
    
    // 4 positionXVariance (float32)
    if (Odometry_array_pose2D_positionXVariance_available[j] == 1)
    {
      tag_dataID = 4;
      Odometry_payload_buffer_pose2D[payload_counter++] = 2 * 16 /* Wiretype = 2  =^ 32 Bit */ + ((tag_dataID>>8) & 0x0F) /* DataID High Part */ ;
      Odometry_payload_buffer_pose2D[payload_counter++] = tag_dataID & 0xFF /* DataID Low Part */ ;
      
      temp_converttodword = interpretAsDword (Odometry_array_pose2D_positionXVariance[j]);
      Odometry_payload_buffer_pose2D[payload_counter++] = temp_converttodword>>24 & 0xFF;
      Odometry_payload_buffer_pose2D[payload_counter++] = temp_converttodword>>16 & 0xFF;
      Odometry_payload_buffer_pose2D[payload_counter++] = temp_converttodword>> 8 & 0xFF;
      Odometry_payload_buffer_pose2D[payload_counter++] = temp_converttodword     & 0xFF;
    }
    
    
    // 5 positionYVariance (float32)
    if (Odometry_array_pose2D_positionYVariance_available[j] == 1)
    {
      tag_dataID = 5;
      Odometry_payload_buffer_pose2D[payload_counter++] = 2 * 16 /* Wiretype = 2  =^ 32 Bit */ + ((tag_dataID>>8) & 0x0F) /* DataID High Part */ ;
      Odometry_payload_buffer_pose2D[payload_counter++] = tag_dataID & 0xFF /* DataID Low Part */ ;
      
      temp_converttodword = interpretAsDword (Odometry_array_pose2D_positionYVariance[j]);
      Odometry_payload_buffer_pose2D[payload_counter++] = temp_converttodword>>24 & 0xFF;
      Odometry_payload_buffer_pose2D[payload_counter++] = temp_converttodword>>16 & 0xFF;
      Odometry_payload_buffer_pose2D[payload_counter++] = temp_converttodword>> 8 & 0xFF;
      Odometry_payload_buffer_pose2D[payload_counter++] = temp_converttodword     & 0xFF;
    }
    
    
    // 6 yawAngleVariance (float32)
    if (Odometry_array_pose2D_yawAngleVariance_available[j] == 1)
    {
      tag_dataID = 6;
      Odometry_payload_buffer_pose2D[payload_counter++] = 2 * 16 /* Wiretype = 2  =^ 32 Bit */ + ((tag_dataID>>8) & 0x0F) /* DataID High Part */ ;
      Odometry_payload_buffer_pose2D[payload_counter++] = tag_dataID & 0xFF /* DataID Low Part */ ;
      
      temp_converttodword = interpretAsDword (Odometry_array_pose2D_yawAngleVariance[j]);
      Odometry_payload_buffer_pose2D[payload_counter++] = temp_converttodword>>24 & 0xFF;
      Odometry_payload_buffer_pose2D[payload_counter++] = temp_converttodword>>16 & 0xFF;
      Odometry_payload_buffer_pose2D[payload_counter++] = temp_converttodword>> 8 & 0xFF;
      Odometry_payload_buffer_pose2D[payload_counter++] = temp_converttodword     & 0xFF;
    }
    
    
    // 7 pose2dConfidence (enum32)
    if (Odometry_array_pose2D_pose2dConfidence_available[j] == 1)
    {
      tag_dataID = 7;
      Odometry_payload_buffer_pose2D[payload_counter++] = 2 * 16 /* Wiretype = 2  =^ 32 Bit */ + ((tag_dataID>>8) & 0x0F) /* DataID High Part */ ;
      Odometry_payload_buffer_pose2D[payload_counter++] = tag_dataID & 0xFF /* DataID Low Part */ ;
      
      Odometry_payload_buffer_pose2D[payload_counter++] = Odometry_array_pose2D_pose2dConfidence[j]>>24 & 0xFF;
      Odometry_payload_buffer_pose2D[payload_counter++] = Odometry_array_pose2D_pose2dConfidence[j]>>16 & 0xFF;
      Odometry_payload_buffer_pose2D[payload_counter++] = Odometry_array_pose2D_pose2dConfidence[j]>> 8 & 0xFF;
      Odometry_payload_buffer_pose2D[payload_counter++] = Odometry_array_pose2D_pose2dConfidence[j]     & 0xFF;
    }
    
    //Element Length
    element_length = payload_counter-start_pos;
    if (element_length >0) Odometry_array_pose2D_array_element_length[j] = element_length - 4;
    else                   Odometry_array_pose2D_array_element_length[j] = element_length;
    
    Odometry_payload_buffer_pose2D[start_pos++] = Odometry_array_pose2D_array_element_length[j]>>24 & 0xFF;
    Odometry_payload_buffer_pose2D[start_pos++] = Odometry_array_pose2D_array_element_length[j]>>16 & 0xFF;
    Odometry_payload_buffer_pose2D[start_pos++] = Odometry_array_pose2D_array_element_length[j]>> 8 & 0xFF;
    Odometry_payload_buffer_pose2D[start_pos++] = Odometry_array_pose2D_array_element_length[j]     & 0xFF;
    
    if (Odometry_array_pose2D_array_element_length[j] == 0) payload_counter = payload_counter+4;
  }
  
  // Struct Length
  Odometry_array_pose2D_struct_element_length = 4*@Odometry_Notification_pose2D_Element_TotalNum;

  for (k=0;k<@Odometry_Notification_pose2D_Element_TotalNum;k++)
   Odometry_array_pose2D_struct_element_length = Odometry_array_pose2D_struct_element_length + Odometry_array_pose2D_array_element_length[k];
  
  Odometry_payload_buffer_pose2D[0] = Odometry_array_pose2D_struct_element_length>>24 & 0xFF;
  Odometry_payload_buffer_pose2D[1] = Odometry_array_pose2D_struct_element_length>>16 & 0xFF;
  Odometry_payload_buffer_pose2D[2] = Odometry_array_pose2D_struct_element_length>> 8 & 0xFF;
  Odometry_payload_buffer_pose2D[3] = Odometry_array_pose2D_struct_element_length     & 0xFF;


  Odometry_payload_length_pose2D = Odometry_array_pose2D_struct_element_length+4;
  putvalue(Odometry_Notification_pose2D_Payload, Odometry_payload_buffer_pose2D, Odometry_payload_length_pose2D);
}

on envVar Odometry_Notification_pose2D_Element_TotalNum
{
  if (@this == 0) @this =  1;
  if (@this > 10) @this = 10;
  
  Odometry_Notification_pose2D();
  Odometry_Notification_pose2D_update();
}

on envVar Odometry_Notification_pose2D_Element
{
  Odometry_Notification_pose2D_update();
}

on envVar Odometry_Notification_pose2D_Element_Next
{
  if (@this == 1 && @Odometry_Notification_pose2D_Element < @Odometry_Notification_pose2D_Element_TotalNum - 1)
  {
    @Odometry_Notification_pose2D_Element = @Odometry_Notification_pose2D_Element + 1;
    Odometry_Notification_pose2D_update();
  }
}

on envVar Odometry_Notification_pose2D_Element_Previous
{
  if (@this == 1 && @Odometry_Notification_pose2D_Element > 0)
  {
    @Odometry_Notification_pose2D_Element = @Odometry_Notification_pose2D_Element - 1;
    Odometry_Notification_pose2D_update();
  }
}

Odometry_Notification_pose2D_update()
{
  @Odometry_Notification_LengthIndicator_Element_pose2D = Odometry_array_pose2D_array_element_length[@Odometry_Notification_pose2D_Element];
  @Odometry_Notification_LengthIndicator_Struct_pose2D  = Odometry_array_pose2D_struct_element_length;
  @Odometry_Notification_Length_pose2D                  = Odometry_payload_length_pose2D+8;
  
  @Odometry_Notification_pose2D_timestamp         = Odometry_array_pose2D_timestamp[@Odometry_Notification_pose2D_Element];
  @Odometry_Notification_pose2D_positionX         = Odometry_array_pose2D_positionX[@Odometry_Notification_pose2D_Element];
  @Odometry_Notification_pose2D_positionY         = Odometry_array_pose2D_positionY[@Odometry_Notification_pose2D_Element];
  @Odometry_Notification_pose2D_yawAngle          = Odometry_array_pose2D_yawAngle[@Odometry_Notification_pose2D_Element];
  @Odometry_Notification_pose2D_positionXVariance = Odometry_array_pose2D_positionXVariance[@Odometry_Notification_pose2D_Element];
  @Odometry_Notification_pose2D_positionYVariance = Odometry_array_pose2D_positionYVariance[@Odometry_Notification_pose2D_Element];
  @Odometry_Notification_pose2D_yawAngleVariance  = Odometry_array_pose2D_yawAngleVariance[@Odometry_Notification_pose2D_Element];
  @Odometry_Notification_pose2D_pose2dConfidence  = Odometry_array_pose2D_pose2dConfidence[@Odometry_Notification_pose2D_Element];
  
  @Odometry_Notification_pose2D_timestamp_available         = Odometry_array_pose2D_timestamp_available[@Odometry_Notification_pose2D_Element];
  @Odometry_Notification_pose2D_positionX_available         = Odometry_array_pose2D_positionX_available[@Odometry_Notification_pose2D_Element];
  @Odometry_Notification_pose2D_positionY_available         = Odometry_array_pose2D_positionY_available[@Odometry_Notification_pose2D_Element];
  @Odometry_Notification_pose2D_yawAngle_available          = Odometry_array_pose2D_yawAngle_available[@Odometry_Notification_pose2D_Element];
  @Odometry_Notification_pose2D_positionXVariance_available = Odometry_array_pose2D_positionXVariance_available[@Odometry_Notification_pose2D_Element];
  @Odometry_Notification_pose2D_positionYVariance_available = Odometry_array_pose2D_positionYVariance_available[@Odometry_Notification_pose2D_Element];
  @Odometry_Notification_pose2D_yawAngleVariance_available  = Odometry_array_pose2D_yawAngleVariance_available[@Odometry_Notification_pose2D_Element];
  @Odometry_Notification_pose2D_pose2dConfidence_available  = Odometry_array_pose2D_pose2dConfidence_available[@Odometry_Notification_pose2D_Element];
}








////////// additionalVehicleMotionInformations Notification //////////

on envVar Odometry_Notification_LengthIndicator_Struct_additionalVehicleMotionInformations
{
  Odometry_Notification_additionalVehicleMotionInformations();
}
on envVar Odometry_Notification_LengthIndicator_Element_additionalVehicleMotionInformations
{
  Odometry_Notification_additionalVehicleMotionInformations();
}
on envVar Odometry_Notification_additionalVehicleMotionInformations_timestamp
{
  Odometry_array_additionalVehicleMotionInformations_timestamp[@Odometry_Notification_additionalVehicleMotionInformations_Element] = @this;
  Odometry_Notification_additionalVehicleMotionInformations();
}
on envVar Odometry_Notification_additionalVehicleMotionInformations_drivingDirectionProbabilityRange
{
  Odometry_array_additionalVehicleMotionInformations_drivingDirectionProbabilityRange[@Odometry_Notification_additionalVehicleMotionInformations_Element] = @this;
  Odometry_Notification_additionalVehicleMotionInformations();
}
on envVar Odometry_Notification_additionalVehicleMotionInformations_drivingDirectionProbabilityRangeConfidence
{
  Odometry_array_additionalVehicleMotionInformations_drivingDirectionProbabilityRangeConfidence[@Odometry_Notification_additionalVehicleMotionInformations_Element] = @this;
  Odometry_Notification_additionalVehicleMotionInformations();
}
on envVar Odometry_Notification_additionalVehicleMotionInformations_standStillProbabilityRange
{
  Odometry_array_additionalVehicleMotionInformations_standStillProbabilityRange[@Odometry_Notification_additionalVehicleMotionInformations_Element] = @this;
  Odometry_Notification_additionalVehicleMotionInformations();
}
on envVar Odometry_Notification_additionalVehicleMotionInformations_standStillProbabilityRangeConfidence
{
  Odometry_array_additionalVehicleMotionInformations_standStillProbabilityRangeConfidence[@Odometry_Notification_additionalVehicleMotionInformations_Element] = @this;
  Odometry_Notification_additionalVehicleMotionInformations();
}
on envVar Odometry_Notification_additionalVehicleMotionInformations_timestamp_available
{
  Odometry_array_additionalVehicleMotionInformations_timestamp_available[@Odometry_Notification_additionalVehicleMotionInformations_Element] = @this;
  Odometry_Notification_additionalVehicleMotionInformations();
}
on envVar Odometry_Notification_additionalVehicleMotionInformations_drivingDirectionProbabilityRange_available
{
  Odometry_array_additionalVehicleMotionInformations_drivingDirectionProbabilityRange_available[@Odometry_Notification_additionalVehicleMotionInformations_Element] = @this;
  Odometry_Notification_additionalVehicleMotionInformations();
}
on envVar Odometry_Notification_additionalVehicleMotionInformations_drivingDirectionProbabilityRangeConfidence_available
{
  Odometry_array_additionalVehicleMotionInformations_drivingDirectionProbabilityRangeConfidence_available[@Odometry_Notification_additionalVehicleMotionInformations_Element] = @this;
  Odometry_Notification_additionalVehicleMotionInformations();
}
on envVar Odometry_Notification_additionalVehicleMotionInformations_standStillProbabilityRange_available
{
  Odometry_array_additionalVehicleMotionInformations_standStillProbabilityRange_available[@Odometry_Notification_additionalVehicleMotionInformations_Element] = @this;
  Odometry_Notification_additionalVehicleMotionInformations();
}
on envVar Odometry_Notification_additionalVehicleMotionInformations_standStillProbabilityRangeConfidence_available
{
  Odometry_array_additionalVehicleMotionInformations_standStillProbabilityRangeConfidence_available[@Odometry_Notification_additionalVehicleMotionInformations_Element] = @this;
  Odometry_Notification_additionalVehicleMotionInformations();
}
on envVar Odometry_Notification_additionalVehicleMotionInformations_Payload
{
  Odometry_Notification_additionalVehicleMotionInformations_update();
}


Odometry_Notification_additionalVehicleMotionInformations()
{
  word payload_counter = 0;
  word start_pos       = 0;
  word element_length  = 0;
  
  // Length Indicator Struct - Platzhalter
  payload_counter = 0+4;
  start_pos = 0;
  
  for (j=0; j<@Odometry_Notification_additionalVehicleMotionInformations_Element_TotalNum; j++)
  {
    Odometry_array_additionalVehicleMotionInformations_available_functions[j] = Odometry_array_additionalVehicleMotionInformations_timestamp_available[j]
                                                                              + Odometry_array_additionalVehicleMotionInformations_drivingDirectionProbabilityRange_available[j]
                                                                              + Odometry_array_additionalVehicleMotionInformations_drivingDirectionProbabilityRangeConfidence_available[j]
                                                                              + Odometry_array_additionalVehicleMotionInformations_standStillProbabilityRange_available[j]
                                                                              + Odometry_array_additionalVehicleMotionInformations_standStillProbabilityRangeConfidence_available[j];
    
    // Length Indicator Element - Platzhalter
    if (Odometry_array_additionalVehicleMotionInformations_available_functions[j] > 0)
    {
      start_pos = payload_counter;
      payload_counter = payload_counter + 4;
    }
    else 
      start_pos = payload_counter;
    
    
    // 0 timestamp (uint64)
    if (Odometry_array_additionalVehicleMotionInformations_timestamp_available[j] == 1)
    {
      tag_dataID = 0;
      Odometry_payload_buffer_additionalVehicleMotionInformations[payload_counter++] = 3 * 16 /* Wiretype = 3  =^ 64 Bit */ + ((tag_dataID>>8) & 0x0F) /* DataID High Part */ ;
      Odometry_payload_buffer_additionalVehicleMotionInformations[payload_counter++] = tag_dataID & 0xFF /* DataID Low Part */ ;
      
      temp_64bit_low  = Odometry_array_additionalVehicleMotionInformations_timestamp[j]     & 0x00000000FFFFFFFF;
      temp_64bit_high = Odometry_array_additionalVehicleMotionInformations_timestamp[j]>>32 & 0x00000000FFFFFFFF;
      
      Odometry_payload_buffer_additionalVehicleMotionInformations[payload_counter++] = temp_64bit_high>>24 & 0xFF;
      Odometry_payload_buffer_additionalVehicleMotionInformations[payload_counter++] = temp_64bit_high>>16 & 0xFF;
      Odometry_payload_buffer_additionalVehicleMotionInformations[payload_counter++] = temp_64bit_high>> 8 & 0xFF;
      Odometry_payload_buffer_additionalVehicleMotionInformations[payload_counter++] = temp_64bit_high     & 0xFF;
      Odometry_payload_buffer_additionalVehicleMotionInformations[payload_counter++] = temp_64bit_low>>24  & 0xFF;
      Odometry_payload_buffer_additionalVehicleMotionInformations[payload_counter++] = temp_64bit_low>>16  & 0xFF;
      Odometry_payload_buffer_additionalVehicleMotionInformations[payload_counter++] = temp_64bit_low>> 8  & 0xFF;
      Odometry_payload_buffer_additionalVehicleMotionInformations[payload_counter++] = temp_64bit_low      & 0xFF;
    }
    
    
    // 1 drivingDirectionProbabilityRange (float32)
    if (Odometry_array_additionalVehicleMotionInformations_drivingDirectionProbabilityRange_available[j] == 1)
    {
      tag_dataID = 1;
      Odometry_payload_buffer_additionalVehicleMotionInformations[payload_counter++] = 2 * 16 /* Wiretype = 2  =^ 32 Bit */ + ((tag_dataID>>8) & 0x0F) /* DataID High Part */ ;
      Odometry_payload_buffer_additionalVehicleMotionInformations[payload_counter++] = tag_dataID & 0xFF /* DataID Low Part */ ;
      
      temp_converttodword = interpretAsDword (Odometry_array_additionalVehicleMotionInformations_drivingDirectionProbabilityRange[j]);
      Odometry_payload_buffer_additionalVehicleMotionInformations[payload_counter++] = temp_converttodword>>24 & 0xFF;
      Odometry_payload_buffer_additionalVehicleMotionInformations[payload_counter++] = temp_converttodword>>16 & 0xFF;
      Odometry_payload_buffer_additionalVehicleMotionInformations[payload_counter++] = temp_converttodword>> 8 & 0xFF;
      Odometry_payload_buffer_additionalVehicleMotionInformations[payload_counter++] = temp_converttodword     & 0xFF;
    }
    
    
    // 2 drivingDirectionProbabilityRangeConfidence (enum32)
    if (Odometry_array_additionalVehicleMotionInformations_drivingDirectionProbabilityRangeConfidence_available[j] == 1)
    {
      tag_dataID = 2;
      Odometry_payload_buffer_additionalVehicleMotionInformations[payload_counter++] = 2 * 16 /* Wiretype = 2  =^ 32 Bit */ + ((tag_dataID>>8) & 0x0F) /* DataID High Part */ ;
      Odometry_payload_buffer_additionalVehicleMotionInformations[payload_counter++] = tag_dataID & 0xFF /* DataID Low Part */ ;
      
      Odometry_payload_buffer_additionalVehicleMotionInformations[payload_counter++] = Odometry_array_additionalVehicleMotionInformations_drivingDirectionProbabilityRangeConfidence[j]>>24 & 0xFF;
      Odometry_payload_buffer_additionalVehicleMotionInformations[payload_counter++] = Odometry_array_additionalVehicleMotionInformations_drivingDirectionProbabilityRangeConfidence[j]>>16 & 0xFF;
      Odometry_payload_buffer_additionalVehicleMotionInformations[payload_counter++] = Odometry_array_additionalVehicleMotionInformations_drivingDirectionProbabilityRangeConfidence[j]>> 8 & 0xFF;
      Odometry_payload_buffer_additionalVehicleMotionInformations[payload_counter++] = Odometry_array_additionalVehicleMotionInformations_drivingDirectionProbabilityRangeConfidence[j]     & 0xFF;
    }
    
    
    // 3 standStillProbabilityRange (float32)
    if (Odometry_array_additionalVehicleMotionInformations_standStillProbabilityRange_available[j] == 1)
    {
      tag_dataID = 3;
      Odometry_payload_buffer_additionalVehicleMotionInformations[payload_counter++] = 2 * 16 /* Wiretype = 2  =^ 32 Bit */ + ((tag_dataID>>8) & 0x0F) /* DataID High Part */ ;
      Odometry_payload_buffer_additionalVehicleMotionInformations[payload_counter++] = tag_dataID & 0xFF /* DataID Low Part */ ;
      
      temp_converttodword = interpretAsDword (Odometry_array_additionalVehicleMotionInformations_standStillProbabilityRange[j]);
      Odometry_payload_buffer_additionalVehicleMotionInformations[payload_counter++] = temp_converttodword>>24 & 0xFF;
      Odometry_payload_buffer_additionalVehicleMotionInformations[payload_counter++] = temp_converttodword>>16 & 0xFF;
      Odometry_payload_buffer_additionalVehicleMotionInformations[payload_counter++] = temp_converttodword>> 8 & 0xFF;
      Odometry_payload_buffer_additionalVehicleMotionInformations[payload_counter++] = temp_converttodword     & 0xFF;
    }
    
    
    // 4 standStillProbabilityRangeConfidence (enum32)
    if (Odometry_array_additionalVehicleMotionInformations_standStillProbabilityRangeConfidence_available[j] == 1)
    {
      tag_dataID = 4;
      Odometry_payload_buffer_additionalVehicleMotionInformations[payload_counter++] = 2 * 16 /* Wiretype = 2  =^ 32 Bit */ + ((tag_dataID>>8) & 0x0F) /* DataID High Part */ ;
      Odometry_payload_buffer_additionalVehicleMotionInformations[payload_counter++] = tag_dataID & 0xFF /* DataID Low Part */ ;
      
      Odometry_payload_buffer_additionalVehicleMotionInformations[payload_counter++] = Odometry_array_additionalVehicleMotionInformations_standStillProbabilityRangeConfidence[j]>>24 & 0xFF;
      Odometry_payload_buffer_additionalVehicleMotionInformations[payload_counter++] = Odometry_array_additionalVehicleMotionInformations_standStillProbabilityRangeConfidence[j]>>16 & 0xFF;
      Odometry_payload_buffer_additionalVehicleMotionInformations[payload_counter++] = Odometry_array_additionalVehicleMotionInformations_standStillProbabilityRangeConfidence[j]>> 8 & 0xFF;
      Odometry_payload_buffer_additionalVehicleMotionInformations[payload_counter++] = Odometry_array_additionalVehicleMotionInformations_standStillProbabilityRangeConfidence[j]     & 0xFF;
    }
    
    //Element Length
    element_length = payload_counter-start_pos;
    if (element_length >0) Odometry_array_additionalVehicleMotionInformations_array_element_length[j] = element_length - 4;
    else                   Odometry_array_additionalVehicleMotionInformations_array_element_length[j] = element_length;
    
    Odometry_payload_buffer_additionalVehicleMotionInformations[start_pos++] = Odometry_array_additionalVehicleMotionInformations_array_element_length[j]>>24 & 0xFF;
    Odometry_payload_buffer_additionalVehicleMotionInformations[start_pos++] = Odometry_array_additionalVehicleMotionInformations_array_element_length[j]>>16 & 0xFF;
    Odometry_payload_buffer_additionalVehicleMotionInformations[start_pos++] = Odometry_array_additionalVehicleMotionInformations_array_element_length[j]>> 8 & 0xFF;
    Odometry_payload_buffer_additionalVehicleMotionInformations[start_pos++] = Odometry_array_additionalVehicleMotionInformations_array_element_length[j]     & 0xFF;
    
    if (Odometry_array_additionalVehicleMotionInformations_array_element_length[j] == 0) payload_counter = payload_counter+4;
  }
  
  // Struct Length
  Odometry_array_additionalVehicleMotionInformations_struct_element_length = 4*@Odometry_Notification_additionalVehicleMotionInformations_Element_TotalNum;

  for (k=0;k<@Odometry_Notification_additionalVehicleMotionInformations_Element_TotalNum;k++)
   Odometry_array_additionalVehicleMotionInformations_struct_element_length = Odometry_array_additionalVehicleMotionInformations_struct_element_length + Odometry_array_additionalVehicleMotionInformations_array_element_length[k];
  
  Odometry_payload_buffer_additionalVehicleMotionInformations[0] = Odometry_array_additionalVehicleMotionInformations_struct_element_length>>24 & 0xFF;
  Odometry_payload_buffer_additionalVehicleMotionInformations[1] = Odometry_array_additionalVehicleMotionInformations_struct_element_length>>16 & 0xFF;
  Odometry_payload_buffer_additionalVehicleMotionInformations[2] = Odometry_array_additionalVehicleMotionInformations_struct_element_length>> 8 & 0xFF;
  Odometry_payload_buffer_additionalVehicleMotionInformations[3] = Odometry_array_additionalVehicleMotionInformations_struct_element_length     & 0xFF;


  Odometry_payload_length_additionalVehicleMotionInformations = Odometry_array_additionalVehicleMotionInformations_struct_element_length+4;
  putvalue(Odometry_Notification_additionalVehicleMotionInformations_Payload, Odometry_payload_buffer_additionalVehicleMotionInformations, Odometry_payload_length_additionalVehicleMotionInformations);
}

on envVar Odometry_Notification_additionalVehicleMotionInformations_Element_TotalNum
{
  if (@this == 0) @this =  1;
  if (@this > 10) @this = 10;
  
  Odometry_Notification_additionalVehicleMotionInformations();
  Odometry_Notification_additionalVehicleMotionInformations_update();
}

on envVar Odometry_Notification_additionalVehicleMotionInformations_Element
{
  Odometry_Notification_additionalVehicleMotionInformations_update();
}

on envVar Odometry_Notification_additionalVehicleMotionInformations_Element_Next
{
  if (@this == 1 && @Odometry_Notification_additionalVehicleMotionInformations_Element < @Odometry_Notification_additionalVehicleMotionInformations_Element_TotalNum - 1)
  {
    @Odometry_Notification_additionalVehicleMotionInformations_Element = @Odometry_Notification_additionalVehicleMotionInformations_Element + 1;
    Odometry_Notification_additionalVehicleMotionInformations_update();
  }
}

on envVar Odometry_Notification_additionalVehicleMotionInformations_Element_Previous
{
  if (@this == 1 && @Odometry_Notification_additionalVehicleMotionInformations_Element > 0)
  {
    @Odometry_Notification_additionalVehicleMotionInformations_Element = @Odometry_Notification_additionalVehicleMotionInformations_Element - 1;
    Odometry_Notification_additionalVehicleMotionInformations_update();
  }
}

Odometry_Notification_additionalVehicleMotionInformations_update()
{
  @Odometry_Notification_LengthIndicator_Element_additionalVehicleMotionInformations = Odometry_array_additionalVehicleMotionInformations_array_element_length[@Odometry_Notification_additionalVehicleMotionInformations_Element];
  @Odometry_Notification_LengthIndicator_Struct_additionalVehicleMotionInformations  = Odometry_array_additionalVehicleMotionInformations_struct_element_length;
  @Odometry_Notification_Length_additionalVehicleMotionInformations                  = Odometry_payload_length_additionalVehicleMotionInformations+8;
  
  @Odometry_Notification_additionalVehicleMotionInformations_timestamp                                  = Odometry_array_additionalVehicleMotionInformations_timestamp[@Odometry_Notification_additionalVehicleMotionInformations_Element];
  @Odometry_Notification_additionalVehicleMotionInformations_drivingDirectionProbabilityRange           = Odometry_array_additionalVehicleMotionInformations_drivingDirectionProbabilityRange[@Odometry_Notification_additionalVehicleMotionInformations_Element];
  @Odometry_Notification_additionalVehicleMotionInformations_drivingDirectionProbabilityRangeConfidence = Odometry_array_additionalVehicleMotionInformations_drivingDirectionProbabilityRangeConfidence[@Odometry_Notification_additionalVehicleMotionInformations_Element];
  @Odometry_Notification_additionalVehicleMotionInformations_standStillProbabilityRange                 = Odometry_array_additionalVehicleMotionInformations_standStillProbabilityRange[@Odometry_Notification_additionalVehicleMotionInformations_Element];
  @Odometry_Notification_additionalVehicleMotionInformations_standStillProbabilityRangeConfidence       = Odometry_array_additionalVehicleMotionInformations_standStillProbabilityRangeConfidence[@Odometry_Notification_additionalVehicleMotionInformations_Element];
  
  @Odometry_Notification_additionalVehicleMotionInformations_timestamp_available                                  = Odometry_array_additionalVehicleMotionInformations_timestamp_available[@Odometry_Notification_additionalVehicleMotionInformations_Element];
  @Odometry_Notification_additionalVehicleMotionInformations_drivingDirectionProbabilityRange_available           = Odometry_array_additionalVehicleMotionInformations_drivingDirectionProbabilityRange_available[@Odometry_Notification_additionalVehicleMotionInformations_Element];
  @Odometry_Notification_additionalVehicleMotionInformations_drivingDirectionProbabilityRangeConfidence_available = Odometry_array_additionalVehicleMotionInformations_drivingDirectionProbabilityRangeConfidence_available[@Odometry_Notification_additionalVehicleMotionInformations_Element];
  @Odometry_Notification_additionalVehicleMotionInformations_standStillProbabilityRange_available                 = Odometry_array_additionalVehicleMotionInformations_standStillProbabilityRange_available[@Odometry_Notification_additionalVehicleMotionInformations_Element];
  @Odometry_Notification_additionalVehicleMotionInformations_standStillProbabilityRangeConfidence_available       = Odometry_array_additionalVehicleMotionInformations_standStillProbabilityRangeConfidence_available[@Odometry_Notification_additionalVehicleMotionInformations_Element];
}








////////// wheelCorrections Notification //////////

on envVar Odometry_Notification_LengthIndicator_Struct_wheelCorrections
{
  Odometry_Notification_wheelCorrections();
}
on envVar Odometry_Notification_LengthIndicator_Element_wheelCorrections
{
  Odometry_Notification_wheelCorrections();
}
on envVar Odometry_Notification_wheelCorrections_timestamp
{
  Odometry_array_wheelCorrections_timestamp[@Odometry_Notification_wheelCorrections_Element] = @this;
  Odometry_Notification_wheelCorrections();
}
on envVar Odometry_Notification_wheelCorrections_wheelCorrectionFactorFrontLeft
{
  Odometry_array_wheelCorrections_wheelCorrectionFactorFrontLeft[@Odometry_Notification_wheelCorrections_Element] = @this;
  Odometry_Notification_wheelCorrections();
}
on envVar Odometry_Notification_wheelCorrections_wheelCorrectionFactorFrontRight
{
  Odometry_array_wheelCorrections_wheelCorrectionFactorFrontRight[@Odometry_Notification_wheelCorrections_Element] = @this;
  Odometry_Notification_wheelCorrections();
}
on envVar Odometry_Notification_wheelCorrections_wheelCorrectionFactorRearLeft
{
  Odometry_array_wheelCorrections_wheelCorrectionFactorRearLeft[@Odometry_Notification_wheelCorrections_Element] = @this;
  Odometry_Notification_wheelCorrections();
}
on envVar Odometry_Notification_wheelCorrections_wheelCorrectionFactorRearRight
{
  Odometry_array_wheelCorrections_wheelCorrectionFactorRearRight[@Odometry_Notification_wheelCorrections_Element] = @this;
  Odometry_Notification_wheelCorrections();
}
on envVar Odometry_Notification_wheelCorrections_wheelCorrectionFactorEstimatorStatus
{
  Odometry_array_wheelCorrections_wheelCorrectionFactorEstimatorStatus[@Odometry_Notification_wheelCorrections_Element] = @this;
  Odometry_Notification_wheelCorrections();
}
on envVar Odometry_Notification_wheelCorrections_wheelCorrectionFactorEstimatorStatusConfidence
{
  Odometry_array_wheelCorrections_wheelCorrectionFactorEstimatorStatusConfidence[@Odometry_Notification_wheelCorrections_Element] = @this;
  Odometry_Notification_wheelCorrections();
}
on envVar Odometry_Notification_wheelCorrections_wheelCorrectionFactorFrontLeftConfidence
{
  Odometry_array_wheelCorrections_wheelCorrectionFactorFrontLeftConfidence[@Odometry_Notification_wheelCorrections_Element] = @this;
  Odometry_Notification_wheelCorrections();
}
on envVar Odometry_Notification_wheelCorrections_wheelCorrectionFactorFrontRightConfidence
{
  Odometry_array_wheelCorrections_wheelCorrectionFactorFrontRightConfidence[@Odometry_Notification_wheelCorrections_Element] = @this;
  Odometry_Notification_wheelCorrections();
}
on envVar Odometry_Notification_wheelCorrections_wheelCorrectionFactoRearLeftConfidence
{
  Odometry_array_wheelCorrections_wheelCorrectionFactoRearLeftConfidence[@Odometry_Notification_wheelCorrections_Element] = @this;
  Odometry_Notification_wheelCorrections();
}
on envVar Odometry_Notification_wheelCorrections_wheelCorrectionFactoRearRightConfidence
{
  Odometry_array_wheelCorrections_wheelCorrectionFactoRearRightConfidence[@Odometry_Notification_wheelCorrections_Element] = @this;
  Odometry_Notification_wheelCorrections();
}
on envVar Odometry_Notification_wheelCorrections_wheelCircumferenceStatic
{
  Odometry_array_wheelCorrections_wheelCircumferenceStatic[@Odometry_Notification_wheelCorrections_Element] = @this;
  Odometry_Notification_wheelCorrections();
}
on envVar Odometry_Notification_wheelCorrections_wheelCircumferenceStaticConfidence
{
  Odometry_array_wheelCorrections_wheelCircumferenceStaticConfidence[@Odometry_Notification_wheelCorrections_Element] = @this;
  Odometry_Notification_wheelCorrections();
}
on envVar Odometry_Notification_wheelCorrections_timestamp_available
{
  Odometry_array_wheelCorrections_timestamp_available[@Odometry_Notification_wheelCorrections_Element] = @this;
  Odometry_Notification_wheelCorrections();
}
on envVar Odometry_Notification_wheelCorrections_wheelCorrectionFactorFrontLeft_available
{
  Odometry_array_wheelCorrections_wheelCorrectionFactorFrontLeft_available[@Odometry_Notification_wheelCorrections_Element] = @this;
  Odometry_Notification_wheelCorrections();
}
on envVar Odometry_Notification_wheelCorrections_wheelCorrectionFactorFrontRight_available
{
  Odometry_array_wheelCorrections_wheelCorrectionFactorFrontRight_available[@Odometry_Notification_wheelCorrections_Element] = @this;
  Odometry_Notification_wheelCorrections();
}
on envVar Odometry_Notification_wheelCorrections_wheelCorrectionFactorRearLeft_available
{
  Odometry_array_wheelCorrections_wheelCorrectionFactorRearLeft_available[@Odometry_Notification_wheelCorrections_Element] = @this;
  Odometry_Notification_wheelCorrections();
}
on envVar Odometry_Notification_wheelCorrections_wheelCorrectionFactorRearRight_available
{
  Odometry_array_wheelCorrections_wheelCorrectionFactorRearRight_available[@Odometry_Notification_wheelCorrections_Element] = @this;
  Odometry_Notification_wheelCorrections();
}
on envVar Odometry_Notification_wheelCorrections_wheelCorrectionFactorEstimatorStatus_available
{
  Odometry_array_wheelCorrections_wheelCorrectionFactorEstimatorStatus_available[@Odometry_Notification_wheelCorrections_Element] = @this;
  Odometry_Notification_wheelCorrections();
}
on envVar Odometry_Notification_wheelCorrections_wheelCorrectionFactorEstimatorStatusConfidence_available
{
  Odometry_array_wheelCorrections_wheelCorrectionFactorEstimatorStatusConfidence_available[@Odometry_Notification_wheelCorrections_Element] = @this;
  Odometry_Notification_wheelCorrections();
}
on envVar Odometry_Notification_wheelCorrections_wheelCorrectionFactorFrontLeftConfidence_available
{
  Odometry_array_wheelCorrections_wheelCorrectionFactorFrontLeftConfidence_available[@Odometry_Notification_wheelCorrections_Element] = @this;
  Odometry_Notification_wheelCorrections();
}
on envVar Odometry_Notification_wheelCorrections_wheelCorrectionFactorFrontRightConfidence_available
{
  Odometry_array_wheelCorrections_wheelCorrectionFactorFrontRightConfidence_available[@Odometry_Notification_wheelCorrections_Element] = @this;
  Odometry_Notification_wheelCorrections();
}
on envVar Odometry_Notification_wheelCorrections_wheelCorrectionFactoRearLeftConfidence_available
{
  Odometry_array_wheelCorrections_wheelCorrectionFactoRearLeftConfidence_available[@Odometry_Notification_wheelCorrections_Element] = @this;
  Odometry_Notification_wheelCorrections();
}
on envVar Odometry_Notification_wheelCorrections_wheelCorrectionFactoRearRightConfidence_available
{
  Odometry_array_wheelCorrections_wheelCorrectionFactoRearRightConfidence_available[@Odometry_Notification_wheelCorrections_Element] = @this;
  Odometry_Notification_wheelCorrections();
}
on envVar Odometry_Notification_wheelCorrections_wheelCircumferenceStatic_available
{
  Odometry_array_wheelCorrections_wheelCircumferenceStatic_available[@Odometry_Notification_wheelCorrections_Element] = @this;
  Odometry_Notification_wheelCorrections();
}
on envVar Odometry_Notification_wheelCorrections_wheelCircumferenceStaticConfidence_available
{
  Odometry_array_wheelCorrections_wheelCircumferenceStaticConfidence_available[@Odometry_Notification_wheelCorrections_Element] = @this;
  Odometry_Notification_wheelCorrections();
}
on envVar Odometry_Notification_wheelCorrections_Payload
{
  Odometry_Notification_wheelCorrections_update();
}


Odometry_Notification_wheelCorrections()
{
  word payload_counter = 0;
  word start_pos       = 0;
  word element_length  = 0;
  
  // Length Indicator Struct - Platzhalter
  payload_counter = 0+4;
  start_pos = 0;
  
  for (j=0; j<@Odometry_Notification_wheelCorrections_Element_TotalNum; j++)
  {
    Odometry_array_wheelCorrections_available_functions[j] = Odometry_array_wheelCorrections_timestamp_available[j]
                                                           + Odometry_array_wheelCorrections_wheelCorrectionFactorFrontLeft_available[j]
                                                           + Odometry_array_wheelCorrections_wheelCorrectionFactorFrontRight_available[j]
                                                           + Odometry_array_wheelCorrections_wheelCorrectionFactorRearLeft_available[j]
                                                           + Odometry_array_wheelCorrections_wheelCorrectionFactorRearRight_available[j]
                                                           + Odometry_array_wheelCorrections_wheelCorrectionFactorEstimatorStatus_available[j]
                                                           + Odometry_array_wheelCorrections_wheelCorrectionFactorEstimatorStatusConfidence_available[j]
                                                           + Odometry_array_wheelCorrections_wheelCorrectionFactorFrontLeftConfidence_available[j]
                                                           + Odometry_array_wheelCorrections_wheelCorrectionFactorFrontRightConfidence_available[j]
                                                           + Odometry_array_wheelCorrections_wheelCorrectionFactoRearLeftConfidence_available[j]
                                                           + Odometry_array_wheelCorrections_wheelCorrectionFactoRearRightConfidence_available[j]
                                                           + Odometry_array_wheelCorrections_wheelCircumferenceStatic_available[j]
                                                           + Odometry_array_wheelCorrections_wheelCircumferenceStaticConfidence_available[j];
    
    // Length Indicator Element - Platzhalter
    if (Odometry_array_wheelCorrections_available_functions[j] > 0)
    {
      start_pos = payload_counter;
      payload_counter = payload_counter + 4;
    }
    else 
      start_pos = payload_counter;
    
    
    // 0 timestamp (uint64)
    if (Odometry_array_wheelCorrections_timestamp_available[j] == 1)
    {
      tag_dataID = 0;
      Odometry_payload_buffer_wheelCorrections[payload_counter++] = 3 * 16 /* Wiretype = 3  =^ 64 Bit */ + ((tag_dataID>>8) & 0x0F) /* DataID High Part */ ;
      Odometry_payload_buffer_wheelCorrections[payload_counter++] = tag_dataID & 0xFF /* DataID Low Part */ ;
      
      temp_64bit_low  = Odometry_array_wheelCorrections_timestamp[j]     & 0x00000000FFFFFFFF;
      temp_64bit_high = Odometry_array_wheelCorrections_timestamp[j]>>32 & 0x00000000FFFFFFFF;
      
      Odometry_payload_buffer_wheelCorrections[payload_counter++] = temp_64bit_high>>24 & 0xFF;
      Odometry_payload_buffer_wheelCorrections[payload_counter++] = temp_64bit_high>>16 & 0xFF;
      Odometry_payload_buffer_wheelCorrections[payload_counter++] = temp_64bit_high>> 8 & 0xFF;
      Odometry_payload_buffer_wheelCorrections[payload_counter++] = temp_64bit_high     & 0xFF;
      Odometry_payload_buffer_wheelCorrections[payload_counter++] = temp_64bit_low>>24  & 0xFF;
      Odometry_payload_buffer_wheelCorrections[payload_counter++] = temp_64bit_low>>16  & 0xFF;
      Odometry_payload_buffer_wheelCorrections[payload_counter++] = temp_64bit_low>> 8  & 0xFF;
      Odometry_payload_buffer_wheelCorrections[payload_counter++] = temp_64bit_low      & 0xFF;
    }
    
    
    // 1 wheelCorrectionFactorFrontLeft (float32)
    if (Odometry_array_wheelCorrections_wheelCorrectionFactorFrontLeft_available[j] == 1)
    {
      tag_dataID = 1;
      Odometry_payload_buffer_wheelCorrections[payload_counter++] = 2 * 16 /* Wiretype = 2  =^ 32 Bit */ + ((tag_dataID>>8) & 0x0F) /* DataID High Part */ ;
      Odometry_payload_buffer_wheelCorrections[payload_counter++] = tag_dataID & 0xFF /* DataID Low Part */ ;
      
      temp_converttodword = interpretAsDword (Odometry_array_wheelCorrections_wheelCorrectionFactorFrontLeft[j]);
      Odometry_payload_buffer_wheelCorrections[payload_counter++] = temp_converttodword>>24 & 0xFF;
      Odometry_payload_buffer_wheelCorrections[payload_counter++] = temp_converttodword>>16 & 0xFF;
      Odometry_payload_buffer_wheelCorrections[payload_counter++] = temp_converttodword>> 8 & 0xFF;
      Odometry_payload_buffer_wheelCorrections[payload_counter++] = temp_converttodword     & 0xFF;
    }
    
    
    // 2 wheelCorrectionFactorFrontRight (float32)
    if (Odometry_array_wheelCorrections_wheelCorrectionFactorFrontRight_available[j] == 1)
    {
      tag_dataID = 2;
      Odometry_payload_buffer_wheelCorrections[payload_counter++] = 2 * 16 /* Wiretype = 2  =^ 32 Bit */ + ((tag_dataID>>8) & 0x0F) /* DataID High Part */ ;
      Odometry_payload_buffer_wheelCorrections[payload_counter++] = tag_dataID & 0xFF /* DataID Low Part */ ;
      
      temp_converttodword = interpretAsDword (Odometry_array_wheelCorrections_wheelCorrectionFactorFrontRight[j]);
      Odometry_payload_buffer_wheelCorrections[payload_counter++] = temp_converttodword>>24 & 0xFF;
      Odometry_payload_buffer_wheelCorrections[payload_counter++] = temp_converttodword>>16 & 0xFF;
      Odometry_payload_buffer_wheelCorrections[payload_counter++] = temp_converttodword>> 8 & 0xFF;
      Odometry_payload_buffer_wheelCorrections[payload_counter++] = temp_converttodword     & 0xFF;
    }
    
    
    // 3 wheelCorrectionFactorRearLeft (float32)
    if (Odometry_array_wheelCorrections_wheelCorrectionFactorRearLeft_available[j] == 1)
    {
      tag_dataID = 3;
      Odometry_payload_buffer_wheelCorrections[payload_counter++] = 2 * 16 /* Wiretype = 2  =^ 32 Bit */ + ((tag_dataID>>8) & 0x0F) /* DataID High Part */ ;
      Odometry_payload_buffer_wheelCorrections[payload_counter++] = tag_dataID & 0xFF /* DataID Low Part */ ;
      
      temp_converttodword = interpretAsDword (Odometry_array_wheelCorrections_wheelCorrectionFactorRearLeft[j]);
      Odometry_payload_buffer_wheelCorrections[payload_counter++] = temp_converttodword>>24 & 0xFF;
      Odometry_payload_buffer_wheelCorrections[payload_counter++] = temp_converttodword>>16 & 0xFF;
      Odometry_payload_buffer_wheelCorrections[payload_counter++] = temp_converttodword>> 8 & 0xFF;
      Odometry_payload_buffer_wheelCorrections[payload_counter++] = temp_converttodword     & 0xFF;
    }
    
    
    // 4 wheelCorrectionFactorRearRight (float32)
    if (Odometry_array_wheelCorrections_wheelCorrectionFactorRearRight_available[j] == 1)
    {
      tag_dataID = 4;
      Odometry_payload_buffer_wheelCorrections[payload_counter++] = 2 * 16 /* Wiretype = 2  =^ 32 Bit */ + ((tag_dataID>>8) & 0x0F) /* DataID High Part */ ;
      Odometry_payload_buffer_wheelCorrections[payload_counter++] = tag_dataID & 0xFF /* DataID Low Part */ ;
      
      temp_converttodword = interpretAsDword (Odometry_array_wheelCorrections_wheelCorrectionFactorRearRight[j]);
      Odometry_payload_buffer_wheelCorrections[payload_counter++] = temp_converttodword>>24 & 0xFF;
      Odometry_payload_buffer_wheelCorrections[payload_counter++] = temp_converttodword>>16 & 0xFF;
      Odometry_payload_buffer_wheelCorrections[payload_counter++] = temp_converttodword>> 8 & 0xFF;
      Odometry_payload_buffer_wheelCorrections[payload_counter++] = temp_converttodword     & 0xFF;
    }
    
    
    // 5 wheelCorrectionFactorEstimatorStatus (uint8)
    if (Odometry_array_wheelCorrections_wheelCorrectionFactorEstimatorStatus_available[j] == 1)
    {
      tag_dataID = 5;
      Odometry_payload_buffer_wheelCorrections[payload_counter++] = 0 * 16 /* Wiretype = 0  =^ 8 Bit */ + ((tag_dataID>>8) & 0x0F) /* DataID High Part */ ;
      Odometry_payload_buffer_wheelCorrections[payload_counter++] = tag_dataID & 0xFF /* DataID Low Part */ ;
      
      Odometry_payload_buffer_wheelCorrections[payload_counter++] = Odometry_array_wheelCorrections_wheelCorrectionFactorEstimatorStatus[j] & 0xFF;
    }
    
    
    // 6 wheelCorrectionFactorEstimatorStatusConfidence (enum32)
    if (Odometry_array_wheelCorrections_wheelCorrectionFactorEstimatorStatusConfidence_available[j] == 1)
    {
      tag_dataID = 6;
      Odometry_payload_buffer_wheelCorrections[payload_counter++] = 2 * 16 /* Wiretype = 2  =^ 32 Bit */ + ((tag_dataID>>8) & 0x0F) /* DataID High Part */ ;
      Odometry_payload_buffer_wheelCorrections[payload_counter++] = tag_dataID & 0xFF /* DataID Low Part */ ;
      
      Odometry_payload_buffer_wheelCorrections[payload_counter++] = Odometry_array_wheelCorrections_wheelCorrectionFactorEstimatorStatusConfidence[j]>>24 & 0xFF;
      Odometry_payload_buffer_wheelCorrections[payload_counter++] = Odometry_array_wheelCorrections_wheelCorrectionFactorEstimatorStatusConfidence[j]>>16 & 0xFF;
      Odometry_payload_buffer_wheelCorrections[payload_counter++] = Odometry_array_wheelCorrections_wheelCorrectionFactorEstimatorStatusConfidence[j]>> 8 & 0xFF;
      Odometry_payload_buffer_wheelCorrections[payload_counter++] = Odometry_array_wheelCorrections_wheelCorrectionFactorEstimatorStatusConfidence[j]     & 0xFF;
    }
    
    
    // 7 wheelCorrectionFactorFrontLeftConfidence (enum32)
    if (Odometry_array_wheelCorrections_wheelCorrectionFactorFrontLeftConfidence_available[j] == 1)
    {
      tag_dataID = 7;
      Odometry_payload_buffer_wheelCorrections[payload_counter++] = 2 * 16 /* Wiretype = 2  =^ 32 Bit */ + ((tag_dataID>>8) & 0x0F) /* DataID High Part */ ;
      Odometry_payload_buffer_wheelCorrections[payload_counter++] = tag_dataID & 0xFF /* DataID Low Part */ ;
      
      Odometry_payload_buffer_wheelCorrections[payload_counter++] = Odometry_array_wheelCorrections_wheelCorrectionFactorFrontLeftConfidence[j]>>24 & 0xFF;
      Odometry_payload_buffer_wheelCorrections[payload_counter++] = Odometry_array_wheelCorrections_wheelCorrectionFactorFrontLeftConfidence[j]>>16 & 0xFF;
      Odometry_payload_buffer_wheelCorrections[payload_counter++] = Odometry_array_wheelCorrections_wheelCorrectionFactorFrontLeftConfidence[j]>> 8 & 0xFF;
      Odometry_payload_buffer_wheelCorrections[payload_counter++] = Odometry_array_wheelCorrections_wheelCorrectionFactorFrontLeftConfidence[j]     & 0xFF;
    }
    
    
    // 8 wheelCorrectionFactorFrontRightConfidence (enum32)
    if (Odometry_array_wheelCorrections_wheelCorrectionFactorFrontRightConfidence_available[j] == 1)
    {
      tag_dataID = 8;
      Odometry_payload_buffer_wheelCorrections[payload_counter++] = 2 * 16 /* Wiretype = 2  =^ 32 Bit */ + ((tag_dataID>>8) & 0x0F) /* DataID High Part */ ;
      Odometry_payload_buffer_wheelCorrections[payload_counter++] = tag_dataID & 0xFF /* DataID Low Part */ ;
      
      Odometry_payload_buffer_wheelCorrections[payload_counter++] = Odometry_array_wheelCorrections_wheelCorrectionFactorFrontRightConfidence[j]>>24 & 0xFF;
      Odometry_payload_buffer_wheelCorrections[payload_counter++] = Odometry_array_wheelCorrections_wheelCorrectionFactorFrontRightConfidence[j]>>16 & 0xFF;
      Odometry_payload_buffer_wheelCorrections[payload_counter++] = Odometry_array_wheelCorrections_wheelCorrectionFactorFrontRightConfidence[j]>> 8 & 0xFF;
      Odometry_payload_buffer_wheelCorrections[payload_counter++] = Odometry_array_wheelCorrections_wheelCorrectionFactorFrontRightConfidence[j]     & 0xFF;
    }
    
    
    // 9 wheelCorrectionFactoRearLeftConfidence (enum32)
    if (Odometry_array_wheelCorrections_wheelCorrectionFactoRearLeftConfidence_available[j] == 1)
    {
      tag_dataID = 9;
      Odometry_payload_buffer_wheelCorrections[payload_counter++] = 2 * 16 /* Wiretype = 2  =^ 32 Bit */ + ((tag_dataID>>8) & 0x0F) /* DataID High Part */ ;
      Odometry_payload_buffer_wheelCorrections[payload_counter++] = tag_dataID & 0xFF /* DataID Low Part */ ;
      
      Odometry_payload_buffer_wheelCorrections[payload_counter++] = Odometry_array_wheelCorrections_wheelCorrectionFactoRearLeftConfidence[j]>>24 & 0xFF;
      Odometry_payload_buffer_wheelCorrections[payload_counter++] = Odometry_array_wheelCorrections_wheelCorrectionFactoRearLeftConfidence[j]>>16 & 0xFF;
      Odometry_payload_buffer_wheelCorrections[payload_counter++] = Odometry_array_wheelCorrections_wheelCorrectionFactoRearLeftConfidence[j]>> 8 & 0xFF;
      Odometry_payload_buffer_wheelCorrections[payload_counter++] = Odometry_array_wheelCorrections_wheelCorrectionFactoRearLeftConfidence[j]     & 0xFF;
    }
    
    
    // 10 wheelCorrectionFactoRearRightConfidence (enum32)
    if (Odometry_array_wheelCorrections_wheelCorrectionFactoRearRightConfidence_available[j] == 1)
    {
      tag_dataID = 10;
      Odometry_payload_buffer_wheelCorrections[payload_counter++] = 2 * 16 /* Wiretype = 2  =^ 32 Bit */ + ((tag_dataID>>8) & 0x0F) /* DataID High Part */ ;
      Odometry_payload_buffer_wheelCorrections[payload_counter++] = tag_dataID & 0xFF /* DataID Low Part */ ;
      
      Odometry_payload_buffer_wheelCorrections[payload_counter++] = Odometry_array_wheelCorrections_wheelCorrectionFactoRearRightConfidence[j]>>24 & 0xFF;
      Odometry_payload_buffer_wheelCorrections[payload_counter++] = Odometry_array_wheelCorrections_wheelCorrectionFactoRearRightConfidence[j]>>16 & 0xFF;
      Odometry_payload_buffer_wheelCorrections[payload_counter++] = Odometry_array_wheelCorrections_wheelCorrectionFactoRearRightConfidence[j]>> 8 & 0xFF;
      Odometry_payload_buffer_wheelCorrections[payload_counter++] = Odometry_array_wheelCorrections_wheelCorrectionFactoRearRightConfidence[j]     & 0xFF;
    }
    
    
    // 11 wheelCircumferenceStatic (uint16)
    if (Odometry_array_wheelCorrections_wheelCircumferenceStatic_available[j] == 1)
    {
      tag_dataID = 11;
      Odometry_payload_buffer_wheelCorrections[payload_counter++] = 1 * 16 /* Wiretype = 1  =^ 16 Bit */ + ((tag_dataID>>8) & 0x0F) /* DataID High Part */ ;
      Odometry_payload_buffer_wheelCorrections[payload_counter++] = tag_dataID & 0xFF /* DataID Low Part */ ;
      
      Odometry_payload_buffer_wheelCorrections[payload_counter++] = Odometry_array_wheelCorrections_wheelCircumferenceStatic[j]>> 8 & 0xFF;
      Odometry_payload_buffer_wheelCorrections[payload_counter++] = Odometry_array_wheelCorrections_wheelCircumferenceStatic[j]     & 0xFF;
    }
    
    
    // 12 wheelCircumferenceStaticConfidence (enum32)
    if (Odometry_array_wheelCorrections_wheelCircumferenceStaticConfidence_available[j] == 1)
    {
      tag_dataID = 12;
      Odometry_payload_buffer_wheelCorrections[payload_counter++] = 2 * 16 /* Wiretype = 2  =^ 32 Bit */ + ((tag_dataID>>8) & 0x0F) /* DataID High Part */ ;
      Odometry_payload_buffer_wheelCorrections[payload_counter++] = tag_dataID & 0xFF /* DataID Low Part */ ;
      
      Odometry_payload_buffer_wheelCorrections[payload_counter++] = Odometry_array_wheelCorrections_wheelCircumferenceStaticConfidence[j]>>24 & 0xFF;
      Odometry_payload_buffer_wheelCorrections[payload_counter++] = Odometry_array_wheelCorrections_wheelCircumferenceStaticConfidence[j]>>16 & 0xFF;
      Odometry_payload_buffer_wheelCorrections[payload_counter++] = Odometry_array_wheelCorrections_wheelCircumferenceStaticConfidence[j]>> 8 & 0xFF;
      Odometry_payload_buffer_wheelCorrections[payload_counter++] = Odometry_array_wheelCorrections_wheelCircumferenceStaticConfidence[j]     & 0xFF;
    }
    
    
    //Element Length
    element_length = payload_counter-start_pos;
    if (element_length >0) Odometry_array_wheelCorrections_array_element_length[j] = element_length - 4;
    else                   Odometry_array_wheelCorrections_array_element_length[j] = element_length;
    
    Odometry_payload_buffer_wheelCorrections[start_pos++] = Odometry_array_wheelCorrections_array_element_length[j]>>24 & 0xFF;
    Odometry_payload_buffer_wheelCorrections[start_pos++] = Odometry_array_wheelCorrections_array_element_length[j]>>16 & 0xFF;
    Odometry_payload_buffer_wheelCorrections[start_pos++] = Odometry_array_wheelCorrections_array_element_length[j]>> 8 & 0xFF;
    Odometry_payload_buffer_wheelCorrections[start_pos++] = Odometry_array_wheelCorrections_array_element_length[j]     & 0xFF;
    
    if (Odometry_array_wheelCorrections_array_element_length[j] == 0) payload_counter = payload_counter+4;
  }
  
  // Struct Length
  Odometry_array_wheelCorrections_struct_element_length = 4*@Odometry_Notification_wheelCorrections_Element_TotalNum;

  for (k=0;k<@Odometry_Notification_wheelCorrections_Element_TotalNum;k++)
   Odometry_array_wheelCorrections_struct_element_length = Odometry_array_wheelCorrections_struct_element_length + Odometry_array_wheelCorrections_array_element_length[k];
  
  Odometry_payload_buffer_wheelCorrections[0] = Odometry_array_wheelCorrections_struct_element_length>>24 & 0xFF;
  Odometry_payload_buffer_wheelCorrections[1] = Odometry_array_wheelCorrections_struct_element_length>>16 & 0xFF;
  Odometry_payload_buffer_wheelCorrections[2] = Odometry_array_wheelCorrections_struct_element_length>> 8 & 0xFF;
  Odometry_payload_buffer_wheelCorrections[3] = Odometry_array_wheelCorrections_struct_element_length     & 0xFF;


  Odometry_payload_length_wheelCorrections = Odometry_array_wheelCorrections_struct_element_length+4;
  putvalue(Odometry_Notification_wheelCorrections_Payload, Odometry_payload_buffer_wheelCorrections, Odometry_payload_length_wheelCorrections);
}

on envVar Odometry_Notification_wheelCorrections_Element_TotalNum
{
  if (@this == 0) @this =  1;
  if (@this > 10) @this = 10;
  
  Odometry_Notification_wheelCorrections();
  Odometry_Notification_wheelCorrections_update();
}

on envVar Odometry_Notification_wheelCorrections_Element
{
  Odometry_Notification_wheelCorrections_update();
}

on envVar Odometry_Notification_wheelCorrections_Element_Next
{
  if (@this == 1 && @Odometry_Notification_wheelCorrections_Element < @Odometry_Notification_wheelCorrections_Element_TotalNum - 1)
  {
    @Odometry_Notification_wheelCorrections_Element = @Odometry_Notification_wheelCorrections_Element + 1;
    Odometry_Notification_wheelCorrections_update();
  }
}

on envVar Odometry_Notification_wheelCorrections_Element_Previous
{
  if (@this == 1 && @Odometry_Notification_wheelCorrections_Element > 0)
  {
    @Odometry_Notification_wheelCorrections_Element = @Odometry_Notification_wheelCorrections_Element - 1;
    Odometry_Notification_wheelCorrections_update();
  }
}

Odometry_Notification_wheelCorrections_update()
{
  @Odometry_Notification_LengthIndicator_Element_wheelCorrections = Odometry_array_wheelCorrections_array_element_length[@Odometry_Notification_wheelCorrections_Element];
  @Odometry_Notification_LengthIndicator_Struct_wheelCorrections  = Odometry_array_wheelCorrections_struct_element_length;
  @Odometry_Notification_Length_wheelCorrections                  = Odometry_payload_length_wheelCorrections+8;
  
  @Odometry_Notification_wheelCorrections_timestamp                                      = Odometry_array_wheelCorrections_timestamp[@Odometry_Notification_wheelCorrections_Element];
  @Odometry_Notification_wheelCorrections_wheelCorrectionFactorFrontLeft                 = Odometry_array_wheelCorrections_wheelCorrectionFactorFrontLeft[@Odometry_Notification_wheelCorrections_Element];
  @Odometry_Notification_wheelCorrections_wheelCorrectionFactorFrontRight                = Odometry_array_wheelCorrections_wheelCorrectionFactorFrontRight[@Odometry_Notification_wheelCorrections_Element];
  @Odometry_Notification_wheelCorrections_wheelCorrectionFactorRearLeft                  = Odometry_array_wheelCorrections_wheelCorrectionFactorRearLeft[@Odometry_Notification_wheelCorrections_Element];
  @Odometry_Notification_wheelCorrections_wheelCorrectionFactorRearRight                 = Odometry_array_wheelCorrections_wheelCorrectionFactorRearRight[@Odometry_Notification_wheelCorrections_Element];
  @Odometry_Notification_wheelCorrections_wheelCorrectionFactorEstimatorStatus           = Odometry_array_wheelCorrections_wheelCorrectionFactorEstimatorStatus[@Odometry_Notification_wheelCorrections_Element];
  @Odometry_Notification_wheelCorrections_wheelCorrectionFactorEstimatorStatusConfidence = Odometry_array_wheelCorrections_wheelCorrectionFactorEstimatorStatusConfidence[@Odometry_Notification_wheelCorrections_Element];
  @Odometry_Notification_wheelCorrections_wheelCorrectionFactorFrontLeftConfidence       = Odometry_array_wheelCorrections_wheelCorrectionFactorFrontLeftConfidence[@Odometry_Notification_wheelCorrections_Element];
  @Odometry_Notification_wheelCorrections_wheelCorrectionFactorFrontRightConfidence      = Odometry_array_wheelCorrections_wheelCorrectionFactorFrontRightConfidence[@Odometry_Notification_wheelCorrections_Element];
  @Odometry_Notification_wheelCorrections_wheelCorrectionFactoRearLeftConfidence         = Odometry_array_wheelCorrections_wheelCorrectionFactoRearLeftConfidence[@Odometry_Notification_wheelCorrections_Element];
  @Odometry_Notification_wheelCorrections_wheelCorrectionFactoRearRightConfidence        = Odometry_array_wheelCorrections_wheelCorrectionFactoRearRightConfidence[@Odometry_Notification_wheelCorrections_Element];
  @Odometry_Notification_wheelCorrections_wheelCircumferenceStatic                       = Odometry_array_wheelCorrections_wheelCircumferenceStatic[@Odometry_Notification_wheelCorrections_Element];
  @Odometry_Notification_wheelCorrections_wheelCircumferenceStaticConfidence             = Odometry_array_wheelCorrections_wheelCircumferenceStaticConfidence[@Odometry_Notification_wheelCorrections_Element];
  
  @Odometry_Notification_wheelCorrections_timestamp_available                                      = Odometry_array_wheelCorrections_timestamp_available[@Odometry_Notification_wheelCorrections_Element];
  @Odometry_Notification_wheelCorrections_wheelCorrectionFactorFrontLeft_available                 = Odometry_array_wheelCorrections_wheelCorrectionFactorFrontLeft_available[@Odometry_Notification_wheelCorrections_Element];
  @Odometry_Notification_wheelCorrections_wheelCorrectionFactorFrontRight_available                = Odometry_array_wheelCorrections_wheelCorrectionFactorFrontRight_available[@Odometry_Notification_wheelCorrections_Element];
  @Odometry_Notification_wheelCorrections_wheelCorrectionFactorRearLeft_available                  = Odometry_array_wheelCorrections_wheelCorrectionFactorRearLeft_available[@Odometry_Notification_wheelCorrections_Element];
  @Odometry_Notification_wheelCorrections_wheelCorrectionFactorRearRight_available                 = Odometry_array_wheelCorrections_wheelCorrectionFactorRearRight_available[@Odometry_Notification_wheelCorrections_Element];
  @Odometry_Notification_wheelCorrections_wheelCorrectionFactorEstimatorStatus_available           = Odometry_array_wheelCorrections_wheelCorrectionFactorEstimatorStatus_available[@Odometry_Notification_wheelCorrections_Element];
  @Odometry_Notification_wheelCorrections_wheelCorrectionFactorEstimatorStatusConfidence_available = Odometry_array_wheelCorrections_wheelCorrectionFactorEstimatorStatusConfidence_available[@Odometry_Notification_wheelCorrections_Element];
  @Odometry_Notification_wheelCorrections_wheelCorrectionFactorFrontLeftConfidence_available       = Odometry_array_wheelCorrections_wheelCorrectionFactorFrontLeftConfidence_available[@Odometry_Notification_wheelCorrections_Element];
  @Odometry_Notification_wheelCorrections_wheelCorrectionFactorFrontRightConfidence_available      = Odometry_array_wheelCorrections_wheelCorrectionFactorFrontRightConfidence_available[@Odometry_Notification_wheelCorrections_Element];
  @Odometry_Notification_wheelCorrections_wheelCorrectionFactoRearLeftConfidence_available         = Odometry_array_wheelCorrections_wheelCorrectionFactoRearLeftConfidence_available[@Odometry_Notification_wheelCorrections_Element];
  @Odometry_Notification_wheelCorrections_wheelCorrectionFactoRearRightConfidence_available        = Odometry_array_wheelCorrections_wheelCorrectionFactoRearRightConfidence_available[@Odometry_Notification_wheelCorrections_Element];
  @Odometry_Notification_wheelCorrections_wheelCircumferenceStatic_available                       = Odometry_array_wheelCorrections_wheelCircumferenceStatic_available[@Odometry_Notification_wheelCorrections_Element];
  @Odometry_Notification_wheelCorrections_wheelCircumferenceStaticConfidence_available             = Odometry_array_wheelCorrections_wheelCircumferenceStaticConfidence_available[@Odometry_Notification_wheelCorrections_Element];
}







////////// accelerations Notification //////////

on envVar Odometry_Notification_LengthIndicator_Struct_accelerations
{
  Odometry_Notification_accelerations();
}
on envVar Odometry_Notification_LengthIndicator_Element_accelerations
{
  Odometry_Notification_accelerations();
}
on envVar Odometry_Notification_accelerations_type
{
  Odometry_array_accelerations_type[@Odometry_Notification_accelerations_Element] = @this;
  Odometry_Notification_accelerations();
}
on envVar Odometry_Notification_accelerations_timestamp
{
  Odometry_array_accelerations_timestamp[@Odometry_Notification_accelerations_Element] = @this;
  Odometry_Notification_accelerations();
}
on envVar Odometry_Notification_accelerations_acceleration
{
  Odometry_array_accelerations_acceleration[@Odometry_Notification_accelerations_Element] = @this;
  Odometry_Notification_accelerations();
}
on envVar Odometry_Notification_accelerations_variance
{
  Odometry_array_accelerations_variance[@Odometry_Notification_accelerations_Element] = @this;
  Odometry_Notification_accelerations();
}
on envVar Odometry_Notification_accelerations_confidence
{
  Odometry_array_accelerations_confidence[@Odometry_Notification_accelerations_Element] = @this;
  Odometry_Notification_accelerations();
}
on envVar Odometry_Notification_accelerations_type_available
{
  Odometry_array_accelerations_type_available[@Odometry_Notification_accelerations_Element] = @this;
  Odometry_Notification_accelerations();
}
on envVar Odometry_Notification_accelerations_timestamp_available
{
  Odometry_array_accelerations_timestamp_available[@Odometry_Notification_accelerations_Element] = @this;
  Odometry_Notification_accelerations();
}
on envVar Odometry_Notification_accelerations_acceleration_available
{
  Odometry_array_accelerations_acceleration_available[@Odometry_Notification_accelerations_Element] = @this;
  Odometry_Notification_accelerations();
}
on envVar Odometry_Notification_accelerations_variance_available
{
  Odometry_array_accelerations_variance_available[@Odometry_Notification_accelerations_Element] = @this;
  Odometry_Notification_accelerations();
}
on envVar Odometry_Notification_accelerations_confidence_available
{
  Odometry_array_accelerations_confidence_available[@Odometry_Notification_accelerations_Element] = @this;
  Odometry_Notification_accelerations();
}
on envVar Odometry_Notification_accelerations_Payload
{
  Odometry_Notification_accelerations_update();
}


Odometry_Notification_accelerations()
{
  word payload_counter = 0;
  word start_pos       = 0;
  word element_length  = 0;
  
  // Length Indicator Struct - Platzhalter
  payload_counter = 0+4;
  start_pos = 0;
  
  for (j=0; j<@Odometry_Notification_accelerations_Element_TotalNum; j++)
  {
    Odometry_array_accelerations_available_functions[j] = Odometry_array_accelerations_type_available[j]
                                                        + Odometry_array_accelerations_timestamp_available[j]
                                                        + Odometry_array_accelerations_acceleration_available[j]
                                                        + Odometry_array_accelerations_variance_available[j]
                                                        + Odometry_array_accelerations_confidence_available[j];
    
    // Length Indicator Element - Platzhalter
    if (Odometry_array_accelerations_available_functions[j] > 0)
    {
      start_pos = payload_counter;
      payload_counter = payload_counter + 4;
    }
    else 
      start_pos = payload_counter;
    
    // 0 type (enum32)
    if (Odometry_array_accelerations_type_available[j] == 1)
    {
      tag_dataID = 0;
      Odometry_payload_buffer_accelerations[payload_counter++] = 2 * 16 /* Wiretype = 2  =^ 32 Bit */ + ((tag_dataID>>8) & 0x0F) /* DataID High Part */ ;
      Odometry_payload_buffer_accelerations[payload_counter++] = tag_dataID & 0xFF /* DataID Low Part */ ;
      
      Odometry_payload_buffer_accelerations[payload_counter++] = Odometry_array_accelerations_type[j]>>24 & 0xFF;
      Odometry_payload_buffer_accelerations[payload_counter++] = Odometry_array_accelerations_type[j]>>16 & 0xFF;
      Odometry_payload_buffer_accelerations[payload_counter++] = Odometry_array_accelerations_type[j]>> 8 & 0xFF;
      Odometry_payload_buffer_accelerations[payload_counter++] = Odometry_array_accelerations_type[j]     & 0xFF;
    }
    
    
    // 1 timestamp (uint64)
    if (Odometry_array_accelerations_timestamp_available[j] == 1)
    {
      tag_dataID = 1;
      Odometry_payload_buffer_accelerations[payload_counter++] = 3 * 16 /* Wiretype = 3  =^ 64 Bit */ + ((tag_dataID>>8) & 0x0F) /* DataID High Part */ ;
      Odometry_payload_buffer_accelerations[payload_counter++] = tag_dataID & 0xFF /* DataID Low Part */ ;
      
      temp_64bit_low  = Odometry_array_accelerations_timestamp[j]     & 0x00000000FFFFFFFF;
      temp_64bit_high = Odometry_array_accelerations_timestamp[j]>>32 & 0x00000000FFFFFFFF;
      
      Odometry_payload_buffer_accelerations[payload_counter++] = temp_64bit_high>>24 & 0xFF;
      Odometry_payload_buffer_accelerations[payload_counter++] = temp_64bit_high>>16 & 0xFF;
      Odometry_payload_buffer_accelerations[payload_counter++] = temp_64bit_high>> 8 & 0xFF;
      Odometry_payload_buffer_accelerations[payload_counter++] = temp_64bit_high     & 0xFF;
      Odometry_payload_buffer_accelerations[payload_counter++] = temp_64bit_low>>24  & 0xFF;
      Odometry_payload_buffer_accelerations[payload_counter++] = temp_64bit_low>>16  & 0xFF;
      Odometry_payload_buffer_accelerations[payload_counter++] = temp_64bit_low>> 8  & 0xFF;
      Odometry_payload_buffer_accelerations[payload_counter++] = temp_64bit_low      & 0xFF;
    }
    
    
    // 2 acceleration (float32)
    if (Odometry_array_accelerations_acceleration_available[j] == 1)
    {
      tag_dataID = 2;
      Odometry_payload_buffer_accelerations[payload_counter++] = 2 * 16 /* Wiretype = 2  =^ 32 Bit */ + ((tag_dataID>>8) & 0x0F) /* DataID High Part */ ;
      Odometry_payload_buffer_accelerations[payload_counter++] = tag_dataID & 0xFF /* DataID Low Part */ ;
      
      temp_converttodword = interpretAsDword (Odometry_array_accelerations_acceleration[j]);
      Odometry_payload_buffer_accelerations[payload_counter++] = temp_converttodword>>24 & 0xFF;
      Odometry_payload_buffer_accelerations[payload_counter++] = temp_converttodword>>16 & 0xFF;
      Odometry_payload_buffer_accelerations[payload_counter++] = temp_converttodword>> 8 & 0xFF;
      Odometry_payload_buffer_accelerations[payload_counter++] = temp_converttodword     & 0xFF;
    }
    
    
    // 3 variance (float32)
    if (Odometry_array_accelerations_variance_available[j] == 1)
    {
      tag_dataID = 3;
      Odometry_payload_buffer_accelerations[payload_counter++] = 2 * 16 /* Wiretype = 2  =^ 32 Bit */ + ((tag_dataID>>8) & 0x0F) /* DataID High Part */ ;
      Odometry_payload_buffer_accelerations[payload_counter++] = tag_dataID & 0xFF /* DataID Low Part */ ;
      
      temp_converttodword = interpretAsDword (Odometry_array_accelerations_variance[j]);
      Odometry_payload_buffer_accelerations[payload_counter++] = temp_converttodword>>24 & 0xFF;
      Odometry_payload_buffer_accelerations[payload_counter++] = temp_converttodword>>16 & 0xFF;
      Odometry_payload_buffer_accelerations[payload_counter++] = temp_converttodword>> 8 & 0xFF;
      Odometry_payload_buffer_accelerations[payload_counter++] = temp_converttodword     & 0xFF;
    }
    
    
    // 4 confidence (enum32)
    if (Odometry_array_accelerations_confidence_available[j] == 1)
    {
      tag_dataID = 4;
      Odometry_payload_buffer_accelerations[payload_counter++] = 2 * 16 /* Wiretype = 2  =^ 32 Bit */ + ((tag_dataID>>8) & 0x0F) /* DataID High Part */ ;
      Odometry_payload_buffer_accelerations[payload_counter++] = tag_dataID & 0xFF /* DataID Low Part */ ;
      
      Odometry_payload_buffer_accelerations[payload_counter++] = Odometry_array_accelerations_confidence[j]>>24 & 0xFF;
      Odometry_payload_buffer_accelerations[payload_counter++] = Odometry_array_accelerations_confidence[j]>>16 & 0xFF;
      Odometry_payload_buffer_accelerations[payload_counter++] = Odometry_array_accelerations_confidence[j]>> 8 & 0xFF;
      Odometry_payload_buffer_accelerations[payload_counter++] = Odometry_array_accelerations_confidence[j]     & 0xFF;
    }
    
    //Element Length
    element_length = payload_counter-start_pos;
    if (element_length >0) Odometry_array_accelerations_array_element_length[j] = element_length - 4;
    else                   Odometry_array_accelerations_array_element_length[j] = element_length;
    
    Odometry_payload_buffer_accelerations[start_pos++] = Odometry_array_accelerations_array_element_length[j]>>24 & 0xFF;
    Odometry_payload_buffer_accelerations[start_pos++] = Odometry_array_accelerations_array_element_length[j]>>16 & 0xFF;
    Odometry_payload_buffer_accelerations[start_pos++] = Odometry_array_accelerations_array_element_length[j]>> 8 & 0xFF;
    Odometry_payload_buffer_accelerations[start_pos++] = Odometry_array_accelerations_array_element_length[j]     & 0xFF;
    
    if (Odometry_array_accelerations_array_element_length[j] == 0) payload_counter = payload_counter+4;
  }
  
  // Struct Length
  Odometry_array_accelerations_struct_element_length = 4*@Odometry_Notification_accelerations_Element_TotalNum;

  for (k=0;k<@Odometry_Notification_accelerations_Element_TotalNum;k++)
   Odometry_array_accelerations_struct_element_length = Odometry_array_accelerations_struct_element_length + Odometry_array_accelerations_array_element_length[k];
  
  Odometry_payload_buffer_accelerations[0] = Odometry_array_accelerations_struct_element_length>>24 & 0xFF;
  Odometry_payload_buffer_accelerations[1] = Odometry_array_accelerations_struct_element_length>>16 & 0xFF;
  Odometry_payload_buffer_accelerations[2] = Odometry_array_accelerations_struct_element_length>> 8 & 0xFF;
  Odometry_payload_buffer_accelerations[3] = Odometry_array_accelerations_struct_element_length     & 0xFF;


  Odometry_payload_length_accelerations = Odometry_array_accelerations_struct_element_length+4;
  putvalue(Odometry_Notification_accelerations_Payload, Odometry_payload_buffer_accelerations, Odometry_payload_length_accelerations);
}

on envVar Odometry_Notification_accelerations_Element_TotalNum
{
  if (@this == 0) @this =  1;
  if (@this > 10) @this = 10;
  
  Odometry_Notification_accelerations();
  Odometry_Notification_accelerations_update();
}

on envVar Odometry_Notification_accelerations_Element
{
  Odometry_Notification_accelerations_update();
}

on envVar Odometry_Notification_accelerations_Element_Next
{
  if (@this == 1 && @Odometry_Notification_accelerations_Element < @Odometry_Notification_accelerations_Element_TotalNum - 1)
  {
    @Odometry_Notification_accelerations_Element = @Odometry_Notification_accelerations_Element + 1;
    Odometry_Notification_accelerations_update();
  }
}

on envVar Odometry_Notification_accelerations_Element_Previous
{
  if (@this == 1 && @Odometry_Notification_accelerations_Element > 0)
  {
    @Odometry_Notification_accelerations_Element = @Odometry_Notification_accelerations_Element - 1;
    Odometry_Notification_accelerations_update();
  }
}

Odometry_Notification_accelerations_update()
{
  @Odometry_Notification_LengthIndicator_Element_accelerations = Odometry_array_accelerations_array_element_length[@Odometry_Notification_accelerations_Element];
  @Odometry_Notification_LengthIndicator_Struct_accelerations  = Odometry_array_accelerations_struct_element_length;
  @Odometry_Notification_Length_accelerations                  = Odometry_payload_length_accelerations+8;
  
  @Odometry_Notification_accelerations_type         = Odometry_array_accelerations_type[@Odometry_Notification_accelerations_Element];
  @Odometry_Notification_accelerations_timestamp    = Odometry_array_accelerations_timestamp[@Odometry_Notification_accelerations_Element];
  @Odometry_Notification_accelerations_acceleration = Odometry_array_accelerations_acceleration[@Odometry_Notification_accelerations_Element];
  @Odometry_Notification_accelerations_variance     = Odometry_array_accelerations_variance[@Odometry_Notification_accelerations_Element];
  @Odometry_Notification_accelerations_confidence   = Odometry_array_accelerations_confidence[@Odometry_Notification_accelerations_Element];
  
  @Odometry_Notification_accelerations_type_available         = Odometry_array_accelerations_type_available[@Odometry_Notification_accelerations_Element];
  @Odometry_Notification_accelerations_timestamp_available    = Odometry_array_accelerations_timestamp_available[@Odometry_Notification_accelerations_Element];
  @Odometry_Notification_accelerations_acceleration_available = Odometry_array_accelerations_acceleration_available[@Odometry_Notification_accelerations_Element];
  @Odometry_Notification_accelerations_variance_available     = Odometry_array_accelerations_variance_available[@Odometry_Notification_accelerations_Element];
  @Odometry_Notification_accelerations_confidence_available   = Odometry_array_accelerations_confidence_available[@Odometry_Notification_accelerations_Element];
}






////////// angularRates Notification //////////

on envVar Odometry_Notification_LengthIndicator_Struct_angularRates
{
  Odometry_Notification_angularRates();
}
on envVar Odometry_Notification_LengthIndicator_Element_angularRates
{
  Odometry_Notification_angularRates();
}
on envVar Odometry_Notification_angularRates_type
{
  Odometry_array_angularRates_type[@Odometry_Notification_angularRates_Element] = @this;
  Odometry_Notification_angularRates();
}
on envVar Odometry_Notification_angularRates_timestamp
{
  Odometry_array_angularRates_timestamp[@Odometry_Notification_angularRates_Element] = @this;
  Odometry_Notification_angularRates();
}
on envVar Odometry_Notification_angularRates_angularrate
{
  Odometry_array_angularRates_angularrate[@Odometry_Notification_angularRates_Element] = @this;
  Odometry_Notification_angularRates();
}
on envVar Odometry_Notification_angularRates_variance
{
  Odometry_array_angularRates_variance[@Odometry_Notification_angularRates_Element] = @this;
  Odometry_Notification_angularRates();
}
on envVar Odometry_Notification_angularRates_confidence
{
  Odometry_array_angularRates_confidence[@Odometry_Notification_angularRates_Element] = @this;
  Odometry_Notification_angularRates();
}
on envVar Odometry_Notification_angularRates_type_available
{
  Odometry_array_angularRates_type_available[@Odometry_Notification_angularRates_Element] = @this;
  Odometry_Notification_angularRates();
}
on envVar Odometry_Notification_angularRates_timestamp_available
{
  Odometry_array_angularRates_timestamp_available[@Odometry_Notification_angularRates_Element] = @this;
  Odometry_Notification_angularRates();
}
on envVar Odometry_Notification_angularRates_angularrate_available
{
  Odometry_array_angularRates_angularrate_available[@Odometry_Notification_angularRates_Element] = @this;
  Odometry_Notification_angularRates();
}
on envVar Odometry_Notification_angularRates_variance_available
{
  Odometry_array_angularRates_variance_available[@Odometry_Notification_angularRates_Element] = @this;
  Odometry_Notification_angularRates();
}
on envVar Odometry_Notification_angularRates_confidence_available
{
  Odometry_array_angularRates_confidence_available[@Odometry_Notification_angularRates_Element] = @this;
  Odometry_Notification_angularRates();
}
on envVar Odometry_Notification_angularRates_Payload
{
  Odometry_Notification_angularRates_update();
}


Odometry_Notification_angularRates()
{
  word payload_counter = 0;
  word start_pos       = 0;
  word element_length  = 0;
  
  // Length Indicator Struct - Platzhalter
  payload_counter = 0+4;
  start_pos = 0;
  
  for (j=0; j<@Odometry_Notification_angularRates_Element_TotalNum; j++)
  {
    Odometry_array_angularRates_available_functions[j] = Odometry_array_angularRates_type_available[j]
                                                       + Odometry_array_angularRates_timestamp_available[j]
                                                       + Odometry_array_angularRates_angularrate_available[j]
                                                       + Odometry_array_angularRates_variance_available[j]
                                                       + Odometry_array_angularRates_confidence_available[j];
    
    // Length Indicator Element - Platzhalter
    if (Odometry_array_angularRates_available_functions[j] > 0)
    {
      start_pos = payload_counter;
      payload_counter = payload_counter + 4;
    }
    else 
      start_pos = payload_counter;
    
    
    // 0 type (enum32)
    if (Odometry_array_angularRates_type_available[j] == 1)
    {
      tag_dataID = 0;
      Odometry_payload_buffer_angularRates[payload_counter++] = 2 * 16 /* Wiretype = 2  =^ 32 Bit */ + ((tag_dataID>>8) & 0x0F) /* DataID High Part */ ;
      Odometry_payload_buffer_angularRates[payload_counter++] = tag_dataID & 0xFF /* DataID Low Part */ ;
      
      Odometry_payload_buffer_angularRates[payload_counter++] = Odometry_array_angularRates_type[j]>>24 & 0xFF;
      Odometry_payload_buffer_angularRates[payload_counter++] = Odometry_array_angularRates_type[j]>>16 & 0xFF;
      Odometry_payload_buffer_angularRates[payload_counter++] = Odometry_array_angularRates_type[j]>> 8 & 0xFF;
      Odometry_payload_buffer_angularRates[payload_counter++] = Odometry_array_angularRates_type[j]     & 0xFF;
    }
    
                                                                                                 
    // 1 timestamp (uint64)
    if (Odometry_array_angularRates_timestamp_available[j] == 1)
    {
      tag_dataID = 1;                                                                              
      Odometry_payload_buffer_angularRates[payload_counter++] = 3 * 16 /* Wiretype = 3  =^ 64 Bit */ + ((tag_dataID>>8) & 0x0F) /* DataID High Part */ ;
      Odometry_payload_buffer_angularRates[payload_counter++] = tag_dataID & 0xFF /* DataID Low Part */ ;
      
      temp_64bit_low  = Odometry_array_angularRates_timestamp[j]     & 0x00000000FFFFFFFF;
      temp_64bit_high = Odometry_array_angularRates_timestamp[j]>>32 & 0x00000000FFFFFFFF;
      
      Odometry_payload_buffer_angularRates[payload_counter++] = temp_64bit_high>>24 & 0xFF;
      Odometry_payload_buffer_angularRates[payload_counter++] = temp_64bit_high>>16 & 0xFF;
      Odometry_payload_buffer_angularRates[payload_counter++] = temp_64bit_high>> 8 & 0xFF;
      Odometry_payload_buffer_angularRates[payload_counter++] = temp_64bit_high     & 0xFF;
      Odometry_payload_buffer_angularRates[payload_counter++] = temp_64bit_low>>24  & 0xFF;
      Odometry_payload_buffer_angularRates[payload_counter++] = temp_64bit_low>>16  & 0xFF;
      Odometry_payload_buffer_angularRates[payload_counter++] = temp_64bit_low>> 8  & 0xFF;
      Odometry_payload_buffer_angularRates[payload_counter++] = temp_64bit_low      & 0xFF;
    }
    
    
    // 2 angularrate (float32)
    if (Odometry_array_angularRates_angularrate_available[j] == 1)
    {
      tag_dataID = 2;
      Odometry_payload_buffer_angularRates[payload_counter++] = 2 * 16 /* Wiretype = 2  =^ 32 Bit */ + ((tag_dataID>>8) & 0x0F) /* DataID High Part */ ;
      Odometry_payload_buffer_angularRates[payload_counter++] = tag_dataID & 0xFF /* DataID Low Part */ ;
      
      temp_converttodword = interpretAsDword (Odometry_array_angularRates_angularrate[j]);
      Odometry_payload_buffer_angularRates[payload_counter++] = temp_converttodword>>24 & 0xFF;
      Odometry_payload_buffer_angularRates[payload_counter++] = temp_converttodword>>16 & 0xFF;
      Odometry_payload_buffer_angularRates[payload_counter++] = temp_converttodword>> 8 & 0xFF;
      Odometry_payload_buffer_angularRates[payload_counter++] = temp_converttodword     & 0xFF;
    }
    
    
    // 3 variance (float32)
    if (Odometry_array_angularRates_variance_available[j] == 1)
    {
      tag_dataID = 3;
      Odometry_payload_buffer_angularRates[payload_counter++] = 2 * 16 /* Wiretype = 2  =^ 32 Bit */ + ((tag_dataID>>8) & 0x0F) /* DataID High Part */ ;
      Odometry_payload_buffer_angularRates[payload_counter++] = tag_dataID & 0xFF /* DataID Low Part */ ;
      
      temp_converttodword = interpretAsDword (Odometry_array_angularRates_variance[j]);
      Odometry_payload_buffer_angularRates[payload_counter++] = temp_converttodword>>24 & 0xFF;
      Odometry_payload_buffer_angularRates[payload_counter++] = temp_converttodword>>16 & 0xFF;
      Odometry_payload_buffer_angularRates[payload_counter++] = temp_converttodword>> 8 & 0xFF;
      Odometry_payload_buffer_angularRates[payload_counter++] = temp_converttodword     & 0xFF;
    }
    
    
    // 4 confidence (enum32)
    if (Odometry_array_angularRates_confidence_available[j] == 1)
    {
      tag_dataID = 4;
      Odometry_payload_buffer_angularRates[payload_counter++] = 2 * 16 /* Wiretype = 2  =^ 32 Bit */ + ((tag_dataID>>8) & 0x0F) /* DataID High Part */ ;
      Odometry_payload_buffer_angularRates[payload_counter++] = tag_dataID & 0xFF /* DataID Low Part */ ;
      
      Odometry_payload_buffer_angularRates[payload_counter++] = Odometry_array_angularRates_confidence[j]>>24 & 0xFF;
      Odometry_payload_buffer_angularRates[payload_counter++] = Odometry_array_angularRates_confidence[j]>>16 & 0xFF;
      Odometry_payload_buffer_angularRates[payload_counter++] = Odometry_array_angularRates_confidence[j]>> 8 & 0xFF;
      Odometry_payload_buffer_angularRates[payload_counter++] = Odometry_array_angularRates_confidence[j]     & 0xFF;
    }
    
    
    //Element Length
    element_length = payload_counter-start_pos;
    if (element_length >0) Odometry_array_angularRates_array_element_length[j] = element_length - 4;
    else                   Odometry_array_angularRates_array_element_length[j] = element_length;
    
    Odometry_payload_buffer_angularRates[start_pos++] = Odometry_array_angularRates_array_element_length[j]>>24 & 0xFF;
    Odometry_payload_buffer_angularRates[start_pos++] = Odometry_array_angularRates_array_element_length[j]>>16 & 0xFF;
    Odometry_payload_buffer_angularRates[start_pos++] = Odometry_array_angularRates_array_element_length[j]>> 8 & 0xFF;
    Odometry_payload_buffer_angularRates[start_pos++] = Odometry_array_angularRates_array_element_length[j]     & 0xFF;
    
    if (Odometry_array_angularRates_array_element_length[j] == 0) payload_counter = payload_counter+4;
  }
  
  // Struct Length
  Odometry_array_angularRates_struct_element_length = 4*@Odometry_Notification_angularRates_Element_TotalNum;

  for (k=0;k<@Odometry_Notification_angularRates_Element_TotalNum;k++)
   Odometry_array_angularRates_struct_element_length = Odometry_array_angularRates_struct_element_length + Odometry_array_angularRates_array_element_length[k];
  
  Odometry_payload_buffer_angularRates[0] = Odometry_array_angularRates_struct_element_length>>24 & 0xFF;
  Odometry_payload_buffer_angularRates[1] = Odometry_array_angularRates_struct_element_length>>16 & 0xFF;
  Odometry_payload_buffer_angularRates[2] = Odometry_array_angularRates_struct_element_length>> 8 & 0xFF;
  Odometry_payload_buffer_angularRates[3] = Odometry_array_angularRates_struct_element_length     & 0xFF;


  Odometry_payload_length_angularRates = Odometry_array_angularRates_struct_element_length+4;
  putvalue(Odometry_Notification_angularRates_Payload, Odometry_payload_buffer_angularRates, Odometry_payload_length_angularRates);
}

on envVar Odometry_Notification_angularRates_Element_TotalNum
{
  if (@this == 0) @this =  1;
  if (@this > 10) @this = 10;
  
  Odometry_Notification_angularRates();
  Odometry_Notification_angularRates_update();
}

on envVar Odometry_Notification_angularRates_Element
{
  Odometry_Notification_angularRates_update();
}

on envVar Odometry_Notification_angularRates_Element_Next
{
  if (@this == 1 && @Odometry_Notification_angularRates_Element < @Odometry_Notification_angularRates_Element_TotalNum - 1)
  {
    @Odometry_Notification_angularRates_Element = @Odometry_Notification_angularRates_Element + 1;
    Odometry_Notification_angularRates_update();
  }
}

on envVar Odometry_Notification_angularRates_Element_Previous
{
  if (@this == 1 && @Odometry_Notification_angularRates_Element > 0)
  {
    @Odometry_Notification_angularRates_Element = @Odometry_Notification_angularRates_Element - 1;
    Odometry_Notification_angularRates_update();
  }
}

Odometry_Notification_angularRates_update()
{
  @Odometry_Notification_LengthIndicator_Element_angularRates = Odometry_array_angularRates_array_element_length[@Odometry_Notification_angularRates_Element];
  @Odometry_Notification_LengthIndicator_Struct_angularRates  = Odometry_array_angularRates_struct_element_length;
  @Odometry_Notification_Length_angularRates                  = Odometry_payload_length_angularRates+8;
  
  @Odometry_Notification_angularRates_type        = Odometry_array_angularRates_type[@Odometry_Notification_angularRates_Element];
  @Odometry_Notification_angularRates_timestamp   = Odometry_array_angularRates_timestamp[@Odometry_Notification_angularRates_Element];
  @Odometry_Notification_angularRates_angularrate = Odometry_array_angularRates_angularrate[@Odometry_Notification_angularRates_Element];
  @Odometry_Notification_angularRates_variance    = Odometry_array_angularRates_variance[@Odometry_Notification_angularRates_Element];
  @Odometry_Notification_angularRates_confidence  = Odometry_array_angularRates_confidence[@Odometry_Notification_angularRates_Element];
  
  @Odometry_Notification_angularRates_type_available        = Odometry_array_angularRates_type_available[@Odometry_Notification_angularRates_Element];
  @Odometry_Notification_angularRates_timestamp_available   = Odometry_array_angularRates_timestamp_available[@Odometry_Notification_angularRates_Element];
  @Odometry_Notification_angularRates_angularrate_available = Odometry_array_angularRates_angularrate_available[@Odometry_Notification_angularRates_Element];
  @Odometry_Notification_angularRates_variance_available    = Odometry_array_angularRates_variance_available[@Odometry_Notification_angularRates_Element];
  @Odometry_Notification_angularRates_confidence_available  = Odometry_array_angularRates_confidence_available[@Odometry_Notification_angularRates_Element];
}







//////////////////////////////////////////////////////////////
////////////////// Service OccupantPresence //////////////////
//////////////////////////////////////////////////////////////

on envVar ServiceDiscovery_Offer_Service_OccupantPresence
{
  Send_ServiceDiscovery_Offer_Service_ICAS1Gateway();
}

on envVar OccupantPresence_Notification_driverPresenceStatus_Send
{
  if (@this == 1)
  {
    UDP_Segments_total = @OccupantPresence_Notification_Length_driverPresenceStatus/1404 + 1;
    UDP_Segments_left  = UDP_Segments_total;
    
    if (UDP_Segments_total > 1) seg_id_flag = 1;
    else                        seg_id_flag = 0;
    
    Send_Service_OccupantPresence_Notification (0xC010 & 0x0000FFFF);
  }
}
on envVar OccupantPresence_Notification_driverPresenceStatus_Send_cyclic
{
  if (@this == 1)
    setTimercyclic (tOccupantPresence_Notification_driverPresenceStatus_Send, @OccupantPresence_Notification_driverPresenceStatus_Send_cyclic_cycletime);
  else
    cancelTimer (tOccupantPresence_Notification_driverPresenceStatus_Send);
}
on envVar OccupantPresence_Notification_driverPresenceStatus_Send_cyclic_cycletime
{
  if (@OccupantPresence_Notification_driverPresenceStatus_Send_cyclic == 1)
  {
    cancelTimer (tOccupantPresence_Notification_driverPresenceStatus_Send);
    setTimercyclic (tOccupantPresence_Notification_driverPresenceStatus_Send, @this);
  }
}
on timer tOccupantPresence_Notification_driverPresenceStatus_Send
{
  UDP_Segments_total = @OccupantPresence_Notification_Length_driverPresenceStatus/1404 + 1;
  UDP_Segments_left  = UDP_Segments_total;
  
  if (UDP_Segments_total > 1) seg_id_flag = 1;
  else                        seg_id_flag = 0;
    
  Send_Service_OccupantPresence_Notification (0xC010 & 0x0000FFFF);
}

on envVar OccupantPresence_Notification_occupantPresenceStatus_Send
{
  if (@this == 1)
  {
    UDP_Segments_total = @OccupantPresence_Notification_Length_occupantPresenceStatus/1404 + 1;
    UDP_Segments_left  = UDP_Segments_total;
    
    if (UDP_Segments_total > 1) seg_id_flag = 1;
    else                        seg_id_flag = 0;
    
    Send_Service_OccupantPresence_Notification (0xC020 & 0x0000FFFF);
  }
}
on envVar OccupantPresence_Notification_occupantPresenceStatus_Send_cyclic
{
  if (@this == 1)
    setTimercyclic (tOccupantPresence_Notification_occupantPresenceStatus_Send, @OccupantPresence_Notification_occupantPresenceStatus_Send_cyclic_cycletime);
  else
    cancelTimer (tOccupantPresence_Notification_occupantPresenceStatus_Send);
}
on envVar OccupantPresence_Notification_occupantPresenceStatus_Send_cyclic_cycletime
{
  if (@OccupantPresence_Notification_occupantPresenceStatus_Send_cyclic == 1)
  {
    cancelTimer (tOccupantPresence_Notification_occupantPresenceStatus_Send);
    setTimercyclic (tOccupantPresence_Notification_occupantPresenceStatus_Send, @this);
  }
}
on timer tOccupantPresence_Notification_occupantPresenceStatus_Send
{
  UDP_Segments_total = @OccupantPresence_Notification_Length_occupantPresenceStatus/1404 + 1;
  UDP_Segments_left  = UDP_Segments_total;
  
  if (UDP_Segments_total > 1) seg_id_flag = 1;
  else                        seg_id_flag = 0;
    
  Send_Service_OccupantPresence_Notification (0xC020 & 0x0000FFFF);
}


Send_Service_OccupantPresence_Notification (word MethodID)
{
  ethernetPacket EthPaket;

  // Ethernet Packet - MAC Source address
  getvalue (ServiceDiscovery_EthernetPacket_MAC_Source_ICAS1Gateway, buffer_MAC);
  //EthPaket.source.ParseAddress ( buffer_MAC );
  EthPaket.source = ethGetMacAddressAsNumber (buffer_MAC);
  
  // Ethernet Packet - MAC Destination address
  getvalue (ServiceDiscovery_EthernetPacket_MAC_Destination, buffer_MAC);
  //EthPaket.destination.ParseAddress ( buffer_MAC );
  EthPaket.destination = ethGetMacAddressAsNumber (buffer_MAC);
  
  // Ethernet Packet - VLAN
  EthPaket.SetVlan (@ServiceDiscovery_EthernetPacket_VLAN_TPID, @ServiceDiscovery_EthernetPacket_VLAN_TCI);
  
  // Ethernet Packet - Type
  //EthPaket.ipv6.type = @EthernetPacket_Type;
  if (@ServiceDiscovery_EthernetPacket_Type == 0x86DD) EthPaket.ipv6.Init();
  
  
  // IPv6 Packet - Version
  EthPaket.ipv6.version = @ServiceDiscovery_IPv6Packet_Version;

  // IPv6 Packet - Traffic Class
  EthPaket.ipv6.class = @ServiceDiscovery_IPv6Packet_Traffic_Class;
  
  // IPv6 Packet - Flow Label
  EthPaket.ipv6.flow = @ServiceDiscovery_IPv6Packet_Flow_Label;
  
  // IPv6 Packet - Payload_Length
  EthPaket.ipv6.length = @ServiceDiscovery_IPv6Packet_Payload_Length;
  
  // IPv6 Packet - Next Header
  EthPaket.ipv6.next = @ServiceDiscovery_IPv6Packet_Next_Header;
  if (@ServiceDiscovery_IPv6Packet_Next_Header == 6) EthPaket.tcp.Init();
  if (@ServiceDiscovery_IPv6Packet_Next_Header == 17) EthPaket.udp.Init();
  
  // IPv6 Packet - Hop Limit
  EthPaket.ipv6.hopLimit = @ServiceDiscovery_IPv6Packet_Hop_Limit;

  // IPv6 Packet - IPv6 Destination address    // TODO: char array zu byte array
  buffer_ipv6[0]  = @ServiceDiscovery_IPv6Packet_IP_Destination_Unicast_01>>8 & 0xFF;
  buffer_ipv6[1]  = @ServiceDiscovery_IPv6Packet_IP_Destination_Unicast_01    & 0xFF;
  buffer_ipv6[2]  = @ServiceDiscovery_IPv6Packet_IP_Destination_Unicast_02>>8 & 0xFF;
  buffer_ipv6[3]  = @ServiceDiscovery_IPv6Packet_IP_Destination_Unicast_02    & 0xFF;
  buffer_ipv6[4]  = @ServiceDiscovery_IPv6Packet_IP_Destination_Unicast_03>>8 & 0xFF;
  buffer_ipv6[5]  = @ServiceDiscovery_IPv6Packet_IP_Destination_Unicast_03    & 0xFF;
  buffer_ipv6[6]  = @ServiceDiscovery_IPv6Packet_IP_Destination_Unicast_04>>8 & 0xFF;
  buffer_ipv6[7]  = @ServiceDiscovery_IPv6Packet_IP_Destination_Unicast_04    & 0xFF;
  buffer_ipv6[8]  = @ServiceDiscovery_IPv6Packet_IP_Destination_Unicast_05>>8 & 0xFF;
  buffer_ipv6[9]  = @ServiceDiscovery_IPv6Packet_IP_Destination_Unicast_05    & 0xFF;
  buffer_ipv6[10] = @ServiceDiscovery_IPv6Packet_IP_Destination_Unicast_06>>8 & 0xFF;
  buffer_ipv6[11] = @ServiceDiscovery_IPv6Packet_IP_Destination_Unicast_06    & 0xFF;
  buffer_ipv6[12] = @ServiceDiscovery_IPv6Packet_IP_Destination_Unicast_07>>8 & 0xFF;
  buffer_ipv6[13] = @ServiceDiscovery_IPv6Packet_IP_Destination_Unicast_07    & 0xFF;
  buffer_ipv6[14] = @ServiceDiscovery_IPv6Packet_IP_Destination_Unicast_08>>8 & 0xFF;
  buffer_ipv6[15] = @ServiceDiscovery_IPv6Packet_IP_Destination_Unicast_08    & 0xFF;
  EthPaket.ipv6.destination.SetData ( 0, buffer_ipv6, elcount(buffer_ipv6) );

  // IPv6 Packet - IPv6 Source address    // TODO: char array zu byte array
  buffer_ipv6[0]  = @ServiceDiscovery_IPv6Packet_IP_Source_ICAS1Gateway_01>>8 & 0xFF;
  buffer_ipv6[1]  = @ServiceDiscovery_IPv6Packet_IP_Source_ICAS1Gateway_01    & 0xFF;
  buffer_ipv6[2]  = @ServiceDiscovery_IPv6Packet_IP_Source_ICAS1Gateway_02>>8 & 0xFF;
  buffer_ipv6[3]  = @ServiceDiscovery_IPv6Packet_IP_Source_ICAS1Gateway_02    & 0xFF;
  buffer_ipv6[4]  = @ServiceDiscovery_IPv6Packet_IP_Source_ICAS1Gateway_03>>8 & 0xFF;
  buffer_ipv6[5]  = @ServiceDiscovery_IPv6Packet_IP_Source_ICAS1Gateway_03    & 0xFF;
  buffer_ipv6[6]  = @ServiceDiscovery_IPv6Packet_IP_Source_ICAS1Gateway_04>>8 & 0xFF;
  buffer_ipv6[7]  = @ServiceDiscovery_IPv6Packet_IP_Source_ICAS1Gateway_04    & 0xFF;
  buffer_ipv6[8]  = @ServiceDiscovery_IPv6Packet_IP_Source_ICAS1Gateway_05>>8 & 0xFF;
  buffer_ipv6[9]  = @ServiceDiscovery_IPv6Packet_IP_Source_ICAS1Gateway_05    & 0xFF;
  buffer_ipv6[10] = @ServiceDiscovery_IPv6Packet_IP_Source_ICAS1Gateway_06>>8 & 0xFF;
  buffer_ipv6[11] = @ServiceDiscovery_IPv6Packet_IP_Source_ICAS1Gateway_06    & 0xFF;
  buffer_ipv6[12] = @ServiceDiscovery_IPv6Packet_IP_Source_ICAS1Gateway_07>>8 & 0xFF;
  buffer_ipv6[13] = @ServiceDiscovery_IPv6Packet_IP_Source_ICAS1Gateway_07    & 0xFF;
  buffer_ipv6[14] = @ServiceDiscovery_IPv6Packet_IP_Source_ICAS1Gateway_08>>8 & 0xFF;
  buffer_ipv6[15] = @ServiceDiscovery_IPv6Packet_IP_Source_ICAS1Gateway_08    & 0xFF;
  EthPaket.ipv6.source.SetData ( 0, buffer_ipv6, elcount(buffer_ipv6) );

  
  // UDP Packet - Source Port
  EthPaket.udp.source = @OccupantPresence_Notification_Port_Source;
  
  // UDP Packet - Destination Port
  EthPaket.udp.destination = @OccupantPresence_Notification_Port_Destination;
  
  // UDP Packet - Length
  EthPaket.udp.length = @ServiceDiscovery_UDPPacket_Length;
  
  
  // SOME/IP Packet aus Rohdaten zusammenbauen (buffer array)
  i=0;
  
  // SOME/IP Packet - Message ID, Service ID [16 bit]
  buffer[i++] = @OccupantPresence_Notification_Message_ID_Service_ID>>8 & 0xFF;
  buffer[i++] = @OccupantPresence_Notification_Message_ID_Service_ID    & 0xFF;
  
  // SOME/IP Packet - Message ID, Message ID [16 bit]
  switch (MethodID)
  {
    case 0xC010: @OccupantPresence_Notification_Message_ID_Method_ID = @OccupantPresence_Notification_Message_ID_Method_ID_driverPresenceStatus; break;
    case 0xC020: @OccupantPresence_Notification_Message_ID_Method_ID = @OccupantPresence_Notification_Message_ID_Method_ID_occupantPresenceStatus; break;
  }
  buffer[i++] = @OccupantPresence_Notification_Message_ID_Method_ID>>8 & 0xFF;
  buffer[i++] = @OccupantPresence_Notification_Message_ID_Method_ID    & 0xFF;
  
  // SOME/IP Packet - Length [32 bit]
  if (UDP_Segments_total == 1)
  {
    switch (MethodID)
    {
      case 0xC010: @OccupantPresence_Notification_Length = @OccupantPresence_Notification_Length_driverPresenceStatus; break;
      case 0xC020: @OccupantPresence_Notification_Length = @OccupantPresence_Notification_Length_occupantPresenceStatus; break;
    }
  }
  else
  {
    if (UDP_Segments_left > 1)
    {
      switch (MethodID)
      {
        case 0xC010: @OccupantPresence_Notification_Length = 1404; break;
        case 0xC020: @OccupantPresence_Notification_Length = 1404; break;
      }
    }
    else
    {
      switch (MethodID)
      {
        case 0xC010: @OccupantPresence_Notification_Length = OccupantPresence_payload_length_driverPresenceStatus   - 1404*(UDP_Segments_total-UDP_Segments_left) + 24; break;
        case 0xC020: @OccupantPresence_Notification_Length = OccupantPresence_payload_length_occupantPresenceStatus - 1404*(UDP_Segments_total-UDP_Segments_left) + 24; break;
      }
    }
  }
  buffer[i++] = @OccupantPresence_Notification_Length>>24 & 0xFF;
  buffer[i++] = @OccupantPresence_Notification_Length>>16 & 0xFF;
  buffer[i++] = @OccupantPresence_Notification_Length>> 8 & 0xFF;
  buffer[i++] = @OccupantPresence_Notification_Length     & 0xFF;
  
  // SOME/IP Packet - Request ID, Client ID [16 bit]
  buffer[i++] = @OccupantPresence_Notification_Request_ID_Client_ID>>8 & 0xFF;
  buffer[i++] = @OccupantPresence_Notification_Request_ID_Client_ID    & 0xFF;
  
  // SOME/IP Packet - Request ID, Session ID) [16 bit]
  if ((UDP_Segments_total == 1) || (seg_id_flag == 1))
  {
    @ServiceDiscovery_SOMEIPPacket_Notification_Request_ID_Session_ID = @ServiceDiscovery_SOMEIPPacket_Notification_Request_ID_Session_ID + 1;
    if (@ServiceDiscovery_SOMEIPPacket_Notification_Request_ID_Session_ID == 0x10000) @ServiceDiscovery_SOMEIPPacket_Notification_Request_ID_Session_ID = 1;
    seg_id_flag = 0;
  }
  
  buffer[i++] = @ServiceDiscovery_SOMEIPPacket_Notification_Request_ID_Session_ID>>8 & 0xFF;
  buffer[i++] = @ServiceDiscovery_SOMEIPPacket_Notification_Request_ID_Session_ID    & 0xFF;
  
  // SOME/IP Packet - Protocol Version [8 bit]
  buffer[i++] = @OccupantPresence_Notification_Protocol_Version;
  
  // SOME/IP Packet - Interface Version [8 bit]
  buffer[i++] = @OccupantPresence_Notification_Interface_Version;
  
  // SOME/IP Packet - Message Type [8 bit]
  buffer[i++] = @OccupantPresence_Notification_Message_Type;
  
  // SOME/IP Packet - Return Code [8 bit]
  buffer[i++] = @OccupantPresence_Notification_Return_Code;
  
  
  if (UDP_Segments_total > 1)
  {
    if (UDP_Segments_left >= 0)
    { 
      // Message Type neu setzen
      buffer[i-2] = @OccupantPresence_Notification_Message_Type + 0x20;
      
      // Offset (16byte Schritte, 1392/16 = 87)
      @OccupantPresence_Notification_Offset = 87 * (UDP_Segments_total - UDP_Segments_left);
      
      // More Segments Flag
      if (UDP_Segments_left > 1) @OccupantPresence_Notification_More_Segments_Flag = 1;
      else                       @OccupantPresence_Notification_More_Segments_Flag = 0;
      
      buffer[i++] =   @OccupantPresence_Notification_Offset>>20 & 0xFF;
      buffer[i++] =   @OccupantPresence_Notification_Offset>>12 & 0xFF;
      buffer[i++] =   @OccupantPresence_Notification_Offset>>4  & 0xFF;
      buffer[i++] = ((@OccupantPresence_Notification_Offset<<4) & 0xF0) + (@OccupantPresence_Notification_More_Segments_Flag & 0x01);
    }
  }
  
  UDP_Segments_left--;
  
  ////// driverPresenceStatus notifier //////
  if (MethodID == 0xC010)
  {
    if (UDP_Segments_total == 1)
    {
      for (j=0; j<OccupantPresence_payload_length_driverPresenceStatus; j++)
        buffer[i++] = OccupantPresence_payload_buffer_driverPresenceStatus[j];
    }
    else
    {
      if (UDP_Segments_left >= 1)
      {
        for (j=(UDP_Segments_total-UDP_Segments_left-1)*1392; j<(UDP_Segments_total-UDP_Segments_left)*1392; j++)
          buffer[i++] = OccupantPresence_payload_buffer_driverPresenceStatus[j];
      }
      else
      {
        for (j=(UDP_Segments_total-(UDP_Segments_left+1))*1392; j<OccupantPresence_payload_length_driverPresenceStatus; j++)
          buffer[i++] = OccupantPresence_payload_buffer_driverPresenceStatus[j];
      }
    }
  }
  
  ////// occupantPresenceStatus notifier //////
  if (MethodID == 0xC020)
  {
    if (UDP_Segments_total == 1)
    {
      for (j=0; j<OccupantPresence_payload_length_occupantPresenceStatus; j++)
        buffer[i++] = OccupantPresence_payload_buffer_occupantPresenceStatus[j];
    }
    else
    {
      if (UDP_Segments_left >= 1)
      {
        for (j=(UDP_Segments_total-UDP_Segments_left-1)*1392; j<(UDP_Segments_total-UDP_Segments_left)*1392; j++)
          buffer[i++] = OccupantPresence_payload_buffer_occupantPresenceStatus[j];
      }
      else
      {
        for (j=(UDP_Segments_total-(UDP_Segments_left+1))*1392; j<OccupantPresence_payload_length_occupantPresenceStatus; j++)
          buffer[i++] = OccupantPresence_payload_buffer_occupantPresenceStatus[j];
      }
    }
  }
  
  
  // Rohdaten in UDP Paket schreiben
  EthPaket.udp.SetData( 0, buffer, i );

  // calculate UDP and IPv6 checksum and send Ethernet packet
  EthPaket.CompletePacket();
  output( EthPaket );
  
  // prüfen ob alle Segemente gesendet wurden, sonst senden erneut aufrufen
  OccupantPresence_Segmentation_Method_ID = MethodID;
  if (UDP_Segments_left>0)
    settimer(OccupantPresence_Segmentation_delay, 50);
}

on timer OccupantPresence_Segmentation_delay
{
  Send_Service_OccupantPresence_Notification (OccupantPresence_Segmentation_Method_ID);
}






////////// driverPresenceStatus Notification //////////

on envVar OccupantPresence_Notification_LengthIndicator_Struct_driverPresenceStatus
{
  OccupantPresence_Notification_driverPresenceStatus();
}
on envVar OccupantPresence_Notification_LengthIndicator_Element_driverPresenceStatus
{
  OccupantPresence_Notification_driverPresenceStatus();
}
on envVar OccupantPresence_Notification_driverPresenceStatus_elementId
{
  OccupantPresence_array_driverPresenceStatus_elementId[@OccupantPresence_Notification_driverPresenceStatus_Element] = @this;
  OccupantPresence_Notification_driverPresenceStatus();
}
on envVar OccupantPresence_Notification_driverPresenceStatus_driverState
{
  OccupantPresence_array_driverPresenceStatus_driverState[@OccupantPresence_Notification_driverPresenceStatus_Element] = @this;
  OccupantPresence_Notification_driverPresenceStatus();
}
on envVar OccupantPresence_Notification_driverPresenceStatus_comfortReadyStatus
{
  OccupantPresence_array_driverPresenceStatus_comfortReadyStatus[@OccupantPresence_Notification_driverPresenceStatus_Element] = @this;
  OccupantPresence_Notification_driverPresenceStatus();
}
on envVar OccupantPresence_Notification_driverPresenceStatus_elementId_available
{
  OccupantPresence_array_driverPresenceStatus_elementId_available[@OccupantPresence_Notification_driverPresenceStatus_Element] = @this;
  OccupantPresence_Notification_driverPresenceStatus();
}
on envVar OccupantPresence_Notification_driverPresenceStatus_driverState_available
{
  OccupantPresence_array_driverPresenceStatus_driverState_available[@OccupantPresence_Notification_driverPresenceStatus_Element] = @this;
  OccupantPresence_Notification_driverPresenceStatus();
}
on envVar OccupantPresence_Notification_driverPresenceStatus_comfortReadyStatus_available
{
  OccupantPresence_array_driverPresenceStatus_comfortReadyStatus_available[@OccupantPresence_Notification_driverPresenceStatus_Element] = @this;
  OccupantPresence_Notification_driverPresenceStatus();
}
on envVar OccupantPresence_Notification_driverPresenceStatus_Payload
{
  OccupantPresence_Notification_driverPresenceStatus_update();
}


OccupantPresence_Notification_driverPresenceStatus()
{
  word payload_counter = 0;
  word start_pos       = 0;
  word element_length  = 0;
  
  // Length Indicator Struct - Platzhalter
  payload_counter = 0+4;
  start_pos = 0;
  
  for (j=0; j<@OccupantPresence_Notification_driverPresenceStatus_Element_TotalNum; j++)
  {
    OccupantPresence_array_driverPresenceStatus_available_functions[j] = OccupantPresence_array_driverPresenceStatus_elementId_available[j]
                                                                       + OccupantPresence_array_driverPresenceStatus_driverState_available[j]
                                                                       + OccupantPresence_array_driverPresenceStatus_comfortReadyStatus_available[j];
    
    // Length Indicator Element - Platzhalter
    if (OccupantPresence_array_driverPresenceStatus_available_functions[j] > 0)
    {
      start_pos = payload_counter;
      payload_counter = payload_counter + 4;
    }
    else 
      start_pos = payload_counter;
    
    
    // 0 elementId (uint32)
    if (OccupantPresence_array_driverPresenceStatus_elementId_available[j] == 1)
    {
      tag_dataID = 0;
      OccupantPresence_payload_buffer_driverPresenceStatus[payload_counter++] = 2 * 16 /* Wiretype = 2  =^ 32 Bit */ + ((tag_dataID>>8) & 0x0F) /* DataID High Part */ ;
      OccupantPresence_payload_buffer_driverPresenceStatus[payload_counter++] = tag_dataID & 0xFF /* DataID Low Part */ ;
      
      OccupantPresence_payload_buffer_driverPresenceStatus[payload_counter++] = OccupantPresence_array_driverPresenceStatus_elementId[j]>>24 & 0xFF;
      OccupantPresence_payload_buffer_driverPresenceStatus[payload_counter++] = OccupantPresence_array_driverPresenceStatus_elementId[j]>>16 & 0xFF;
      OccupantPresence_payload_buffer_driverPresenceStatus[payload_counter++] = OccupantPresence_array_driverPresenceStatus_elementId[j]>> 8 & 0xFF;
      OccupantPresence_payload_buffer_driverPresenceStatus[payload_counter++] = OccupantPresence_array_driverPresenceStatus_elementId[j]     & 0xFF;
    }
    
    
    // 1 driverState (enum32)
    if (OccupantPresence_array_driverPresenceStatus_driverState_available[j] == 1)
    {
      tag_dataID = 1;
      OccupantPresence_payload_buffer_driverPresenceStatus[payload_counter++] = 2 * 16 /* Wiretype = 2  =^ 32 Bit */ + ((tag_dataID>>8) & 0x0F) /* DataID High Part */ ;
      OccupantPresence_payload_buffer_driverPresenceStatus[payload_counter++] = tag_dataID & 0xFF /* DataID Low Part */ ;
      
      OccupantPresence_payload_buffer_driverPresenceStatus[payload_counter++] = OccupantPresence_array_driverPresenceStatus_driverState[j]>>24 & 0xFF;
      OccupantPresence_payload_buffer_driverPresenceStatus[payload_counter++] = OccupantPresence_array_driverPresenceStatus_driverState[j]>>16 & 0xFF;
      OccupantPresence_payload_buffer_driverPresenceStatus[payload_counter++] = OccupantPresence_array_driverPresenceStatus_driverState[j]>> 8 & 0xFF;
      OccupantPresence_payload_buffer_driverPresenceStatus[payload_counter++] = OccupantPresence_array_driverPresenceStatus_driverState[j]     & 0xFF;
    }
    
    
    // 2 comfortReadyStatus (enum32)
    if (OccupantPresence_array_driverPresenceStatus_comfortReadyStatus_available[j] == 1)
    {
      tag_dataID = 2;
      OccupantPresence_payload_buffer_driverPresenceStatus[payload_counter++] = 2 * 16 /* Wiretype = 2  =^ 32 Bit */ + ((tag_dataID>>8) & 0x0F) /* DataID High Part */ ;
      OccupantPresence_payload_buffer_driverPresenceStatus[payload_counter++] = tag_dataID & 0xFF /* DataID Low Part */ ;
      
      OccupantPresence_payload_buffer_driverPresenceStatus[payload_counter++] = OccupantPresence_array_driverPresenceStatus_comfortReadyStatus[j]>>24 & 0xFF;
      OccupantPresence_payload_buffer_driverPresenceStatus[payload_counter++] = OccupantPresence_array_driverPresenceStatus_comfortReadyStatus[j]>>16 & 0xFF;
      OccupantPresence_payload_buffer_driverPresenceStatus[payload_counter++] = OccupantPresence_array_driverPresenceStatus_comfortReadyStatus[j]>> 8 & 0xFF;
      OccupantPresence_payload_buffer_driverPresenceStatus[payload_counter++] = OccupantPresence_array_driverPresenceStatus_comfortReadyStatus[j]     & 0xFF;
    }
    
    
    //Element Length
    element_length = payload_counter-start_pos;
    if (element_length >0) OccupantPresence_array_driverPresenceStatus_array_element_length[j] = element_length - 4;
    else                   OccupantPresence_array_driverPresenceStatus_array_element_length[j] = element_length;
    
    OccupantPresence_payload_buffer_driverPresenceStatus[start_pos++] = OccupantPresence_array_driverPresenceStatus_array_element_length[j]>>24 & 0xFF;
    OccupantPresence_payload_buffer_driverPresenceStatus[start_pos++] = OccupantPresence_array_driverPresenceStatus_array_element_length[j]>>16 & 0xFF;
    OccupantPresence_payload_buffer_driverPresenceStatus[start_pos++] = OccupantPresence_array_driverPresenceStatus_array_element_length[j]>> 8 & 0xFF;
    OccupantPresence_payload_buffer_driverPresenceStatus[start_pos++] = OccupantPresence_array_driverPresenceStatus_array_element_length[j]     & 0xFF;
    
    if (OccupantPresence_array_driverPresenceStatus_array_element_length[j] == 0) payload_counter = payload_counter+4;
  }
  
  // Struct Length
  OccupantPresence_array_driverPresenceStatus_struct_element_length = 4*@OccupantPresence_Notification_driverPresenceStatus_Element_TotalNum;

  for (k=0;k<@OccupantPresence_Notification_driverPresenceStatus_Element_TotalNum;k++)
    OccupantPresence_array_driverPresenceStatus_struct_element_length = OccupantPresence_array_driverPresenceStatus_struct_element_length + OccupantPresence_array_driverPresenceStatus_array_element_length[k];
  
  OccupantPresence_payload_buffer_driverPresenceStatus[0] = OccupantPresence_array_driverPresenceStatus_struct_element_length>>24 & 0xFF;
  OccupantPresence_payload_buffer_driverPresenceStatus[1] = OccupantPresence_array_driverPresenceStatus_struct_element_length>>16 & 0xFF;
  OccupantPresence_payload_buffer_driverPresenceStatus[2] = OccupantPresence_array_driverPresenceStatus_struct_element_length>> 8 & 0xFF;
  OccupantPresence_payload_buffer_driverPresenceStatus[3] = OccupantPresence_array_driverPresenceStatus_struct_element_length     & 0xFF;


  OccupantPresence_payload_length_driverPresenceStatus = OccupantPresence_array_driverPresenceStatus_struct_element_length+4;
  putvalue(OccupantPresence_Notification_driverPresenceStatus_Payload, OccupantPresence_payload_buffer_driverPresenceStatus, OccupantPresence_payload_length_driverPresenceStatus);
}

on envVar OccupantPresence_Notification_driverPresenceStatus_Element_TotalNum
{
  if (@this == 0) @this =  1;
  if (@this > 10) @this = 10;
  
  OccupantPresence_Notification_driverPresenceStatus();
  OccupantPresence_Notification_driverPresenceStatus_update();
}

on envVar OccupantPresence_Notification_driverPresenceStatus_Element
{
  OccupantPresence_Notification_driverPresenceStatus_update();
}

on envVar OccupantPresence_Notification_driverPresenceStatus_Element_Next
{
  if (@this == 1 && @OccupantPresence_Notification_driverPresenceStatus_Element < @OccupantPresence_Notification_driverPresenceStatus_Element_TotalNum - 1)
  {
    @OccupantPresence_Notification_driverPresenceStatus_Element = @OccupantPresence_Notification_driverPresenceStatus_Element + 1;
    OccupantPresence_Notification_driverPresenceStatus_update();
  }
}

on envVar OccupantPresence_Notification_driverPresenceStatus_Element_Previous
{
  if (@this == 1 && @OccupantPresence_Notification_driverPresenceStatus_Element > 0)
  {
    @OccupantPresence_Notification_driverPresenceStatus_Element = @OccupantPresence_Notification_driverPresenceStatus_Element - 1;
    OccupantPresence_Notification_driverPresenceStatus_update();
  }
}

OccupantPresence_Notification_driverPresenceStatus_update()
{
  @OccupantPresence_Notification_LengthIndicator_Element_driverPresenceStatus = OccupantPresence_array_driverPresenceStatus_array_element_length[@OccupantPresence_Notification_driverPresenceStatus_Element];
  @OccupantPresence_Notification_LengthIndicator_Struct_driverPresenceStatus  = OccupantPresence_array_driverPresenceStatus_struct_element_length;
  @OccupantPresence_Notification_Length_driverPresenceStatus                  = OccupantPresence_payload_length_driverPresenceStatus+8;
  
  @OccupantPresence_Notification_driverPresenceStatus_elementId          = OccupantPresence_array_driverPresenceStatus_elementId[@OccupantPresence_Notification_driverPresenceStatus_Element];
  @OccupantPresence_Notification_driverPresenceStatus_driverState        = OccupantPresence_array_driverPresenceStatus_driverState[@OccupantPresence_Notification_driverPresenceStatus_Element];
  @OccupantPresence_Notification_driverPresenceStatus_comfortReadyStatus = OccupantPresence_array_driverPresenceStatus_comfortReadyStatus[@OccupantPresence_Notification_driverPresenceStatus_Element];
  
  @OccupantPresence_Notification_driverPresenceStatus_elementId_available          = OccupantPresence_array_driverPresenceStatus_elementId_available[@OccupantPresence_Notification_driverPresenceStatus_Element];
  @OccupantPresence_Notification_driverPresenceStatus_driverState_available        = OccupantPresence_array_driverPresenceStatus_driverState_available[@OccupantPresence_Notification_driverPresenceStatus_Element];
  @OccupantPresence_Notification_driverPresenceStatus_comfortReadyStatus_available = OccupantPresence_array_driverPresenceStatus_comfortReadyStatus_available[@OccupantPresence_Notification_driverPresenceStatus_Element];
}






////////// occupantPresenceStatus Notification //////////

on envVar OccupantPresence_Notification_LengthIndicator_Struct_occupantPresenceStatus
{
  OccupantPresence_Notification_occupantPresenceStatus();
}
on envVar OccupantPresence_Notification_LengthIndicator_Element_occupantPresenceStatus
{
  OccupantPresence_Notification_occupantPresenceStatus();
}
on envVar OccupantPresence_Notification_occupantPresenceStatus_occupantId
{
  OccupantPresence_array_occupantPresenceStatus_occupantId[@OccupantPresence_Notification_occupantPresenceStatus_Element] = @this;
  OccupantPresence_Notification_occupantPresenceStatus();
}
on envVar OccupantPresence_Notification_occupantPresenceStatus_occupantState
{
  OccupantPresence_array_occupantPresenceStatus_occupantState[@OccupantPresence_Notification_occupantPresenceStatus_Element] = @this;
  OccupantPresence_Notification_occupantPresenceStatus();
}
on envVar OccupantPresence_Notification_occupantPresenceStatus_occupantId_available
{
  OccupantPresence_array_occupantPresenceStatus_occupantId_available[@OccupantPresence_Notification_occupantPresenceStatus_Element] = @this;
  OccupantPresence_Notification_occupantPresenceStatus();
}
on envVar OccupantPresence_Notification_occupantPresenceStatus_occupantState_available
{
  OccupantPresence_array_occupantPresenceStatus_occupantState_available[@OccupantPresence_Notification_occupantPresenceStatus_Element] = @this;
  OccupantPresence_Notification_occupantPresenceStatus();
}
on envVar OccupantPresence_Notification_occupantPresenceStatus_Payload
{
  OccupantPresence_Notification_occupantPresenceStatus_update();
}


OccupantPresence_Notification_occupantPresenceStatus()
{
  word payload_counter = 0;
  word start_pos       = 0;
  word element_length  = 0;
  
  // Length Indicator Struct - Platzhalter
  payload_counter = 0+4;
  start_pos = 0;
  
  for (j=0; j<@OccupantPresence_Notification_occupantPresenceStatus_Element_TotalNum; j++)
  {
    OccupantPresence_array_occupantPresenceStatus_available_functions[j] = OccupantPresence_array_occupantPresenceStatus_occupantId_available[j]
                                                                         + OccupantPresence_array_occupantPresenceStatus_occupantState_available[j];
    
    // Length Indicator Element - Platzhalter
    if (OccupantPresence_array_occupantPresenceStatus_available_functions[j] > 0)
    {
      start_pos = payload_counter;
      payload_counter = payload_counter + 4;
    }
    else 
      start_pos = payload_counter;
    
    
    // 0 existiert nicht
    
    
    // 1 occupantId (enum32)
    if (OccupantPresence_array_occupantPresenceStatus_occupantId_available[j] == 1)
    {
      tag_dataID = 1;
      OccupantPresence_payload_buffer_occupantPresenceStatus[payload_counter++] = 2 * 16 /* Wiretype = 2  =^ 32 Bit */ + ((tag_dataID>>8) & 0x0F) /* DataID High Part */ ;
      OccupantPresence_payload_buffer_occupantPresenceStatus[payload_counter++] = tag_dataID & 0xFF /* DataID Low Part */ ;
      
      OccupantPresence_payload_buffer_occupantPresenceStatus[payload_counter++] = OccupantPresence_array_occupantPresenceStatus_occupantId[j]>>24 & 0xFF;
      OccupantPresence_payload_buffer_occupantPresenceStatus[payload_counter++] = OccupantPresence_array_occupantPresenceStatus_occupantId[j]>>16 & 0xFF;
      OccupantPresence_payload_buffer_occupantPresenceStatus[payload_counter++] = OccupantPresence_array_occupantPresenceStatus_occupantId[j]>> 8 & 0xFF;
      OccupantPresence_payload_buffer_occupantPresenceStatus[payload_counter++] = OccupantPresence_array_occupantPresenceStatus_occupantId[j]     & 0xFF;
    }
    
    // 2 occupantState (enum32)
    if (OccupantPresence_array_occupantPresenceStatus_occupantState_available[j] == 1)
    {
      tag_dataID = 2;
      OccupantPresence_payload_buffer_occupantPresenceStatus[payload_counter++] = 2 * 16 /* Wiretype = 2  =^ 32 Bit */ + ((tag_dataID>>8) & 0x0F) /* DataID High Part */ ;
      OccupantPresence_payload_buffer_occupantPresenceStatus[payload_counter++] = tag_dataID & 0xFF /* DataID Low Part */ ;
      
      OccupantPresence_payload_buffer_occupantPresenceStatus[payload_counter++] = OccupantPresence_array_occupantPresenceStatus_occupantState[j]>>24 & 0xFF;
      OccupantPresence_payload_buffer_occupantPresenceStatus[payload_counter++] = OccupantPresence_array_occupantPresenceStatus_occupantState[j]>>16 & 0xFF;
      OccupantPresence_payload_buffer_occupantPresenceStatus[payload_counter++] = OccupantPresence_array_occupantPresenceStatus_occupantState[j]>> 8 & 0xFF;
      OccupantPresence_payload_buffer_occupantPresenceStatus[payload_counter++] = OccupantPresence_array_occupantPresenceStatus_occupantState[j]     & 0xFF;
    }
    
    
    //Element Length
    element_length = payload_counter-start_pos;
    if (element_length >0) OccupantPresence_array_occupantPresenceStatus_array_element_length[j] = element_length - 4;
    else                   OccupantPresence_array_occupantPresenceStatus_array_element_length[j] = element_length;
    
    OccupantPresence_payload_buffer_occupantPresenceStatus[start_pos++] = OccupantPresence_array_occupantPresenceStatus_array_element_length[j]>>24 & 0xFF;
    OccupantPresence_payload_buffer_occupantPresenceStatus[start_pos++] = OccupantPresence_array_occupantPresenceStatus_array_element_length[j]>>16 & 0xFF;
    OccupantPresence_payload_buffer_occupantPresenceStatus[start_pos++] = OccupantPresence_array_occupantPresenceStatus_array_element_length[j]>> 8 & 0xFF;
    OccupantPresence_payload_buffer_occupantPresenceStatus[start_pos++] = OccupantPresence_array_occupantPresenceStatus_array_element_length[j]     & 0xFF;
    
    if (OccupantPresence_array_occupantPresenceStatus_array_element_length[j] == 0) payload_counter = payload_counter+4;
  }
  
  // Struct Length
  OccupantPresence_array_occupantPresenceStatus_struct_element_length = 4*@OccupantPresence_Notification_occupantPresenceStatus_Element_TotalNum;

  for (k=0;k<@OccupantPresence_Notification_occupantPresenceStatus_Element_TotalNum;k++)
    OccupantPresence_array_occupantPresenceStatus_struct_element_length = OccupantPresence_array_occupantPresenceStatus_struct_element_length + OccupantPresence_array_occupantPresenceStatus_array_element_length[k];
  
  OccupantPresence_payload_buffer_occupantPresenceStatus[0] = OccupantPresence_array_occupantPresenceStatus_struct_element_length>>24 & 0xFF;
  OccupantPresence_payload_buffer_occupantPresenceStatus[1] = OccupantPresence_array_occupantPresenceStatus_struct_element_length>>16 & 0xFF;
  OccupantPresence_payload_buffer_occupantPresenceStatus[2] = OccupantPresence_array_occupantPresenceStatus_struct_element_length>> 8 & 0xFF;
  OccupantPresence_payload_buffer_occupantPresenceStatus[3] = OccupantPresence_array_occupantPresenceStatus_struct_element_length     & 0xFF;


  OccupantPresence_payload_length_occupantPresenceStatus = OccupantPresence_array_occupantPresenceStatus_struct_element_length+4;
  putvalue(OccupantPresence_Notification_occupantPresenceStatus_Payload, OccupantPresence_payload_buffer_occupantPresenceStatus, OccupantPresence_payload_length_occupantPresenceStatus);
}

on envVar OccupantPresence_Notification_occupantPresenceStatus_Element_TotalNum
{
  if (@this == 0) @this =  1;
  if (@this > 10) @this = 10;
  
  OccupantPresence_Notification_occupantPresenceStatus();
  OccupantPresence_Notification_occupantPresenceStatus_update();
}

on envVar OccupantPresence_Notification_occupantPresenceStatus_Element
{
  OccupantPresence_Notification_occupantPresenceStatus_update();
}

on envVar OccupantPresence_Notification_occupantPresenceStatus_Element_Next
{
  if (@this == 1 && @OccupantPresence_Notification_occupantPresenceStatus_Element < @OccupantPresence_Notification_occupantPresenceStatus_Element_TotalNum - 1)
  {
    @OccupantPresence_Notification_occupantPresenceStatus_Element = @OccupantPresence_Notification_occupantPresenceStatus_Element + 1;
    OccupantPresence_Notification_occupantPresenceStatus_update();
  }
}

on envVar OccupantPresence_Notification_occupantPresenceStatus_Element_Previous
{
  if (@this == 1 && @OccupantPresence_Notification_occupantPresenceStatus_Element > 0)
  {
    @OccupantPresence_Notification_occupantPresenceStatus_Element = @OccupantPresence_Notification_occupantPresenceStatus_Element - 1;
    OccupantPresence_Notification_occupantPresenceStatus_update();
  }
}

OccupantPresence_Notification_occupantPresenceStatus_update()
{
  @OccupantPresence_Notification_LengthIndicator_Element_occupantPresenceStatus = OccupantPresence_array_occupantPresenceStatus_array_element_length[@OccupantPresence_Notification_occupantPresenceStatus_Element];
  @OccupantPresence_Notification_LengthIndicator_Struct_occupantPresenceStatus  = OccupantPresence_array_occupantPresenceStatus_struct_element_length;
  @OccupantPresence_Notification_Length_occupantPresenceStatus                  = OccupantPresence_payload_length_occupantPresenceStatus+8;
  
  @OccupantPresence_Notification_occupantPresenceStatus_occupantId    = OccupantPresence_array_occupantPresenceStatus_occupantId[@OccupantPresence_Notification_occupantPresenceStatus_Element];
  @OccupantPresence_Notification_occupantPresenceStatus_occupantState = OccupantPresence_array_occupantPresenceStatus_occupantState[@OccupantPresence_Notification_occupantPresenceStatus_Element];
  
  @OccupantPresence_Notification_occupantPresenceStatus_occupantId_available    = OccupantPresence_array_occupantPresenceStatus_occupantId_available[@OccupantPresence_Notification_occupantPresenceStatus_Element];
  @OccupantPresence_Notification_occupantPresenceStatus_occupantState_available = OccupantPresence_array_occupantPresenceStatus_occupantState_available[@OccupantPresence_Notification_occupantPresenceStatus_Element];
}









//////////////////////////////////////////////////////////////
////////////////// Service VehicleBasicData //////////////////
//////////////////////////////////////////////////////////////

on envVar ServiceDiscovery_Offer_Service_VehicleBasicData
{
  Send_ServiceDiscovery_Offer_Service_ICAS1Gateway();
}

on envVar VehicleBasicData_Notification_installations_Send
{
  if (@this == 1)
  {
    UDP_Segments_total = @VehicleBasicData_Notification_Length_installations/1404 + 1;
    UDP_Segments_left  = UDP_Segments_total;
    
    if (UDP_Segments_total > 1) seg_id_flag = 1;
    else                        seg_id_flag = 0;
    
    Send_Service_VehicleBasicData_Notification (0xC010 & 0x0000FFFF);
  }
}
on envVar VehicleBasicData_Notification_installations_Send_cyclic
{
  if (@this == 1)
    setTimercyclic (tVehicleBasicData_Notification_installations_Send, @VehicleBasicData_Notification_installations_Send_cyclic_cycletime);
  else
    cancelTimer (tVehicleBasicData_Notification_installations_Send);
}
on envVar VehicleBasicData_Notification_installations_Send_cyclic_cycletime
{
  if (@VehicleBasicData_Notification_installations_Send_cyclic == 1)
  {
    cancelTimer (tVehicleBasicData_Notification_installations_Send);
    setTimercyclic (tVehicleBasicData_Notification_installations_Send, @this);
  }
}
on timer tVehicleBasicData_Notification_installations_Send
{
  UDP_Segments_total = @VehicleBasicData_Notification_Length_installations/1404 + 1;
  UDP_Segments_left  = UDP_Segments_total;
  
  if (UDP_Segments_total > 1) seg_id_flag = 1;
  else                        seg_id_flag = 0;
    
  Send_Service_VehicleBasicData_Notification (0xC010 & 0x0000FFFF);
}

on envVar VehicleBasicData_Notification_variants_Send
{
  if (@this == 1)
  {
    UDP_Segments_total = @VehicleBasicData_Notification_Length_variants/1404 + 1;
    UDP_Segments_left  = UDP_Segments_total;
    
    if (UDP_Segments_total > 1) seg_id_flag = 1;
    else                        seg_id_flag = 0;
    
    Send_Service_VehicleBasicData_Notification (0xC020 & 0x0000FFFF);
  }
}
on envVar VehicleBasicData_Notification_variants_Send_cyclic
{
  if (@this == 1)
    setTimercyclic (tVehicleBasicData_Notification_variants_Send, @VehicleBasicData_Notification_variants_Send_cyclic_cycletime);
  else
    cancelTimer (tVehicleBasicData_Notification_variants_Send);
}
on envVar VehicleBasicData_Notification_variants_Send_cyclic_cycletime
{
  if (@VehicleBasicData_Notification_variants_Send_cyclic == 1)
  {
    cancelTimer (tVehicleBasicData_Notification_variants_Send);
    setTimercyclic (tVehicleBasicData_Notification_variants_Send, @this);
  }
}
on timer tVehicleBasicData_Notification_variants_Send
{
  UDP_Segments_total = @VehicleBasicData_Notification_Length_variants/1404 + 1;
  UDP_Segments_left  = UDP_Segments_total;
  
  if (UDP_Segments_total > 1) seg_id_flag = 1;
  else                        seg_id_flag = 0;
    
  Send_Service_VehicleBasicData_Notification (0xC020 & 0x0000FFFF);
}

on envVar VehicleBasicData_Notification_parameters_Send
{
  if (@this == 1)
  {
    UDP_Segments_total = @VehicleBasicData_Notification_Length_parameters/1404 + 1;
    UDP_Segments_left  = UDP_Segments_total;
    
    if (UDP_Segments_total > 1) seg_id_flag = 1;
    else                        seg_id_flag = 0;
    
    Send_Service_VehicleBasicData_Notification (0xC030 & 0x0000FFFF);
  }
}
on envVar VehicleBasicData_Notification_parameters_Send_cyclic
{
  if (@this == 1)
    setTimercyclic (tVehicleBasicData_Notification_parameters_Send, @VehicleBasicData_Notification_parameters_Send_cyclic_cycletime);
  else
    cancelTimer (tVehicleBasicData_Notification_parameters_Send);
}
on envVar VehicleBasicData_Notification_parameters_Send_cyclic_cycletime
{
  if (@VehicleBasicData_Notification_parameters_Send_cyclic == 1)
  {
    cancelTimer (tVehicleBasicData_Notification_parameters_Send);
    setTimercyclic (tVehicleBasicData_Notification_parameters_Send, @this);
  }
}
on timer tVehicleBasicData_Notification_parameters_Send
{
  UDP_Segments_total = @VehicleBasicData_Notification_Length_parameters/1404 + 1;
  UDP_Segments_left  = UDP_Segments_total;
  
  if (UDP_Segments_total > 1) seg_id_flag = 1;
  else                        seg_id_flag = 0;
    
  Send_Service_VehicleBasicData_Notification (0xC030 & 0x0000FFFF);
}


Send_Service_VehicleBasicData_Notification (word MethodID)
{
  ethernetPacket EthPaket;

  // Ethernet Packet - MAC Source address
  getvalue (ServiceDiscovery_EthernetPacket_MAC_Source_ICAS1Gateway, buffer_MAC);
  //EthPaket.source.ParseAddress ( buffer_MAC );
  EthPaket.source = ethGetMacAddressAsNumber (buffer_MAC);
  
  // Ethernet Packet - MAC Destination address
  getvalue (ServiceDiscovery_EthernetPacket_MAC_Destination, buffer_MAC);
  //EthPaket.destination.ParseAddress ( buffer_MAC );
  EthPaket.destination = ethGetMacAddressAsNumber (buffer_MAC);
  
  // Ethernet Packet - VLAN
  EthPaket.SetVlan (@ServiceDiscovery_EthernetPacket_VLAN_TPID, @ServiceDiscovery_EthernetPacket_VLAN_TCI);
  
  // Ethernet Packet - Type
  //EthPaket.ipv6.type = @EthernetPacket_Type;
  if (@ServiceDiscovery_EthernetPacket_Type == 0x86DD) EthPaket.ipv6.Init();
  
  
  // IPv6 Packet - Version
  EthPaket.ipv6.version = @ServiceDiscovery_IPv6Packet_Version;

  // IPv6 Packet - Traffic Class
  EthPaket.ipv6.class = @ServiceDiscovery_IPv6Packet_Traffic_Class;
  
  // IPv6 Packet - Flow Label
  EthPaket.ipv6.flow = @ServiceDiscovery_IPv6Packet_Flow_Label;
  
  // IPv6 Packet - Payload_Length
  EthPaket.ipv6.length = @ServiceDiscovery_IPv6Packet_Payload_Length;
  
  // IPv6 Packet - Next Header
  EthPaket.ipv6.next = @ServiceDiscovery_IPv6Packet_Next_Header;
  if (@ServiceDiscovery_IPv6Packet_Next_Header == 6) EthPaket.tcp.Init();
  if (@ServiceDiscovery_IPv6Packet_Next_Header == 17) EthPaket.udp.Init();
  
  // IPv6 Packet - Hop Limit
  EthPaket.ipv6.hopLimit = @ServiceDiscovery_IPv6Packet_Hop_Limit;

  // IPv6 Packet - IPv6 Destination address    // TODO: char array zu byte array
  buffer_ipv6[0]  = @ServiceDiscovery_IPv6Packet_IP_Destination_Unicast_01>>8 & 0xFF;
  buffer_ipv6[1]  = @ServiceDiscovery_IPv6Packet_IP_Destination_Unicast_01    & 0xFF;
  buffer_ipv6[2]  = @ServiceDiscovery_IPv6Packet_IP_Destination_Unicast_02>>8 & 0xFF;
  buffer_ipv6[3]  = @ServiceDiscovery_IPv6Packet_IP_Destination_Unicast_02    & 0xFF;
  buffer_ipv6[4]  = @ServiceDiscovery_IPv6Packet_IP_Destination_Unicast_03>>8 & 0xFF;
  buffer_ipv6[5]  = @ServiceDiscovery_IPv6Packet_IP_Destination_Unicast_03    & 0xFF;
  buffer_ipv6[6]  = @ServiceDiscovery_IPv6Packet_IP_Destination_Unicast_04>>8 & 0xFF;
  buffer_ipv6[7]  = @ServiceDiscovery_IPv6Packet_IP_Destination_Unicast_04    & 0xFF;
  buffer_ipv6[8]  = @ServiceDiscovery_IPv6Packet_IP_Destination_Unicast_05>>8 & 0xFF;
  buffer_ipv6[9]  = @ServiceDiscovery_IPv6Packet_IP_Destination_Unicast_05    & 0xFF;
  buffer_ipv6[10] = @ServiceDiscovery_IPv6Packet_IP_Destination_Unicast_06>>8 & 0xFF;
  buffer_ipv6[11] = @ServiceDiscovery_IPv6Packet_IP_Destination_Unicast_06    & 0xFF;
  buffer_ipv6[12] = @ServiceDiscovery_IPv6Packet_IP_Destination_Unicast_07>>8 & 0xFF;
  buffer_ipv6[13] = @ServiceDiscovery_IPv6Packet_IP_Destination_Unicast_07    & 0xFF;
  buffer_ipv6[14] = @ServiceDiscovery_IPv6Packet_IP_Destination_Unicast_08>>8 & 0xFF;
  buffer_ipv6[15] = @ServiceDiscovery_IPv6Packet_IP_Destination_Unicast_08    & 0xFF;
  EthPaket.ipv6.destination.SetData ( 0, buffer_ipv6, elcount(buffer_ipv6) );

  // IPv6 Packet - IPv6 Source address    // TODO: char array zu byte array
  buffer_ipv6[0]  = @ServiceDiscovery_IPv6Packet_IP_Source_ICAS1Gateway_01>>8 & 0xFF;
  buffer_ipv6[1]  = @ServiceDiscovery_IPv6Packet_IP_Source_ICAS1Gateway_01    & 0xFF;
  buffer_ipv6[2]  = @ServiceDiscovery_IPv6Packet_IP_Source_ICAS1Gateway_02>>8 & 0xFF;
  buffer_ipv6[3]  = @ServiceDiscovery_IPv6Packet_IP_Source_ICAS1Gateway_02    & 0xFF;
  buffer_ipv6[4]  = @ServiceDiscovery_IPv6Packet_IP_Source_ICAS1Gateway_03>>8 & 0xFF;
  buffer_ipv6[5]  = @ServiceDiscovery_IPv6Packet_IP_Source_ICAS1Gateway_03    & 0xFF;
  buffer_ipv6[6]  = @ServiceDiscovery_IPv6Packet_IP_Source_ICAS1Gateway_04>>8 & 0xFF;
  buffer_ipv6[7]  = @ServiceDiscovery_IPv6Packet_IP_Source_ICAS1Gateway_04    & 0xFF;
  buffer_ipv6[8]  = @ServiceDiscovery_IPv6Packet_IP_Source_ICAS1Gateway_05>>8 & 0xFF;
  buffer_ipv6[9]  = @ServiceDiscovery_IPv6Packet_IP_Source_ICAS1Gateway_05    & 0xFF;
  buffer_ipv6[10] = @ServiceDiscovery_IPv6Packet_IP_Source_ICAS1Gateway_06>>8 & 0xFF;
  buffer_ipv6[11] = @ServiceDiscovery_IPv6Packet_IP_Source_ICAS1Gateway_06    & 0xFF;
  buffer_ipv6[12] = @ServiceDiscovery_IPv6Packet_IP_Source_ICAS1Gateway_07>>8 & 0xFF;
  buffer_ipv6[13] = @ServiceDiscovery_IPv6Packet_IP_Source_ICAS1Gateway_07    & 0xFF;
  buffer_ipv6[14] = @ServiceDiscovery_IPv6Packet_IP_Source_ICAS1Gateway_08>>8 & 0xFF;
  buffer_ipv6[15] = @ServiceDiscovery_IPv6Packet_IP_Source_ICAS1Gateway_08    & 0xFF;
  EthPaket.ipv6.source.SetData ( 0, buffer_ipv6, elcount(buffer_ipv6) );

  
  // UDP Packet - Source Port
  EthPaket.udp.source = @VehicleBasicData_Notification_Port_Source;
  
  // UDP Packet - Destination Port
  EthPaket.udp.destination = @VehicleBasicData_Notification_Port_Destination;
  
  // UDP Packet - Length
  EthPaket.udp.length = @ServiceDiscovery_UDPPacket_Length;
  
  
  // SOME/IP Packet aus Rohdaten zusammenbauen (buffer array)
  i=0;
  
  // SOME/IP Packet - Message ID, Service ID [16 bit]
  buffer[i++] = @VehicleBasicData_Notification_Message_ID_Service_ID>>8 & 0xFF;
  buffer[i++] = @VehicleBasicData_Notification_Message_ID_Service_ID    & 0xFF;
  
  // SOME/IP Packet - Message ID, Message ID [16 bit]
  switch (MethodID)
  {
    case 0xC010: @VehicleBasicData_Notification_Message_ID_Method_ID = @VehicleBasicData_Notification_Message_ID_Method_ID_installations; break;
    case 0xC020: @VehicleBasicData_Notification_Message_ID_Method_ID = @VehicleBasicData_Notification_Message_ID_Method_ID_variants; break;
    case 0xC030: @VehicleBasicData_Notification_Message_ID_Method_ID = @VehicleBasicData_Notification_Message_ID_Method_ID_parameters; break;
  }
  buffer[i++] = @VehicleBasicData_Notification_Message_ID_Method_ID>>8 & 0xFF;
  buffer[i++] = @VehicleBasicData_Notification_Message_ID_Method_ID    & 0xFF;
  
  // SOME/IP Packet - Length [32 bit]
  if (UDP_Segments_total == 1)
  {
    switch (MethodID)
    {
      case 0xC010: @VehicleBasicData_Notification_Length = @VehicleBasicData_Notification_Length_installations; break;
      case 0xC020: @VehicleBasicData_Notification_Length = @VehicleBasicData_Notification_Length_variants; break;
      case 0xC030: @VehicleBasicData_Notification_Length = @VehicleBasicData_Notification_Length_parameters; break;
    }
  }
  else
  {
    if (UDP_Segments_left > 1)
    {
      switch (MethodID)
      {
        case 0xC010: @VehicleBasicData_Notification_Length = 1404; break;
        case 0xC020: @VehicleBasicData_Notification_Length = 1404; break;
        case 0xC030: @VehicleBasicData_Notification_Length = 1404; break;
      }
    }
    else
    {
      switch (MethodID)
      {
        case 0xC010: @VehicleBasicData_Notification_Length = VehicleBasicData_payload_length_installations - 1404*(UDP_Segments_total-UDP_Segments_left) + 24; break;
        case 0xC020: @VehicleBasicData_Notification_Length = VehicleBasicData_payload_length_variants      - 1404*(UDP_Segments_total-UDP_Segments_left) + 24; break;
        case 0xC030: @VehicleBasicData_Notification_Length = VehicleBasicData_payload_length_parameters    - 1404*(UDP_Segments_total-UDP_Segments_left) + 24; break;
      }
    }
  }
  buffer[i++] = @VehicleBasicData_Notification_Length>>24 & 0xFF;
  buffer[i++] = @VehicleBasicData_Notification_Length>>16 & 0xFF;
  buffer[i++] = @VehicleBasicData_Notification_Length>> 8 & 0xFF;
  buffer[i++] = @VehicleBasicData_Notification_Length     & 0xFF;
  
  // SOME/IP Packet - Request ID, Client ID [16 bit]
  buffer[i++] = @VehicleBasicData_Notification_Request_ID_Client_ID>>8 & 0xFF;
  buffer[i++] = @VehicleBasicData_Notification_Request_ID_Client_ID    & 0xFF;
  
  // SOME/IP Packet - Request ID, Session ID) [16 bit]
  if ((UDP_Segments_total == 1) || (seg_id_flag == 1))
  {
    @ServiceDiscovery_SOMEIPPacket_Notification_Request_ID_Session_ID = @ServiceDiscovery_SOMEIPPacket_Notification_Request_ID_Session_ID + 1;
    if (@ServiceDiscovery_SOMEIPPacket_Notification_Request_ID_Session_ID == 0x10000) @ServiceDiscovery_SOMEIPPacket_Notification_Request_ID_Session_ID = 1;
    seg_id_flag = 0;
  }
  
  buffer[i++] = @ServiceDiscovery_SOMEIPPacket_Notification_Request_ID_Session_ID>>8 & 0xFF;
  buffer[i++] = @ServiceDiscovery_SOMEIPPacket_Notification_Request_ID_Session_ID    & 0xFF;
  
  // SOME/IP Packet - Protocol Version [8 bit]
  buffer[i++] = @VehicleBasicData_Notification_Protocol_Version;
  
  // SOME/IP Packet - Interface Version [8 bit]
  buffer[i++] = @VehicleBasicData_Notification_Interface_Version;
  
  // SOME/IP Packet - Message Type [8 bit]
  buffer[i++] = @VehicleBasicData_Notification_Message_Type;
  
  // SOME/IP Packet - Return Code [8 bit]
  buffer[i++] = @VehicleBasicData_Notification_Return_Code;
  
  
  if (UDP_Segments_total > 1)
  {
    if (UDP_Segments_left >= 0)
    { 
      // Message Type neu setzen
      buffer[i-2] = @VehicleBasicData_Notification_Message_Type + 0x20;
      
      // Offset (16byte Schritte, 1392/16 = 87)
      @VehicleBasicData_Notification_Offset = 87 * (UDP_Segments_total - UDP_Segments_left);
      
      // More Segments Flag
      if (UDP_Segments_left > 1) @VehicleBasicData_Notification_More_Segments_Flag = 1;
      else                       @VehicleBasicData_Notification_More_Segments_Flag = 0;
      
      buffer[i++] =   @VehicleBasicData_Notification_Offset>>20 & 0xFF;
      buffer[i++] =   @VehicleBasicData_Notification_Offset>>12 & 0xFF;
      buffer[i++] =   @VehicleBasicData_Notification_Offset>>4  & 0xFF;
      buffer[i++] = ((@VehicleBasicData_Notification_Offset<<4) & 0xF0) + (@VehicleBasicData_Notification_More_Segments_Flag & 0x01);
    }
  }
  
  UDP_Segments_left--;
  
  ////// installations notifier //////
  if (MethodID == 0xC010)
  {
    if (UDP_Segments_total == 1)
    {
      for (j=0; j<VehicleBasicData_payload_length_installations; j++)
        buffer[i++] = VehicleBasicData_payload_buffer_installations[j];
    }
    else
    {
      if (UDP_Segments_left >= 1)
      {
        for (j=(UDP_Segments_total-UDP_Segments_left-1)*1392; j<(UDP_Segments_total-UDP_Segments_left)*1392; j++)
          buffer[i++] = VehicleBasicData_payload_buffer_installations[j];
      }
      else
      {
        for (j=(UDP_Segments_total-(UDP_Segments_left+1))*1392; j<VehicleBasicData_payload_length_installations; j++)
          buffer[i++] = VehicleBasicData_payload_buffer_installations[j];
      }
    }
  }
  
  ////// variants notifier //////
  if (MethodID == 0xC020)
  {
    if (UDP_Segments_total == 1)
    {
      for (j=0; j<VehicleBasicData_payload_length_variants; j++)
        buffer[i++] = VehicleBasicData_payload_buffer_variants[j];
    }
    else
    {
      if (UDP_Segments_left >= 1)
      {
        for (j=(UDP_Segments_total-UDP_Segments_left-1)*1392; j<(UDP_Segments_total-UDP_Segments_left)*1392; j++)
          buffer[i++] = VehicleBasicData_payload_buffer_variants[j];
      }
      else
      {
        for (j=(UDP_Segments_total-(UDP_Segments_left+1))*1392; j<VehicleBasicData_payload_length_variants; j++)
          buffer[i++] = VehicleBasicData_payload_buffer_variants[j];
      }
    }
  }
  
  ////// parameters notifier //////
  if (MethodID == 0xC030)
  {
    if (UDP_Segments_total == 1)
    {
      for (j=0; j<VehicleBasicData_payload_length_parameters; j++)
        buffer[i++] = VehicleBasicData_payload_buffer_parameters[j];
    }
    else
    {
      if (UDP_Segments_left >= 1)
      {
        for (j=(UDP_Segments_total-UDP_Segments_left-1)*1392; j<(UDP_Segments_total-UDP_Segments_left)*1392; j++)
          buffer[i++] = VehicleBasicData_payload_buffer_parameters[j];
      }
      else
      {
        for (j=(UDP_Segments_total-(UDP_Segments_left+1))*1392; j<VehicleBasicData_payload_length_parameters; j++)
          buffer[i++] = VehicleBasicData_payload_buffer_parameters[j];
      }
    }
  }
  
  
  // Rohdaten in UDP Paket schreiben
  EthPaket.udp.SetData( 0, buffer, i );

  // calculate UDP and IPv6 checksum and send Ethernet packet
  EthPaket.CompletePacket();
  output( EthPaket );
  
  // prüfen ob alle Segemente gesendet wurden, sonst senden erneut aufrufen
  VehicleBasicData_Segmentation_Method_ID = MethodID;
  if (UDP_Segments_left>0)
    settimer(VehicleBasicData_Segmentation_delay, 50);
}

on timer VehicleBasicData_Segmentation_delay
{
  Send_Service_VehicleBasicData_Notification (VehicleBasicData_Segmentation_Method_ID);
}






////////// installations Notification //////////

on envVar VehicleBasicData_Notification_LengthIndicator_Struct_installations
{
  VehicleBasicData_Notification_installations();
}
on envVar VehicleBasicData_Notification_LengthIndicator_Element_installations
{
  VehicleBasicData_Notification_installations();
}
on envVar VehicleBasicData_Notification_installations_elementId
{
  VehicleBasicData_array_installations_elementId[@VehicleBasicData_Notification_installations_Element] = @this;
  VehicleBasicData_Notification_installations();
}
on envVar VehicleBasicData_Notification_installations_rainSensor
{
  VehicleBasicData_array_installations_rainSensor[@VehicleBasicData_Notification_installations_Element] = @this;
  VehicleBasicData_Notification_installations();
}
on envVar VehicleBasicData_Notification_installations_exteriorSound
{
  VehicleBasicData_array_installations_exteriorSound[@VehicleBasicData_Notification_installations_Element] = @this;
  VehicleBasicData_Notification_installations();
}
on envVar VehicleBasicData_Notification_installations_allWheelDrive
{
  VehicleBasicData_array_installations_allWheelDrive[@VehicleBasicData_Notification_installations_Element] = @this;
  VehicleBasicData_Notification_installations();
}
on envVar VehicleBasicData_Notification_installations_speedLimiterButton
{
  VehicleBasicData_array_installations_speedLimiterButton[@VehicleBasicData_Notification_installations_Element] = @this;
  VehicleBasicData_Notification_installations();
}
on envVar VehicleBasicData_Notification_installations_rearSeatOccupiedSensor
{
  VehicleBasicData_array_installations_rearSeatOccupiedSensor[@VehicleBasicData_Notification_installations_Element] = @this;
  VehicleBasicData_Notification_installations();
}
on envVar VehicleBasicData_Notification_installations_elementId_available
{
  VehicleBasicData_array_installations_elementId_available[@VehicleBasicData_Notification_installations_Element] = @this;
  VehicleBasicData_Notification_installations();
}
on envVar VehicleBasicData_Notification_installations_rainSensor_available
{
  VehicleBasicData_array_installations_rainSensor_available[@VehicleBasicData_Notification_installations_Element] = @this;
  VehicleBasicData_Notification_installations();
}
on envVar VehicleBasicData_Notification_installations_exteriorSound_available
{
  VehicleBasicData_array_installations_exteriorSound_available[@VehicleBasicData_Notification_installations_Element] = @this;
  VehicleBasicData_Notification_installations();
}
on envVar VehicleBasicData_Notification_installations_allWheelDrive_available
{
  VehicleBasicData_array_installations_allWheelDrive_available[@VehicleBasicData_Notification_installations_Element] = @this;
  VehicleBasicData_Notification_installations();
}
on envVar VehicleBasicData_Notification_installations_speedLimiterButton_available
{
  VehicleBasicData_array_installations_speedLimiterButton_available[@VehicleBasicData_Notification_installations_Element] = @this;
  VehicleBasicData_Notification_installations();
}
on envVar VehicleBasicData_Notification_installations_rearSeatOccupiedSensor_available
{
  VehicleBasicData_array_installations_rearSeatOccupiedSensor_available[@VehicleBasicData_Notification_installations_Element] = @this;
  VehicleBasicData_Notification_installations();
}
on envVar VehicleBasicData_Notification_installations_Payload
{
  VehicleBasicData_Notification_installations_update();
}


VehicleBasicData_Notification_installations()
{
  word payload_counter = 0;
  word start_pos       = 0;
  word element_length  = 0;
  
  // Length Indicator Struct - Platzhalter
  payload_counter = 0+4;
  start_pos = 0;
  
  for (j=0; j<@VehicleBasicData_Notification_installations_Element_TotalNum; j++)
  {
    VehicleBasicData_array_installations_available_functions[j] = VehicleBasicData_array_installations_elementId_available[j]
                                                                + VehicleBasicData_array_installations_rainSensor_available[j]
                                                                + VehicleBasicData_array_installations_exteriorSound_available[j]
                                                                + VehicleBasicData_array_installations_allWheelDrive_available[j]
                                                                + VehicleBasicData_array_installations_speedLimiterButton_available[j]
                                                                + VehicleBasicData_array_installations_rearSeatOccupiedSensor_available[j];
    
    // Length Indicator Element - Platzhalter
    if (VehicleBasicData_array_installations_available_functions[j] > 0)
    {
      start_pos = payload_counter;
      payload_counter = payload_counter + 4;
    }
    else 
      start_pos = payload_counter;
    
    
    // 0 elementId (uint32)
    if (VehicleBasicData_array_installations_elementId_available[j] == 1)
    {
      tag_dataID = 0;
      VehicleBasicData_payload_buffer_installations[payload_counter++] = 2 * 16 /* Wiretype = 2  =^ 32 Bit */ + ((tag_dataID>>8) & 0x0F) /* DataID High Part */ ;
      VehicleBasicData_payload_buffer_installations[payload_counter++] = tag_dataID & 0xFF /* DataID Low Part */ ;
      
      VehicleBasicData_payload_buffer_installations[payload_counter++] = VehicleBasicData_array_installations_elementId[j]>>24 & 0xFF;
      VehicleBasicData_payload_buffer_installations[payload_counter++] = VehicleBasicData_array_installations_elementId[j]>>16 & 0xFF;
      VehicleBasicData_payload_buffer_installations[payload_counter++] = VehicleBasicData_array_installations_elementId[j]>> 8 & 0xFF;
      VehicleBasicData_payload_buffer_installations[payload_counter++] = VehicleBasicData_array_installations_elementId[j]     & 0xFF;
    }
    
    
    // 1 rainSensor (boolean)
    if (VehicleBasicData_array_installations_rainSensor_available[j] == 1)
    {
      tag_dataID = 1;
      VehicleBasicData_payload_buffer_installations[payload_counter++] = 0 * 16 /* Wiretype = 0  =^ 8 Bit */ + ((tag_dataID>>8) & 0x0F) /* DataID High Part */ ;
      VehicleBasicData_payload_buffer_installations[payload_counter++] = tag_dataID & 0xFF /* DataID Low Part */ ;
      
      VehicleBasicData_payload_buffer_installations[payload_counter++] = VehicleBasicData_array_installations_rainSensor[j] & 0xFF;
    }
    
    
    // 2 exteriorSound (boolean)
    if (VehicleBasicData_array_installations_exteriorSound_available[j] == 1)
    {
      tag_dataID = 2;
      VehicleBasicData_payload_buffer_installations[payload_counter++] = 0 * 16 /* Wiretype = 0  =^ 8 Bit */ + ((tag_dataID>>8) & 0x0F) /* DataID High Part */ ;
      VehicleBasicData_payload_buffer_installations[payload_counter++] = tag_dataID & 0xFF /* DataID Low Part */ ;
      
      VehicleBasicData_payload_buffer_installations[payload_counter++] = VehicleBasicData_array_installations_exteriorSound[j] & 0xFF;
    }
    
    
    // 3 allWheelDrive (boolean)
    if (VehicleBasicData_array_installations_allWheelDrive_available[j] == 1)
    {
      tag_dataID = 3;
      VehicleBasicData_payload_buffer_installations[payload_counter++] = 0 * 16 /* Wiretype = 0  =^ 8 Bit */ + ((tag_dataID>>8) & 0x0F) /* DataID High Part */ ;
      VehicleBasicData_payload_buffer_installations[payload_counter++] = tag_dataID & 0xFF /* DataID Low Part */ ;
      
      VehicleBasicData_payload_buffer_installations[payload_counter++] = VehicleBasicData_array_installations_allWheelDrive[j] & 0xFF;
    }
    
    
    // 4 speedLimiterButton (boolean)
    if (VehicleBasicData_array_installations_speedLimiterButton_available[j] == 1)
    {
      tag_dataID = 4;
      VehicleBasicData_payload_buffer_installations[payload_counter++] = 0 * 16 /* Wiretype = 0  =^ 8 Bit */ + ((tag_dataID>>8) & 0x0F) /* DataID High Part */ ;
      VehicleBasicData_payload_buffer_installations[payload_counter++] = tag_dataID & 0xFF /* DataID Low Part */ ;
      
      VehicleBasicData_payload_buffer_installations[payload_counter++] = VehicleBasicData_array_installations_speedLimiterButton[j] & 0xFF;
    }

    // 5 rearSeatOccupiedSensor (enum32)
    if (VehicleBasicData_array_installations_rearSeatOccupiedSensor_available[j] == 1)
    {
      tag_dataID = 5;
      VehicleBasicData_payload_buffer_installations[payload_counter++] = 2 * 16 /* Wiretype = 2  =^ 32 Bit */ + ((tag_dataID>>8) & 0x0F) /* DataID High Part */ ;
      VehicleBasicData_payload_buffer_installations[payload_counter++] = tag_dataID & 0xFF /* DataID Low Part */ ;
      
      VehicleBasicData_payload_buffer_installations[payload_counter++] = VehicleBasicData_array_installations_rearSeatOccupiedSensor[j]>>24 & 0xFF;
      VehicleBasicData_payload_buffer_installations[payload_counter++] = VehicleBasicData_array_installations_rearSeatOccupiedSensor[j]>>16 & 0xFF;
      VehicleBasicData_payload_buffer_installations[payload_counter++] = VehicleBasicData_array_installations_rearSeatOccupiedSensor[j]>> 8 & 0xFF;
      VehicleBasicData_payload_buffer_installations[payload_counter++] = VehicleBasicData_array_installations_rearSeatOccupiedSensor[j]     & 0xFF;
    }
    
    
    //Element Length
    element_length = payload_counter-start_pos;
    if (element_length >0) VehicleBasicData_array_installations_array_element_length[j] = element_length - 4;
    else                   VehicleBasicData_array_installations_array_element_length[j] = element_length;
    
    VehicleBasicData_payload_buffer_installations[start_pos++] = VehicleBasicData_array_installations_array_element_length[j]>>24 & 0xFF;
    VehicleBasicData_payload_buffer_installations[start_pos++] = VehicleBasicData_array_installations_array_element_length[j]>>16 & 0xFF;
    VehicleBasicData_payload_buffer_installations[start_pos++] = VehicleBasicData_array_installations_array_element_length[j]>> 8 & 0xFF;
    VehicleBasicData_payload_buffer_installations[start_pos++] = VehicleBasicData_array_installations_array_element_length[j]     & 0xFF;
    
    if (VehicleBasicData_array_installations_array_element_length[j] == 0) payload_counter = payload_counter+4;
  }
  
  // Struct Length
  VehicleBasicData_array_installations_struct_element_length = 4*@VehicleBasicData_Notification_installations_Element_TotalNum;

  for (k=0;k<@VehicleBasicData_Notification_installations_Element_TotalNum;k++)
    VehicleBasicData_array_installations_struct_element_length = VehicleBasicData_array_installations_struct_element_length + VehicleBasicData_array_installations_array_element_length[k];
  
  VehicleBasicData_payload_buffer_installations[0] = VehicleBasicData_array_installations_struct_element_length>>24 & 0xFF;
  VehicleBasicData_payload_buffer_installations[1] = VehicleBasicData_array_installations_struct_element_length>>16 & 0xFF;
  VehicleBasicData_payload_buffer_installations[2] = VehicleBasicData_array_installations_struct_element_length>> 8 & 0xFF;
  VehicleBasicData_payload_buffer_installations[3] = VehicleBasicData_array_installations_struct_element_length     & 0xFF;


  VehicleBasicData_payload_length_installations = VehicleBasicData_array_installations_struct_element_length+4;
  putvalue(VehicleBasicData_Notification_installations_Payload, VehicleBasicData_payload_buffer_installations, VehicleBasicData_payload_length_installations);
}

on envVar VehicleBasicData_Notification_installations_Element_TotalNum
{
  if (@this == 0) @this =  1;
  if (@this > 10) @this = 10;
  
  VehicleBasicData_Notification_installations();
  VehicleBasicData_Notification_installations_update();
}

on envVar VehicleBasicData_Notification_installations_Element
{
  VehicleBasicData_Notification_installations_update();
}

on envVar VehicleBasicData_Notification_installations_Element_Next
{
  if (@this == 1 && @VehicleBasicData_Notification_installations_Element < @VehicleBasicData_Notification_installations_Element_TotalNum - 1)
  {
    @VehicleBasicData_Notification_installations_Element = @VehicleBasicData_Notification_installations_Element + 1;
    VehicleBasicData_Notification_installations_update();
  }
}

on envVar VehicleBasicData_Notification_installations_Element_Previous
{
  if (@this == 1 && @VehicleBasicData_Notification_installations_Element > 0)
  {
    @VehicleBasicData_Notification_installations_Element = @VehicleBasicData_Notification_installations_Element - 1;
    VehicleBasicData_Notification_installations_update();
  }
}

VehicleBasicData_Notification_installations_update()
{
  @VehicleBasicData_Notification_LengthIndicator_Element_installations = VehicleBasicData_array_installations_array_element_length[@VehicleBasicData_Notification_installations_Element];
  @VehicleBasicData_Notification_LengthIndicator_Struct_installations  = VehicleBasicData_array_installations_struct_element_length;
  @VehicleBasicData_Notification_Length_installations                  = VehicleBasicData_payload_length_installations+8;
  
  @VehicleBasicData_Notification_installations_elementId              = VehicleBasicData_array_installations_elementId[@VehicleBasicData_Notification_installations_Element];
  @VehicleBasicData_Notification_installations_rainSensor             = VehicleBasicData_array_installations_rainSensor[@VehicleBasicData_Notification_installations_Element];
  @VehicleBasicData_Notification_installations_exteriorSound          = VehicleBasicData_array_installations_exteriorSound[@VehicleBasicData_Notification_installations_Element];
  @VehicleBasicData_Notification_installations_allWheelDrive          = VehicleBasicData_array_installations_allWheelDrive[@VehicleBasicData_Notification_installations_Element];
  @VehicleBasicData_Notification_installations_speedLimiterButton     = VehicleBasicData_array_installations_speedLimiterButton[@VehicleBasicData_Notification_installations_Element];
  @VehicleBasicData_Notification_installations_rearSeatOccupiedSensor = VehicleBasicData_array_installations_rearSeatOccupiedSensor[@VehicleBasicData_Notification_installations_Element];
  
  @VehicleBasicData_Notification_installations_elementId_available              = VehicleBasicData_array_installations_elementId_available[@VehicleBasicData_Notification_installations_Element];
  @VehicleBasicData_Notification_installations_rainSensor_available             = VehicleBasicData_array_installations_rainSensor_available[@VehicleBasicData_Notification_installations_Element];
  @VehicleBasicData_Notification_installations_exteriorSound_available          = VehicleBasicData_array_installations_exteriorSound_available[@VehicleBasicData_Notification_installations_Element];
  @VehicleBasicData_Notification_installations_allWheelDrive_available          = VehicleBasicData_array_installations_allWheelDrive_available[@VehicleBasicData_Notification_installations_Element];
  @VehicleBasicData_Notification_installations_speedLimiterButton_available     = VehicleBasicData_array_installations_speedLimiterButton_available[@VehicleBasicData_Notification_installations_Element];
  @VehicleBasicData_Notification_installations_rearSeatOccupiedSensor_available = VehicleBasicData_array_installations_rearSeatOccupiedSensor_available[@VehicleBasicData_Notification_installations_Element];
}






////////// variants Notification //////////

on envVar VehicleBasicData_Notification_LengthIndicator_Struct_variants
{
  VehicleBasicData_Notification_variants();
}
on envVar VehicleBasicData_Notification_LengthIndicator_Element_variants
{
  VehicleBasicData_Notification_variants();
}
on envVar VehicleBasicData_Notification_variants_elementId
{
  VehicleBasicData_array_variants_elementId[@VehicleBasicData_Notification_variants_Element] = @this;
  VehicleBasicData_Notification_variants();
}
on envVar VehicleBasicData_Notification_variants_adaptiveCruiseControlType
{
  VehicleBasicData_array_variants_adaptiveCruiseControlType[@VehicleBasicData_Notification_variants_Element] = @this;
  VehicleBasicData_Notification_variants();
}
on envVar VehicleBasicData_Notification_variants_engineType
{
  VehicleBasicData_array_variants_engineType[@VehicleBasicData_Notification_variants_Element] = @this;
  VehicleBasicData_Notification_variants();
}
on envVar VehicleBasicData_Notification_variants_steeringWheelPosition
{
  VehicleBasicData_array_variants_steeringWheelPosition[@VehicleBasicData_Notification_variants_Element] = @this;
  VehicleBasicData_Notification_variants();
}
on envVar VehicleBasicData_Notification_variants_fuelType
{
  VehicleBasicData_array_variants_fuelType[@VehicleBasicData_Notification_variants_Element] = @this;
  VehicleBasicData_Notification_variants();
}
on envVar VehicleBasicData_Notification_variants_hybridType
{
  VehicleBasicData_array_variants_hybridType[@VehicleBasicData_Notification_variants_Element] = @this;
  VehicleBasicData_Notification_variants();
}
on envVar VehicleBasicData_Notification_variants_elementId_available
{
  VehicleBasicData_array_variants_elementId_available[@VehicleBasicData_Notification_variants_Element] = @this;
  VehicleBasicData_Notification_variants();
}
on envVar VehicleBasicData_Notification_variants_adaptiveCruiseControlType_available
{
  VehicleBasicData_array_variants_adaptiveCruiseControlType_available[@VehicleBasicData_Notification_variants_Element] = @this;
  VehicleBasicData_Notification_variants();
}
on envVar VehicleBasicData_Notification_variants_engineType_available
{
  VehicleBasicData_array_variants_engineType_available[@VehicleBasicData_Notification_variants_Element] = @this;
  VehicleBasicData_Notification_variants();
}
on envVar VehicleBasicData_Notification_variants_steeringWheelPosition_available
{
  VehicleBasicData_array_variants_steeringWheelPosition_available[@VehicleBasicData_Notification_variants_Element] = @this;
  VehicleBasicData_Notification_variants();
}
on envVar VehicleBasicData_Notification_variants_fuelType_available
{
  VehicleBasicData_array_variants_fuelType_available[@VehicleBasicData_Notification_variants_Element] = @this;
  VehicleBasicData_Notification_variants();
}
on envVar VehicleBasicData_Notification_variants_hybridType_available
{
  VehicleBasicData_array_variants_hybridType_available[@VehicleBasicData_Notification_variants_Element] = @this;
  VehicleBasicData_Notification_variants();
}
on envVar VehicleBasicData_Notification_variants_Payload
{
  VehicleBasicData_Notification_variants_update();
}


VehicleBasicData_Notification_variants()
{
  word payload_counter = 0;
  word start_pos       = 0;
  word element_length  = 0;
  
  // Length Indicator Struct - Platzhalter
  payload_counter = 0+4;
  start_pos = 0;
  
  for (j=0; j<@VehicleBasicData_Notification_variants_Element_TotalNum; j++)
  {
    VehicleBasicData_array_variants_available_functions[j] = VehicleBasicData_array_variants_elementId_available[j]
                                                           + VehicleBasicData_array_variants_adaptiveCruiseControlType_available[j]
                                                           + VehicleBasicData_array_variants_engineType_available[j]
                                                           + VehicleBasicData_array_variants_steeringWheelPosition_available[j]
                                                           + VehicleBasicData_array_variants_fuelType_available[j]
                                                           + VehicleBasicData_array_variants_hybridType_available[j];
    
    // Length Indicator Element - Platzhalter
    if (VehicleBasicData_array_variants_available_functions[j] > 0)
    {
      start_pos = payload_counter;
      payload_counter = payload_counter + 4;
    }
    else 
      start_pos = payload_counter;
    
    
    // 0 elementId (uint32)
    if (VehicleBasicData_array_variants_elementId_available[j] == 1)
    {
      tag_dataID = 0;
      VehicleBasicData_payload_buffer_variants[payload_counter++] = 2 * 16 /* Wiretype = 2  =^ 32 Bit */ + ((tag_dataID>>8) & 0x0F) /* DataID High Part */ ;
      VehicleBasicData_payload_buffer_variants[payload_counter++] = tag_dataID & 0xFF /* DataID Low Part */ ;
      
      VehicleBasicData_payload_buffer_variants[payload_counter++] = VehicleBasicData_array_variants_elementId[j]>>24 & 0xFF;
      VehicleBasicData_payload_buffer_variants[payload_counter++] = VehicleBasicData_array_variants_elementId[j]>>16 & 0xFF;
      VehicleBasicData_payload_buffer_variants[payload_counter++] = VehicleBasicData_array_variants_elementId[j]>> 8 & 0xFF;
      VehicleBasicData_payload_buffer_variants[payload_counter++] = VehicleBasicData_array_variants_elementId[j]     & 0xFF;
    }
    
    
    // 1 adaptiveCruiseControlType (enum32)
    if (VehicleBasicData_array_variants_adaptiveCruiseControlType_available[j] == 1)
    {
      tag_dataID = 1;
      VehicleBasicData_payload_buffer_variants[payload_counter++] = 2 * 16 /* Wiretype = 2  =^ 32 Bit */ + ((tag_dataID>>8) & 0x0F) /* DataID High Part */ ;
      VehicleBasicData_payload_buffer_variants[payload_counter++] = tag_dataID & 0xFF /* DataID Low Part */ ;
      
      VehicleBasicData_payload_buffer_variants[payload_counter++] = VehicleBasicData_array_variants_adaptiveCruiseControlType[j]>>24 & 0xFF;
      VehicleBasicData_payload_buffer_variants[payload_counter++] = VehicleBasicData_array_variants_adaptiveCruiseControlType[j]>>16 & 0xFF;
      VehicleBasicData_payload_buffer_variants[payload_counter++] = VehicleBasicData_array_variants_adaptiveCruiseControlType[j]>> 8 & 0xFF;
      VehicleBasicData_payload_buffer_variants[payload_counter++] = VehicleBasicData_array_variants_adaptiveCruiseControlType[j]     & 0xFF;
    }
    
    
    // 2 engineType (enum32)
    if (VehicleBasicData_array_variants_engineType_available[j] == 1)
    {
      tag_dataID = 2;
      VehicleBasicData_payload_buffer_variants[payload_counter++] = 2 * 16 /* Wiretype = 2  =^ 32 Bit */ + ((tag_dataID>>8) & 0x0F) /* DataID High Part */ ;
      VehicleBasicData_payload_buffer_variants[payload_counter++] = tag_dataID & 0xFF /* DataID Low Part */ ;
      
      VehicleBasicData_payload_buffer_variants[payload_counter++] = VehicleBasicData_array_variants_engineType[j]>>24 & 0xFF;
      VehicleBasicData_payload_buffer_variants[payload_counter++] = VehicleBasicData_array_variants_engineType[j]>>16 & 0xFF;
      VehicleBasicData_payload_buffer_variants[payload_counter++] = VehicleBasicData_array_variants_engineType[j]>> 8 & 0xFF;
      VehicleBasicData_payload_buffer_variants[payload_counter++] = VehicleBasicData_array_variants_engineType[j]     & 0xFF;
    }
    
    
    // 3 steeringWheelPosition (enum32)
    if (VehicleBasicData_array_variants_steeringWheelPosition_available[j] == 1)
    {
      tag_dataID = 3;
      VehicleBasicData_payload_buffer_variants[payload_counter++] = 2 * 16 /* Wiretype = 2  =^ 32 Bit */ + ((tag_dataID>>8) & 0x0F) /* DataID High Part */ ;
      VehicleBasicData_payload_buffer_variants[payload_counter++] = tag_dataID & 0xFF /* DataID Low Part */ ;
      
      VehicleBasicData_payload_buffer_variants[payload_counter++] = VehicleBasicData_array_variants_steeringWheelPosition[j]>>24 & 0xFF;
      VehicleBasicData_payload_buffer_variants[payload_counter++] = VehicleBasicData_array_variants_steeringWheelPosition[j]>>16 & 0xFF;
      VehicleBasicData_payload_buffer_variants[payload_counter++] = VehicleBasicData_array_variants_steeringWheelPosition[j]>> 8 & 0xFF;
      VehicleBasicData_payload_buffer_variants[payload_counter++] = VehicleBasicData_array_variants_steeringWheelPosition[j]     & 0xFF;
    }
    
    
    // 4 fuelType (enum32)
    if (VehicleBasicData_array_variants_fuelType_available[j] == 1)
    {
      tag_dataID = 4;
      VehicleBasicData_payload_buffer_variants[payload_counter++] = 2 * 16 /* Wiretype = 2  =^ 32 Bit */ + ((tag_dataID>>8) & 0x0F) /* DataID High Part */ ;
      VehicleBasicData_payload_buffer_variants[payload_counter++] = tag_dataID & 0xFF /* DataID Low Part */ ;
      
      VehicleBasicData_payload_buffer_variants[payload_counter++] = VehicleBasicData_array_variants_fuelType[j]>>24 & 0xFF;
      VehicleBasicData_payload_buffer_variants[payload_counter++] = VehicleBasicData_array_variants_fuelType[j]>>16 & 0xFF;
      VehicleBasicData_payload_buffer_variants[payload_counter++] = VehicleBasicData_array_variants_fuelType[j]>> 8 & 0xFF;
      VehicleBasicData_payload_buffer_variants[payload_counter++] = VehicleBasicData_array_variants_fuelType[j]     & 0xFF;
    }
    
    // 5 hybridType (enum32)
    if (VehicleBasicData_array_variants_hybridType_available[j] == 1)
    {
      tag_dataID = 5;
      VehicleBasicData_payload_buffer_variants[payload_counter++] = 2 * 16 /* Wiretype = 2  =^ 32 Bit */ + ((tag_dataID>>8) & 0x0F) /* DataID High Part */ ;
      VehicleBasicData_payload_buffer_variants[payload_counter++] = tag_dataID & 0xFF /* DataID Low Part */ ;
      
      VehicleBasicData_payload_buffer_variants[payload_counter++] = VehicleBasicData_array_variants_hybridType[j]>>24 & 0xFF;
      VehicleBasicData_payload_buffer_variants[payload_counter++] = VehicleBasicData_array_variants_hybridType[j]>>16 & 0xFF;
      VehicleBasicData_payload_buffer_variants[payload_counter++] = VehicleBasicData_array_variants_hybridType[j]>> 8 & 0xFF;
      VehicleBasicData_payload_buffer_variants[payload_counter++] = VehicleBasicData_array_variants_hybridType[j]     & 0xFF;
    }
    
    
    //Element Length
    element_length = payload_counter-start_pos;
    if (element_length >0) VehicleBasicData_array_variants_array_element_length[j] = element_length - 4;
    else                   VehicleBasicData_array_variants_array_element_length[j] = element_length;
    
    VehicleBasicData_payload_buffer_variants[start_pos++] = VehicleBasicData_array_variants_array_element_length[j]>>24 & 0xFF;
    VehicleBasicData_payload_buffer_variants[start_pos++] = VehicleBasicData_array_variants_array_element_length[j]>>16 & 0xFF;
    VehicleBasicData_payload_buffer_variants[start_pos++] = VehicleBasicData_array_variants_array_element_length[j]>> 8 & 0xFF;
    VehicleBasicData_payload_buffer_variants[start_pos++] = VehicleBasicData_array_variants_array_element_length[j]     & 0xFF;
    
    if (VehicleBasicData_array_variants_array_element_length[j] == 0) payload_counter = payload_counter+4;
  }
  
  // Struct Length
  VehicleBasicData_array_variants_struct_element_length = 4*@VehicleBasicData_Notification_variants_Element_TotalNum;

  for (k=0;k<@VehicleBasicData_Notification_variants_Element_TotalNum;k++)
    VehicleBasicData_array_variants_struct_element_length = VehicleBasicData_array_variants_struct_element_length + VehicleBasicData_array_variants_array_element_length[k];
  
  VehicleBasicData_payload_buffer_variants[0] = VehicleBasicData_array_variants_struct_element_length>>24 & 0xFF;
  VehicleBasicData_payload_buffer_variants[1] = VehicleBasicData_array_variants_struct_element_length>>16 & 0xFF;
  VehicleBasicData_payload_buffer_variants[2] = VehicleBasicData_array_variants_struct_element_length>> 8 & 0xFF;
  VehicleBasicData_payload_buffer_variants[3] = VehicleBasicData_array_variants_struct_element_length     & 0xFF;


  VehicleBasicData_payload_length_variants = VehicleBasicData_array_variants_struct_element_length+4;
  putvalue(VehicleBasicData_Notification_variants_Payload, VehicleBasicData_payload_buffer_variants, VehicleBasicData_payload_length_variants);
}

on envVar VehicleBasicData_Notification_variants_Element_TotalNum
{
  if (@this == 0) @this =  1;
  if (@this > 10) @this = 10;
  
  VehicleBasicData_Notification_variants();
  VehicleBasicData_Notification_variants_update();
}

on envVar VehicleBasicData_Notification_variants_Element
{
  VehicleBasicData_Notification_variants_update();
}

on envVar VehicleBasicData_Notification_variants_Element_Next
{
  if (@this == 1 && @VehicleBasicData_Notification_variants_Element < @VehicleBasicData_Notification_variants_Element_TotalNum - 1)
  {
    @VehicleBasicData_Notification_variants_Element = @VehicleBasicData_Notification_variants_Element + 1;
    VehicleBasicData_Notification_variants_update();
  }
}

on envVar VehicleBasicData_Notification_variants_Element_Previous
{
  if (@this == 1 && @VehicleBasicData_Notification_variants_Element > 0)
  {
    @VehicleBasicData_Notification_variants_Element = @VehicleBasicData_Notification_variants_Element - 1;
    VehicleBasicData_Notification_variants_update();
  }
}

VehicleBasicData_Notification_variants_update()
{
  @VehicleBasicData_Notification_LengthIndicator_Element_variants = VehicleBasicData_array_variants_array_element_length[@VehicleBasicData_Notification_variants_Element];
  @VehicleBasicData_Notification_LengthIndicator_Struct_variants  = VehicleBasicData_array_variants_struct_element_length;
  @VehicleBasicData_Notification_Length_variants                  = VehicleBasicData_payload_length_variants+8;
  
  @VehicleBasicData_Notification_variants_elementId                 = VehicleBasicData_array_variants_elementId[@VehicleBasicData_Notification_variants_Element];
  @VehicleBasicData_Notification_variants_adaptiveCruiseControlType = VehicleBasicData_array_variants_adaptiveCruiseControlType[@VehicleBasicData_Notification_variants_Element];
  @VehicleBasicData_Notification_variants_engineType                = VehicleBasicData_array_variants_engineType[@VehicleBasicData_Notification_variants_Element];
  @VehicleBasicData_Notification_variants_steeringWheelPosition     = VehicleBasicData_array_variants_steeringWheelPosition[@VehicleBasicData_Notification_variants_Element];
  @VehicleBasicData_Notification_variants_fuelType                  = VehicleBasicData_array_variants_fuelType[@VehicleBasicData_Notification_variants_Element];
  @VehicleBasicData_Notification_variants_hybridType                = VehicleBasicData_array_variants_hybridType[@VehicleBasicData_Notification_variants_Element];
  
  @VehicleBasicData_Notification_variants_elementId_available                 = VehicleBasicData_array_variants_elementId_available[@VehicleBasicData_Notification_variants_Element];
  @VehicleBasicData_Notification_variants_adaptiveCruiseControlType_available = VehicleBasicData_array_variants_adaptiveCruiseControlType_available[@VehicleBasicData_Notification_variants_Element];
  @VehicleBasicData_Notification_variants_engineType_available                = VehicleBasicData_array_variants_engineType_available[@VehicleBasicData_Notification_variants_Element];
  @VehicleBasicData_Notification_variants_steeringWheelPosition_available     = VehicleBasicData_array_variants_steeringWheelPosition_available[@VehicleBasicData_Notification_variants_Element];
  @VehicleBasicData_Notification_variants_fuelType_available                  = VehicleBasicData_array_variants_fuelType_available[@VehicleBasicData_Notification_variants_Element];
  @VehicleBasicData_Notification_variants_hybridType_available                = VehicleBasicData_array_variants_hybridType_available[@VehicleBasicData_Notification_variants_Element];
}





////////// parameters Notification //////////

on envVar VehicleBasicData_Notification_LengthIndicator_Struct_parameters
{
  VehicleBasicData_Notification_parameters();
}
on envVar VehicleBasicData_Notification_LengthIndicator_Element_parameters
{
  VehicleBasicData_Notification_parameters();
}
on envVar VehicleBasicData_Notification_parameters_elementId
{
  VehicleBasicData_array_parameters_elementId[@VehicleBasicData_Notification_parameters_Element] = @this;
  VehicleBasicData_Notification_parameters();
}
on envVar VehicleBasicData_Notification_parameters_tyreCircumference
{
  VehicleBasicData_array_parameters_tyreCircumference[@VehicleBasicData_Notification_parameters_Element] = @this;
  VehicleBasicData_Notification_parameters();
}
on envVar VehicleBasicData_Notification_parameters_elementId_available
{
  VehicleBasicData_array_parameters_elementId_available[@VehicleBasicData_Notification_parameters_Element] = @this;
  VehicleBasicData_Notification_parameters();
}
on envVar VehicleBasicData_Notification_parameters_tyreCircumference_available
{
  VehicleBasicData_array_parameters_tyreCircumference_available[@VehicleBasicData_Notification_parameters_Element] = @this;
  VehicleBasicData_Notification_parameters();
}
on envVar VehicleBasicData_Notification_parameters_Payload
{
  VehicleBasicData_Notification_parameters_update();
}


VehicleBasicData_Notification_parameters()
{
  word payload_counter = 0;
  word start_pos       = 0;
  word element_length  = 0;
  
  // Length Indicator Struct - Platzhalter
  payload_counter = 0+4;
  start_pos = 0;
  
  for (j=0; j<@VehicleBasicData_Notification_parameters_Element_TotalNum; j++)
  {
    VehicleBasicData_array_parameters_available_functions[j] = VehicleBasicData_array_parameters_elementId_available[j]
                                                             + VehicleBasicData_array_parameters_tyreCircumference_available[j];
    
    // Length Indicator Element - Platzhalter
    if (VehicleBasicData_array_parameters_available_functions[j] > 0)
    {
      start_pos = payload_counter;
      payload_counter = payload_counter + 4;
    }
    else 
      start_pos = payload_counter;
    
    
    // 0 elementId (uint32)
    if (VehicleBasicData_array_parameters_elementId_available[j] == 1)
    {
      tag_dataID = 0;
      VehicleBasicData_payload_buffer_parameters[payload_counter++] = 2 * 16 /* Wiretype = 2  =^ 32 Bit */ + ((tag_dataID>>8) & 0x0F) /* DataID High Part */ ;
      VehicleBasicData_payload_buffer_parameters[payload_counter++] = tag_dataID & 0xFF /* DataID Low Part */ ;
      
      VehicleBasicData_payload_buffer_parameters[payload_counter++] = VehicleBasicData_array_parameters_elementId[j]>>24 & 0xFF;
      VehicleBasicData_payload_buffer_parameters[payload_counter++] = VehicleBasicData_array_parameters_elementId[j]>>16 & 0xFF;
      VehicleBasicData_payload_buffer_parameters[payload_counter++] = VehicleBasicData_array_parameters_elementId[j]>> 8 & 0xFF;
      VehicleBasicData_payload_buffer_parameters[payload_counter++] = VehicleBasicData_array_parameters_elementId[j]     & 0xFF;
    }
    
    // 1 tyreCircumference (uint32)
    if (VehicleBasicData_array_parameters_tyreCircumference_available[j] == 1)
    {
      tag_dataID = 1;
      VehicleBasicData_payload_buffer_parameters[payload_counter++] = 2 * 16 /* Wiretype = 2  =^ 32 Bit */ + ((tag_dataID>>8) & 0x0F) /* DataID High Part */ ;
      VehicleBasicData_payload_buffer_parameters[payload_counter++] = tag_dataID & 0xFF /* DataID Low Part */ ;
      
      VehicleBasicData_payload_buffer_parameters[payload_counter++] = VehicleBasicData_array_parameters_tyreCircumference[j]>>24 & 0xFF;
      VehicleBasicData_payload_buffer_parameters[payload_counter++] = VehicleBasicData_array_parameters_tyreCircumference[j]>>16 & 0xFF;
      VehicleBasicData_payload_buffer_parameters[payload_counter++] = VehicleBasicData_array_parameters_tyreCircumference[j]>> 8 & 0xFF;
      VehicleBasicData_payload_buffer_parameters[payload_counter++] = VehicleBasicData_array_parameters_tyreCircumference[j]     & 0xFF;
    }
    
    
    //Element Length
    element_length = payload_counter-start_pos;
    if (element_length >0) VehicleBasicData_array_parameters_array_element_length[j] = element_length - 4;
    else                   VehicleBasicData_array_parameters_array_element_length[j] = element_length;
    
    VehicleBasicData_payload_buffer_parameters[start_pos++] = VehicleBasicData_array_parameters_array_element_length[j]>>24 & 0xFF;
    VehicleBasicData_payload_buffer_parameters[start_pos++] = VehicleBasicData_array_parameters_array_element_length[j]>>16 & 0xFF;
    VehicleBasicData_payload_buffer_parameters[start_pos++] = VehicleBasicData_array_parameters_array_element_length[j]>> 8 & 0xFF;
    VehicleBasicData_payload_buffer_parameters[start_pos++] = VehicleBasicData_array_parameters_array_element_length[j]     & 0xFF;
    
    if (VehicleBasicData_array_parameters_array_element_length[j] == 0) payload_counter = payload_counter+4;
  }
  
  // Struct Length
  VehicleBasicData_array_parameters_struct_element_length = 4*@VehicleBasicData_Notification_parameters_Element_TotalNum;

  for (k=0;k<@VehicleBasicData_Notification_parameters_Element_TotalNum;k++)
    VehicleBasicData_array_parameters_struct_element_length = VehicleBasicData_array_parameters_struct_element_length + VehicleBasicData_array_parameters_array_element_length[k];
  
  VehicleBasicData_payload_buffer_parameters[0] = VehicleBasicData_array_parameters_struct_element_length>>24 & 0xFF;
  VehicleBasicData_payload_buffer_parameters[1] = VehicleBasicData_array_parameters_struct_element_length>>16 & 0xFF;
  VehicleBasicData_payload_buffer_parameters[2] = VehicleBasicData_array_parameters_struct_element_length>> 8 & 0xFF;
  VehicleBasicData_payload_buffer_parameters[3] = VehicleBasicData_array_parameters_struct_element_length     & 0xFF;


  VehicleBasicData_payload_length_parameters = VehicleBasicData_array_parameters_struct_element_length+4;
  putvalue(VehicleBasicData_Notification_parameters_Payload, VehicleBasicData_payload_buffer_parameters, VehicleBasicData_payload_length_parameters);
}

on envVar VehicleBasicData_Notification_parameters_Element_TotalNum
{
  if (@this == 0) @this =  1;
  if (@this > 10) @this = 10;
  
  VehicleBasicData_Notification_parameters();
  VehicleBasicData_Notification_parameters_update();
}

on envVar VehicleBasicData_Notification_parameters_Element
{
  VehicleBasicData_Notification_parameters_update();
}

on envVar VehicleBasicData_Notification_parameters_Element_Next
{
  if (@this == 1 && @VehicleBasicData_Notification_parameters_Element < @VehicleBasicData_Notification_parameters_Element_TotalNum - 1)
  {
    @VehicleBasicData_Notification_parameters_Element = @VehicleBasicData_Notification_parameters_Element + 1;
    VehicleBasicData_Notification_parameters_update();
  }
}

on envVar VehicleBasicData_Notification_parameters_Element_Previous
{
  if (@this == 1 && @VehicleBasicData_Notification_parameters_Element > 0)
  {
    @VehicleBasicData_Notification_parameters_Element = @VehicleBasicData_Notification_parameters_Element - 1;
    VehicleBasicData_Notification_parameters_update();
  }
}

VehicleBasicData_Notification_parameters_update()
{
  @VehicleBasicData_Notification_LengthIndicator_Element_parameters = VehicleBasicData_array_parameters_array_element_length[@VehicleBasicData_Notification_parameters_Element];
  @VehicleBasicData_Notification_LengthIndicator_Struct_parameters  = VehicleBasicData_array_parameters_struct_element_length;
  @VehicleBasicData_Notification_Length_parameters                  = VehicleBasicData_payload_length_parameters+8;
  
  @VehicleBasicData_Notification_parameters_elementId         = VehicleBasicData_array_parameters_elementId[@VehicleBasicData_Notification_parameters_Element];
  @VehicleBasicData_Notification_parameters_tyreCircumference = VehicleBasicData_array_parameters_tyreCircumference[@VehicleBasicData_Notification_parameters_Element];
  
  @VehicleBasicData_Notification_parameters_elementId_available         = VehicleBasicData_array_parameters_elementId_available[@VehicleBasicData_Notification_parameters_Element];
  @VehicleBasicData_Notification_parameters_tyreCircumference_available = VehicleBasicData_array_parameters_tyreCircumference_available[@VehicleBasicData_Notification_parameters_Element];
}






////////////////////////////////////////////////////////
////////////////// Service Powertrain //////////////////
////////////////////////////////////////////////////////

on envVar ServiceDiscovery_Offer_Service_Powertrain
{
  Send_ServiceDiscovery_Offer_Service_ICAS1Gateway();
}

on envVar Powertrain_Notification_notifications_Send
{
  if (@this == 1)
  {
    UDP_Segments_total = @Powertrain_Notification_Length_notifications/1404 + 1;
    UDP_Segments_left  = UDP_Segments_total;
    
    if (UDP_Segments_total > 1) seg_id_flag = 1;
    else                        seg_id_flag = 0;
    
    Send_Service_Powertrain_Notification (0xC010 & 0x0000FFFF);
  }
}
on envVar Powertrain_Notification_notifications_Send_cyclic
{
  if (@this == 1)
    setTimercyclic (tPowertrain_Notification_notifications_Send, @Powertrain_Notification_notifications_Send_cyclic_cycletime);
  else
    cancelTimer (tPowertrain_Notification_notifications_Send);
}
on envVar Powertrain_Notification_notifications_Send_cyclic_cycletime
{
  if (@Powertrain_Notification_notifications_Send_cyclic == 1)
  {
    cancelTimer (tPowertrain_Notification_notifications_Send);
    setTimercyclic (tPowertrain_Notification_notifications_Send, @this);
  }
}
on timer tPowertrain_Notification_notifications_Send
{
  UDP_Segments_total = @Powertrain_Notification_Length_notifications/1404 + 1;
  UDP_Segments_left  = UDP_Segments_total;
  
  if (UDP_Segments_total > 1) seg_id_flag = 1;
  else                        seg_id_flag = 0;
    
  Send_Service_Powertrain_Notification (0xC010 & 0x0000FFFF);
}

on envVar Powertrain_Notification_displayValues_Send
{
  if (@this == 1)
  {
    UDP_Segments_total = @Powertrain_Notification_Length_displayValues/1404 + 1;
    UDP_Segments_left  = UDP_Segments_total;
    
    if (UDP_Segments_total > 1) seg_id_flag = 1;
    else                        seg_id_flag = 0;
    
    Send_Service_Powertrain_Notification (0xC020 & 0x0000FFFF);
  }
}
on envVar Powertrain_Notification_displayValues_Send_cyclic
{
  if (@this == 1)
    setTimercyclic (tPowertrain_Notification_displayValues_Send, @Powertrain_Notification_displayValues_Send_cyclic_cycletime);
  else
    cancelTimer (tPowertrain_Notification_displayValues_Send);
}
on envVar Powertrain_Notification_displayValues_Send_cyclic_cycletime
{
  if (@Powertrain_Notification_displayValues_Send_cyclic == 1)
  {
    cancelTimer (tPowertrain_Notification_displayValues_Send);
    setTimercyclic (tPowertrain_Notification_displayValues_Send, @this);
  }
}
on timer tPowertrain_Notification_displayValues_Send
{
  UDP_Segments_total = @Powertrain_Notification_Length_displayValues/1404 + 1;
  UDP_Segments_left  = UDP_Segments_total;
  
  if (UDP_Segments_total > 1) seg_id_flag = 1;
  else                        seg_id_flag = 0;
    
  Send_Service_Powertrain_Notification (0xC020 & 0x0000FFFF);
}

on envVar Powertrain_Notification_status_Send
{
  if (@this == 1)
  {
    UDP_Segments_total = @Powertrain_Notification_Length_status/1404 + 1;
    UDP_Segments_left  = UDP_Segments_total;
    
    if (UDP_Segments_total > 1) seg_id_flag = 1;
    else                        seg_id_flag = 0;
    
    Send_Service_Powertrain_Notification (0xC030 & 0x0000FFFF);
  }
}
on envVar Powertrain_Notification_status_Send_cyclic
{
  if (@this == 1)
    setTimercyclic (tPowertrain_Notification_status_Send, @Powertrain_Notification_status_Send_cyclic_cycletime);
  else
    cancelTimer (tPowertrain_Notification_status_Send);
}
on envVar Powertrain_Notification_status_Send_cyclic_cycletime
{
  if (@Powertrain_Notification_status_Send_cyclic == 1)
  {
    cancelTimer (tPowertrain_Notification_status_Send);
    setTimercyclic (tPowertrain_Notification_status_Send, @this);
  }
}
on timer tPowertrain_Notification_status_Send
{
  UDP_Segments_total = @Powertrain_Notification_Length_status/1404 + 1;
  UDP_Segments_left  = UDP_Segments_total;
  
  if (UDP_Segments_total > 1) seg_id_flag = 1;
  else                        seg_id_flag = 0;
    
  Send_Service_Powertrain_Notification (0xC030 & 0x0000FFFF);
}


Send_Service_Powertrain_Notification (word MethodID)
{
  ethernetPacket EthPaket;

  // Ethernet Packet - MAC Source address
  getvalue (ServiceDiscovery_EthernetPacket_MAC_Source_ICAS1Gateway, buffer_MAC);
  //EthPaket.source.ParseAddress ( buffer_MAC );
  EthPaket.source = ethGetMacAddressAsNumber (buffer_MAC);
  
  // Ethernet Packet - MAC Destination address
  getvalue (ServiceDiscovery_EthernetPacket_MAC_Destination, buffer_MAC);
  //EthPaket.destination.ParseAddress ( buffer_MAC );
  EthPaket.destination = ethGetMacAddressAsNumber (buffer_MAC);
  
  // Ethernet Packet - VLAN
  EthPaket.SetVlan (@ServiceDiscovery_EthernetPacket_VLAN_TPID, @ServiceDiscovery_EthernetPacket_VLAN_TCI);
  
  // Ethernet Packet - Type
  //EthPaket.ipv6.type = @EthernetPacket_Type;
  if (@ServiceDiscovery_EthernetPacket_Type == 0x86DD) EthPaket.ipv6.Init();
  
  
  // IPv6 Packet - Version
  EthPaket.ipv6.version = @ServiceDiscovery_IPv6Packet_Version;

  // IPv6 Packet - Traffic Class
  EthPaket.ipv6.class = @ServiceDiscovery_IPv6Packet_Traffic_Class;
  
  // IPv6 Packet - Flow Label
  EthPaket.ipv6.flow = @ServiceDiscovery_IPv6Packet_Flow_Label;
  
  // IPv6 Packet - Payload_Length
  EthPaket.ipv6.length = @ServiceDiscovery_IPv6Packet_Payload_Length;
  
  // IPv6 Packet - Next Header
  EthPaket.ipv6.next = @ServiceDiscovery_IPv6Packet_Next_Header;
  if (@ServiceDiscovery_IPv6Packet_Next_Header == 6) EthPaket.tcp.Init();
  if (@ServiceDiscovery_IPv6Packet_Next_Header == 17) EthPaket.udp.Init();
  
  // IPv6 Packet - Hop Limit
  EthPaket.ipv6.hopLimit = @ServiceDiscovery_IPv6Packet_Hop_Limit;

  // IPv6 Packet - IPv6 Destination address    // TODO: char array zu byte array
  buffer_ipv6[0]  = @ServiceDiscovery_IPv6Packet_IP_Destination_Unicast_01>>8 & 0xFF;
  buffer_ipv6[1]  = @ServiceDiscovery_IPv6Packet_IP_Destination_Unicast_01    & 0xFF;
  buffer_ipv6[2]  = @ServiceDiscovery_IPv6Packet_IP_Destination_Unicast_02>>8 & 0xFF;
  buffer_ipv6[3]  = @ServiceDiscovery_IPv6Packet_IP_Destination_Unicast_02    & 0xFF;
  buffer_ipv6[4]  = @ServiceDiscovery_IPv6Packet_IP_Destination_Unicast_03>>8 & 0xFF;
  buffer_ipv6[5]  = @ServiceDiscovery_IPv6Packet_IP_Destination_Unicast_03    & 0xFF;
  buffer_ipv6[6]  = @ServiceDiscovery_IPv6Packet_IP_Destination_Unicast_04>>8 & 0xFF;
  buffer_ipv6[7]  = @ServiceDiscovery_IPv6Packet_IP_Destination_Unicast_04    & 0xFF;
  buffer_ipv6[8]  = @ServiceDiscovery_IPv6Packet_IP_Destination_Unicast_05>>8 & 0xFF;
  buffer_ipv6[9]  = @ServiceDiscovery_IPv6Packet_IP_Destination_Unicast_05    & 0xFF;
  buffer_ipv6[10] = @ServiceDiscovery_IPv6Packet_IP_Destination_Unicast_06>>8 & 0xFF;
  buffer_ipv6[11] = @ServiceDiscovery_IPv6Packet_IP_Destination_Unicast_06    & 0xFF;
  buffer_ipv6[12] = @ServiceDiscovery_IPv6Packet_IP_Destination_Unicast_07>>8 & 0xFF;
  buffer_ipv6[13] = @ServiceDiscovery_IPv6Packet_IP_Destination_Unicast_07    & 0xFF;
  buffer_ipv6[14] = @ServiceDiscovery_IPv6Packet_IP_Destination_Unicast_08>>8 & 0xFF;
  buffer_ipv6[15] = @ServiceDiscovery_IPv6Packet_IP_Destination_Unicast_08    & 0xFF;
  EthPaket.ipv6.destination.SetData ( 0, buffer_ipv6, elcount(buffer_ipv6) );

  // IPv6 Packet - IPv6 Source address    // TODO: char array zu byte array
  buffer_ipv6[0]  = @ServiceDiscovery_IPv6Packet_IP_Source_ICAS1Gateway_01>>8 & 0xFF;
  buffer_ipv6[1]  = @ServiceDiscovery_IPv6Packet_IP_Source_ICAS1Gateway_01    & 0xFF;
  buffer_ipv6[2]  = @ServiceDiscovery_IPv6Packet_IP_Source_ICAS1Gateway_02>>8 & 0xFF;
  buffer_ipv6[3]  = @ServiceDiscovery_IPv6Packet_IP_Source_ICAS1Gateway_02    & 0xFF;
  buffer_ipv6[4]  = @ServiceDiscovery_IPv6Packet_IP_Source_ICAS1Gateway_03>>8 & 0xFF;
  buffer_ipv6[5]  = @ServiceDiscovery_IPv6Packet_IP_Source_ICAS1Gateway_03    & 0xFF;
  buffer_ipv6[6]  = @ServiceDiscovery_IPv6Packet_IP_Source_ICAS1Gateway_04>>8 & 0xFF;
  buffer_ipv6[7]  = @ServiceDiscovery_IPv6Packet_IP_Source_ICAS1Gateway_04    & 0xFF;
  buffer_ipv6[8]  = @ServiceDiscovery_IPv6Packet_IP_Source_ICAS1Gateway_05>>8 & 0xFF;
  buffer_ipv6[9]  = @ServiceDiscovery_IPv6Packet_IP_Source_ICAS1Gateway_05    & 0xFF;
  buffer_ipv6[10] = @ServiceDiscovery_IPv6Packet_IP_Source_ICAS1Gateway_06>>8 & 0xFF;
  buffer_ipv6[11] = @ServiceDiscovery_IPv6Packet_IP_Source_ICAS1Gateway_06    & 0xFF;
  buffer_ipv6[12] = @ServiceDiscovery_IPv6Packet_IP_Source_ICAS1Gateway_07>>8 & 0xFF;
  buffer_ipv6[13] = @ServiceDiscovery_IPv6Packet_IP_Source_ICAS1Gateway_07    & 0xFF;
  buffer_ipv6[14] = @ServiceDiscovery_IPv6Packet_IP_Source_ICAS1Gateway_08>>8 & 0xFF;
  buffer_ipv6[15] = @ServiceDiscovery_IPv6Packet_IP_Source_ICAS1Gateway_08    & 0xFF;
  EthPaket.ipv6.source.SetData ( 0, buffer_ipv6, elcount(buffer_ipv6) );

  
  // UDP Packet - Source Port
  EthPaket.udp.source = @Powertrain_Notification_Port_Source;
  
  // UDP Packet - Destination Port
  EthPaket.udp.destination = @Powertrain_Notification_Port_Destination;
  
  // UDP Packet - Length
  EthPaket.udp.length = @ServiceDiscovery_UDPPacket_Length;
  
  
  // SOME/IP Packet aus Rohdaten zusammenbauen (buffer array)
  i=0;
  
  // SOME/IP Packet - Message ID, Service ID [16 bit]
  buffer[i++] = @Powertrain_Notification_Message_ID_Service_ID>>8 & 0xFF;
  buffer[i++] = @Powertrain_Notification_Message_ID_Service_ID    & 0xFF;
  
  // SOME/IP Packet - Message ID, Message ID [16 bit]
  switch (MethodID)
  {
    case 0xC010: @Powertrain_Notification_Message_ID_Method_ID = @Powertrain_Notification_Message_ID_Method_ID_notifications; break;
    case 0xC020: @Powertrain_Notification_Message_ID_Method_ID = @Powertrain_Notification_Message_ID_Method_ID_displayValues; break;
    case 0xC030: @Powertrain_Notification_Message_ID_Method_ID = @Powertrain_Notification_Message_ID_Method_ID_status; break;
  }
  buffer[i++] = @Powertrain_Notification_Message_ID_Method_ID>>8 & 0xFF;
  buffer[i++] = @Powertrain_Notification_Message_ID_Method_ID    & 0xFF;
  
  // SOME/IP Packet - Length [32 bit]
  if (UDP_Segments_total == 1)
  {
    switch (MethodID)
    {
      case 0xC010: @Powertrain_Notification_Length = @Powertrain_Notification_Length_notifications; break;
      case 0xC020: @Powertrain_Notification_Length = @Powertrain_Notification_Length_displayValues; break;
      case 0xC030: @Powertrain_Notification_Length = @Powertrain_Notification_Length_status; break;
    }
  }
  else
  {
    if (UDP_Segments_left > 1)
    {
      switch (MethodID)
      {
        case 0xC010: @Powertrain_Notification_Length = 1404; break;
        case 0xC020: @Powertrain_Notification_Length = 1404; break;
        case 0xC030: @Powertrain_Notification_Length = 1404; break;
      }
    }
    else
    {
      switch (MethodID)
      {
        case 0xC010: @Powertrain_Notification_Length = Powertrain_payload_length_notifications - 1404*(UDP_Segments_total-UDP_Segments_left) + 24; break;
        case 0xC020: @Powertrain_Notification_Length = Powertrain_payload_length_displayValues - 1404*(UDP_Segments_total-UDP_Segments_left) + 24; break;
        case 0xC030: @Powertrain_Notification_Length = Powertrain_payload_length_status        - 1404*(UDP_Segments_total-UDP_Segments_left) + 24; break;
      }
    }
  }
  buffer[i++] = @Powertrain_Notification_Length>>24 & 0xFF;
  buffer[i++] = @Powertrain_Notification_Length>>16 & 0xFF;
  buffer[i++] = @Powertrain_Notification_Length>> 8 & 0xFF;
  buffer[i++] = @Powertrain_Notification_Length     & 0xFF;
  
  // SOME/IP Packet - Request ID, Client ID [16 bit]
  buffer[i++] = @Powertrain_Notification_Request_ID_Client_ID>>8 & 0xFF;
  buffer[i++] = @Powertrain_Notification_Request_ID_Client_ID    & 0xFF;
  
  // SOME/IP Packet - Request ID, Session ID) [16 bit]
  if ((UDP_Segments_total == 1) || (seg_id_flag == 1))
  {
    @ServiceDiscovery_SOMEIPPacket_Notification_Request_ID_Session_ID = @ServiceDiscovery_SOMEIPPacket_Notification_Request_ID_Session_ID + 1;
    if (@ServiceDiscovery_SOMEIPPacket_Notification_Request_ID_Session_ID == 0x10000) @ServiceDiscovery_SOMEIPPacket_Notification_Request_ID_Session_ID = 1;
    seg_id_flag = 0;
  }
  
  buffer[i++] = @ServiceDiscovery_SOMEIPPacket_Notification_Request_ID_Session_ID>>8 & 0xFF;
  buffer[i++] = @ServiceDiscovery_SOMEIPPacket_Notification_Request_ID_Session_ID    & 0xFF;
  
  // SOME/IP Packet - Protocol Version [8 bit]
  buffer[i++] = @Powertrain_Notification_Protocol_Version;
  
  // SOME/IP Packet - Interface Version [8 bit]
  buffer[i++] = @Powertrain_Notification_Interface_Version;
  
  // SOME/IP Packet - Message Type [8 bit]
  buffer[i++] = @Powertrain_Notification_Message_Type;
  
  // SOME/IP Packet - Return Code [8 bit]
  buffer[i++] = @Powertrain_Notification_Return_Code;
  
  
  if (UDP_Segments_total > 1)
  {
    if (UDP_Segments_left >= 0)
    { 
      // Message Type neu setzen
      buffer[i-2] = @Powertrain_Notification_Message_Type + 0x20;
      
      // Offset (16byte Schritte, 1392/16 = 87)
      @Powertrain_Notification_Offset = 87 * (UDP_Segments_total - UDP_Segments_left);
      
      // More Segments Flag
      if (UDP_Segments_left > 1) @Powertrain_Notification_More_Segments_Flag = 1;
      else                       @Powertrain_Notification_More_Segments_Flag = 0;
      
      buffer[i++] =   @Powertrain_Notification_Offset>>20 & 0xFF;
      buffer[i++] =   @Powertrain_Notification_Offset>>12 & 0xFF;
      buffer[i++] =   @Powertrain_Notification_Offset>>4  & 0xFF;
      buffer[i++] = ((@Powertrain_Notification_Offset<<4) & 0xF0) + (@Powertrain_Notification_More_Segments_Flag & 0x01);
    }
  }
  
  UDP_Segments_left--;
  
  ////// notifications notifier //////
  if (MethodID == 0xC010)
  {
    if (UDP_Segments_total == 1)
    {
      for (j=0; j<Powertrain_payload_length_notifications; j++)
        buffer[i++] = Powertrain_payload_buffer_notifications[j];
    }
    else
    {
      if (UDP_Segments_left >= 1)
      {
        for (j=(UDP_Segments_total-UDP_Segments_left-1)*1392; j<(UDP_Segments_total-UDP_Segments_left)*1392; j++)
          buffer[i++] = Powertrain_payload_buffer_notifications[j];
      }
      else
      {
        for (j=(UDP_Segments_total-(UDP_Segments_left+1))*1392; j<Powertrain_payload_length_notifications; j++)
          buffer[i++] = Powertrain_payload_buffer_notifications[j];
      }
    }
  }
  
  ////// displayValues notifier //////
  if (MethodID == 0xC020)
  {
    if (UDP_Segments_total == 1)
    {
      for (j=0; j<Powertrain_payload_length_displayValues; j++)
        buffer[i++] = Powertrain_payload_buffer_displayValues[j];
    }
    else
    {
      if (UDP_Segments_left >= 1)
      {
        for (j=(UDP_Segments_total-UDP_Segments_left-1)*1392; j<(UDP_Segments_total-UDP_Segments_left)*1392; j++)
          buffer[i++] = Powertrain_payload_buffer_displayValues[j];
      }
      else
      {
        for (j=(UDP_Segments_total-(UDP_Segments_left+1))*1392; j<Powertrain_payload_length_displayValues; j++)
          buffer[i++] = Powertrain_payload_buffer_displayValues[j];
      }
    }
  }
  
  ////// status notifier //////
  if (MethodID == 0xC030)
  {
    if (UDP_Segments_total == 1)
    {
      for (j=0; j<Powertrain_payload_length_status; j++)
        buffer[i++] = Powertrain_payload_buffer_status[j];
    }
    else
    {
      if (UDP_Segments_left >= 1)
      {
        for (j=(UDP_Segments_total-UDP_Segments_left-1)*1392; j<(UDP_Segments_total-UDP_Segments_left)*1392; j++)
          buffer[i++] = Powertrain_payload_buffer_status[j];
      }
      else
      {
        for (j=(UDP_Segments_total-(UDP_Segments_left+1))*1392; j<Powertrain_payload_length_status; j++)
          buffer[i++] = Powertrain_payload_buffer_status[j];
      }
    }
  }
  
  
  // Rohdaten in UDP Paket schreiben
  EthPaket.udp.SetData( 0, buffer, i );

  // calculate UDP and IPv6 checksum and send Ethernet packet
  EthPaket.CompletePacket();
  output( EthPaket );
  
  // prüfen ob alle Segemente gesendet wurden, sonst senden erneut aufrufen
  Powertrain_Segmentation_Method_ID = MethodID;
  if (UDP_Segments_left>0)
    settimer(Powertrain_Segmentation_delay, 50);
}

on timer Powertrain_Segmentation_delay
{
  Send_Service_Powertrain_Notification (Powertrain_Segmentation_Method_ID);
}






////////// notifications Notification //////////

on envVar Powertrain_Notification_LengthIndicator_Struct_notifications
{
  Powertrain_Notification_notifications();
}
on envVar Powertrain_Notification_LengthIndicator_Element_notifications
{
  Powertrain_Notification_notifications();
}
on envVar Powertrain_Notification_notifications_type
{
  Powertrain_array_notifications_type[@Powertrain_Notification_notifications_Element] = @this;
  Powertrain_Notification_notifications();
}
on envVar Powertrain_Notification_notifications_value
{
  Powertrain_array_notifications_value[@Powertrain_Notification_notifications_Element] = @this;
  Powertrain_Notification_notifications();
}
on envVar Powertrain_Notification_notifications_type_available
{
  Powertrain_array_notifications_type_available[@Powertrain_Notification_notifications_Element] = @this;
  Powertrain_Notification_notifications();
}
on envVar Powertrain_Notification_notifications_value_available
{
  Powertrain_array_notifications_value_available[@Powertrain_Notification_notifications_Element] = @this;
  Powertrain_Notification_notifications();
}
on envVar Powertrain_Notification_notifications_Payload
{
  Powertrain_Notification_notifications_update();
}


Powertrain_Notification_notifications()
{
  word payload_counter = 0;
  word start_pos       = 0;
  word element_length  = 0;
  
  // Length Indicator Struct - Platzhalter
  payload_counter = 0+4;
  start_pos = 0;
  
  for (j=0; j<@Powertrain_Notification_notifications_Element_TotalNum; j++)
  {
    Powertrain_array_notifications_available_functions[j] = Powertrain_array_notifications_type_available[j]
                                                          + Powertrain_array_notifications_value_available[j];
    
    // Length Indicator Element - Platzhalter
    if (Powertrain_array_notifications_available_functions[j] > 0)
    {
      start_pos = payload_counter;
      payload_counter = payload_counter + 4;
    }
    else 
      start_pos = payload_counter;
    
    
    // 0 type (enum32)
    if (Powertrain_array_notifications_type_available[j] == 1)
    {
      tag_dataID = 0;
      Powertrain_payload_buffer_notifications[payload_counter++] = 2 * 16 /* Wiretype = 2  =^ 32 Bit */ + ((tag_dataID>>8) & 0x0F) /* DataID High Part */ ;
      Powertrain_payload_buffer_notifications[payload_counter++] = tag_dataID & 0xFF /* DataID Low Part */ ;
      
      Powertrain_payload_buffer_notifications[payload_counter++] = Powertrain_array_notifications_type[j]>>24 & 0xFF;
      Powertrain_payload_buffer_notifications[payload_counter++] = Powertrain_array_notifications_type[j]>>16 & 0xFF;
      Powertrain_payload_buffer_notifications[payload_counter++] = Powertrain_array_notifications_type[j]>> 8 & 0xFF;
      Powertrain_payload_buffer_notifications[payload_counter++] = Powertrain_array_notifications_type[j]     & 0xFF;
    }
    
    // 1 value (uint32)
    if (Powertrain_array_notifications_value_available[j] == 1)
    {
      tag_dataID = 1;
      Powertrain_payload_buffer_notifications[payload_counter++] = 2 * 16 /* Wiretype = 2  =^ 32 Bit */ + ((tag_dataID>>8) & 0x0F) /* DataID High Part */ ;
      Powertrain_payload_buffer_notifications[payload_counter++] = tag_dataID & 0xFF /* DataID Low Part */ ;
      
      Powertrain_payload_buffer_notifications[payload_counter++] = Powertrain_array_notifications_value[j]>>24 & 0xFF;
      Powertrain_payload_buffer_notifications[payload_counter++] = Powertrain_array_notifications_value[j]>>16 & 0xFF;
      Powertrain_payload_buffer_notifications[payload_counter++] = Powertrain_array_notifications_value[j]>> 8 & 0xFF;
      Powertrain_payload_buffer_notifications[payload_counter++] = Powertrain_array_notifications_value[j]     & 0xFF;
    }
    
    
    //Element Length
    element_length = payload_counter-start_pos;
    if (element_length >0) Powertrain_array_notifications_array_element_length[j] = element_length - 4;
    else                   Powertrain_array_notifications_array_element_length[j] = element_length;
    
    Powertrain_payload_buffer_notifications[start_pos++] = Powertrain_array_notifications_array_element_length[j]>>24 & 0xFF;
    Powertrain_payload_buffer_notifications[start_pos++] = Powertrain_array_notifications_array_element_length[j]>>16 & 0xFF;
    Powertrain_payload_buffer_notifications[start_pos++] = Powertrain_array_notifications_array_element_length[j]>> 8 & 0xFF;
    Powertrain_payload_buffer_notifications[start_pos++] = Powertrain_array_notifications_array_element_length[j]     & 0xFF;
    
    if (Powertrain_array_notifications_array_element_length[j] == 0) payload_counter = payload_counter+4;
  }
  
  // Struct Length
  Powertrain_array_notifications_struct_element_length = 4*@Powertrain_Notification_notifications_Element_TotalNum;

  for (k=0;k<@Powertrain_Notification_notifications_Element_TotalNum;k++)
    Powertrain_array_notifications_struct_element_length = Powertrain_array_notifications_struct_element_length + Powertrain_array_notifications_array_element_length[k];
  
  Powertrain_payload_buffer_notifications[0] = Powertrain_array_notifications_struct_element_length>>24 & 0xFF;
  Powertrain_payload_buffer_notifications[1] = Powertrain_array_notifications_struct_element_length>>16 & 0xFF;
  Powertrain_payload_buffer_notifications[2] = Powertrain_array_notifications_struct_element_length>> 8 & 0xFF;
  Powertrain_payload_buffer_notifications[3] = Powertrain_array_notifications_struct_element_length     & 0xFF;


  Powertrain_payload_length_notifications = Powertrain_array_notifications_struct_element_length+4;
  putvalue(Powertrain_Notification_notifications_Payload, Powertrain_payload_buffer_notifications, Powertrain_payload_length_notifications);
}

on envVar Powertrain_Notification_notifications_Element_TotalNum
{
  if (@this == 0) @this =  1;
  if (@this > 10) @this = 10;
  
  Powertrain_Notification_notifications();
  Powertrain_Notification_notifications_update();
}

on envVar Powertrain_Notification_notifications_Element
{
  Powertrain_Notification_notifications_update();
}

on envVar Powertrain_Notification_notifications_Element_Next
{
  if (@this == 1 && @Powertrain_Notification_notifications_Element < @Powertrain_Notification_notifications_Element_TotalNum - 1)
  {
    @Powertrain_Notification_notifications_Element = @Powertrain_Notification_notifications_Element + 1;
    Powertrain_Notification_notifications_update();
  }
}

on envVar Powertrain_Notification_notifications_Element_Previous
{
  if (@this == 1 && @Powertrain_Notification_notifications_Element > 0)
  {
    @Powertrain_Notification_notifications_Element = @Powertrain_Notification_notifications_Element - 1;
    Powertrain_Notification_notifications_update();
  }
}

Powertrain_Notification_notifications_update()
{
  @Powertrain_Notification_LengthIndicator_Element_notifications = Powertrain_array_notifications_array_element_length[@Powertrain_Notification_notifications_Element];
  @Powertrain_Notification_LengthIndicator_Struct_notifications  = Powertrain_array_notifications_struct_element_length;
  @Powertrain_Notification_Length_notifications                  = Powertrain_payload_length_notifications+8;
  
  @Powertrain_Notification_notifications_type  = Powertrain_array_notifications_type[@Powertrain_Notification_notifications_Element];
  @Powertrain_Notification_notifications_value = Powertrain_array_notifications_value[@Powertrain_Notification_notifications_Element];
  
  @Powertrain_Notification_notifications_type_available  = Powertrain_array_notifications_type_available[@Powertrain_Notification_notifications_Element];
  @Powertrain_Notification_notifications_value_available = Powertrain_array_notifications_value_available[@Powertrain_Notification_notifications_Element];
}








////////// displayValues Notification //////////

on envVar Powertrain_Notification_LengthIndicator_Struct_displayValues
{
  Powertrain_Notification_displayValues();
}
on envVar Powertrain_Notification_LengthIndicator_Element_displayValues
{
  Powertrain_Notification_displayValues();
}
on envVar Powertrain_Notification_displayValues_elementId
{
  Powertrain_array_displayValues_elementId[@Powertrain_Notification_displayValues_Element] = @this;
  Powertrain_Notification_displayValues();
}
on envVar Powertrain_Notification_displayValues_gearShiftPosition
{
  Powertrain_array_displayValues_gearShiftPosition[@Powertrain_Notification_displayValues_Element] = @this;
  Powertrain_Notification_displayValues();
}
on envVar Powertrain_Notification_displayValues_recuperationLevel
{
  Powertrain_array_displayValues_recuperationLevel[@Powertrain_Notification_displayValues_Element] = @this;
  Powertrain_Notification_displayValues();
}
on envVar Powertrain_Notification_displayValues_isPowertrainActive
{
  Powertrain_array_displayValues_isPowertrainActive[@Powertrain_Notification_displayValues_Element] = @this;
  Powertrain_Notification_displayValues();
}
on envVar Powertrain_Notification_displayValues_isShiftLockActive
{
  Powertrain_array_displayValues_isShiftLockActive[@Powertrain_Notification_displayValues_Element] = @this;
  Powertrain_Notification_displayValues();
}
on envVar Powertrain_Notification_displayValues_elementId_available
{
  Powertrain_array_displayValues_elementId_available[@Powertrain_Notification_displayValues_Element] = @this;
  Powertrain_Notification_displayValues();
}
on envVar Powertrain_Notification_displayValues_gearShiftPosition_available
{
  Powertrain_array_displayValues_gearShiftPosition_available[@Powertrain_Notification_displayValues_Element] = @this;
  Powertrain_Notification_displayValues();
}
on envVar Powertrain_Notification_displayValues_recuperationLevel_available
{
  Powertrain_array_displayValues_recuperationLevel_available[@Powertrain_Notification_displayValues_Element] = @this;
  Powertrain_Notification_displayValues();
}
on envVar Powertrain_Notification_displayValues_isPowertrainActive_available
{
  Powertrain_array_displayValues_isPowertrainActive_available[@Powertrain_Notification_displayValues_Element] = @this;
  Powertrain_Notification_displayValues();
}
on envVar Powertrain_Notification_displayValues_isShiftLockActive_available
{
  Powertrain_array_displayValues_isShiftLockActive_available[@Powertrain_Notification_displayValues_Element] = @this;
  Powertrain_Notification_displayValues();
}
on envVar Powertrain_Notification_displayValues_Payload
{
  Powertrain_Notification_displayValues_update();
}


Powertrain_Notification_displayValues()
{
  word payload_counter = 0;
  word start_pos       = 0;
  word element_length  = 0;
  
  // Length Indicator Struct - Platzhalter
  payload_counter = 0+4;
  start_pos = 0;
  
  for (j=0; j<@Powertrain_Notification_displayValues_Element_TotalNum; j++)
  {
    Powertrain_array_displayValues_available_functions[j] = Powertrain_array_displayValues_elementId_available[j]
                                                          + Powertrain_array_displayValues_gearShiftPosition_available[j]
                                                          + Powertrain_array_displayValues_recuperationLevel_available[j]
                                                          + Powertrain_array_displayValues_isPowertrainActive_available[j]
                                                          + Powertrain_array_displayValues_isShiftLockActive_available[j];
    
    // Length Indicator Element - Platzhalter
    if (Powertrain_array_displayValues_available_functions[j] > 0)
    {
      start_pos = payload_counter;
      payload_counter = payload_counter + 4;
    }
    else 
      start_pos = payload_counter;
    
    
    // 0 elementId (uint32)
    if (Powertrain_array_displayValues_elementId_available[j] == 1)
    {
      tag_dataID = 0;
      Powertrain_payload_buffer_displayValues[payload_counter++] = 2 * 16 /* Wiretype = 2  =^ 32 Bit */ + ((tag_dataID>>8) & 0x0F) /* DataID High Part */ ;
      Powertrain_payload_buffer_displayValues[payload_counter++] = tag_dataID & 0xFF /* DataID Low Part */ ;
      
      Powertrain_payload_buffer_displayValues[payload_counter++] = Powertrain_array_displayValues_elementId[j]>>24 & 0xFF;
      Powertrain_payload_buffer_displayValues[payload_counter++] = Powertrain_array_displayValues_elementId[j]>>16 & 0xFF;
      Powertrain_payload_buffer_displayValues[payload_counter++] = Powertrain_array_displayValues_elementId[j]>> 8 & 0xFF;
      Powertrain_payload_buffer_displayValues[payload_counter++] = Powertrain_array_displayValues_elementId[j]     & 0xFF;
    }
    
    
    // 1 gearShiftPosition (enum32)
    if (Powertrain_array_displayValues_gearShiftPosition_available[j] == 1)
    {
      tag_dataID = 1;
      Powertrain_payload_buffer_displayValues[payload_counter++] = 2 * 16 /* Wiretype = 2  =^ 32 Bit */ + ((tag_dataID>>8) & 0x0F) /* DataID High Part */ ;
      Powertrain_payload_buffer_displayValues[payload_counter++] = tag_dataID & 0xFF /* DataID Low Part */ ;
      
      Powertrain_payload_buffer_displayValues[payload_counter++] = Powertrain_array_displayValues_gearShiftPosition[j]>>24 & 0xFF;
      Powertrain_payload_buffer_displayValues[payload_counter++] = Powertrain_array_displayValues_gearShiftPosition[j]>>16 & 0xFF;
      Powertrain_payload_buffer_displayValues[payload_counter++] = Powertrain_array_displayValues_gearShiftPosition[j]>> 8 & 0xFF;
      Powertrain_payload_buffer_displayValues[payload_counter++] = Powertrain_array_displayValues_gearShiftPosition[j]     & 0xFF;
    }
    
    // 2 recuperationLevel (enum32)
    if (Powertrain_array_displayValues_recuperationLevel_available[j] == 1)
    {
      tag_dataID = 2;
      Powertrain_payload_buffer_displayValues[payload_counter++] = 2 * 16 /* Wiretype = 2  =^ 32 Bit */ + ((tag_dataID>>8) & 0x0F) /* DataID High Part */ ;
      Powertrain_payload_buffer_displayValues[payload_counter++] = tag_dataID & 0xFF /* DataID Low Part */ ;
      
      Powertrain_payload_buffer_displayValues[payload_counter++] = Powertrain_array_displayValues_recuperationLevel[j]>>24 & 0xFF;
      Powertrain_payload_buffer_displayValues[payload_counter++] = Powertrain_array_displayValues_recuperationLevel[j]>>16 & 0xFF;
      Powertrain_payload_buffer_displayValues[payload_counter++] = Powertrain_array_displayValues_recuperationLevel[j]>> 8 & 0xFF;
      Powertrain_payload_buffer_displayValues[payload_counter++] = Powertrain_array_displayValues_recuperationLevel[j]     & 0xFF;
    }
    
    // 3 isPowertrainActive (boolean)
    if (Powertrain_array_displayValues_isPowertrainActive_available[j] == 1)
    {
      tag_dataID = 3;
      Powertrain_payload_buffer_displayValues[payload_counter++] = 0 * 16 /* Wiretype = 0  =^ 8 Bit */ + ((tag_dataID>>8) & 0x0F) /* DataID High Part */ ;
      Powertrain_payload_buffer_displayValues[payload_counter++] = tag_dataID & 0xFF /* DataID Low Part */ ;
      
      Powertrain_payload_buffer_displayValues[payload_counter++] = Powertrain_array_displayValues_isPowertrainActive[j] & 0xFF;
    }
    
    
    // 4 isShiftLockActive (boolean)
    if (Powertrain_array_displayValues_isShiftLockActive_available[j] == 1)
    {
      tag_dataID = 4;
      Powertrain_payload_buffer_displayValues[payload_counter++] = 0 * 16 /* Wiretype = 0  =^ 8 Bit */ + ((tag_dataID>>8) & 0x0F) /* DataID High Part */ ;
      Powertrain_payload_buffer_displayValues[payload_counter++] = tag_dataID & 0xFF /* DataID Low Part */ ;
      
      Powertrain_payload_buffer_displayValues[payload_counter++] = Powertrain_array_displayValues_isShiftLockActive[j] & 0xFF;
    }
    
    
    //Element Length
    element_length = payload_counter-start_pos;
    if (element_length >0) Powertrain_array_displayValues_array_element_length[j] = element_length - 4;
    else                   Powertrain_array_displayValues_array_element_length[j] = element_length;
    
    Powertrain_payload_buffer_displayValues[start_pos++] = Powertrain_array_displayValues_array_element_length[j]>>24 & 0xFF;
    Powertrain_payload_buffer_displayValues[start_pos++] = Powertrain_array_displayValues_array_element_length[j]>>16 & 0xFF;
    Powertrain_payload_buffer_displayValues[start_pos++] = Powertrain_array_displayValues_array_element_length[j]>> 8 & 0xFF;
    Powertrain_payload_buffer_displayValues[start_pos++] = Powertrain_array_displayValues_array_element_length[j]     & 0xFF;
    
    if (Powertrain_array_displayValues_array_element_length[j] == 0) payload_counter = payload_counter+4;
  }
  
  // Struct Length
  Powertrain_array_displayValues_struct_element_length = 4*@Powertrain_Notification_displayValues_Element_TotalNum;

  for (k=0;k<@Powertrain_Notification_displayValues_Element_TotalNum;k++)
    Powertrain_array_displayValues_struct_element_length = Powertrain_array_displayValues_struct_element_length + Powertrain_array_displayValues_array_element_length[k];
  
  Powertrain_payload_buffer_displayValues[0] = Powertrain_array_displayValues_struct_element_length>>24 & 0xFF;
  Powertrain_payload_buffer_displayValues[1] = Powertrain_array_displayValues_struct_element_length>>16 & 0xFF;
  Powertrain_payload_buffer_displayValues[2] = Powertrain_array_displayValues_struct_element_length>> 8 & 0xFF;
  Powertrain_payload_buffer_displayValues[3] = Powertrain_array_displayValues_struct_element_length     & 0xFF;


  Powertrain_payload_length_displayValues = Powertrain_array_displayValues_struct_element_length+4;
  putvalue(Powertrain_Notification_displayValues_Payload, Powertrain_payload_buffer_displayValues, Powertrain_payload_length_displayValues);
}

on envVar Powertrain_Notification_displayValues_Element_TotalNum
{
  if (@this == 0) @this =  1;
  if (@this > 10) @this = 10;
  
  Powertrain_Notification_displayValues();
  Powertrain_Notification_displayValues_update();
}

on envVar Powertrain_Notification_displayValues_Element
{
  Powertrain_Notification_displayValues_update();
}

on envVar Powertrain_Notification_displayValues_Element_Next
{
  if (@this == 1 && @Powertrain_Notification_displayValues_Element < @Powertrain_Notification_displayValues_Element_TotalNum - 1)
  {
    @Powertrain_Notification_displayValues_Element = @Powertrain_Notification_displayValues_Element + 1;
    Powertrain_Notification_displayValues_update();
  }
}

on envVar Powertrain_Notification_displayValues_Element_Previous
{
  if (@this == 1 && @Powertrain_Notification_displayValues_Element > 0)
  {
    @Powertrain_Notification_displayValues_Element = @Powertrain_Notification_displayValues_Element - 1;
    Powertrain_Notification_displayValues_update();
  }
}

Powertrain_Notification_displayValues_update()
{
  @Powertrain_Notification_LengthIndicator_Element_displayValues = Powertrain_array_displayValues_array_element_length[@Powertrain_Notification_displayValues_Element];
  @Powertrain_Notification_LengthIndicator_Struct_displayValues  = Powertrain_array_displayValues_struct_element_length;
  @Powertrain_Notification_Length_displayValues                  = Powertrain_payload_length_displayValues+8;
  
  @Powertrain_Notification_displayValues_elementId          = Powertrain_array_displayValues_elementId[@Powertrain_Notification_displayValues_Element];
  @Powertrain_Notification_displayValues_gearShiftPosition  = Powertrain_array_displayValues_gearShiftPosition[@Powertrain_Notification_displayValues_Element];
  @Powertrain_Notification_displayValues_recuperationLevel  = Powertrain_array_displayValues_recuperationLevel[@Powertrain_Notification_displayValues_Element];
  @Powertrain_Notification_displayValues_isPowertrainActive = Powertrain_array_displayValues_isPowertrainActive[@Powertrain_Notification_displayValues_Element];
  @Powertrain_Notification_displayValues_isShiftLockActive  = Powertrain_array_displayValues_isShiftLockActive[@Powertrain_Notification_displayValues_Element];
  
  @Powertrain_Notification_displayValues_elementId_available          = Powertrain_array_displayValues_elementId_available[@Powertrain_Notification_displayValues_Element];
  @Powertrain_Notification_displayValues_gearShiftPosition_available  = Powertrain_array_displayValues_gearShiftPosition_available[@Powertrain_Notification_displayValues_Element];
  @Powertrain_Notification_displayValues_recuperationLevel_available  = Powertrain_array_displayValues_recuperationLevel_available[@Powertrain_Notification_displayValues_Element];
  @Powertrain_Notification_displayValues_isPowertrainActive_available = Powertrain_array_displayValues_isPowertrainActive_available[@Powertrain_Notification_displayValues_Element];
  @Powertrain_Notification_displayValues_isShiftLockActive_available  = Powertrain_array_displayValues_isShiftLockActive_available[@Powertrain_Notification_displayValues_Element];
}





////////// status Notification //////////

on envVar Powertrain_Notification_LengthIndicator_Struct_status
{
  Powertrain_Notification_status();
}
on envVar Powertrain_Notification_LengthIndicator_Element_status
{
  Powertrain_Notification_status();
}
on envVar Powertrain_Notification_status_elementId
{
  Powertrain_array_status_elementId[@Powertrain_Notification_status_Element] = @this;
  Powertrain_Notification_status();
}
on envVar Powertrain_Notification_status_isKickDown
{
  Powertrain_array_status_isKickDown[@Powertrain_Notification_status_Element] = @this;
  Powertrain_Notification_status();
}
on envVar Powertrain_Notification_status_gearShiftPositionTarget
{
  Powertrain_array_status_gearShiftPositionTarget[@Powertrain_Notification_status_Element] = @this;
  Powertrain_Notification_status();
}
on envVar Powertrain_Notification_status_powertrainAndPropulsionState
{
  Powertrain_array_status_powertrainAndPropulsionState[@Powertrain_Notification_status_Element] = @this;
  Powertrain_Notification_status();
}
on envVar Powertrain_Notification_status_elementId_available
{
  Powertrain_array_status_elementId_available[@Powertrain_Notification_status_Element] = @this;
  Powertrain_Notification_status();
}
on envVar Powertrain_Notification_status_isKickDown_available
{
  Powertrain_array_status_isKickDown_available[@Powertrain_Notification_status_Element] = @this;
  Powertrain_Notification_status();
}
on envVar Powertrain_Notification_status_gearShiftPositionTarget_available
{
  Powertrain_array_status_gearShiftPositionTarget_available[@Powertrain_Notification_status_Element] = @this;
  Powertrain_Notification_status();
}
on envVar Powertrain_Notification_status_powertrainAndPropulsionState_available
{
  Powertrain_array_status_powertrainAndPropulsionState_available[@Powertrain_Notification_status_Element] = @this;
  Powertrain_Notification_status();
}
on envVar Powertrain_Notification_status_Payload
{
  Powertrain_Notification_status_update();
}


Powertrain_Notification_status()
{
  word payload_counter = 0;
  word start_pos       = 0;
  word element_length  = 0;
  
  // Length Indicator Struct - Platzhalter
  payload_counter = 0+4;
  start_pos = 0;
  
  for (j=0; j<@Powertrain_Notification_status_Element_TotalNum; j++)
  {
    Powertrain_array_status_available_functions[j] = Powertrain_array_status_elementId_available[j]
                                                   + Powertrain_array_status_isKickDown_available[j]
                                                   + Powertrain_array_status_gearShiftPositionTarget_available[j]
                                                   + Powertrain_array_status_powertrainAndPropulsionState_available[j];
    
    // Length Indicator Element - Platzhalter
    if (Powertrain_array_status_available_functions[j] > 0)
    {
      start_pos = payload_counter;
      payload_counter = payload_counter + 4;
    }
    else 
      start_pos = payload_counter;
    
    
    // 0 elementId (uint32)
    if (Powertrain_array_status_elementId_available[j] == 1)
    {
      tag_dataID = 0;
      Powertrain_payload_buffer_status[payload_counter++] = 2 * 16 /* Wiretype = 2  =^ 32 Bit */ + ((tag_dataID>>8) & 0x0F) /* DataID High Part */ ;
      Powertrain_payload_buffer_status[payload_counter++] = tag_dataID & 0xFF /* DataID Low Part */ ;
      
      Powertrain_payload_buffer_status[payload_counter++] = Powertrain_array_status_elementId[j]>>24 & 0xFF;
      Powertrain_payload_buffer_status[payload_counter++] = Powertrain_array_status_elementId[j]>>16 & 0xFF;
      Powertrain_payload_buffer_status[payload_counter++] = Powertrain_array_status_elementId[j]>> 8 & 0xFF;
      Powertrain_payload_buffer_status[payload_counter++] = Powertrain_array_status_elementId[j]     & 0xFF;
    }
    
    
    // 1 existiert nicht
    
    
    // 2 isKickDown (boolean)
    if (Powertrain_array_status_isKickDown_available[j] == 1)
    {
      tag_dataID = 2;
      Powertrain_payload_buffer_status[payload_counter++] = 0 * 16 /* Wiretype = 0  =^ 8 Bit */ + ((tag_dataID>>8) & 0x0F) /* DataID High Part */ ;
      Powertrain_payload_buffer_status[payload_counter++] = tag_dataID & 0xFF /* DataID Low Part */ ;
      
      Powertrain_payload_buffer_status[payload_counter++] = Powertrain_array_status_isKickDown[j] & 0xFF;
    }
    
    
    // 3 gearShiftPositionTarget (enum32)
    if (Powertrain_array_status_gearShiftPositionTarget_available[j] == 1)
    {
      tag_dataID = 3;
      Powertrain_payload_buffer_status[payload_counter++] = 2 * 16 /* Wiretype = 2  =^ 32 Bit */ + ((tag_dataID>>8) & 0x0F) /* DataID High Part */ ;
      Powertrain_payload_buffer_status[payload_counter++] = tag_dataID & 0xFF /* DataID Low Part */ ;
      
      Powertrain_payload_buffer_status[payload_counter++] = Powertrain_array_status_gearShiftPositionTarget[j]>>24 & 0xFF;
      Powertrain_payload_buffer_status[payload_counter++] = Powertrain_array_status_gearShiftPositionTarget[j]>>16 & 0xFF;
      Powertrain_payload_buffer_status[payload_counter++] = Powertrain_array_status_gearShiftPositionTarget[j]>> 8 & 0xFF;
      Powertrain_payload_buffer_status[payload_counter++] = Powertrain_array_status_gearShiftPositionTarget[j]     & 0xFF;
    }
    
    
    // 4 powertrainAndPropulsionState (enum32)
    if (Powertrain_array_status_powertrainAndPropulsionState_available[j] == 1)
    {
      tag_dataID = 4;
      Powertrain_payload_buffer_status[payload_counter++] = 2 * 16 /* Wiretype = 2  =^ 32 Bit */ + ((tag_dataID>>8) & 0x0F) /* DataID High Part */ ;
      Powertrain_payload_buffer_status[payload_counter++] = tag_dataID & 0xFF /* DataID Low Part */ ;
      
      Powertrain_payload_buffer_status[payload_counter++] = Powertrain_array_status_powertrainAndPropulsionState[j]>>24 & 0xFF;
      Powertrain_payload_buffer_status[payload_counter++] = Powertrain_array_status_powertrainAndPropulsionState[j]>>16 & 0xFF;
      Powertrain_payload_buffer_status[payload_counter++] = Powertrain_array_status_powertrainAndPropulsionState[j]>> 8 & 0xFF;
      Powertrain_payload_buffer_status[payload_counter++] = Powertrain_array_status_powertrainAndPropulsionState[j]     & 0xFF;
    }
    
    
    //Element Length
    element_length = payload_counter-start_pos;
    if (element_length >0) Powertrain_array_status_array_element_length[j] = element_length - 4;
    else                   Powertrain_array_status_array_element_length[j] = element_length;
    
    Powertrain_payload_buffer_status[start_pos++] = Powertrain_array_status_array_element_length[j]>>24 & 0xFF;
    Powertrain_payload_buffer_status[start_pos++] = Powertrain_array_status_array_element_length[j]>>16 & 0xFF;
    Powertrain_payload_buffer_status[start_pos++] = Powertrain_array_status_array_element_length[j]>> 8 & 0xFF;
    Powertrain_payload_buffer_status[start_pos++] = Powertrain_array_status_array_element_length[j]     & 0xFF;
    
    if (Powertrain_array_status_array_element_length[j] == 0) payload_counter = payload_counter+4;
  }
  
  // Struct Length
  Powertrain_array_status_struct_element_length = 4*@Powertrain_Notification_status_Element_TotalNum;

  for (k=0;k<@Powertrain_Notification_status_Element_TotalNum;k++)
    Powertrain_array_status_struct_element_length = Powertrain_array_status_struct_element_length + Powertrain_array_status_array_element_length[k];
  
  Powertrain_payload_buffer_status[0] = Powertrain_array_status_struct_element_length>>24 & 0xFF;
  Powertrain_payload_buffer_status[1] = Powertrain_array_status_struct_element_length>>16 & 0xFF;
  Powertrain_payload_buffer_status[2] = Powertrain_array_status_struct_element_length>> 8 & 0xFF;
  Powertrain_payload_buffer_status[3] = Powertrain_array_status_struct_element_length     & 0xFF;


  Powertrain_payload_length_status = Powertrain_array_status_struct_element_length+4;
  putvalue(Powertrain_Notification_status_Payload, Powertrain_payload_buffer_status, Powertrain_payload_length_status);
}

on envVar Powertrain_Notification_status_Element_TotalNum
{
  if (@this == 0) @this =  1;
  if (@this > 10) @this = 10;
  
  Powertrain_Notification_status();
  Powertrain_Notification_status_update();
}

on envVar Powertrain_Notification_status_Element
{
  Powertrain_Notification_status_update();
}

on envVar Powertrain_Notification_status_Element_Next
{
  if (@this == 1 && @Powertrain_Notification_status_Element < @Powertrain_Notification_status_Element_TotalNum - 1)
  {
    @Powertrain_Notification_status_Element = @Powertrain_Notification_status_Element + 1;
    Powertrain_Notification_status_update();
  }
}

on envVar Powertrain_Notification_status_Element_Previous
{
  if (@this == 1 && @Powertrain_Notification_status_Element > 0)
  {
    @Powertrain_Notification_status_Element = @Powertrain_Notification_status_Element - 1;
    Powertrain_Notification_status_update();
  }
}

Powertrain_Notification_status_update()
{
  @Powertrain_Notification_LengthIndicator_Element_status = Powertrain_array_status_array_element_length[@Powertrain_Notification_status_Element];
  @Powertrain_Notification_LengthIndicator_Struct_status  = Powertrain_array_status_struct_element_length;
  @Powertrain_Notification_Length_status                  = Powertrain_payload_length_status+8;
  
  @Powertrain_Notification_status_elementId                    = Powertrain_array_status_elementId[@Powertrain_Notification_status_Element];
  @Powertrain_Notification_status_isKickDown                   = Powertrain_array_status_isKickDown[@Powertrain_Notification_status_Element];
  @Powertrain_Notification_status_gearShiftPositionTarget      = Powertrain_array_status_gearShiftPositionTarget[@Powertrain_Notification_status_Element];
  @Powertrain_Notification_status_powertrainAndPropulsionState = Powertrain_array_status_powertrainAndPropulsionState[@Powertrain_Notification_status_Element];
  
  @Powertrain_Notification_status_elementId_available                    = Powertrain_array_status_elementId_available[@Powertrain_Notification_status_Element];
  @Powertrain_Notification_status_isKickDown_available                   = Powertrain_array_status_isKickDown_available[@Powertrain_Notification_status_Element];
  @Powertrain_Notification_status_gearShiftPositionTarget_available      = Powertrain_array_status_gearShiftPositionTarget_available[@Powertrain_Notification_status_Element];
  @Powertrain_Notification_status_powertrainAndPropulsionState_available = Powertrain_array_status_powertrainAndPropulsionState_available[@Powertrain_Notification_status_Element];
}










on envVar ServiceDiscovery_EthernetPacket_VLAN_TCI
{
  @ServiceDiscovery_EthernetPacket_VLAN_TCI_Prio = @this>>13 & 0x0003;
  @ServiceDiscovery_EthernetPacket_VLAN_TCI_CFI  = @this>>12 & 0x0001;
  @ServiceDiscovery_EthernetPacket_VLAN_TCI_ID   = @this     & 0x0FFF;
}

on envVar ServiceDiscovery_EthernetPacket_VLAN_TCI_Prio { build_VLAN_TCI(); }
on envVar ServiceDiscovery_EthernetPacket_VLAN_TCI_CFI  { build_VLAN_TCI(); }
on envVar ServiceDiscovery_EthernetPacket_VLAN_TCI_ID   { build_VLAN_TCI(); }


build_VLAN_TCI()
{
  @ServiceDiscovery_EthernetPacket_VLAN_TCI = @ServiceDiscovery_EthernetPacket_VLAN_TCI_ID + @ServiceDiscovery_EthernetPacket_VLAN_TCI_CFI * 4096 + @ServiceDiscovery_EthernetPacket_VLAN_TCI_Prio * 8192;
}

on envVar ServiceDiscovery_SOMEIPPacket_Offer_ICAS1Gateway_Flags
{
  @ServiceDiscovery_SOMEIPPacket_Offer_ICAS1Gateway_Flags_Reboot                       = @this>>7 & 0x01;
  @ServiceDiscovery_SOMEIPPacket_Offer_ICAS1Gateway_Flags_Unicast                      = @this>>6 & 0x01;
  @ServiceDiscovery_SOMEIPPacket_Offer_ICAS1Gateway_Flags_Explicit_Intial_Data_Control = @this>>5 & 0x01;
}

on envVar ServiceDiscovery_SOMEIPPacket_Offer_ICAS1Gateway_Flags_Reboot                       { build_SOMEIP_find_flags_ICAS1Gateway (); }
on envVar ServiceDiscovery_SOMEIPPacket_Offer_ICAS1Gateway_Flags_Unicast                      { build_SOMEIP_find_flags_ICAS1Gateway (); }
on envVar ServiceDiscovery_SOMEIPPacket_Offer_ICAS1Gateway_Flags_Explicit_Intial_Data_Control { build_SOMEIP_find_flags_ICAS1Gateway (); }

build_SOMEIP_find_flags_ICAS1Gateway()
{
  @ServiceDiscovery_SOMEIPPacket_Offer_ICAS1Gateway_Flags = @ServiceDiscovery_SOMEIPPacket_Offer_ICAS1Gateway_Flags_Explicit_Intial_Data_Control * 32 + @ServiceDiscovery_SOMEIPPacket_Offer_ICAS1Gateway_Flags_Unicast * 64 + @ServiceDiscovery_SOMEIPPacket_Offer_ICAS1Gateway_Flags_Reboot * 128;
}






on ethernetPacket *
{
  byte type;
  word length_of_entries_array;
  byte send_subAck_flag;
  
  byte  notification_rx_session_id;
  dword someip_array_counter;
  
  if (this.type == 0x86DD && this.dir == RX) // IPv6
  {
    // MAC Adresse auslesen und zuweisen
    //ethGetMacAddressAsString ( this.source, buffer_MAC, 18 );
    //putValue (ServiceDiscovery_EthernetPacket_MAC_Destination, buffer_MAC);
  
    if (this.ipv6.next == 17) // UDP
    {
      this.udp.GetData (0, someip_buffer, this.udp.length-8);
      
      // ServiceDiscovery
      if ((someip_buffer[0]&0x000000FF) == 0xFF && (someip_buffer[1]&0x000000FF) == 0xFF && (someip_buffer[2]&0x000000FF) == 0x81 && (someip_buffer[3]&0x000000FF) == 0x00)
      {
        // Länge des Entry Arrays prüfen und Anzahl der Elemente berechnen
        length_of_entries_array = (someip_buffer[20]&0x000000FF) * 16777216 + (someip_buffer[21]&0x000000FF) * 65536 + (someip_buffer[22]&0x000000FF) * 256 + someip_buffer[23]&0x000000FF;
        number_of_entries_array_elements = length_of_entries_array / 16;
        
        for (k=0;k<number_of_entries_array_elements;k++)
        {
           // Find
          if ((someip_buffer[24+16*k]&0x000000FF) == 0 && @Send_ServiceDiscovery_Offer_AutomaticReply == 1)
          {
            Send_ServiceDiscovery_Offer_Service_ICAS1Gateway();
          }
          
          // Subscribe
          if ((someip_buffer[24+16*k]&0x000000FF) == 6)
          {
            servicediscovery_sub_rx_entries_array_type[k]              =   someip_buffer[24+16*k]&0x000000FF;
            servicediscovery_sub_rx_entries_array_index_1st_options[k] =   someip_buffer[25+16*k]&0x000000FF;
            servicediscovery_sub_rx_entries_array_index_2nd_options[k] =   someip_buffer[26+16*k]&0x000000FF;
            servicediscovery_sub_rx_entries_array_nr_of_opt_1[k]       =  (someip_buffer[27+16*k]>>4)&0x0000000F;
            servicediscovery_sub_rx_entries_array_nr_of_opt_1[k]       =   someip_buffer[27+16*k]    &0x0000000F;
            servicediscovery_sub_rx_entries_array_service_id[k]        = ((someip_buffer[28+16*k]&0x000000FF) * 256)
                                                                       +  (someip_buffer[29+16*k]&0x000000FF);
            servicediscovery_sub_rx_entries_array_instance_id[k]       = ((someip_buffer[30+16*k]&0x000000FF) * 256)
                                                                       +  (someip_buffer[31+16*k]&0x000000FF);
            servicediscovery_sub_rx_entries_array_major_version[k]     =   someip_buffer[32+16*k]&0x000000FF;
            servicediscovery_sub_rx_entries_array_ttl[k]               = ((someip_buffer[33+16*k]&0x000000FF) * 65536)
                                                                       + ((someip_buffer[34+16*k]&0x000000FF) * 256)
                                                                       +  (someip_buffer[35+16*k]&0x000000FF);
            servicediscovery_sub_rx_entries_array_eventgroup_id[k]     = ((someip_buffer[38+16*k]&0x000000FF) * 256)
                                                                       +  (someip_buffer[39+16*k]&0x000000FF);
            
            send_subAck_flag = 1;
          }
          
        }
        if (send_subAck_flag == 1)
        {
          send_subAck_flag = 0;
          
          this.ipv6.destination.GetData (0, buffer_ipv6, 16);
          
          if (buffer_ipv6[14] == 0x00 & buffer_ipv6[15] == 0x10)
            Send_ServiceDiscovery_SubscribeACK_ICAS1Gateway();
        }
      }
    }
  }
}