/*@!Encoding:1252*/


// BV1_Linien_01
on envVar EnvBV1_Richtungspfeile {$BV1_Richtungspfeile_XIX_BV1_Linien_01_XIX_E3V_VLAN_Infotainment	 = @this; }
on envVar EnvBV1_FahrSzen_AusfLinks {$	BV1_FahrSzen_AusfLinks_XIX_BV1_Linien_01_XIX_E3V_VLAN_Infotainment	 = @this; }
on envVar EnvBV1_FahrSzen_AusfRechts {$	BV1_FahrSzen_AusfRechts_XIX_BV1_Linien_01_XIX_E3V_VLAN_Infotainment	 = @this; }
on envVar EnvBV1_FahrSzen_EinfLinks {$	BV1_FahrSzen_EinfLinks_XIX_BV1_Linien_01_XIX_E3V_VLAN_Infotainment	 = @this; }
on envVar EnvBV1_FahrSzen_EinfRechts {$	BV1_FahrSzen_EinfRechts_XIX_BV1_Linien_01_XIX_E3V_VLAN_Infotainment	 = @this; }
on envVar EnvBV1_LIN_01_ExistMass {$	BV1_LIN_01_ExistMass_XIX_BV1_Linien_01_XIX_E3V_VLAN_Infotainment	 = @this; }
on envVar EnvBV1_LIN_02_ExistMass {$	BV1_LIN_02_ExistMass_XIX_BV1_Linien_01_XIX_E3V_VLAN_Infotainment	 = @this; }
on envVar EnvBV1_LIN_01_BeginnX {$	BV1_LIN_01_BeginnX_XIX_BV1_Linien_01_XIX_E3V_VLAN_Infotainment	 = @this; }
on envVar EnvBV1_LIN_02_BeginnX {$	BV1_LIN_02_BeginnX_XIX_BV1_Linien_01_XIX_E3V_VLAN_Infotainment	 = @this; }
on envVar EnvBV1_LIN_01_ID {$	BV1_LIN_01_ID_XIX_BV1_Linien_01_XIX_E3V_VLAN_Infotainment	 = @this; }
on envVar EnvBV1_LIN_02_ID {$	BV1_LIN_02_ID_XIX_BV1_Linien_01_XIX_E3V_VLAN_Infotainment	 = @this; }
on envVar EnvBV1_LIN_03_ID {$	BV1_LIN_03_ID_XIX_BV1_Linien_01_XIX_E3V_VLAN_Infotainment	 = @this; }
on envVar EnvBV1_LIN_07_GierWnkl {$	BV1_LIN_07_GierWnkl_XIX_BV1_Linien_01_XIX_E3V_VLAN_Infotainment	 = @this; }
on envVar EnvBV1_LIN_07_HorKruemm {$	BV1_LIN_07_HorKruemm_XIX_BV1_Linien_01_XIX_E3V_VLAN_Infotainment	 = @this; }
on envVar EnvBV1_LIN_07_HorKruemmAend {$	BV1_LIN_07_HorKruemmAend_XIX_BV1_Linien_01_XIX_E3V_VLAN_Infotainment	 = @this; }
on envVar EnvBV1_LIN_07_BeginnX {$	BV1_LIN_07_BeginnX_XIX_BV1_Linien_01_XIX_E3V_VLAN_Infotainment	 = @this; }
on envVar EnvBV1_LIN_07_ExistMass {$	BV1_LIN_07_ExistMass_XIX_BV1_Linien_01_XIX_E3V_VLAN_Infotainment	 = @this; }
on envVar EnvBV1_LIN_07_EndeX {$	BV1_LIN_07_EndeX_XIX_BV1_Linien_01_XIX_E3V_VLAN_Infotainment	 = @this; }
on envVar EnvBV1_FahrSzen_Baustelle {$	BV1_FahrSzen_Baustelle_XIX_BV1_Linien_01_XIX_E3V_VLAN_Infotainment	 = @this; }
on envVar EnvBV1_LIN_04_ID {$	BV1_LIN_04_ID_XIX_BV1_Linien_01_XIX_E3V_VLAN_Infotainment	 = @this; }
on envVar EnvBV1_LIN_08_GierWnkl {$	BV1_LIN_08_GierWnkl_XIX_BV1_Linien_01_XIX_E3V_VLAN_Infotainment	 = @this; }
on envVar EnvBV1_LIN_08_HorKruemm {$	BV1_LIN_08_HorKruemm_XIX_BV1_Linien_01_XIX_E3V_VLAN_Infotainment	 = @this; }
on envVar EnvBV1_LIN_08_HorKruemmAend {$	BV1_LIN_08_HorKruemmAend_XIX_BV1_Linien_01_XIX_E3V_VLAN_Infotainment	 = @this; }
on envVar EnvBV1_LIN_08_BeginnX {$	BV1_LIN_08_BeginnX_XIX_BV1_Linien_01_XIX_E3V_VLAN_Infotainment	 = @this; }
on envVar EnvBV1_LIN_08_ExistMass {$	BV1_LIN_08_ExistMass_XIX_BV1_Linien_01_XIX_E3V_VLAN_Infotainment	 = @this; }
on envVar EnvBV1_LIN_08_EndeX {$	BV1_LIN_08_EndeX_XIX_BV1_Linien_01_XIX_E3V_VLAN_Infotainment	 = @this; }
on envVar EnvBV1_FahrSzen_Kreuzung {$	BV1_FahrSzen_Kreuzung_XIX_BV1_Linien_01_XIX_E3V_VLAN_Infotainment	 = @this; }
on envVar EnvBV1_LIN_03_BeginnX {$	BV1_LIN_03_BeginnX_XIX_BV1_Linien_01_XIX_E3V_VLAN_Infotainment	 = @this; }
on envVar EnvBV1_LIN_01_EndeX {$	BV1_LIN_01_EndeX_XIX_BV1_Linien_01_XIX_E3V_VLAN_Infotainment	 = @this; }
on envVar EnvBV1_LIN_02_EndeX {$	BV1_LIN_02_EndeX_XIX_BV1_Linien_01_XIX_E3V_VLAN_Infotainment	 = @this; }
on envVar EnvBV1_LIN_03_ExistMass {$	BV1_LIN_03_ExistMass_XIX_BV1_Linien_01_XIX_E3V_VLAN_Infotainment	 = @this; }
on envVar EnvBV1_LIN_04_BeginnX {$	BV1_LIN_04_BeginnX_XIX_BV1_Linien_01_XIX_E3V_VLAN_Infotainment	 = @this; }
on envVar EnvBV1_LIN_03_EndeX {$	BV1_LIN_03_EndeX_XIX_BV1_Linien_01_XIX_E3V_VLAN_Infotainment	 = @this; }
on envVar EnvBV1_LIN_04_EndeX {$	BV1_LIN_04_EndeX_XIX_BV1_Linien_01_XIX_E3V_VLAN_Infotainment	 = @this; }
on envVar EnvBV1_LIN_04_ExistMass {$	BV1_LIN_04_ExistMass_XIX_BV1_Linien_01_XIX_E3V_VLAN_Infotainment	 = @this; }
on envVar EnvBV1_LIN_01_AbstandY {$	BV1_LIN_01_AbstandY_XIX_BV1_Linien_01_XIX_E3V_VLAN_Infotainment	 = @this; }
on envVar EnvBV1_LIN_01_GierWnkl {$	BV1_LIN_01_GierWnkl_XIX_BV1_Linien_01_XIX_E3V_VLAN_Infotainment	 = @this; }
on envVar EnvBV1_LIN_01_HorKruemm {$	BV1_LIN_01_HorKruemm_XIX_BV1_Linien_01_XIX_E3V_VLAN_Infotainment	 = @this; }
on envVar EnvBV1_LIN_01_HorKruemmAend {$	BV1_LIN_01_HorKruemmAend_XIX_BV1_Linien_01_XIX_E3V_VLAN_Infotainment	 = @this; }
on envVar EnvBV1_LIN_01_Breite {$	BV1_LIN_01_Breite_XIX_BV1_Linien_01_XIX_E3V_VLAN_Infotainment	 = @this; }
on envVar EnvBV1_LIN_01_Farbe {$	BV1_LIN_01_Farbe_XIX_BV1_Linien_01_XIX_E3V_VLAN_Infotainment	 = @this; }
on envVar EnvBV1_LIN_01_Typ_02 {$	BV1_LIN_01_Typ_02_XIX_BV1_Linien_01_XIX_E3V_VLAN_Infotainment	 = @this; }
on envVar EnvBV1_LIN_02_AbstandY {$	BV1_LIN_02_AbstandY_XIX_BV1_Linien_01_XIX_E3V_VLAN_Infotainment	 = @this; }
on envVar EnvBV1_LIN_02_GierWnkl {$	BV1_LIN_02_GierWnkl_XIX_BV1_Linien_01_XIX_E3V_VLAN_Infotainment	 = @this; }
on envVar EnvBV1_LIN_02_HorKruemm {$	BV1_LIN_02_HorKruemm_XIX_BV1_Linien_01_XIX_E3V_VLAN_Infotainment	 = @this; }
on envVar EnvBV1_LIN_02_HorKruemmAend {$	BV1_LIN_02_HorKruemmAend_XIX_BV1_Linien_01_XIX_E3V_VLAN_Infotainment	 = @this; }
on envVar EnvBV1_LIN_02_Breite {$	BV1_LIN_02_Breite_XIX_BV1_Linien_01_XIX_E3V_VLAN_Infotainment	 = @this; }
on envVar EnvBV1_LIN_02_Farbe {$	BV1_LIN_02_Farbe_XIX_BV1_Linien_01_XIX_E3V_VLAN_Infotainment	 = @this; }
on envVar EnvBV1_LIN_02_Typ_02 {$	BV1_LIN_02_Typ_02_XIX_BV1_Linien_01_XIX_E3V_VLAN_Infotainment	 = @this; }
on envVar EnvBV1_LIN_03_AbstandY {$	BV1_LIN_03_AbstandY_XIX_BV1_Linien_01_XIX_E3V_VLAN_Infotainment	 = @this; }
on envVar EnvBV1_LIN_03_GierWnkl {$	BV1_LIN_03_GierWnkl_XIX_BV1_Linien_01_XIX_E3V_VLAN_Infotainment	 = @this; }
on envVar EnvBV1_LIN_03_HorKruemm {$	BV1_LIN_03_HorKruemm_XIX_BV1_Linien_01_XIX_E3V_VLAN_Infotainment	 = @this; }
on envVar EnvBV1_LIN_03_HorKruemmAend {$	BV1_LIN_03_HorKruemmAend_XIX_BV1_Linien_01_XIX_E3V_VLAN_Infotainment	 = @this; }
on envVar EnvBV1_LIN_03_Breite {$	BV1_LIN_03_Breite_XIX_BV1_Linien_01_XIX_E3V_VLAN_Infotainment	 = @this; }
on envVar EnvBV1_LIN_03_Farbe {$	BV1_LIN_03_Farbe_XIX_BV1_Linien_01_XIX_E3V_VLAN_Infotainment	 = @this; }
on envVar EnvBV1_LIN_03_Typ_02 {$	BV1_LIN_03_Typ_02_XIX_BV1_Linien_01_XIX_E3V_VLAN_Infotainment	 = @this; }
on envVar EnvBV1_LIN_04_AbstandY {$	BV1_LIN_04_AbstandY_XIX_BV1_Linien_01_XIX_E3V_VLAN_Infotainment	 = @this; }
on envVar EnvBV1_LIN_04_GierWnkl {$	BV1_LIN_04_GierWnkl_XIX_BV1_Linien_01_XIX_E3V_VLAN_Infotainment	 = @this; }
on envVar EnvBV1_LIN_04_HorKruemm {$	BV1_LIN_04_HorKruemm_XIX_BV1_Linien_01_XIX_E3V_VLAN_Infotainment	 = @this; }
on envVar EnvBV1_LIN_04_HorKruemmAend {$	BV1_LIN_04_HorKruemmAend_XIX_BV1_Linien_01_XIX_E3V_VLAN_Infotainment	 = @this; }
on envVar EnvBV1_LIN_04_Breite {$	BV1_LIN_04_Breite_XIX_BV1_Linien_01_XIX_E3V_VLAN_Infotainment	 = @this; }
on envVar EnvBV1_LIN_04_Farbe {$	BV1_LIN_04_Farbe_XIX_BV1_Linien_01_XIX_E3V_VLAN_Infotainment	 = @this; }
on envVar EnvBV1_LIN_04_Typ_02 {$	BV1_LIN_04_Typ_02_XIX_BV1_Linien_01_XIX_E3V_VLAN_Infotainment	 = @this; }
  
// BV1_Linien_02
on envVar EnvBV1_EgospurLExistMass {$	BV1_EgospurLExistMass_XIX_BV1_Linien_02_XIX_E3V_VLAN_Infotainment	 = @this; }
on envVar EnvBV1_EgospurRExistMass {$	BV1_EgospurRExistMass_XIX_BV1_Linien_02_XIX_E3V_VLAN_Infotainment	 = @this; }
on envVar EnvBV1_NebenspurLExistMass {$	BV1_NebenspurLExistMass_XIX_BV1_Linien_02_XIX_E3V_VLAN_Infotainment	 = @this; }
on envVar EnvBV1_NebenspurRExistMass {$	BV1_NebenspurRExistMass_XIX_BV1_Linien_02_XIX_E3V_VLAN_Infotainment	 = @this; }
on envVar EnvBV1_FS_0_KonfVerkehrsrichtung {$	BV1_FS_0_KonfVerkehrsrichtung_XIX_BV1_Linien_02_XIX_E3V_VLAN_Infotainment	 = @this; }
on envVar EnvBV1_FS_1_KonfVerkehrsrichtung {$	BV1_FS_1_KonfVerkehrsrichtung_XIX_BV1_Linien_02_XIX_E3V_VLAN_Infotainment	 = @this; }
on envVar EnvBV1_FS_2_KonfVerkehrsrichtung {$	BV1_FS_2_KonfVerkehrsrichtung_XIX_BV1_Linien_02_XIX_E3V_VLAN_Infotainment	 = @this; }
on envVar EnvBV1_FS_3_KonfVerkehrsrichtung {$	BV1_FS_3_KonfVerkehrsrichtung_XIX_BV1_Linien_02_XIX_E3V_VLAN_Infotainment	 = @this; }
on envVar EnvBV1_FS_0_Aend_Quern_Kubisch {$	BV1_FS_0_Aend_Quern_Kubisch_XIX_BV1_Linien_02_XIX_E3V_VLAN_Infotainment	 = @this; }
on envVar EnvBV1_FS_0_Aend_Quern_Linear {$	BV1_FS_0_Aend_Quern_Linear_XIX_BV1_Linien_02_XIX_E3V_VLAN_Infotainment	 = @this; }
on envVar EnvBV1_FS_0_Aend_Quern_Quad {$	BV1_FS_0_Aend_Quern_Quad_XIX_BV1_Linien_02_XIX_E3V_VLAN_Infotainment	 = @this; }
on envVar EnvBV1_FS_0_Aend_Quern_VorausGemess {$	BV1_FS_0_Aend_Quern_VorausGemess_XIX_BV1_Linien_02_XIX_E3V_VLAN_Infotainment	 = @this; }
on envVar EnvBV1_LIN_01_Seg01_StdA_A {$	BV1_LIN_01_Seg01_StdA_A_XIX_BV1_Linien_02_XIX_E3V_VLAN_Infotainment	 = @this; }
on envVar EnvBV1_LIN_01_Seg01_StdA_M {$	BV1_LIN_01_Seg01_StdA_M_XIX_BV1_Linien_02_XIX_E3V_VLAN_Infotainment	 = @this; }
on envVar EnvBV1_LIN_01_Seg01_StdA_E {$	BV1_LIN_01_Seg01_StdA_E_XIX_BV1_Linien_02_XIX_E3V_VLAN_Infotainment	 = @this; }
on envVar EnvBV1_LIN_01_Seg02_StdA_A {$	BV1_LIN_01_Seg02_StdA_A_XIX_BV1_Linien_02_XIX_E3V_VLAN_Infotainment	 = @this; }
on envVar EnvBV1_LIN_01_Seg02_StdA_M {$	BV1_LIN_01_Seg02_StdA_M_XIX_BV1_Linien_02_XIX_E3V_VLAN_Infotainment	 = @this; }
on envVar EnvBV1_LIN_01_Seg02_StdA_E {$	BV1_LIN_01_Seg02_StdA_E_XIX_BV1_Linien_02_XIX_E3V_VLAN_Infotainment	 = @this; }
on envVar EnvBV1_LIN_02_Seg01_StdA_A {$	BV1_LIN_02_Seg01_StdA_A_XIX_BV1_Linien_02_XIX_E3V_VLAN_Infotainment	 = @this; }
on envVar EnvBV1_LIN_02_Seg01_StdA_M {$	BV1_LIN_02_Seg01_StdA_M_XIX_BV1_Linien_02_XIX_E3V_VLAN_Infotainment	 = @this; }
on envVar EnvBV1_LIN_02_Seg01_StdA_E {$	BV1_LIN_02_Seg01_StdA_E_XIX_BV1_Linien_02_XIX_E3V_VLAN_Infotainment	 = @this; }
on envVar EnvBV1_LIN_02_Seg02_StdA_A {$	BV1_LIN_02_Seg02_StdA_A_XIX_BV1_Linien_02_XIX_E3V_VLAN_Infotainment	 = @this; }
on envVar EnvBV1_LIN_02_Seg02_StdA_M {$	BV1_LIN_02_Seg02_StdA_M_XIX_BV1_Linien_02_XIX_E3V_VLAN_Infotainment	 = @this; }
on envVar EnvBV1_LIN_02_Seg02_StdA_E {$	BV1_LIN_02_Seg02_StdA_E_XIX_BV1_Linien_02_XIX_E3V_VLAN_Infotainment	 = @this; }
on envVar EnvBV1_FS_0_Haltelinie_longDist {$	BV1_FS_0_Haltelinie_longDist_XIX_BV1_Linien_02_XIX_E3V_VLAN_Infotainment	 = @this; }
on envVar EnvBV1_FS_0_Haltelinie_latDist {$	BV1_FS_0_Haltelinie_latDist_XIX_BV1_Linien_02_XIX_E3V_VLAN_Infotainment	 = @this; }
on envVar EnvBV1_FS_0_Haltelinie_Status {$	BV1_FS_0_Haltelinie_Status_XIX_BV1_Linien_02_XIX_E3V_VLAN_Infotainment	 = @this; }
on envVar EnvBV1_FS_0_Haltelinie_Breite {$	BV1_FS_0_Haltelinie_Breite_XIX_BV1_Linien_02_XIX_E3V_VLAN_Infotainment	 = @this; }
on envVar EnvBV1_FS_0_Haltelinie_Typ {$	BV1_FS_0_Haltelinie_Typ_XIX_BV1_Linien_02_XIX_E3V_VLAN_Infotainment	 = @this; }
on envVar EnvBV1_FS_0_ExistWahrsch {$	BV1_FS_0_ExistWahrsch_XIX_BV1_Linien_02_XIX_E3V_VLAN_Infotainment	 = @this; }
on envVar EnvBV1_FS_1_ExistWahrsch {$	BV1_FS_1_ExistWahrsch_XIX_BV1_Linien_02_XIX_E3V_VLAN_Infotainment	 = @this; }
on envVar EnvBV1_FS_2_ExistWahrsch {$	BV1_FS_2_ExistWahrsch_XIX_BV1_Linien_02_XIX_E3V_VLAN_Infotainment	 = @this; }
on envVar EnvBV1_FS_3_ExistWahrsch {$	BV1_FS_3_ExistWahrsch_XIX_BV1_Linien_02_XIX_E3V_VLAN_Infotainment	 = @this; }
on envVar EnvBV1_FS_4_ExistWahrsch {$	BV1_FS_4_ExistWahrsch_XIX_BV1_Linien_02_XIX_E3V_VLAN_Infotainment	 = @this; }
on envVar EnvBV1_Zebrastreifen_latDist {$	BV1_Zebrastreifen_latDist_XIX_BV1_Linien_02_XIX_E3V_VLAN_Infotainment	 = @this; }
on envVar EnvBV1_Zebrastreifen_Status {$	BV1_Zebrastreifen_Status_XIX_BV1_Linien_02_XIX_E3V_VLAN_Infotainment	 = @this; }
on envVar EnvBV1_Zebrastreifen_longDist {$	BV1_Zebrastreifen_longDist_XIX_BV1_Linien_02_XIX_E3V_VLAN_Infotainment	 = @this; }
on envVar EnvBV1_EgospurLVorausGemessen_02 {$	BV1_EgospurLVorausGemessen_02_XIX_BV1_Linien_02_XIX_E3V_VLAN_Infotainment	 = @this; }
on envVar EnvBV1_EgospurRVorausGemessen_02 {$	BV1_EgospurRVorausGemessen_02_XIX_BV1_Linien_02_XIX_E3V_VLAN_Infotainment	 = @this; }
on envVar EnvBV1_FS_4_KonfVerkehrsrichtung {$	BV1_FS_4_KonfVerkehrsrichtung_XIX_BV1_Linien_02_XIX_E3V_VLAN_Infotainment	 = @this; }
on envVar EnvBV1_FS_0_Verkehrsrichtung {$	BV1_FS_0_Verkehrsrichtung_XIX_BV1_Linien_02_XIX_E3V_VLAN_Infotainment	 = @this; }
on envVar EnvBV1_FS_1_Verkehrsrichtung {$	BV1_FS_1_Verkehrsrichtung_XIX_BV1_Linien_02_XIX_E3V_VLAN_Infotainment	 = @this; }
on envVar EnvBV1_FS_2_Verkehrsrichtung {$	BV1_FS_2_Verkehrsrichtung_XIX_BV1_Linien_02_XIX_E3V_VLAN_Infotainment	 = @this; }
on envVar EnvBV1_FS_3_Verkehrsrichtung {$	BV1_FS_3_Verkehrsrichtung_XIX_BV1_Linien_02_XIX_E3V_VLAN_Infotainment	 = @this; }
on envVar EnvBV1_FS_4_Verkehrsrichtung {$	BV1_FS_4_Verkehrsrichtung_XIX_BV1_Linien_02_XIX_E3V_VLAN_Infotainment	 = @this; }
on envVar EnvBV1_Verzoegerungsbereich {$	BV1_Verzoegerungsbereich_XIX_BV1_Linien_02_XIX_E3V_VLAN_Infotainment	 = @this; }
on envVar EnvBV1_FS_0_Haltelinie_Gierwinkel {$	BV1_FS_0_Haltelinie_Gierwinkel_XIX_BV1_Linien_02_XIX_E3V_VLAN_Infotainment	 = @this; }

// BV_Header_Eth
on envVar	EnvBV_Header_Eth_CRC	{	$	BV_Header_Eth_CRC_XIX_BV_Header_Eth_XIX_E3V_VLAN_Infotainment	=	@this	;	}
on envVar	EnvBV_Header_Eth_BZ	{	$	BV_Header_Eth_BZ_XIX_BV_Header_Eth_XIX_E3V_VLAN_Infotainment	=	@this	;	}
on envVar	EnvBV_FGE_Bremsung	{	$	BV_FGE_Bremsung_XIX_BV_Header_Eth_XIX_E3V_VLAN_Infotainment	=	@this	;	}
on envVar	EnvBV_FGE_Freigabe_Bremsung	{	$	BV_FGE_Freigabe_Bremsung_XIX_BV_Header_Eth_XIX_E3V_VLAN_Infotainment	=	@this	;	}
on envVar	EnvBV_FGE_Objekt_ID_Freigabe	{	$	BV_FGE_Objekt_ID_Freigabe_XIX_BV_Header_Eth_XIX_E3V_VLAN_Infotainment	=	@this	;	}
on envVar	EnvBV_FGE_Warnung	{	$	BV_FGE_Warnung_XIX_BV_Header_Eth_XIX_E3V_VLAN_Infotainment	=	@this	;	}
on envVar	EnvBV_VD_Bremsung	{	$	BV_VD_Bremsung_XIX_BV_Header_Eth_XIX_E3V_VLAN_Infotainment	=	@this	;	}
on envVar	EnvBV_VD_Freigabe_Bremsung	{	$	BV_VD_Freigabe_Bremsung_XIX_BV_Header_Eth_XIX_E3V_VLAN_Infotainment	=	@this	;	}
on envVar	EnvBV_VD_Objekt_ID_Freigabe	{	$	BV_VD_Objekt_ID_Freigabe_XIX_BV_Header_Eth_XIX_E3V_VLAN_Infotainment	=	@this	;	}
on envVar	EnvBV_VD_Warnung	{	$	BV_VD_Warnung_XIX_BV_Header_Eth_XIX_E3V_VLAN_Infotainment	=	@this	;	}
on envVar	EnvBV_Zeitstempel	{	$	BV_Zeitstempel_XIX_BV_Header_Eth_XIX_E3V_VLAN_Infotainment	=	@this	;	}
on envVar	EnvBV_ZeitstempelStatus	{	$	BV_ZeitstempelStatus_XIX_BV_Header_Eth_XIX_E3V_VLAN_Infotainment	=	@this	;	}
on envVar	EnvBV_BildNummer	{	$	BV_BildNummer_XIX_BV_Header_Eth_XIX_E3V_VLAN_Infotainment	=	@this	;	}
on envVar	EnvBV_OffsetZeitstempel	{	$	BV_OffsetZeitstempel_XIX_BV_Header_Eth_XIX_E3V_VLAN_Infotainment	=	@this	;	}
on envVar	EnvBV_Objektdatenalter	{	$	BV_Objektdatenalter_XIX_BV_Header_Eth_XIX_E3V_VLAN_Infotainment	=	@this	;	}
on envVar	EnvBV_Spurdatenalter	{	$	BV_Spurdatenalter_XIX_BV_Header_Eth_XIX_E3V_VLAN_Infotainment	=	@this	;	}
on envVar	EnvBV_VD_DatenUpdateZaehler	{	$	BV_VD_DatenUpdateZaehler_XIX_BV_Header_Eth_XIX_E3V_VLAN_Infotainment	=	@this	;	}
on envVar	EnvBV_VD_ObjektdatenZaehler	{	$	BV_VD_ObjektdatenZaehler_XIX_BV_Header_Eth_XIX_E3V_VLAN_Infotainment	=	@this	;	}
on envVar	EnvBV_LDA_SpurdatenZaehler	{	$	BV_LDA_SpurdatenZaehler_XIX_BV_Header_Eth_XIX_E3V_VLAN_Infotainment	=	@this	;	}
on envVar	EnvBV_VD_NaheinschererLinks	{	$	BV_VD_NaheinschererLinks_XIX_BV_Header_Eth_XIX_E3V_VLAN_Infotainment	=	@this	;	}
on envVar	EnvBV_VD_NaheinschererRechts	{	$	BV_VD_NaheinschererRechts_XIX_BV_Header_Eth_XIX_E3V_VLAN_Infotainment	=	@this	;	}
on envVar	EnvBV_RFD_Intruder	{	$	BV_RFD_Intruder_XIX_BV_Header_Eth_XIX_E3V_VLAN_Infotainment	=	@this	;	}
on envVar	EnvBV_RFD_EindringlingDistanz	{	$	BV_RFD_EindringlingDistanz_XIX_BV_Header_Eth_XIX_E3V_VLAN_Infotainment	=	@this	;	}
on envVar	EnvBV_RFD_NichtVerfuegbar	{	$	BV_RFD_NichtVerfuegbar_XIX_BV_Header_Eth_XIX_E3V_VLAN_Infotainment	=	@this	;	}
on envVar	EnvBV_FehlerBlindheit	{	$	BV_FehlerBlindheit_XIX_BV_Header_Eth_XIX_E3V_VLAN_Infotainment	=	@this	;	}
on envVar	EnvBV_FehlerFreisicht	{	$	BV_FehlerFreisicht_XIX_BV_Header_Eth_XIX_E3V_VLAN_Infotainment	=	@this	;	}
on envVar	EnvBV_FehlerRelevant	{	$	BV_FehlerRelevant_XIX_BV_Header_Eth_XIX_E3V_VLAN_Infotainment	=	@this	;	}
on envVar	EnvBV_FehlerVerfuegbarkeit	{	$	BV_FehlerVerfuegbarkeit_XIX_BV_Header_Eth_XIX_E3V_VLAN_Infotainment	=	@this	;	}
on envVar	EnvBV_VD_GesamtDetektionsrate	{	$	BV_VD_GesamtDetektionsrate_XIX_BV_Header_Eth_XIX_E3V_VLAN_Infotainment	=	@this	;	}
on envVar	EnvBV_VD_LichtStatusVerfuegbarkeit	{	$	BV_VD_LichtStatusVerfuegbarkeit_XIX_BV_Header_Eth_XIX_E3V_VLAN_Infotainment	=	@this	;	}
on envVar	EnvBV_SendeZeitstempel	{	$	BV_SendeZeitstempel_XIX_BV_Header_Eth_XIX_E3V_VLAN_Infotainment	=	@this	;	}

// BV_Kameraposition_Eth
on envVar	EnvBV_Kameraposition_Eth_CRC	{	$	BV_Kameraposition_Eth_CRC_XIX_BV_Kameraposition_Eth_XIX_E3V_VLAN_Infotainment	=	@this	;	}
on envVar	EnvBV_Kameraposition_Eth_BZ	{	$	BV_Kameraposition_Eth_BZ_XIX_BV_Kameraposition_Eth_XIX_E3V_VLAN_Infotainment	=	@this	;	}
on envVar	EnvBV_Position_Kamera_x	{	$	BV_Position_Kamera_x_XIX_BV_Kameraposition_Eth_XIX_E3V_VLAN_Infotainment	=	@this	;	}
on envVar	EnvBV_Position_Kamera_y	{	$	BV_Position_Kamera_y_XIX_BV_Kameraposition_Eth_XIX_E3V_VLAN_Infotainment	=	@this	;	}
on envVar	EnvBV_Position_Kamera_z	{	$	BV_Position_Kamera_z_XIX_BV_Kameraposition_Eth_XIX_E3V_VLAN_Infotainment	=	@this	;	}
									
// BV_Obj_01_Eth
on envVar	EnvBV_Obj_01_Eth_CRC	{	$	BV_Obj_01_Eth_CRC_XIX_BV_Obj_01_Eth_XIX_E3V_VLAN_Infotainment	=	@this	;	}
on envVar	EnvBV_Obj_01_Eth_BZ	{	$	BV_Obj_01_Eth_BZ_XIX_BV_Obj_01_Eth_XIX_E3V_VLAN_Infotainment	=	@this	;	}
on envVar	EnvBV_Obj_01_Gierwinkel	{	$	BV_Obj_01_Gierwinkel_XIX_BV_Obj_01_Eth_XIX_E3V_VLAN_Infotainment	=	@this	;	}
on envVar	EnvBV_Obj_01_Gierwinkel_StdA	{	$	BV_Obj_01_Gierwinkel_StdA_XIX_BV_Obj_01_Eth_XIX_E3V_VLAN_Infotainment	=	@this	;	}
on envVar	EnvBV_Obj_01_LateralGeschwRel	{	$	BV_Obj_01_LateralGeschwRel_XIX_BV_Obj_01_Eth_XIX_E3V_VLAN_Infotainment	=	@this	;	}
on envVar	EnvBV_Obj_01_LateralGeschwRelStdA	{	$	BV_Obj_01_LateralGeschwRelStdA_XIX_BV_Obj_01_Eth_XIX_E3V_VLAN_Infotainment	=	@this	;	}
on envVar	EnvBV_Obj_01_ID	{	$	BV_Obj_01_ID_XIX_BV_Obj_01_Eth_XIX_E3V_VLAN_Infotainment	=	@this	;	}
on envVar	EnvBV_Obj_01_Klasse	{	$	BV_Obj_01_Klasse_XIX_BV_Obj_01_Eth_XIX_E3V_VLAN_Infotainment	=	@this	;	}
on envVar	EnvBV_Obj_01_InverseTTIPC	{	$	BV_Obj_01_InverseTTIPC_XIX_BV_Obj_01_Eth_XIX_E3V_VLAN_Infotainment	=	@this	;	}
on envVar	EnvBV_Obj_01_InverseTTIPCStdA	{	$	BV_Obj_01_InverseTTIPCStdA_XIX_BV_Obj_01_Eth_XIX_E3V_VLAN_Infotainment	=	@this	;	}
on envVar	EnvBV_Obj_01_TTCFront	{	$	BV_Obj_01_TTCFront_XIX_BV_Obj_01_Eth_XIX_E3V_VLAN_Infotainment	=	@this	;	}
on envVar	EnvBV_Obj_01_TTCFrontStdA	{	$	BV_Obj_01_TTCFrontStdA_XIX_BV_Obj_01_Eth_XIX_E3V_VLAN_Infotainment	=	@this	;	}
on envVar	EnvBV_Obj_01_LongitudinalDist	{	$	BV_Obj_01_LongitudinalDist_XIX_BV_Obj_01_Eth_XIX_E3V_VLAN_Infotainment	=	@this	;	}
on envVar	EnvBV_Obj_01_LongitudinalDistStdA	{	$	BV_Obj_01_LongitudinalDistStdA_XIX_BV_Obj_01_Eth_XIX_E3V_VLAN_Infotainment	=	@this	;	}
on envVar	EnvBV_Obj_01_LongitudinalGeschw	{	$	BV_Obj_01_LongitudinalGeschw_XIX_BV_Obj_01_Eth_XIX_E3V_VLAN_Infotainment	=	@this	;	}
on envVar	EnvBV_Obj_01_LongitudinalGeschwStdA	{	$	BV_Obj_01_LongitudinalGeschwStdA_XIX_BV_Obj_01_Eth_XIX_E3V_VLAN_Infotainment	=	@this	;	}
on envVar	EnvBV_Obj_01_LateralDist	{	$	BV_Obj_01_LateralDist_XIX_BV_Obj_01_Eth_XIX_E3V_VLAN_Infotainment	=	@this	;	}
on envVar	EnvBV_Obj_01_LateralDistStdA	{	$	BV_Obj_01_LateralDistStdA_XIX_BV_Obj_01_Eth_XIX_E3V_VLAN_Infotainment	=	@this	;	}
on envVar	EnvBV_Obj_01_WnklGeschw	{	$	BV_Obj_01_WnklGeschw_XIX_BV_Obj_01_Eth_XIX_E3V_VLAN_Infotainment	=	@this	;	}
on envVar	EnvBV_Obj_01_WnklGeschwStdA	{	$	BV_Obj_01_WnklGeschwStdA_XIX_BV_Obj_01_Eth_XIX_E3V_VLAN_Infotainment	=	@this	;	}
on envVar	EnvBV_Obj_01_KantenwinkelLinks	{	$	BV_Obj_01_KantenwinkelLinks_XIX_BV_Obj_01_Eth_XIX_E3V_VLAN_Infotainment	=	@this	;	}
on envVar	EnvBV_Obj_01_KantenwinkelLinksStd	{	$	BV_Obj_01_KantenwinkelLinksStd_XIX_BV_Obj_01_Eth_XIX_E3V_VLAN_Infotainment	=	@this	;	}
on envVar	EnvBV_Obj_01_KantenwinkelRechts	{	$	BV_Obj_01_KantenwinkelRechts_XIX_BV_Obj_01_Eth_XIX_E3V_VLAN_Infotainment	=	@this	;	}
on envVar	EnvBV_Obj_01_KantenwinkelRechtsStdA	{	$	BV_Obj_01_KantenwinkelRechtsStdA_XIX_BV_Obj_01_Eth_XIX_E3V_VLAN_Infotainment	=	@this	;	}
on envVar	EnvBV_Obj_01_ExistenzMass	{	$	BV_Obj_01_ExistenzMass_XIX_BV_Obj_01_Eth_XIX_E3V_VLAN_Infotainment	=	@this	;	}
on envVar	EnvBV_Obj_01_UeberdWnklEgoSpurR	{	$	BV_Obj_01_UeberdWnklEgoSpurR_XIX_BV_Obj_01_Eth_XIX_E3V_VLAN_Infotainment	=	@this	;	}
on envVar	EnvBV_Obj_01_UeberdWnklEgoSpurL	{	$	BV_Obj_01_UeberdWnklEgoSpurL_XIX_BV_Obj_01_Eth_XIX_E3V_VLAN_Infotainment	=	@this	;	}
on envVar	EnvBV_Obj_01_WnklMitte	{	$	BV_Obj_01_WnklMitte_XIX_BV_Obj_01_Eth_XIX_E3V_VLAN_Infotainment	=	@this	;	}
on envVar	EnvBV_Obj_01_WnklMitteStdA	{	$	BV_Obj_01_WnklMitteStdA_XIX_BV_Obj_01_Eth_XIX_E3V_VLAN_Infotainment	=	@this	;	}
on envVar	EnvBV_Obj_01_WnklBreite	{	$	BV_Obj_01_WnklBreite_XIX_BV_Obj_01_Eth_XIX_E3V_VLAN_Infotainment	=	@this	;	}
on envVar	EnvBV_Obj_01_WnklBreiteStdA	{	$	BV_Obj_01_WnklBreiteStdA_XIX_BV_Obj_01_Eth_XIX_E3V_VLAN_Infotainment	=	@this	;	}
on envVar	EnvBV_Obj_01_ScaleChange	{	$	BV_Obj_01_ScaleChange_XIX_BV_Obj_01_Eth_XIX_E3V_VLAN_Infotainment	=	@this	;	}
on envVar	EnvBV_Obj_01_Gemessen	{	$	BV_Obj_01_Gemessen_XIX_BV_Obj_01_Eth_XIX_E3V_VLAN_Infotainment	=	@this	;	}
on envVar	EnvBV_Obj_01_Bezugspunkt	{	$	BV_Obj_01_Bezugspunkt_XIX_BV_Obj_01_Eth_XIX_E3V_VLAN_Infotainment	=	@this	;	}
on envVar	EnvBV_Obj_01_Alter	{	$	BV_Obj_01_Alter_XIX_BV_Obj_01_Eth_XIX_E3V_VLAN_Infotainment	=	@this	;	}
on envVar	EnvBV_Obj_01_Stehend	{	$	BV_Obj_01_Stehend_XIX_BV_Obj_01_Eth_XIX_E3V_VLAN_Infotainment	=	@this	;	}
on envVar	EnvBV_Obj_01_BlinkerLinks	{	$	BV_Obj_01_BlinkerLinks_XIX_BV_Obj_01_Eth_XIX_E3V_VLAN_Infotainment	=	@this	;	}
on envVar	EnvBV_Obj_01_BremsLicht	{	$	BV_Obj_01_BremsLicht_XIX_BV_Obj_01_Eth_XIX_E3V_VLAN_Infotainment	=	@this	;	}
on envVar	EnvBV_Obj_01_Spurzuordnung	{	$	BV_Obj_01_Spurzuordnung_XIX_BV_Obj_01_Eth_XIX_E3V_VLAN_Infotainment	=	@this	;	}

// BV_Obj_01_delta_Eth
on envVar	EnvBV_Obj_01_delta_Eth_CRC	{	$	BV_Obj_01_delta_Eth_CRC_XIX_BV_Obj_01_delta_Eth_XIX_E3V_VLAN_Infotainment	=	@this	;	}
on envVar	EnvBV_Obj_01_delta_Eth_BZ	{	$	BV_Obj_01_delta_Eth_BZ_XIX_BV_Obj_01_delta_Eth_XIX_E3V_VLAN_Infotainment	=	@this	;	}
on envVar	EnvBV_Obj_01_Breite	{	$	BV_Obj_01_Breite_XIX_BV_Obj_01_delta_Eth_XIX_E3V_VLAN_Infotainment	=	@this	;	}
on envVar	EnvBV_Obj_01_BreiteStdA	{	$	BV_Obj_01_BreiteStdA_XIX_BV_Obj_01_delta_Eth_XIX_E3V_VLAN_Infotainment	=	@this	;	}
on envVar	EnvBV_Obj_01_Klassenwahrscheinlichk	{	$	BV_Obj_01_Klassenwahrscheinlichk_XIX_BV_Obj_01_delta_Eth_XIX_E3V_VLAN_Infotainment	=	@this	;	}
on envVar	EnvBV_Obj_01_Laenge	{	$	BV_Obj_01_Laenge_XIX_BV_Obj_01_delta_Eth_XIX_E3V_VLAN_Infotainment	=	@this	;	}
on envVar	EnvBV_Obj_01_LaengeStdA	{	$	BV_Obj_01_LaengeStdA_XIX_BV_Obj_01_delta_Eth_XIX_E3V_VLAN_Infotainment	=	@this	;	}
on envVar	EnvBV_Obj_01_LateralGeschwAbs	{	$	BV_Obj_01_LateralGeschwAbs_XIX_BV_Obj_01_delta_Eth_XIX_E3V_VLAN_Infotainment	=	@this	;	}
on envVar	EnvBV_Obj_01_LateralGeschwAbsStdA	{	$	BV_Obj_01_LateralGeschwAbsStdA_XIX_BV_Obj_01_delta_Eth_XIX_E3V_VLAN_Infotainment	=	@this	;	}
on envVar	EnvBV_Obj_01_LichtStatus	{	$	BV_Obj_01_LichtStatus_XIX_BV_Obj_01_delta_Eth_XIX_E3V_VLAN_Infotainment	=	@this	;	}
on envVar	EnvBV_Obj_01_LongitudinalBeschlAbs	{	$	BV_Obj_01_LongitudinalBeschlAbs_XIX_BV_Obj_01_delta_Eth_XIX_E3V_VLAN_Infotainment	=	@this	;	}
on envVar	EnvBV_Obj_01_LongitudinalBeschlAbsS	{	$	BV_Obj_01_LongitudinalBeschlAbsS_XIX_BV_Obj_01_delta_Eth_XIX_E3V_VLAN_Infotainment	=	@this	;	}
on envVar	EnvBV_Obj_01_LongitudinalGeschwAbs	{	$	BV_Obj_01_LongitudinalGeschwAbs_XIX_BV_Obj_01_delta_Eth_XIX_E3V_VLAN_Infotainment	=	@this	;	}
on envVar	EnvBV_Obj_01_LongitudinalGeschwAbsS	{	$	BV_Obj_01_LongitudinalGeschwAbsS_XIX_BV_Obj_01_delta_Eth_XIX_E3V_VLAN_Infotainment	=	@this	;	}
on envVar	EnvBV_Obj_01_RadialDist	{	$	BV_Obj_01_RadialDist_XIX_BV_Obj_01_delta_Eth_XIX_E3V_VLAN_Infotainment	=	@this	;	}
on envVar	EnvBV_Obj_01_RadialDistStdA	{	$	BV_Obj_01_RadialDistStdA_XIX_BV_Obj_01_delta_Eth_XIX_E3V_VLAN_Infotainment	=	@this	;	}
on envVar	EnvBV_Obj_01_WnklAzimut	{	$	BV_Obj_01_WnklAzimut_XIX_BV_Obj_01_delta_Eth_XIX_E3V_VLAN_Infotainment	=	@this	;	}
on envVar	EnvBV_Obj_01_WnklAzimutStdA	{	$	BV_Obj_01_WnklAzimutStdA_XIX_BV_Obj_01_delta_Eth_XIX_E3V_VLAN_Infotainment	=	@this	;	}
on envVar	EnvBV_Obj_01_WnklElevation	{	$	BV_Obj_01_WnklElevation_XIX_BV_Obj_01_delta_Eth_XIX_E3V_VLAN_Infotainment	=	@this	;	}
on envVar	EnvBV_Obj_01_WnklElevationStdA	{	$	BV_Obj_01_WnklElevationStdA_XIX_BV_Obj_01_delta_Eth_XIX_E3V_VLAN_Infotainment	=	@this	;	}