/*@!Encoding:1252*/
includes
{
    #include "..\..\_DLL\latest_BAP_DLL.cin"
}

variables
{
	char  dbcan_path[255]           = "BAP\\_DBC\\BAP_V9.04F.dbc";
	char  xml_path[255]             = "BAP\\InfoSettings_P30DF30_V1.01_FSG80\\bapxml\\BAP_SW18_InfoSettings_P30DF30_V1.01_FSG.xml";

    //@BAPSIMGEN_VAR_SECTION_BEGIN

	/***************************************************/
	/*            BapSimGen FSG template               */
	/***************************************************/

	/************** Ausgabe Konsole (Traces) ***********/
	dword gBAP_Trace;
	dword gError_Trace;

	/************** Node Verwaltung ***************/
	//Power on/off
	byte gSG_PowerOnOff=0x01;     // wird mit Power_off/on gesetzt
	byte gBAP_Init=0;             // schon mal initialisiert?

	const Power_off = 0x00;	
	const Power_on	= 0x01;

	mstimer TaskTimer;				//real communication timer

	/************** Request **************/
	const Requestbuffer_lines = 100;
	const BAP_buffer_size = 4096;

	/************ Speichern von Requests im "Ringbuffer" ***********/
	int   gBAP_Requestbuffer_status	[Requestbuffer_lines];		             // 0: kein Eintrag, 1: pending
	dword gBAP_Request_header		[Requestbuffer_lines] [6];				 // beinhaltet auch skalare Daten
	dword gBAP_Request_data         [Requestbuffer_lines] [BAP_buffer_size]; // Ringbuffer fuer BAP-Request


	/************** Indication **************/
	// enthaelt die derzeitige Indication
	dword gBAP_Indication_header[6];	
	byte  gBAP_Indication_data[BAP_buffer_size];		

	/************** Konstanten ****************/

	//BAP Data Type 
	const Bap_void				=0;
	const Bap_uint8				=1;
	const Bap_uint16			=2;
	const Bap_uint32			=3;
	const Bap_byteSequence		=4;
    const Bap_fixedByteSequence =4;
    const Bap_error				=5;
    const Bap_acknowledge		=6;

	char Datatype_Text[7][20] =
	{
		"void", "uint8", "uint16", "uint32", "byteSequence", "error", "acknowledge"
	};
	
	//BAP request types
	const DataSetGet_REQ	= 0x00;
	const DataSet_REQ		= 0x01;
	const DataGet_REQ		= 0x02;
	const Data_REQ			= 0x03;
	const Changed_REQ		= 0x04;
	const Start_REQ			= 0x05;
	const StartResult_REQ	= 0x06;
	const AbortResult_REQ	= 0x07;
	const Processing_REQ	= 0x08;
	const Result_REQ		= 0x09;
	const DataAck_REQ       = 0x0A;
	const Ack_REQ           = 0x0B;
	const Invalid_REQ    	= 0x1F; // Kennzeichnung fuer einen ungueltigen Request
	const Error_REQ         = 0x20;

	char Requesttype_Text[33][30] =
	{
		"DataSetGet_REQ", "DataSet_REQ", "DataGet_REQ", "Data_REQ",			/* 00 .. 03 */
		"Changed_REQ", "Start_REQ", "StartResult_REQ", "AbortResult_REQ",   /* 04 .. 07 */
		"Processing_REQ", "Result_REQ", "DataAck_REQ", "Ack_REQ", 		/* 08 .. 0b */
		"Invalid_REQ", "Invalid_REQ", "Invalid_REQ", "Invalid_REQ",  		/* 0c .. 0f */
		"Invalid_REQ", "Invalid_REQ", "Invalid_REQ", "Invalid_REQ",  		/* 10 .. 13 */
		"Invalid_REQ", "Invalid_REQ", "Invalid_REQ", "Invalid_REQ",  		/* 14 .. 17 */
		"Invalid_REQ", "Invalid_REQ", "Invalid_REQ", "Invalid_REQ", 		/* 18 .. 1b */
		"Invalid_REQ", "Invalid_REQ", "Invalid_REQ", "Invalid_REQ",  		/* 1c .. 1f */
		"Error_REQ"	  														/* 20 */
	};
	
	//BAP indication types
	const Data_IND				= 0x00;
	const Reset_IND				= 0x01;
	const DataAck_IND			= 0x02;
	const Result_IND			= 0x03;
	const Processing_IND	    = 0x04;
	const Changed_IND			= 0x05;
	const DataSetGet_IND	    = 0x06;
	const DataSet_IND			= 0x07;
	const DataGet_IND			= 0x08;
	const Ack_IND				= 0x09;
	const Processing_CNF_IND	= 0x0A;
	const Start_IND				= 0x0B;
	const StartResult_IND		= 0x0C;
	const AbortResult_IND		= 0x0D;
	const Invalid_IND			= 0x1F; // Kennzeichnung fuer eine ungueltige Indication
	const Error_IND             = 0x20;

	char Indicationtype_Text[33][30] =
	{
		"Data_IND", "Reset_IND", "DataAck_IND", "Result_IND",				/* 00 .. 03 */
		"Processing_IND", "Changed_IND", "DataSetGet_IND", "DataSet_IND",	/* 04 .. 07 */
		"DataGet_IND", "Ack_IND", "Processing_CNF_IND", "Start_REQ",		/* 08 .. 0b */
		"StartResult_REQ", "AbortResult_REQ", "Invalid_REQ", "Invalid_REQ", /* 0c .. 0f */
		"Invalid_REQ", "Invalid_REQ", "Invalid_REQ", "Invalid_REQ",			/* 10 .. 13 */
		"Invalid_REQ", "Invalid_REQ", "Invalid_REQ", "Invalid_REQ",			/* 14 .. 17 */
		"Invalid_REQ", "Invalid_REQ", "Invalid_REQ", "Invalid_REQ",			/* 18 .. 1b */
		"Invalid_REQ", "Invalid_REQ", "Invalid_REQ", "Invalid_REQ",			/* 1c .. 1f */
		"Error_REQ"	  														/* 20 */
	};	
	
	char Acknowledgetype_Text[24][30] =
	{
		"Property_SetGet_ACK", "Array_SetGet_ACK", "Property_Set_ACK", "Array_Set_ACK",				/* 00 .. 03 */
		"Method_Start_ACK", "Method_StartResult_ACK", "Method_AbortResult_ACK", "Property_Get_ACK",	/* 04 .. 07 */
		"Array_Get_ACK", "Cache_GetAll_ACK", "Property_Ack_ACK", "Property_Status_ACK",	   			/* 08 .. 0b */
		"Property_StatusAck_ACK", "Property_Error_ACK", "Array_Status_ACK", "Array_Changed_ACK",	/* 0c .. 0f */
		"Array_Error_ACK", "Method_Processing_ACK", "Method_Result_ACK", "Method_Error_ACK",  		/* 10 .. 13 */
		"Unknown_ACK", "Unknown_ACK", "Unknown_ACK", "Unknown_ACK"									/* 14 .. 17 */
	};

	/**************************** Global Function-ID's ******************************/

	byte already_pressed = 0;

	const FctID_GetAll									= 0x01;
	const FctID_BAP_Config								= 0x02;
	const FctID_FunctionList							= 0x03;
	const FctID_HeartBeat								= 0x04;
    
    char SGtype[4]="FSG";


	//// Begin: konfigurationsabhýngige Variablen, die als BAPCONFIG_VARS in Template definiert sind
	
	dword NODE_INDEX                =  0;
	char  NODE_NAME[100]            = "InfoSettings";
	const LSGID                     = 80;
	char  panel_name[100]           = "FSG80_0";
	char  bapconfig_panel_name[100]    = "panel1";
	char  common_panel_name[100]    = "panel2";
	const TaskTime                  = 10;
	 const C_FSG_80_0_0_1_ID = 1;
	 char gCheckbox1[100] = "checkbox_C_FSG_80_0_0_1";
	 char gErrField1[100] = "errfield_C_FSG_80_0_0_1";
	 byte gC_FSG_80_0_0_1_ErrCode = 1;
	 const P_FSG_80_0_0_2_ID = 2;
	 byte P_FSG_80_0_0_2Reset_BTN_already_pressed = 0;
	 char gCheckbox2[100] = "checkbox_P_FSG_80_0_0_2";
	 char gErrField2[100] = "errfield_P_FSG_80_0_0_2";
	 byte gP_FSG_80_0_0_2_ErrCode = 1;
	 const P_FSG_80_0_0_3_ID = 3;
	 byte P_FSG_80_0_0_3Status_BTN_already_pressed = 0;
	 char gCheckbox3[100] = "checkbox_P_FSG_80_0_0_3";
	 char gErrField3[100] = "errfield_P_FSG_80_0_0_3";
	 byte gP_FSG_80_0_0_3_ErrCode = 1;
	 const P_FSG_80_0_0_4_ID = 4;
	 byte P_FSG_80_0_0_4Status_BTN_already_pressed = 0;
	 char gCheckbox4[100] = "checkbox_P_FSG_80_0_0_4";
	 char gErrField4[100] = "errfield_P_FSG_80_0_0_4";
	 byte gP_FSG_80_0_0_4_ErrCode = 1;
	 const P_FSG_80_0_0_13_ID = 13;
	 byte P_FSG_80_0_0_13Status_BTN_already_pressed = 0;
	 char gCheckbox13[100] = "checkbox_P_FSG_80_0_0_13";
	 char gErrField13[100] = "errfield_P_FSG_80_0_0_13";
	 byte gP_FSG_80_0_0_13_ErrCode = 1;
	 char gPanel13[100] = "panel_P_FSG_80_0_0_13";
	 const P_FSG_80_0_0_14_ID = 14;
	 byte P_FSG_80_0_0_14Status_BTN_already_pressed = 0;
	 char gCheckbox14[100] = "checkbox_P_FSG_80_0_0_14";
	 char gErrField14[100] = "errfield_P_FSG_80_0_0_14";
	 byte gP_FSG_80_0_0_14_ErrCode = 1;
	 char gPanel14[100] = "panel_P_FSG_80_0_0_14";
	 const P_FSG_80_0_0_15_ID = 15;
	 byte P_FSG_80_0_0_15Status_BTN_already_pressed = 0;
	 char gCheckbox15[100] = "checkbox_P_FSG_80_0_0_15";
	 char gErrField15[100] = "errfield_P_FSG_80_0_0_15";
	 byte gP_FSG_80_0_0_15_ErrCode = 1;
	 char gPanel15[100] = "panel_P_FSG_80_0_0_15";
	 const M_FSG_80_0_0_16_ID = 16;
	 byte M_FSG_80_0_0_16Result_BTN_already_pressed = 0;
	 char gCheckbox16[100] = "checkbox_M_FSG_80_0_0_16";
	 char gErrField16[100] = "errfield_M_FSG_80_0_0_16";
	 byte gM_FSG_80_0_0_16_ErrCode = 1;
	 char gPanel16[100] = "panel_M_FSG_80_0_0_16";
	 const P_FSG_80_0_0_17_ID = 17;
	 byte P_FSG_80_0_0_17Status_BTN_already_pressed = 0;
	 char gCheckbox17[100] = "checkbox_P_FSG_80_0_0_17";
	 char gErrField17[100] = "errfield_P_FSG_80_0_0_17";
	 byte gP_FSG_80_0_0_17_ErrCode = 1;
	 char gPanel17[100] = "panel_P_FSG_80_0_0_17";
	 const P_FSG_80_0_0_18_ID = 18;
	 byte P_FSG_80_0_0_18Status_BTN_already_pressed = 0;
	 char gCheckbox18[100] = "checkbox_P_FSG_80_0_0_18";
	 char gErrField18[100] = "errfield_P_FSG_80_0_0_18";
	 byte gP_FSG_80_0_0_18_ErrCode = 1;
	 char gPanel18[100] = "panel_P_FSG_80_0_0_18";
	 const P_FSG_80_0_0_19_ID = 19;
	 byte P_FSG_80_0_0_19Status_BTN_already_pressed = 0;
	 char gCheckbox19[100] = "checkbox_P_FSG_80_0_0_19";
	 char gErrField19[100] = "errfield_P_FSG_80_0_0_19";
	 byte gP_FSG_80_0_0_19_ErrCode = 1;
	 char gPanel19[100] = "panel_P_FSG_80_0_0_19";
	 const M_FSG_80_0_0_20_ID = 20;
	 byte M_FSG_80_0_0_20Result_BTN_already_pressed = 0;
	 char gCheckbox20[100] = "checkbox_M_FSG_80_0_0_20";
	 char gErrField20[100] = "errfield_M_FSG_80_0_0_20";
	 byte gM_FSG_80_0_0_20_ErrCode = 1;
	 char gPanel20[100] = "panel_M_FSG_80_0_0_20";
	 const P_FSG_80_0_0_21_ID = 21;
	 byte P_FSG_80_0_0_21Status_BTN_already_pressed = 0;
	 char gCheckbox21[100] = "checkbox_P_FSG_80_0_0_21";
	 char gErrField21[100] = "errfield_P_FSG_80_0_0_21";
	 byte gP_FSG_80_0_0_21_ErrCode = 1;
	 char gPanel21[100] = "panel_P_FSG_80_0_0_21";
	 const A_FSG_80_0_0_22_ID = 22;
	 byte A_FSG_80_0_0_22Changed_BTN_already_pressed = 0;
	 byte A_FSG_80_0_0_22Status_BTN_already_pressed = 0;
	 char gCheckbox22[100] = "checkbox_A_FSG_80_0_0_22";
	 char gErrField22[100] = "errfield_A_FSG_80_0_0_22";
	 byte gA_FSG_80_0_0_22_ErrCode = 1;
	 char gPanel22[100] = "panel_A_FSG_80_0_0_22";
	 byte A_FSG_80_0_0_22_DataIndex_Decr_already_pressed = 0;
	 byte A_FSG_80_0_0_22_DataIndex_Incr_already_pressed = 0;
	 byte A_FSG_80_0_0_22_DataIndex_SetGet_Decr_already_pressed = 0;
	 byte A_FSG_80_0_0_22_DataIndex_SetGet_Incr_already_pressed = 0;
	 byte A_FSG_80_0_0_22_generateData_Btn_already_pressed = 0;
	 byte A_FSG_80_0_0_22_loadArray_Btn_already_pressed = 0;
	 _align(1) struct A_FSG_80_0_0_22_ArrayDataStruct {
		 byte Param1;
		 byte Param2;
		 byte Param3[100];
		 word Param3_Length;
	 };
	 struct A_FSG_80_0_0_22_ArrayDataStruct A_FSG_80_0_0_22_ArrayDataList[255];
	 const A_FSG_80_0_0_22_ArrayDataList_Length = 255;
	 long A_FSG_80_0_0_22_Data_3_LenList[255];
	 byte A_FSG_80_0_0_22_Data_3_CntList[255];
	 long A_FSG_80_0_0_22_Data_3_SetGet_LenList[255];
	 byte A_FSG_80_0_0_22_Data_3_SetGet_CntList[255];
	 const M_FSG_80_0_0_23_ID = 23;
	 byte M_FSG_80_0_0_23Result_BTN_already_pressed = 0;
	 char gCheckbox23[100] = "checkbox_M_FSG_80_0_0_23";
	 char gErrField23[100] = "errfield_M_FSG_80_0_0_23";
	 byte gM_FSG_80_0_0_23_ErrCode = 1;
	 char gPanel23[100] = "panel_M_FSG_80_0_0_23";
	 const A_FSG_80_0_0_24_ID = 24;
	 byte A_FSG_80_0_0_24Changed_BTN_already_pressed = 0;
	 byte A_FSG_80_0_0_24Status_BTN_already_pressed = 0;
	 char gCheckbox24[100] = "checkbox_A_FSG_80_0_0_24";
	 char gErrField24[100] = "errfield_A_FSG_80_0_0_24";
	 byte gA_FSG_80_0_0_24_ErrCode = 1;
	 char gPanel24[100] = "panel_A_FSG_80_0_0_24";
	 byte A_FSG_80_0_0_24_DataIndex_Decr_already_pressed = 0;
	 byte A_FSG_80_0_0_24_DataIndex_Incr_already_pressed = 0;
	 byte A_FSG_80_0_0_24_DataIndex_SetGet_Decr_already_pressed = 0;
	 byte A_FSG_80_0_0_24_DataIndex_SetGet_Incr_already_pressed = 0;
	 byte A_FSG_80_0_0_24_generateData_Btn_already_pressed = 0;
	 byte A_FSG_80_0_0_24_loadArray_Btn_already_pressed = 0;
	 _align(1) struct A_FSG_80_0_0_24_ArrayDataStruct {
		 word Param1;
		 byte Param2[1202];
		 word Param2_Length;
	 };
	 struct A_FSG_80_0_0_24_ArrayDataStruct A_FSG_80_0_0_24_ArrayDataList[65535];
	 const A_FSG_80_0_0_24_ArrayDataList_Length = 65535;
	 long A_FSG_80_0_0_24_Data_2_LenList[65535];
	 byte A_FSG_80_0_0_24_Data_2_CntList[65535];
	 long A_FSG_80_0_0_24_Data_2_SetGet_LenList[65535];
	 byte A_FSG_80_0_0_24_Data_2_SetGet_CntList[65535];
	 const P_FSG_80_0_0_25_ID = 25;
	 byte P_FSG_80_0_0_25Status_BTN_already_pressed = 0;
	 char gCheckbox25[100] = "checkbox_P_FSG_80_0_0_25";
	 char gErrField25[100] = "errfield_P_FSG_80_0_0_25";
	 byte gP_FSG_80_0_0_25_ErrCode = 1;
	 char gPanel25[100] = "panel_P_FSG_80_0_0_25";
	 const P_FSG_80_0_0_26_ID = 26;
	 byte P_FSG_80_0_0_26Status_BTN_already_pressed = 0;
	 char gCheckbox26[100] = "checkbox_P_FSG_80_0_0_26";
	 char gErrField26[100] = "errfield_P_FSG_80_0_0_26";
	 byte gP_FSG_80_0_0_26_ErrCode = 1;
	 char gPanel26[100] = "panel_P_FSG_80_0_0_26";
	 const M_FSG_80_0_0_27_ID = 27;
	 byte M_FSG_80_0_0_27Result_BTN_already_pressed = 0;
	 char gCheckbox27[100] = "checkbox_M_FSG_80_0_0_27";
	 char gErrField27[100] = "errfield_M_FSG_80_0_0_27";
	 byte gM_FSG_80_0_0_27_ErrCode = 1;
	 char gPanel27[100] = "panel_M_FSG_80_0_0_27";
	 const A_FSG_80_0_0_28_ID = 28;
	 byte A_FSG_80_0_0_28Changed_BTN_already_pressed = 0;
	 byte A_FSG_80_0_0_28Status_BTN_already_pressed = 0;
	 char gCheckbox28[100] = "checkbox_A_FSG_80_0_0_28";
	 char gErrField28[100] = "errfield_A_FSG_80_0_0_28";
	 byte gA_FSG_80_0_0_28_ErrCode = 1;
	 char gPanel28[100] = "panel_A_FSG_80_0_0_28";
	 byte A_FSG_80_0_0_28_DataIndex_Decr_already_pressed = 0;
	 byte A_FSG_80_0_0_28_DataIndex_Incr_already_pressed = 0;
	 byte A_FSG_80_0_0_28_DataIndex_SetGet_Decr_already_pressed = 0;
	 byte A_FSG_80_0_0_28_DataIndex_SetGet_Incr_already_pressed = 0;
	 byte A_FSG_80_0_0_28_generateData_Btn_already_pressed = 0;
	 byte A_FSG_80_0_0_28_loadArray_Btn_already_pressed = 0;
	 const A_FSG_80_0_0_28_ArrayDataList_Length = 400;
	 _align(1) struct A_FSG_80_0_0_28_ArrayDataStruct {
		 dword Param1;
		 byte Param2;
		 byte Param3;
		 dword Param4;
		 byte Param5[32767];
		 word Param5_Length;
	 };
	 struct A_FSG_80_0_0_28_ArrayDataStruct A_FSG_80_0_0_28_ArrayDataList[A_FSG_80_0_0_28_ArrayDataList_Length];
	 long A_FSG_80_0_0_28_Data_5_LenList[A_FSG_80_0_0_28_ArrayDataList_Length];
	 byte A_FSG_80_0_0_28_Data_5_CntList[A_FSG_80_0_0_28_ArrayDataList_Length];
	 long A_FSG_80_0_0_28_Data_5_SetGet_LenList[A_FSG_80_0_0_28_ArrayDataList_Length];
	 byte A_FSG_80_0_0_28_Data_5_SetGet_CntList[A_FSG_80_0_0_28_ArrayDataList_Length];

	 byte fctList_global[8];
	 byte StatusallMessagecount = 0;
	//// End konfigurationsabhýngige Variablen 
	
	/// Begin: Definition der BUS-Schnittstellen
	
	// FLEXRAY NOT ENABLED!
	
	// ETHERNET NOT ENABLED! 
	
	//// End Bus Schnittstellen

}

/*on preStart
{
    char Version[200];
    
    // **** Erzeugen der Ausgabeconsolen ****
    gBAP_Trace=writecreate("BAP-Trace");        //write-window for BAP-cummunication
    writeclear(gBAP_Trace);                     //clear BAP-window in write-window
    
    gError_Trace=writecreate("Error");          //error-window for BAP-cummunication
    writeclear(gError_Trace);                   //clear error-window in write-window
    
    writeclear(1);                              //clear CAPL-window in write-window 
    
    // *** Versionsstring von DLL holen und auf Bildschirm ausgeben ***
    BAP170_GetVersions( Version, 200);
    writelineEx(gBAP_Trace, 0, "Versionx:%s", Version);
                                            
    NODE_INDEX = BAP150_CreateNode();
    writelineEx(gBAP_Trace, 0, "FSG %d Nodeindex:%d", LSGID, Version);
    
    // FLEXRAY NOT ENABLED!
}*/

on preStart
{
    char Version[200];
    char Path[255];

    /***** Erzeugen der Ausgabeconsolen *****/  
    gBAP_Trace=writecreate("BAP-Trace");        //write-window for BAP-cummunication
    writeclear(gBAP_Trace);                     //clear BAP-window in write-window
    
    gError_Trace=writecreate("Error");          //error-window for BAP-cummunication
    writeclear(gError_Trace);                   //clear error-window in write-window
    
    writeclear(1);                              //clear CAPL-window in write-window
    
    /**** Versionsstring von DLL holen und auf Bildschirm ausgeben ***/ 
    BAP150_GetVersions(Version, 200);
    writelineEx(gBAP_Trace, 0, "Versionx:%s", Version);
                                            
    NODE_INDEX = BAP150_CreateNode();
    writelineEx(gBAP_Trace, 0, "FSG %d Nodeindex:%d", LSGID, Version);
    
    /**** Laden der CANoe Datenbank *****/
    getAbsFilePath(dbcan_path, Path, 255);
    writelineEx(gBAP_Trace, 0, "Load BAP_DBC-File: %s", Path);
    if(BAP150_LoadDBC(NODE_INDEX, 1, Path)  != 0) {        writelineEx(gError_Trace, 0, "Fehler beim Laden: %s !", Path);
    }

    /**** Laden des BAP XML Files ****/
    getAbsFilePath(xml_path, Path, 255);
    writelineEx(gBAP_Trace, 0, "Load BAP-XML-File: %s", Path);
    if (BAP150_LoadConfig(NODE_INDEX, Path) != 0) {
        writelineEx(gError_Trace, 0, "Fehler beim Laden: %s !", Path);
    }

    if (BAP150_AddCanMap(NODE_INDEX, 1, 1) != 0) {
        writelineEx(gError_Trace, 0, "Fehler beim Mappen!");
    }   
    
    // FLEXRAY NOT ENABLED!
}

DisableFctCtrl ()
{
  	EnableControl(panel_name, common_panel_name, 0);
	EnableControl(panel_name,gErrField1,0);
	EnableControl(panel_name,gErrField2,0);
	EnableControl(panel_name,gErrField3,0);
	EnableControl(panel_name,gErrField4,0);
	EnableControl(panel_name,gErrField13,0);
	EnableControl(panel_name,gPanel13,0);
	EnableControl(panel_name,"panel_P_FSG_80_0_0_13",0);
	EnableControl(panel_name,gErrField14,0);
	EnableControl(panel_name,gPanel14,0);
	EnableControl(panel_name,"panel_P_FSG_80_0_0_14",0);
	EnableControl(panel_name,gErrField15,0);
	EnableControl(panel_name,gPanel15,0);
	EnableControl(panel_name,"panel_P_FSG_80_0_0_15",0);
	EnableControl(panel_name,gErrField16,0);
	EnableControl(panel_name,gPanel16,0);
	EnableControl(panel_name,"panel_M_FSG_80_0_0_16_Result",0);
	EnableControl(panel_name,"panel_M_FSG_80_0_0_16_Processing",0);
	EnableControl(panel_name,"panel_M_FSG_80_0_0_16_Start",0);
	EnableControl(panel_name,gErrField17,0);
	EnableControl(panel_name,gPanel17,0);
	EnableControl(panel_name,"panel_P_FSG_80_0_0_17",0);
	EnableControl(panel_name,gErrField18,0);
	EnableControl(panel_name,gPanel18,0);
	EnableControl(panel_name,"panel_P_FSG_80_0_0_18",0);
	EnableControl(panel_name,gErrField19,0);
	EnableControl(panel_name,gPanel19,0);
	EnableControl(panel_name,"panel_P_FSG_80_0_0_19",0);
	EnableControl(panel_name,gErrField20,0);
	EnableControl(panel_name,gPanel20,0);
	EnableControl(panel_name,"panel_M_FSG_80_0_0_20_Result",0);
	EnableControl(panel_name,"panel_M_FSG_80_0_0_20_Processing",0);
	EnableControl(panel_name,"panel_M_FSG_80_0_0_20_Start",0);
	EnableControl(panel_name,gErrField21,0);
	EnableControl(panel_name,gPanel21,0);
	EnableControl(panel_name,"panel_P_FSG_80_0_0_21",0);
	EnableControl(panel_name,gErrField22,0);
	EnableControl(panel_name,gPanel22,0);
	EnableControl(panel_name,"panel_A_FSG_80_0_0_22",0);
	EnableControl(panel_name,"panel_A_FSG_80_0_0_22_Status",0);
	EnableControl(panel_name,"panel_A_FSG_80_0_0_22_Changed",0);
	EnableControl(panel_name,"panel_A_FSG_80_0_0_22_SetGet",0);
	EnableControl(panel_name,gErrField23,0);
	EnableControl(panel_name,gPanel23,0);
	EnableControl(panel_name,"panel_M_FSG_80_0_0_23_Result",0);
	EnableControl(panel_name,"panel_M_FSG_80_0_0_23_Processing",0);
	EnableControl(panel_name,"panel_M_FSG_80_0_0_23_Start",0);
	EnableControl(panel_name,gErrField24,0);
	EnableControl(panel_name,gPanel24,0);
	EnableControl(panel_name,"panel_A_FSG_80_0_0_24",0);
	EnableControl(panel_name,"panel_A_FSG_80_0_0_24_Status",0);
	EnableControl(panel_name,"panel_A_FSG_80_0_0_24_Changed",0);
	EnableControl(panel_name,"panel_A_FSG_80_0_0_24_SetGet",0);
	EnableControl(panel_name,gErrField25,0);
	EnableControl(panel_name,gPanel25,0);
	EnableControl(panel_name,"panel_P_FSG_80_0_0_25",0);
	EnableControl(panel_name,gErrField26,0);
	EnableControl(panel_name,gPanel26,0);
	EnableControl(panel_name,"panel_P_FSG_80_0_0_26",0);
	EnableControl(panel_name,gErrField27,0);
	EnableControl(panel_name,gPanel27,0);
	EnableControl(panel_name,"panel_M_FSG_80_0_0_27_Result",0);
	EnableControl(panel_name,"panel_M_FSG_80_0_0_27_Processing",0);
	EnableControl(panel_name,"panel_M_FSG_80_0_0_27_Start",0);
	EnableControl(panel_name,gErrField28,0);
	EnableControl(panel_name,gPanel28,0);
	EnableControl(panel_name,"panel_A_FSG_80_0_0_28",0);
	EnableControl(panel_name,"panel_A_FSG_80_0_0_28_Status",0);
	EnableControl(panel_name,"panel_A_FSG_80_0_0_28_Changed",0);
	EnableControl(panel_name,"panel_A_FSG_80_0_0_28_SetGet",0);

}

EnableFctCtrl ()
{
  	EnableControl(panel_name, common_panel_name, 1);
	if(getValue(P_FSG_80_0_0_13_FctLstItemEn)){
		 EnableControl(panel_name,gPanel13,1);
		 EnableControl(panel_name,gErrField13,1);
	}
	if(getValue(P_FSG_80_0_0_14_FctLstItemEn)){
		 EnableControl(panel_name,gPanel14,1);
		 EnableControl(panel_name,gErrField14,1);
	}
	if(getValue(P_FSG_80_0_0_15_FctLstItemEn)){
		 EnableControl(panel_name,gPanel15,1);
		 EnableControl(panel_name,gErrField15,1);
	}
	if(getValue(M_FSG_80_0_0_16_FctLstItemEn)){
		 EnableControl(panel_name,gPanel16,1);
		 EnableControl(panel_name,gErrField16,1);
	}
	if(getValue(P_FSG_80_0_0_17_FctLstItemEn)){
		 EnableControl(panel_name,gPanel17,1);
		 EnableControl(panel_name,gErrField17,1);
	}
	if(getValue(P_FSG_80_0_0_18_FctLstItemEn)){
		 EnableControl(panel_name,gPanel18,1);
		 EnableControl(panel_name,gErrField18,1);
	}
	if(getValue(P_FSG_80_0_0_19_FctLstItemEn)){
		 EnableControl(panel_name,gPanel19,1);
		 EnableControl(panel_name,gErrField19,1);
	}
	if(getValue(M_FSG_80_0_0_20_FctLstItemEn)){
		 EnableControl(panel_name,gPanel20,1);
		 EnableControl(panel_name,gErrField20,1);
	}
	if(getValue(P_FSG_80_0_0_21_FctLstItemEn)){
		 EnableControl(panel_name,gPanel21,1);
		 EnableControl(panel_name,gErrField21,1);
	}
	if(getValue(A_FSG_80_0_0_22_FctLstItemEn)){
		 EnableControl(panel_name,gPanel22,1);
	EnableControl(panel_name,"panel_A_FSG_80_0_0_22_Status",1);
		 EnableControl(panel_name,gErrField22,1);
	}
	if(getValue(M_FSG_80_0_0_23_FctLstItemEn)){
		 EnableControl(panel_name,gPanel23,1);
		 EnableControl(panel_name,gErrField23,1);
	}
	if(getValue(A_FSG_80_0_0_24_FctLstItemEn)){
		 EnableControl(panel_name,gPanel24,1);
	EnableControl(panel_name,"panel_A_FSG_80_0_0_24_Status",1);
		 EnableControl(panel_name,gErrField24,1);
	}
	if(getValue(P_FSG_80_0_0_25_FctLstItemEn)){
		 EnableControl(panel_name,gPanel25,1);
		 EnableControl(panel_name,gErrField25,1);
	}
	if(getValue(P_FSG_80_0_0_26_FctLstItemEn)){
		 EnableControl(panel_name,gPanel26,1);
		 EnableControl(panel_name,gErrField26,1);
	}
	if(getValue(M_FSG_80_0_0_27_FctLstItemEn)){
		 EnableControl(panel_name,gPanel27,1);
		 EnableControl(panel_name,gErrField27,1);
	}
	if(getValue(A_FSG_80_0_0_28_FctLstItemEn)){
		 EnableControl(panel_name,gPanel28,1);
	EnableControl(panel_name,"panel_A_FSG_80_0_0_28_Status",1);
		 EnableControl(panel_name,gErrField28,1);
	}

}

DisableConfigCtrl ()
{
    EnableControl(panel_name, bapconfig_panel_name, 0);
	EnableControl(panel_name, "panel1_edit", 0);
//	EnableControl(panel_name,gCheckbox1,0);
//	if(!getValue(C_FSG_80_0_0_1_FctLstItemEn)){
//		 SetControlBackColor(panel_name,gCheckbox1,MakeRGB(200,200,200));
//	}
//	EnableControl(panel_name,gCheckbox2,0);
//	if(!getValue(P_FSG_80_0_0_2_FctLstItemEn)){
//		 SetControlBackColor(panel_name,gCheckbox2,MakeRGB(200,200,200));
//	}
//	EnableControl(panel_name,gCheckbox3,0);
//	if(!getValue(P_FSG_80_0_0_3_FctLstItemEn)){
//		 SetControlBackColor(panel_name,gCheckbox3,MakeRGB(200,200,200));
//	}
	EnableControl(panel_name, "panel_P_FSG_80_0_0_4", 0);
//	EnableControl(panel_name,gCheckbox4,0);
//	if(!getValue(P_FSG_80_0_0_4_FctLstItemEn)){
//		 SetControlBackColor(panel_name,gCheckbox4,MakeRGB(200,200,200));
//	}
//	EnableControl(panel_name,gCheckbox13,0);
//	if(!getValue(P_FSG_80_0_0_13_FctLstItemEn)){
//		 SetControlBackColor(panel_name,gCheckbox13,MakeRGB(200,200,200));
//	}
//	EnableControl(panel_name,gCheckbox14,0);
//	if(!getValue(P_FSG_80_0_0_14_FctLstItemEn)){
//		 SetControlBackColor(panel_name,gCheckbox14,MakeRGB(200,200,200));
//	}
//	EnableControl(panel_name,gCheckbox15,0);
//	if(!getValue(P_FSG_80_0_0_15_FctLstItemEn)){
//		 SetControlBackColor(panel_name,gCheckbox15,MakeRGB(200,200,200));
//	}
//	EnableControl(panel_name,gCheckbox16,0);
//	if(!getValue(M_FSG_80_0_0_16_FctLstItemEn)){
//		 SetControlBackColor(panel_name,gCheckbox16,MakeRGB(200,200,200));
//	}
//	EnableControl(panel_name,gCheckbox17,0);
//	if(!getValue(P_FSG_80_0_0_17_FctLstItemEn)){
//		 SetControlBackColor(panel_name,gCheckbox17,MakeRGB(200,200,200));
//	}
//	EnableControl(panel_name,gCheckbox18,0);
//	if(!getValue(P_FSG_80_0_0_18_FctLstItemEn)){
//		 SetControlBackColor(panel_name,gCheckbox18,MakeRGB(200,200,200));
//	}
//	EnableControl(panel_name,gCheckbox19,0);
//	if(!getValue(P_FSG_80_0_0_19_FctLstItemEn)){
//		 SetControlBackColor(panel_name,gCheckbox19,MakeRGB(200,200,200));
//	}
//	EnableControl(panel_name,gCheckbox20,0);
//	if(!getValue(M_FSG_80_0_0_20_FctLstItemEn)){
//		 SetControlBackColor(panel_name,gCheckbox20,MakeRGB(200,200,200));
//	}
//	EnableControl(panel_name,gCheckbox21,0);
//	if(!getValue(P_FSG_80_0_0_21_FctLstItemEn)){
//		 SetControlBackColor(panel_name,gCheckbox21,MakeRGB(200,200,200));
//	}
//	EnableControl(panel_name,gCheckbox22,0);
//	if(!getValue(A_FSG_80_0_0_22_FctLstItemEn)){
//		 SetControlBackColor(panel_name,gCheckbox22,MakeRGB(200,200,200));
//	}
//	EnableControl(panel_name,gCheckbox23,0);
//	if(!getValue(M_FSG_80_0_0_23_FctLstItemEn)){
//		 SetControlBackColor(panel_name,gCheckbox23,MakeRGB(200,200,200));
//	}
//	EnableControl(panel_name,gCheckbox24,0);
//	if(!getValue(A_FSG_80_0_0_24_FctLstItemEn)){
//		 SetControlBackColor(panel_name,gCheckbox24,MakeRGB(200,200,200));
//	}
//	EnableControl(panel_name,gCheckbox25,0);
//	if(!getValue(P_FSG_80_0_0_25_FctLstItemEn)){
//		 SetControlBackColor(panel_name,gCheckbox25,MakeRGB(200,200,200));
//	}
//	EnableControl(panel_name,gCheckbox26,0);
//	if(!getValue(P_FSG_80_0_0_26_FctLstItemEn)){
//		 SetControlBackColor(panel_name,gCheckbox26,MakeRGB(200,200,200));
//	}
//	EnableControl(panel_name,gCheckbox27,0);
//	if(!getValue(M_FSG_80_0_0_27_FctLstItemEn)){
//		 SetControlBackColor(panel_name,gCheckbox27,MakeRGB(200,200,200));
//	}
//	EnableControl(panel_name,gCheckbox28,0);
//	if(!getValue(A_FSG_80_0_0_28_FctLstItemEn)){
//		 SetControlBackColor(panel_name,gCheckbox28,MakeRGB(200,200,200));
//	}

}

EnableConfigCtrl ()
{
  	EnableControl(panel_name, bapconfig_panel_name, 1);
	EnableControl(panel_name, "panel1_edit", 1);
	if(getValue(C_FSG_80_0_0_1_FctLstItemEn))
	{
		setControlForeColor(panel_name, gCheckbox1, MakeRGB(0,240,0));
	}
	else
	{
		setControlForeColor(panel_name, gCheckbox1, MakeRGB(250,0,0));
	}
	if(getValue(P_FSG_80_0_0_2_FctLstItemEn))
	{
		setControlForeColor(panel_name, gCheckbox2, MakeRGB(0,240,0));
	}
	else
	{
		setControlForeColor(panel_name, gCheckbox2, MakeRGB(250,0,0));
	}
	if(getValue(P_FSG_80_0_0_3_FctLstItemEn))
	{
		setControlForeColor(panel_name, gCheckbox3, MakeRGB(0,240,0));
	}
	else
	{
		setControlForeColor(panel_name, gCheckbox3, MakeRGB(250,0,0));
	}
	EnableControl(panel_name, "panel_P_FSG_80_0_0_4", 1);
	if(getValue(P_FSG_80_0_0_4_FctLstItemEn))
	{
		setControlForeColor(panel_name, gCheckbox4, MakeRGB(0,240,0));
	}
	else
	{
		setControlForeColor(panel_name, gCheckbox4, MakeRGB(250,0,0));
	}
	if(getValue(P_FSG_80_0_0_13_FctLstItemEn))
	{
		EnableControl(panel_name, "panel_P_FSG_80_0_0_13",1);
		EnableControl(panel_name,"errfield_P_FSG_80_0_0_13",1);
		setControlForeColor(panel_name, gCheckbox13, MakeRGB(0,240,0));
	}
	else
	{
		EnableControl(panel_name, "panel_P_FSG_80_0_0_13",0);
		EnableControl(panel_name,"errfield_P_FSG_80_0_0_13",0);
		setControlForeColor(panel_name, gCheckbox13, MakeRGB(250,0,0));
	}
	if(getValue(P_FSG_80_0_0_14_FctLstItemEn))
	{
		EnableControl(panel_name, "panel_P_FSG_80_0_0_14",1);
		EnableControl(panel_name,"errfield_P_FSG_80_0_0_14",1);
		setControlForeColor(panel_name, gCheckbox14, MakeRGB(0,240,0));
	}
	else
	{
		EnableControl(panel_name, "panel_P_FSG_80_0_0_14",0);
		EnableControl(panel_name,"errfield_P_FSG_80_0_0_14",0);
		setControlForeColor(panel_name, gCheckbox14, MakeRGB(250,0,0));
	}
	if(getValue(P_FSG_80_0_0_15_FctLstItemEn))
	{
		EnableControl(panel_name, "panel_P_FSG_80_0_0_15",1);
		EnableControl(panel_name,"errfield_P_FSG_80_0_0_15",1);
		setControlForeColor(panel_name, gCheckbox15, MakeRGB(0,240,0));
	}
	else
	{
		EnableControl(panel_name, "panel_P_FSG_80_0_0_15",0);
		EnableControl(panel_name,"errfield_P_FSG_80_0_0_15",0);
		setControlForeColor(panel_name, gCheckbox15, MakeRGB(250,0,0));
	}
	if(getValue(M_FSG_80_0_0_16_FctLstItemEn))
	{
		EnableControl(panel_name, "panel_M_FSG_80_0_0_16",1);
		EnableControl(panel_name,"errfield_M_FSG_80_0_0_16",1);
		EnableControl(panel_name,"panel_M_FSG_80_0_0_16_Processing",1);
		EnableControl(panel_name,"panel_M_FSG_80_0_0_16_Start",1);
		setControlForeColor(panel_name, gCheckbox16, MakeRGB(0,240,0));
	}
	else
	{
		EnableControl(panel_name, "panel_M_FSG_80_0_0_16",0);
		EnableControl(panel_name,"errfield_M_FSG_80_0_0_16",0);
		EnableControl(panel_name,"panel_M_FSG_80_0_0_16_Processing",0);
		EnableControl(panel_name,"panel_M_FSG_80_0_0_16_Start",0);
		setControlForeColor(panel_name, gCheckbox16, MakeRGB(250,0,0));
	}
	if(getValue(P_FSG_80_0_0_17_FctLstItemEn))
	{
		EnableControl(panel_name, "panel_P_FSG_80_0_0_17",1);
		EnableControl(panel_name,"errfield_P_FSG_80_0_0_17",1);
		setControlForeColor(panel_name, gCheckbox17, MakeRGB(0,240,0));
	}
	else
	{
		EnableControl(panel_name, "panel_P_FSG_80_0_0_17",0);
		EnableControl(panel_name,"errfield_P_FSG_80_0_0_17",0);
		setControlForeColor(panel_name, gCheckbox17, MakeRGB(250,0,0));
	}
	if(getValue(P_FSG_80_0_0_18_FctLstItemEn))
	{
		EnableControl(panel_name, "panel_P_FSG_80_0_0_18",1);
		EnableControl(panel_name,"errfield_P_FSG_80_0_0_18",1);
		setControlForeColor(panel_name, gCheckbox18, MakeRGB(0,240,0));
	}
	else
	{
		EnableControl(panel_name, "panel_P_FSG_80_0_0_18",0);
		EnableControl(panel_name,"errfield_P_FSG_80_0_0_18",0);
		setControlForeColor(panel_name, gCheckbox18, MakeRGB(250,0,0));
	}
	if(getValue(P_FSG_80_0_0_19_FctLstItemEn))
	{
		EnableControl(panel_name, "panel_P_FSG_80_0_0_19",1);
		EnableControl(panel_name,"errfield_P_FSG_80_0_0_19",1);
		setControlForeColor(panel_name, gCheckbox19, MakeRGB(0,240,0));
	}
	else
	{
		EnableControl(panel_name, "panel_P_FSG_80_0_0_19",0);
		EnableControl(panel_name,"errfield_P_FSG_80_0_0_19",0);
		setControlForeColor(panel_name, gCheckbox19, MakeRGB(250,0,0));
	}
	if(getValue(M_FSG_80_0_0_20_FctLstItemEn))
	{
		EnableControl(panel_name, "panel_M_FSG_80_0_0_20",1);
		EnableControl(panel_name,"errfield_M_FSG_80_0_0_20",1);
		EnableControl(panel_name,"panel_M_FSG_80_0_0_20_Processing",1);
		EnableControl(panel_name,"panel_M_FSG_80_0_0_20_Start",1);
		setControlForeColor(panel_name, gCheckbox20, MakeRGB(0,240,0));
	}
	else
	{
		EnableControl(panel_name, "panel_M_FSG_80_0_0_20",0);
		EnableControl(panel_name,"errfield_M_FSG_80_0_0_20",0);
		EnableControl(panel_name,"panel_M_FSG_80_0_0_20_Processing",0);
		EnableControl(panel_name,"panel_M_FSG_80_0_0_20_Start",0);
		setControlForeColor(panel_name, gCheckbox20, MakeRGB(250,0,0));
	}
	if(getValue(P_FSG_80_0_0_21_FctLstItemEn))
	{
		EnableControl(panel_name, "panel_P_FSG_80_0_0_21",1);
		EnableControl(panel_name,"errfield_P_FSG_80_0_0_21",1);
		setControlForeColor(panel_name, gCheckbox21, MakeRGB(0,240,0));
	}
	else
	{
		EnableControl(panel_name, "panel_P_FSG_80_0_0_21",0);
		EnableControl(panel_name,"errfield_P_FSG_80_0_0_21",0);
		setControlForeColor(panel_name, gCheckbox21, MakeRGB(250,0,0));
	}
	if(getValue(A_FSG_80_0_0_22_FctLstItemEn))
	{
		EnableControl(panel_name, "panel_A_FSG_80_0_0_22",1);
		EnableControl(panel_name,"panel_A_FSG_80_0_0_22_Status",1);
		EnableControl(panel_name,"errfield_A_FSG_80_0_0_22",1);
		EnableControl(panel_name,"panel_A_FSG_80_0_0_22_Changed",1);
		EnableControl(panel_name,"panel_A_FSG_80_0_0_22_SetGet",1);
		setControlForeColor(panel_name, gCheckbox22, MakeRGB(0,240,0));
	}
	else
	{
		EnableControl(panel_name, "panel_A_FSG_80_0_0_22",0);
		EnableControl(panel_name,"panel_A_FSG_80_0_0_22_Status",0);
		EnableControl(panel_name,"errfield_A_FSG_80_0_0_22",0);
		EnableControl(panel_name,"panel_A_FSG_80_0_0_22_Changed",0);
		EnableControl(panel_name,"panel_A_FSG_80_0_0_22_SetGet",0);
		setControlForeColor(panel_name, gCheckbox22, MakeRGB(250,0,0));
	}
	if(getValue(M_FSG_80_0_0_23_FctLstItemEn))
	{
		EnableControl(panel_name, "panel_M_FSG_80_0_0_23",1);
		EnableControl(panel_name,"errfield_M_FSG_80_0_0_23",1);
		EnableControl(panel_name,"panel_M_FSG_80_0_0_23_Processing",1);
		EnableControl(panel_name,"panel_M_FSG_80_0_0_23_Start",1);
		setControlForeColor(panel_name, gCheckbox23, MakeRGB(0,240,0));
	}
	else
	{
		EnableControl(panel_name, "panel_M_FSG_80_0_0_23",0);
		EnableControl(panel_name,"errfield_M_FSG_80_0_0_23",0);
		EnableControl(panel_name,"panel_M_FSG_80_0_0_23_Processing",0);
		EnableControl(panel_name,"panel_M_FSG_80_0_0_23_Start",0);
		setControlForeColor(panel_name, gCheckbox23, MakeRGB(250,0,0));
	}
	if(getValue(A_FSG_80_0_0_24_FctLstItemEn))
	{
		EnableControl(panel_name, "panel_A_FSG_80_0_0_24",1);
		EnableControl(panel_name,"panel_A_FSG_80_0_0_24_Status",1);
		EnableControl(panel_name,"errfield_A_FSG_80_0_0_24",1);
		EnableControl(panel_name,"panel_A_FSG_80_0_0_24_Changed",1);
		EnableControl(panel_name,"panel_A_FSG_80_0_0_24_SetGet",1);
		setControlForeColor(panel_name, gCheckbox24, MakeRGB(0,240,0));
	}
	else
	{
		EnableControl(panel_name, "panel_A_FSG_80_0_0_24",0);
		EnableControl(panel_name,"panel_A_FSG_80_0_0_24_Status",0);
		EnableControl(panel_name,"errfield_A_FSG_80_0_0_24",0);
		EnableControl(panel_name,"panel_A_FSG_80_0_0_24_Changed",0);
		EnableControl(panel_name,"panel_A_FSG_80_0_0_24_SetGet",0);
		setControlForeColor(panel_name, gCheckbox24, MakeRGB(250,0,0));
	}
	if(getValue(P_FSG_80_0_0_25_FctLstItemEn))
	{
		EnableControl(panel_name, "panel_P_FSG_80_0_0_25",1);
		EnableControl(panel_name,"errfield_P_FSG_80_0_0_25",1);
		setControlForeColor(panel_name, gCheckbox25, MakeRGB(0,240,0));
	}
	else
	{
		EnableControl(panel_name, "panel_P_FSG_80_0_0_25",0);
		EnableControl(panel_name,"errfield_P_FSG_80_0_0_25",0);
		setControlForeColor(panel_name, gCheckbox25, MakeRGB(250,0,0));
	}
	if(getValue(P_FSG_80_0_0_26_FctLstItemEn))
	{
		EnableControl(panel_name, "panel_P_FSG_80_0_0_26",1);
		EnableControl(panel_name,"errfield_P_FSG_80_0_0_26",1);
		setControlForeColor(panel_name, gCheckbox26, MakeRGB(0,240,0));
	}
	else
	{
		EnableControl(panel_name, "panel_P_FSG_80_0_0_26",0);
		EnableControl(panel_name,"errfield_P_FSG_80_0_0_26",0);
		setControlForeColor(panel_name, gCheckbox26, MakeRGB(250,0,0));
	}
	if(getValue(M_FSG_80_0_0_27_FctLstItemEn))
	{
		EnableControl(panel_name, "panel_M_FSG_80_0_0_27",1);
		EnableControl(panel_name,"errfield_M_FSG_80_0_0_27",1);
		EnableControl(panel_name,"panel_M_FSG_80_0_0_27_Processing",1);
		EnableControl(panel_name,"panel_M_FSG_80_0_0_27_Start",1);
		setControlForeColor(panel_name, gCheckbox27, MakeRGB(0,240,0));
	}
	else
	{
		EnableControl(panel_name, "panel_M_FSG_80_0_0_27",0);
		EnableControl(panel_name,"errfield_M_FSG_80_0_0_27",0);
		EnableControl(panel_name,"panel_M_FSG_80_0_0_27_Processing",0);
		EnableControl(panel_name,"panel_M_FSG_80_0_0_27_Start",0);
		setControlForeColor(panel_name, gCheckbox27, MakeRGB(250,0,0));
	}
	if(getValue(A_FSG_80_0_0_28_FctLstItemEn))
	{
		EnableControl(panel_name, "panel_A_FSG_80_0_0_28",1);
		EnableControl(panel_name,"panel_A_FSG_80_0_0_28_Status",1);
		EnableControl(panel_name,"errfield_A_FSG_80_0_0_28",1);
		EnableControl(panel_name,"panel_A_FSG_80_0_0_28_Changed",1);
		EnableControl(panel_name,"panel_A_FSG_80_0_0_28_SetGet",1);
		setControlForeColor(panel_name, gCheckbox28, MakeRGB(0,240,0));
	}
	else
	{
		EnableControl(panel_name, "panel_A_FSG_80_0_0_28",0);
		EnableControl(panel_name,"panel_A_FSG_80_0_0_28_Status",0);
		EnableControl(panel_name,"errfield_A_FSG_80_0_0_28",0);
		EnableControl(panel_name,"panel_A_FSG_80_0_0_28_Changed",0);
		EnableControl(panel_name,"panel_A_FSG_80_0_0_28_SetGet",0);
		setControlForeColor(panel_name, gCheckbox28, MakeRGB(250,0,0));
	}

}

resetErrfieldColor()
{
  	setControlBackColor(panel_name, "errfield_C_FSG_80_0_0_1", MakeRGB(255,255,255));
	setControlBackColor(panel_name, "errfield_P_FSG_80_0_0_2", MakeRGB(255,255,255));
	setControlBackColor(panel_name, "errfield_P_FSG_80_0_0_3", MakeRGB(255,255,255));
	setControlBackColor(panel_name, "errfield_P_FSG_80_0_0_4", MakeRGB(255,255,255));
	setControlBackColor(panel_name, "errfield_P_FSG_80_0_0_13", MakeRGB(255,255,255));
	setControlBackColor(panel_name, "errfield_P_FSG_80_0_0_14", MakeRGB(255,255,255));
	setControlBackColor(panel_name, "errfield_P_FSG_80_0_0_15", MakeRGB(255,255,255));
	setControlBackColor(panel_name, "errfield_M_FSG_80_0_0_16", MakeRGB(255,255,255));
	setControlBackColor(panel_name, "errfield_P_FSG_80_0_0_17", MakeRGB(255,255,255));
	setControlBackColor(panel_name, "errfield_P_FSG_80_0_0_18", MakeRGB(255,255,255));
	setControlBackColor(panel_name, "errfield_P_FSG_80_0_0_19", MakeRGB(255,255,255));
	setControlBackColor(panel_name, "errfield_M_FSG_80_0_0_20", MakeRGB(255,255,255));
	setControlBackColor(panel_name, "errfield_P_FSG_80_0_0_21", MakeRGB(255,255,255));
	setControlBackColor(panel_name, "errfield_A_FSG_80_0_0_22", MakeRGB(255,255,255));
	setControlBackColor(panel_name, "errfield_M_FSG_80_0_0_23", MakeRGB(255,255,255));
	setControlBackColor(panel_name, "errfield_A_FSG_80_0_0_24", MakeRGB(255,255,255));
	setControlBackColor(panel_name, "errfield_P_FSG_80_0_0_25", MakeRGB(255,255,255));
	setControlBackColor(panel_name, "errfield_P_FSG_80_0_0_26", MakeRGB(255,255,255));
	setControlBackColor(panel_name, "errfield_M_FSG_80_0_0_27", MakeRGB(255,255,255));
	setControlBackColor(panel_name, "errfield_A_FSG_80_0_0_28", MakeRGB(255,255,255));

}

CANoe_Shutdown ()
{
	// Timer: cancel real CAN-communication timer
	canceltimer(TaskTimer);
	// Ruecksetzen der Hintergrundfarbe der Error-Felder
	resetErrfieldColor();
	// Deaktivierung aller Panel Elemente 
	EnableConfigCtrl();
}

on timer TaskTimer
{
	/*** Aufruf des BAP Task in DLL fuer NODE_INDEX ***/
	BAP150_Task(NODE_INDEX);	

	/*** Pollen ueber die anstehenden Indications (Lesen aus DLL, Auslesen eines Puffers der DLL) ***/
	BAP_DLL_Indication();	
	
	/*** Pollen ueber die anstehenden Requests (Schreiben in DLL, dort werden evt. Sendeauftraege gesetzt) ***/
	BAP_DLL_Request();
	
	/*** Abarbeiten der ausstehenden Sendeauftraege innerhalb der BAP DLL und Versenden ueber CANoe ***/
	if (getValue(eSendEnabled))
	{
		BAP_CAN_TX_Request();
	}

	//BAP_DLL_SetRxData();

	/*** Retriggern des Timers mit 10 ms ***/
	setTimer(TaskTimer, TaskTime); // @TODO bei anderer Taskzeit muss hier modifiziert werden
}


BAP_DLL_SetRxData()
{
}


BAP_DLL_Indication()	//function to get received BAP-data from DLL (at BAL-interface)
{
	int i, length, datalength, temp;
	byte Indication_data[BAP_buffer_size];		// indication data from DLL
	dword Indication_header[6];					// indication header from DLL
	byte BAP_data_type;

	// init local variables
	length=0;
	datalength=0;
	temp=0;
	BAP_data_type=0;

	for(i = 0; i < 6; i++)
		Indication_header[i]=0;

	for(i = 0; i < BAP_buffer_size; i++)
		Indication_data[i]=0;

	// BAP-Stack needs this information for successful BAP150_GetIndication 
	Indication_header[4]=BAP_buffer_size;

	while (BAP150_GetInd(NODE_INDEX, Indication_header, Indication_data) == 0)
	{		
		//read header and write in global variable
		for (i = 0; i < 6; i++) {
			gBAP_Indication_header[i]=Indication_header[i];	
		}

		// nur Bytesequneces haben Datenanteil
		if (gBAP_Indication_header[3] == Bap_byteSequence)
		{
			for (i = 0; i < BAP_buffer_size; i++) {
				gBAP_Indication_data[i]=Indication_data[i];	
			}
		}	
		// Verarbeiten der Indication
		Process_Current_Indication();

		// Vorbereiten fuer naechsten Durchlauf 
		Indication_header[4]=BAP_buffer_size;
	} 
}

setBitInFctList(word fctid, byte fctList[])
{
    byte byteNo ;
    byte bitno ;
    byte fctValue ;

    byteNo = fctid / 8;
    bitno = fctid % 8;
    fctValue = 0x80 >> bitno;
    fctList[byteNo] |= fctValue;
  writelineex(4,0,"fctList[%d]: %X",byteNo,fctList[byteNo]);
}

float round (float value, float step)
{
	return _floor(value / step + 0.5) * step;
}

ChangeConfig(long paramIndex,long config[])
{
        byte temp ;
        temp = BAP150_ChangeConfig(NODE_INDEX, paramIndex, config);
        if(temp == 0)
            writelineEx(gBAP_Trace, 0, "BAP150_ChangeConfig for %s succesful (LSG %d, NODE_INDEX %d)", NODE_NAME, LSGID, NODE_INDEX);
        else
            writelineEx(gError_Trace, 0, "BAP150_ChangeConfig error 0x%X for %s (LSG %d, NODE_INDEX %d)", temp, NODE_NAME, LSGID, NODE_INDEX);        
}

PrintIndicationError(char reason[])
{
	writelineEx(gError_Trace, 0, "%s - %s lsgId:%d fctid:%d indType:%d dataType:%s",
		reason, SGtype, gBAP_Indication_header[0], gBAP_Indication_header[1], Indicationtype_Text[gBAP_Indication_header[2]], Datatype_Text[gBAP_Indication_header[3]]);
}

initBapConfig()
{
        long config[3];
    config[0] = LSGID;
    config[1] = 0;
    config[2] = getValue(BAPCFG_FSG_80_0_0_ProtocolMajor);
    ChangeConfig(0x0012,config);
    config[2] = getValue(BAPCFG_FSG_80_0_0_ProtocolMinor);
    ChangeConfig(0x0013,config);
    config[2] = getValue(BAPCFG_FSG_80_0_0_LsgClassMajor);
    ChangeConfig(0x0010,config);
    config[2] = getValue(BAPCFG_FSG_80_0_0_LsgClassMinor);
    ChangeConfig(0x0011,config);
    config[2] = getValue(BAPCFG_FSG_80_0_0_DFMajor);
    ChangeConfig(0x0014,config);
    config[2] = getValue(BAPCFG_FSG_80_0_0_DFMinor);
    ChangeConfig(0x0015,config);
    
}

initFctList()
{
    byte fctList[8]={0,0,0,0,0,0,0,0};
    int i;
    dword request[6];
    byte errorCode;

    fctList[0]=0;
    fctList[1]=0;
    fctList[2]=0;
    fctList[3]=0;
    fctList[4]=0;
    fctList[5]=0;
    fctList[6]=0;
    fctList[7]=0;

    /*if(getValue(P_FSG_44_0_13_FunctionListId))
    {
        setBitInFctList(P_FSG_44_0_13_ID, fctList);
    }*/
           if(getValue(P_FSG_80_0_0_19_FctLstItemEn))
       {
           setBitInFctList(P_FSG_80_0_0_19_ID, fctList);
       }
       if(getValue(P_FSG_80_0_0_18_FctLstItemEn))
       {
           setBitInFctList(P_FSG_80_0_0_18_ID, fctList);
       }
       if(getValue(P_FSG_80_0_0_17_FctLstItemEn))
       {
           setBitInFctList(P_FSG_80_0_0_17_ID, fctList);
       }
       if(getValue(M_FSG_80_0_0_16_FctLstItemEn))
       {
           setBitInFctList(M_FSG_80_0_0_16_ID, fctList);
       }
       if(getValue(P_FSG_80_0_0_15_FctLstItemEn))
       {
           setBitInFctList(P_FSG_80_0_0_15_ID, fctList);
       }
       if(getValue(P_FSG_80_0_0_14_FctLstItemEn))
       {
           setBitInFctList(P_FSG_80_0_0_14_ID, fctList);
       }
       if(getValue(P_FSG_80_0_0_13_FctLstItemEn))
       {
           setBitInFctList(P_FSG_80_0_0_13_ID, fctList);
       }
       if(getValue(A_FSG_80_0_0_28_FctLstItemEn))
       {
           setBitInFctList(A_FSG_80_0_0_28_ID, fctList);
       }
       if(getValue(M_FSG_80_0_0_27_FctLstItemEn))
       {
           setBitInFctList(M_FSG_80_0_0_27_ID, fctList);
       }
       if(getValue(P_FSG_80_0_0_26_FctLstItemEn))
       {
           setBitInFctList(P_FSG_80_0_0_26_ID, fctList);
       }
       if(getValue(P_FSG_80_0_0_4_FctLstItemEn))
       {
           setBitInFctList(P_FSG_80_0_0_4_ID, fctList);
       }
       if(getValue(P_FSG_80_0_0_25_FctLstItemEn))
       {
           setBitInFctList(P_FSG_80_0_0_25_ID, fctList);
       }
       if(getValue(P_FSG_80_0_0_3_FctLstItemEn))
       {
           setBitInFctList(P_FSG_80_0_0_3_ID, fctList);
       }
       if(getValue(A_FSG_80_0_0_24_FctLstItemEn))
       {
           setBitInFctList(A_FSG_80_0_0_24_ID, fctList);
       }
       if(getValue(P_FSG_80_0_0_2_FctLstItemEn))
       {
           setBitInFctList(P_FSG_80_0_0_2_ID, fctList);
       }
       if(getValue(M_FSG_80_0_0_23_FctLstItemEn))
       {
           setBitInFctList(M_FSG_80_0_0_23_ID, fctList);
       }
       if(getValue(C_FSG_80_0_0_1_FctLstItemEn))
       {
           setBitInFctList(C_FSG_80_0_0_1_ID, fctList);
       }
       if(getValue(A_FSG_80_0_0_22_FctLstItemEn))
       {
           setBitInFctList(A_FSG_80_0_0_22_ID, fctList);
       }
       if(getValue(P_FSG_80_0_0_21_FctLstItemEn))
       {
           setBitInFctList(P_FSG_80_0_0_21_ID, fctList);
       }
       if(getValue(M_FSG_80_0_0_20_FctLstItemEn))
       {
           setBitInFctList(M_FSG_80_0_0_20_ID, fctList);
       }


    for(i=0;i<8;i++){
        writelineEx(gBAP_Trace, 0, "fctList[%d]: 0x%02x ",i,fctList[i]);
    }

    for(i=0;i<8;i++){
        writelineEx(gBAP_Trace, 0, "fctList[%d]: 0x%02x ",i,fctList[i]);
        //MR 81562
        fctList_global[i] = fctList[i];
    }

    request [0]= 80; // LSG-ID
    request [1]= 3;
    request [3]= Bap_byteSequence;
    request [4]= 8;

    errorCode= BAP150_InitSendBuf(NODE_INDEX,request,fctList);
      
    if(errorCode)
        writelineEx(gError_Trace, 0, "BAP150_InitSendBuf(Functionlist) returns 0x%02x ",errorCode);
}

initHeartbeat()
{
       long data[2];
   data[0]=80;//LSGID;
   if( getValue(P_FSG_80_0_0_4_FctLstItemEn) )
      data[1]=getValue(P_FSG_80_0_0_4);
   else
      data[1]=0;
   ChangeConfig(0x00,data);
   InitSendBuf_int8(P_FSG_80_0_0_4_ID, data[1]);

}

/*BapOnOff(byte _on)
{
  int length, temp;
  char Path[255];*/
  
  /***** Einschalten ******/
  /*if(_on==1){
    if(@BusType_FSG80_0 == 0){  // Uses CAN
      getAbsFilePath(dbcan_path, Path, 255);
      if(BAP180_LoadDB(NODE_INDEX,1, 0, Path) != 0){ // CG
        writelineEx(gError_Trace, 0, "Fehler beim Laden: %s !", Path);
      }
    }*/
      
    /**** Laden des BAP XML Files ****/
    /*getAbsFilePath(xml_path, Path, 255);
    writelineEx(gBAP_Trace, 0, "Load BAP-XML-File: %s", Path);
    if (BAP150_LoadConfig(NODE_INDEX, Path) != 0) {
        writelineEx(gError_Trace, 0, "Fehler beim Laden: %s !", Path);
    }

    if (BAP150_AddCanMap(NODE_INDEX, 1, 1) != 0) {
        writelineEx(gError_Trace, 0, "Fehler beim Mappen!");
    }
    
  
    // soll der BAP Stack wieder initlialisiert werden?                                 
    if(gBAP_Init==0){
        //gBAP_Init=1;
        temp=BAP150_Init(NODE_INDEX, LSGID);
        if(temp==0)
            writelineEx(gBAP_Trace, 0, "BAP_Init for %s succesful (LSG %d, NODE_INDEX %d)", NODE_NAME, LSGID, NODE_INDEX);
        else
            writelineEx(gError_Trace, 0, "BAP_Init error 0x%X for %s (LSG %d, NODE_INDEX %d)", temp, NODE_NAME, LSGID, NODE_INDEX);         
    }

    // Initialisierung aller Variablen
    Initialize_Variables();                     

    // Aktivierung aller Panelelemente
    EnableFctCtrl();
    //EnableControl(panel_name, bapconfig_panel_name, 0); // @TODO
    DisableConfigCtrl();

    
    //BAP-Shutdown
    temp = BAP150_Shutdown(NODE_INDEX, LSGID);
    if(temp==0)
        writelineEx(gBAP_Trace, 0, "BAP_Shutdown for %s succesful (LSG %d, NODE_INDEX %d)", NODE_NAME, LSGID, NODE_INDEX);
    else
        writelineEx(gError_Trace, 0, "BAP_Shutdown error 0x%X for %s (LSG %d, NODE_INDEX %d)", temp, NODE_NAME, LSGID, NODE_INDEX); 

    initBapConfig();
    initFctList();
    initHeartbeat();

    temp = BAP150_Start(NODE_INDEX, LSGID);             
    if(temp == 0)
        writelineEx(gBAP_Trace, 0, "BAP_Start for %s succesful (LSG %d, NODE_INDEX %d)", NODE_NAME, LSGID, NODE_INDEX);
    else
        writelineEx(gError_Trace, 0, "BAP_Start error 0x%X for %s (LSG %d, NODE_INDEX %d)", temp, NODE_NAME, LSGID, NODE_INDEX);        

    // setze den Timer fuer den zyklischen Aufruf des CANoe-"Tasks"
    setTimer(TaskTimer, 10);                
// ETHERNET AND FLEXRAY NOT ENABLED!
    //  BAPFsg_ProcessDebug(NODE_INDEX,DEBUG_CAN_CHANNEL, DEBUG_ID, LSGID, DEBUG_SWITCH_ON);    
  }*/
  //else{ /***** Ausschalten ****/
      
   //   BAP150_Shutdown(NODE_INDEX,LSGID);
      
  //    CANoe_Shutdown();
      
      // ETHERNET NOT ENABLED! (CALL_FCT_CLOSE_UPD_SOCKET_TOKEN)
 // }

//}


BapOnOff(byte _on)
{
    int length, temp;

    /***** Einschalten ******/
    if(_on==1){
        // soll der BAP Stack wieder initlialisiert werden?                                 
        if(gBAP_Init==0){
            gBAP_Init=1;
            temp=BAP150_Init(NODE_INDEX, LSGID);
            Init_Arrays();
            if(temp==0)
                writelineEx(gBAP_Trace, 0, "BAP_Init for %s succesful (LSG %d, NODE_INDEX %d)", NODE_NAME, LSGID, NODE_INDEX);
            else
                writelineEx(gError_Trace, 0, "BAP_Init error 0x%X for %s (LSG %d, NODE_INDEX %d)", temp, NODE_NAME, LSGID, NODE_INDEX);         
        }

        // Initialisierung aller Variablen
        Initialize_Variables();                     

        // Aktivierung aller Panelelemente
		EnableFctCtrl();
        //EnableControl(panel_name, bapconfig_panel_name, 0); // @TODO
		DisableConfigCtrl();


        //BAP-Shutdown
        temp = BAP150_Shutdown(NODE_INDEX, LSGID);
        if(temp==0)
            writelineEx(gBAP_Trace, 0, "BAP_Shutdown for %s succesful (LSG %d, NODE_INDEX %d)", NODE_NAME, LSGID, NODE_INDEX);
        else
            writelineEx(gError_Trace, 0, "BAP_Shutdown error 0x%X for %s (LSG %d, NODE_INDEX %d)", temp, NODE_NAME, LSGID, NODE_INDEX); 

        initBapConfig();
        initFctList();
        initHeartbeat();

        temp = BAP150_Start(NODE_INDEX, LSGID);             
        if(temp == 0)
            writelineEx(gBAP_Trace, 0, "BAP_Start for %s succesful (LSG %d, NODE_INDEX %d)", NODE_NAME, LSGID, NODE_INDEX);
        else
            writelineEx(gError_Trace, 0, "BAP_Start error 0x%X for %s (LSG %d, NODE_INDEX %d)", temp, NODE_NAME, LSGID, NODE_INDEX);        
    
        // setze den Timer fuer den zyklischen Aufruf des CANoe-"Tasks"
        setTimer(TaskTimer, 10);                
    
        //  BAPFsg_ProcessDebug(NODE_INDEX,DEBUG_CAN_CHANNEL, DEBUG_ID, LSGID, DEBUG_SWITCH_ON);    
    }
    else{ /***** Ausschalten ****/
        
        BAP150_Shutdown(NODE_INDEX,LSGID);
        
        CANoe_Shutdown();
        
        // ETHERNET NOT ENABLED! (CALL_FCT_CLOSE_UPD_SOCKET_TOKEN)
    }

}

Initialize_Variables()	//initialize/reset all global variables
{
	int temp, i;
	byte  InitSend_data[BAP_buffer_size];	// InitSend data for DLL
	dword InitSend_header[6];	// InitSend header for DLL

	/**** Request Buffer Geschichten initialisieren ****/
	for (i = 0; i < Requestbuffer_lines; i++)
	{
		gBAP_Requestbuffer_status[i] = 0;
	}	
	for (i = 0; i < BAP_buffer_size; i++)
	{
		InitSend_data[i] = 0;
	}	

	// @TODO nur FSG relevant
	/**** Es ist notwendig mittels InitSendbuffer alle Properties im FSG zu initialisieren ****/
           InitSend_header[0] = LSGID;       
       InitSend_header[1] = 13; 
       InitSend_header[3] = Bap_uint8;
       InitSend_header[4] = 1;
       InitSend_header[5] = getValue(P_FSG_80_0_0_13);
	 putValue(P_FSG_80_0_0_13, InitSend_header[5]);
       temp = Bap150_InitSendBuf(NODE_INDEX, InitSend_header, InitSend_data);
       if(temp != 0)
           writelineEx(gError_Trace, 0, "BAP150_InitSendBuf error 0x%X for %s (LSG %d, FCTID %d)", temp, NODE_NAME, LSGID, InitSend_header[1]);
       InitSend_header[0] = LSGID;       
       InitSend_header[1] = 14; 
       InitSend_header[3] = Bap_byteSequence;
       InitSend_header[4] = 12;//71;
       InitSend_header[5] = 0;
       getValue(P_FSG_80_0_0_14,InitSend_data);
       putValue(P_FSG_80_0_0_14,InitSend_data, 71);
       temp = Bap150_InitSendBuf(NODE_INDEX, InitSend_header, InitSend_data);
       for (i=0; i<(getValueSize(P_FSG_80_0_0_14)); i++) 
       {
           InitSend_data[i] = 0;
       }
       if(temp != 0)
           writelineEx(gError_Trace, 0, "BAP150_InitSendBuf error 0x%X for %s (LSG %d, FCTID %d)", temp, NODE_NAME, LSGID, InitSend_header[1]);
       InitSend_header[0] = LSGID;       
       InitSend_header[1] = 15; 
       InitSend_header[3] = Bap_fixedByteSequence;
       InitSend_header[4] = 6;
       InitSend_header[5] = 0;
       getValue(P_FSG_80_0_0_15,InitSend_data);
       putValue(P_FSG_80_0_0_15,InitSend_data, 6);
       temp = Bap150_InitSendBuf(NODE_INDEX, InitSend_header, InitSend_data);
       for (i=0; i<(getValueSize(P_FSG_80_0_0_15)); i++) 
       {
           InitSend_data[i] = 0;
       }
       if(temp != 0)
           writelineEx(gError_Trace, 0, "BAP150_InitSendBuf error 0x%X for %s (LSG %d, FCTID %d)", temp, NODE_NAME, LSGID, InitSend_header[1]);
       InitSend_header[0] = LSGID;       
       InitSend_header[1] = 17; 
       InitSend_header[3] = Bap_fixedByteSequence;
       InitSend_header[4] = 6;
       InitSend_header[5] = 0;
       getValue(P_FSG_80_0_0_17,InitSend_data);
       putValue(P_FSG_80_0_0_17,InitSend_data, 6);
       temp = Bap150_InitSendBuf(NODE_INDEX, InitSend_header, InitSend_data);
       for (i=0; i<(getValueSize(P_FSG_80_0_0_17)); i++) 
       {
           InitSend_data[i] = 0;
       }
       if(temp != 0)
           writelineEx(gError_Trace, 0, "BAP150_InitSendBuf error 0x%X for %s (LSG %d, FCTID %d)", temp, NODE_NAME, LSGID, InitSend_header[1]);
       InitSend_header[0] = LSGID;       
       InitSend_header[1] = 18; 
       InitSend_header[3] = Bap_fixedByteSequence;
       InitSend_header[4] = 6;
       InitSend_header[5] = 0;
       getValue(P_FSG_80_0_0_18,InitSend_data);
       putValue(P_FSG_80_0_0_18,InitSend_data, 6);
       temp = Bap150_InitSendBuf(NODE_INDEX, InitSend_header, InitSend_data);
       for (i=0; i<(getValueSize(P_FSG_80_0_0_18)); i++) 
       {
           InitSend_data[i] = 0;
       }
       if(temp != 0)
           writelineEx(gError_Trace, 0, "BAP150_InitSendBuf error 0x%X for %s (LSG %d, FCTID %d)", temp, NODE_NAME, LSGID, InitSend_header[1]);
       InitSend_header[0] = LSGID;       
       InitSend_header[1] = 19; 
       InitSend_header[3] = Bap_fixedByteSequence;
       InitSend_header[4] = 6;
       InitSend_header[5] = 0;
       getValue(P_FSG_80_0_0_19,InitSend_data);
       putValue(P_FSG_80_0_0_19,InitSend_data, 6);
       temp = Bap150_InitSendBuf(NODE_INDEX, InitSend_header, InitSend_data);
       for (i=0; i<(getValueSize(P_FSG_80_0_0_19)); i++) 
       {
           InitSend_data[i] = 0;
       }
       if(temp != 0)
           writelineEx(gError_Trace, 0, "BAP150_InitSendBuf error 0x%X for %s (LSG %d, FCTID %d)", temp, NODE_NAME, LSGID, InitSend_header[1]);
       InitSend_header[0] = LSGID;       
       InitSend_header[1] = 21; 
       InitSend_header[3] = Bap_byteSequence;
       InitSend_header[4] = 7;//111;
       InitSend_header[5] = 0;
       getValue(P_FSG_80_0_0_21,InitSend_data);
       putValue(P_FSG_80_0_0_21,InitSend_data, 111);
       temp = Bap150_InitSendBuf(NODE_INDEX, InitSend_header, InitSend_data);
       for (i=0; i<(getValueSize(P_FSG_80_0_0_21)); i++) 
       {
           InitSend_data[i] = 0;
       }
       if(temp != 0)
           writelineEx(gError_Trace, 0, "BAP150_InitSendBuf error 0x%X for %s (LSG %d, FCTID %d)", temp, NODE_NAME, LSGID, InitSend_header[1]);
       InitSend_header[0] = LSGID;       
       InitSend_header[1] = 25; 
       InitSend_header[3] = Bap_byteSequence;
       InitSend_header[4] = 6;//335;
       InitSend_header[5] = 0;
       getValue(P_FSG_80_0_0_25,InitSend_data);
       putValue(P_FSG_80_0_0_25,InitSend_data, 335);
       temp = Bap150_InitSendBuf(NODE_INDEX, InitSend_header, InitSend_data);
       for (i=0; i<(getValueSize(P_FSG_80_0_0_25)); i++) 
       {
           InitSend_data[i] = 0;
       }
       if(temp != 0)
           writelineEx(gError_Trace, 0, "BAP150_InitSendBuf error 0x%X for %s (LSG %d, FCTID %d)", temp, NODE_NAME, LSGID, InitSend_header[1]);
       InitSend_header[0] = LSGID;       
       InitSend_header[1] = 26; 
       InitSend_header[3] = Bap_byteSequence;
       InitSend_header[4] = 6;//366;
       InitSend_header[5] = 0;
       getValue(P_FSG_80_0_0_26,InitSend_data);
       putValue(P_FSG_80_0_0_26,InitSend_data, 366);
       temp = Bap150_InitSendBuf(NODE_INDEX, InitSend_header, InitSend_data);
       for (i=0; i<(getValueSize(P_FSG_80_0_0_26)); i++) 
       {
           InitSend_data[i] = 0;
       }
       if(temp != 0)
           writelineEx(gError_Trace, 0, "BAP150_InitSendBuf error 0x%X for %s (LSG %d, FCTID %d)", temp, NODE_NAME, LSGID, InitSend_header[1]);

}

on start
{
	// noch nicht eingeschaltet
	gSG_PowerOnOff=0;
	// noch nicht initialisiert
	gBAP_Init=0;
	// open the panel, nur fuer CANoe-Version >= 5.1 erlaubt
	//openPanel(panel_name);
	// deaktiviere alle aktiven Panel Elemente, ausser AN/AUSS
    CANoe_Shutdown();
    
// ETHERNET AND FLEXRAY NOT ENABLED!
        
}

/*BAP_CAN_TX_Request()	//Function to send BAP-data over CAN
{
   int i;
   byte DestIp[16];
   byte TX_Data[1500];				// CAN-data
   byte TX_Data_FR[10];    		// FlexRay-Data
   dword TX_Header[13];			// Header
   message 0x100 TX_Message;	// dummy-message, Adresse wird noch modifiziert
   
   byte send_result;
   
   // ONLY CAN IS ENABLED! 
      TX_Header[0] = 1; //BusType: 1=Can, 2=Lin, 3=Flexray, 4=Ethernet
   		TX_Header[2] = 8; // max-Length of TX_Data

		// Pollen ueber die Queue, die von der DLL zur Verfuegung gestellt wird
		// Diese Daten muessen ueber den CAN Bus gesendet werden
	   	while (BAP180_GetTxData(NODE_INDEX,TX_Header,TX_Data) == 0) {
        TX_Message.CAN = TX_Header[1]; 		//CAN channel
        TX_Message.ID = TX_Header[3]; 	  //Can ID
        TX_Message.DataLength = TX_Header[2]; 		// received length
			
			  for (i=0; i<TX_Message.DataLength; i++) {	//CAN data-bytes
		  		TX_Message.byte(i) = TX_Data[i];
		  	}
		  	
        TX_Message.EDL = 0;
        TX_Message.BRS = 0;
        if(TX_Header[4] & 2) 
          TX_Message.EDL = 1;
        if(TX_Header[4] & 4) 
          TX_Message.BRS = 1;
        
		  	output(TX_Message);					//send CAN message
		  	
		  	//Versions Output
		  	if(TX_Data[0] == 0x40 && TX_Data[1] == 0x00 && TX_Header[2] == 4)
		  	{
		    	writelineEx(gBAP_Trace, 0,"Major Version: %i, Minor Version: %i", TX_Data[2], TX_Data[3]);
		  	}       
		  	TX_Header[2] = 8; // max-Length of TX_Data
	   	} 
   // ONLY CAN IS ENABLED!
   // FLEXRAY NOT ENABLED! (TX_FR_TOKEN)
   // ETHERNET NOT ENABLED! (TX_IP_TOKEN)
}*/

BAP_CAN_TX_Request()	//Function to send BAP-data over CAN
{
   int i;
   byte TX_Data[8];				// CAN-data
   byte TX_Data_FR[10];    		// FlexRay-Data
   dword TX_Header[3];			// CAN-header
   message 0x100 TX_Message;	// dummy-message, Adresse wird noch modifiziert
   
   byte send_result;
   
   // ONLY CAN IS ENABLED! 
   		TX_Header[2] = 8; // max-Length of TX_Data

		// Pollen ueber die Queue, die von der DLL zur Verfuegung gestellt wird
		// Diese Daten muessen ueber den CAN Bus gesendet werden
	   	while (BAP150_CAN_GetTxDat(NODE_INDEX,TX_Header,TX_Data) == 0) {	
			TX_Message.CAN = TX_Header[0]; 		//CAN channel
			TX_Message.ID =TX_Header[1]; 			//Can ID
			TX_Message.DLC = TX_Header[2]; 		// received length

		    //FctList Output
            //MR 81562
            if( TX_Data[0] == 0x80 && TX_Data[1] == 0x08 && (TX_Data[2] == 0x30 || TX_Data[2] == 0x40) && TX_Data[3] == 0x03 )
		    {
		    //writelineEx(gBAP_Trace, 0,"NODE_INDEX: %x TX_Header: %x %x %x FctList: %x, %x, %x, %x", NODE_INDEX, TX_Header[0], TX_Header[1], TX_Header[2], TX_Data[4], TX_Data[5], TX_Data[6], TX_Data[7]);				
                TX_Data[4] = fctList_global[0];
				TX_Data[5] = fctList_global[1]; 
				TX_Data[6] = fctList_global[2]; 
				TX_Data[7] = fctList_global[3];
			}
            else if( TX_Data[0] == 0x80 && TX_Data[2] == 0x40 && TX_Data[3] == 0x01 && StatusallMessagecount == 0)
            {
                StatusallMessagecount = 1;
            }
            else if(StatusallMessagecount == 1)
            {
				TX_Data[5] = fctList_global[0]; 
				TX_Data[6] = fctList_global[1]; 
				TX_Data[7] = fctList_global[2];
                StatusallMessagecount = 2;
            }
            else if(StatusallMessagecount == 2)
            {
				TX_Data[1] = fctList_global[3];
                StatusallMessagecount = 0;
            }
			for (i=0; i<TX_Message.DLC; i++) {	//CAN data-bytes
		  		TX_Message.byte(i) = TX_Data[i];
		  	}

		  	output(TX_Message);					//send CAN message
		  	
		  	//Versions Output
		  	if(TX_Data[0] == 0x40 && TX_Data[1] == 0x00 && TX_Header[2] == 4)
		  	{
		    	writelineEx(gBAP_Trace, 0,"Major Version: %i, Minor Version: %i", TX_Data[2], TX_Data[3]);
		  	}       
		  	TX_Header[2] = 8; // max-Length of TX_Data
	   	} 
   // ONLY CAN IS ENABLED!
   // FLEXRAY NOT ENABLED! (TX_FR_TOKEN)
   // ETHERNET NOT ENABLED! (TX_IP_TOKEN)
}

ringbuffer_write (byte lsgID, byte fctID, byte request, byte dataType, word length, dword singleData, byte data[])
{
	int bufferline, i;

	bufferline = getNextWriteIndex();	//get next free position in ring-buffer

	if (bufferline == -1) 
	{
		writelineEx(gError_Trace, 0, "Crititcal Error: No free buffer found!");
		return;
	}
		
	gBAP_Request_header[bufferline][0] = lsgID;	// LSG
	gBAP_Request_header[bufferline][1] = fctID;	// FCT
	gBAP_Request_header[bufferline][3] = dataType; // dataType
    //writelineEx(gBAP_Trace, 0, "Write request in buffer FSG NODEINDEX:%d lsgid:%d fctid:%d requesttype:%d datatype:%d length:%d", 
    //        NODE_INDEX,lsgID,fctID,request,dataType,length);


	switch (dataType)
	{
		case Bap_void:
			gBAP_Request_header[bufferline][2] = request;	// request
			gBAP_Request_header[bufferline][4] = 0;	// length
				// Void
			// @TODO?		
			break;
		case Bap_uint8:
			gBAP_Request_header[bufferline][2] = request;		// request
			gBAP_Request_header[bufferline][5] = singleData;	// Daten		
			break;
		case Bap_uint16:
			gBAP_Request_header[bufferline][2] = request;		// request
			gBAP_Request_header[bufferline][5] = singleData;	// Daten
			break;			
		case Bap_uint32:
			gBAP_Request_header[bufferline][2] = request;		// request
			gBAP_Request_header[bufferline][5] = singleData;	// Daten		
			break;	
		case Bap_byteSequence:
			gBAP_Request_header[bufferline][2] = request;	// request
			gBAP_Request_header[bufferline][4] = length;	// length
			// Daten der ByteSequence kopieren
			for(i = 0; i < BAP_buffer_size; i++)									
				gBAP_Request_data[bufferline][i] = data[i];
		case Bap_error:
			gBAP_Request_header[bufferline][5] = singleData;	// Errorcode						
			break;
		default:
			break;
	}

			

}

Request_void (byte lsgID, byte fctID, byte request)
{
	int i;
	byte dataArray [BAP_buffer_size];

	// Initialisieren eines Arrays
	for(i=0;i<BAP_buffer_size;i++) dataArray [i]=0;

	ringbuffer_write (lsgID, fctID, request, Bap_void, 0, 0, dataArray);	
}

Request_int8 (byte lsgID, byte fctID, byte request, dword data)
{
	int i;
	byte dataArray [BAP_buffer_size];

	// Initialisieren eines Arrays
	for(i=0;i<BAP_buffer_size;i++) dataArray [i]=0;

	ringbuffer_write (lsgID, fctID, request, Bap_uint8, 0, data, dataArray);

}

Request_int16 (byte lsgID, byte fctID, byte request, dword data)
{
	int i;
	byte dataArray [BAP_buffer_size];

	// Initialisieren eines Arrays
	for(i=0;i<BAP_buffer_size;i++) dataArray [i]=0;

	ringbuffer_write (lsgID, fctID, request, Bap_uint16, 0, data, dataArray);

}

Request_int32 (byte lsgID, byte fctID, byte request, dword data)
{
	int i;
	byte dataArray [BAP_buffer_size];

	// Initialisieren eines Arrays
	for(i=0;i<BAP_buffer_size;i++) dataArray [i]=0;

	ringbuffer_write (lsgID, fctID, request, Bap_uint32, 0, data, dataArray);
}

Request_byteSequence (byte lsgID, byte fctID, byte request, byte data[], word length)
{
	int i;
	byte dataArray [BAP_buffer_size];

	// Initialisieren eines Arrays
	for(i=0;i<BAP_buffer_size;i++) dataArray [i]=0;

	// Fuellen des Arrays
	for(i=0;i<length;i++) dataArray [i]=data[i];

	ringbuffer_write (lsgID, fctID, request, Bap_byteSequence, length, 0, dataArray);
}

Request_error (byte lsgID, byte fctID, byte errorCode)
{
	int i;
	byte dataArray [BAP_buffer_size];

	// Initialisieren eines Arrays
	for(i=0;i<BAP_buffer_size;i++) dataArray [i]=0;

	ringbuffer_write (lsgID, fctID, Error_REQ, Bap_error, 0, errorCode, dataArray);
}

InitSendBuf_int8 (byte fctID, dword data)
{
    dword request[6];
    int errorCode;
    byte  InitSend_data[1];

    request [0]= LSGID;
    request [1]= fctID;
    request [3]= Bap_uint8;
    request [5]= data;

    errorCode=
    BAP150_InitSendBuf(NODE_INDEX,request,InitSend_data);
    
    if(errorCode)
        writelineEx(gError_Trace, 0, "InitSendBuf_int8 error 0x%X for %s (LSG %d, FCTID %d)", errorCode, NODE_NAME, LSGID, fctID);
    
}

InitSendBuf_int16 (byte fctID, dword data)
{
    dword request[6];
    byte errorCode;
    byte  InitSend_data[1];

    request [0]= LSGID;
    request [1]= fctID;
    request [3]= Bap_uint16;
    request [5]= data;

    errorCode=BAP150_InitSendBuf(NODE_INDEX,request,InitSend_data);
    
    if(errorCode)
        writelineEx(gError_Trace, 0, "InitSendBuf_int16 error 0x%X for %s (LSG %d, FCTID %d)", errorCode, NODE_NAME, LSGID, fctID);
}

InitSendBuf_int32 (byte fctID, dword data)
{
    dword request[6];
    byte errorCode;
    byte  InitSend_data[1];

    request [0]= LSGID;
    request [1]= fctID;
    request [3]= Bap_uint32;
    request [5]= data;

    errorCode=BAP150_InitSendBuf(NODE_INDEX,request,InitSend_data);
    
    if(errorCode)
        writelineEx(gError_Trace, 0, "InitSendBuf_int32 error 0x%X for %s (LSG %d, FCTID %d)", errorCode, NODE_NAME, LSGID, fctID);
}

InitSendBuf_byteSequence (byte fctID, byte data[], word length)
{
    dword request[6];
    byte errorCode;

    request [0]= LSGID;
    request [1]= fctID;
    request [3]= Bap_uint32;
    request [4]= length;

    errorCode=BAP150_InitSendBuf(NODE_INDEX,request,data);
    
    if(errorCode)
        writelineEx(gError_Trace, 0, "InitSendBuf_byteSequence error 0x%X for %s (LSG %d, FCTID %d)", errorCode, NODE_NAME, LSGID, fctID);
}

DisplayRequestErrorCode(dword fctID, dword errCode)
{
       switch(fctID)
   {
       case C_FSG_80_0_0_1_ID:
           gC_FSG_80_0_0_1_ErrCode = 0;
           putValue(C_FSG_80_0_0_1_ErrCode,  errCode);
           setControlBackColor(panel_name,"errfield_C_FSG_80_0_0_1", MakeRGB(255,79,79));
       break;
       case P_FSG_80_0_0_2_ID:
           gP_FSG_80_0_0_2_ErrCode = 0;
           putValue(P_FSG_80_0_0_2_ErrCode,  errCode);
           setControlBackColor(panel_name,"errfield_P_FSG_80_0_0_2", MakeRGB(255,79,79));
       break;
       case P_FSG_80_0_0_3_ID:
           gP_FSG_80_0_0_3_ErrCode = 0;
           putValue(P_FSG_80_0_0_3_ErrCode,  errCode);
           setControlBackColor(panel_name,"errfield_P_FSG_80_0_0_3", MakeRGB(255,79,79));
       break;
       case P_FSG_80_0_0_4_ID:
           gP_FSG_80_0_0_4_ErrCode = 0;
           putValue(P_FSG_80_0_0_4_ErrCode,  errCode);
           setControlBackColor(panel_name,"errfield_P_FSG_80_0_0_4", MakeRGB(255,79,79));
       break;
       case P_FSG_80_0_0_13_ID:
           gP_FSG_80_0_0_13_ErrCode = 0;
           putValue(P_FSG_80_0_0_13_ErrCode,  errCode);
           setControlBackColor(panel_name,"errfield_P_FSG_80_0_0_13", MakeRGB(255,79,79));
       break;
       case P_FSG_80_0_0_14_ID:
           gP_FSG_80_0_0_14_ErrCode = 0;
           putValue(P_FSG_80_0_0_14_ErrCode,  errCode);
           setControlBackColor(panel_name,"errfield_P_FSG_80_0_0_14", MakeRGB(255,79,79));
       break;
       case P_FSG_80_0_0_15_ID:
           gP_FSG_80_0_0_15_ErrCode = 0;
           putValue(P_FSG_80_0_0_15_ErrCode,  errCode);
           setControlBackColor(panel_name,"errfield_P_FSG_80_0_0_15", MakeRGB(255,79,79));
       break;
       case M_FSG_80_0_0_16_ID:
           gM_FSG_80_0_0_16_ErrCode = 0;
           putValue(M_FSG_80_0_0_16_ErrCode,  errCode);
           setControlBackColor(panel_name,"errfield_M_FSG_80_0_0_16", MakeRGB(255,79,79));
           putValue(M_FSG_80_0_0_16_State,  "ReqErr");
       break;
       case P_FSG_80_0_0_17_ID:
           gP_FSG_80_0_0_17_ErrCode = 0;
           putValue(P_FSG_80_0_0_17_ErrCode,  errCode);
           setControlBackColor(panel_name,"errfield_P_FSG_80_0_0_17", MakeRGB(255,79,79));
       break;
       case P_FSG_80_0_0_18_ID:
           gP_FSG_80_0_0_18_ErrCode = 0;
           putValue(P_FSG_80_0_0_18_ErrCode,  errCode);
           setControlBackColor(panel_name,"errfield_P_FSG_80_0_0_18", MakeRGB(255,79,79));
       break;
       case P_FSG_80_0_0_19_ID:
           gP_FSG_80_0_0_19_ErrCode = 0;
           putValue(P_FSG_80_0_0_19_ErrCode,  errCode);
           setControlBackColor(panel_name,"errfield_P_FSG_80_0_0_19", MakeRGB(255,79,79));
       break;
       case M_FSG_80_0_0_20_ID:
           gM_FSG_80_0_0_20_ErrCode = 0;
           putValue(M_FSG_80_0_0_20_ErrCode,  errCode);
           setControlBackColor(panel_name,"errfield_M_FSG_80_0_0_20", MakeRGB(255,79,79));
           putValue(M_FSG_80_0_0_20_State,  "ReqErr");
       break;
       case P_FSG_80_0_0_21_ID:
           gP_FSG_80_0_0_21_ErrCode = 0;
           putValue(P_FSG_80_0_0_21_ErrCode,  errCode);
           setControlBackColor(panel_name,"errfield_P_FSG_80_0_0_21", MakeRGB(255,79,79));
       break;
       case A_FSG_80_0_0_22_ID:
           gA_FSG_80_0_0_22_ErrCode = 0;
           putValue(A_FSG_80_0_0_22_ErrCode,  errCode);
           setControlBackColor(panel_name,"errfield_A_FSG_80_0_0_22", MakeRGB(255,79,79));
       break;
       case M_FSG_80_0_0_23_ID:
           gM_FSG_80_0_0_23_ErrCode = 0;
           putValue(M_FSG_80_0_0_23_ErrCode,  errCode);
           setControlBackColor(panel_name,"errfield_M_FSG_80_0_0_23", MakeRGB(255,79,79));
           putValue(M_FSG_80_0_0_23_State,  "ReqErr");
       break;
       case A_FSG_80_0_0_24_ID:
           gA_FSG_80_0_0_24_ErrCode = 0;
           putValue(A_FSG_80_0_0_24_ErrCode,  errCode);
           setControlBackColor(panel_name,"errfield_A_FSG_80_0_0_24", MakeRGB(255,79,79));
       break;
       case P_FSG_80_0_0_25_ID:
           gP_FSG_80_0_0_25_ErrCode = 0;
           putValue(P_FSG_80_0_0_25_ErrCode,  errCode);
           setControlBackColor(panel_name,"errfield_P_FSG_80_0_0_25", MakeRGB(255,79,79));
       break;
       case P_FSG_80_0_0_26_ID:
           gP_FSG_80_0_0_26_ErrCode = 0;
           putValue(P_FSG_80_0_0_26_ErrCode,  errCode);
           setControlBackColor(panel_name,"errfield_P_FSG_80_0_0_26", MakeRGB(255,79,79));
       break;
       case M_FSG_80_0_0_27_ID:
           gM_FSG_80_0_0_27_ErrCode = 0;
           putValue(M_FSG_80_0_0_27_ErrCode,  errCode);
           setControlBackColor(panel_name,"errfield_M_FSG_80_0_0_27", MakeRGB(255,79,79));
           putValue(M_FSG_80_0_0_27_State,  "ReqErr");
       break;
       case A_FSG_80_0_0_28_ID:
           gA_FSG_80_0_0_28_ErrCode = 0;
           putValue(A_FSG_80_0_0_28_ErrCode,  errCode);
           setControlBackColor(panel_name,"errfield_A_FSG_80_0_0_28", MakeRGB(255,79,79));
       break;
       default:
           writelineEx(gError_Trace, 0, "%s%d/%d Unknown Functionid in  displayErrorCode", SGtype, LSGID,fctID);
   }

}

BAP_DLL_Request ()
{
    int i;
    int l=0;
    byte temp;
    byte Request_data[4096];    //Request data for DLL
    dword Request_header[6];    //Request header for DLL
    byte dataValid;
    int nextElementToRead;
    
    // defaultmaessig ist senden OK
    dataValid = 1;

    // loeschen der Daten "Container"
    for(i=0;i<6;i++)
        Request_header[i]=0;
    for(i=0;i<BAP_buffer_size;i++)
        Request_data[i]=0;

    
    // Verarbeiten aller noch offenen Requests  
    while ((nextElementToRead = getNextReadIndex()) != -1) 
    {
        // Fuer alle Datentypen gleich
        Request_header[0]=gBAP_Request_header [nextElementToRead][0];       //LSG-ID
        Request_header[1]=gBAP_Request_header [nextElementToRead][1];       //Function-ID
        Request_header[2]=gBAP_Request_header [nextElementToRead][2];       //request type
        Request_header[3]=gBAP_Request_header [nextElementToRead][3];       //BAP data type

        switch(gBAP_Request_header[nextElementToRead][3]){
            case Bap_uint32:
                l=2;
            case Bap_uint16:
                l++;
            case Bap_uint8:
            case Bap_error: // Request (2) wird dabei ignoriert
                l++;
            case Bap_void:  // Datenfeld (5) wird dabei ignoriert
                Request_header[4]=l;                                                //  not used
                Request_header[5]=gBAP_Request_header [nextElementToRead][5];       // Daten
            break;
            case Bap_byteSequence:                                  
                Request_header[4]=gBAP_Request_header [nextElementToRead][4];       // length
                Request_header[5]=0;                                                // not used

                // data-array for BAP-DLL funcion 'BAP_Request'
                for(i=0;i<BAP_buffer_size;i++)
                    Request_data[i]=gBAP_Request_data [nextElementToRead][i];
                break;          
            default:
                writelineEx(gError_Trace, 0, "BAP_DLL_Request: invalid BAP-Data-Type: %d", gBAP_Request_header[nextElementToRead][3]);
                dataValid = 0;
            break;          
        }
        
        if(dataValid){
            // wie heisst der Request?
            writelineEx(gBAP_Trace, 0, "%s%d/%d BAP_Request %s datatype:%s length:%d", SGtype, Request_header[0],Request_header[1],Requesttype_Text[Request_header[2]],Datatype_Text[Request_header[3]],Request_header[4]);
            temp = BAP150_Request(NODE_INDEX, Request_header, Request_data);    //send data to BAP-DLL  
            // BAP-Request failed
            if(temp != 0){
                // Fehlercode: Request failed
                writelineEx(gError_Trace, 0, "%s%d/%d Error during BAP_Request errorcode: 0x%X", SGtype, Request_header[0],Request_header[1],temp);
                DisplayRequestErrorCode(Request_header[1],temp);
            } 
        }

    }
} 

int getNextReadIndex ()
{
	int i, ret;
	// der Puffer wird nach dem naechsten zu lesenden Eintrag durchsucht
	// Existiert keiner wird -1 zurueckgegeben
	ret = -1;

	for (i = 0; i < Requestbuffer_lines; i++)
	{
		if (gBAP_Requestbuffer_status[i] == 1)
		{
			// zum verschicken
			ret = i;
			// und wieder freigeben
			gBAP_Requestbuffer_status[i] = 0;
			break;
		}
	}

	return (ret);
}

int getNextWriteIndex ()
{
	int i, ret;
	// der Puffer wird nach dem naechsten freien Eintrag durchsucht
	// Existiert keiner wird -1 zurueckgegeben
	ret = -1;

	for (i = 0; i < Requestbuffer_lines; i++)
	{
		if (gBAP_Requestbuffer_status[i] == 0)
		{
			// zum schreiben
			ret = i;
			// belegen
			gBAP_Requestbuffer_status[i] = 1;
			break;
		}
	}

	return (ret);
}

//gBAP_Indication_header[0])  // LSGID
//gBAP_Indication_header[1]) // FCTID
//gBAP_Indication_header[2]) // IndType
//gBAP_Indication_header[3]) // Datentyp

M_FSG_80_0_0_16_ProcessingRequest ()
{
   byte temp[BAP_buffer_size];
   getValue(M_FSG_80_0_0_16_Processing, temp);
   Request_byteSequence(LSGID, M_FSG_80_0_0_16_ID, Processing_REQ, temp, getValueSize(M_FSG_80_0_0_16_Processing));
}
M_FSG_80_0_0_27_ProcessingRequest ()
{
   byte temp[BAP_buffer_size];
   getValue(M_FSG_80_0_0_27_Processing, temp);
   Request_byteSequence(LSGID, M_FSG_80_0_0_27_ID, Processing_REQ, temp, getValueSize(M_FSG_80_0_0_27_Processing));
}
M_FSG_80_0_0_23_ProcessingRequest ()
{
   byte temp[BAP_buffer_size];
   getValue(M_FSG_80_0_0_23_Processing, temp);
   Request_byteSequence(LSGID, M_FSG_80_0_0_23_ID, Processing_REQ, temp, getValueSize(M_FSG_80_0_0_23_Processing));
}
M_FSG_80_0_0_20_ProcessingRequest ()
{
   byte temp[BAP_buffer_size];
   getValue(M_FSG_80_0_0_20_Processing, temp);
   Request_byteSequence(LSGID, M_FSG_80_0_0_20_ID, Processing_REQ, temp, getValueSize(M_FSG_80_0_0_20_Processing));
}


Process_Current_Indication ()
{
   int rxsize;
   int txsize;
   byte temp[BAP_buffer_size];
   char buffer[BAP_buffer_size];
  
   if(strncmp(Datatype_Text[gBAP_Indication_header[3]], "acknowledge", 4)!=0) 
       writelineEx(gBAP_Trace, 0, "NodeIndex: %d: CurrentIndication %s lsgid:%d fctid:%d indType:%s dataType=%s length=%d",
               NODE_INDEX, SGtype, gBAP_Indication_header[0], gBAP_Indication_header[1], Indicationtype_Text[gBAP_Indication_header[2]], Datatype_Text[gBAP_Indication_header[3]], gBAP_Indication_header[4]);
   else 
       writelineEx(gBAP_Trace, 0, "Internal acknowledge %s-%d fctid:%d indType:%s dataType=%s length=%d",
               SGtype, gBAP_Indication_header[0], gBAP_Indication_header[1], Acknowledgetype_Text[gBAP_Indication_header[5]], Datatype_Text[gBAP_Indication_header[3]], gBAP_Indication_header[4]);
   switch(gBAP_Indication_header[0])  // LSGID
   {
   case LSGID:
       switch(gBAP_Indication_header[1]) // FCTID
       {
    case P_FSG_80_0_0_13_ID: 
        switch(gBAP_Indication_header[3]) // Datentyp 
        {
            case Bap_uint8:
                    switch(gBAP_Indication_header[2]) // IndType
                    {
                        case DataSet_IND: // Indicationtyp pruefen
                            if (getValue(P_FSG_80_0_0_13_ErrEn)) { 
                               Request_error(LSGID,P_FSG_80_0_0_13_ID,getValue(P_FSG_80_0_0_13_ErrCode)); 
                               break;
                            }
                            // Daten setzen
                            putValue(P_FSG_80_0_0_13, gBAP_Indication_header[5]);
                            setControlBackColor(panel_name, "errfield_P_FSG_80_0_0_13", MakeRGB(255,255,255));  
                            break;                              
                        case DataSetGet_IND: // Indicationtyp pruefen
                            if (getValue(P_FSG_80_0_0_13_ErrEn)) { 
                               Request_error(LSGID,P_FSG_80_0_0_13_ID,getValue(P_FSG_80_0_0_13_ErrCode)); 
                               break;
                            }
                            // Daten setzen
                            putValue(P_FSG_80_0_0_13, gBAP_Indication_header[5]);
                            setControlBackColor(panel_name, "errfield_P_FSG_80_0_0_13", MakeRGB(255,255,255));  
                            // und antworten
                            Request_Int8(LSGID, P_FSG_80_0_0_13_ID, Data_REQ, getValue(P_FSG_80_0_0_13));
                            break;
                        default:
                            PrintIndicationError("Illegal IndType");
                            break;
                    }
                    break;
            case Bap_error:
                gP_FSG_80_0_0_13_ErrCode = 0;
                putValue(P_FSG_80_0_0_13_ErrCode,  gBAP_Indication_header[5]);
                setControlBackColor(panel_name, "errfield_P_FSG_80_0_0_13", MakeRGB(255,79,79));  
                gP_FSG_80_0_0_13_ErrCode = 1;
                break;
            case Bap_acknowledge:
                break;
            default:
                    PrintIndicationError("Illegal DataType");
                    break;
        }
    break;
    case P_FSG_80_0_0_14_ID: 
        switch(gBAP_Indication_header[3]) // Datentyp 
        {
            case Bap_error:
                gP_FSG_80_0_0_14_ErrCode = 0;
                setControlBackColor(panel_name, "errfield_P_FSG_80_0_0_14", MakeRGB(255,79,79));  
                gP_FSG_80_0_0_14_ErrCode = 1;
                break;
            case Bap_acknowledge:
                break;
            default:
                PrintIndicationError("Illegal DataType");
                break;
        }
    break;
    case P_FSG_80_0_0_15_ID: 
        switch(gBAP_Indication_header[3]) // Datentyp 
        {
            case Bap_error:
                gP_FSG_80_0_0_15_ErrCode = 0;
                setControlBackColor(panel_name, "errfield_P_FSG_80_0_0_15", MakeRGB(255,79,79));  
                gP_FSG_80_0_0_15_ErrCode = 1;
                break;
            case Bap_acknowledge:
                break;
            default:
                PrintIndicationError("Illegal DataType");
                break;
        }
    break;
    case M_FSG_80_0_0_16_ID: 
            switch(gBAP_Indication_header[3]) // Datentyp
            {
                case Bap_byteSequence:
                    switch (gBAP_Indication_header[2]) // IndType
                    {
                        case StartResult_IND: 
                            if (getValue(M_FSG_80_0_0_16_ErrEn)) { 
                               Request_error(LSGID,M_FSG_80_0_0_16_ID,getValue(M_FSG_80_0_0_16_ErrCode)); 
                               break;
                            }
                           // running
                            putValue(M_FSG_80_0_0_16_State, "Running");
                            // Daten setzen
                            putValue(M_FSG_80_0_0_16_Start, gBAP_Indication_data, gBAP_Indication_header[4]);
                            setControlBackColor(panel_name, "errfield_M_FSG_80_0_0_16", MakeRGB(255,255,255));  
                            break;
                        case Start_IND:
                            if (getValue(M_FSG_80_0_0_16_ErrEn)) { 
                               Request_error(LSGID,M_FSG_80_0_0_16_ID,getValue(M_FSG_80_0_0_16_ErrCode)); 
                               break;
                            }
                            putValue(M_FSG_80_0_0_16_State, "Started");
                            // Daten setzen
                            putValue(M_FSG_80_0_0_16_Start, gBAP_Indication_data, gBAP_Indication_header[4]);
                            setControlBackColor(panel_name, "errfield_M_FSG_80_0_0_16", MakeRGB(255,255,255));  
                            break;
                        default:
                            PrintIndicationError("Illegal IndType");
                            break;
                    }
                    break;
              case Bap_void:
                    switch (gBAP_Indication_header[2]) // IndType
                    {
                        case AbortResult_IND:
                            putValue(M_FSG_80_0_0_16_State, "Aborted");
                            //if (getValue(M_FSG_80_0_0_16_ErrEn)) 
                            { 
                               // Fehler als Quittierung schicken
                               Request_Error(LSGID, M_FSG_80_0_0_16_ID, getValue(M_FSG_80_0_0_16_ErrCode));
                            }
                            break;
                        case Processing_CNF_IND:    
                            if (getValue(M_FSG_80_0_0_16_ErrEn)) { 
                               // Fehler als Quittierung schicken
                               Request_Error(LSGID, M_FSG_80_0_0_16_ID, getValue(M_FSG_80_0_0_16_ErrCode));
                               break;
                            }
                            // Processing schicken
                            //getValue(M_FSG_80_0_0_16_Processing, temp);
                            //Request_byteSequence(LSGID, M_FSG_80_0_0_16_ID, Processing_REQ, temp, getValueSize(M_FSG_80_0_0_16_Processing));
                            M_FSG_80_0_0_16_ProcessingRequest();
                            setControlBackColor(panel_name, "errfield_M_FSG_80_0_0_16", MakeRGB(255,255,255));  
                            break;
                        default:
                            PrintIndicationError("Illegal IndType");
                            break;
                    }
                    break;
            case Bap_error:
                gM_FSG_80_0_0_16_ErrCode = 0;
                putValue(M_FSG_80_0_0_16_ErrCode,  gBAP_Indication_header[5]);
                setControlBackColor(panel_name, "errfield_M_FSG_80_0_0_16", MakeRGB(255,79,79));  
                gM_FSG_80_0_0_16_ErrCode = 1;
                break;
            case Bap_acknowledge:
                break;
            default:
                    PrintIndicationError("Illegal DataType");
                    break;
            }
    break;
    case P_FSG_80_0_0_17_ID: 
        switch(gBAP_Indication_header[3]) // Datentyp 
        {
            case Bap_byteSequence:
                switch (gBAP_Indication_header[2]) // IndType
                {
                    case DataSet_IND: // Indicationtyp pruefen
                       if (getValue(P_FSG_80_0_0_17_ErrEn)) { 
                           Request_error(LSGID,P_FSG_80_0_0_17_ID,getValue(P_FSG_80_0_0_17_ErrCode)); 
                           break;
                        }
                        // Daten setzen
                        putValue(P_FSG_80_0_0_17, gBAP_Indication_data, gBAP_Indication_header[4]);
                        setControlBackColor(panel_name, "errfield_P_FSG_80_0_0_17", MakeRGB(255,255,255));  
                        break;
                    case DataSetGet_IND: // Indicationtyp pruefen
                       if (getValue(P_FSG_80_0_0_17_ErrEn)) { 
                           Request_error(LSGID,P_FSG_80_0_0_17_ID,getValue(P_FSG_80_0_0_17_ErrCode)); 
                           break;
                        }
                        // Daten setzen
						getValue(P_FSG_80_0_0_17, temp);
						gBAP_Indication_data[2]= gBAP_Indication_data[2]&0x0f;
						gBAP_Indication_data[2]= gBAP_Indication_data[2]|(temp[2]&0xf0);
						gBAP_Indication_data[2]= gBAP_Indication_data[2]&0xf0;
						gBAP_Indication_data[2]= gBAP_Indication_data[2]|(temp[2]&0x0f);
						gBAP_Indication_data[4]= gBAP_Indication_data[4]&0x0f;
						gBAP_Indication_data[4]= gBAP_Indication_data[4]|(temp[4]&0xf0);
						gBAP_Indication_data[4]= gBAP_Indication_data[4]&0xf0;
						gBAP_Indication_data[4]= gBAP_Indication_data[4]|(temp[4]&0x0f);
                        putValue(P_FSG_80_0_0_17, gBAP_Indication_data, gBAP_Indication_header[4]);
                        setControlBackColor(panel_name, "errfield_P_FSG_80_0_0_17", MakeRGB(255,255,255));  
                        // und antworten
                        getValue(P_FSG_80_0_0_17, temp);
                        Request_byteSequence(LSGID, P_FSG_80_0_0_17_ID, Data_REQ, temp, gBAP_Indication_header[4]);
                        break;
                    default:
                            PrintIndicationError("Illegal IndType");
                        break;
                }
                break;
            case Bap_error:
                gP_FSG_80_0_0_17_ErrCode = 0;
                putValue(P_FSG_80_0_0_17_ErrCode,  gBAP_Indication_header[5]);
                setControlBackColor(panel_name, "errfield_P_FSG_80_0_0_17", MakeRGB(255,79,79));  
                gP_FSG_80_0_0_17_ErrCode = 1;
                break;
            case Bap_acknowledge:
                break;
            default:
                PrintIndicationError("Illegal DataType");
                break;
        }
    break;
    case P_FSG_80_0_0_18_ID: 
        switch(gBAP_Indication_header[3]) // Datentyp 
        {
            case Bap_byteSequence:
                switch (gBAP_Indication_header[2]) // IndType
                {
                    case DataSet_IND: // Indicationtyp pruefen
                       if (getValue(P_FSG_80_0_0_18_ErrEn)) { 
                           Request_error(LSGID,P_FSG_80_0_0_18_ID,getValue(P_FSG_80_0_0_18_ErrCode)); 
                           break;
                        }
                        // Daten setzen
                        putValue(P_FSG_80_0_0_18, gBAP_Indication_data, gBAP_Indication_header[4]);
                        setControlBackColor(panel_name, "errfield_P_FSG_80_0_0_18", MakeRGB(255,255,255));  
                        break;
                    case DataSetGet_IND: // Indicationtyp pruefen
                       if (getValue(P_FSG_80_0_0_18_ErrEn)) { 
                           Request_error(LSGID,P_FSG_80_0_0_18_ID,getValue(P_FSG_80_0_0_18_ErrCode)); 
                           break;
                        }
                        // Daten setzen
						getValue(P_FSG_80_0_0_18, temp);
						gBAP_Indication_data[1]= gBAP_Indication_data[1]&0x0f;
						gBAP_Indication_data[1]= gBAP_Indication_data[1]|(temp[1]&0xf0);
						gBAP_Indication_data[1]= gBAP_Indication_data[1]&0xf0;
						gBAP_Indication_data[1]= gBAP_Indication_data[1]|(temp[1]&0x0f);
                        putValue(P_FSG_80_0_0_18, gBAP_Indication_data, gBAP_Indication_header[4]);
                        setControlBackColor(panel_name, "errfield_P_FSG_80_0_0_18", MakeRGB(255,255,255));  
                        // und antworten
                        getValue(P_FSG_80_0_0_18, temp);
                        Request_byteSequence(LSGID, P_FSG_80_0_0_18_ID, Data_REQ, temp, gBAP_Indication_header[4]);
                        break;
                    default:
                            PrintIndicationError("Illegal IndType");
                        break;
                }
                break;
            case Bap_error:
                gP_FSG_80_0_0_18_ErrCode = 0;
                putValue(P_FSG_80_0_0_18_ErrCode,  gBAP_Indication_header[5]);
                setControlBackColor(panel_name, "errfield_P_FSG_80_0_0_18", MakeRGB(255,79,79));  
                gP_FSG_80_0_0_18_ErrCode = 1;
                break;
            case Bap_acknowledge:
                break;
            default:
                PrintIndicationError("Illegal DataType");
                break;
        }
    break;
    case P_FSG_80_0_0_19_ID: 
        switch(gBAP_Indication_header[3]) // Datentyp 
        {
            case Bap_byteSequence:
                switch (gBAP_Indication_header[2]) // IndType
                {
                    case DataSet_IND: // Indicationtyp pruefen
                       if (getValue(P_FSG_80_0_0_19_ErrEn)) { 
                           Request_error(LSGID,P_FSG_80_0_0_19_ID,getValue(P_FSG_80_0_0_19_ErrCode)); 
                           break;
                        }
                        // Daten setzen
                        putValue(P_FSG_80_0_0_19, gBAP_Indication_data, gBAP_Indication_header[4]);
                        setControlBackColor(panel_name, "errfield_P_FSG_80_0_0_19", MakeRGB(255,255,255));  
                        break;
                    case DataSetGet_IND: // Indicationtyp pruefen
                       if (getValue(P_FSG_80_0_0_19_ErrEn)) { 
                           Request_error(LSGID,P_FSG_80_0_0_19_ID,getValue(P_FSG_80_0_0_19_ErrCode)); 
                           break;
                        }
                        // Daten setzen
						getValue(P_FSG_80_0_0_19, temp);
						gBAP_Indication_data[5]= gBAP_Indication_data[5]&0x0f;
						gBAP_Indication_data[5]= gBAP_Indication_data[5]|(temp[5]&0xf0);
						gBAP_Indication_data[5]= gBAP_Indication_data[5]&0xf0;
						gBAP_Indication_data[5]= gBAP_Indication_data[5]|(temp[5]&0x0f);
                        putValue(P_FSG_80_0_0_19, gBAP_Indication_data, gBAP_Indication_header[4]);
                        setControlBackColor(panel_name, "errfield_P_FSG_80_0_0_19", MakeRGB(255,255,255));  
                        // und antworten
                        getValue(P_FSG_80_0_0_19, temp);
                        Request_byteSequence(LSGID, P_FSG_80_0_0_19_ID, Data_REQ, temp, gBAP_Indication_header[4]);
                        break;
                    default:
                            PrintIndicationError("Illegal IndType");
                        break;
                }
                break;
            case Bap_error:
                gP_FSG_80_0_0_19_ErrCode = 0;
                putValue(P_FSG_80_0_0_19_ErrCode,  gBAP_Indication_header[5]);
                setControlBackColor(panel_name, "errfield_P_FSG_80_0_0_19", MakeRGB(255,79,79));  
                gP_FSG_80_0_0_19_ErrCode = 1;
                break;
            case Bap_acknowledge:
                break;
            default:
                PrintIndicationError("Illegal DataType");
                break;
        }
    break;
    case M_FSG_80_0_0_20_ID: 
            switch(gBAP_Indication_header[3]) // Datentyp
            {
                case Bap_byteSequence:
                    switch (gBAP_Indication_header[2]) // IndType
                    {
                        case StartResult_IND: 
                            if (getValue(M_FSG_80_0_0_20_ErrEn)) { 
                               Request_error(LSGID,M_FSG_80_0_0_20_ID,getValue(M_FSG_80_0_0_20_ErrCode)); 
                               break;
                            }
                           // running
                            putValue(M_FSG_80_0_0_20_State, "Running");
                            // Daten setzen
                            putValue(M_FSG_80_0_0_20_Start, gBAP_Indication_data, gBAP_Indication_header[4]);
                            setControlBackColor(panel_name, "errfield_M_FSG_80_0_0_20", MakeRGB(255,255,255));  
                            break;
                        case Start_IND:
                            if (getValue(M_FSG_80_0_0_20_ErrEn)) { 
                               Request_error(LSGID,M_FSG_80_0_0_20_ID,getValue(M_FSG_80_0_0_20_ErrCode)); 
                               break;
                            }
                            putValue(M_FSG_80_0_0_20_State, "Started");
                            // Daten setzen
                            putValue(M_FSG_80_0_0_20_Start, gBAP_Indication_data, gBAP_Indication_header[4]);
                            setControlBackColor(panel_name, "errfield_M_FSG_80_0_0_20", MakeRGB(255,255,255));  
                            break;
                        default:
                            PrintIndicationError("Illegal IndType");
                            break;
                    }
                    break;
              case Bap_void:
                    switch (gBAP_Indication_header[2]) // IndType
                    {
                        case AbortResult_IND:
                            putValue(M_FSG_80_0_0_20_State, "Aborted");
                            //if (getValue(M_FSG_80_0_0_20_ErrEn)) 
                            { 
                               // Fehler als Quittierung schicken
                               Request_Error(LSGID, M_FSG_80_0_0_20_ID, getValue(M_FSG_80_0_0_20_ErrCode));
                            }
                            break;
                        case Processing_CNF_IND:    
                            if (getValue(M_FSG_80_0_0_20_ErrEn)) { 
                               // Fehler als Quittierung schicken
                               Request_Error(LSGID, M_FSG_80_0_0_20_ID, getValue(M_FSG_80_0_0_20_ErrCode));
                               break;
                            }
                            // Processing schicken
                            //getValue(M_FSG_80_0_0_20_Processing, temp);
                            //Request_byteSequence(LSGID, M_FSG_80_0_0_20_ID, Processing_REQ, temp, getValueSize(M_FSG_80_0_0_20_Processing));
                            M_FSG_80_0_0_20_ProcessingRequest();
                            setControlBackColor(panel_name, "errfield_M_FSG_80_0_0_20", MakeRGB(255,255,255));  
                            break;
                        default:
                            PrintIndicationError("Illegal IndType");
                            break;
                    }
                    break;
            case Bap_error:
                gM_FSG_80_0_0_20_ErrCode = 0;
                putValue(M_FSG_80_0_0_20_ErrCode,  gBAP_Indication_header[5]);
                setControlBackColor(panel_name, "errfield_M_FSG_80_0_0_20", MakeRGB(255,79,79));  
                gM_FSG_80_0_0_20_ErrCode = 1;
                break;
            case Bap_acknowledge:
                break;
            default:
                    PrintIndicationError("Illegal DataType");
                    break;
            }
    break;
    case P_FSG_80_0_0_21_ID: 
        switch(gBAP_Indication_header[3]) // Datentyp 
        {
            case Bap_error:
                gP_FSG_80_0_0_21_ErrCode = 0;
                setControlBackColor(panel_name, "errfield_P_FSG_80_0_0_21", MakeRGB(255,79,79));  
                gP_FSG_80_0_0_21_ErrCode = 1;
                break;
            case Bap_acknowledge:
                break;
            default:
                PrintIndicationError("Illegal DataType");
                break;
        }
    break;
    case A_FSG_80_0_0_22_ID: 
    switch(gBAP_Indication_header[3]) // Datentyp
    {
        case Bap_byteSequence:
            switch (gBAP_Indication_header[2]) // IndType
            {
                case DataSet_IND: // Indicationtyp pruefen
                    if (getValue(A_FSG_80_0_0_22_ErrEn)) { 
                               Request_error(LSGID,A_FSG_80_0_0_22_ID,getValue(A_FSG_80_0_0_22_ErrCode)); 
                               break;
                    }
                    // Daten setzen
                    //putValue(A_FSG_80_0_0_22_SetGet, gBAP_Indication_data, gBAP_Indication_header[4]);
                        A_FSG_80_0_0_22_SetInd();
                    setControlBackColor(panel_name, "errfield_A_FSG_80_0_0_22", MakeRGB(255,255,255));  
                    break;
                case DataGet_IND:
                    if (getValue(A_FSG_80_0_0_22_ErrEn)) { 
                               Request_error(LSGID,A_FSG_80_0_0_22_ID,getValue(A_FSG_80_0_0_22_ErrCode)); 
                               break;
                    }
                    // Daten setzen
                    //putValue(A_FSG_80_0_0_22_SetGet, gBAP_Indication_data, gBAP_Indication_header[4]);
                        A_FSG_80_0_0_22_GetInd();
                    setControlBackColor(panel_name, "errfield_A_FSG_80_0_0_22", MakeRGB(255,255,255));  
                    // und antworten
                    //getValue(A_FSG_80_0_0_22, temp);
                    //Request_byteSequence(LSGID, A_FSG_80_0_0_22_ID, Data_REQ, temp, getValueSize(A_FSG_80_0_0_22));
                    //Button fuer Status betaetigen => antwort status wird geschickt, code sparen
                    //putValue(A_FSG_80_0_0_22Status_BTN, 1);
                    //putValue(A_FSG_80_0_0_22Status_BTN, 0);
                    A_FSG_80_0_0_22_SendStatus();
                    break;
                case DataSetGet_IND: // Indicationtyp pruefen
                    if (getValue(A_FSG_80_0_0_22_ErrEn)) { 
                               Request_error(LSGID,A_FSG_80_0_0_22_ID,getValue(A_FSG_80_0_0_22_ErrCode)); 
                               break;
                    }
                    // Daten setzen
                    //putValue(A_FSG_80_0_0_22_SetGet, gBAP_Indication_data, gBAP_Indication_header[4]);
                        A_FSG_80_0_0_22_SetGetInd();
                    setControlBackColor(panel_name, "errfield_A_FSG_80_0_0_22", MakeRGB(255,255,255));  
                    // und antworten
                    //getValue(A_FSG_80_0_0_22, temp);
                    //Request_byteSequence(LSGID, A_FSG_80_0_0_22_ID, Data_REQ, temp, getValueSize(A_FSG_80_0_0_22));
                    //Button fuer Status betaetigen => antwort status wird geschickt, code sparen
                    //putValue(A_FSG_80_0_0_22Status_BTN, 1);
                    //putValue(A_FSG_80_0_0_22Status_BTN, 0);
                    A_FSG_80_0_0_22_SendStatus();
                    break;
                default:
                    PrintIndicationError("Illegal IndType");
                    break;
            }
            break;
            case Bap_error:
                gA_FSG_80_0_0_22_ErrCode = 0;
                putValue(A_FSG_80_0_0_22_ErrCode,  gBAP_Indication_header[5]);
                setControlBackColor(panel_name, "errfield_A_FSG_80_0_0_22", MakeRGB(255,79,79));  
                gA_FSG_80_0_0_22_ErrCode = 1;
                break;
            case Bap_acknowledge:
                break;
            default:
                PrintIndicationError("Illegal DataType");
                break;
        }
    break;
    case M_FSG_80_0_0_23_ID: 
            switch(gBAP_Indication_header[3]) // Datentyp
            {
                case Bap_byteSequence:
                    switch (gBAP_Indication_header[2]) // IndType
                    {
                        case StartResult_IND: 
                            if (getValue(M_FSG_80_0_0_23_ErrEn)) { 
                               Request_error(LSGID,M_FSG_80_0_0_23_ID,getValue(M_FSG_80_0_0_23_ErrCode)); 
                               break;
                            }
                           // running
                            putValue(M_FSG_80_0_0_23_State, "Running");
                            // Daten setzen
                            putValue(M_FSG_80_0_0_23_Start, gBAP_Indication_data, gBAP_Indication_header[4]);
                            setControlBackColor(panel_name, "errfield_M_FSG_80_0_0_23", MakeRGB(255,255,255));  
                            break;
                        case Start_IND:
                            if (getValue(M_FSG_80_0_0_23_ErrEn)) { 
                               Request_error(LSGID,M_FSG_80_0_0_23_ID,getValue(M_FSG_80_0_0_23_ErrCode)); 
                               break;
                            }
                            putValue(M_FSG_80_0_0_23_State, "Started");
                            // Daten setzen
                            putValue(M_FSG_80_0_0_23_Start, gBAP_Indication_data, gBAP_Indication_header[4]);
                            setControlBackColor(panel_name, "errfield_M_FSG_80_0_0_23", MakeRGB(255,255,255));  
                            break;
                        default:
                            PrintIndicationError("Illegal IndType");
                            break;
                    }
                    break;
              case Bap_void:
                    switch (gBAP_Indication_header[2]) // IndType
                    {
                        case AbortResult_IND:
                            putValue(M_FSG_80_0_0_23_State, "Aborted");
                            //if (getValue(M_FSG_80_0_0_23_ErrEn)) 
                            { 
                               // Fehler als Quittierung schicken
                               Request_Error(LSGID, M_FSG_80_0_0_23_ID, getValue(M_FSG_80_0_0_23_ErrCode));
                            }
                            break;
                        case Processing_CNF_IND:    
                            if (getValue(M_FSG_80_0_0_23_ErrEn)) { 
                               // Fehler als Quittierung schicken
                               Request_Error(LSGID, M_FSG_80_0_0_23_ID, getValue(M_FSG_80_0_0_23_ErrCode));
                               break;
                            }
                            // Processing schicken
                            //getValue(M_FSG_80_0_0_23_Processing, temp);
                            //Request_byteSequence(LSGID, M_FSG_80_0_0_23_ID, Processing_REQ, temp, getValueSize(M_FSG_80_0_0_23_Processing));
                            M_FSG_80_0_0_23_ProcessingRequest();
                            setControlBackColor(panel_name, "errfield_M_FSG_80_0_0_23", MakeRGB(255,255,255));  
                            break;
                        default:
                            PrintIndicationError("Illegal IndType");
                            break;
                    }
                    break;
            case Bap_error:
                gM_FSG_80_0_0_23_ErrCode = 0;
                putValue(M_FSG_80_0_0_23_ErrCode,  gBAP_Indication_header[5]);
                setControlBackColor(panel_name, "errfield_M_FSG_80_0_0_23", MakeRGB(255,79,79));  
                gM_FSG_80_0_0_23_ErrCode = 1;
                break;
            case Bap_acknowledge:
                break;
            default:
                    PrintIndicationError("Illegal DataType");
                    break;
            }
    break;
    case A_FSG_80_0_0_24_ID: 
    switch(gBAP_Indication_header[3]) // Datentyp
    {
        case Bap_byteSequence:
            switch (gBAP_Indication_header[2]) // IndType
            {
                case DataSet_IND: // Indicationtyp pruefen
                    if (getValue(A_FSG_80_0_0_24_ErrEn)) { 
                               Request_error(LSGID,A_FSG_80_0_0_24_ID,getValue(A_FSG_80_0_0_24_ErrCode)); 
                               break;
                    }
                    // Daten setzen
                    //putValue(A_FSG_80_0_0_24_SetGet, gBAP_Indication_data, gBAP_Indication_header[4]);
                        A_FSG_80_0_0_24_SetInd();
                    setControlBackColor(panel_name, "errfield_A_FSG_80_0_0_24", MakeRGB(255,255,255));  
                    break;
                case DataGet_IND:
                    if (getValue(A_FSG_80_0_0_24_ErrEn)) { 
                               Request_error(LSGID,A_FSG_80_0_0_24_ID,getValue(A_FSG_80_0_0_24_ErrCode)); 
                               break;
                    }
                    // Daten setzen
                    //putValue(A_FSG_80_0_0_24_SetGet, gBAP_Indication_data, gBAP_Indication_header[4]);
                        A_FSG_80_0_0_24_GetInd();
                    setControlBackColor(panel_name, "errfield_A_FSG_80_0_0_24", MakeRGB(255,255,255));  
                    // und antworten
                    //getValue(A_FSG_80_0_0_24, temp);
                    //Request_byteSequence(LSGID, A_FSG_80_0_0_24_ID, Data_REQ, temp, getValueSize(A_FSG_80_0_0_24));
                    //Button fuer Status betaetigen => antwort status wird geschickt, code sparen
                    //putValue(A_FSG_80_0_0_24Status_BTN, 1);
                    //putValue(A_FSG_80_0_0_24Status_BTN, 0);
                    A_FSG_80_0_0_24_SendStatus();
                    break;
                case DataSetGet_IND: // Indicationtyp pruefen
                    if (getValue(A_FSG_80_0_0_24_ErrEn)) { 
                               Request_error(LSGID,A_FSG_80_0_0_24_ID,getValue(A_FSG_80_0_0_24_ErrCode)); 
                               break;
                    }
                    // Daten setzen
                    //putValue(A_FSG_80_0_0_24_SetGet, gBAP_Indication_data, gBAP_Indication_header[4]);
                        A_FSG_80_0_0_24_SetGetInd();
                    setControlBackColor(panel_name, "errfield_A_FSG_80_0_0_24", MakeRGB(255,255,255));  
                    // und antworten
                    //getValue(A_FSG_80_0_0_24, temp);
                    //Request_byteSequence(LSGID, A_FSG_80_0_0_24_ID, Data_REQ, temp, getValueSize(A_FSG_80_0_0_24));
                    //Button fuer Status betaetigen => antwort status wird geschickt, code sparen
                    //putValue(A_FSG_80_0_0_24Status_BTN, 1);
                    //putValue(A_FSG_80_0_0_24Status_BTN, 0);
                    A_FSG_80_0_0_24_SendStatus();
                    break;
                default:
                    PrintIndicationError("Illegal IndType");
                    break;
            }
            break;
            case Bap_error:
                gA_FSG_80_0_0_24_ErrCode = 0;
                putValue(A_FSG_80_0_0_24_ErrCode,  gBAP_Indication_header[5]);
                setControlBackColor(panel_name, "errfield_A_FSG_80_0_0_24", MakeRGB(255,79,79));  
                gA_FSG_80_0_0_24_ErrCode = 1;
                break;
            case Bap_acknowledge:
                break;
            default:
                PrintIndicationError("Illegal DataType");
                break;
        }
    break;
    case P_FSG_80_0_0_25_ID: 
        switch(gBAP_Indication_header[3]) // Datentyp 
        {
            case Bap_error:
                gP_FSG_80_0_0_25_ErrCode = 0;
                setControlBackColor(panel_name, "errfield_P_FSG_80_0_0_25", MakeRGB(255,79,79));  
                gP_FSG_80_0_0_25_ErrCode = 1;
                break;
            case Bap_acknowledge:
                break;
            default:
                PrintIndicationError("Illegal DataType");
                break;
        }
    break;
    case P_FSG_80_0_0_26_ID: 
        switch(gBAP_Indication_header[3]) // Datentyp 
        {
            case Bap_error:
                gP_FSG_80_0_0_26_ErrCode = 0;
                setControlBackColor(panel_name, "errfield_P_FSG_80_0_0_26", MakeRGB(255,79,79));  
                gP_FSG_80_0_0_26_ErrCode = 1;
                break;
            case Bap_acknowledge:
                break;
            default:
                PrintIndicationError("Illegal DataType");
                break;
        }
    break;
    case M_FSG_80_0_0_27_ID: 
            switch(gBAP_Indication_header[3]) // Datentyp
            {
                case Bap_byteSequence:
                    switch (gBAP_Indication_header[2]) // IndType
                    {
                        case StartResult_IND: 
                            if (getValue(M_FSG_80_0_0_27_ErrEn)) { 
                               Request_error(LSGID,M_FSG_80_0_0_27_ID,getValue(M_FSG_80_0_0_27_ErrCode)); 
                               break;
                            }
                           // running
                            putValue(M_FSG_80_0_0_27_State, "Running");
                            // Daten setzen
                            putValue(M_FSG_80_0_0_27_Start, gBAP_Indication_data, gBAP_Indication_header[4]);
                            setControlBackColor(panel_name, "errfield_M_FSG_80_0_0_27", MakeRGB(255,255,255));  
                            break;
                        case Start_IND:
                            if (getValue(M_FSG_80_0_0_27_ErrEn)) { 
                               Request_error(LSGID,M_FSG_80_0_0_27_ID,getValue(M_FSG_80_0_0_27_ErrCode)); 
                               break;
                            }
                            putValue(M_FSG_80_0_0_27_State, "Started");
                            // Daten setzen
                            putValue(M_FSG_80_0_0_27_Start, gBAP_Indication_data, gBAP_Indication_header[4]);
                            setControlBackColor(panel_name, "errfield_M_FSG_80_0_0_27", MakeRGB(255,255,255));  
                            break;
                        default:
                            PrintIndicationError("Illegal IndType");
                            break;
                    }
                    break;
              case Bap_void:
                    switch (gBAP_Indication_header[2]) // IndType
                    {
                        case AbortResult_IND:
                            putValue(M_FSG_80_0_0_27_State, "Aborted");
                            //if (getValue(M_FSG_80_0_0_27_ErrEn)) 
                            { 
                               // Fehler als Quittierung schicken
                               Request_Error(LSGID, M_FSG_80_0_0_27_ID, getValue(M_FSG_80_0_0_27_ErrCode));
                            }
                            break;
                        case Processing_CNF_IND:    
                            if (getValue(M_FSG_80_0_0_27_ErrEn)) { 
                               // Fehler als Quittierung schicken
                               Request_Error(LSGID, M_FSG_80_0_0_27_ID, getValue(M_FSG_80_0_0_27_ErrCode));
                               break;
                            }
                            // Processing schicken
                            //getValue(M_FSG_80_0_0_27_Processing, temp);
                            //Request_byteSequence(LSGID, M_FSG_80_0_0_27_ID, Processing_REQ, temp, getValueSize(M_FSG_80_0_0_27_Processing));
                            M_FSG_80_0_0_27_ProcessingRequest();
                            setControlBackColor(panel_name, "errfield_M_FSG_80_0_0_27", MakeRGB(255,255,255));  
                            break;
                        default:
                            PrintIndicationError("Illegal IndType");
                            break;
                    }
                    break;
            case Bap_error:
                gM_FSG_80_0_0_27_ErrCode = 0;
                putValue(M_FSG_80_0_0_27_ErrCode,  gBAP_Indication_header[5]);
                setControlBackColor(panel_name, "errfield_M_FSG_80_0_0_27", MakeRGB(255,79,79));  
                gM_FSG_80_0_0_27_ErrCode = 1;
                break;
            case Bap_acknowledge:
                break;
            default:
                    PrintIndicationError("Illegal DataType");
                    break;
            }
    break;
    case A_FSG_80_0_0_28_ID: 
    switch(gBAP_Indication_header[3]) // Datentyp
    {
        case Bap_byteSequence:
            switch (gBAP_Indication_header[2]) // IndType
            {
                case DataSet_IND: // Indicationtyp pruefen
                    if (getValue(A_FSG_80_0_0_28_ErrEn)) { 
                               Request_error(LSGID,A_FSG_80_0_0_28_ID,getValue(A_FSG_80_0_0_28_ErrCode)); 
                               break;
                    }
                    // Daten setzen
                    //putValue(A_FSG_80_0_0_28_SetGet, gBAP_Indication_data, gBAP_Indication_header[4]);
                        A_FSG_80_0_0_28_SetInd();
                    setControlBackColor(panel_name, "errfield_A_FSG_80_0_0_28", MakeRGB(255,255,255));  
                    break;
                case DataGet_IND:
                    if (getValue(A_FSG_80_0_0_28_ErrEn)) { 
                               Request_error(LSGID,A_FSG_80_0_0_28_ID,getValue(A_FSG_80_0_0_28_ErrCode)); 
                               break;
                    }
                    // Daten setzen
                    //putValue(A_FSG_80_0_0_28_SetGet, gBAP_Indication_data, gBAP_Indication_header[4]);
                        A_FSG_80_0_0_28_GetInd();
                    setControlBackColor(panel_name, "errfield_A_FSG_80_0_0_28", MakeRGB(255,255,255));  
                    // und antworten
                    //getValue(A_FSG_80_0_0_28, temp);
                    //Request_byteSequence(LSGID, A_FSG_80_0_0_28_ID, Data_REQ, temp, getValueSize(A_FSG_80_0_0_28));
                    //Button fuer Status betaetigen => antwort status wird geschickt, code sparen
                    //putValue(A_FSG_80_0_0_28Status_BTN, 1);
                    //putValue(A_FSG_80_0_0_28Status_BTN, 0);
                    A_FSG_80_0_0_28_SendStatus();
                    break;
                case DataSetGet_IND: // Indicationtyp pruefen
                    if (getValue(A_FSG_80_0_0_28_ErrEn)) { 
                               Request_error(LSGID,A_FSG_80_0_0_28_ID,getValue(A_FSG_80_0_0_28_ErrCode)); 
                               break;
                    }
                    // Daten setzen
                    //putValue(A_FSG_80_0_0_28_SetGet, gBAP_Indication_data, gBAP_Indication_header[4]);
                        A_FSG_80_0_0_28_SetGetInd();
                    setControlBackColor(panel_name, "errfield_A_FSG_80_0_0_28", MakeRGB(255,255,255));  
                    // und antworten
                    //getValue(A_FSG_80_0_0_28, temp);
                    //Request_byteSequence(LSGID, A_FSG_80_0_0_28_ID, Data_REQ, temp, getValueSize(A_FSG_80_0_0_28));
                    //Button fuer Status betaetigen => antwort status wird geschickt, code sparen
                    //putValue(A_FSG_80_0_0_28Status_BTN, 1);
                    //putValue(A_FSG_80_0_0_28Status_BTN, 0);
                    A_FSG_80_0_0_28_SendStatus();
                    break;
                default:
                    PrintIndicationError("Illegal IndType");
                    break;
            }
            break;
            case Bap_error:
                gA_FSG_80_0_0_28_ErrCode = 0;
                putValue(A_FSG_80_0_0_28_ErrCode,  gBAP_Indication_header[5]);
                setControlBackColor(panel_name, "errfield_A_FSG_80_0_0_28", MakeRGB(255,79,79));  
                gA_FSG_80_0_0_28_ErrCode = 1;
                break;
            case Bap_acknowledge:
                break;
            default:
                PrintIndicationError("Illegal DataType");
                break;
        }
    break;
       default:
           writelineEx(gError_Trace, 0, "NodeIndex: %d: Illegal Fct: lsgid:%d fctid:%d indType:%d",
           NODE_INDEX, gBAP_Indication_header[0], gBAP_Indication_header[1], gBAP_Indication_header[2]);
           break;
       }
       break;
   default:
       writelineEx(gError_Trace, 0, "NodeIndex: %d: Illegal LSGID: lsgid:%d fctid:%d indType:%s", NODE_INDEX, gBAP_Indication_header[0], gBAP_Indication_header[1], Indicationtype_Text[gBAP_Indication_header[2]]);
       break;
   }
}



on message BAP_InfoSettings_ASG_01
{
   int i, temp;
   byte RX_Data[8];            // received CAN-DATA
   dword RX_Header[3];         // received CAN-Header
   if(gSG_PowerOnOff==Power_on){
       RX_Header[0]=this.CAN;
       RX_Header[1]=this.ID;
       RX_Header[2]=this.DLC; // received length
       for (i=0; i<this.DLC; i++) {
           RX_Data[i]=this.byte(i);
       }
       temp=BAP150_CAN_SetRxDat(NODE_INDEX, RX_Header, RX_Data);
   }
}

on message BAP_InfoSettings_ASG_03
{
   int i, temp;
   byte RX_Data[8];            // received CAN-DATA
   dword RX_Header[3];         // received CAN-Header
   if(gSG_PowerOnOff==Power_on){
       RX_Header[0]=this.CAN;
       RX_Header[1]=this.ID;
       RX_Header[2]=this.DLC; // received length
       for (i=0; i<this.DLC; i++) {
           RX_Data[i]=this.byte(i);
       }
       temp=BAP150_CAN_SetRxDat(NODE_INDEX, RX_Header, RX_Data);
   }
}

/*on message BAP_InfoSettings_ASG_03
{
   int i, temp;
   byte RX_Data[64];            // received CAN-DATA
   dword RX_Header[4];         // received CAN-Header
   if(gSG_PowerOnOff==Power_on){
       if(this.msgChannel == 1){
           RX_Header[0]=1; // BusType: 1=Can, 2=Lin, 3=Flexray, 4=Ethernet
           RX_Header[1]=1;
           RX_Header[2]=this.DataLength; // received length
           RX_Header[3]=this.ID;
           for (i=0; i<this.DataLength; i++) {
               RX_Data[i]=this.byte(i);
           }
           temp=BAP180_SetRxData(NODE_INDEX, RX_Header, RX_Data);
       }
   }
}

on message BAP_InfoSettings_ASG_01
{
   int i, temp;
   byte RX_Data[64];            // received CAN-DATA
   dword RX_Header[4];         // received CAN-Header
   if(gSG_PowerOnOff==Power_on){
       if(this.msgChannel == 1){
           RX_Header[0]=1; // BusType: 1=Can, 2=Lin, 3=Flexray, 4=Ethernet
           RX_Header[1]=1;
           RX_Header[2]=this.DataLength; // received length
           RX_Header[3]=this.ID;
           for (i=0; i<this.DataLength; i++) {
               RX_Data[i]=this.byte(i);
           }
           temp=BAP180_SetRxData(NODE_INDEX, RX_Header, RX_Data);
       }
   }
}*/



intertelegram_err(long fctId)
{
    long data[4];
    data[0]=LSGID;
    data[1]=fctId;
    data[2]=1;
    data[3]=940;
    ChangeConfig(0x0020,data);
}

sequence_err(long fctId, long size)
{
    long data[5];
    long lastSeg;

    lastSeg = size-5;

    data[0]=LSGID;
    data[1]=fctId;
    data[2]=lastSeg/7+1;
    data[3]=1;
    data[4]=(lastSeg/7+4) & 15;
    ChangeConfig(0x0021,data);
}

intertelegram_err_off(long fctId)
{
    long data[4];
    data[0]=LSGID;
    data[1]=fctId;
    data[2]=5000;
    data[3]=0;
    ChangeConfig(0x0020,data);
}

sequence_err_off(long fctId)
{
    long data[5];

    data[0]=LSGID;
    data[1]=fctId;
    data[2]=5000;
    data[3]=0;
    data[4]=0;
    ChangeConfig(0x0021,data);
}

// START OF BUS CONFIG PANEL CAPL

// ETHERNET AND FLEXRAY NOT ENABLED! (ENABLE_BUS_SELECTOR_PANEL_TOKEN)

// ETHERNET AND FLEXRAY NOT ENABLED! (ENABLE_CAN_FRAME_TOKEN)

// ETHERNET AND FLEXRAY NOT ENABLED! (ENABLE_FR_FRAME_TOKEN)

// ETHERNET AND FLEXRAY NOT ENABLED! (ENABLE_ETHERNET_FRAME_TOKEN)

// ETHERNET AND FLEXRAY NOT ENABLED! (ON_ENVVAR_BUSTYPE_TOKEN)

// ETHERNET NOT ENABLED! (ON_UDP_RECEIVE_FROM_TOKEN)

// ETHERNET NOT ENABLED!

on envVar ON_OFF_FSG80_0
{
   BapOnOff(getvalue(this));
   gSG_PowerOnOff=getvalue(ON_OFF_FSG80_0);
}
on envVar BAPCFG_FSG_80_0_0_DFMajor
{
    long temp[3];
    byte ret,i ;
    for (i = 0; i < 4; i++)
    {
        temp[0] = LSGID;
        temp[1] = i;
        temp[2] = getValue(this);
        ret = BAP150_ChangeConfig(NODE_INDEX, 9, temp);
        if (ret != 0)
        {
            writeLineEx(gBAP_Trace, 0, "NodeIndex: %d: Error %d occured during setting of Minor DF Version.",NODE_INDEX, ret);
        }
    }
}
on envVar BAPCFG_FSG_80_0_0_DFMinor
{
    long temp[3];
    byte ret,i ;
    for (i = 0; i < 4; i++)
    {
        temp[0] = LSGID;
        temp[1] = i;
        temp[2] = getValue(this);
        ret = BAP150_ChangeConfig(NODE_INDEX, 10, temp);
        if (ret != 0)
        {
            writeLineEx(gBAP_Trace, 0, "NodeIndex: %d: Error %d occured during setting of Minor DF Version.",NODE_INDEX, ret);
        }
    }
}
on envVar BAPCFG_FSG_80_0_0_LsgClassMajor
{
    long temp[3];
    byte ret,i ;
    for (i = 0; i < 4; i++)
    {
        temp[0] = LSGID;
        temp[1] = i;
        temp[2] = getValue(this);
        ret = BAP150_ChangeConfig(NODE_INDEX, 5, temp);
        if (ret != 0)
        {
            writeLineEx(gBAP_Trace, 0, "NodeIndex: %d: Error %d occured during setting of Minor DF Version.",NODE_INDEX, ret);
        }
    }
}
on envVar BAPCFG_FSG_80_0_0_LsgClassMinor
{
    long temp[3];
    byte ret,i ;
    for (i = 0; i < 4; i++)
    {
        temp[0] = LSGID;
        temp[1] = i;
        temp[2] = getValue(this);
        ret = BAP150_ChangeConfig(NODE_INDEX, 6, temp);
        if (ret != 0)
        {
            writeLineEx(gBAP_Trace, 0, "NodeIndex: %d: Error %d occured during setting of Minor DF Version.",NODE_INDEX, ret);
        }
    }
}
on envVar BAPCFG_FSG_80_0_0_ProtocolMajor
{
    long temp[3];
    byte ret,i ;
    for (i = 0; i < 4; i++)
    {
        temp[0] = LSGID;
        temp[1] = i;
        temp[2] = getValue(this);
        ret = BAP150_ChangeConfig(NODE_INDEX, 7, temp);
        if (ret != 0)
        {
            writeLineEx(gBAP_Trace, 0, "NodeIndex: %d: Error %d occured during setting of Minor DF Version.",NODE_INDEX, ret);
        }
    }
}
on envVar BAPCFG_FSG_80_0_0_ProtocolMinor
{
    long temp[3];
    byte ret,i ;
    for (i = 0; i < 4; i++)
    {
        temp[0] = LSGID;
        temp[1] = i;
        temp[2] = getValue(this);
        ret = BAP150_ChangeConfig(NODE_INDEX, 8, temp);
        if (ret != 0)
        {
            writeLineEx(gBAP_Trace, 0, "NodeIndex: %d: Error %d occured during setting of Minor DF Version.",NODE_INDEX, ret);
        }
    }
}
// Setzen der Schriftfarbe bei Zustandswechsel der FCTID C_FSG_80_0_0_1_ID
on envVar C_FSG_80_0_0_1_FctLstItemEn
{
       if(getValue(this)) 
       {
           setControlForeColor(panel_name, "checkbox_C_FSG_80_0_0_1", MakeRGB(0,240,0));
       }
       else
       {
           setControlForeColor(panel_name, "checkbox_C_FSG_80_0_0_1", MakeRGB(250,0,0));
       }
}
// Setzen der Schriftfarbe bei Zustandswechsel der FCTID P_FSG_80_0_0_2_ID
on envVar P_FSG_80_0_0_2_FctLstItemEn
{
       if(getValue(this)) 
       {
           setControlForeColor(panel_name, "checkbox_P_FSG_80_0_0_2", MakeRGB(0,240,0));
       }
       else
       {
           setControlForeColor(panel_name, "checkbox_P_FSG_80_0_0_2", MakeRGB(250,0,0));
       }
}
// Ruecksetzen des Fehlerstatus durch manuelle Fehlereingabe
on envVar P_FSG_80_0_0_2_ErrCode
{
       if(gP_FSG_80_0_0_2_ErrCode) 
       {
           setControlBackColor(panel_name,"errfield_P_FSG_80_0_0_2", MakeRGB(255,255,255));
       }
       gP_FSG_80_0_0_2_ErrCode = 1;
}
// Setzen der Schriftfarbe bei Zustandswechsel der FCTID P_FSG_80_0_0_3_ID
on envVar P_FSG_80_0_0_3_FctLstItemEn
{
       if(getValue(this)) 
       {
           setControlForeColor(panel_name, "checkbox_P_FSG_80_0_0_3", MakeRGB(0,240,0));
       }
       else
       {
           setControlForeColor(panel_name, "checkbox_P_FSG_80_0_0_3", MakeRGB(250,0,0));
       }
}
// Ruecksetzen des Fehlerstatus durch manuelle Fehlereingabe
on envVar P_FSG_80_0_0_3_ErrCode
{
       if(gP_FSG_80_0_0_3_ErrCode) 
       {
           setControlBackColor(panel_name,"errfield_P_FSG_80_0_0_3", MakeRGB(255,255,255));
       }
       gP_FSG_80_0_0_3_ErrCode = 1;
}
// De-Aktivierung der Eingabefelder der HB-FCT P_FSG_80_0_0_4
on envVar P_FSG_80_0_0_4_FctLstItemEn
{
       if(getValue(this)) 
       {
//           EnableControl(panel_name,"panel_FSG_80_0_0_4",1);
//           EnableControl(panel_name,"${ERRFIELD}",1);
           EnableControl(panel_name,"panel_P_FSG_80_0_0_4_HBEn",1);
           setControlForeColor(panel_name, "checkbox_P_FSG_80_0_0_4", MakeRGB(0,240,0));
       }
       else
       {
//           EnableControl(panel_name,"panel_FSG_80_0_0_4",0);
//           EnableControl(panel_name,"${ERRFIELD}",0);
           EnableControl(panel_name,"panel_P_FSG_80_0_0_4_HBEn",0);
           setControlForeColor(panel_name, "checkbox_P_FSG_80_0_0_4", MakeRGB(250,0,0));
       }
}
on envVar P_FSG_80_0_0_4_FctEn
{
	long data[2];
	if(getValue(P_FSG_80_0_0_4_FctEn)>0)
	{
		data[0] = 80;
		data[1] = getValue(P_FSG_80_0_0_4);
		write("enable HB");
	}
	else
	{
		data[0] = 80;
		data[1] = 0;
		write("disable HB");
	}
	Bap150_ChangeConfig(NODE_INDEX, 0x00, data);
}
// Ruecksetzen des Fehlerstatus durch manuelle Fehlereingabe
on envVar P_FSG_80_0_0_4_ErrCode
{
       if(gP_FSG_80_0_0_4_ErrCode) 
       {
           setControlBackColor(panel_name,"errfield_P_FSG_80_0_0_4", MakeRGB(255,255,255));
       }
       gP_FSG_80_0_0_4_ErrCode = 1;
}
// Ruecksetzen des Fehlerstatus durch manuelle Fehlereingabe
on envVar P_FSG_80_0_0_13_ErrCode
{
       if(gP_FSG_80_0_0_13_ErrCode) 
       {
           setControlBackColor(panel_name,"errfield_P_FSG_80_0_0_13", MakeRGB(255,255,255));
       }
       gP_FSG_80_0_0_13_ErrCode = 1;
}
on envVar P_FSG_80_0_0_13Status_BTN
{
    if (P_FSG_80_0_0_13Status_BTN_already_pressed == 0)
    {
       putValue(P_FSG_80_0_0_13_ErrCode,0);
       SetControlBackColor(panel_name,"errField_P_FSG_80_0_0_13",MakeRGB(255,255,255));
       P_FSG_80_0_0_13Status_BTN_already_pressed = 1;
    }
    else
    {
       Request_Int8(LSGID, P_FSG_80_0_0_13_ID, Data_REQ, getValue(P_FSG_80_0_0_13));
      P_FSG_80_0_0_13Status_BTN_already_pressed = 0;
    }
}
on envVar P_FSG_80_0_0_13_FctEn
{
    long data[3];
    data[0]=LSGID;
    data[1]=P_FSG_80_0_0_13_ID;
    data[2]=getValue(P_FSG_80_0_0_13_FctEn);
    ChangeConfig(0x0031,data);
}
// De-Aktivierung der Eingabefelder der FCTID P_FSG_80_0_0_13
on envVar P_FSG_80_0_0_13_FctLstItemEn
{
       if(getValue(this)) 
       {
           EnableControl(panel_name,"panel_FSG_80_0_0_13",1);
           EnableControl(panel_name,"errfield_P_FSG_80_0_0_13",1);
           EnableControl(panel_name,"panel_P_FSG_80_0_0_13",1);
           setControlForeColor(panel_name, "checkbox_P_FSG_80_0_0_13", MakeRGB(0,240,0));
       }
       else
       {
           EnableControl(panel_name,"panel_FSG_80_0_0_13",0);
           EnableControl(panel_name,"errfield_P_FSG_80_0_0_13",0);
           EnableControl(panel_name,"panel_P_FSG_80_0_0_13",0);
           setControlForeColor(panel_name, "checkbox_P_FSG_80_0_0_13", MakeRGB(250,0,0));
       }
}
on envVar P_FSG_80_0_0_13 // bus value of FSG_Control (13).
{
	// opcodes: Error-Status
	byte param1; // Controlcode
	// DATATYPE_UINTXX
	param1 = getValue(P_FSG_80_0_0_13);
	putValue(P_FSG_80_0_0_13_1, param1);
}

on envVar P_FSG_80_0_0_13_1_0
{
	byte bitval;
	//thisval steht hier fuer den bitfield-wert, 
	//aus Generierungsgruenden hier keine einheitliche Bezeichnung moeglich.
	byte thisval; // Controlcode
	bitval= getValue(this);
	thisval = getValue(P_FSG_80_0_0_13_1);
	thisval = thisval&~(1<<0)|(bitval<<0);
	putValue(P_FSG_80_0_0_13_1,thisval);
}

on envVar P_FSG_80_0_0_13_1 // FSG_Control.Controlcode
{
	byte superval;

	//Update Childvalue (BitField)
	byte mask=0x01;
	int i = 0;
	byte thisval; // Controlcode
	thisval = getValue(this);
	if(thisval&(mask<<0))
		putValue(P_FSG_80_0_0_13_1_0, 1);
	else
		putValue(P_FSG_80_0_0_13_1_0, 0);

    // Update superval
	superval = getValue(P_FSG_80_0_0_13);
	superval = thisval;
	putValue(P_FSG_80_0_0_13,superval);
}

// Ruecksetzen des Fehlerstatus durch manuelle Fehlereingabe
on envVar P_FSG_80_0_0_14_ErrCode
{
       if(gP_FSG_80_0_0_14_ErrCode) 
       {
           setControlBackColor(panel_name,"errfield_P_FSG_80_0_0_14", MakeRGB(255,255,255));
       }
       gP_FSG_80_0_0_14_ErrCode = 1;
}
on envVar P_FSG_80_0_0_14Status_BTN
{
	byte BAPTemp[71];
    if (P_FSG_80_0_0_14Status_BTN_already_pressed == 0)
    {
        putValue(P_FSG_80_0_0_14_ErrCode,0);
        SetControlBackColor(panel_name,"errField_P_FSG_80_0_0_14",MakeRGB(255,255,255));
        P_FSG_80_0_0_14Status_BTN_already_pressed = 1;
    }
    else
    {
		P_FSG_80_0_0_14_BuildFct();
        getValue(P_FSG_80_0_0_14, BAPTemp);
        Request_ByteSequence(LSGID, P_FSG_80_0_0_14_ID, Data_REQ, BAPTemp, getValueSize(P_FSG_80_0_0_14));
        if(getValue(P_FSG_80_0_0_14_IntTlgEn)) //getValue(IT))
        {
           intertelegram_err(P_FSG_80_0_0_14_ID);
        }
        if(getValue(P_FSG_80_0_0_14_SegmEn))   //getvalue(SG)
        {
           sequence_err(P_FSG_80_0_0_14_ID,elCount(BAPTemp));
        }
       P_FSG_80_0_0_14Status_BTN_already_pressed = 0;
    }
}
on envVar P_FSG_80_0_0_14_FctEn
{
    long data[3];
    data[0]=LSGID;
    data[1]=P_FSG_80_0_0_14_ID;
    data[2]=getValue(P_FSG_80_0_0_14_FctEn);
    ChangeConfig(0x0031,data);
}
// De-Aktivierung der Eingabefelder der FCTID P_FSG_80_0_0_14
on envVar P_FSG_80_0_0_14_FctLstItemEn
{
       if(getValue(this)) 
       {
           EnableControl(panel_name,"panel_FSG_80_0_0_14",1);
           EnableControl(panel_name,"errfield_P_FSG_80_0_0_14",1);
           EnableControl(panel_name,"panel_P_FSG_80_0_0_14",1);
           setControlForeColor(panel_name, "checkbox_P_FSG_80_0_0_14", MakeRGB(0,240,0));
       }
       else
       {
           EnableControl(panel_name,"panel_FSG_80_0_0_14",0);
           EnableControl(panel_name,"errfield_P_FSG_80_0_0_14",0);
           EnableControl(panel_name,"panel_P_FSG_80_0_0_14",0);
           setControlForeColor(panel_name, "checkbox_P_FSG_80_0_0_14", MakeRGB(250,0,0));
       }
}
// Man darf gleichzeitig nur Checkbox fuer SegmError oder IntertelegramError aktiviert werden
on envVar P_FSG_80_0_0_14_IntTlgEn
{
       if(getValue(this)) 
       {
           putValue(P_FSG_80_0_0_14_SegmEn,0);
           intertelegram_err(P_FSG_80_0_0_14_ID);
       }
       else
       {
           intertelegram_err_off(P_FSG_80_0_0_14_ID);
       }
}
// Man darf gleichzeitig nur Checkbox fuer SegmError oder IntertelegramError aktiviert werden
on envVar P_FSG_80_0_0_14_SegmEn
{
       if(getValue(this)) 
       {
           putValue(P_FSG_80_0_0_14_IntTlgEn,0);
           sequence_err(P_FSG_80_0_0_14_ID,getValueSize(P_FSG_80_0_0_14_SegmEn));
       }
       else
       {
              sequence_err_off(P_FSG_80_0_0_14_ID);
       }
}
on envVar P_FSG_80_0_0_14 // bus value of FSG_Setup (14).
{
	// opcodes: Error-Status
	byte param1; // AvailableToneSettings
	byte param2; // AvailableSoundSettings
	byte param3; // maxVolume
	byte param4; // maxRadioFavorites
	byte param5; // StepsTreble
	byte param6; // StepsBass
	byte param7; // StepsBalance
	byte param8; // Extension1
	byte param9; // StepsGALA
	byte param10[61]; // BTNodeName
	word len10;
	byte cnt10;
	byte param11; // Extension2
	byte param12; // Extension3
	// DATATYPE_BYTESEQUENCE / DATATYPE_FIXEDBYTESEQUENCE
	int i;
	byte superval[71];
	int currentPos;
	currentPos = 0;
	for( i = 0; i < 71; i++ ) {
		superval[i] = 0;
	}
	getValue(P_FSG_80_0_0_14, superval);
	///////// Start param1 - UINT8 /////////
	param1 = superval[currentPos++];
	putValue(P_FSG_80_0_0_14_1, param1);
	///////// Start param2 - UINT8 /////////
	param2 = superval[currentPos++];
	putValue(P_FSG_80_0_0_14_2, param2);
	///////// Start param3 - UINT8 /////////
	param3 = superval[currentPos++];
	putValue(P_FSG_80_0_0_14_3, round((param3 * 1.0) - (0) + (0), 1.0));
	///////// Start param4 - UINT8 /////////
	param4 = superval[currentPos++];
	putValue(P_FSG_80_0_0_14_4, round((param4 * 1.0) - (0) + (0), 1.0));
	///////// Start param5 - UINT8 /////////
	param5 = superval[currentPos++];
	putValue(P_FSG_80_0_0_14_5, round((param5 * 1.0) - (0) + (0), 1.0));
	///////// Start param6 - UINT8 /////////
	param6 = superval[currentPos++];
	putValue(P_FSG_80_0_0_14_6, round((param6 * 1.0) - (0) + (0), 1.0));
	///////// Start param7 - UINT8 /////////
	param7 = superval[currentPos++];
	putValue(P_FSG_80_0_0_14_7, round((param7 * 1.0) - (0) + (0), 1.0));
	///////// Start param8 - NIBBLE /////////
	param8 = (superval[currentPos] & 0xf0)>>4;
	putValue(P_FSG_80_0_0_14_8, round((param8 * 1.0) - (0) + (0), 1.0));
	///////// Start param9 - NIBBLE /////////
	param9 = superval[currentPos++] & 0x0f;
	putValue(P_FSG_80_0_0_14_9, round((param9 * 1.0) - (0) + (0), 1.0));
	///////// Start param10 - STRING /////////
	getValue(P_FSG_80_0_0_14_10, param10);
	if((superval[currentPos] & 0x80) > 0)
	{
		if(60>127) /* Max Fct-Katalog Laenge: 60*/
		{
			len10 = ( (superval[currentPos]&0x7F) <<8) + superval[currentPos+1];
			currentPos = currentPos + 2;
			cnt10 = 1;
		}
		else
		{
			len10 = 60;
			writelineEx(gBAP_Trace, 0, "Anzahl der Laengeninformation-Bytes in P_FSG_80_0_0_14 ueberschreitet die erlaubte 1 Byte vom Fct-Kalatog.");
		}
	}
	else
	{
		len10 = superval[currentPos]&0x7F;
		currentPos = currentPos + 1;
		cnt10 = 0;
	}
	
	if(len10 > 60)
	{
		writelineEx(gBAP_Trace, 0, "Laenge:%d bei der Byte Position:%d ueberschreitet die Maximale erlaubte Laenge von Fct-Kalatog", len10, currentPos);
		len10 = 60;
	
		if(len10 < 128) cnt10 = 0;
		else cnt10 = 1;
	}
	
	for(i = 0; i < len10; i++)
	{
		param10[i] = superval[currentPos++];
	}
	
	putValue(P_FSG_80_0_0_14_10_len, len10);
	putValue(P_FSG_80_0_0_14_10_cnt, cnt10);
	
	if(len10 > getValueSize(P_FSG_80_0_0_14_10))
		putValue(P_FSG_80_0_0_14_10, param10, len10);
	else
		putValue(P_FSG_80_0_0_14_10, param10, getValueSize(P_FSG_80_0_0_14_10));

	///////// Start param11 - UINT8 /////////
	param11 = superval[currentPos++];
	putValue(P_FSG_80_0_0_14_11, round((param11 * 1.0) - (0) + (0), 1.0));
	///////// Start param12 - UINT8 /////////
	param12 = superval[currentPos++];
	putValue(P_FSG_80_0_0_14_12, round((param12 * 1.0) - (0) + (0), 1.0));
}

// Updates the bus value field and other dependencies.
P_FSG_80_0_0_14_BuildFct()
{
	byte param1; // AvailableToneSettings
	byte param2; // AvailableSoundSettings
	byte param3; // maxVolume
	byte param4; // maxRadioFavorites
	byte param5; // StepsTreble
	byte param6; // StepsBass
	byte param7; // StepsBalance
	byte param8; // Extension1
	byte param9; // StepsGALA
	byte param10[61]; // BTNodeName
	word len10;
	byte cnt10;
	byte param11; // Extension2
	byte param12; // Extension3

	int i;
	byte superval[71];
	int currentPos;
	currentPos = 0;
// gen_BuildFunc_SetSuperVals 
	param1 = getValue(P_FSG_80_0_0_14_1);
	@P_FSG_80_0_0_14_1_0 = (param1 & 1) > 0;
	@P_FSG_80_0_0_14_1_1 = (param1 & 2) > 0;
	@P_FSG_80_0_0_14_1_2 = (param1 & 4) > 0;
	superval[currentPos++]=param1;
// gen_BuildFunc_SetSuperVals 
	param2 = getValue(P_FSG_80_0_0_14_2);
	@P_FSG_80_0_0_14_2_0 = (param2 & 1) > 0;
	@P_FSG_80_0_0_14_2_1 = (param2 & 2) > 0;
	@P_FSG_80_0_0_14_2_2 = (param2 & 4) > 0;
	@P_FSG_80_0_0_14_2_3 = (param2 & 8) > 0;
	superval[currentPos++]=param2;
// gen_BuildFunc_SetSuperVals 
	@P_FSG_80_0_0_14_3_range = round(@P_FSG_80_0_0_14_3 + (0), 1.0); // slider value + min = real value
	param3 = round( (@P_FSG_80_0_0_14_3 + (0) - (0)) / (1.0), 1.0); // (slider value + min - offset) / step = busvalue
	superval[currentPos++]=param3;
// gen_BuildFunc_SetSuperVals 
	@P_FSG_80_0_0_14_4_range = round(@P_FSG_80_0_0_14_4 + (0), 1.0); // slider value + min = real value
	param4 = round( (@P_FSG_80_0_0_14_4 + (0) - (0)) / (1.0), 1.0); // (slider value + min - offset) / step = busvalue
	superval[currentPos++]=param4;
// gen_BuildFunc_SetSuperVals 
	@P_FSG_80_0_0_14_5_range = round(@P_FSG_80_0_0_14_5 + (0), 1.0); // slider value + min = real value
	param5 = round( (@P_FSG_80_0_0_14_5 + (0) - (0)) / (1.0), 1.0); // (slider value + min - offset) / step = busvalue
	superval[currentPos++]=param5;
// gen_BuildFunc_SetSuperVals 
	@P_FSG_80_0_0_14_6_range = round(@P_FSG_80_0_0_14_6 + (0), 1.0); // slider value + min = real value
	param6 = round( (@P_FSG_80_0_0_14_6 + (0) - (0)) / (1.0), 1.0); // (slider value + min - offset) / step = busvalue
	superval[currentPos++]=param6;
// gen_BuildFunc_SetSuperVals 
	@P_FSG_80_0_0_14_7_range = round(@P_FSG_80_0_0_14_7 + (0), 1.0); // slider value + min = real value
	param7 = round( (@P_FSG_80_0_0_14_7 + (0) - (0)) / (1.0), 1.0); // (slider value + min - offset) / step = busvalue
	superval[currentPos++]=param7;
// gen_BuildFunc_SetSuperVals 
	@P_FSG_80_0_0_14_8_range = round(@P_FSG_80_0_0_14_8 + (0), 1.0); // slider value + min = real value
	param8 = 0; // underlying parameter has constant value 0.
	param8 = param8 & 0x0f;
	superval[currentPos]= superval[currentPos]&0x0f;
	superval[currentPos]= superval[currentPos]|(param8<<4);
// gen_BuildFunc_SetSuperVals 
	@P_FSG_80_0_0_14_9_range = round(@P_FSG_80_0_0_14_9 + (0), 1.0); // slider value + min = real value
	param9 = round( (@P_FSG_80_0_0_14_9 + (0) - (0)) / (1.0), 1.0); // (slider value + min - offset) / step = busvalue
	param9 = param9 & 0x0f;
	superval[currentPos]= superval[currentPos]&0xf0;
	superval[currentPos]= superval[currentPos]|param9;
	currentPos++;
// gen_BuildFunc_SetSuperVals 
	getValue(P_FSG_80_0_0_14_10, param10);
	len10 = getValue(P_FSG_80_0_0_14_10_len);
	cnt10= getValue(P_FSG_80_0_0_14_10_cnt);
	
	/* check box aktiviert*/
	if (cnt10 == 1)
	{
		/* 0 bis 60 (MaxString - 1B oder 2B) */
		if(len10 >= 0 && len10 <= 60)
		{
			//writelineEx(gBAP_Trace, 0, "[Debug-1] Len10: %d", len10);
			superval[currentPos] = (len10&0x7f00) | 0x80;
			superval[currentPos+1] = len10 & 0x00ff;
		}
		else
		{
			writelineEx(gBAP_Trace, 0, "Eingegebene Laenge: %d von P_FSG_80_0_0_14_10 ist ungueltig. Die max. erlaubte Laenge ist %d.", len10, 60);
			return;
		}
	}
	else if(cnt10 == 0) /*check box deaktiviert*/
	{
		if(len10 >= 0 && len10 <= 127)
		{
			//writelineEx(gBAP_Trace, 0, "[Debug-1] Len10: %d", len10);
			superval[currentPos]= len10 & 0x00ff;
			putValue(P_FSG_80_0_0_14_10_len, len10);
		}
		else if(len10 > 127 && len10 <= 60)
		{
			superval[currentPos] = (len10&0x7f00) | 0x80;
			superval[currentPos+1] = len10 & 0x00ff;
			putValue(P_FSG_80_0_0_14_10_len, len10);
			putValue(P_FSG_80_0_0_14_10_cnt, 1);
		}
		else
		{
			writelineEx(gBAP_Trace, 0, "Eingegebene Laenge: %d von P_FSG_80_0_0_14_10 ist ungueltig. Die max. erlaubte Laenge ist %d.", len10, 60);
			return;
		}
	}
	currentPos += cnt10+1;
	for(i = 0; i < len10; i++)
	{
		superval[currentPos++]= param10[i];
	}

// gen_BuildFunc_SetSuperVals 
	@P_FSG_80_0_0_14_11_range = round(@P_FSG_80_0_0_14_11 + (0), 1.0); // slider value + min = real value
	param11 = 0; // underlying parameter has constant value 0.
	superval[currentPos++]=param11;
// gen_BuildFunc_SetSuperVals 
	@P_FSG_80_0_0_14_12_range = round(@P_FSG_80_0_0_14_12 + (0), 1.0); // slider value + min = real value
	param12 = 0; // underlying parameter has constant value 0.
	superval[currentPos++]=param12;
	putValue(P_FSG_80_0_0_14, superval, currentPos);
}


on envVar P_FSG_80_0_0_14_1_0
{
	byte bitval;
	//thisval steht hier fuer den bitfield-wert, 
	//aus Generierungsgruenden hier keine einheitliche Bezeichnung moeglich.
	byte thisval; // AvailableToneSettings
	bitval= getValue(this);
	thisval = getValue(P_FSG_80_0_0_14_1);
	thisval = thisval&~(1<<0)|(bitval<<0);
	putValue(P_FSG_80_0_0_14_1,thisval);
}

on envVar P_FSG_80_0_0_14_1_1
{
	byte bitval;
	//thisval steht hier fuer den bitfield-wert, 
	//aus Generierungsgruenden hier keine einheitliche Bezeichnung moeglich.
	byte thisval; // AvailableToneSettings
	bitval= getValue(this);
	thisval = getValue(P_FSG_80_0_0_14_1);
	thisval = thisval&~(1<<1)|(bitval<<1);
	putValue(P_FSG_80_0_0_14_1,thisval);
}

on envVar P_FSG_80_0_0_14_1_2
{
	byte bitval;
	//thisval steht hier fuer den bitfield-wert, 
	//aus Generierungsgruenden hier keine einheitliche Bezeichnung moeglich.
	byte thisval; // AvailableToneSettings
	bitval= getValue(this);
	thisval = getValue(P_FSG_80_0_0_14_1);
	thisval = thisval&~(1<<2)|(bitval<<2);
	putValue(P_FSG_80_0_0_14_1,thisval);
}

on envVar P_FSG_80_0_0_14_1 // FSG_Setup.AvailableToneSettings
{
	P_FSG_80_0_0_14_BuildFct();
}

on envVar P_FSG_80_0_0_14_2_0
{
	byte bitval;
	//thisval steht hier fuer den bitfield-wert, 
	//aus Generierungsgruenden hier keine einheitliche Bezeichnung moeglich.
	byte thisval; // AvailableSoundSettings
	bitval= getValue(this);
	thisval = getValue(P_FSG_80_0_0_14_2);
	thisval = thisval&~(1<<0)|(bitval<<0);
	putValue(P_FSG_80_0_0_14_2,thisval);
}

on envVar P_FSG_80_0_0_14_2_1
{
	byte bitval;
	//thisval steht hier fuer den bitfield-wert, 
	//aus Generierungsgruenden hier keine einheitliche Bezeichnung moeglich.
	byte thisval; // AvailableSoundSettings
	bitval= getValue(this);
	thisval = getValue(P_FSG_80_0_0_14_2);
	thisval = thisval&~(1<<1)|(bitval<<1);
	putValue(P_FSG_80_0_0_14_2,thisval);
}

on envVar P_FSG_80_0_0_14_2_2
{
	byte bitval;
	//thisval steht hier fuer den bitfield-wert, 
	//aus Generierungsgruenden hier keine einheitliche Bezeichnung moeglich.
	byte thisval; // AvailableSoundSettings
	bitval= getValue(this);
	thisval = getValue(P_FSG_80_0_0_14_2);
	thisval = thisval&~(1<<2)|(bitval<<2);
	putValue(P_FSG_80_0_0_14_2,thisval);
}

on envVar P_FSG_80_0_0_14_2_3
{
	byte bitval;
	//thisval steht hier fuer den bitfield-wert, 
	//aus Generierungsgruenden hier keine einheitliche Bezeichnung moeglich.
	byte thisval; // AvailableSoundSettings
	bitval= getValue(this);
	thisval = getValue(P_FSG_80_0_0_14_2);
	thisval = thisval&~(1<<3)|(bitval<<3);
	putValue(P_FSG_80_0_0_14_2,thisval);
}

on envVar P_FSG_80_0_0_14_2 // FSG_Setup.AvailableSoundSettings
{
	P_FSG_80_0_0_14_BuildFct();
}

// Ueberwachung der Darstellungsvariable der Range.
on envVar P_FSG_80_0_0_14_3_range // FSG_Setup.maxVolume 
{
	@P_FSG_80_0_0_14_3 = @P_FSG_80_0_0_14_3_range - (0); // slider = range - min
}

on envVar P_FSG_80_0_0_14_3 // FSG_Setup.maxVolume
{
	P_FSG_80_0_0_14_BuildFct();
}

// Ueberwachung der Darstellungsvariable der Range.
on envVar P_FSG_80_0_0_14_4_range // FSG_Setup.maxRadioFavorites 
{
	@P_FSG_80_0_0_14_4 = @P_FSG_80_0_0_14_4_range - (0); // slider = range - min
}

on envVar P_FSG_80_0_0_14_4 // FSG_Setup.maxRadioFavorites
{
	P_FSG_80_0_0_14_BuildFct();
}

// Ueberwachung der Darstellungsvariable der Range.
on envVar P_FSG_80_0_0_14_5_range // FSG_Setup.StepsTreble 
{
	@P_FSG_80_0_0_14_5 = @P_FSG_80_0_0_14_5_range - (0); // slider = range - min
}

on envVar P_FSG_80_0_0_14_5 // FSG_Setup.StepsTreble
{
	P_FSG_80_0_0_14_BuildFct();
}

// Ueberwachung der Darstellungsvariable der Range.
on envVar P_FSG_80_0_0_14_6_range // FSG_Setup.StepsBass 
{
	@P_FSG_80_0_0_14_6 = @P_FSG_80_0_0_14_6_range - (0); // slider = range - min
}

on envVar P_FSG_80_0_0_14_6 // FSG_Setup.StepsBass
{
	P_FSG_80_0_0_14_BuildFct();
}

// Ueberwachung der Darstellungsvariable der Range.
on envVar P_FSG_80_0_0_14_7_range // FSG_Setup.StepsBalance 
{
	@P_FSG_80_0_0_14_7 = @P_FSG_80_0_0_14_7_range - (0); // slider = range - min
}

on envVar P_FSG_80_0_0_14_7 // FSG_Setup.StepsBalance
{
	P_FSG_80_0_0_14_BuildFct();
}

// Ueberwachung der Darstellungsvariable der Range.
on envVar P_FSG_80_0_0_14_8_range // FSG_Setup.Extension1 
{
	@P_FSG_80_0_0_14_8 = @P_FSG_80_0_0_14_8_range - (0); // slider = range - min
}

on envVar P_FSG_80_0_0_14_8 // FSG_Setup.Extension1
{
	P_FSG_80_0_0_14_BuildFct();
}

// Ueberwachung der Darstellungsvariable der Range.
on envVar P_FSG_80_0_0_14_9_range // FSG_Setup.StepsGALA 
{
	@P_FSG_80_0_0_14_9 = @P_FSG_80_0_0_14_9_range - (0); // slider = range - min
}

on envVar P_FSG_80_0_0_14_9 // FSG_Setup.StepsGALA
{
	P_FSG_80_0_0_14_BuildFct();
}


// Ueberwachung der CheckBox fuer String
on envVar  P_FSG_80_0_0_14_10_cnt
{
	word len;
	byte cnt;
	len = getValue(P_FSG_80_0_0_14_10_len);
	cnt = getValue(P_FSG_80_0_0_14_10_cnt);

	/* wird nur gerufen, wenn check box deaktiviert mit Length>127*/ 
	if( cnt == 0) 
	{
		if(len > 127 )
		{
			putValue(P_FSG_80_0_0_14_10_len, 127);
		}
	}

	P_FSG_80_0_0_14_BuildFct();
}



// Ueberwachung der Eingabefeld fuer String Data
on envVar P_FSG_80_0_0_14_10_len
{
	word len;
	len = getValue(this);
	/* Validierung der Eingabe*/
	if(len > 60)
	{
		writelineEx(gBAP_Trace, 0, "Eingegebene Laenge: %d von P_FSG_80_0_0_14_10 ist ungueltig. Die max. erlaubte Laenge ist %d. ", len, 60);
		putValue(this, 60);
	}
	P_FSG_80_0_0_14_BuildFct();
}


on envVar P_FSG_80_0_0_14_10 // FSG_Setup.BTNodeName
{
	putValue(P_FSG_80_0_0_14_10_len, getValueSize(this));
	P_FSG_80_0_0_14_BuildFct();
}

// Ueberwachung der Darstellungsvariable der Range.
on envVar P_FSG_80_0_0_14_11_range // FSG_Setup.Extension2 
{
	@P_FSG_80_0_0_14_11 = @P_FSG_80_0_0_14_11_range - (0); // slider = range - min
}

on envVar P_FSG_80_0_0_14_11 // FSG_Setup.Extension2
{
	P_FSG_80_0_0_14_BuildFct();
}

// Ueberwachung der Darstellungsvariable der Range.
on envVar P_FSG_80_0_0_14_12_range // FSG_Setup.Extension3 
{
	@P_FSG_80_0_0_14_12 = @P_FSG_80_0_0_14_12_range - (0); // slider = range - min
}

on envVar P_FSG_80_0_0_14_12 // FSG_Setup.Extension3
{
	P_FSG_80_0_0_14_BuildFct();
}

// Ruecksetzen des Fehlerstatus durch manuelle Fehlereingabe
on envVar P_FSG_80_0_0_15_ErrCode
{
       if(gP_FSG_80_0_0_15_ErrCode) 
       {
           setControlBackColor(panel_name,"errfield_P_FSG_80_0_0_15", MakeRGB(255,255,255));
       }
       gP_FSG_80_0_0_15_ErrCode = 1;
}
on envVar P_FSG_80_0_0_15Status_BTN
{
	byte BAPTemp[6];
   if (P_FSG_80_0_0_15Status_BTN_already_pressed == 0)
   {
      putValue(P_FSG_80_0_0_15_ErrCode,0);
      SetControlBackColor(panel_name,"errField_P_FSG_80_0_0_15",MakeRGB(255,255,255));
      P_FSG_80_0_0_15Status_BTN_already_pressed = 1;
   }
   else
   {
      getValue(P_FSG_80_0_0_15, BAPTemp);
      Request_ByteSequence(LSGID, P_FSG_80_0_0_15_ID, Data_REQ, BAPTemp, getValueSize(P_FSG_80_0_0_15));
      P_FSG_80_0_0_15Status_BTN_already_pressed = 0;
   }
}
on envVar P_FSG_80_0_0_15_FctEn
{
    long data[3];
    data[0]=LSGID;
    data[1]=P_FSG_80_0_0_15_ID;
    data[2]=getValue(P_FSG_80_0_0_15_FctEn);
    ChangeConfig(0x0031,data);
}
// De-Aktivierung der Eingabefelder der FCTID P_FSG_80_0_0_15
on envVar P_FSG_80_0_0_15_FctLstItemEn
{
       if(getValue(this)) 
       {
           EnableControl(panel_name,"panel_FSG_80_0_0_15",1);
           EnableControl(panel_name,"errfield_P_FSG_80_0_0_15",1);
           EnableControl(panel_name,"panel_P_FSG_80_0_0_15",1);
           setControlForeColor(panel_name, "checkbox_P_FSG_80_0_0_15", MakeRGB(0,240,0));
       }
       else
       {
           EnableControl(panel_name,"panel_FSG_80_0_0_15",0);
           EnableControl(panel_name,"errfield_P_FSG_80_0_0_15",0);
           EnableControl(panel_name,"panel_P_FSG_80_0_0_15",0);
           setControlForeColor(panel_name, "checkbox_P_FSG_80_0_0_15", MakeRGB(250,0,0));
       }
}
on envVar P_FSG_80_0_0_15 // bus value of FSG_OperationState (15).
{
	// opcodes: Error-Status
	byte param1; // OP_State
	byte param2; // GlobalErrorState
	byte param3; // Extension1
	byte param4; // Extension2
	byte param5; // Extension3
	byte param6; // Extension4
	// DATATYPE_BYTESEQUENCE / DATATYPE_FIXEDBYTESEQUENCE
	int i;
	byte superval[6];
	int currentPos;
	currentPos = 0;
	for( i = 0; i < 6; i++ ) {
		superval[i] = 0;
	}
	getValue(P_FSG_80_0_0_15, superval);
	///////// Start param1 - UINT8 /////////
	param1 = superval[currentPos++];
	putValue(P_FSG_80_0_0_15_1, param1);
	///////// Start param2 - UINT8 /////////
	param2 = superval[currentPos++];
	putValue(P_FSG_80_0_0_15_2, param2);
	///////// Start param3 - UINT8 /////////
	param3 = superval[currentPos++];
	putValue(P_FSG_80_0_0_15_3, round((param3 * 1.0) - (0) + (0), 1.0));
	///////// Start param4 - UINT8 /////////
	param4 = superval[currentPos++];
	putValue(P_FSG_80_0_0_15_4, round((param4 * 1.0) - (0) + (0), 1.0));
	///////// Start param5 - UINT8 /////////
	param5 = superval[currentPos++];
	putValue(P_FSG_80_0_0_15_5, round((param5 * 1.0) - (0) + (0), 1.0));
	///////// Start param6 - UINT8 /////////
	param6 = superval[currentPos++];
	putValue(P_FSG_80_0_0_15_6, round((param6 * 1.0) - (0) + (0), 1.0));
}

on envVar P_FSG_80_0_0_15_1 // FSG_OperationState.OP_State
{
	byte superval[6];

	//Update Childvalue (Enum)
	byte thisval; // OP_State
	thisval = getValue(this);

    // Update superval
	getValue(P_FSG_80_0_0_15, superval);
	superval[0]=thisval;
	putValue(P_FSG_80_0_0_15,superval);
}

on envVar P_FSG_80_0_0_15_2 // FSG_OperationState.GlobalErrorState
{
	byte superval[6];

	//Update Childvalue (Enum)
	byte thisval; // GlobalErrorState
	thisval = getValue(this);

    // Update superval
	getValue(P_FSG_80_0_0_15, superval);
	superval[1]=thisval;
	putValue(P_FSG_80_0_0_15,superval);
}

// Ueberwachung der Darstellungsvariable der Range.
on envVar P_FSG_80_0_0_15_3_range // FSG_OperationState.Extension1 
{
	@P_FSG_80_0_0_15_3 = @P_FSG_80_0_0_15_3_range - (0); // slider = range - min
}

on envVar P_FSG_80_0_0_15_3 // FSG_OperationState.Extension1
{
	byte superval[6];

	//Update Childvalue (Number)
	byte thisval; // Extension1
	float slider_value;

	slider_value = 0; // Konstanter Parameter.
	@P_FSG_80_0_0_15_3_range = slider_value + (0); // real value := slider value + range min.
	thisval = (byte)round((slider_value + (0) - (0)) / (1.0), 1); // bus value := (slider value + min - offset) / step.

    // Update superval
	getValue(P_FSG_80_0_0_15, superval);
	superval[2]=thisval;
	putValue(P_FSG_80_0_0_15,superval);
}

// Ueberwachung der Darstellungsvariable der Range.
on envVar P_FSG_80_0_0_15_4_range // FSG_OperationState.Extension2 
{
	@P_FSG_80_0_0_15_4 = @P_FSG_80_0_0_15_4_range - (0); // slider = range - min
}

on envVar P_FSG_80_0_0_15_4 // FSG_OperationState.Extension2
{
	byte superval[6];

	//Update Childvalue (Number)
	byte thisval; // Extension2
	float slider_value;

	slider_value = 0; // Konstanter Parameter.
	@P_FSG_80_0_0_15_4_range = slider_value + (0); // real value := slider value + range min.
	thisval = (byte)round((slider_value + (0) - (0)) / (1.0), 1); // bus value := (slider value + min - offset) / step.

    // Update superval
	getValue(P_FSG_80_0_0_15, superval);
	superval[3]=thisval;
	putValue(P_FSG_80_0_0_15,superval);
}

// Ueberwachung der Darstellungsvariable der Range.
on envVar P_FSG_80_0_0_15_5_range // FSG_OperationState.Extension3 
{
	@P_FSG_80_0_0_15_5 = @P_FSG_80_0_0_15_5_range - (0); // slider = range - min
}

on envVar P_FSG_80_0_0_15_5 // FSG_OperationState.Extension3
{
	byte superval[6];

	//Update Childvalue (Number)
	byte thisval; // Extension3
	float slider_value;

	slider_value = 0; // Konstanter Parameter.
	@P_FSG_80_0_0_15_5_range = slider_value + (0); // real value := slider value + range min.
	thisval = (byte)round((slider_value + (0) - (0)) / (1.0), 1); // bus value := (slider value + min - offset) / step.

    // Update superval
	getValue(P_FSG_80_0_0_15, superval);
	superval[4]=thisval;
	putValue(P_FSG_80_0_0_15,superval);
}

// Ueberwachung der Darstellungsvariable der Range.
on envVar P_FSG_80_0_0_15_6_range // FSG_OperationState.Extension4 
{
	@P_FSG_80_0_0_15_6 = @P_FSG_80_0_0_15_6_range - (0); // slider = range - min
}

on envVar P_FSG_80_0_0_15_6 // FSG_OperationState.Extension4
{
	byte superval[6];

	//Update Childvalue (Number)
	byte thisval; // Extension4
	float slider_value;

	slider_value = 0; // Konstanter Parameter.
	@P_FSG_80_0_0_15_6_range = slider_value + (0); // real value := slider value + range min.
	thisval = (byte)round((slider_value + (0) - (0)) / (1.0), 1); // bus value := (slider value + min - offset) / step.

    // Update superval
	getValue(P_FSG_80_0_0_15, superval);
	superval[5]=thisval;
	putValue(P_FSG_80_0_0_15,superval);
}

// Ruecksetzen des Fehlerstatus durch manuelle Fehlereingabe
on envVar M_FSG_80_0_0_16_ErrCode
{
       if(gM_FSG_80_0_0_16_ErrCode) 
       {
           setControlBackColor(panel_name,"errfield_M_FSG_80_0_0_16", MakeRGB(255,255,255));
       }
       gM_FSG_80_0_0_16_ErrCode = 1;
}
on envVar M_FSG_80_0_0_16Result_BTN
{
    byte temp[2];
    if (M_FSG_80_0_0_16Result_BTN_already_pressed == 0)
    {
        putValue(M_FSG_80_0_0_16_ErrCode,0);
        SetControlBackColor(panel_name,"errField_M_FSG_80_0_0_16",MakeRGB(255,255,255));
        M_FSG_80_0_0_16Result_BTN_already_pressed = 1;
    }
    else
    {
        putValue(M_FSG_80_0_0_16_State, "Result");
        getValue(M_FSG_80_0_0_16_Result, temp);
        Request_ByteSequence(LSGID, M_FSG_80_0_0_16_ID, Result_REQ, temp, getValueSize(M_FSG_80_0_0_16_Result));
        M_FSG_80_0_0_16Result_BTN_already_pressed = 0;
    }
}
on envVar M_FSG_80_0_0_16_FctEn
{
    long data[3];
    data[0]=LSGID;
    data[1]=M_FSG_80_0_0_16_ID;
    data[2]=getValue(M_FSG_80_0_0_16_FctEn);
    ChangeConfig(0x0031,data);
}
// De-Aktivierung der Eingabefelder der FCTID M_FSG_80_0_0_16
on envVar M_FSG_80_0_0_16_FctLstItemEn
{
       if(getValue(this)) 
       {
           EnableControl(panel_name,"panel_FSG_80_0_0_16",1);
           EnableControl(panel_name,"errfield_M_FSG_80_0_0_16",1);
           EnableControl(panel_name,"panel_M_FSG_80_0_0_16",1);
           EnableControl(panel_name,"panel_M_FSG_80_0_0_16_Processing",1);
           EnableControl(panel_name,"panel_M_FSG_80_0_0_16_Start",1);
           setControlForeColor(panel_name, "checkbox_M_FSG_80_0_0_16", MakeRGB(0,240,0));
       }
       else
       {
           EnableControl(panel_name,"panel_FSG_80_0_0_16",0);
           EnableControl(panel_name,"errfield_M_FSG_80_0_0_16",0);
           EnableControl(panel_name,"panel_M_FSG_80_0_0_16",0);
           EnableControl(panel_name,"panel_M_FSG_80_0_0_16_Processing",0);
           EnableControl(panel_name,"panel_M_FSG_80_0_0_16_Start",0);
           setControlForeColor(panel_name, "checkbox_M_FSG_80_0_0_16", MakeRGB(250,0,0));
       }
}
on envVar M_FSG_80_0_0_16_Result // bus value of ResetFactorySettings (16).
{
	// opcodes: Error-Processing-Result
	byte param1; // ASG_ID
	byte param2; // CommandType
	byte param3; // ResetFactorySettings_Result
	// DATATYPE_BYTESEQUENCE / DATATYPE_FIXEDBYTESEQUENCE
	int i;
	byte superval[2];
	int currentPos;
	currentPos = 0;
	for( i = 0; i < 2; i++ ) {
		superval[i] = 0;
	}
	getValue(M_FSG_80_0_0_16_Result, superval);
	///////// Start param1 - NIBBLE /////////
	param1 = (superval[currentPos] & 0xf0)>>4;
	putValue(M_FSG_80_0_0_16_Result_1, param1);
	///////// Start param2 - NIBBLE /////////
	param2 = superval[currentPos++] & 0x0f;
	putValue(M_FSG_80_0_0_16_Result_2, param2);
	///////// Start param3 - UINT8 /////////
	param3 = superval[currentPos++];
	putValue(M_FSG_80_0_0_16_Result_3, param3);
}

on envVar M_FSG_80_0_0_16_Result_1 // ResetFactorySettings.ASG_ID
{
	byte superval[2];

	//Update Childvalue (Enum)
	byte thisval; // ASG_ID
	thisval = 0x0f & getValue(this);

    // Update superval
	getValue(M_FSG_80_0_0_16_Result, superval);
	superval[0]= superval[0]&0x0f;
	superval[0]= superval[0]|(thisval<<4);
	putValue(M_FSG_80_0_0_16_Result,superval);
}

on envVar M_FSG_80_0_0_16_Result_2 // ResetFactorySettings.CommandType
{
	byte superval[2];

	//Update Childvalue (Enum)
	byte thisval; // CommandType
	thisval = 0x0f & getValue(this);

    // Update superval
	getValue(M_FSG_80_0_0_16_Result, superval);
	superval[0]= superval[0]&0xf0;
	superval[0]= superval[0]|thisval;
	putValue(M_FSG_80_0_0_16_Result,superval);
}

on envVar M_FSG_80_0_0_16_Result_3 // ResetFactorySettings.ResetFactorySettings_Result
{
	byte superval[2];

	//Update Childvalue (Enum)
	byte thisval; // ResetFactorySettings_Result
	thisval = getValue(this);

    // Update superval
	getValue(M_FSG_80_0_0_16_Result, superval);
	superval[1]=thisval;
	putValue(M_FSG_80_0_0_16_Result,superval);
}

on envVar M_FSG_80_0_0_16_Processing // bus value of ResetFactorySettings (16).
{
	// opcodes: Error-Processing-Result
	byte param1; // ASG_ID
	byte param2; // CommandType
	byte param3; // Reserve
	// DATATYPE_BYTESEQUENCE / DATATYPE_FIXEDBYTESEQUENCE
	int i;
	byte superval[2];
	int currentPos;
	currentPos = 0;
	for( i = 0; i < 2; i++ ) {
		superval[i] = 0;
	}
	getValue(M_FSG_80_0_0_16_Processing, superval);
	///////// Start param1 - NIBBLE /////////
	param1 = (superval[currentPos] & 0xf0)>>4;
	putValue(M_FSG_80_0_0_16_Processing_1, param1);
	///////// Start param2 - NIBBLE /////////
	param2 = superval[currentPos++] & 0x0f;
	putValue(M_FSG_80_0_0_16_Processing_2, param2);
	///////// Start param3 - UINT8 /////////
	param3 = superval[currentPos++];
	putValue(M_FSG_80_0_0_16_Processing_3, round((param3 * 1.0) - (0) + (0), 1.0));
}

on envVar M_FSG_80_0_0_16_Processing_1 // ResetFactorySettings.ASG_ID
{
	byte superval[2];

	//Update Childvalue (Enum)
	byte thisval; // ASG_ID
	thisval = 0x0f & getValue(this);

    // Update superval
	getValue(M_FSG_80_0_0_16_Processing, superval);
	superval[0]= superval[0]&0x0f;
	superval[0]= superval[0]|(thisval<<4);
	putValue(M_FSG_80_0_0_16_Processing,superval);
}

on envVar M_FSG_80_0_0_16_Processing_2 // ResetFactorySettings.CommandType
{
	byte superval[2];

	//Update Childvalue (Enum)
	byte thisval; // CommandType
	thisval = 0x0f & getValue(this);

    // Update superval
	getValue(M_FSG_80_0_0_16_Processing, superval);
	superval[0]= superval[0]&0xf0;
	superval[0]= superval[0]|thisval;
	putValue(M_FSG_80_0_0_16_Processing,superval);
}

// Ueberwachung der Darstellungsvariable der Range.
on envVar M_FSG_80_0_0_16_Processing_3_range // ResetFactorySettings.Reserve 
{
	@M_FSG_80_0_0_16_Processing_3 = @M_FSG_80_0_0_16_Processing_3_range - (0); // slider = range - min
}

on envVar M_FSG_80_0_0_16_Processing_3 // ResetFactorySettings.Reserve
{
	byte superval[2];

	//Update Childvalue (Number)
	byte thisval; // Reserve
	float slider_value;

	slider_value = 0; // Konstanter Parameter.
	@M_FSG_80_0_0_16_Processing_3_range = slider_value + (0); // real value := slider value + range min.
	thisval = (byte)round((slider_value + (0) - (0)) / (1.0), 1); // bus value := (slider value + min - offset) / step.

    // Update superval
	getValue(M_FSG_80_0_0_16_Processing, superval);
	superval[1]=thisval;
	putValue(M_FSG_80_0_0_16_Processing,superval);
}

on envVar M_FSG_80_0_0_16_Start // bus value of ResetFactorySettings (16).
{
	// opcodes: AbortResult-StartResult
	byte param1; // ASG_ID
	byte param2; // CommandType
	byte param3; // Extension1
	byte param4; // Extension2
	// DATATYPE_BYTESEQUENCE / DATATYPE_FIXEDBYTESEQUENCE
	int i;
	byte superval[3];
	int currentPos;
	currentPos = 0;
	for( i = 0; i < 3; i++ ) {
		superval[i] = 0;
	}
	getValue(M_FSG_80_0_0_16_Start, superval);
	///////// Start param1 - NIBBLE /////////
	param1 = (superval[currentPos] & 0xf0)>>4;
	putValue(M_FSG_80_0_0_16_Start_1, param1);
	///////// Start param2 - NIBBLE /////////
	param2 = superval[currentPos++] & 0x0f;
	putValue(M_FSG_80_0_0_16_Start_2, param2);
	///////// Start param3 - UINT8 /////////
	param3 = superval[currentPos++];
	putValue(M_FSG_80_0_0_16_Start_3, round((param3 * 1.0) - (0) + (0), 1.0));
	///////// Start param4 - UINT8 /////////
	param4 = superval[currentPos++];
	putValue(M_FSG_80_0_0_16_Start_4, round((param4 * 1.0) - (0) + (0), 1.0));
}

on envVar M_FSG_80_0_0_16_Start_1 // ResetFactorySettings.ASG_ID
{
	byte superval[3];

	//Update Childvalue (Enum)
	byte thisval; // ASG_ID
	thisval = 0x0f & getValue(this);

    // Update superval
	getValue(M_FSG_80_0_0_16_Start, superval);
	superval[0]= superval[0]&0x0f;
	superval[0]= superval[0]|(thisval<<4);
	putValue(M_FSG_80_0_0_16_Start,superval);
}

on envVar M_FSG_80_0_0_16_Start_2 // ResetFactorySettings.CommandType
{
	byte superval[3];

	//Update Childvalue (Enum)
	byte thisval; // CommandType
	thisval = 0x0f & getValue(this);

    // Update superval
	getValue(M_FSG_80_0_0_16_Start, superval);
	superval[0]= superval[0]&0xf0;
	superval[0]= superval[0]|thisval;
	putValue(M_FSG_80_0_0_16_Start,superval);
}

// Ueberwachung der Darstellungsvariable der Range.
on envVar M_FSG_80_0_0_16_Start_3_range // ResetFactorySettings.Extension1 
{
	@M_FSG_80_0_0_16_Start_3 = @M_FSG_80_0_0_16_Start_3_range - (0); // slider = range - min
}

on envVar M_FSG_80_0_0_16_Start_3 // ResetFactorySettings.Extension1
{
	byte superval[3];

	//Update Childvalue (Number)
	byte thisval; // Extension1
	float slider_value;

	slider_value = 0; // Konstanter Parameter.
	@M_FSG_80_0_0_16_Start_3_range = slider_value + (0); // real value := slider value + range min.
	thisval = (byte)round((slider_value + (0) - (0)) / (1.0), 1); // bus value := (slider value + min - offset) / step.

    // Update superval
	getValue(M_FSG_80_0_0_16_Start, superval);
	superval[1]=thisval;
	putValue(M_FSG_80_0_0_16_Start,superval);
}

// Ueberwachung der Darstellungsvariable der Range.
on envVar M_FSG_80_0_0_16_Start_4_range // ResetFactorySettings.Extension2 
{
	@M_FSG_80_0_0_16_Start_4 = @M_FSG_80_0_0_16_Start_4_range - (0); // slider = range - min
}

on envVar M_FSG_80_0_0_16_Start_4 // ResetFactorySettings.Extension2
{
	byte superval[3];

	//Update Childvalue (Number)
	byte thisval; // Extension2
	float slider_value;

	slider_value = 0; // Konstanter Parameter.
	@M_FSG_80_0_0_16_Start_4_range = slider_value + (0); // real value := slider value + range min.
	thisval = (byte)round((slider_value + (0) - (0)) / (1.0), 1); // bus value := (slider value + min - offset) / step.

    // Update superval
	getValue(M_FSG_80_0_0_16_Start, superval);
	superval[2]=thisval;
	putValue(M_FSG_80_0_0_16_Start,superval);
}

// Ruecksetzen des Fehlerstatus durch manuelle Fehlereingabe
on envVar P_FSG_80_0_0_17_ErrCode
{
       if(gP_FSG_80_0_0_17_ErrCode) 
       {
           setControlBackColor(panel_name,"errfield_P_FSG_80_0_0_17", MakeRGB(255,255,255));
       }
       gP_FSG_80_0_0_17_ErrCode = 1;
}
on envVar P_FSG_80_0_0_17Status_BTN
{
	byte BAPTemp[6];
   if (P_FSG_80_0_0_17Status_BTN_already_pressed == 0)
   {
      putValue(P_FSG_80_0_0_17_ErrCode,0);
      SetControlBackColor(panel_name,"errField_P_FSG_80_0_0_17",MakeRGB(255,255,255));
      P_FSG_80_0_0_17Status_BTN_already_pressed = 1;
   }
   else
   {
      getValue(P_FSG_80_0_0_17, BAPTemp);
      Request_ByteSequence(LSGID, P_FSG_80_0_0_17_ID, Data_REQ, BAPTemp, getValueSize(P_FSG_80_0_0_17));
      P_FSG_80_0_0_17Status_BTN_already_pressed = 0;
   }
}
on envVar P_FSG_80_0_0_17_FctEn
{
    long data[3];
    data[0]=LSGID;
    data[1]=P_FSG_80_0_0_17_ID;
    data[2]=getValue(P_FSG_80_0_0_17_FctEn);
    ChangeConfig(0x0031,data);
}
// De-Aktivierung der Eingabefelder der FCTID P_FSG_80_0_0_17
on envVar P_FSG_80_0_0_17_FctLstItemEn
{
       if(getValue(this)) 
       {
           EnableControl(panel_name,"panel_FSG_80_0_0_17",1);
           EnableControl(panel_name,"errfield_P_FSG_80_0_0_17",1);
           EnableControl(panel_name,"panel_P_FSG_80_0_0_17",1);
           setControlForeColor(panel_name, "checkbox_P_FSG_80_0_0_17", MakeRGB(0,240,0));
       }
       else
       {
           EnableControl(panel_name,"panel_FSG_80_0_0_17",0);
           EnableControl(panel_name,"errfield_P_FSG_80_0_0_17",0);
           EnableControl(panel_name,"panel_P_FSG_80_0_0_17",0);
           setControlForeColor(panel_name, "checkbox_P_FSG_80_0_0_17", MakeRGB(250,0,0));
       }
}
on envVar P_FSG_80_0_0_17 // bus value of ToneVolume (17).
{
	// opcodes: Error-Status
	byte param1; // Extension1
	byte param2; // AudioSourceRequest
	byte param3; // VolumeAnnouncements
	byte param4; // ModificationReason_VolumeAnnouncements
	byte param5; // ModificationState_VolumeAnnouncements
	byte param6; // VolumeRingtone
	byte param7; // ModificationReason_VolumeRingtone
	byte param8; // ModificationState_VolumeRingtone
	byte param9; // Extension2
	// DATATYPE_BYTESEQUENCE / DATATYPE_FIXEDBYTESEQUENCE
	int i;
	byte superval[6];
	int currentPos;
	currentPos = 0;
	for( i = 0; i < 6; i++ ) {
		superval[i] = 0;
	}
	getValue(P_FSG_80_0_0_17, superval);
	///////// Start param1 - NIBBLE /////////
	param1 = (superval[currentPos] & 0xf0)>>4;
	putValue(P_FSG_80_0_0_17_1, round((param1 * 1.0) - (0) + (0), 1.0));
	///////// Start param2 - NIBBLE /////////
	param2 = superval[currentPos++] & 0x0f;
	putValue(P_FSG_80_0_0_17_2, param2);
	///////// Start param3 - UINT8 /////////
	param3 = superval[currentPos++];
	putValue(P_FSG_80_0_0_17_3, round((param3 * 1.0) - (0) + (0), 1.0));
	///////// Start param4 - NIBBLE /////////
	param4 = (superval[currentPos] & 0xf0)>>4;
	putValue(P_FSG_80_0_0_17_4, param4);
	///////// Start param5 - NIBBLE /////////
	param5 = superval[currentPos++] & 0x0f;
	putValue(P_FSG_80_0_0_17_5, param5);
	///////// Start param6 - UINT8 /////////
	param6 = superval[currentPos++];
	putValue(P_FSG_80_0_0_17_6, round((param6 * 1.0) - (0) + (0), 1.0));
	///////// Start param7 - NIBBLE /////////
	param7 = (superval[currentPos] & 0xf0)>>4;
	putValue(P_FSG_80_0_0_17_7, param7);
	///////// Start param8 - NIBBLE /////////
	param8 = superval[currentPos++] & 0x0f;
	putValue(P_FSG_80_0_0_17_8, param8);
	///////// Start param9 - UINT8 /////////
	param9 = superval[currentPos++];
	putValue(P_FSG_80_0_0_17_9, round((param9 * 1.0) - (0) + (0), 1.0));
}

// Ueberwachung der Darstellungsvariable der Range.
on envVar P_FSG_80_0_0_17_1_range // ToneVolume.Extension1 
{
	@P_FSG_80_0_0_17_1 = @P_FSG_80_0_0_17_1_range - (0); // slider = range - min
}

on envVar P_FSG_80_0_0_17_1 // ToneVolume.Extension1
{
	byte superval[6];

	//Update Childvalue (Number)
	byte thisval; // Extension1
	float slider_value;

	slider_value = 0; // Konstanter Parameter.
	@P_FSG_80_0_0_17_1_range = slider_value + (0); // real value := slider value + range min.
	thisval = (byte)round((slider_value + (0) - (0)) / (1.0), 1); // bus value := (slider value + min - offset) / step.

    // Update superval
	getValue(P_FSG_80_0_0_17, superval);
	superval[0]= superval[0]&0x0f;
	superval[0]= superval[0]|(thisval<<4);
	putValue(P_FSG_80_0_0_17,superval);
}

on envVar P_FSG_80_0_0_17_2 // ToneVolume.AudioSourceRequest
{
	byte superval[6];

	//Update Childvalue (Enum)
	byte thisval; // AudioSourceRequest
	thisval = 0x0f & getValue(this);

    // Update superval
	getValue(P_FSG_80_0_0_17, superval);
	superval[0]= superval[0]&0xf0;
	superval[0]= superval[0]|thisval;
	putValue(P_FSG_80_0_0_17,superval);
}

// Ueberwachung der Darstellungsvariable der Range.
on envVar P_FSG_80_0_0_17_3_range // ToneVolume.VolumeAnnouncements 
{
	@P_FSG_80_0_0_17_3 = @P_FSG_80_0_0_17_3_range - (0); // slider = range - min
}

on envVar P_FSG_80_0_0_17_3 // ToneVolume.VolumeAnnouncements
{
	byte superval[6];

	//Update Childvalue (Number)
	byte thisval; // VolumeAnnouncements
	float slider_value;

	slider_value = round(@P_FSG_80_0_0_17_3, 1.0);
	@P_FSG_80_0_0_17_3_range = slider_value + (0); // real value := slider value + range min.
	thisval = (byte)round((slider_value + (0) - (0)) / (1.0), 1); // bus value := (slider value + min - offset) / step.

    // Update superval
	getValue(P_FSG_80_0_0_17, superval);
	superval[1]=thisval;
	putValue(P_FSG_80_0_0_17,superval);
}

on envVar P_FSG_80_0_0_17_4 // ToneVolume.ModificationReason_VolumeAnnouncements
{
	byte superval[6];

	//Update Childvalue (Enum)
	byte thisval; // ModificationReason_VolumeAnnouncements
	thisval = 0x0f & getValue(this);

    // Update superval
	getValue(P_FSG_80_0_0_17, superval);
	superval[2]= superval[2]&0x0f;
	superval[2]= superval[2]|(thisval<<4);
	putValue(P_FSG_80_0_0_17,superval);
}

on envVar P_FSG_80_0_0_17_5_0
{
	byte bitval;
	//thisval steht hier fuer den bitfield-wert, 
	//aus Generierungsgruenden hier keine einheitliche Bezeichnung moeglich.
	byte thisval; // ModificationState_VolumeAnnouncements
	bitval= getValue(this);
	thisval = getValue(P_FSG_80_0_0_17_5);
	thisval = thisval&~(1<<0)|(bitval<<0);
	putValue(P_FSG_80_0_0_17_5,thisval);
}

on envVar P_FSG_80_0_0_17_5 // ToneVolume.ModificationState_VolumeAnnouncements
{
	byte superval[6];

	//Update Childvalue (BitField)
	byte mask=0x01;
	int i = 0;
	byte thisval; // ModificationState_VolumeAnnouncements
	thisval = getValue(this);
	if(thisval&(mask<<0))
		putValue(P_FSG_80_0_0_17_5_0, 1);
	else
		putValue(P_FSG_80_0_0_17_5_0, 0);

    // Update superval
	getValue(P_FSG_80_0_0_17, superval);
	superval[2]= superval[2]&0xf0;
	superval[2]= superval[2]|thisval;
	putValue(P_FSG_80_0_0_17,superval);
}

// Ueberwachung der Darstellungsvariable der Range.
on envVar P_FSG_80_0_0_17_6_range // ToneVolume.VolumeRingtone 
{
	@P_FSG_80_0_0_17_6 = @P_FSG_80_0_0_17_6_range - (0); // slider = range - min
}

on envVar P_FSG_80_0_0_17_6 // ToneVolume.VolumeRingtone
{
	byte superval[6];

	//Update Childvalue (Number)
	byte thisval; // VolumeRingtone
	float slider_value;

	slider_value = round(@P_FSG_80_0_0_17_6, 1.0);
	@P_FSG_80_0_0_17_6_range = slider_value + (0); // real value := slider value + range min.
	thisval = (byte)round((slider_value + (0) - (0)) / (1.0), 1); // bus value := (slider value + min - offset) / step.

    // Update superval
	getValue(P_FSG_80_0_0_17, superval);
	superval[3]=thisval;
	putValue(P_FSG_80_0_0_17,superval);
}

on envVar P_FSG_80_0_0_17_7 // ToneVolume.ModificationReason_VolumeRingtone
{
	byte superval[6];

	//Update Childvalue (Enum)
	byte thisval; // ModificationReason_VolumeRingtone
	thisval = 0x0f & getValue(this);

    // Update superval
	getValue(P_FSG_80_0_0_17, superval);
	superval[4]= superval[4]&0x0f;
	superval[4]= superval[4]|(thisval<<4);
	putValue(P_FSG_80_0_0_17,superval);
}

on envVar P_FSG_80_0_0_17_8_0
{
	byte bitval;
	//thisval steht hier fuer den bitfield-wert, 
	//aus Generierungsgruenden hier keine einheitliche Bezeichnung moeglich.
	byte thisval; // ModificationState_VolumeRingtone
	bitval= getValue(this);
	thisval = getValue(P_FSG_80_0_0_17_8);
	thisval = thisval&~(1<<0)|(bitval<<0);
	putValue(P_FSG_80_0_0_17_8,thisval);
}

on envVar P_FSG_80_0_0_17_8 // ToneVolume.ModificationState_VolumeRingtone
{
	byte superval[6];

	//Update Childvalue (BitField)
	byte mask=0x01;
	int i = 0;
	byte thisval; // ModificationState_VolumeRingtone
	thisval = getValue(this);
	if(thisval&(mask<<0))
		putValue(P_FSG_80_0_0_17_8_0, 1);
	else
		putValue(P_FSG_80_0_0_17_8_0, 0);

    // Update superval
	getValue(P_FSG_80_0_0_17, superval);
	superval[4]= superval[4]&0xf0;
	superval[4]= superval[4]|thisval;
	putValue(P_FSG_80_0_0_17,superval);
}

// Ueberwachung der Darstellungsvariable der Range.
on envVar P_FSG_80_0_0_17_9_range // ToneVolume.Extension2 
{
	@P_FSG_80_0_0_17_9 = @P_FSG_80_0_0_17_9_range - (0); // slider = range - min
}

on envVar P_FSG_80_0_0_17_9 // ToneVolume.Extension2
{
	byte superval[6];

	//Update Childvalue (Number)
	byte thisval; // Extension2
	float slider_value;

	slider_value = 0; // Konstanter Parameter.
	@P_FSG_80_0_0_17_9_range = slider_value + (0); // real value := slider value + range min.
	thisval = (byte)round((slider_value + (0) - (0)) / (1.0), 1); // bus value := (slider value + min - offset) / step.

    // Update superval
	getValue(P_FSG_80_0_0_17, superval);
	superval[5]=thisval;
	putValue(P_FSG_80_0_0_17,superval);
}

// Ruecksetzen des Fehlerstatus durch manuelle Fehlereingabe
on envVar P_FSG_80_0_0_18_ErrCode
{
       if(gP_FSG_80_0_0_18_ErrCode) 
       {
           setControlBackColor(panel_name,"errfield_P_FSG_80_0_0_18", MakeRGB(255,255,255));
       }
       gP_FSG_80_0_0_18_ErrCode = 1;
}
on envVar P_FSG_80_0_0_18Status_BTN
{
	byte BAPTemp[6];
   if (P_FSG_80_0_0_18Status_BTN_already_pressed == 0)
   {
      putValue(P_FSG_80_0_0_18_ErrCode,0);
      SetControlBackColor(panel_name,"errField_P_FSG_80_0_0_18",MakeRGB(255,255,255));
      P_FSG_80_0_0_18Status_BTN_already_pressed = 1;
   }
   else
   {
      getValue(P_FSG_80_0_0_18, BAPTemp);
      Request_ByteSequence(LSGID, P_FSG_80_0_0_18_ID, Data_REQ, BAPTemp, getValueSize(P_FSG_80_0_0_18));
      P_FSG_80_0_0_18Status_BTN_already_pressed = 0;
   }
}
on envVar P_FSG_80_0_0_18_FctEn
{
    long data[3];
    data[0]=LSGID;
    data[1]=P_FSG_80_0_0_18_ID;
    data[2]=getValue(P_FSG_80_0_0_18_FctEn);
    ChangeConfig(0x0031,data);
}
// De-Aktivierung der Eingabefelder der FCTID P_FSG_80_0_0_18
on envVar P_FSG_80_0_0_18_FctLstItemEn
{
       if(getValue(this)) 
       {
           EnableControl(panel_name,"panel_FSG_80_0_0_18",1);
           EnableControl(panel_name,"errfield_P_FSG_80_0_0_18",1);
           EnableControl(panel_name,"panel_P_FSG_80_0_0_18",1);
           setControlForeColor(panel_name, "checkbox_P_FSG_80_0_0_18", MakeRGB(0,240,0));
       }
       else
       {
           EnableControl(panel_name,"panel_FSG_80_0_0_18",0);
           EnableControl(panel_name,"errfield_P_FSG_80_0_0_18",0);
           EnableControl(panel_name,"panel_P_FSG_80_0_0_18",0);
           setControlForeColor(panel_name, "checkbox_P_FSG_80_0_0_18", MakeRGB(250,0,0));
       }
}
on envVar P_FSG_80_0_0_18 // bus value of ToneSettings (18).
{
	// opcodes: Error-Status
	byte param1; // EntertainmentFaderParking
	char param2; // MicrophoneInputLevel
	byte param3; // ModificationReason_MicrophoneInputLevel
	byte param4; // ModificationState_MicrophoneInputLevel
	byte param5; // Extension1
	byte param6; // Extension2
	byte param7; // Extension3
	byte param8; // Extension4
	// DATATYPE_BYTESEQUENCE / DATATYPE_FIXEDBYTESEQUENCE
	int i;
	byte superval[6];
	int currentPos;
	currentPos = 0;
	for( i = 0; i < 6; i++ ) {
		superval[i] = 0;
	}
	getValue(P_FSG_80_0_0_18, superval);
	///////// Start param1 - NIBBLE /////////
	param1 = (superval[currentPos] & 0xf0)>>4;
	putValue(P_FSG_80_0_0_18_1, param1);
	///////// Start param2 - NIBBLE /////////
	param2 = superval[currentPos++] & 0x0f;
	if (param2 & 0x08) {
		param2 |= 0xf0; 
	}
	putValue(P_FSG_80_0_0_18_2, round((param2 * 1.0) - (-7) + (0), 1.0));
	///////// Start param3 - NIBBLE /////////
	param3 = (superval[currentPos] & 0xf0)>>4;
	putValue(P_FSG_80_0_0_18_3, param3);
	///////// Start param4 - NIBBLE /////////
	param4 = superval[currentPos++] & 0x0f;
	putValue(P_FSG_80_0_0_18_4, param4);
	///////// Start param5 - UINT8 /////////
	param5 = superval[currentPos++];
	putValue(P_FSG_80_0_0_18_5, round((param5 * 1.0) - (0) + (0), 1.0));
	///////// Start param6 - UINT8 /////////
	param6 = superval[currentPos++];
	putValue(P_FSG_80_0_0_18_6, round((param6 * 1.0) - (0) + (0), 1.0));
	///////// Start param7 - UINT8 /////////
	param7 = superval[currentPos++];
	putValue(P_FSG_80_0_0_18_7, round((param7 * 1.0) - (0) + (0), 1.0));
	///////// Start param8 - UINT8 /////////
	param8 = superval[currentPos++];
	putValue(P_FSG_80_0_0_18_8, round((param8 * 1.0) - (0) + (0), 1.0));
}

on envVar P_FSG_80_0_0_18_1 // ToneSettings.EntertainmentFaderParking
{
	byte superval[6];

	//Update Childvalue (Enum)
	byte thisval; // EntertainmentFaderParking
	thisval = 0x0f & getValue(this);

    // Update superval
	getValue(P_FSG_80_0_0_18, superval);
	superval[0]= superval[0]&0x0f;
	superval[0]= superval[0]|(thisval<<4);
	putValue(P_FSG_80_0_0_18,superval);
}

// Ueberwachung der Darstellungsvariable der Range.
on envVar P_FSG_80_0_0_18_2_range // ToneSettings.MicrophoneInputLevel 
{
	@P_FSG_80_0_0_18_2 = @P_FSG_80_0_0_18_2_range - (-7); // slider = range - min
}

on envVar P_FSG_80_0_0_18_2 // ToneSettings.MicrophoneInputLevel
{
	byte superval[6];

	//Update Childvalue (Number)
	char thisval; // MicrophoneInputLevel
	float slider_value;

	slider_value = round(@P_FSG_80_0_0_18_2, 1.0);
	@P_FSG_80_0_0_18_2_range = slider_value + (-7); // real value := slider value + range min.
	thisval = (char)round((slider_value + (-7) - (0)) / (1.0), 1); // bus value := (slider value + min - offset) / step.

    // Update superval
	getValue(P_FSG_80_0_0_18, superval);
	superval[0]= superval[0]&0xf0;
	superval[0]= superval[0]|thisval;
	putValue(P_FSG_80_0_0_18,superval);
}

on envVar P_FSG_80_0_0_18_3 // ToneSettings.ModificationReason_MicrophoneInputLevel
{
	byte superval[6];

	//Update Childvalue (Enum)
	byte thisval; // ModificationReason_MicrophoneInputLevel
	thisval = 0x0f & getValue(this);

    // Update superval
	getValue(P_FSG_80_0_0_18, superval);
	superval[1]= superval[1]&0x0f;
	superval[1]= superval[1]|(thisval<<4);
	putValue(P_FSG_80_0_0_18,superval);
}

on envVar P_FSG_80_0_0_18_4_0
{
	byte bitval;
	//thisval steht hier fuer den bitfield-wert, 
	//aus Generierungsgruenden hier keine einheitliche Bezeichnung moeglich.
	byte thisval; // ModificationState_MicrophoneInputLevel
	bitval= getValue(this);
	thisval = getValue(P_FSG_80_0_0_18_4);
	thisval = thisval&~(1<<0)|(bitval<<0);
	putValue(P_FSG_80_0_0_18_4,thisval);
}

on envVar P_FSG_80_0_0_18_4 // ToneSettings.ModificationState_MicrophoneInputLevel
{
	byte superval[6];

	//Update Childvalue (BitField)
	byte mask=0x01;
	int i = 0;
	byte thisval; // ModificationState_MicrophoneInputLevel
	thisval = getValue(this);
	if(thisval&(mask<<0))
		putValue(P_FSG_80_0_0_18_4_0, 1);
	else
		putValue(P_FSG_80_0_0_18_4_0, 0);

    // Update superval
	getValue(P_FSG_80_0_0_18, superval);
	superval[1]= superval[1]&0xf0;
	superval[1]= superval[1]|thisval;
	putValue(P_FSG_80_0_0_18,superval);
}

// Ueberwachung der Darstellungsvariable der Range.
on envVar P_FSG_80_0_0_18_5_range // ToneSettings.Extension1 
{
	@P_FSG_80_0_0_18_5 = @P_FSG_80_0_0_18_5_range - (0); // slider = range - min
}

on envVar P_FSG_80_0_0_18_5 // ToneSettings.Extension1
{
	byte superval[6];

	//Update Childvalue (Number)
	byte thisval; // Extension1
	float slider_value;

	slider_value = 0; // Konstanter Parameter.
	@P_FSG_80_0_0_18_5_range = slider_value + (0); // real value := slider value + range min.
	thisval = (byte)round((slider_value + (0) - (0)) / (1.0), 1); // bus value := (slider value + min - offset) / step.

    // Update superval
	getValue(P_FSG_80_0_0_18, superval);
	superval[2]=thisval;
	putValue(P_FSG_80_0_0_18,superval);
}

// Ueberwachung der Darstellungsvariable der Range.
on envVar P_FSG_80_0_0_18_6_range // ToneSettings.Extension2 
{
	@P_FSG_80_0_0_18_6 = @P_FSG_80_0_0_18_6_range - (0); // slider = range - min
}

on envVar P_FSG_80_0_0_18_6 // ToneSettings.Extension2
{
	byte superval[6];

	//Update Childvalue (Number)
	byte thisval; // Extension2
	float slider_value;

	slider_value = 0; // Konstanter Parameter.
	@P_FSG_80_0_0_18_6_range = slider_value + (0); // real value := slider value + range min.
	thisval = (byte)round((slider_value + (0) - (0)) / (1.0), 1); // bus value := (slider value + min - offset) / step.

    // Update superval
	getValue(P_FSG_80_0_0_18, superval);
	superval[3]=thisval;
	putValue(P_FSG_80_0_0_18,superval);
}

// Ueberwachung der Darstellungsvariable der Range.
on envVar P_FSG_80_0_0_18_7_range // ToneSettings.Extension3 
{
	@P_FSG_80_0_0_18_7 = @P_FSG_80_0_0_18_7_range - (0); // slider = range - min
}

on envVar P_FSG_80_0_0_18_7 // ToneSettings.Extension3
{
	byte superval[6];

	//Update Childvalue (Number)
	byte thisval; // Extension3
	float slider_value;

	slider_value = 0; // Konstanter Parameter.
	@P_FSG_80_0_0_18_7_range = slider_value + (0); // real value := slider value + range min.
	thisval = (byte)round((slider_value + (0) - (0)) / (1.0), 1); // bus value := (slider value + min - offset) / step.

    // Update superval
	getValue(P_FSG_80_0_0_18, superval);
	superval[4]=thisval;
	putValue(P_FSG_80_0_0_18,superval);
}

// Ueberwachung der Darstellungsvariable der Range.
on envVar P_FSG_80_0_0_18_8_range // ToneSettings.Extension4 
{
	@P_FSG_80_0_0_18_8 = @P_FSG_80_0_0_18_8_range - (0); // slider = range - min
}

on envVar P_FSG_80_0_0_18_8 // ToneSettings.Extension4
{
	byte superval[6];

	//Update Childvalue (Number)
	byte thisval; // Extension4
	float slider_value;

	slider_value = 0; // Konstanter Parameter.
	@P_FSG_80_0_0_18_8_range = slider_value + (0); // real value := slider value + range min.
	thisval = (byte)round((slider_value + (0) - (0)) / (1.0), 1); // bus value := (slider value + min - offset) / step.

    // Update superval
	getValue(P_FSG_80_0_0_18, superval);
	superval[5]=thisval;
	putValue(P_FSG_80_0_0_18,superval);
}

// Ruecksetzen des Fehlerstatus durch manuelle Fehlereingabe
on envVar P_FSG_80_0_0_19_ErrCode
{
       if(gP_FSG_80_0_0_19_ErrCode) 
       {
           setControlBackColor(panel_name,"errfield_P_FSG_80_0_0_19", MakeRGB(255,255,255));
       }
       gP_FSG_80_0_0_19_ErrCode = 1;
}
on envVar P_FSG_80_0_0_19Status_BTN
{
	byte BAPTemp[6];
   if (P_FSG_80_0_0_19Status_BTN_already_pressed == 0)
   {
      putValue(P_FSG_80_0_0_19_ErrCode,0);
      SetControlBackColor(panel_name,"errField_P_FSG_80_0_0_19",MakeRGB(255,255,255));
      P_FSG_80_0_0_19Status_BTN_already_pressed = 1;
   }
   else
   {
      getValue(P_FSG_80_0_0_19, BAPTemp);
      Request_ByteSequence(LSGID, P_FSG_80_0_0_19_ID, Data_REQ, BAPTemp, getValueSize(P_FSG_80_0_0_19));
      P_FSG_80_0_0_19Status_BTN_already_pressed = 0;
   }
}
on envVar P_FSG_80_0_0_19_FctEn
{
    long data[3];
    data[0]=LSGID;
    data[1]=P_FSG_80_0_0_19_ID;
    data[2]=getValue(P_FSG_80_0_0_19_FctEn);
    ChangeConfig(0x0031,data);
}
// De-Aktivierung der Eingabefelder der FCTID P_FSG_80_0_0_19
on envVar P_FSG_80_0_0_19_FctLstItemEn
{
       if(getValue(this)) 
       {
           EnableControl(panel_name,"panel_FSG_80_0_0_19",1);
           EnableControl(panel_name,"errfield_P_FSG_80_0_0_19",1);
           EnableControl(panel_name,"panel_P_FSG_80_0_0_19",1);
           setControlForeColor(panel_name, "checkbox_P_FSG_80_0_0_19", MakeRGB(0,240,0));
       }
       else
       {
           EnableControl(panel_name,"panel_FSG_80_0_0_19",0);
           EnableControl(panel_name,"errfield_P_FSG_80_0_0_19",0);
           EnableControl(panel_name,"panel_P_FSG_80_0_0_19",0);
           setControlForeColor(panel_name, "checkbox_P_FSG_80_0_0_19", MakeRGB(250,0,0));
       }
}
on envVar P_FSG_80_0_0_19 // bus value of SoundSettings (19).
{
	// opcodes: Error-Status
	char param1; // Treble
	char param2; // Bass
	char param3; // Balance
	byte param4; // Extension1
	byte param5; // GALA
	byte param6; // Extension2
	byte param7; // ModificationReason_Sound
	byte param8; // ModificationState_Sound
	// DATATYPE_BYTESEQUENCE / DATATYPE_FIXEDBYTESEQUENCE
	int i;
	byte superval[6];
	int currentPos;
	currentPos = 0;
	for( i = 0; i < 6; i++ ) {
		superval[i] = 0;
	}
	getValue(P_FSG_80_0_0_19, superval);
	///////// Start param1 - UINT8 /////////
	param1 = superval[currentPos++];
	putValue(P_FSG_80_0_0_19_1, round((param1 * 1.0) - (-127) + (0), 1.0));
	///////// Start param2 - UINT8 /////////
	param2 = superval[currentPos++];
	putValue(P_FSG_80_0_0_19_2, round((param2 * 1.0) - (-127) + (0), 1.0));
	///////// Start param3 - UINT8 /////////
	param3 = superval[currentPos++];
	putValue(P_FSG_80_0_0_19_3, round((param3 * 1.0) - (-127) + (0), 1.0));
	///////// Start param4 - NIBBLE /////////
	param4 = (superval[currentPos] & 0xf0)>>4;
	putValue(P_FSG_80_0_0_19_4, round((param4 * 1.0) - (0) + (0), 1.0));
	///////// Start param5 - NIBBLE /////////
	param5 = superval[currentPos++] & 0x0f;
	putValue(P_FSG_80_0_0_19_5, round((param5 * 1.0) - (0) + (0), 1.0));
	///////// Start param6 - UINT8 /////////
	param6 = superval[currentPos++];
	putValue(P_FSG_80_0_0_19_6, round((param6 * 1.0) - (0) + (0), 1.0));
	///////// Start param7 - NIBBLE /////////
	param7 = (superval[currentPos] & 0xf0)>>4;
	putValue(P_FSG_80_0_0_19_7, param7);
	///////// Start param8 - NIBBLE /////////
	param8 = superval[currentPos++] & 0x0f;
	putValue(P_FSG_80_0_0_19_8, param8);
}

// Ueberwachung der Darstellungsvariable der Range.
on envVar P_FSG_80_0_0_19_1_range // SoundSettings.Treble 
{
	@P_FSG_80_0_0_19_1 = @P_FSG_80_0_0_19_1_range - (-127); // slider = range - min
}

on envVar P_FSG_80_0_0_19_1 // SoundSettings.Treble
{
	byte superval[6];

	//Update Childvalue (Number)
	char thisval; // Treble
	float slider_value;

	slider_value = round(@P_FSG_80_0_0_19_1, 1.0);
	@P_FSG_80_0_0_19_1_range = slider_value + (-127); // real value := slider value + range min.
	thisval = (char)round((slider_value + (-127) - (0)) / (1.0), 1); // bus value := (slider value + min - offset) / step.

    // Update superval
	getValue(P_FSG_80_0_0_19, superval);
	superval[0]=thisval;
	putValue(P_FSG_80_0_0_19,superval);
}

// Ueberwachung der Darstellungsvariable der Range.
on envVar P_FSG_80_0_0_19_2_range // SoundSettings.Bass 
{
	@P_FSG_80_0_0_19_2 = @P_FSG_80_0_0_19_2_range - (-127); // slider = range - min
}

on envVar P_FSG_80_0_0_19_2 // SoundSettings.Bass
{
	byte superval[6];

	//Update Childvalue (Number)
	char thisval; // Bass
	float slider_value;

	slider_value = round(@P_FSG_80_0_0_19_2, 1.0);
	@P_FSG_80_0_0_19_2_range = slider_value + (-127); // real value := slider value + range min.
	thisval = (char)round((slider_value + (-127) - (0)) / (1.0), 1); // bus value := (slider value + min - offset) / step.

    // Update superval
	getValue(P_FSG_80_0_0_19, superval);
	superval[1]=thisval;
	putValue(P_FSG_80_0_0_19,superval);
}

// Ueberwachung der Darstellungsvariable der Range.
on envVar P_FSG_80_0_0_19_3_range // SoundSettings.Balance 
{
	@P_FSG_80_0_0_19_3 = @P_FSG_80_0_0_19_3_range - (-127); // slider = range - min
}

on envVar P_FSG_80_0_0_19_3 // SoundSettings.Balance
{
	byte superval[6];

	//Update Childvalue (Number)
	char thisval; // Balance
	float slider_value;

	slider_value = round(@P_FSG_80_0_0_19_3, 1.0);
	@P_FSG_80_0_0_19_3_range = slider_value + (-127); // real value := slider value + range min.
	thisval = (char)round((slider_value + (-127) - (0)) / (1.0), 1); // bus value := (slider value + min - offset) / step.

    // Update superval
	getValue(P_FSG_80_0_0_19, superval);
	superval[2]=thisval;
	putValue(P_FSG_80_0_0_19,superval);
}

// Ueberwachung der Darstellungsvariable der Range.
on envVar P_FSG_80_0_0_19_4_range // SoundSettings.Extension1 
{
	@P_FSG_80_0_0_19_4 = @P_FSG_80_0_0_19_4_range - (0); // slider = range - min
}

on envVar P_FSG_80_0_0_19_4 // SoundSettings.Extension1
{
	byte superval[6];

	//Update Childvalue (Number)
	byte thisval; // Extension1
	float slider_value;

	slider_value = 0; // Konstanter Parameter.
	@P_FSG_80_0_0_19_4_range = slider_value + (0); // real value := slider value + range min.
	thisval = (byte)round((slider_value + (0) - (0)) / (1.0), 1); // bus value := (slider value + min - offset) / step.

    // Update superval
	getValue(P_FSG_80_0_0_19, superval);
	superval[3]= superval[3]&0x0f;
	superval[3]= superval[3]|(thisval<<4);
	putValue(P_FSG_80_0_0_19,superval);
}

// Ueberwachung der Darstellungsvariable der Range.
on envVar P_FSG_80_0_0_19_5_range // SoundSettings.GALA 
{
	@P_FSG_80_0_0_19_5 = @P_FSG_80_0_0_19_5_range - (0); // slider = range - min
}

on envVar P_FSG_80_0_0_19_5 // SoundSettings.GALA
{
	byte superval[6];

	//Update Childvalue (Number)
	byte thisval; // GALA
	float slider_value;

	slider_value = round(@P_FSG_80_0_0_19_5, 1.0);
	@P_FSG_80_0_0_19_5_range = slider_value + (0); // real value := slider value + range min.
	thisval = (byte)round((slider_value + (0) - (0)) / (1.0), 1); // bus value := (slider value + min - offset) / step.

    // Update superval
	getValue(P_FSG_80_0_0_19, superval);
	superval[3]= superval[3]&0xf0;
	superval[3]= superval[3]|thisval;
	putValue(P_FSG_80_0_0_19,superval);
}

// Ueberwachung der Darstellungsvariable der Range.
on envVar P_FSG_80_0_0_19_6_range // SoundSettings.Extension2 
{
	@P_FSG_80_0_0_19_6 = @P_FSG_80_0_0_19_6_range - (0); // slider = range - min
}

on envVar P_FSG_80_0_0_19_6 // SoundSettings.Extension2
{
	byte superval[6];

	//Update Childvalue (Number)
	byte thisval; // Extension2
	float slider_value;

	slider_value = 0; // Konstanter Parameter.
	@P_FSG_80_0_0_19_6_range = slider_value + (0); // real value := slider value + range min.
	thisval = (byte)round((slider_value + (0) - (0)) / (1.0), 1); // bus value := (slider value + min - offset) / step.

    // Update superval
	getValue(P_FSG_80_0_0_19, superval);
	superval[4]=thisval;
	putValue(P_FSG_80_0_0_19,superval);
}

on envVar P_FSG_80_0_0_19_7 // SoundSettings.ModificationReason_Sound
{
	byte superval[6];

	//Update Childvalue (Enum)
	byte thisval; // ModificationReason_Sound
	thisval = 0x0f & getValue(this);

    // Update superval
	getValue(P_FSG_80_0_0_19, superval);
	superval[5]= superval[5]&0x0f;
	superval[5]= superval[5]|(thisval<<4);
	putValue(P_FSG_80_0_0_19,superval);
}

on envVar P_FSG_80_0_0_19_8_0
{
	byte bitval;
	//thisval steht hier fuer den bitfield-wert, 
	//aus Generierungsgruenden hier keine einheitliche Bezeichnung moeglich.
	byte thisval; // ModificationState_Sound
	bitval= getValue(this);
	thisval = getValue(P_FSG_80_0_0_19_8);
	thisval = thisval&~(1<<0)|(bitval<<0);
	putValue(P_FSG_80_0_0_19_8,thisval);
}

on envVar P_FSG_80_0_0_19_8 // SoundSettings.ModificationState_Sound
{
	byte superval[6];

	//Update Childvalue (BitField)
	byte mask=0x01;
	int i = 0;
	byte thisval; // ModificationState_Sound
	thisval = getValue(this);
	if(thisval&(mask<<0))
		putValue(P_FSG_80_0_0_19_8_0, 1);
	else
		putValue(P_FSG_80_0_0_19_8_0, 0);

    // Update superval
	getValue(P_FSG_80_0_0_19, superval);
	superval[5]= superval[5]&0xf0;
	superval[5]= superval[5]|thisval;
	putValue(P_FSG_80_0_0_19,superval);
}

// Ruecksetzen des Fehlerstatus durch manuelle Fehlereingabe
on envVar M_FSG_80_0_0_20_ErrCode
{
       if(gM_FSG_80_0_0_20_ErrCode) 
       {
           setControlBackColor(panel_name,"errfield_M_FSG_80_0_0_20", MakeRGB(255,255,255));
       }
       gM_FSG_80_0_0_20_ErrCode = 1;
}
on envVar M_FSG_80_0_0_20Result_BTN
{
    byte temp[2];
    if (M_FSG_80_0_0_20Result_BTN_already_pressed == 0)
    {
        putValue(M_FSG_80_0_0_20_ErrCode,0);
        SetControlBackColor(panel_name,"errField_M_FSG_80_0_0_20",MakeRGB(255,255,255));
        M_FSG_80_0_0_20Result_BTN_already_pressed = 1;
    }
    else
    {
        putValue(M_FSG_80_0_0_20_State, "Result");
        getValue(M_FSG_80_0_0_20_Result, temp);
        Request_ByteSequence(LSGID, M_FSG_80_0_0_20_ID, Result_REQ, temp, getValueSize(M_FSG_80_0_0_20_Result));
        M_FSG_80_0_0_20Result_BTN_already_pressed = 0;
    }
}
on envVar M_FSG_80_0_0_20_FctEn
{
    long data[3];
    data[0]=LSGID;
    data[1]=M_FSG_80_0_0_20_ID;
    data[2]=getValue(M_FSG_80_0_0_20_FctEn);
    ChangeConfig(0x0031,data);
}
// De-Aktivierung der Eingabefelder der FCTID M_FSG_80_0_0_20
on envVar M_FSG_80_0_0_20_FctLstItemEn
{
       if(getValue(this)) 
       {
           EnableControl(panel_name,"panel_FSG_80_0_0_20",1);
           EnableControl(panel_name,"errfield_M_FSG_80_0_0_20",1);
           EnableControl(panel_name,"panel_M_FSG_80_0_0_20",1);
           EnableControl(panel_name,"panel_M_FSG_80_0_0_20_Processing",1);
           EnableControl(panel_name,"panel_M_FSG_80_0_0_20_Start",1);
           setControlForeColor(panel_name, "checkbox_M_FSG_80_0_0_20", MakeRGB(0,240,0));
       }
       else
       {
           EnableControl(panel_name,"panel_FSG_80_0_0_20",0);
           EnableControl(panel_name,"errfield_M_FSG_80_0_0_20",0);
           EnableControl(panel_name,"panel_M_FSG_80_0_0_20",0);
           EnableControl(panel_name,"panel_M_FSG_80_0_0_20_Processing",0);
           EnableControl(panel_name,"panel_M_FSG_80_0_0_20_Start",0);
           setControlForeColor(panel_name, "checkbox_M_FSG_80_0_0_20", MakeRGB(250,0,0));
       }
}
on envVar M_FSG_80_0_0_20_Result // bus value of RadioFavoriteCommands (20).
{
	// opcodes: Error-Processing-Result
	byte param1; // ASG_ID
	byte param2; // CommandType
	byte param3; // RadioFavoriteCommands_Result
	// DATATYPE_BYTESEQUENCE / DATATYPE_FIXEDBYTESEQUENCE
	int i;
	byte superval[2];
	int currentPos;
	currentPos = 0;
	for( i = 0; i < 2; i++ ) {
		superval[i] = 0;
	}
	getValue(M_FSG_80_0_0_20_Result, superval);
	///////// Start param1 - NIBBLE /////////
	param1 = (superval[currentPos] & 0xf0)>>4;
	putValue(M_FSG_80_0_0_20_Result_1, param1);
	///////// Start param2 - NIBBLE /////////
	param2 = superval[currentPos++] & 0x0f;
	putValue(M_FSG_80_0_0_20_Result_2, param2);
	///////// Start param3 - UINT8 /////////
	param3 = superval[currentPos++];
	putValue(M_FSG_80_0_0_20_Result_3, param3);
}

on envVar M_FSG_80_0_0_20_Result_1 // RadioFavoriteCommands.ASG_ID
{
	byte superval[2];

	//Update Childvalue (Enum)
	byte thisval; // ASG_ID
	thisval = 0x0f & getValue(this);

    // Update superval
	getValue(M_FSG_80_0_0_20_Result, superval);
	superval[0]= superval[0]&0x0f;
	superval[0]= superval[0]|(thisval<<4);
	putValue(M_FSG_80_0_0_20_Result,superval);
}

on envVar M_FSG_80_0_0_20_Result_2 // RadioFavoriteCommands.CommandType
{
	byte superval[2];

	//Update Childvalue (Enum)
	byte thisval; // CommandType
	thisval = 0x0f & getValue(this);

    // Update superval
	getValue(M_FSG_80_0_0_20_Result, superval);
	superval[0]= superval[0]&0xf0;
	superval[0]= superval[0]|thisval;
	putValue(M_FSG_80_0_0_20_Result,superval);
}

on envVar M_FSG_80_0_0_20_Result_3 // RadioFavoriteCommands.RadioFavoriteCommands_Result
{
	byte superval[2];

	//Update Childvalue (Enum)
	byte thisval; // RadioFavoriteCommands_Result
	thisval = getValue(this);

    // Update superval
	getValue(M_FSG_80_0_0_20_Result, superval);
	superval[1]=thisval;
	putValue(M_FSG_80_0_0_20_Result,superval);
}

on envVar M_FSG_80_0_0_20_Processing // bus value of RadioFavoriteCommands (20).
{
	// opcodes: Error-Processing-Result
	byte param1; // ASG_ID
	byte param2; // CommandType
	byte param3; // Reserve
	// DATATYPE_BYTESEQUENCE / DATATYPE_FIXEDBYTESEQUENCE
	int i;
	byte superval[2];
	int currentPos;
	currentPos = 0;
	for( i = 0; i < 2; i++ ) {
		superval[i] = 0;
	}
	getValue(M_FSG_80_0_0_20_Processing, superval);
	///////// Start param1 - NIBBLE /////////
	param1 = (superval[currentPos] & 0xf0)>>4;
	putValue(M_FSG_80_0_0_20_Processing_1, param1);
	///////// Start param2 - NIBBLE /////////
	param2 = superval[currentPos++] & 0x0f;
	putValue(M_FSG_80_0_0_20_Processing_2, param2);
	///////// Start param3 - UINT8 /////////
	param3 = superval[currentPos++];
	putValue(M_FSG_80_0_0_20_Processing_3, round((param3 * 1.0) - (0) + (0), 1.0));
}

on envVar M_FSG_80_0_0_20_Processing_1 // RadioFavoriteCommands.ASG_ID
{
	byte superval[2];

	//Update Childvalue (Enum)
	byte thisval; // ASG_ID
	thisval = 0x0f & getValue(this);

    // Update superval
	getValue(M_FSG_80_0_0_20_Processing, superval);
	superval[0]= superval[0]&0x0f;
	superval[0]= superval[0]|(thisval<<4);
	putValue(M_FSG_80_0_0_20_Processing,superval);
}

on envVar M_FSG_80_0_0_20_Processing_2 // RadioFavoriteCommands.CommandType
{
	byte superval[2];

	//Update Childvalue (Enum)
	byte thisval; // CommandType
	thisval = 0x0f & getValue(this);

    // Update superval
	getValue(M_FSG_80_0_0_20_Processing, superval);
	superval[0]= superval[0]&0xf0;
	superval[0]= superval[0]|thisval;
	putValue(M_FSG_80_0_0_20_Processing,superval);
}

// Ueberwachung der Darstellungsvariable der Range.
on envVar M_FSG_80_0_0_20_Processing_3_range // RadioFavoriteCommands.Reserve 
{
	@M_FSG_80_0_0_20_Processing_3 = @M_FSG_80_0_0_20_Processing_3_range - (0); // slider = range - min
}

on envVar M_FSG_80_0_0_20_Processing_3 // RadioFavoriteCommands.Reserve
{
	byte superval[2];

	//Update Childvalue (Number)
	byte thisval; // Reserve
	float slider_value;

	slider_value = 0; // Konstanter Parameter.
	@M_FSG_80_0_0_20_Processing_3_range = slider_value + (0); // real value := slider value + range min.
	thisval = (byte)round((slider_value + (0) - (0)) / (1.0), 1); // bus value := (slider value + min - offset) / step.

    // Update superval
	getValue(M_FSG_80_0_0_20_Processing, superval);
	superval[1]=thisval;
	putValue(M_FSG_80_0_0_20_Processing,superval);
}

on envVar M_FSG_80_0_0_20_Start // bus value of RadioFavoriteCommands (20).
{
	// opcodes: AbortResult-StartResult
	byte param1; // ASG_ID
	byte param2; // CommandType
	byte param3; // Extension1
	byte param4; // Source
	word param5; // Pos_Source
	byte param6; // PresetID
	byte param7; // Extension2
	// DATATYPE_BYTESEQUENCE / DATATYPE_FIXEDBYTESEQUENCE
	int i;
	byte superval[6];
	int currentPos;
	currentPos = 0;
	for( i = 0; i < 6; i++ ) {
		superval[i] = 0;
	}
	getValue(M_FSG_80_0_0_20_Start, superval);
	///////// Start param1 - NIBBLE /////////
	param1 = (superval[currentPos] & 0xf0)>>4;
	putValue(M_FSG_80_0_0_20_Start_1, param1);
	///////// Start param2 - NIBBLE /////////
	param2 = superval[currentPos++] & 0x0f;
	putValue(M_FSG_80_0_0_20_Start_2, param2);
	///////// Start param3 - NIBBLE /////////
	param3 = (superval[currentPos] & 0xf0)>>4;
	putValue(M_FSG_80_0_0_20_Start_3, round((param3 * 1.0) - (0) + (0), 1.0));
	///////// Start param4 - NIBBLE /////////
	param4 = superval[currentPos++] & 0x0f;
	putValue(M_FSG_80_0_0_20_Start_4, param4);
	///////// Start param5 - UINT16 /////////
	param5 = superval[currentPos++]|(superval[currentPos++]<<8);
	putValue(M_FSG_80_0_0_20_Start_5, round((param5 * 1.0) - (1) + (1), 1.0));
	///////// Start param6 - UINT8 /////////
	param6 = superval[currentPos++];
	putValue(M_FSG_80_0_0_20_Start_6, round((param6 * 1.0) - (1) + (1), 1.0));
	///////// Start param7 - UINT8 /////////
	param7 = superval[currentPos++];
	putValue(M_FSG_80_0_0_20_Start_7, round((param7 * 1.0) - (0) + (0), 1.0));
}

on envVar M_FSG_80_0_0_20_Start_1 // RadioFavoriteCommands.ASG_ID
{
	byte superval[6];

	//Update Childvalue (Enum)
	byte thisval; // ASG_ID
	thisval = 0x0f & getValue(this);

    // Update superval
	getValue(M_FSG_80_0_0_20_Start, superval);
	superval[0]= superval[0]&0x0f;
	superval[0]= superval[0]|(thisval<<4);
	putValue(M_FSG_80_0_0_20_Start,superval);
}

on envVar M_FSG_80_0_0_20_Start_2 // RadioFavoriteCommands.CommandType
{
	byte superval[6];

	//Update Childvalue (Enum)
	byte thisval; // CommandType
	thisval = 0x0f & getValue(this);

    // Update superval
	getValue(M_FSG_80_0_0_20_Start, superval);
	superval[0]= superval[0]&0xf0;
	superval[0]= superval[0]|thisval;
	putValue(M_FSG_80_0_0_20_Start,superval);
}

// Ueberwachung der Darstellungsvariable der Range.
on envVar M_FSG_80_0_0_20_Start_3_range // RadioFavoriteCommands.Extension1 
{
	@M_FSG_80_0_0_20_Start_3 = @M_FSG_80_0_0_20_Start_3_range - (0); // slider = range - min
}

on envVar M_FSG_80_0_0_20_Start_3 // RadioFavoriteCommands.Extension1
{
	byte superval[6];

	//Update Childvalue (Number)
	byte thisval; // Extension1
	float slider_value;

	slider_value = 0; // Konstanter Parameter.
	@M_FSG_80_0_0_20_Start_3_range = slider_value + (0); // real value := slider value + range min.
	thisval = (byte)round((slider_value + (0) - (0)) / (1.0), 1); // bus value := (slider value + min - offset) / step.

    // Update superval
	getValue(M_FSG_80_0_0_20_Start, superval);
	superval[1]= superval[1]&0x0f;
	superval[1]= superval[1]|(thisval<<4);
	putValue(M_FSG_80_0_0_20_Start,superval);
}

on envVar M_FSG_80_0_0_20_Start_4 // RadioFavoriteCommands.Source
{
	byte superval[6];

	//Update Childvalue (Enum)
	byte thisval; // Source
	thisval = 0x0f & getValue(this);

    // Update superval
	getValue(M_FSG_80_0_0_20_Start, superval);
	superval[1]= superval[1]&0xf0;
	superval[1]= superval[1]|thisval;
	putValue(M_FSG_80_0_0_20_Start,superval);
}

// Ueberwachung der Darstellungsvariable der Range.
on envVar M_FSG_80_0_0_20_Start_5_range // RadioFavoriteCommands.Pos_Source 
{
	@M_FSG_80_0_0_20_Start_5 = @M_FSG_80_0_0_20_Start_5_range - (1); // slider = range - min
}

on envVar M_FSG_80_0_0_20_Start_5 // RadioFavoriteCommands.Pos_Source
{
	byte superval[6];

	//Update Childvalue (Number)
	word thisval; // Pos_Source
	float slider_value;

	slider_value = round(@M_FSG_80_0_0_20_Start_5, 1.0);
	@M_FSG_80_0_0_20_Start_5_range = slider_value + (1); // real value := slider value + range min.
	thisval = (word)round((slider_value + (1) - (1)) / (1.0), 1); // bus value := (slider value + min - offset) / step.

    // Update superval
	getValue(M_FSG_80_0_0_20_Start, superval);
	superval[2]=thisval&0x00ff;
	superval[3]=(thisval&0xff00)>>8;
	putValue(M_FSG_80_0_0_20_Start,superval);
}

// Ueberwachung der Darstellungsvariable der Range.
on envVar M_FSG_80_0_0_20_Start_6_range // RadioFavoriteCommands.PresetID 
{
	@M_FSG_80_0_0_20_Start_6 = @M_FSG_80_0_0_20_Start_6_range - (1); // slider = range - min
}

on envVar M_FSG_80_0_0_20_Start_6 // RadioFavoriteCommands.PresetID
{
	byte superval[6];

	//Update Childvalue (Number)
	byte thisval; // PresetID
	float slider_value;

	slider_value = round(@M_FSG_80_0_0_20_Start_6, 1.0);
	@M_FSG_80_0_0_20_Start_6_range = slider_value + (1); // real value := slider value + range min.
	thisval = (byte)round((slider_value + (1) - (1)) / (1.0), 1); // bus value := (slider value + min - offset) / step.

    // Update superval
	getValue(M_FSG_80_0_0_20_Start, superval);
	superval[4]=thisval;
	putValue(M_FSG_80_0_0_20_Start,superval);
}

// Ueberwachung der Darstellungsvariable der Range.
on envVar M_FSG_80_0_0_20_Start_7_range // RadioFavoriteCommands.Extension2 
{
	@M_FSG_80_0_0_20_Start_7 = @M_FSG_80_0_0_20_Start_7_range - (0); // slider = range - min
}

on envVar M_FSG_80_0_0_20_Start_7 // RadioFavoriteCommands.Extension2
{
	byte superval[6];

	//Update Childvalue (Number)
	byte thisval; // Extension2
	float slider_value;

	slider_value = 0; // Konstanter Parameter.
	@M_FSG_80_0_0_20_Start_7_range = slider_value + (0); // real value := slider value + range min.
	thisval = (byte)round((slider_value + (0) - (0)) / (1.0), 1); // bus value := (slider value + min - offset) / step.

    // Update superval
	getValue(M_FSG_80_0_0_20_Start, superval);
	superval[5]=thisval;
	putValue(M_FSG_80_0_0_20_Start,superval);
}

// Ruecksetzen des Fehlerstatus durch manuelle Fehlereingabe
on envVar P_FSG_80_0_0_21_ErrCode
{
       if(gP_FSG_80_0_0_21_ErrCode) 
       {
           setControlBackColor(panel_name,"errfield_P_FSG_80_0_0_21", MakeRGB(255,255,255));
       }
       gP_FSG_80_0_0_21_ErrCode = 1;
}
on envVar P_FSG_80_0_0_21Status_BTN
{
	byte BAPTemp[111];
    if (P_FSG_80_0_0_21Status_BTN_already_pressed == 0)
    {
        putValue(P_FSG_80_0_0_21_ErrCode,0);
        SetControlBackColor(panel_name,"errField_P_FSG_80_0_0_21",MakeRGB(255,255,255));
        P_FSG_80_0_0_21Status_BTN_already_pressed = 1;
    }
    else
    {
		P_FSG_80_0_0_21_BuildFct();
        getValue(P_FSG_80_0_0_21, BAPTemp);
        Request_ByteSequence(LSGID, P_FSG_80_0_0_21_ID, Data_REQ, BAPTemp, getValueSize(P_FSG_80_0_0_21));
        if(getValue(P_FSG_80_0_0_21_IntTlgEn)) //getValue(IT))
        {
           intertelegram_err(P_FSG_80_0_0_21_ID);
        }
        if(getValue(P_FSG_80_0_0_21_SegmEn))   //getvalue(SG)
        {
           sequence_err(P_FSG_80_0_0_21_ID,elCount(BAPTemp));
        }
       P_FSG_80_0_0_21Status_BTN_already_pressed = 0;
    }
}
on envVar P_FSG_80_0_0_21_FctEn
{
    long data[3];
    data[0]=LSGID;
    data[1]=P_FSG_80_0_0_21_ID;
    data[2]=getValue(P_FSG_80_0_0_21_FctEn);
    ChangeConfig(0x0031,data);
}
// De-Aktivierung der Eingabefelder der FCTID P_FSG_80_0_0_21
on envVar P_FSG_80_0_0_21_FctLstItemEn
{
       if(getValue(this)) 
       {
           EnableControl(panel_name,"panel_FSG_80_0_0_21",1);
           EnableControl(panel_name,"errfield_P_FSG_80_0_0_21",1);
           EnableControl(panel_name,"panel_P_FSG_80_0_0_21",1);
           setControlForeColor(panel_name, "checkbox_P_FSG_80_0_0_21", MakeRGB(0,240,0));
       }
       else
       {
           EnableControl(panel_name,"panel_FSG_80_0_0_21",0);
           EnableControl(panel_name,"errfield_P_FSG_80_0_0_21",0);
           EnableControl(panel_name,"panel_P_FSG_80_0_0_21",0);
           setControlForeColor(panel_name, "checkbox_P_FSG_80_0_0_21", MakeRGB(250,0,0));
       }
}
// Man darf gleichzeitig nur Checkbox fuer SegmError oder IntertelegramError aktiviert werden
on envVar P_FSG_80_0_0_21_IntTlgEn
{
       if(getValue(this)) 
       {
           putValue(P_FSG_80_0_0_21_SegmEn,0);
           intertelegram_err(P_FSG_80_0_0_21_ID);
       }
       else
       {
           intertelegram_err_off(P_FSG_80_0_0_21_ID);
       }
}
// Man darf gleichzeitig nur Checkbox fuer SegmError oder IntertelegramError aktiviert werden
on envVar P_FSG_80_0_0_21_SegmEn
{
       if(getValue(this)) 
       {
           putValue(P_FSG_80_0_0_21_IntTlgEn,0);
           sequence_err(P_FSG_80_0_0_21_ID,getValueSize(P_FSG_80_0_0_21_SegmEn));
       }
       else
       {
              sequence_err_off(P_FSG_80_0_0_21_ID);
       }
}
on envVar P_FSG_80_0_0_21 // bus value of BTPairingState (21).
{
	// opcodes: Error-Status
	byte param1; // Extension1
	byte param2; // PairingState
	byte param3; // ModificationReason_BT
	byte param4; // ModificationState_BT
	byte param5[7]; // PairingPIN
	word len5;
	byte cnt5;
	byte param6[100]; // BTDeviceName
	word len6;
	byte cnt6;
	byte param7; // Extension2
	byte param8; // Extension3
	// DATATYPE_BYTESEQUENCE / DATATYPE_FIXEDBYTESEQUENCE
	int i;
	byte superval[111];
	int currentPos;
	currentPos = 0;
	for( i = 0; i < 111; i++ ) {
		superval[i] = 0;
	}
	getValue(P_FSG_80_0_0_21, superval);
	///////// Start param1 - NIBBLE /////////
	param1 = (superval[currentPos] & 0xf0)>>4;
	putValue(P_FSG_80_0_0_21_1, round((param1 * 1.0) - (0) + (0), 1.0));
	///////// Start param2 - NIBBLE /////////
	param2 = superval[currentPos++] & 0x0f;
	putValue(P_FSG_80_0_0_21_2, param2);
	///////// Start param3 - NIBBLE /////////
	param3 = (superval[currentPos] & 0xf0)>>4;
	putValue(P_FSG_80_0_0_21_3, param3);
	///////// Start param4 - NIBBLE /////////
	param4 = superval[currentPos++] & 0x0f;
	putValue(P_FSG_80_0_0_21_4, param4);
	///////// Start param5 - STRING /////////
	getValue(P_FSG_80_0_0_21_5, param5);
	if((superval[currentPos] & 0x80) > 0)
	{
		if(6>127) /* Max Fct-Katalog Laenge: 6*/
		{
			len5 = ( (superval[currentPos]&0x7F) <<8) + superval[currentPos+1];
			currentPos = currentPos + 2;
			cnt5 = 1;
		}
		else
		{
			len5 = 6;
			writelineEx(gBAP_Trace, 0, "Anzahl der Laengeninformation-Bytes in P_FSG_80_0_0_21 ueberschreitet die erlaubte 1 Byte vom Fct-Kalatog.");
		}
	}
	else
	{
		len5 = superval[currentPos]&0x7F;
		currentPos = currentPos + 1;
		cnt5 = 0;
	}
	
	if(len5 > 6)
	{
		writelineEx(gBAP_Trace, 0, "Laenge:%d bei der Byte Position:%d ueberschreitet die Maximale erlaubte Laenge von Fct-Kalatog", len5, currentPos);
		len5 = 6;
	
		if(len5 < 128) cnt5 = 0;
		else cnt5 = 1;
	}
	
	for(i = 0; i < len5; i++)
	{
		param5[i] = superval[currentPos++];
	}
	
	putValue(P_FSG_80_0_0_21_5_len, len5);
	putValue(P_FSG_80_0_0_21_5_cnt, cnt5);
	
	if(len5 > getValueSize(P_FSG_80_0_0_21_5))
		putValue(P_FSG_80_0_0_21_5, param5, len5);
	else
		putValue(P_FSG_80_0_0_21_5, param5, getValueSize(P_FSG_80_0_0_21_5));

	///////// Start param6 - STRING /////////
	getValue(P_FSG_80_0_0_21_6, param6);
	if((superval[currentPos] & 0x80) > 0)
	{
		if(99>127) /* Max Fct-Katalog Laenge: 99*/
		{
			len6 = ( (superval[currentPos]&0x7F) <<8) + superval[currentPos+1];
			currentPos = currentPos + 2;
			cnt6 = 1;
		}
		else
		{
			len6 = 99;
			writelineEx(gBAP_Trace, 0, "Anzahl der Laengeninformation-Bytes in P_FSG_80_0_0_21 ueberschreitet die erlaubte 1 Byte vom Fct-Kalatog.");
		}
	}
	else
	{
		len6 = superval[currentPos]&0x7F;
		currentPos = currentPos + 1;
		cnt6 = 0;
	}
	
	if(len6 > 99)
	{
		writelineEx(gBAP_Trace, 0, "Laenge:%d bei der Byte Position:%d ueberschreitet die Maximale erlaubte Laenge von Fct-Kalatog", len6, currentPos);
		len6 = 99;
	
		if(len6 < 128) cnt6 = 0;
		else cnt6 = 1;
	}
	
	for(i = 0; i < len6; i++)
	{
		param6[i] = superval[currentPos++];
	}
	
	putValue(P_FSG_80_0_0_21_6_len, len6);
	putValue(P_FSG_80_0_0_21_6_cnt, cnt6);
	
	if(len6 > getValueSize(P_FSG_80_0_0_21_6))
		putValue(P_FSG_80_0_0_21_6, param6, len6);
	else
		putValue(P_FSG_80_0_0_21_6, param6, getValueSize(P_FSG_80_0_0_21_6));

	///////// Start param7 - UINT8 /////////
	param7 = superval[currentPos++];
	putValue(P_FSG_80_0_0_21_7, round((param7 * 1.0) - (0) + (0), 1.0));
	///////// Start param8 - UINT8 /////////
	param8 = superval[currentPos++];
	putValue(P_FSG_80_0_0_21_8, round((param8 * 1.0) - (0) + (0), 1.0));
}

// Updates the bus value field and other dependencies.
P_FSG_80_0_0_21_BuildFct()
{
	byte param1; // Extension1
	byte param2; // PairingState
	byte param3; // ModificationReason_BT
	byte param4; // ModificationState_BT
	byte param5[7]; // PairingPIN
	word len5;
	byte cnt5;
	byte param6[100]; // BTDeviceName
	word len6;
	byte cnt6;
	byte param7; // Extension2
	byte param8; // Extension3

	int i;
	byte superval[111];
	int currentPos;
	currentPos = 0;
// gen_BuildFunc_SetSuperVals 
	@P_FSG_80_0_0_21_1_range = round(@P_FSG_80_0_0_21_1 + (0), 1.0); // slider value + min = real value
	param1 = 0; // underlying parameter has constant value 0.
	param1 = param1 & 0x0f;
	superval[currentPos]= superval[currentPos]&0x0f;
	superval[currentPos]= superval[currentPos]|(param1<<4);
// gen_BuildFunc_SetSuperVals 
	param2 = getValue(P_FSG_80_0_0_21_2);
	param2 = param2 & 0x0f;
	superval[currentPos]= superval[currentPos]&0xf0;
	superval[currentPos]= superval[currentPos]|param2;
	currentPos++;
// gen_BuildFunc_SetSuperVals 
	param3 = getValue(P_FSG_80_0_0_21_3);
	param3 = param3 & 0x0f;
	superval[currentPos]= superval[currentPos]&0x0f;
	superval[currentPos]= superval[currentPos]|(param3<<4);
// gen_BuildFunc_SetSuperVals 
	param4 = getValue(P_FSG_80_0_0_21_4);
	param4=param4& 0x0f;
	@P_FSG_80_0_0_21_4_0 = (param4 & 1) > 0;
	param4 = param4 & 0x0f;
	superval[currentPos]= superval[currentPos]&0xf0;
	superval[currentPos]= superval[currentPos]|param4;
	currentPos++;
// gen_BuildFunc_SetSuperVals 
	getValue(P_FSG_80_0_0_21_5, param5);
	len5 = getValue(P_FSG_80_0_0_21_5_len);
	cnt5= getValue(P_FSG_80_0_0_21_5_cnt);
	
	/* check box aktiviert*/
	if (cnt5 == 1)
	{
		/* 0 bis 6 (MaxString - 1B oder 2B) */
		if(len5 >= 0 && len5 <= 6)
		{
			//writelineEx(gBAP_Trace, 0, "[Debug-1] Len5: %d", len5);
			superval[currentPos] = (len5&0x7f00) | 0x80;
			superval[currentPos+1] = len5 & 0x00ff;
		}
		else
		{
			writelineEx(gBAP_Trace, 0, "Eingegebene Laenge: %d von P_FSG_80_0_0_21_5 ist ungueltig. Die max. erlaubte Laenge ist %d.", len5, 6);
			return;
		}
	}
	else if(cnt5 == 0) /*check box deaktiviert*/
	{
		if(len5 >= 0 && len5 <= 127)
		{
			//writelineEx(gBAP_Trace, 0, "[Debug-1] Len5: %d", len5);
			superval[currentPos]= len5 & 0x00ff;
			putValue(P_FSG_80_0_0_21_5_len, len5);
		}
		else if(len5 > 127 && len5 <= 6)
		{
			superval[currentPos] = (len5&0x7f00) | 0x80;
			superval[currentPos+1] = len5 & 0x00ff;
			putValue(P_FSG_80_0_0_21_5_len, len5);
			putValue(P_FSG_80_0_0_21_5_cnt, 1);
		}
		else
		{
			writelineEx(gBAP_Trace, 0, "Eingegebene Laenge: %d von P_FSG_80_0_0_21_5 ist ungueltig. Die max. erlaubte Laenge ist %d.", len5, 6);
			return;
		}
	}
	currentPos += cnt5+1;
	for(i = 0; i < len5; i++)
	{
		superval[currentPos++]= param5[i];
	}

// gen_BuildFunc_SetSuperVals 
	getValue(P_FSG_80_0_0_21_6, param6);
	len6 = getValue(P_FSG_80_0_0_21_6_len);
	cnt6= getValue(P_FSG_80_0_0_21_6_cnt);
	
	/* check box aktiviert*/
	if (cnt6 == 1)
	{
		/* 0 bis 99 (MaxString - 1B oder 2B) */
		if(len6 >= 0 && len6 <= 99)
		{
			//writelineEx(gBAP_Trace, 0, "[Debug-1] Len6: %d", len6);
			superval[currentPos] = (len6&0x7f00) | 0x80;
			superval[currentPos+1] = len6 & 0x00ff;
		}
		else
		{
			writelineEx(gBAP_Trace, 0, "Eingegebene Laenge: %d von P_FSG_80_0_0_21_6 ist ungueltig. Die max. erlaubte Laenge ist %d.", len6, 99);
			return;
		}
	}
	else if(cnt6 == 0) /*check box deaktiviert*/
	{
		if(len6 >= 0 && len6 <= 127)
		{
			//writelineEx(gBAP_Trace, 0, "[Debug-1] Len6: %d", len6);
			superval[currentPos]= len6 & 0x00ff;
			putValue(P_FSG_80_0_0_21_6_len, len6);
		}
		else if(len6 > 127 && len6 <= 99)
		{
			superval[currentPos] = (len6&0x7f00) | 0x80;
			superval[currentPos+1] = len6 & 0x00ff;
			putValue(P_FSG_80_0_0_21_6_len, len6);
			putValue(P_FSG_80_0_0_21_6_cnt, 1);
		}
		else
		{
			writelineEx(gBAP_Trace, 0, "Eingegebene Laenge: %d von P_FSG_80_0_0_21_6 ist ungueltig. Die max. erlaubte Laenge ist %d.", len6, 99);
			return;
		}
	}
	currentPos += cnt6+1;
	for(i = 0; i < len6; i++)
	{
		superval[currentPos++]= param6[i];
	}

// gen_BuildFunc_SetSuperVals 
	@P_FSG_80_0_0_21_7_range = round(@P_FSG_80_0_0_21_7 + (0), 1.0); // slider value + min = real value
	param7 = 0; // underlying parameter has constant value 0.
	superval[currentPos++]=param7;
// gen_BuildFunc_SetSuperVals 
	@P_FSG_80_0_0_21_8_range = round(@P_FSG_80_0_0_21_8 + (0), 1.0); // slider value + min = real value
	param8 = 0; // underlying parameter has constant value 0.
	superval[currentPos++]=param8;
	putValue(P_FSG_80_0_0_21, superval, currentPos);
}


// Ueberwachung der Darstellungsvariable der Range.
on envVar P_FSG_80_0_0_21_1_range // BTPairingState.Extension1 
{
	@P_FSG_80_0_0_21_1 = @P_FSG_80_0_0_21_1_range - (0); // slider = range - min
}

on envVar P_FSG_80_0_0_21_1 // BTPairingState.Extension1
{
	P_FSG_80_0_0_21_BuildFct();
}

on envVar P_FSG_80_0_0_21_2 // BTPairingState.PairingState
{
	P_FSG_80_0_0_21_BuildFct();
}

on envVar P_FSG_80_0_0_21_3 // BTPairingState.ModificationReason_BT
{
	P_FSG_80_0_0_21_BuildFct();
}

on envVar P_FSG_80_0_0_21_4_0
{
	byte bitval;
	//thisval steht hier fuer den bitfield-wert, 
	//aus Generierungsgruenden hier keine einheitliche Bezeichnung moeglich.
	byte thisval; // ModificationState_BT
	bitval= getValue(this);
	thisval = getValue(P_FSG_80_0_0_21_4);
	thisval = thisval&~(1<<0)|(bitval<<0);
	putValue(P_FSG_80_0_0_21_4,thisval);
}

on envVar P_FSG_80_0_0_21_4 // BTPairingState.ModificationState_BT
{
	P_FSG_80_0_0_21_BuildFct();
}


// Ueberwachung der CheckBox fuer String
on envVar  P_FSG_80_0_0_21_5_cnt
{
	word len;
	byte cnt;
	len = getValue(P_FSG_80_0_0_21_5_len);
	cnt = getValue(P_FSG_80_0_0_21_5_cnt);

	/* wird nur gerufen, wenn check box deaktiviert mit Length>127*/ 
	if( cnt == 0) 
	{
		if(len > 127 )
		{
			putValue(P_FSG_80_0_0_21_5_len, 127);
		}
	}

	P_FSG_80_0_0_21_BuildFct();
}



// Ueberwachung der Eingabefeld fuer String Data
on envVar P_FSG_80_0_0_21_5_len
{
	word len;
	len = getValue(this);
	/* Validierung der Eingabe*/
	if(len > 6)
	{
		writelineEx(gBAP_Trace, 0, "Eingegebene Laenge: %d von P_FSG_80_0_0_21_5 ist ungueltig. Die max. erlaubte Laenge ist %d. ", len, 6);
		putValue(this, 6);
	}
	P_FSG_80_0_0_21_BuildFct();
}


on envVar P_FSG_80_0_0_21_5 // BTPairingState.PairingPIN
{
	putValue(P_FSG_80_0_0_21_5_len, getValueSize(this));
	P_FSG_80_0_0_21_BuildFct();
}


// Ueberwachung der CheckBox fuer String
on envVar  P_FSG_80_0_0_21_6_cnt
{
	word len;
	byte cnt;
	len = getValue(P_FSG_80_0_0_21_6_len);
	cnt = getValue(P_FSG_80_0_0_21_6_cnt);

	/* wird nur gerufen, wenn check box deaktiviert mit Length>127*/ 
	if( cnt == 0) 
	{
		if(len > 127 )
		{
			putValue(P_FSG_80_0_0_21_6_len, 127);
		}
	}

	P_FSG_80_0_0_21_BuildFct();
}



// Ueberwachung der Eingabefeld fuer String Data
on envVar P_FSG_80_0_0_21_6_len
{
	word len;
	len = getValue(this);
	/* Validierung der Eingabe*/
	if(len > 99)
	{
		writelineEx(gBAP_Trace, 0, "Eingegebene Laenge: %d von P_FSG_80_0_0_21_6 ist ungueltig. Die max. erlaubte Laenge ist %d. ", len, 99);
		putValue(this, 99);
	}
	P_FSG_80_0_0_21_BuildFct();
}


on envVar P_FSG_80_0_0_21_6 // BTPairingState.BTDeviceName
{
	putValue(P_FSG_80_0_0_21_6_len, getValueSize(this));
	P_FSG_80_0_0_21_BuildFct();
}

// Ueberwachung der Darstellungsvariable der Range.
on envVar P_FSG_80_0_0_21_7_range // BTPairingState.Extension2 
{
	@P_FSG_80_0_0_21_7 = @P_FSG_80_0_0_21_7_range - (0); // slider = range - min
}

on envVar P_FSG_80_0_0_21_7 // BTPairingState.Extension2
{
	P_FSG_80_0_0_21_BuildFct();
}

// Ueberwachung der Darstellungsvariable der Range.
on envVar P_FSG_80_0_0_21_8_range // BTPairingState.Extension3 
{
	@P_FSG_80_0_0_21_8 = @P_FSG_80_0_0_21_8_range - (0); // slider = range - min
}

on envVar P_FSG_80_0_0_21_8 // BTPairingState.Extension3
{
	P_FSG_80_0_0_21_BuildFct();
}

// Ruecksetzen des Fehlerstatus durch manuelle Fehlereingabe
on envVar A_FSG_80_0_0_22_ErrCode
{
       if(gA_FSG_80_0_0_22_ErrCode) 
       {
           setControlBackColor(panel_name,"errfield_A_FSG_80_0_0_22", MakeRGB(255,255,255));
       }
       gA_FSG_80_0_0_22_ErrCode = 1;
}
on envVar A_FSG_80_0_0_22Changed_BTN
{
    byte data[2045]; 
    byte stringValue[2045];
    byte head[5];
    int i;
    int headLength;
    long tempValue;
    word currentPos;
    word startVal;
    word elementsVal;
  byte nibbleSetted;
    if (A_FSG_80_0_0_22Changed_BTN_already_pressed == 0)
    {
        putValue(A_FSG_80_0_0_22_ErrCode,0);
        SetControlBackColor(panel_name,"errField_A_FSG_80_0_0_22",MakeRGB(255,255,255));
        A_FSG_80_0_0_22Changed_BTN_already_pressed = 1;
    }
    else 
    {
        currentPos = 0;
        //head Parameter
        headLength = getValueSize(A_FSG_80_0_0_22_Changed);
        getValue(A_FSG_80_0_0_22_Changed,head);
        for(i=0; i< headLength; i++)
        {
            data[currentPos++] = head[i];
        }
    //data Parameter
     startVal = getValue(A_FSG_80_0_0_22_Changed_Start);
     elementsVal = getValue(A_FSG_80_0_0_22_Changed_Elements);
     nibbleSetted = 0;
    if( (head[0]&0x20) == 0)
    {
     if( (head[0] & 0x10) > 0)
     {
        startVal++;
     }
     for( i = startVal ; i < startVal + elementsVal ; i++)
     {
       if( i < 0 || i >= A_FSG_80_0_0_22_ArrayDataList_Length )
       {
         write("Array index ausserhalb der Grenzen, Fct: 22");
         break;
       }
      if(nibbleSetted == 1) currentPos++;
      nibbleSetted = 0;
    //sollte der letzte Parameter ein first nibble gewesen sein, muss noch 1 increment durchgefuehrt werden
    if( nibbleSetted==1) currentPos++;
    nibbleSetted = 0;
     }
    }
    else
    {
     if( (head[0] & 0x10) > 0)
     {
        if(startVal != 0) startVal--;
        else
        {
           startVal = A_FSG_80_0_0_22_ArrayDataList_Length -1;
        }
     }
     for( i = startVal ; i > startVal - elementsVal ; i--)
     {
       if( i < 0 || i >= A_FSG_80_0_0_22_ArrayDataList_Length )
       {
         write("Array index ausserhalb der Grenzen, Fct: 22");
         break;
       }
      if(nibbleSetted == 1) currentPos++;
      nibbleSetted = 0;
    //sollte der letzte Parameter ein first nibble gewesen sein, muss noch 1 increment durchgefuehrt werden
    if( nibbleSetted==1) currentPos++;
    nibbleSetted = 0;
     }
    }

       Request_ByteSequence(LSGID, A_FSG_80_0_0_22_ID, Changed_REQ, data, currentPos);
       if(getValue(A_FSG_80_0_0_22_IntTlgEn)) //getValue(IT))
       {
           intertelegram_err(A_FSG_80_0_0_22_ID);
       }
       if(getValue(A_FSG_80_0_0_22_SegmEn))   //getvalue(SG)
       {
             sequence_err(A_FSG_80_0_0_22_ID,getValueSize(A_FSG_80_0_0_22_Changed));
       }
        A_FSG_80_0_0_22Changed_BTN_already_pressed = 0;
    }
}
on envVar A_FSG_80_0_0_22Status_BTN
{
    byte data[2045 + 5]; // array header (3 or 5 bytes), followed by payload.
    byte stringValue[2045];
    byte head[5];
    int i = 0;
    int j = 0;
    long StringLength = 0;
    int headLength;
    long tempValue;
    word currentPos;

    word startVal;
    word elementsVal;
    byte nibbleSetted;
    if (A_FSG_80_0_0_22Status_BTN_already_pressed == 0)
    {
        putValue(A_FSG_80_0_0_22_ErrCode,0);
        SetControlBackColor(panel_name,"errField_A_FSG_80_0_0_22",MakeRGB(255,255,255));
        A_FSG_80_0_0_22Status_BTN_already_pressed = 1;
    }
    else
    {
        currentPos = 0;
        //Einzelparameter: ASG_ID
        tempValue = getValue(A_FSG_80_0_0_22_1);
    if(nibbleSetted == 1)
    {
        //voriger Parameter war ein Nibble, => second nibble, Pos incr und Flag zuruecksetzen
        data[currentPos] = (tempValue &0x0F) | (data[currentPos] &0xF0);
        currentPos++;
        nibbleSetted = 0;
    }
    else
    {
        //first nibble, kein increment, Flag setzen
        data[currentPos] = (tempValue<<4) &0xF0;
        nibbleSetted = 1;
    }
        //Einzelparameter: TAID
        tempValue = getValue(A_FSG_80_0_0_22_2);
    if(nibbleSetted == 1)
    {
        //voriger Parameter war ein Nibble, => second nibble, Pos incr und Flag zuruecksetzen
        data[currentPos] = (tempValue &0x0F) | (data[currentPos] &0xF0);
        currentPos++;
        nibbleSetted = 0;
    }
    else
    {
        //first nibble, kein increment, Flag setzen
        data[currentPos] = (tempValue<<4) &0xF0;
        nibbleSetted = 1;
    }
        //Einzelparameter: TotalNumListElements
        tempValue = getValue(A_FSG_80_0_0_22_3);
        //voriger Parameter war ein first nibble, bei 1 Byte Werten Position incr
        if(nibbleSetted == 1) currentPos++;
        nibbleSetted = 0;
        data[currentPos++] = tempValue;
        //head Parameter
        headLength = getValueSize(A_FSG_80_0_0_22);
        getValue(A_FSG_80_0_0_22,head);
        for(i=0; i< headLength; i++)
        {
            data[currentPos++] = head[i];
        }
    //data Parameter
     startVal = getValue(A_FSG_80_0_0_22_Start);
     elementsVal = getValue(A_FSG_80_0_0_22_Elements);
     nibbleSetted = 0;
    if( (head[0]&0x20) == 0)
    {
     if( (head[0] & 0x10) > 0)
     {
        startVal++;
     }
     for( i = startVal ; i < startVal + elementsVal ; i++)
     {
       if( i < 0 || i >= A_FSG_80_0_0_22_ArrayDataList_Length )
       {
         write("Array index ausserhalb der Grenzen, Fct: 22");
         break;
       }
      if(nibbleSetted == 1) currentPos++;
      nibbleSetted = 0;
     if( (head[0]&0x40) == 0){ /* Transmit_Pos = 0, keine Positionsdaten */ }
     else
     {
        if( (head[0]&0x80) == 0)
        {
           //IndexSize = 0, Pos als 1 Byte Wert
           data[currentPos++] = A_FSG_80_0_0_22_ArrayDataList[i].Param1 & 0xFF;
        }
        else
        {
           //IndexSize = 1, Pos als 2 Byte Wert
           data[currentPos++] = A_FSG_80_0_0_22_ArrayDataList[i].Param1 & 0xFF;
           data[currentPos++] = (A_FSG_80_0_0_22_ArrayDataList[i].Param1 >> 8) & 0xFF;
        }
     }
      // Check if the current value of RecAdr enables the variable BTProfiles:
      if( 0 || 1 == getValue( A_FSG_80_0_0_22_RecAdr ) || 2 == getValue( A_FSG_80_0_0_22_RecAdr ) )
      {
        //Sollte vor einem 1 Byte Wert 1 Nibble kommen, muss der index um 1 incrementiert werden!
        if( nibbleSetted==1) currentPos++;
        nibbleSetted = 0;
        data[currentPos++] = (A_FSG_80_0_0_22_ArrayDataList[i].Param2 ) & 0xFF;
       }
      // Check if the current value of RecAdr enables the variable DeviceName:
      if( 0 || 1 == getValue( A_FSG_80_0_0_22_RecAdr ) || 3 == getValue( A_FSG_80_0_0_22_RecAdr ) )
      {
        //Sollte vor einem String Wert 1 Nibble kommen, muss der index um 1 incrementiert werden!
        if( nibbleSetted==1) currentPos++;
        nibbleSetted = 0;
        StringLength =A_FSG_80_0_0_22_ArrayDataList[i].Param3_Length;
		/* Pruefung ob die Laenge-Checkbox aktiv ist */
		if (1 == A_FSG_80_0_0_22_Data_3_CntList[i] )
		{
			if(StringLength >= 0 && StringLength <= 32767 && StringLength <= 100-2)
			{
				data[currentPos++] = ( (StringLength >> 8) & 0x7F ) | 0x80; //2Byte Flag (Bit 8) setzen + HighByte (erste 7 bit)
				data[currentPos++] = StringLength &0xFF;
			}
			else
			{
				writelineEx(gBAP_Trace, 0, "Eingegebene Laenge: %d von A_FSG_80_0_0_22_Data_3 mit Record Nr. %d ist ungueltig. Die max. erlaubte Laenge ist %d.", StringLength, i, 100-2);
				return;
			}
		}
		else if(0 == A_FSG_80_0_0_22_Data_3_CntList[i] ) /*check box deaktiviert*/
		{
			if(StringLength >= 0 && StringLength <= 127 && StringLength <= 100-1)
			{
				data[currentPos++] = StringLength & 0x7F; //Bit 8 = 0
			}
			else
			{
				writelineEx(gBAP_Trace, 0, "Eingegebene Laenge: %d von A_FSG_80_0_0_22_Data_3 mit Record Nr. %d ist ungueltig. Die max. erlaubte Laenge ist %d. ", StringLength, i, 100-1);
				return;
			}
		}
        for(j=0; j < StringLength ; j++)
        {
            data[currentPos++] = A_FSG_80_0_0_22_ArrayDataList[i].Param3[j];
        }
       }
    //sollte der letzte Parameter ein first nibble gewesen sein, muss noch 1 increment durchgefuehrt werden
    if( nibbleSetted==1) currentPos++;
    nibbleSetted = 0;
     }
    }
    else
    {
     if( (head[0] & 0x10) > 0)
     {
        if(startVal != 0) startVal--;
        else
        {
           startVal = A_FSG_80_0_0_22_ArrayDataList_Length -1;
        }
     }
     for( i = startVal ; i > startVal - elementsVal ; i--)
     {
       if( i < 0 || i >= A_FSG_80_0_0_22_ArrayDataList_Length )
       {
         write("Array index ausserhalb der Grenzen, Fct: 22");
         break;
       }
      if(nibbleSetted == 1) currentPos++;
      nibbleSetted = 0;
     if( (head[0]&0x40) == 0){ /* Transmit_Pos = 0, keine Positionsdaten */ }
     else
     {
        if( (head[0]&0x80) == 0)
        {
           //IndexSize = 0, Pos als 1 Byte Wert
           data[currentPos++] = A_FSG_80_0_0_22_ArrayDataList[i].Param1 & 0xFF;
        }
        else
        {
           //IndexSize = 1, Pos als 2 Byte Wert
           data[currentPos++] = A_FSG_80_0_0_22_ArrayDataList[i].Param1 & 0xFF;
           data[currentPos++] = (A_FSG_80_0_0_22_ArrayDataList[i].Param1 >> 8) & 0xFF;
        }
     }
      // Check if the current value of RecAdr enables the variable BTProfiles:
      if( 0 || 1 == getValue( A_FSG_80_0_0_22_RecAdr ) || 2 == getValue( A_FSG_80_0_0_22_RecAdr ) )
      {
        //Sollte vor einem 1 Byte Wert 1 Nibble kommen, muss der index um 1 incrementiert werden!
        if( nibbleSetted==1) currentPos++;
        nibbleSetted = 0;
        data[currentPos++] = (A_FSG_80_0_0_22_ArrayDataList[i].Param2 ) & 0xFF;
       }
      // Check if the current value of RecAdr enables the variable DeviceName:
      if( 0 || 1 == getValue( A_FSG_80_0_0_22_RecAdr ) || 3 == getValue( A_FSG_80_0_0_22_RecAdr ) )
      {
        //Sollte vor einem String Wert 1 Nibble kommen, muss der index um 1 incrementiert werden!
        if( nibbleSetted==1) currentPos++;
        nibbleSetted = 0;
        StringLength =A_FSG_80_0_0_22_ArrayDataList[i].Param3_Length;
		/* Pruefung ob die Laenge-Checkbox aktiv ist */
		if (1 == A_FSG_80_0_0_22_Data_3_CntList[i] )
		{
			if(StringLength >= 0 && StringLength <= 32767 && StringLength <= 100-2)
			{
				data[currentPos++] = ( (StringLength >> 8) & 0x7F ) | 0x80; //2Byte Flag (Bit 8) setzen + HighByte (erste 7 bit)
				data[currentPos++] = StringLength &0xFF;
			}
			else
			{
				writelineEx(gBAP_Trace, 0, "Eingegebene Laenge: %d von A_FSG_80_0_0_22_Data_3 mit Record Nr. %d ist ungueltig. Die max. erlaubte Laenge ist %d.", StringLength, i, 100-2);
				return;
			}
		}
		else if(0 == A_FSG_80_0_0_22_Data_3_CntList[i] ) /*check box deaktiviert*/
		{
			if(StringLength >= 0 && StringLength <= 127 && StringLength <= 100-1)
			{
				data[currentPos++] = StringLength & 0x7F; //Bit 8 = 0
			}
			else
			{
				writelineEx(gBAP_Trace, 0, "Eingegebene Laenge: %d von A_FSG_80_0_0_22_Data_3 mit Record Nr. %d ist ungueltig. Die max. erlaubte Laenge ist %d. ", StringLength, i, 100-1);
				return;
			}
		}
        for(j=0; j < StringLength ; j++)
        {
            data[currentPos++] = A_FSG_80_0_0_22_ArrayDataList[i].Param3[j];
        }
       }
    //sollte der letzte Parameter ein first nibble gewesen sein, muss noch 1 increment durchgefuehrt werden
    if( nibbleSetted==1) currentPos++;
    nibbleSetted = 0;
     }
    }

        //getValue(A_FSG_80_0_0_22, data);
        Request_ByteSequence(LSGID, A_FSG_80_0_0_22_ID, Data_REQ, data,currentPos);
        if(getValue(A_FSG_80_0_0_22_IntTlgEn)) //getValue(IT))
        {
            intertelegram_err(A_FSG_80_0_0_22_ID);
        }
        if(getValue(A_FSG_80_0_0_22_SegmEn))   //getvalue(SG)
        {
            sequence_err(A_FSG_80_0_0_22_ID,getValueSize(A_FSG_80_0_0_22));
        }
        A_FSG_80_0_0_22Status_BTN_already_pressed = 0;
    }
}
A_FSG_80_0_0_22_SendStatus()
{
    word currentPos;
    word headLength;
    int i;
    int j;
    word StringLength;
    long tempValue;
    word startVal;
    word elementsVal;
    byte data[2045];
    byte stringValue[2045];
    byte head[5];
    byte nibbleSetted;
    nibbleSetted = 0;
        currentPos = 0;
        //Einzelparameter: ASG_ID
        tempValue = getValue(A_FSG_80_0_0_22_1);
    if(nibbleSetted == 1)
    {
        //voriger Parameter war ein Nibble, => second nibble, Pos incr und Flag zuruecksetzen
        data[currentPos] = (tempValue &0x0F) | (data[currentPos] &0xF0);
        currentPos++;
        nibbleSetted = 0;
    }
    else
    {
        //first nibble, kein increment, Flag setzen
        data[currentPos] = (tempValue<<4) &0xF0;
        nibbleSetted = 1;
    }
        //Einzelparameter: TAID
        tempValue = getValue(A_FSG_80_0_0_22_2);
    if(nibbleSetted == 1)
    {
        //voriger Parameter war ein Nibble, => second nibble, Pos incr und Flag zuruecksetzen
        data[currentPos] = (tempValue &0x0F) | (data[currentPos] &0xF0);
        currentPos++;
        nibbleSetted = 0;
    }
    else
    {
        //first nibble, kein increment, Flag setzen
        data[currentPos] = (tempValue<<4) &0xF0;
        nibbleSetted = 1;
    }
        //Einzelparameter: TotalNumListElements
        tempValue = getValue(A_FSG_80_0_0_22_3);
        //voriger Parameter war ein first nibble, bei 1 Byte Werten Position incr
        if(nibbleSetted == 1) currentPos++;
        nibbleSetted = 0;
        data[currentPos++] = tempValue;
        //head Parameter
        headLength = getValueSize(A_FSG_80_0_0_22);
        getValue(A_FSG_80_0_0_22,head);
        for(i=0; i< headLength; i++)
        {
            data[currentPos++] = head[i];
        }
    //data Parameter
     startVal = getValue(A_FSG_80_0_0_22_Start);
     elementsVal = getValue(A_FSG_80_0_0_22_Elements);
     nibbleSetted = 0;
    if( (head[0]&0x20) == 0)
    {
     if( (head[0] & 0x10) > 0)
     {
        startVal++;
     }
     for( i = startVal ; i < startVal + elementsVal ; i++)
     {
       if( i < 0 || i >= A_FSG_80_0_0_22_ArrayDataList_Length )
       {
         write("Array index ausserhalb der Grenzen, Fct: 22");
         break;
       }
      if(nibbleSetted == 1) currentPos++;
      nibbleSetted = 0;
     if( (head[0]&0x40) == 0){ /* Transmit_Pos = 0, keine Positionsdaten */ }
     else
     {
        if( (head[0]&0x80) == 0)
        {
           //IndexSize = 0, Pos als 1 Byte Wert
           data[currentPos++] = A_FSG_80_0_0_22_ArrayDataList[i].Param1 & 0xFF;
        }
        else
        {
           //IndexSize = 1, Pos als 2 Byte Wert
           data[currentPos++] = A_FSG_80_0_0_22_ArrayDataList[i].Param1 & 0xFF;
           data[currentPos++] = (A_FSG_80_0_0_22_ArrayDataList[i].Param1 >> 8) & 0xFF;
        }
     }
      // Check if the current value of RecAdr enables the variable BTProfiles:
      if( 0 || 1 == getValue( A_FSG_80_0_0_22_RecAdr ) || 2 == getValue( A_FSG_80_0_0_22_RecAdr ) )
      {
        //Sollte vor einem 1 Byte Wert 1 Nibble kommen, muss der index um 1 incrementiert werden!
        if( nibbleSetted==1) currentPos++;
        nibbleSetted = 0;
        data[currentPos++] = (A_FSG_80_0_0_22_ArrayDataList[i].Param2 ) & 0xFF;
       }
      // Check if the current value of RecAdr enables the variable DeviceName:
      if( 0 || 1 == getValue( A_FSG_80_0_0_22_RecAdr ) || 3 == getValue( A_FSG_80_0_0_22_RecAdr ) )
      {
        //Sollte vor einem String Wert 1 Nibble kommen, muss der index um 1 incrementiert werden!
        if( nibbleSetted==1) currentPos++;
        nibbleSetted = 0;
        StringLength =A_FSG_80_0_0_22_ArrayDataList[i].Param3_Length;
		/* Pruefung ob die Laenge-Checkbox aktiv ist */
		if (1 == A_FSG_80_0_0_22_Data_3_CntList[i] )
		{
			if(StringLength >= 0 && StringLength <= 32767 && StringLength <= 100-2)
			{
				data[currentPos++] = ( (StringLength >> 8) & 0x7F ) | 0x80; //2Byte Flag (Bit 8) setzen + HighByte (erste 7 bit)
				data[currentPos++] = StringLength &0xFF;
			}
			else
			{
				writelineEx(gBAP_Trace, 0, "Eingegebene Laenge: %d von A_FSG_80_0_0_22_Data_3 mit Record Nr. %d ist ungueltig. Die max. erlaubte Laenge ist %d.", StringLength, i, 100-2);
				return;
			}
		}
		else if(0 == A_FSG_80_0_0_22_Data_3_CntList[i] ) /*check box deaktiviert*/
		{
			if(StringLength >= 0 && StringLength <= 127 && StringLength <= 100-1)
			{
				data[currentPos++] = StringLength & 0x7F; //Bit 8 = 0
			}
			else
			{
				writelineEx(gBAP_Trace, 0, "Eingegebene Laenge: %d von A_FSG_80_0_0_22_Data_3 mit Record Nr. %d ist ungueltig. Die max. erlaubte Laenge ist %d. ", StringLength, i, 100-1);
				return;
			}
		}
        for(j=0; j < StringLength ; j++)
        {
            data[currentPos++] = A_FSG_80_0_0_22_ArrayDataList[i].Param3[j];
        }
       }
    //sollte der letzte Parameter ein first nibble gewesen sein, muss noch 1 increment durchgefuehrt werden
    if( nibbleSetted==1) currentPos++;
    nibbleSetted = 0;
     }
    }
    else
    {
     if( (head[0] & 0x10) > 0)
     {
        if(startVal != 0) startVal--;
        else
        {
           startVal = A_FSG_80_0_0_22_ArrayDataList_Length -1;
        }
     }
     for( i = startVal ; i > startVal - elementsVal ; i--)
     {
       if( i < 0 || i >= A_FSG_80_0_0_22_ArrayDataList_Length )
       {
         write("Array index ausserhalb der Grenzen, Fct: 22");
         break;
       }
      if(nibbleSetted == 1) currentPos++;
      nibbleSetted = 0;
     if( (head[0]&0x40) == 0){ /* Transmit_Pos = 0, keine Positionsdaten */ }
     else
     {
        if( (head[0]&0x80) == 0)
        {
           //IndexSize = 0, Pos als 1 Byte Wert
           data[currentPos++] = A_FSG_80_0_0_22_ArrayDataList[i].Param1 & 0xFF;
        }
        else
        {
           //IndexSize = 1, Pos als 2 Byte Wert
           data[currentPos++] = A_FSG_80_0_0_22_ArrayDataList[i].Param1 & 0xFF;
           data[currentPos++] = (A_FSG_80_0_0_22_ArrayDataList[i].Param1 >> 8) & 0xFF;
        }
     }
      // Check if the current value of RecAdr enables the variable BTProfiles:
      if( 0 || 1 == getValue( A_FSG_80_0_0_22_RecAdr ) || 2 == getValue( A_FSG_80_0_0_22_RecAdr ) )
      {
        //Sollte vor einem 1 Byte Wert 1 Nibble kommen, muss der index um 1 incrementiert werden!
        if( nibbleSetted==1) currentPos++;
        nibbleSetted = 0;
        data[currentPos++] = (A_FSG_80_0_0_22_ArrayDataList[i].Param2 ) & 0xFF;
       }
      // Check if the current value of RecAdr enables the variable DeviceName:
      if( 0 || 1 == getValue( A_FSG_80_0_0_22_RecAdr ) || 3 == getValue( A_FSG_80_0_0_22_RecAdr ) )
      {
        //Sollte vor einem String Wert 1 Nibble kommen, muss der index um 1 incrementiert werden!
        if( nibbleSetted==1) currentPos++;
        nibbleSetted = 0;
        StringLength =A_FSG_80_0_0_22_ArrayDataList[i].Param3_Length;
		/* Pruefung ob die Laenge-Checkbox aktiv ist */
		if (1 == A_FSG_80_0_0_22_Data_3_CntList[i] )
		{
			if(StringLength >= 0 && StringLength <= 32767 && StringLength <= 100-2)
			{
				data[currentPos++] = ( (StringLength >> 8) & 0x7F ) | 0x80; //2Byte Flag (Bit 8) setzen + HighByte (erste 7 bit)
				data[currentPos++] = StringLength &0xFF;
			}
			else
			{
				writelineEx(gBAP_Trace, 0, "Eingegebene Laenge: %d von A_FSG_80_0_0_22_Data_3 mit Record Nr. %d ist ungueltig. Die max. erlaubte Laenge ist %d.", StringLength, i, 100-2);
				return;
			}
		}
		else if(0 == A_FSG_80_0_0_22_Data_3_CntList[i] ) /*check box deaktiviert*/
		{
			if(StringLength >= 0 && StringLength <= 127 && StringLength <= 100-1)
			{
				data[currentPos++] = StringLength & 0x7F; //Bit 8 = 0
			}
			else
			{
				writelineEx(gBAP_Trace, 0, "Eingegebene Laenge: %d von A_FSG_80_0_0_22_Data_3 mit Record Nr. %d ist ungueltig. Die max. erlaubte Laenge ist %d. ", StringLength, i, 100-1);
				return;
			}
		}
        for(j=0; j < StringLength ; j++)
        {
            data[currentPos++] = A_FSG_80_0_0_22_ArrayDataList[i].Param3[j];
        }
       }
    //sollte der letzte Parameter ein first nibble gewesen sein, muss noch 1 increment durchgefuehrt werden
    if( nibbleSetted==1) currentPos++;
    nibbleSetted = 0;
     }
    }
    Request_byteSequence(LSGID, A_FSG_80_0_0_22_ID, Data_REQ, data, currentPos);
}
on envVar A_FSG_80_0_0_22
{
    byte temp[2045];
    getValue(A_FSG_80_0_0_22, temp);
    putValue(A_FSG_80_0_0_22_RecAdr, 0x0F & temp[0]); //Record Address = Bit 0-3 von Byte 0
    if ( (0x10 & temp[0]) >0)
        putValue(A_FSG_80_0_0_22_Shift, 1); //Shift = Bit 4 von Byte 0
    else
        putValue(A_FSG_80_0_0_22_Shift, 0); //Shift = Bit 4 von Byte 0
    if ( (0x20 & temp[0]) >0)
        putValue(A_FSG_80_0_0_22_Direction, 1); //Direction = Bit 5 von Byte 0
    else
        putValue(A_FSG_80_0_0_22_Direction, 0); //Direction = Bit 5 von Byte 0
    if ( (0x40 & temp[0]) >0)
        putValue(A_FSG_80_0_0_22_TransPos, 1); //Transmission Pos = Bit 6 von Byte 0
    else
        putValue(A_FSG_80_0_0_22_TransPos, 0); //Transmission Pos = Bit 6 von Byte 0
    if ( (0x80 & temp[0]) >0)
        putValue(A_FSG_80_0_0_22_IndexSize, 1); //IndexSize = Bit 7 von Byte 0
    else
        putValue(A_FSG_80_0_0_22_IndexSize, 0); //IndexSize = Bit 7 von Byte 0
    if(getValue(A_FSG_80_0_0_22_IndexSize))
    {
        putValue(A_FSG_80_0_0_22_Start, ((temp[2]<<8)| temp[1]) ); // Array Start index, 2 Byte.
        putValue(A_FSG_80_0_0_22_Elements, ((temp[4]<<8)| temp[3]) ); // Array element count, 2 Byte.
    }
    else
    {
        putValue(A_FSG_80_0_0_22_Start, temp[1]); // Array Start index, 1 Byte.
        putValue(A_FSG_80_0_0_22_Elements, temp[2]); // Array element count, 1 Byte.
    }
}
A_FSG_80_0_0_22_GenerateStatus()
{
    byte head[5];
    int i = 0;
    int headLength;
    long tempValue;
    int currentPos;
    //Record Address in Byte 0 Bit 0-3 kopieren - MAX Wert = 0x0F
    if(getValue(A_FSG_80_0_0_22_RecAdr) > 0x0F)
        putValue(A_FSG_80_0_0_22_RecAdr , 0x0F);
    head[0] = (head[0] & 0xF0) | getValue(A_FSG_80_0_0_22_RecAdr);
    //Shift Bit in Byte 0 Bit 4 kopieren
    if( getValue(A_FSG_80_0_0_22_Shift) > 0) head[0] = head[0] | 0x10;
    else head[0] = head[0] & 0xEF;
    // Direction Bit in Byte 0 Bit 5 kopieren
    if( getValue(A_FSG_80_0_0_22_Direction) > 0) head[0] = head[0] | 0x20;
    else head[0] = head[0] & 0xDF;
    // TransmissionPos Bit in Byte 0 Bit 6 kopieren
    if( getValue(A_FSG_80_0_0_22_TransPos) > 0) head[0] = head[0] | 0x40;
    else head[0] = head[0] & 0xBF;
    if( getValue(A_FSG_80_0_0_22_IndexSize) > 0)
    {
        // 5 Byte Header
        head[0] = head[0] | 0x80;
        head[1] =  getValue(A_FSG_80_0_0_22_Start) & 0xFF;
        head[2] = (getValue(A_FSG_80_0_0_22_Start) >> 8 ) & 0xFF;
        head[3] =  getValue(A_FSG_80_0_0_22_Elements) & 0xFF;
        head[4] = (getValue(A_FSG_80_0_0_22_Elements)  >> 8 ) & 0xFF;
        //ToDo: DATA - derzeit einfach laenge = 5
        headLength = 5;
    }
    else 
    {
        // 3 Byte Header
        head[0] = head[0] & 0x7F;
        head[1] = getValue(A_FSG_80_0_0_22_Start) & 0xFF;
        head[2] = getValue(A_FSG_80_0_0_22_Elements) & 0xFF;
        //ToDo: DATA - derzeit einfach laenge = 3
        headLength = 3;
    }

    currentPos = 0;

    putValue(A_FSG_80_0_0_22, head, headLength); 
}

on envVar A_FSG_80_0_0_22_RecAdr
{
    A_FSG_80_0_0_22_GenerateStatus();
}

on envVar A_FSG_80_0_0_22_Shift
{
    A_FSG_80_0_0_22_GenerateStatus();
}

on envVar A_FSG_80_0_0_22_Direction
{
    A_FSG_80_0_0_22_GenerateStatus();
}

on envVar A_FSG_80_0_0_22_Start
{
    A_FSG_80_0_0_22_GenerateStatus();
}

on envVar A_FSG_80_0_0_22_Elements
{
    A_FSG_80_0_0_22_GenerateStatus();
}

on envVar A_FSG_80_0_0_22_IndexSize
{
    A_FSG_80_0_0_22_GenerateStatus();
}
on envVar A_FSG_80_0_0_22_TransPos
{
    A_FSG_80_0_0_22_GenerateStatus();
}
A_FSG_80_0_0_22_Changed_GenerateChanged()
{
    byte head[5];
    //Record Address in Byte 0 Bit 0-3 kopieren - MAX Wert = 0x0F
    if(getValue(A_FSG_80_0_0_22_Changed_RecAdr) > 0x0F)
        putValue(A_FSG_80_0_0_22_Changed_RecAdr , 0x0F);
    head[0] = (head[0] & 0xF0) | getValue(A_FSG_80_0_0_22_Changed_RecAdr);
    //Shift Bit in Byte 0 Bit 4 kopieren
    if( getValue(A_FSG_80_0_0_22_Changed_Shift) > 0) head[0] = head[0] | 0x10;
    else head[0] = head[0] & 0xEF;
    // Direction Bit in Byte 0 Bit 5 kopieren
    if( getValue(A_FSG_80_0_0_22_Changed_Direction) > 0) head[0] = head[0] | 0x20;
    else head[0] = head[0] & 0xDF;
    // TransmissionPos Bit in Byte 0 Bit 6 kopieren
    if( getValue(A_FSG_80_0_0_22_Changed_TransPos) > 0) head[0] = head[0] | 0x40;
    else head[0] = head[0] & 0xBF;
    if( getValue(A_FSG_80_0_0_22_Changed_IndexSize) > 0)
    {
        // 5 Byte Header
        head[0] = head[0] | 0x80;
        head[1] =  getValue(A_FSG_80_0_0_22_Changed_Start) & 0xFF;
        head[2] = (getValue(A_FSG_80_0_0_22_Changed_Start) >> 8 ) & 0xFF;
        head[3] =  getValue(A_FSG_80_0_0_22_Changed_Elements) & 0xFF;
        head[4] = (getValue(A_FSG_80_0_0_22_Changed_Elements)  >> 8 ) & 0xFF;
        //ToDo: DATA - derzeit einfach laenge = 5
        putValue(A_FSG_80_0_0_22_Changed, head, 5); 
    }
    else 
    {
        // 3 Byte Header
        head[0] = head[0] & 0x7F;
        head[1] = getValue(A_FSG_80_0_0_22_Changed_Start) & 0xFF;
        head[2] = getValue(A_FSG_80_0_0_22_Changed_Elements) & 0xFF;
        //ToDo: DATA - derzeit einfach laenge = 3
        putValue(A_FSG_80_0_0_22_Changed, head, 3); 
    }
}

on envVar A_FSG_80_0_0_22_Changed_RecAdr
{
    A_FSG_80_0_0_22_Changed_GenerateChanged();
}

on envVar A_FSG_80_0_0_22_Changed_Shift
{
    A_FSG_80_0_0_22_Changed_GenerateChanged();
}

on envVar A_FSG_80_0_0_22_Changed_Direction
{
    A_FSG_80_0_0_22_Changed_GenerateChanged();
}

on envVar A_FSG_80_0_0_22_Changed_Start
{
    A_FSG_80_0_0_22_Changed_GenerateChanged();
}

on envVar A_FSG_80_0_0_22_Changed_Elements
{
    A_FSG_80_0_0_22_Changed_GenerateChanged();
}

on envVar A_FSG_80_0_0_22_Changed_IndexSize
{
    A_FSG_80_0_0_22_Changed_GenerateChanged();
}
on envVar A_FSG_80_0_0_22_Changed_TransPos
{
    A_FSG_80_0_0_22_Changed_GenerateChanged();
}
on envVar A_FSG_80_0_0_22_SetGet
{
    byte temp[2045];
    getValue(A_FSG_80_0_0_22_SetGet, temp);
    putValue(A_FSG_80_0_0_22_SetGet_RecAdr, 0x0F & temp[0]); //Record Address = Bit 0-3 von Byte 0
    if ( (0x10 & temp[0]) >0)
        putValue(A_FSG_80_0_0_22_SetGet_Shift, 1); //Shift = Bit 4 von Byte 0
    else
        putValue(A_FSG_80_0_0_22_SetGet_Shift, 0); //Shift = Bit 4 von Byte 0
    if ( (0x20 & temp[0]) >0)
        putValue(A_FSG_80_0_0_22_SetGet_Direction, 1); //Direction = Bit 5 von Byte 0
    else
        putValue(A_FSG_80_0_0_22_SetGet_Direction, 0); //Direction = Bit 5 von Byte 0
    // Bit 6 von Byte 0 = reserved
    if ( (0x80 & temp[0]) >0)
        putValue(A_FSG_80_0_0_22_SetGet_IndexSize, 1); //IndexSize = Bit 7 von Byte 0
    else
        putValue(A_FSG_80_0_0_22_SetGet_IndexSize, 0); //IndexSize = Bit 7 von Byte 0
    if(getValue(A_FSG_80_0_0_22_SetGet_IndexSize))
    {
        putValue(A_FSG_80_0_0_22_SetGet_Start, ((temp[2]<<8)| temp[1]) ); //Start Wert, 2 Byte lang
        putValue(A_FSG_80_0_0_22_SetGet_Elements, ((temp[4]<<8)| temp[3]) ); //Elements Wert, 2 Byte lang
    }
    else
    {
        putValue(A_FSG_80_0_0_22_SetGet_Start, temp[1]); //Start Wert, 1 Byte lang
        putValue(A_FSG_80_0_0_22_SetGet_Elements, temp[2]); //Start Wert, 1 Byte lang
    }
}
A_FSG_80_0_0_22_LoadArray()
{
	/********* Statische Deklarationen ***********/
	dword CSVfileHandle;
	dword filePos;
	dword paramPos;
	dword Num_of_csv_byte;
	dword element;
	dword current_CSV_line;
	byte buffer_byte[0xFFFF];
	dword i;
	dword j;
	char CSV_filename[255];
	dword  count1 =0, count2 =0;
	char CSV_filepath[0xFFFF];

	/********* Param Puffer Deklarationen ***********/
	char temp1[25];
	char temp2[25];

	/********* Initialisierungen ***********/
	CSVfileHandle = 0;
	filePos = 0;
	paramPos = 0;
	Num_of_csv_byte = 0;
	element = 1;
	current_CSV_line = 0;
	for(i = 0; i < A_FSG_80_0_0_22_ArrayDataList_Length; i++)
	{ /* Initialisierung von den Ziel-Strukturen */
		A_FSG_80_0_0_22_ArrayDataList[i].Param1 = 0;
		A_FSG_80_0_0_22_ArrayDataList[i].Param2 = 0;
		for(j=0; j<100; j++)
			A_FSG_80_0_0_22_ArrayDataList[i].Param3[j] = 0;
		A_FSG_80_0_0_22_ArrayDataList[i].Param3_Length = 0;
		A_FSG_80_0_0_22_Data_3_LenList[i] = 0;
	}
	for(i=0;i<0xFFFF;i++)
		CSV_filepath[i] =0;
	/********* Laden der CSV-Datei ***********/
	getValue(A_FSG_80_0_0_22_fileSelector, CSV_filepath);
	i =0;
	while (CSV_filepath[i] !=0) //scan "path"
	{
		if(CSV_filepath[i] ==0x5C) //count "/" to seperate later "path" & "filename" 
				count1++;
		//write("Path[%d] of *.csv: %x",i, CSV_filepath[i]); //debug
		i++;
	}  
	 
	i =0; j =0; //reset values
	while (CSV_filepath[i] !=0) //seperate "path" and "filename"
	{
		if(count2==count1) //get filename after last "\"
		{              
			CSV_filename[j] =CSV_filepath[i];
			j++;
			CSV_filepath[i] =0;              
		}
		if(CSV_filepath[i]==0x5C) //count "\" to get filename after last "\"            
			count2++;   
		i++;
	}
	setFilePath(CSV_filepath, 0); //set path for *.csv file
	CSVfileHandle = openFileRead(CSV_filename, 1); //open *.csv (binary-mode ->get the ASCII/UTF-8 code)

	if (CSVfileHandle!=0) //*.csv file access successful
	{
		writelineEx(gBAP_Trace, 0,"Dateizugriff auf '%s' erfolgreich", CSV_filename);    //output result
		//get data from *.csv and store the total number of byte in *.csv-file
		Num_of_csv_byte = fileGetBinaryBlock (buffer_byte, elcount(buffer_byte), CSVfileHandle);

		for (filePos = 0; filePos < Num_of_csv_byte; filePos++) //copy data into "LastDestList"
		{
			if (buffer_byte[filePos] != 0x3B) //read data if no ";" is detected
			{
				//nextline in *.csv (next "record element" in LastDestList) -> "LF" and "CR" detected -> copy (transform string -> long) data from help values in global values
				if(buffer_byte[filePos] == 0x0D && buffer_byte[filePos+1] == 0x0A)
				{
					if(current_CSV_line > 0 && current_CSV_line < 256) //ignore first line in *.csv file
					{
						A_FSG_80_0_0_22_ArrayDataList[current_CSV_line-1].Param1 = atol(temp1); //Pos
						A_FSG_80_0_0_22_ArrayDataList[current_CSV_line-1].Param2 = atol(temp2); //BTProfiles
						for(i = 0; i < 25; i++)
						{ /* Temp-Puffer Initialisierung zur Vermeidung von Nebeneffekte */
							temp1[i]=0;
							temp2[i]=0;
						}
					}
					current_CSV_line++; //next line in *.csv file
					element = 1; //start at 'POS' (first record element of "array data")
					paramPos = 0; //reset value
				}
 				//copy data from "buffer_byte" (data from *.csv file) in help values and "name" until end of line is not detected
				else if(current_CSV_line > 0 && current_CSV_line < 256)
				{
					//writelineEx(gBAP_Trace, 0, "Element %x  Index %x", element, j);
					switch (element)
					{
						case 1: //Pos
								if( paramPos >= elCount(temp1) ){
									writelineEx(gBAP_Trace, 0, "Param%x in Zeile %d in der Input CSV Datei, enthaelt mehr Zeichen als erlaubt. Bearbeitung abgebrochen!", element, current_CSV_line);
									return; //False
								}else{
									temp1[paramPos] = buffer_byte[filePos];
									paramPos++;
								}
							break;
						case 2: //BTProfiles
								if( paramPos >= elCount(temp2) ){
									writelineEx(gBAP_Trace, 0, "Param%x in Zeile %d in der Input CSV Datei, enthaelt mehr Zeichen als erlaubt. Bearbeitung abgebrochen!", element, current_CSV_line);
									return; //False
								}else{
									temp2[paramPos] = buffer_byte[filePos];
									paramPos++;
								}
							break;
						case 3: //DeviceName
								if(paramPos < 99)
								{
									A_FSG_80_0_0_22_ArrayDataList[current_CSV_line-1].Param3[paramPos] = buffer_byte[filePos];
									A_FSG_80_0_0_22_ArrayDataList[current_CSV_line-1].Param3_Length = paramPos +1;
								}
								paramPos++;
						break;
						default:
						break;
					}
				}
			}
			else  // ";" is detected ->next record element of "array data"
			{
				//writelineEx(gBAP_Trace, 0, "naechstes Element %d Bytes",element);
				element++;
				paramPos=0; //reset value
			}
		}

		if(fileClose (CSVfileHandle) !=0) //close *.csv file
			writelineEx(gBAP_Trace, 0,"Datei '%s' geschlossen", CSV_filename); //output result
		else
			writelineEx(gBAP_Trace, 0,"Fehler beim Schliessen der Datei '%s'", CSV_filename);//output result
	}
	else //*.csv file access not successful
	{
		writelineEx(gBAP_Trace, 0,"Fehler beim Dateizugriff auf '%s'",CSV_filename); //output result
	}
}

on envVar A_FSG_80_0_0_22_loadArray_Btn
{
	char filePath[255];
	if (A_FSG_80_0_0_22_generateData_Btn_already_pressed == 0)
	{
		A_FSG_80_0_0_22_generateData_Btn_already_pressed = 1;
	}
	else
	{
		A_FSG_80_0_0_22_generateData_Btn_already_pressed = 0;
		getValue(A_FSG_80_0_0_22_fileSelector, filePath);
		if(0 == strlen(filePath))
		{
			writelineEx(gBAP_Trace, 0, "Invalid file path!");
		}
		else
		{
			A_FSG_80_0_0_22_LoadArray();
			writelineEx(gBAP_Trace, 0, "Load array from CSV file: %s", filePath);
		}
	}
	putValue(A_FSG_80_0_0_22_Data_1, A_FSG_80_0_0_22_ArrayDataList[ getValue( A_FSG_80_0_0_22_DataIndex) ].Param1);
	putValue(A_FSG_80_0_0_22_Data_2, A_FSG_80_0_0_22_ArrayDataList[ getValue( A_FSG_80_0_0_22_DataIndex) ].Param2);
	putValue(A_FSG_80_0_0_22_Data_3, A_FSG_80_0_0_22_ArrayDataList[ getValue( A_FSG_80_0_0_22_DataIndex) ].Param3, A_FSG_80_0_0_22_ArrayDataList[getValue(A_FSG_80_0_0_22_DataIndex)].Param3_Length);
}


on envVar A_FSG_80_0_0_22_generateData_Btn
{
	word i;
	dword elementsArray[4] = {1, 1, 100, 2};
	byte elementsTypeArray[4] = {0, 0, 0xE, 0xF};
	dword elementsMaxSizeArray[4] = {255, 0xFF, 0, 0};
	byte tempArray[26520];
	if (A_FSG_80_0_0_22_generateData_Btn_already_pressed == 0)
	{
		A_FSG_80_0_0_22_generateData_Btn_already_pressed = 1;
	}
	else
	{
		initStruct(tempArray, elementsArray, elementsTypeArray, elementsMaxSizeArray, 22, 255 );
		for(i = 0; i < 255; i++)
		{
			memcpy(A_FSG_80_0_0_22_ArrayDataList[i], tempArray, (i * 104) );
			if(A_FSG_80_0_0_22_ArrayDataList[i].Param3_Length > 127 )
				A_FSG_80_0_0_22_Data_3_CntList[i] = 1;
		}
		A_FSG_80_0_0_22_generateData_Btn_already_pressed = 0;
	}
	putValue(A_FSG_80_0_0_22_Data_1, A_FSG_80_0_0_22_ArrayDataList[ getValue( A_FSG_80_0_0_22_DataIndex) ].Param1);
	putValue(A_FSG_80_0_0_22_Data_2, A_FSG_80_0_0_22_ArrayDataList[ getValue( A_FSG_80_0_0_22_DataIndex) ].Param2);
	putValue(A_FSG_80_0_0_22_Data_3, A_FSG_80_0_0_22_ArrayDataList[ getValue( A_FSG_80_0_0_22_DataIndex) ].Param3, A_FSG_80_0_0_22_ArrayDataList[getValue(A_FSG_80_0_0_22_DataIndex)].Param3_Length);
}
// HME generateCaplOnEnv (3131)
on envVar A_FSG_80_0_0_22_DataIndex
{
    long index;
    long maxIndex = 255-1;
    index = getValue(this);
    if(index >= maxIndex) index = maxIndex;
    else if(index < 0) index = 0;
    putValue(this, index);
    putValue(A_FSG_80_0_0_22_Data_1, A_FSG_80_0_0_22_ArrayDataList[index].Param1);
    putValue(A_FSG_80_0_0_22_Data_2, A_FSG_80_0_0_22_ArrayDataList[index].Param2);
    putValue(A_FSG_80_0_0_22_Data_3_len, A_FSG_80_0_0_22_Data_3_LenList[index]);
    putValue(A_FSG_80_0_0_22_Data_3_cnt, A_FSG_80_0_0_22_Data_3_CntList[index]);
    putValue(A_FSG_80_0_0_22_Data_3, A_FSG_80_0_0_22_ArrayDataList[index].Param3, A_FSG_80_0_0_22_ArrayDataList[index].Param3_Length);

}
on envVar A_FSG_80_0_0_22_DataIndex_Incr
{
    long index;
    if(A_FSG_80_0_0_22_DataIndex_Incr_already_pressed == 0)
    {
        A_FSG_80_0_0_22_DataIndex_Incr_already_pressed = 1;
    }
    else
    {
        index = getValue(A_FSG_80_0_0_22_DataIndex);
        index++;
        putValue(A_FSG_80_0_0_22_DataIndex, index);
        A_FSG_80_0_0_22_DataIndex_Incr_already_pressed = 0;
    }
}
on envVar A_FSG_80_0_0_22_DataIndex_Decr
{
    long index;
    if(A_FSG_80_0_0_22_DataIndex_Decr_already_pressed == 0)
    {
        A_FSG_80_0_0_22_DataIndex_Decr_already_pressed = 1;
    }
    else
    {
        index = getValue(A_FSG_80_0_0_22_DataIndex);
        index--;
        putValue(A_FSG_80_0_0_22_DataIndex, index);
        A_FSG_80_0_0_22_DataIndex_Decr_already_pressed = 0;
    }
}
on envVar A_FSG_80_0_0_22_FctEn
{
    long data[3];
    data[0]=LSGID;
    data[1]=A_FSG_80_0_0_22_ID;
    data[2]=getValue(A_FSG_80_0_0_22_FctEn);
    ChangeConfig(0x0031,data);
}
// De-Aktivierung der Eingabefelder der FCTID A_FSG_80_0_0_22
on envVar A_FSG_80_0_0_22_FctLstItemEn
{
       if(getValue(this)) 
       {
           EnableControl(panel_name,"panel_FSG_80_0_0_22",1);
           EnableControl(panel_name,"panel_A_FSG_80_0_0_22_Status",1);
           EnableControl(panel_name,"errfield_A_FSG_80_0_0_22",1);
           EnableControl(panel_name,"panel_A_FSG_80_0_0_22",1);
           EnableControl(panel_name,"panel_A_FSG_80_0_0_22_Changed",1);
           EnableControl(panel_name,"panel_A_FSG_80_0_0_22_SetGet",1);
           setControlForeColor(panel_name, "checkbox_A_FSG_80_0_0_22", MakeRGB(0,240,0));
       }
       else
       {
           EnableControl(panel_name,"panel_FSG_80_0_0_22",0);
           EnableControl(panel_name,"panel_A_FSG_80_0_0_22_Status",0);
           EnableControl(panel_name,"errfield_A_FSG_80_0_0_22",0);
           EnableControl(panel_name,"panel_A_FSG_80_0_0_22",0);
           EnableControl(panel_name,"panel_A_FSG_80_0_0_22_Changed",0);
           EnableControl(panel_name,"panel_A_FSG_80_0_0_22_SetGet",0);
           setControlForeColor(panel_name, "checkbox_A_FSG_80_0_0_22", MakeRGB(250,0,0));
       }
}
// Man darf gleichzeitig nur Checkbox fuer SegmError oder IntertelegramError aktiviert werden
on envVar A_FSG_80_0_0_22_IntTlgEn
{
       if(getValue(this)) 
       {
           putValue(A_FSG_80_0_0_22_SegmEn,0);
           intertelegram_err(A_FSG_80_0_0_22_ID);
       }
       else
       {
           intertelegram_err_off(A_FSG_80_0_0_22_ID);
       }
}
// Man darf gleichzeitig nur Checkbox fuer SegmError oder IntertelegramError aktiviert werden
on envVar A_FSG_80_0_0_22_SegmEn
{
       if(getValue(this)) 
       {
           putValue(A_FSG_80_0_0_22_IntTlgEn,0);
           sequence_err(A_FSG_80_0_0_22_ID,getValueSize(A_FSG_80_0_0_22_SegmEn));
       }
       else
       {
              sequence_err_off(A_FSG_80_0_0_22_ID);
       }
}

// [XL] Ueberwachung der CheckBox fuer AT
on envVar A_FSG_80_0_0_22_AT
{
	if(getValue(this))
	{
		EnableControl(panel_name,"panel_A_FSG_80_0_0_22_Status",0);
	}
	else
	{
   	EnableControl(panel_name,"panel_A_FSG_80_0_0_22_Status",1);
 	}
}



A_FSG_80_0_0_22_SetInd () { /* leere Function*/ }

A_FSG_80_0_0_22_SetGetInd () { /* leere Function*/ }

A_FSG_80_0_0_22_GetInd()
{
    int currentPos;
    byte head[5];
    byte stringTempValue[2045];
    int i;
    int j;
    int startVal;
    int elementsVal;
    byte recordAddressVal;
    byte transmitPosVal;
    long tempValue;
    long index;
    byte nibbleSetted;
    currentPos = 0;
    nibbleSetted = 0;
    //Einzelparameter: ASG_ID
    if(nibbleSetted == 1)
    {
        //voriger Parameter war ein Nibble, => second nibble, Pos incr und Flag zuruecksetzen
        tempValue = (gBAP_Indication_data[currentPos++] &0xF);
        nibbleSetted = 0;
    }
    else
    {
        //first nibble, kein increment, Flag setzen
        tempValue = ((gBAP_Indication_data[currentPos]>>4) &0xF);
        nibbleSetted = 1;
    }
    putValue(A_FSG_80_0_0_22_1_SetGet, tempValue);
    //Einzelparameter: TAID
    if(nibbleSetted == 1)
    {
        //voriger Parameter war ein Nibble, => second nibble, Pos incr und Flag zuruecksetzen
        tempValue = (gBAP_Indication_data[currentPos++] &0xF);
        nibbleSetted = 0;
    }
    else
    {
        //first nibble, kein increment, Flag setzen
        tempValue = ((gBAP_Indication_data[currentPos]>>4) &0xF);
        nibbleSetted = 1;
    }
    putValue(A_FSG_80_0_0_22_2_SetGet, tempValue);
    //head Parameter
    if(gBAP_Indication_header[4] >= (3+currentPos))
    {
        if( (gBAP_Indication_data[currentPos] & 0x80) > 0)
            if(gBAP_Indication_header[4] >= (5+currentPos))
            {
                for(i = 0; i < 5; i++) head[i] = gBAP_Indication_data[currentPos++];
                putValue(A_FSG_80_0_0_22_SetGet, head, 5);
                if(getValue(A_FSG_80_0_0_22_AT))
                {
                    putValue(A_FSG_80_0_0_22,head,5);
                }
                startVal = (head[2]<<8) | head[1];
                elementsVal = (head[4]<<8) | head[3];
            }
            else write("received Data Error");
        else
        {
            for(i = 0; i < 3; i++) head[i] = gBAP_Indication_data[currentPos++];
            putValue(A_FSG_80_0_0_22_SetGet, head, 3);
            if(getValue(A_FSG_80_0_0_22_AT))
            {
                putValue(A_FSG_80_0_0_22,head,3);
            }
                startVal = head[1];
                elementsVal = head[2];
        }
        recordAddressVal = head[0] & 0x0F;
        transmitPosVal = head[0] & 0x40;
        if(getValue(A_FSG_80_0_0_22_AT))
        {
            putValue(A_FSG_80_0_0_22_RecAdr,recordAddressVal);
            putValue(A_FSG_80_0_0_22_Start, startVal);
            putValue(A_FSG_80_0_0_22_Elements, elementsVal);
            putValue(A_FSG_80_0_0_22_TransPos, transmitPosVal);
        }
    }
}

on envVar A_FSG_80_0_0_22_1
{
	byte superval[2045];

	//Update Childvalue (Enum)
	byte thisval; // ASG_ID
	thisval = 0x0f & getValue(this);
}
// Ueberwachung der Darstellungsvariable der Range.
on envVar A_FSG_80_0_0_22_2_range // BTDeviceList.TAID 
{
	@A_FSG_80_0_0_22_2 = @A_FSG_80_0_0_22_2_range - (0); // slider = range - min
}

on envVar A_FSG_80_0_0_22_2
{
	byte superval[2045];

	//Update Childvalue (Number)
	byte thisval; // TAID
	float slider_value;

	slider_value = round(@A_FSG_80_0_0_22_2, 1.0);
	@A_FSG_80_0_0_22_2_range = slider_value + (0); // real value := slider value + range min.
	thisval = (byte)round((slider_value + (0) - (0)) / (1.0), 1); // bus value := (slider value + min - offset) / step.
}
// Ueberwachung der Darstellungsvariable der Range.
on envVar A_FSG_80_0_0_22_3_range // BTDeviceList.TotalNumListElements 
{
	@A_FSG_80_0_0_22_3 = @A_FSG_80_0_0_22_3_range - (0); // slider = range - min
}

on envVar A_FSG_80_0_0_22_3
{
	byte superval[2045];

	//Update Childvalue (Number)
	byte thisval; // TotalNumListElements
	float slider_value;

	slider_value = round(@A_FSG_80_0_0_22_3, 1.0);
	@A_FSG_80_0_0_22_3_range = slider_value + (0); // real value := slider value + range min.
	thisval = (byte)round((slider_value + (0) - (0)) / (1.0), 1); // bus value := (slider value + min - offset) / step.
}
// Ueberwachung der Darstellungsvariable der Range.
on envVar A_FSG_80_0_0_22_Data_1_range // BTDeviceList.Pos 
{
	@A_FSG_80_0_0_22_Data_1 = @A_FSG_80_0_0_22_Data_1_range - (0); // slider = range - min
}

on envVar A_FSG_80_0_0_22_Data_1
{
	byte superval[2045];

	//Update Childvalue (Number)
	byte thisval; // Pos
	float slider_value;

	slider_value = round(@A_FSG_80_0_0_22_Data_1, 1.0);
	@A_FSG_80_0_0_22_Data_1_range = slider_value + (0); // real value := slider value + range min.
	thisval = (byte)round((slider_value + (0) - (0)) / (1.0), 1); // bus value := (slider value + min - offset) / step.
    A_FSG_80_0_0_22_ArrayDataList[getValue(A_FSG_80_0_0_22_DataIndex)].Param1 = thisval;
}
on envVar A_FSG_80_0_0_22_Data_2_0
{
	byte bitval;
	//thisval steht hier fuer den bitfield-wert, 
	//aus Generierungsgruenden hier keine einheitliche Bezeichnung moeglich.
	byte thisval; // BTProfiles
	bitval= getValue(this);
	thisval = getValue(A_FSG_80_0_0_22_Data_2);
	thisval = thisval&~(1<<0)|(bitval<<0);
	putValue(A_FSG_80_0_0_22_Data_2,thisval);
}

on envVar A_FSG_80_0_0_22_Data_2_1
{
	byte bitval;
	//thisval steht hier fuer den bitfield-wert, 
	//aus Generierungsgruenden hier keine einheitliche Bezeichnung moeglich.
	byte thisval; // BTProfiles
	bitval= getValue(this);
	thisval = getValue(A_FSG_80_0_0_22_Data_2);
	thisval = thisval&~(1<<1)|(bitval<<1);
	putValue(A_FSG_80_0_0_22_Data_2,thisval);
}

on envVar A_FSG_80_0_0_22_Data_2_2
{
	byte bitval;
	//thisval steht hier fuer den bitfield-wert, 
	//aus Generierungsgruenden hier keine einheitliche Bezeichnung moeglich.
	byte thisval; // BTProfiles
	bitval= getValue(this);
	thisval = getValue(A_FSG_80_0_0_22_Data_2);
	thisval = thisval&~(1<<2)|(bitval<<2);
	putValue(A_FSG_80_0_0_22_Data_2,thisval);
}

on envVar A_FSG_80_0_0_22_Data_2
{
	byte superval[2045];

	//Update Childvalue (BitField)
	byte mask=0x01;
	int i = 0;
	byte thisval; // BTProfiles
	thisval = getValue(this);
	if(thisval&(mask<<0))
		putValue(A_FSG_80_0_0_22_Data_2_0, 1);
	else
		putValue(A_FSG_80_0_0_22_Data_2_0, 0);
	if(thisval&(mask<<1))
		putValue(A_FSG_80_0_0_22_Data_2_1, 1);
	else
		putValue(A_FSG_80_0_0_22_Data_2_1, 0);
	if(thisval&(mask<<2))
		putValue(A_FSG_80_0_0_22_Data_2_2, 1);
	else
		putValue(A_FSG_80_0_0_22_Data_2_2, 0);
    A_FSG_80_0_0_22_ArrayDataList[getValue(A_FSG_80_0_0_22_DataIndex)].Param2 = thisval;
}

// Ueberwachung der CheckBox fuer String
on envVar  A_FSG_80_0_0_22_Data_3_cnt
{
	word len;
	byte cnt;
	len = getValue(A_FSG_80_0_0_22_Data_3_len);
	cnt = getValue(this);

    /* Cnt Wert im Array aktualisieren */
	 A_FSG_80_0_0_22_Data_3_CntList[ getValue(A_FSG_80_0_0_22_DataIndex) ] = cnt;

	/* wird nur gerufen, wenn check box deaktiviert mit Length>127*/ 
	if(cnt == 0) 
	{
		if(len > 127 )
		{
			putValue(A_FSG_80_0_0_22_Data_3_len, 127);
		}
	}

}


on envVar A_FSG_80_0_0_22_Data_3_len
{
	long thisval;
	byte cnt;
	thisval = getValue(this);
	cnt = getValue(A_FSG_80_0_0_22_Data_3_cnt);

	/* wenn die Laenge ausserhalb des erlaubten Bereich liegt, wird diese begrenzt */
	if(thisval > 99 || thisval < 0 )
	{
		writelineEx(gBAP_Trace, 0, "Eingegebene Laenge: %d von A_FSG_80_0_0_22_Data_3 ist ungueltig. Die max. erlaubte Laenge ist %d. ", thisval, 99);
		thisval = 99;
	}
	if( thisval >127)
	{
		putValue(A_FSG_80_0_0_22_Data_3_cnt, 1); /* Switch checkbox on */
	}

	A_FSG_80_0_0_22_ArrayDataList[getValue(A_FSG_80_0_0_22_DataIndex)].Param3_Length = thisval;
	A_FSG_80_0_0_22_Data_3_LenList[ getValue(A_FSG_80_0_0_22_DataIndex) ] = thisval;
	putValue(A_FSG_80_0_0_22_Data_3_len, thisval);

}

on envVar A_FSG_80_0_0_22_Data_3
{
	byte superval[2045];

	//Update Childvalue (String)
	word i;
	byte thisval[100];
	getValue(this, thisval);
    for(i = 0; i < getValueSize(this); i++)
        A_FSG_80_0_0_22_ArrayDataList[getValue(A_FSG_80_0_0_22_DataIndex)].Param3[i] = thisval[i];
    A_FSG_80_0_0_22_ArrayDataList[getValue(A_FSG_80_0_0_22_DataIndex)].Param3_Length = getValueSize(this);
    A_FSG_80_0_0_22_Data_3_LenList[getValue(A_FSG_80_0_0_22_DataIndex)]= getValueSize(this);
    putValue(A_FSG_80_0_0_22_Data_3_len, getValueSize(this));
}
on envVar A_FSG_80_0_0_22_1_SetGet
{
	byte superval[4];

	//Update Childvalue (Enum)
	byte thisval; // ASG_ID
	thisval = 0x0f & getValue(this);
}
// Ueberwachung der Darstellungsvariable der Range.
on envVar A_FSG_80_0_0_22_2_SetGet_range // BTDeviceList.TAID 
{
	@A_FSG_80_0_0_22_2_SetGet = @A_FSG_80_0_0_22_2_SetGet_range - (0); // slider = range - min
}

on envVar A_FSG_80_0_0_22_2_SetGet
{
	byte superval[4];

	//Update Childvalue (Number)
	byte thisval; // TAID
	float slider_value;

	slider_value = round(@A_FSG_80_0_0_22_2_SetGet, 1.0);
	@A_FSG_80_0_0_22_2_SetGet_range = slider_value + (0); // real value := slider value + range min.
	thisval = (byte)round((slider_value + (0) - (0)) / (1.0), 1); // bus value := (slider value + min - offset) / step.
}
// Ruecksetzen des Fehlerstatus durch manuelle Fehlereingabe
on envVar M_FSG_80_0_0_23_ErrCode
{
       if(gM_FSG_80_0_0_23_ErrCode) 
       {
           setControlBackColor(panel_name,"errfield_M_FSG_80_0_0_23", MakeRGB(255,255,255));
       }
       gM_FSG_80_0_0_23_ErrCode = 1;
}
on envVar M_FSG_80_0_0_23Result_BTN
{
    byte temp[2];
    if (M_FSG_80_0_0_23Result_BTN_already_pressed == 0)
    {
        putValue(M_FSG_80_0_0_23_ErrCode,0);
        SetControlBackColor(panel_name,"errField_M_FSG_80_0_0_23",MakeRGB(255,255,255));
        M_FSG_80_0_0_23Result_BTN_already_pressed = 1;
    }
    else
    {
        putValue(M_FSG_80_0_0_23_State, "Result");
        getValue(M_FSG_80_0_0_23_Result, temp);
        Request_ByteSequence(LSGID, M_FSG_80_0_0_23_ID, Result_REQ, temp, getValueSize(M_FSG_80_0_0_23_Result));
        M_FSG_80_0_0_23Result_BTN_already_pressed = 0;
    }
}
on envVar M_FSG_80_0_0_23_FctEn
{
    long data[3];
    data[0]=LSGID;
    data[1]=M_FSG_80_0_0_23_ID;
    data[2]=getValue(M_FSG_80_0_0_23_FctEn);
    ChangeConfig(0x0031,data);
}
// De-Aktivierung der Eingabefelder der FCTID M_FSG_80_0_0_23
on envVar M_FSG_80_0_0_23_FctLstItemEn
{
       if(getValue(this)) 
       {
           EnableControl(panel_name,"panel_FSG_80_0_0_23",1);
           EnableControl(panel_name,"errfield_M_FSG_80_0_0_23",1);
           EnableControl(panel_name,"panel_M_FSG_80_0_0_23",1);
           EnableControl(panel_name,"panel_M_FSG_80_0_0_23_Processing",1);
           EnableControl(panel_name,"panel_M_FSG_80_0_0_23_Start",1);
           setControlForeColor(panel_name, "checkbox_M_FSG_80_0_0_23", MakeRGB(0,240,0));
       }
       else
       {
           EnableControl(panel_name,"panel_FSG_80_0_0_23",0);
           EnableControl(panel_name,"errfield_M_FSG_80_0_0_23",0);
           EnableControl(panel_name,"panel_M_FSG_80_0_0_23",0);
           EnableControl(panel_name,"panel_M_FSG_80_0_0_23_Processing",0);
           EnableControl(panel_name,"panel_M_FSG_80_0_0_23_Start",0);
           setControlForeColor(panel_name, "checkbox_M_FSG_80_0_0_23", MakeRGB(250,0,0));
       }
}
on envVar M_FSG_80_0_0_23_Result // bus value of BTPairingCommands (23).
{
	// opcodes: Error-Processing-Result
	byte param1; // ASG_ID
	byte param2; // CommandType
	byte param3; // BTPairingCommands_Result
	// DATATYPE_BYTESEQUENCE / DATATYPE_FIXEDBYTESEQUENCE
	int i;
	byte superval[2];
	int currentPos;
	currentPos = 0;
	for( i = 0; i < 2; i++ ) {
		superval[i] = 0;
	}
	getValue(M_FSG_80_0_0_23_Result, superval);
	///////// Start param1 - NIBBLE /////////
	param1 = (superval[currentPos] & 0xf0)>>4;
	putValue(M_FSG_80_0_0_23_Result_1, param1);
	///////// Start param2 - NIBBLE /////////
	param2 = superval[currentPos++] & 0x0f;
	putValue(M_FSG_80_0_0_23_Result_2, param2);
	///////// Start param3 - UINT8 /////////
	param3 = superval[currentPos++];
	putValue(M_FSG_80_0_0_23_Result_3, param3);
}

on envVar M_FSG_80_0_0_23_Result_1 // BTPairingCommands.ASG_ID
{
	byte superval[2];

	//Update Childvalue (Enum)
	byte thisval; // ASG_ID
	thisval = 0x0f & getValue(this);

    // Update superval
	getValue(M_FSG_80_0_0_23_Result, superval);
	superval[0]= superval[0]&0x0f;
	superval[0]= superval[0]|(thisval<<4);
	putValue(M_FSG_80_0_0_23_Result,superval);
}

on envVar M_FSG_80_0_0_23_Result_2 // BTPairingCommands.CommandType
{
	byte superval[2];

	//Update Childvalue (Enum)
	byte thisval; // CommandType
	thisval = 0x0f & getValue(this);

    // Update superval
	getValue(M_FSG_80_0_0_23_Result, superval);
	superval[0]= superval[0]&0xf0;
	superval[0]= superval[0]|thisval;
	putValue(M_FSG_80_0_0_23_Result,superval);
}

on envVar M_FSG_80_0_0_23_Result_3 // BTPairingCommands.BTPairingCommands_Result
{
	byte superval[2];

	//Update Childvalue (Enum)
	byte thisval; // BTPairingCommands_Result
	thisval = getValue(this);

    // Update superval
	getValue(M_FSG_80_0_0_23_Result, superval);
	superval[1]=thisval;
	putValue(M_FSG_80_0_0_23_Result,superval);
}

on envVar M_FSG_80_0_0_23_Processing // bus value of BTPairingCommands (23).
{
	// opcodes: Error-Processing-Result
	byte param1; // ASG_ID
	byte param2; // CommandType
	byte param3; // Reserve
	// DATATYPE_BYTESEQUENCE / DATATYPE_FIXEDBYTESEQUENCE
	int i;
	byte superval[2];
	int currentPos;
	currentPos = 0;
	for( i = 0; i < 2; i++ ) {
		superval[i] = 0;
	}
	getValue(M_FSG_80_0_0_23_Processing, superval);
	///////// Start param1 - NIBBLE /////////
	param1 = (superval[currentPos] & 0xf0)>>4;
	putValue(M_FSG_80_0_0_23_Processing_1, param1);
	///////// Start param2 - NIBBLE /////////
	param2 = superval[currentPos++] & 0x0f;
	putValue(M_FSG_80_0_0_23_Processing_2, param2);
	///////// Start param3 - UINT8 /////////
	param3 = superval[currentPos++];
	putValue(M_FSG_80_0_0_23_Processing_3, round((param3 * 1.0) - (0) + (0), 1.0));
}

on envVar M_FSG_80_0_0_23_Processing_1 // BTPairingCommands.ASG_ID
{
	byte superval[2];

	//Update Childvalue (Enum)
	byte thisval; // ASG_ID
	thisval = 0x0f & getValue(this);

    // Update superval
	getValue(M_FSG_80_0_0_23_Processing, superval);
	superval[0]= superval[0]&0x0f;
	superval[0]= superval[0]|(thisval<<4);
	putValue(M_FSG_80_0_0_23_Processing,superval);
}

on envVar M_FSG_80_0_0_23_Processing_2 // BTPairingCommands.CommandType
{
	byte superval[2];

	//Update Childvalue (Enum)
	byte thisval; // CommandType
	thisval = 0x0f & getValue(this);

    // Update superval
	getValue(M_FSG_80_0_0_23_Processing, superval);
	superval[0]= superval[0]&0xf0;
	superval[0]= superval[0]|thisval;
	putValue(M_FSG_80_0_0_23_Processing,superval);
}

// Ueberwachung der Darstellungsvariable der Range.
on envVar M_FSG_80_0_0_23_Processing_3_range // BTPairingCommands.Reserve 
{
	@M_FSG_80_0_0_23_Processing_3 = @M_FSG_80_0_0_23_Processing_3_range - (0); // slider = range - min
}

on envVar M_FSG_80_0_0_23_Processing_3 // BTPairingCommands.Reserve
{
	byte superval[2];

	//Update Childvalue (Number)
	byte thisval; // Reserve
	float slider_value;

	slider_value = 0; // Konstanter Parameter.
	@M_FSG_80_0_0_23_Processing_3_range = slider_value + (0); // real value := slider value + range min.
	thisval = (byte)round((slider_value + (0) - (0)) / (1.0), 1); // bus value := (slider value + min - offset) / step.

    // Update superval
	getValue(M_FSG_80_0_0_23_Processing, superval);
	superval[1]=thisval;
	putValue(M_FSG_80_0_0_23_Processing,superval);
}

on envVar M_FSG_80_0_0_23_Start // bus value of BTPairingCommands (23).
{
	// opcodes: AbortResult-StartResult
	byte param1; // ASG_ID
	byte param2; // CommandType
	byte param3; // Pos_BTDeviceList
	byte param4; // Extension1
	byte param5; // Extension2
	// DATATYPE_BYTESEQUENCE / DATATYPE_FIXEDBYTESEQUENCE
	int i;
	byte superval[4];
	int currentPos;
	currentPos = 0;
	for( i = 0; i < 4; i++ ) {
		superval[i] = 0;
	}
	getValue(M_FSG_80_0_0_23_Start, superval);
	///////// Start param1 - NIBBLE /////////
	param1 = (superval[currentPos] & 0xf0)>>4;
	putValue(M_FSG_80_0_0_23_Start_1, param1);
	///////// Start param2 - NIBBLE /////////
	param2 = superval[currentPos++] & 0x0f;
	putValue(M_FSG_80_0_0_23_Start_2, param2);
	///////// Start param3 - UINT8 /////////
	param3 = superval[currentPos++];
	putValue(M_FSG_80_0_0_23_Start_3, round((param3 * 1.0) - (1) + (1), 1.0));
	///////// Start param4 - UINT8 /////////
	param4 = superval[currentPos++];
	putValue(M_FSG_80_0_0_23_Start_4, round((param4 * 1.0) - (0) + (0), 1.0));
	///////// Start param5 - UINT8 /////////
	param5 = superval[currentPos++];
	putValue(M_FSG_80_0_0_23_Start_5, round((param5 * 1.0) - (0) + (0), 1.0));
}

on envVar M_FSG_80_0_0_23_Start_1 // BTPairingCommands.ASG_ID
{
	byte superval[4];

	//Update Childvalue (Enum)
	byte thisval; // ASG_ID
	thisval = 0x0f & getValue(this);

    // Update superval
	getValue(M_FSG_80_0_0_23_Start, superval);
	superval[0]= superval[0]&0x0f;
	superval[0]= superval[0]|(thisval<<4);
	putValue(M_FSG_80_0_0_23_Start,superval);
}

on envVar M_FSG_80_0_0_23_Start_2 // BTPairingCommands.CommandType
{
	byte superval[4];

	//Update Childvalue (Enum)
	byte thisval; // CommandType
	thisval = 0x0f & getValue(this);

    // Update superval
	getValue(M_FSG_80_0_0_23_Start, superval);
	superval[0]= superval[0]&0xf0;
	superval[0]= superval[0]|thisval;
	putValue(M_FSG_80_0_0_23_Start,superval);
}

// Ueberwachung der Darstellungsvariable der Range.
on envVar M_FSG_80_0_0_23_Start_3_range // BTPairingCommands.Pos_BTDeviceList 
{
	@M_FSG_80_0_0_23_Start_3 = @M_FSG_80_0_0_23_Start_3_range - (1); // slider = range - min
}

on envVar M_FSG_80_0_0_23_Start_3 // BTPairingCommands.Pos_BTDeviceList
{
	byte superval[4];

	//Update Childvalue (Number)
	byte thisval; // Pos_BTDeviceList
	float slider_value;

	slider_value = round(@M_FSG_80_0_0_23_Start_3, 1.0);
	@M_FSG_80_0_0_23_Start_3_range = slider_value + (1); // real value := slider value + range min.
	thisval = (byte)round((slider_value + (1) - (1)) / (1.0), 1); // bus value := (slider value + min - offset) / step.

    // Update superval
	getValue(M_FSG_80_0_0_23_Start, superval);
	superval[1]=thisval;
	putValue(M_FSG_80_0_0_23_Start,superval);
}

// Ueberwachung der Darstellungsvariable der Range.
on envVar M_FSG_80_0_0_23_Start_4_range // BTPairingCommands.Extension1 
{
	@M_FSG_80_0_0_23_Start_4 = @M_FSG_80_0_0_23_Start_4_range - (0); // slider = range - min
}

on envVar M_FSG_80_0_0_23_Start_4 // BTPairingCommands.Extension1
{
	byte superval[4];

	//Update Childvalue (Number)
	byte thisval; // Extension1
	float slider_value;

	slider_value = 0; // Konstanter Parameter.
	@M_FSG_80_0_0_23_Start_4_range = slider_value + (0); // real value := slider value + range min.
	thisval = (byte)round((slider_value + (0) - (0)) / (1.0), 1); // bus value := (slider value + min - offset) / step.

    // Update superval
	getValue(M_FSG_80_0_0_23_Start, superval);
	superval[2]=thisval;
	putValue(M_FSG_80_0_0_23_Start,superval);
}

// Ueberwachung der Darstellungsvariable der Range.
on envVar M_FSG_80_0_0_23_Start_5_range // BTPairingCommands.Extension2 
{
	@M_FSG_80_0_0_23_Start_5 = @M_FSG_80_0_0_23_Start_5_range - (0); // slider = range - min
}

on envVar M_FSG_80_0_0_23_Start_5 // BTPairingCommands.Extension2
{
	byte superval[4];

	//Update Childvalue (Number)
	byte thisval; // Extension2
	float slider_value;

	slider_value = 0; // Konstanter Parameter.
	@M_FSG_80_0_0_23_Start_5_range = slider_value + (0); // real value := slider value + range min.
	thisval = (byte)round((slider_value + (0) - (0)) / (1.0), 1); // bus value := (slider value + min - offset) / step.

    // Update superval
	getValue(M_FSG_80_0_0_23_Start, superval);
	superval[3]=thisval;
	putValue(M_FSG_80_0_0_23_Start,superval);
}

// Ruecksetzen des Fehlerstatus durch manuelle Fehlereingabe
on envVar A_FSG_80_0_0_24_ErrCode
{
       if(gA_FSG_80_0_0_24_ErrCode) 
       {
           setControlBackColor(panel_name,"errfield_A_FSG_80_0_0_24", MakeRGB(255,255,255));
       }
       gA_FSG_80_0_0_24_ErrCode = 1;
}
on envVar A_FSG_80_0_0_24Changed_BTN
{
    byte data[1212]; 
    byte stringValue[1212];
    byte head[5];
    int i;
    int headLength;
    long tempValue;
    word currentPos;
    word startVal;
    word elementsVal;
  byte nibbleSetted;
    if (A_FSG_80_0_0_24Changed_BTN_already_pressed == 0)
    {
        putValue(A_FSG_80_0_0_24_ErrCode,0);
        SetControlBackColor(panel_name,"errField_A_FSG_80_0_0_24",MakeRGB(255,255,255));
        A_FSG_80_0_0_24Changed_BTN_already_pressed = 1;
    }
    else 
    {
        currentPos = 0;
        //head Parameter
        headLength = getValueSize(A_FSG_80_0_0_24_Changed);
        getValue(A_FSG_80_0_0_24_Changed,head);
        for(i=0; i< headLength; i++)
        {
            data[currentPos++] = head[i];
        }
    //data Parameter
     startVal = getValue(A_FSG_80_0_0_24_Changed_Start);
     elementsVal = getValue(A_FSG_80_0_0_24_Changed_Elements);
     nibbleSetted = 0;
    if( (head[0]&0x20) == 0)
    {
     if( (head[0] & 0x10) > 0)
     {
        startVal++;
     }
     for( i = startVal ; i < startVal + elementsVal ; i++)
     {
       if( i < 0 || i >= A_FSG_80_0_0_24_ArrayDataList_Length )
       {
         write("Array index ausserhalb der Grenzen, Fct: 24");
         break;
       }
      if(nibbleSetted == 1) currentPos++;
      nibbleSetted = 0;
    //sollte der letzte Parameter ein first nibble gewesen sein, muss noch 1 increment durchgefuehrt werden
    if( nibbleSetted==1) currentPos++;
    nibbleSetted = 0;
     }
    }
    else
    {
     if( (head[0] & 0x10) > 0)
     {
        if(startVal != 0) startVal--;
        else
        {
           startVal = A_FSG_80_0_0_24_ArrayDataList_Length -1;
        }
     }
     for( i = startVal ; i > startVal - elementsVal ; i--)
     {
       if( i < 0 || i >= A_FSG_80_0_0_24_ArrayDataList_Length )
       {
         write("Array index ausserhalb der Grenzen, Fct: 24");
         break;
       }
      if(nibbleSetted == 1) currentPos++;
      nibbleSetted = 0;
    //sollte der letzte Parameter ein first nibble gewesen sein, muss noch 1 increment durchgefuehrt werden
    if( nibbleSetted==1) currentPos++;
    nibbleSetted = 0;
     }
    }

       Request_ByteSequence(LSGID, A_FSG_80_0_0_24_ID, Changed_REQ, data, currentPos);
       if(getValue(A_FSG_80_0_0_24_IntTlgEn)) //getValue(IT))
       {
           intertelegram_err(A_FSG_80_0_0_24_ID);
       }
       if(getValue(A_FSG_80_0_0_24_SegmEn))   //getvalue(SG)
       {
             sequence_err(A_FSG_80_0_0_24_ID,getValueSize(A_FSG_80_0_0_24_Changed));
       }
        A_FSG_80_0_0_24Changed_BTN_already_pressed = 0;
    }
}
on envVar A_FSG_80_0_0_24Status_BTN
{
    byte data[1212 + 5]; // array header (3 or 5 bytes), followed by payload.
    byte stringValue[1212];
    byte head[5];
    int i = 0;
    int j = 0;
    long StringLength = 0;
    int headLength;
    long tempValue;
    word currentPos;

    word startVal;
    word elementsVal;
    byte nibbleSetted;
    if (A_FSG_80_0_0_24Status_BTN_already_pressed == 0)
    {
        putValue(A_FSG_80_0_0_24_ErrCode,0);
        SetControlBackColor(panel_name,"errField_A_FSG_80_0_0_24",MakeRGB(255,255,255));
        A_FSG_80_0_0_24Status_BTN_already_pressed = 1;
    }
    else
    {
        currentPos = 0;
        //Einzelparameter: ASG_ID
        tempValue = getValue(A_FSG_80_0_0_24_1);
    if(nibbleSetted == 1)
    {
        //voriger Parameter war ein Nibble, => second nibble, Pos incr und Flag zuruecksetzen
        data[currentPos] = (tempValue &0x0F) | (data[currentPos] &0xF0);
        currentPos++;
        nibbleSetted = 0;
    }
    else
    {
        //first nibble, kein increment, Flag setzen
        data[currentPos] = (tempValue<<4) &0xF0;
        nibbleSetted = 1;
    }
        //Einzelparameter: TAID
        tempValue = getValue(A_FSG_80_0_0_24_2);
    if(nibbleSetted == 1)
    {
        //voriger Parameter war ein Nibble, => second nibble, Pos incr und Flag zuruecksetzen
        data[currentPos] = (tempValue &0x0F) | (data[currentPos] &0xF0);
        currentPos++;
        nibbleSetted = 0;
    }
    else
    {
        //first nibble, kein increment, Flag setzen
        data[currentPos] = (tempValue<<4) &0xF0;
        nibbleSetted = 1;
    }
        //Einzelparameter: TotalNumListElements
        tempValue = getValue(A_FSG_80_0_0_24_3);
        //voriger Parameter war ein first nibble, bei 1 Byte Werten Position incr
        if(nibbleSetted == 1) currentPos++;
        nibbleSetted = 0;
        data[currentPos++] = (tempValue ) & 0xFF;
        data[currentPos++] = (tempValue >> 8) & 0xFF;
        //head Parameter
        headLength = getValueSize(A_FSG_80_0_0_24);
        getValue(A_FSG_80_0_0_24,head);
        for(i=0; i< headLength; i++)
        {
            data[currentPos++] = head[i];
        }
    //data Parameter
     startVal = getValue(A_FSG_80_0_0_24_Start);
     elementsVal = getValue(A_FSG_80_0_0_24_Elements);
     nibbleSetted = 0;
    if( (head[0]&0x20) == 0)
    {
     if( (head[0] & 0x10) > 0)
     {
        startVal++;
     }
     for( i = startVal ; i < startVal + elementsVal ; i++)
     {
       if( i < 0 || i >= A_FSG_80_0_0_24_ArrayDataList_Length )
       {
         write("Array index ausserhalb der Grenzen, Fct: 24");
         break;
       }
      if(nibbleSetted == 1) currentPos++;
      nibbleSetted = 0;
     if( (head[0]&0x40) == 0){ /* Transmit_Pos = 0, keine Positionsdaten */ }
     else
     {
        if( (head[0]&0x80) == 0)
        {
           //IndexSize = 0, Pos als 1 Byte Wert
           data[currentPos++] = A_FSG_80_0_0_24_ArrayDataList[i].Param1 & 0xFF;
        }
        else
        {
           //IndexSize = 1, Pos als 2 Byte Wert
           data[currentPos++] = A_FSG_80_0_0_24_ArrayDataList[i].Param1 & 0xFF;
           data[currentPos++] = (A_FSG_80_0_0_24_ArrayDataList[i].Param1 >> 8) & 0xFF;
        }
     }
      // Check if the current value of RecAdr enables the variable LicenseText:
      if( 0 || 1 == getValue( A_FSG_80_0_0_24_RecAdr ) )
      {
        //Sollte vor einem String Wert 1 Nibble kommen, muss der index um 1 incrementiert werden!
        if( nibbleSetted==1) currentPos++;
        nibbleSetted = 0;
        StringLength =A_FSG_80_0_0_24_ArrayDataList[i].Param2_Length;
		/* Pruefung ob die Laenge-Checkbox aktiv ist */
		if (1 == A_FSG_80_0_0_24_Data_2_CntList[i] )
		{
			if(StringLength >= 0 && StringLength <= 32767 && StringLength <= 1202-2)
			{
				data[currentPos++] = ( (StringLength >> 8) & 0x7F ) | 0x80; //2Byte Flag (Bit 8) setzen + HighByte (erste 7 bit)
				data[currentPos++] = StringLength &0xFF;
			}
			else
			{
				writelineEx(gBAP_Trace, 0, "Eingegebene Laenge: %d von A_FSG_80_0_0_24_Data_2 mit Record Nr. %d ist ungueltig. Die max. erlaubte Laenge ist %d.", StringLength, i, 1202-2);
				return;
			}
		}
		else if(0 == A_FSG_80_0_0_24_Data_2_CntList[i] ) /*check box deaktiviert*/
		{
			if(StringLength >= 0 && StringLength <= 127 && StringLength <= 1202-1)
			{
				data[currentPos++] = StringLength & 0x7F; //Bit 8 = 0
			}
			else
			{
				writelineEx(gBAP_Trace, 0, "Eingegebene Laenge: %d von A_FSG_80_0_0_24_Data_2 mit Record Nr. %d ist ungueltig. Die max. erlaubte Laenge ist %d. ", StringLength, i, 1202-1);
				return;
			}
		}
        for(j=0; j < StringLength ; j++)
        {
            data[currentPos++] = A_FSG_80_0_0_24_ArrayDataList[i].Param2[j];
        }
       }
    //sollte der letzte Parameter ein first nibble gewesen sein, muss noch 1 increment durchgefuehrt werden
    if( nibbleSetted==1) currentPos++;
    nibbleSetted = 0;
     }
    }
    else
    {
     if( (head[0] & 0x10) > 0)
     {
        if(startVal != 0) startVal--;
        else
        {
           startVal = A_FSG_80_0_0_24_ArrayDataList_Length -1;
        }
     }
     for( i = startVal ; i > startVal - elementsVal ; i--)
     {
       if( i < 0 || i >= A_FSG_80_0_0_24_ArrayDataList_Length )
       {
         write("Array index ausserhalb der Grenzen, Fct: 24");
         break;
       }
      if(nibbleSetted == 1) currentPos++;
      nibbleSetted = 0;
     if( (head[0]&0x40) == 0){ /* Transmit_Pos = 0, keine Positionsdaten */ }
     else
     {
        if( (head[0]&0x80) == 0)
        {
           //IndexSize = 0, Pos als 1 Byte Wert
           data[currentPos++] = A_FSG_80_0_0_24_ArrayDataList[i].Param1 & 0xFF;
        }
        else
        {
           //IndexSize = 1, Pos als 2 Byte Wert
           data[currentPos++] = A_FSG_80_0_0_24_ArrayDataList[i].Param1 & 0xFF;
           data[currentPos++] = (A_FSG_80_0_0_24_ArrayDataList[i].Param1 >> 8) & 0xFF;
        }
     }
      // Check if the current value of RecAdr enables the variable LicenseText:
      if( 0 || 1 == getValue( A_FSG_80_0_0_24_RecAdr ) )
      {
        //Sollte vor einem String Wert 1 Nibble kommen, muss der index um 1 incrementiert werden!
        if( nibbleSetted==1) currentPos++;
        nibbleSetted = 0;
        StringLength =A_FSG_80_0_0_24_ArrayDataList[i].Param2_Length;
		/* Pruefung ob die Laenge-Checkbox aktiv ist */
		if (1 == A_FSG_80_0_0_24_Data_2_CntList[i] )
		{
			if(StringLength >= 0 && StringLength <= 32767 && StringLength <= 1202-2)
			{
				data[currentPos++] = ( (StringLength >> 8) & 0x7F ) | 0x80; //2Byte Flag (Bit 8) setzen + HighByte (erste 7 bit)
				data[currentPos++] = StringLength &0xFF;
			}
			else
			{
				writelineEx(gBAP_Trace, 0, "Eingegebene Laenge: %d von A_FSG_80_0_0_24_Data_2 mit Record Nr. %d ist ungueltig. Die max. erlaubte Laenge ist %d.", StringLength, i, 1202-2);
				return;
			}
		}
		else if(0 == A_FSG_80_0_0_24_Data_2_CntList[i] ) /*check box deaktiviert*/
		{
			if(StringLength >= 0 && StringLength <= 127 && StringLength <= 1202-1)
			{
				data[currentPos++] = StringLength & 0x7F; //Bit 8 = 0
			}
			else
			{
				writelineEx(gBAP_Trace, 0, "Eingegebene Laenge: %d von A_FSG_80_0_0_24_Data_2 mit Record Nr. %d ist ungueltig. Die max. erlaubte Laenge ist %d. ", StringLength, i, 1202-1);
				return;
			}
		}
        for(j=0; j < StringLength ; j++)
        {
            data[currentPos++] = A_FSG_80_0_0_24_ArrayDataList[i].Param2[j];
        }
       }
    //sollte der letzte Parameter ein first nibble gewesen sein, muss noch 1 increment durchgefuehrt werden
    if( nibbleSetted==1) currentPos++;
    nibbleSetted = 0;
     }
    }

        //getValue(A_FSG_80_0_0_24, data);
        Request_ByteSequence(LSGID, A_FSG_80_0_0_24_ID, Data_REQ, data,currentPos);
        if(getValue(A_FSG_80_0_0_24_IntTlgEn)) //getValue(IT))
        {
            intertelegram_err(A_FSG_80_0_0_24_ID);
        }
        if(getValue(A_FSG_80_0_0_24_SegmEn))   //getvalue(SG)
        {
            sequence_err(A_FSG_80_0_0_24_ID,getValueSize(A_FSG_80_0_0_24));
        }
        A_FSG_80_0_0_24Status_BTN_already_pressed = 0;
    }
}
A_FSG_80_0_0_24_SendStatus()
{
    word currentPos;
    word headLength;
    int i;
    int j;
    word StringLength;
    long tempValue;
    word startVal;
    word elementsVal;
    byte data[1212];
    byte stringValue[1212];
    byte head[5];
    byte nibbleSetted;
    nibbleSetted = 0;
        currentPos = 0;
        //Einzelparameter: ASG_ID
        tempValue = getValue(A_FSG_80_0_0_24_1);
    if(nibbleSetted == 1)
    {
        //voriger Parameter war ein Nibble, => second nibble, Pos incr und Flag zuruecksetzen
        data[currentPos] = (tempValue &0x0F) | (data[currentPos] &0xF0);
        currentPos++;
        nibbleSetted = 0;
    }
    else
    {
        //first nibble, kein increment, Flag setzen
        data[currentPos] = (tempValue<<4) &0xF0;
        nibbleSetted = 1;
    }
        //Einzelparameter: TAID
        tempValue = getValue(A_FSG_80_0_0_24_2);
    if(nibbleSetted == 1)
    {
        //voriger Parameter war ein Nibble, => second nibble, Pos incr und Flag zuruecksetzen
        data[currentPos] = (tempValue &0x0F) | (data[currentPos] &0xF0);
        currentPos++;
        nibbleSetted = 0;
    }
    else
    {
        //first nibble, kein increment, Flag setzen
        data[currentPos] = (tempValue<<4) &0xF0;
        nibbleSetted = 1;
    }
        //Einzelparameter: TotalNumListElements
        tempValue = getValue(A_FSG_80_0_0_24_3);
        //voriger Parameter war ein first nibble, bei 1 Byte Werten Position incr
        if(nibbleSetted == 1) currentPos++;
        nibbleSetted = 0;
        data[currentPos++] = (tempValue ) & 0xFF;
        data[currentPos++] = (tempValue >> 8) & 0xFF;
        //head Parameter
        headLength = getValueSize(A_FSG_80_0_0_24);
        getValue(A_FSG_80_0_0_24,head);
        for(i=0; i< headLength; i++)
        {
            data[currentPos++] = head[i];
        }
    //data Parameter
     startVal = getValue(A_FSG_80_0_0_24_Start);
     elementsVal = getValue(A_FSG_80_0_0_24_Elements);
     nibbleSetted = 0;
    if( (head[0]&0x20) == 0)
    {
     if( (head[0] & 0x10) > 0)
     {
        startVal++;
     }
     for( i = startVal ; i < startVal + elementsVal ; i++)
     {
       if( i < 0 || i >= A_FSG_80_0_0_24_ArrayDataList_Length )
       {
         write("Array index ausserhalb der Grenzen, Fct: 24");
         break;
       }
      if(nibbleSetted == 1) currentPos++;
      nibbleSetted = 0;
     if( (head[0]&0x40) == 0){ /* Transmit_Pos = 0, keine Positionsdaten */ }
     else
     {
        if( (head[0]&0x80) == 0)
        {
           //IndexSize = 0, Pos als 1 Byte Wert
           data[currentPos++] = A_FSG_80_0_0_24_ArrayDataList[i].Param1 & 0xFF;
        }
        else
        {
           //IndexSize = 1, Pos als 2 Byte Wert
           data[currentPos++] = A_FSG_80_0_0_24_ArrayDataList[i].Param1 & 0xFF;
           data[currentPos++] = (A_FSG_80_0_0_24_ArrayDataList[i].Param1 >> 8) & 0xFF;
        }
     }
      // Check if the current value of RecAdr enables the variable LicenseText:
      if( 0 || 1 == getValue( A_FSG_80_0_0_24_RecAdr ) )
      {
        //Sollte vor einem String Wert 1 Nibble kommen, muss der index um 1 incrementiert werden!
        if( nibbleSetted==1) currentPos++;
        nibbleSetted = 0;
        StringLength =A_FSG_80_0_0_24_ArrayDataList[i].Param2_Length;
		/* Pruefung ob die Laenge-Checkbox aktiv ist */
		if (1 == A_FSG_80_0_0_24_Data_2_CntList[i] )
		{
			if(StringLength >= 0 && StringLength <= 32767 && StringLength <= 1202-2)
			{
				data[currentPos++] = ( (StringLength >> 8) & 0x7F ) | 0x80; //2Byte Flag (Bit 8) setzen + HighByte (erste 7 bit)
				data[currentPos++] = StringLength &0xFF;
			}
			else
			{
				writelineEx(gBAP_Trace, 0, "Eingegebene Laenge: %d von A_FSG_80_0_0_24_Data_2 mit Record Nr. %d ist ungueltig. Die max. erlaubte Laenge ist %d.", StringLength, i, 1202-2);
				return;
			}
		}
		else if(0 == A_FSG_80_0_0_24_Data_2_CntList[i] ) /*check box deaktiviert*/
		{
			if(StringLength >= 0 && StringLength <= 127 && StringLength <= 1202-1)
			{
				data[currentPos++] = StringLength & 0x7F; //Bit 8 = 0
			}
			else
			{
				writelineEx(gBAP_Trace, 0, "Eingegebene Laenge: %d von A_FSG_80_0_0_24_Data_2 mit Record Nr. %d ist ungueltig. Die max. erlaubte Laenge ist %d. ", StringLength, i, 1202-1);
				return;
			}
		}
        for(j=0; j < StringLength ; j++)
        {
            data[currentPos++] = A_FSG_80_0_0_24_ArrayDataList[i].Param2[j];
        }
       }
    //sollte der letzte Parameter ein first nibble gewesen sein, muss noch 1 increment durchgefuehrt werden
    if( nibbleSetted==1) currentPos++;
    nibbleSetted = 0;
     }
    }
    else
    {
     if( (head[0] & 0x10) > 0)
     {
        if(startVal != 0) startVal--;
        else
        {
           startVal = A_FSG_80_0_0_24_ArrayDataList_Length -1;
        }
     }
     for( i = startVal ; i > startVal - elementsVal ; i--)
     {
       if( i < 0 || i >= A_FSG_80_0_0_24_ArrayDataList_Length )
       {
         write("Array index ausserhalb der Grenzen, Fct: 24");
         break;
       }
      if(nibbleSetted == 1) currentPos++;
      nibbleSetted = 0;
     if( (head[0]&0x40) == 0){ /* Transmit_Pos = 0, keine Positionsdaten */ }
     else
     {
        if( (head[0]&0x80) == 0)
        {
           //IndexSize = 0, Pos als 1 Byte Wert
           data[currentPos++] = A_FSG_80_0_0_24_ArrayDataList[i].Param1 & 0xFF;
        }
        else
        {
           //IndexSize = 1, Pos als 2 Byte Wert
           data[currentPos++] = A_FSG_80_0_0_24_ArrayDataList[i].Param1 & 0xFF;
           data[currentPos++] = (A_FSG_80_0_0_24_ArrayDataList[i].Param1 >> 8) & 0xFF;
        }
     }
      // Check if the current value of RecAdr enables the variable LicenseText:
      if( 0 || 1 == getValue( A_FSG_80_0_0_24_RecAdr ) )
      {
        //Sollte vor einem String Wert 1 Nibble kommen, muss der index um 1 incrementiert werden!
        if( nibbleSetted==1) currentPos++;
        nibbleSetted = 0;
        StringLength =A_FSG_80_0_0_24_ArrayDataList[i].Param2_Length;
		/* Pruefung ob die Laenge-Checkbox aktiv ist */
		if (1 == A_FSG_80_0_0_24_Data_2_CntList[i] )
		{
			if(StringLength >= 0 && StringLength <= 32767 && StringLength <= 1202-2)
			{
				data[currentPos++] = ( (StringLength >> 8) & 0x7F ) | 0x80; //2Byte Flag (Bit 8) setzen + HighByte (erste 7 bit)
				data[currentPos++] = StringLength &0xFF;
			}
			else
			{
				writelineEx(gBAP_Trace, 0, "Eingegebene Laenge: %d von A_FSG_80_0_0_24_Data_2 mit Record Nr. %d ist ungueltig. Die max. erlaubte Laenge ist %d.", StringLength, i, 1202-2);
				return;
			}
		}
		else if(0 == A_FSG_80_0_0_24_Data_2_CntList[i] ) /*check box deaktiviert*/
		{
			if(StringLength >= 0 && StringLength <= 127 && StringLength <= 1202-1)
			{
				data[currentPos++] = StringLength & 0x7F; //Bit 8 = 0
			}
			else
			{
				writelineEx(gBAP_Trace, 0, "Eingegebene Laenge: %d von A_FSG_80_0_0_24_Data_2 mit Record Nr. %d ist ungueltig. Die max. erlaubte Laenge ist %d. ", StringLength, i, 1202-1);
				return;
			}
		}
        for(j=0; j < StringLength ; j++)
        {
            data[currentPos++] = A_FSG_80_0_0_24_ArrayDataList[i].Param2[j];
        }
       }
    //sollte der letzte Parameter ein first nibble gewesen sein, muss noch 1 increment durchgefuehrt werden
    if( nibbleSetted==1) currentPos++;
    nibbleSetted = 0;
     }
    }
    Request_byteSequence(LSGID, A_FSG_80_0_0_24_ID, Data_REQ, data, currentPos);
}
on envVar A_FSG_80_0_0_24
{
    byte temp[1212];
    getValue(A_FSG_80_0_0_24, temp);
    putValue(A_FSG_80_0_0_24_RecAdr, 0x0F & temp[0]); //Record Address = Bit 0-3 von Byte 0
    if ( (0x10 & temp[0]) >0)
        putValue(A_FSG_80_0_0_24_Shift, 1); //Shift = Bit 4 von Byte 0
    else
        putValue(A_FSG_80_0_0_24_Shift, 0); //Shift = Bit 4 von Byte 0
    if ( (0x20 & temp[0]) >0)
        putValue(A_FSG_80_0_0_24_Direction, 1); //Direction = Bit 5 von Byte 0
    else
        putValue(A_FSG_80_0_0_24_Direction, 0); //Direction = Bit 5 von Byte 0
    if ( (0x40 & temp[0]) >0)
        putValue(A_FSG_80_0_0_24_TransPos, 1); //Transmission Pos = Bit 6 von Byte 0
    else
        putValue(A_FSG_80_0_0_24_TransPos, 0); //Transmission Pos = Bit 6 von Byte 0
    if ( (0x80 & temp[0]) >0)
        putValue(A_FSG_80_0_0_24_IndexSize, 1); //IndexSize = Bit 7 von Byte 0
    else
        putValue(A_FSG_80_0_0_24_IndexSize, 0); //IndexSize = Bit 7 von Byte 0
    if(getValue(A_FSG_80_0_0_24_IndexSize))
    {
        putValue(A_FSG_80_0_0_24_Start, ((temp[2]<<8)| temp[1]) ); // Array Start index, 2 Byte.
        putValue(A_FSG_80_0_0_24_Elements, ((temp[4]<<8)| temp[3]) ); // Array element count, 2 Byte.
    }
    else
    {
        putValue(A_FSG_80_0_0_24_Start, temp[1]); // Array Start index, 1 Byte.
        putValue(A_FSG_80_0_0_24_Elements, temp[2]); // Array element count, 1 Byte.
    }
}
A_FSG_80_0_0_24_GenerateStatus()
{
    byte head[5];
    int i = 0;
    int headLength;
    long tempValue;
    int currentPos;
    //Record Address in Byte 0 Bit 0-3 kopieren - MAX Wert = 0x0F
    if(getValue(A_FSG_80_0_0_24_RecAdr) > 0x0F)
        putValue(A_FSG_80_0_0_24_RecAdr , 0x0F);
    head[0] = (head[0] & 0xF0) | getValue(A_FSG_80_0_0_24_RecAdr);
    //Shift Bit in Byte 0 Bit 4 kopieren
    if( getValue(A_FSG_80_0_0_24_Shift) > 0) head[0] = head[0] | 0x10;
    else head[0] = head[0] & 0xEF;
    // Direction Bit in Byte 0 Bit 5 kopieren
    if( getValue(A_FSG_80_0_0_24_Direction) > 0) head[0] = head[0] | 0x20;
    else head[0] = head[0] & 0xDF;
    // TransmissionPos Bit in Byte 0 Bit 6 kopieren
    if( getValue(A_FSG_80_0_0_24_TransPos) > 0) head[0] = head[0] | 0x40;
    else head[0] = head[0] & 0xBF;
    if( getValue(A_FSG_80_0_0_24_IndexSize) > 0)
    {
        // 5 Byte Header
        head[0] = head[0] | 0x80;
        head[1] =  getValue(A_FSG_80_0_0_24_Start) & 0xFF;
        head[2] = (getValue(A_FSG_80_0_0_24_Start) >> 8 ) & 0xFF;
        head[3] =  getValue(A_FSG_80_0_0_24_Elements) & 0xFF;
        head[4] = (getValue(A_FSG_80_0_0_24_Elements)  >> 8 ) & 0xFF;
        //ToDo: DATA - derzeit einfach laenge = 5
        headLength = 5;
    }
    else 
    {
        // 3 Byte Header
        head[0] = head[0] & 0x7F;
        head[1] = getValue(A_FSG_80_0_0_24_Start) & 0xFF;
        head[2] = getValue(A_FSG_80_0_0_24_Elements) & 0xFF;
        //ToDo: DATA - derzeit einfach laenge = 3
        headLength = 3;
    }

    currentPos = 0;

    putValue(A_FSG_80_0_0_24, head, headLength); 
}

on envVar A_FSG_80_0_0_24_RecAdr
{
    A_FSG_80_0_0_24_GenerateStatus();
}

on envVar A_FSG_80_0_0_24_Shift
{
    A_FSG_80_0_0_24_GenerateStatus();
}

on envVar A_FSG_80_0_0_24_Direction
{
    A_FSG_80_0_0_24_GenerateStatus();
}

on envVar A_FSG_80_0_0_24_Start
{
    A_FSG_80_0_0_24_GenerateStatus();
}

on envVar A_FSG_80_0_0_24_Elements
{
    A_FSG_80_0_0_24_GenerateStatus();
}

on envVar A_FSG_80_0_0_24_IndexSize
{
    A_FSG_80_0_0_24_GenerateStatus();
}
on envVar A_FSG_80_0_0_24_TransPos
{
    A_FSG_80_0_0_24_GenerateStatus();
}
A_FSG_80_0_0_24_Changed_GenerateChanged()
{
    byte head[5];
    //Record Address in Byte 0 Bit 0-3 kopieren - MAX Wert = 0x0F
    if(getValue(A_FSG_80_0_0_24_Changed_RecAdr) > 0x0F)
        putValue(A_FSG_80_0_0_24_Changed_RecAdr , 0x0F);
    head[0] = (head[0] & 0xF0) | getValue(A_FSG_80_0_0_24_Changed_RecAdr);
    //Shift Bit in Byte 0 Bit 4 kopieren
    if( getValue(A_FSG_80_0_0_24_Changed_Shift) > 0) head[0] = head[0] | 0x10;
    else head[0] = head[0] & 0xEF;
    // Direction Bit in Byte 0 Bit 5 kopieren
    if( getValue(A_FSG_80_0_0_24_Changed_Direction) > 0) head[0] = head[0] | 0x20;
    else head[0] = head[0] & 0xDF;
    // TransmissionPos Bit in Byte 0 Bit 6 kopieren
    if( getValue(A_FSG_80_0_0_24_Changed_TransPos) > 0) head[0] = head[0] | 0x40;
    else head[0] = head[0] & 0xBF;
    if( getValue(A_FSG_80_0_0_24_Changed_IndexSize) > 0)
    {
        // 5 Byte Header
        head[0] = head[0] | 0x80;
        head[1] =  getValue(A_FSG_80_0_0_24_Changed_Start) & 0xFF;
        head[2] = (getValue(A_FSG_80_0_0_24_Changed_Start) >> 8 ) & 0xFF;
        head[3] =  getValue(A_FSG_80_0_0_24_Changed_Elements) & 0xFF;
        head[4] = (getValue(A_FSG_80_0_0_24_Changed_Elements)  >> 8 ) & 0xFF;
        //ToDo: DATA - derzeit einfach laenge = 5
        putValue(A_FSG_80_0_0_24_Changed, head, 5); 
    }
    else 
    {
        // 3 Byte Header
        head[0] = head[0] & 0x7F;
        head[1] = getValue(A_FSG_80_0_0_24_Changed_Start) & 0xFF;
        head[2] = getValue(A_FSG_80_0_0_24_Changed_Elements) & 0xFF;
        //ToDo: DATA - derzeit einfach laenge = 3
        putValue(A_FSG_80_0_0_24_Changed, head, 3); 
    }
}

on envVar A_FSG_80_0_0_24_Changed_RecAdr
{
    A_FSG_80_0_0_24_Changed_GenerateChanged();
}

on envVar A_FSG_80_0_0_24_Changed_Shift
{
    A_FSG_80_0_0_24_Changed_GenerateChanged();
}

on envVar A_FSG_80_0_0_24_Changed_Direction
{
    A_FSG_80_0_0_24_Changed_GenerateChanged();
}

on envVar A_FSG_80_0_0_24_Changed_Start
{
    A_FSG_80_0_0_24_Changed_GenerateChanged();
}

on envVar A_FSG_80_0_0_24_Changed_Elements
{
    A_FSG_80_0_0_24_Changed_GenerateChanged();
}

on envVar A_FSG_80_0_0_24_Changed_IndexSize
{
    A_FSG_80_0_0_24_Changed_GenerateChanged();
}
on envVar A_FSG_80_0_0_24_Changed_TransPos
{
    A_FSG_80_0_0_24_Changed_GenerateChanged();
}
on envVar A_FSG_80_0_0_24_SetGet
{
    byte temp[1212];
    getValue(A_FSG_80_0_0_24_SetGet, temp);
    putValue(A_FSG_80_0_0_24_SetGet_RecAdr, 0x0F & temp[0]); //Record Address = Bit 0-3 von Byte 0
    if ( (0x10 & temp[0]) >0)
        putValue(A_FSG_80_0_0_24_SetGet_Shift, 1); //Shift = Bit 4 von Byte 0
    else
        putValue(A_FSG_80_0_0_24_SetGet_Shift, 0); //Shift = Bit 4 von Byte 0
    if ( (0x20 & temp[0]) >0)
        putValue(A_FSG_80_0_0_24_SetGet_Direction, 1); //Direction = Bit 5 von Byte 0
    else
        putValue(A_FSG_80_0_0_24_SetGet_Direction, 0); //Direction = Bit 5 von Byte 0
    // Bit 6 von Byte 0 = reserved
    if ( (0x80 & temp[0]) >0)
        putValue(A_FSG_80_0_0_24_SetGet_IndexSize, 1); //IndexSize = Bit 7 von Byte 0
    else
        putValue(A_FSG_80_0_0_24_SetGet_IndexSize, 0); //IndexSize = Bit 7 von Byte 0
    if(getValue(A_FSG_80_0_0_24_SetGet_IndexSize))
    {
        putValue(A_FSG_80_0_0_24_SetGet_Start, ((temp[2]<<8)| temp[1]) ); //Start Wert, 2 Byte lang
        putValue(A_FSG_80_0_0_24_SetGet_Elements, ((temp[4]<<8)| temp[3]) ); //Elements Wert, 2 Byte lang
    }
    else
    {
        putValue(A_FSG_80_0_0_24_SetGet_Start, temp[1]); //Start Wert, 1 Byte lang
        putValue(A_FSG_80_0_0_24_SetGet_Elements, temp[2]); //Start Wert, 1 Byte lang
    }
}
A_FSG_80_0_0_24_LoadArray()
{
	/********* Statische Deklarationen ***********/
	dword CSVfileHandle;
	dword filePos;
	dword paramPos;
	dword Num_of_csv_byte;
	dword element;
	dword current_CSV_line;
	byte buffer_byte[0xFFFF];
	dword i;
	dword j;
	char CSV_filename[255];
	dword  count1 =0, count2 =0;
	char CSV_filepath[0xFFFF];

	/********* Param Puffer Deklarationen ***********/
	char temp1[25];

	/********* Initialisierungen ***********/
	CSVfileHandle = 0;
	filePos = 0;
	paramPos = 0;
	Num_of_csv_byte = 0;
	element = 1;
	current_CSV_line = 0;
	for(i = 0; i < A_FSG_80_0_0_24_ArrayDataList_Length; i++)
	{ /* Initialisierung von den Ziel-Strukturen */
		A_FSG_80_0_0_24_ArrayDataList[i].Param1 = 0;
		for(j=0; j<1202; j++)
			A_FSG_80_0_0_24_ArrayDataList[i].Param2[j] = 0;
		A_FSG_80_0_0_24_ArrayDataList[i].Param2_Length = 0;
		A_FSG_80_0_0_24_Data_2_LenList[i] = 0;
	}

	/********* Laden der CSV-Datei ***********/
	for(i=0;i<0xFFFF;i++)
		CSV_filepath[i] =0;

	getValue(A_FSG_80_0_0_24_fileSelector, CSV_filepath);
	i =0;
	while (CSV_filepath[i] !=0) //scan "path"
	{
		if(CSV_filepath[i] ==0x5C) //count "/" to seperate later "path" & "filename" 
				count1++;
		//write("Path[%d] of *.csv: %x",i, CSV_filepath[i]); //debug
		i++;
	}  
	 
	i =0; j =0; //reset values
	while (CSV_filepath[i] !=0) //seperate "path" and "filename"
	{
		if(count2==count1) //get filename after last "\"
		{              
			CSV_filename[j] =CSV_filepath[i];
			j++;
			CSV_filepath[i] =0;              
		}
		if(CSV_filepath[i]==0x5C) //count "\" to get filename after last "\"            
			count2++;   
		i++;
	}
	setFilePath(CSV_filepath, 0); //set path for *.csv file
	CSVfileHandle = openFileRead(CSV_filename, 1); //open *.csv (binary-mode ->get the ASCII/UTF-8 code)

	if (CSVfileHandle!=0) //*.csv file access successful
	{
		writelineEx(gBAP_Trace, 0,"Dateizugriff auf '%s' erfolgreich", CSV_filename);    //output result
		//get data from *.csv and store the total number of byte in *.csv-file
		Num_of_csv_byte = fileGetBinaryBlock (buffer_byte, elcount(buffer_byte), CSVfileHandle);

		for (filePos = 0; filePos < Num_of_csv_byte; filePos++) //copy data into "LastDestList"
		{
			if (buffer_byte[filePos] != 0x3B) //read data if no ";" is detected
			{
				//nextline in *.csv (next "record element" in LastDestList) -> "LF" and "CR" detected -> copy (transform string -> long) data from help values in global values
				if(buffer_byte[filePos] == 0x0D && buffer_byte[filePos+1] == 0x0A)
				{
					if(current_CSV_line > 0 && current_CSV_line < 65536) //ignore first line in *.csv file
					{
						A_FSG_80_0_0_24_ArrayDataList[current_CSV_line-1].Param1 = atol(temp1); //Pos
						for(i = 0; i < 25; i++)
						{ /* Temp-Puffer Initialisierung zur Vermeidung von Nebeneffekte */
							temp1[i]=0;
						}
					}
					current_CSV_line++; //next line in *.csv file
					element = 1; //start at 'POS' (first record element of "array data")
					paramPos = 0; //reset value
				}
 				//copy data from "buffer_byte" (data from *.csv file) in help values and "name" until end of line is not detected
				else if(current_CSV_line > 0 && current_CSV_line < 65536)
				{
					//writelineEx(gBAP_Trace, 0, "Element %x  Index %x", element, j);
					switch (element)
					{
						case 1: //Pos
								if( paramPos >= elCount(temp1) ){
									writelineEx(gBAP_Trace, 0, "Param%x in Zeile %d in der Input CSV Datei, enthaelt mehr Zeichen als erlaubt. Bearbeitung abgebrochen!", element, current_CSV_line);
									return; //False
								}else{
									temp1[paramPos] = buffer_byte[filePos];
									paramPos++;
								}
							break;
						case 2: //LicenseText
								if(paramPos < 1200)
								{
									A_FSG_80_0_0_24_ArrayDataList[current_CSV_line-1].Param2[paramPos] = buffer_byte[filePos];
									A_FSG_80_0_0_24_ArrayDataList[current_CSV_line-1].Param2_Length = paramPos +1;
								}
								paramPos++;
						break;
						default:
						break;
					}
				}
			}
			else  // ";" is detected ->next record element of "array data"
			{
				//writelineEx(gBAP_Trace, 0, "naechstes Element %d Bytes",element);
				element++;
				paramPos=0; //reset value
			}
		}

		if(fileClose (CSVfileHandle) !=0) //close *.csv file
			writelineEx(gBAP_Trace, 0,"Datei '%s' geschlossen", CSV_filename); //output result
		else
			writelineEx(gBAP_Trace, 0,"Fehler beim Schliessen der Datei '%s'", CSV_filename);//output result
	}
	else //*.csv file access not successful
	{
		writelineEx(gBAP_Trace, 0,"Fehler beim Dateizugriff auf '%s'",CSV_filename); //output result
	}
}

on envVar A_FSG_80_0_0_24_loadArray_Btn
{
	char filePath[255];
	if (A_FSG_80_0_0_24_generateData_Btn_already_pressed == 0)
	{
		A_FSG_80_0_0_24_generateData_Btn_already_pressed = 1;
	}
	else
	{
		A_FSG_80_0_0_24_generateData_Btn_already_pressed = 0;
		getValue(A_FSG_80_0_0_24_fileSelector, filePath);
		if(0 == strlen(filePath))
		{
			writelineEx(gBAP_Trace, 0, "Invalid file path!");
		}
		else
		{
			A_FSG_80_0_0_24_LoadArray();
			writelineEx(gBAP_Trace, 0, "Load array from CSV file: %s", filePath);
		}
	}
	putValue(A_FSG_80_0_0_24_Data_1, A_FSG_80_0_0_24_ArrayDataList[ getValue( A_FSG_80_0_0_24_DataIndex) ].Param1);
	putValue(A_FSG_80_0_0_24_Data_2, A_FSG_80_0_0_24_ArrayDataList[ getValue( A_FSG_80_0_0_24_DataIndex) ].Param2, A_FSG_80_0_0_24_ArrayDataList[getValue(A_FSG_80_0_0_24_DataIndex)].Param2_Length);
}
on envVar A_FSG_80_0_0_24_generateData_Btn
{
	word i;
	dword elementsArray[3] = {2, 1202, 2};
	byte elementsTypeArray[3] = {0, 0xE, 0xF};
	dword elementsMaxSizeArray[3] = {65535, 0, 0};
	byte tempArray[9879552];
	if (A_FSG_80_0_0_24_generateData_Btn_already_pressed == 0)
	{
		A_FSG_80_0_0_24_generateData_Btn_already_pressed = 1;
	}
	else
	{
		initStruct(tempArray, elementsArray, elementsTypeArray, elementsMaxSizeArray, 24, 8192 );
		for(i = 0; i < 8192; i++)
		{
			memcpy(A_FSG_80_0_0_24_ArrayDataList[i], tempArray, (i * 1206) );
			if(A_FSG_80_0_0_24_ArrayDataList[i].Param2_Length > 127 )
				A_FSG_80_0_0_24_Data_2_CntList[i] = 1;
		}
		A_FSG_80_0_0_24_generateData_Btn_already_pressed = 0;
	}
	putValue(A_FSG_80_0_0_24_Data_1, A_FSG_80_0_0_24_ArrayDataList[ getValue( A_FSG_80_0_0_24_DataIndex) ].Param1);
	putValue(A_FSG_80_0_0_24_Data_2, A_FSG_80_0_0_24_ArrayDataList[ getValue( A_FSG_80_0_0_24_DataIndex) ].Param2, A_FSG_80_0_0_24_ArrayDataList[getValue(A_FSG_80_0_0_24_DataIndex)].Param2_Length);
}
// HME generateCaplOnEnv (3131)
on envVar A_FSG_80_0_0_24_DataIndex
{
    long index;
    long maxIndex = 65535-1;
    index = getValue(this);
    if(index >= maxIndex) index = maxIndex;
    else if(index < 0) index = 0;
    putValue(this, index);
    putValue(A_FSG_80_0_0_24_Data_1, A_FSG_80_0_0_24_ArrayDataList[index].Param1);
    putValue(A_FSG_80_0_0_24_Data_2_len, A_FSG_80_0_0_24_Data_2_LenList[index]);
    putValue(A_FSG_80_0_0_24_Data_2_cnt, A_FSG_80_0_0_24_Data_2_CntList[index]);
    putValue(A_FSG_80_0_0_24_Data_2, A_FSG_80_0_0_24_ArrayDataList[index].Param2, A_FSG_80_0_0_24_ArrayDataList[index].Param2_Length);

}
on envVar A_FSG_80_0_0_24_DataIndex_Incr
{
    long index;
    if(A_FSG_80_0_0_24_DataIndex_Incr_already_pressed == 0)
    {
        A_FSG_80_0_0_24_DataIndex_Incr_already_pressed = 1;
    }
    else
    {
        index = getValue(A_FSG_80_0_0_24_DataIndex);
        index++;
        putValue(A_FSG_80_0_0_24_DataIndex, index);
        A_FSG_80_0_0_24_DataIndex_Incr_already_pressed = 0;
    }
}
on envVar A_FSG_80_0_0_24_DataIndex_Decr
{
    long index;
    if(A_FSG_80_0_0_24_DataIndex_Decr_already_pressed == 0)
    {
        A_FSG_80_0_0_24_DataIndex_Decr_already_pressed = 1;
    }
    else
    {
        index = getValue(A_FSG_80_0_0_24_DataIndex);
        index--;
        putValue(A_FSG_80_0_0_24_DataIndex, index);
        A_FSG_80_0_0_24_DataIndex_Decr_already_pressed = 0;
    }
}
on envVar A_FSG_80_0_0_24_FctEn
{
    long data[3];
    data[0]=LSGID;
    data[1]=A_FSG_80_0_0_24_ID;
    data[2]=getValue(A_FSG_80_0_0_24_FctEn);
    ChangeConfig(0x0031,data);
}
// De-Aktivierung der Eingabefelder der FCTID A_FSG_80_0_0_24
on envVar A_FSG_80_0_0_24_FctLstItemEn
{
       if(getValue(this)) 
       {
           EnableControl(panel_name,"panel_FSG_80_0_0_24",1);
           EnableControl(panel_name,"panel_A_FSG_80_0_0_24_Status",1);
           EnableControl(panel_name,"errfield_A_FSG_80_0_0_24",1);
           EnableControl(panel_name,"panel_A_FSG_80_0_0_24",1);
           EnableControl(panel_name,"panel_A_FSG_80_0_0_24_Changed",1);
           EnableControl(panel_name,"panel_A_FSG_80_0_0_24_SetGet",1);
           setControlForeColor(panel_name, "checkbox_A_FSG_80_0_0_24", MakeRGB(0,240,0));
       }
       else
       {
           EnableControl(panel_name,"panel_FSG_80_0_0_24",0);
           EnableControl(panel_name,"panel_A_FSG_80_0_0_24_Status",0);
           EnableControl(panel_name,"errfield_A_FSG_80_0_0_24",0);
           EnableControl(panel_name,"panel_A_FSG_80_0_0_24",0);
           EnableControl(panel_name,"panel_A_FSG_80_0_0_24_Changed",0);
           EnableControl(panel_name,"panel_A_FSG_80_0_0_24_SetGet",0);
           setControlForeColor(panel_name, "checkbox_A_FSG_80_0_0_24", MakeRGB(250,0,0));
       }
}
// Man darf gleichzeitig nur Checkbox fuer SegmError oder IntertelegramError aktiviert werden
on envVar A_FSG_80_0_0_24_IntTlgEn
{
       if(getValue(this)) 
       {
           putValue(A_FSG_80_0_0_24_SegmEn,0);
           intertelegram_err(A_FSG_80_0_0_24_ID);
       }
       else
       {
           intertelegram_err_off(A_FSG_80_0_0_24_ID);
       }
}
// Man darf gleichzeitig nur Checkbox fuer SegmError oder IntertelegramError aktiviert werden
on envVar A_FSG_80_0_0_24_SegmEn
{
       if(getValue(this)) 
       {
           putValue(A_FSG_80_0_0_24_IntTlgEn,0);
           sequence_err(A_FSG_80_0_0_24_ID,getValueSize(A_FSG_80_0_0_24_SegmEn));
       }
       else
       {
              sequence_err_off(A_FSG_80_0_0_24_ID);
       }
}

// [XL] Ueberwachung der CheckBox fuer AT
on envVar A_FSG_80_0_0_24_AT
{
	if(getValue(this))
	{
		EnableControl(panel_name,"panel_A_FSG_80_0_0_24_Status",0);
	}
	else
	{
   	EnableControl(panel_name,"panel_A_FSG_80_0_0_24_Status",1);
 	}
}

A_FSG_80_0_0_24_SetInd () { /* leere Function*/ }

A_FSG_80_0_0_24_SetGetInd () { /* leere Function*/ }

A_FSG_80_0_0_24_GetInd()
{
    int currentPos;
    byte head[5];
    byte stringTempValue[1212];
    int i;
    int j;
    int startVal;
    int elementsVal;
    byte recordAddressVal;
    byte transmitPosVal;
    long tempValue;
    long index;
    byte nibbleSetted;
    currentPos = 0;
    nibbleSetted = 0;
    //Einzelparameter: ASG_ID
    if(nibbleSetted == 1)
    {
        //voriger Parameter war ein Nibble, => second nibble, Pos incr und Flag zuruecksetzen
        tempValue = (gBAP_Indication_data[currentPos++] &0xF);
        nibbleSetted = 0;
    }
    else
    {
        //first nibble, kein increment, Flag setzen
        tempValue = ((gBAP_Indication_data[currentPos]>>4) &0xF);
        nibbleSetted = 1;
    }
    putValue(A_FSG_80_0_0_24_1_SetGet, tempValue);
    //Einzelparameter: TAID
    if(nibbleSetted == 1)
    {
        //voriger Parameter war ein Nibble, => second nibble, Pos incr und Flag zuruecksetzen
        tempValue = (gBAP_Indication_data[currentPos++] &0xF);
        nibbleSetted = 0;
    }
    else
    {
        //first nibble, kein increment, Flag setzen
        tempValue = ((gBAP_Indication_data[currentPos]>>4) &0xF);
        nibbleSetted = 1;
    }
    putValue(A_FSG_80_0_0_24_2_SetGet, tempValue);
    //head Parameter
    if(gBAP_Indication_header[4] >= (3+currentPos))
    {
        if( (gBAP_Indication_data[currentPos] & 0x80) > 0)
            if(gBAP_Indication_header[4] >= (5+currentPos))
            {
                for(i = 0; i < 5; i++) head[i] = gBAP_Indication_data[currentPos++];
                putValue(A_FSG_80_0_0_24_SetGet, head, 5);
                if(getValue(A_FSG_80_0_0_24_AT))
                {
                    putValue(A_FSG_80_0_0_24,head,5);
                }
                startVal = (head[2]<<8) | head[1];
                elementsVal = (head[4]<<8) | head[3];
            }
            else write("received Data Error");
        else
        {
            for(i = 0; i < 3; i++) head[i] = gBAP_Indication_data[currentPos++];
            putValue(A_FSG_80_0_0_24_SetGet, head, 3);
            if(getValue(A_FSG_80_0_0_24_AT))
            {
                putValue(A_FSG_80_0_0_24,head,3);
            }
                startVal = head[1];
                elementsVal = head[2];
        }
        recordAddressVal = head[0] & 0x0F;
        transmitPosVal = head[0] & 0x40;
        if(getValue(A_FSG_80_0_0_24_AT))
        {
            putValue(A_FSG_80_0_0_24_RecAdr,recordAddressVal);
            putValue(A_FSG_80_0_0_24_Start, startVal);
            putValue(A_FSG_80_0_0_24_Elements, elementsVal);
            putValue(A_FSG_80_0_0_24_TransPos, transmitPosVal);
        }
    }
}

on envVar A_FSG_80_0_0_24_1
{
	byte superval[1212];

	//Update Childvalue (Enum)
	byte thisval; // ASG_ID
	thisval = 0x0f & getValue(this);
}
// Ueberwachung der Darstellungsvariable der Range.
on envVar A_FSG_80_0_0_24_2_range // LicenseInformation.TAID 
{
	@A_FSG_80_0_0_24_2 = @A_FSG_80_0_0_24_2_range - (0); // slider = range - min
}

on envVar A_FSG_80_0_0_24_2
{
	byte superval[1212];

	//Update Childvalue (Number)
	byte thisval; // TAID
	float slider_value;

	slider_value = round(@A_FSG_80_0_0_24_2, 1.0);
	@A_FSG_80_0_0_24_2_range = slider_value + (0); // real value := slider value + range min.
	thisval = (byte)round((slider_value + (0) - (0)) / (1.0), 1); // bus value := (slider value + min - offset) / step.
}
// Ueberwachung der Darstellungsvariable der Range.
on envVar A_FSG_80_0_0_24_3_range // LicenseInformation.TotalNumListElements 
{
	@A_FSG_80_0_0_24_3 = @A_FSG_80_0_0_24_3_range - (0); // slider = range - min
}

on envVar A_FSG_80_0_0_24_3
{
	byte superval[1212];

	//Update Childvalue (Number)
	word thisval; // TotalNumListElements
	float slider_value;

	slider_value = round(@A_FSG_80_0_0_24_3, 1.0);
	@A_FSG_80_0_0_24_3_range = slider_value + (0); // real value := slider value + range min.
	thisval = (word)round((slider_value + (0) - (0)) / (1.0), 1); // bus value := (slider value + min - offset) / step.
}
// Ueberwachung der Darstellungsvariable der Range.
on envVar A_FSG_80_0_0_24_Data_1_range // LicenseInformation.Pos 
{
	@A_FSG_80_0_0_24_Data_1 = @A_FSG_80_0_0_24_Data_1_range - (0); // slider = range - min
}

on envVar A_FSG_80_0_0_24_Data_1
{
	byte superval[1212];

	//Update Childvalue (Number)
	word thisval; // Pos
	float slider_value;

	slider_value = round(@A_FSG_80_0_0_24_Data_1, 1.0);
	@A_FSG_80_0_0_24_Data_1_range = slider_value + (0); // real value := slider value + range min.
	thisval = (word)round((slider_value + (0) - (0)) / (1.0), 1); // bus value := (slider value + min - offset) / step.
    A_FSG_80_0_0_24_ArrayDataList[getValue(A_FSG_80_0_0_24_DataIndex)].Param1 = thisval;
}

// Ueberwachung der CheckBox fuer String
on envVar  A_FSG_80_0_0_24_Data_2_cnt
{
	word len;
	byte cnt;
	len = getValue(A_FSG_80_0_0_24_Data_2_len);
	cnt = getValue(this);

    /* Cnt Wert im Array aktualisieren */
	 A_FSG_80_0_0_24_Data_2_CntList[ getValue(A_FSG_80_0_0_24_DataIndex) ] = cnt;

	/* wird nur gerufen, wenn check box deaktiviert mit Length>127*/ 
	if(cnt == 0) 
	{
		if(len > 127 )
		{
			putValue(A_FSG_80_0_0_24_Data_2_len, 127);
		}
	}

}


on envVar A_FSG_80_0_0_24_Data_2_len
{
	long thisval;
	byte cnt;
	thisval = getValue(this);
	cnt = getValue(A_FSG_80_0_0_24_Data_2_cnt);

	/* wenn die Laenge ausserhalb des erlaubten Bereich liegt, wird diese begrenzt */
	if(thisval > 1200 || thisval < 0 )
	{
		writelineEx(gBAP_Trace, 0, "Eingegebene Laenge: %d von A_FSG_80_0_0_24_Data_2 ist ungueltig. Die max. erlaubte Laenge ist %d. ", thisval, 1200);
		thisval = 1200;
	}
	if( thisval >127)
	{
		putValue(A_FSG_80_0_0_24_Data_2_cnt, 1); /* Switch checkbox on */
	}

	A_FSG_80_0_0_24_ArrayDataList[getValue(A_FSG_80_0_0_24_DataIndex)].Param2_Length = thisval;
	A_FSG_80_0_0_24_Data_2_LenList[ getValue(A_FSG_80_0_0_24_DataIndex) ] = thisval;
	putValue(A_FSG_80_0_0_24_Data_2_len, thisval);

}

on envVar A_FSG_80_0_0_24_Data_2
{
	byte superval[1212];

	//Update Childvalue (String)
	word i;
	byte thisval[1202];
	getValue(this, thisval);
    for(i = 0; i < getValueSize(this); i++)
        A_FSG_80_0_0_24_ArrayDataList[getValue(A_FSG_80_0_0_24_DataIndex)].Param2[i] = thisval[i];
    A_FSG_80_0_0_24_ArrayDataList[getValue(A_FSG_80_0_0_24_DataIndex)].Param2_Length = getValueSize(this);
    A_FSG_80_0_0_24_Data_2_LenList[getValue(A_FSG_80_0_0_24_DataIndex)]= getValueSize(this);
    putValue(A_FSG_80_0_0_24_Data_2_len, getValueSize(this));
}
on envVar A_FSG_80_0_0_24_1_SetGet
{
	byte superval[6];

	//Update Childvalue (Enum)
	byte thisval; // ASG_ID
	thisval = 0x0f & getValue(this);
}
// Ueberwachung der Darstellungsvariable der Range.
on envVar A_FSG_80_0_0_24_2_SetGet_range // LicenseInformation.TAID 
{
	@A_FSG_80_0_0_24_2_SetGet = @A_FSG_80_0_0_24_2_SetGet_range - (0); // slider = range - min
}

on envVar A_FSG_80_0_0_24_2_SetGet
{
	byte superval[6];

	//Update Childvalue (Number)
	byte thisval; // TAID
	float slider_value;

	slider_value = round(@A_FSG_80_0_0_24_2_SetGet, 1.0);
	@A_FSG_80_0_0_24_2_SetGet_range = slider_value + (0); // real value := slider value + range min.
	thisval = (byte)round((slider_value + (0) - (0)) / (1.0), 1); // bus value := (slider value + min - offset) / step.
}
// Ruecksetzen des Fehlerstatus durch manuelle Fehlereingabe
on envVar P_FSG_80_0_0_25_ErrCode
{
       if(gP_FSG_80_0_0_25_ErrCode) 
       {
           setControlBackColor(panel_name,"errfield_P_FSG_80_0_0_25", MakeRGB(255,255,255));
       }
       gP_FSG_80_0_0_25_ErrCode = 1;
}
on envVar P_FSG_80_0_0_25Status_BTN
{
	byte BAPTemp[335];
    if (P_FSG_80_0_0_25Status_BTN_already_pressed == 0)
    {
        putValue(P_FSG_80_0_0_25_ErrCode,0);
        SetControlBackColor(panel_name,"errField_P_FSG_80_0_0_25",MakeRGB(255,255,255));
        P_FSG_80_0_0_25Status_BTN_already_pressed = 1;
    }
    else
    {
		P_FSG_80_0_0_25_BuildFct();
        getValue(P_FSG_80_0_0_25, BAPTemp);
        Request_ByteSequence(LSGID, P_FSG_80_0_0_25_ID, Data_REQ, BAPTemp, getValueSize(P_FSG_80_0_0_25));
        if(getValue(P_FSG_80_0_0_25_IntTlgEn)) //getValue(IT))
        {
           intertelegram_err(P_FSG_80_0_0_25_ID);
        }
        if(getValue(P_FSG_80_0_0_25_SegmEn))   //getvalue(SG)
        {
           sequence_err(P_FSG_80_0_0_25_ID,elCount(BAPTemp));
        }
       P_FSG_80_0_0_25Status_BTN_already_pressed = 0;
    }
}
on envVar P_FSG_80_0_0_25_FctEn
{
    long data[3];
    data[0]=LSGID;
    data[1]=P_FSG_80_0_0_25_ID;
    data[2]=getValue(P_FSG_80_0_0_25_FctEn);
    ChangeConfig(0x0031,data);
}
// De-Aktivierung der Eingabefelder der FCTID P_FSG_80_0_0_25
on envVar P_FSG_80_0_0_25_FctLstItemEn
{
       if(getValue(this)) 
       {
           EnableControl(panel_name,"panel_FSG_80_0_0_25",1);
           EnableControl(panel_name,"errfield_P_FSG_80_0_0_25",1);
           EnableControl(panel_name,"panel_P_FSG_80_0_0_25",1);
           setControlForeColor(panel_name, "checkbox_P_FSG_80_0_0_25", MakeRGB(0,240,0));
       }
       else
       {
           EnableControl(panel_name,"panel_FSG_80_0_0_25",0);
           EnableControl(panel_name,"errfield_P_FSG_80_0_0_25",0);
           EnableControl(panel_name,"panel_P_FSG_80_0_0_25",0);
           setControlForeColor(panel_name, "checkbox_P_FSG_80_0_0_25", MakeRGB(250,0,0));
       }
}
// Man darf gleichzeitig nur Checkbox fuer SegmError oder IntertelegramError aktiviert werden
on envVar P_FSG_80_0_0_25_IntTlgEn
{
       if(getValue(this)) 
       {
           putValue(P_FSG_80_0_0_25_SegmEn,0);
           intertelegram_err(P_FSG_80_0_0_25_ID);
       }
       else
       {
           intertelegram_err_off(P_FSG_80_0_0_25_ID);
       }
}
// Man darf gleichzeitig nur Checkbox fuer SegmError oder IntertelegramError aktiviert werden
on envVar P_FSG_80_0_0_25_SegmEn
{
       if(getValue(this)) 
       {
           putValue(P_FSG_80_0_0_25_IntTlgEn,0);
           sequence_err(P_FSG_80_0_0_25_ID,getValueSize(P_FSG_80_0_0_25_SegmEn));
       }
       else
       {
              sequence_err_off(P_FSG_80_0_0_25_ID);
       }
}
on envVar P_FSG_80_0_0_25 // bus value of VersionInfo (25).
{
	// opcodes: Error-Status
	byte param1[151]; // CurrentTrainVersion
	word len1;
	byte cnt1;
	byte param2[31]; // CurrentMUVersion
	word len2;
	byte cnt2;
	byte param3[151]; // UpdateTrainVersion
	word len3;
	byte cnt3;
	byte param4; // Extension1
	byte param5; // Extension2
	// DATATYPE_BYTESEQUENCE / DATATYPE_FIXEDBYTESEQUENCE
	int i;
	byte superval[335];
	int currentPos;
	currentPos = 0;
	for( i = 0; i < 335; i++ ) {
		superval[i] = 0;
	}
	getValue(P_FSG_80_0_0_25, superval);
	///////// Start param1 - STRING /////////
	getValue(P_FSG_80_0_0_25_1, param1);
	if((superval[currentPos] & 0x80) > 0)
	{
		if(149>127) /* Max Fct-Katalog Laenge: 149*/
		{
			len1 = ( (superval[currentPos]&0x7F) <<8) + superval[currentPos+1];
			currentPos = currentPos + 2;
			cnt1 = 1;
		}
		else
		{
			len1 = 149;
			writelineEx(gBAP_Trace, 0, "Anzahl der Laengeninformation-Bytes in P_FSG_80_0_0_25 ueberschreitet die erlaubte 1 Byte vom Fct-Kalatog.");
		}
	}
	else
	{
		len1 = superval[currentPos]&0x7F;
		currentPos = currentPos + 1;
		cnt1 = 0;
	}
	
	if(len1 > 149)
	{
		writelineEx(gBAP_Trace, 0, "Laenge:%d bei der Byte Position:%d ueberschreitet die Maximale erlaubte Laenge von Fct-Kalatog", len1, currentPos);
		len1 = 149;
	
		if(len1 < 128) cnt1 = 0;
		else cnt1 = 1;
	}
	
	for(i = 0; i < len1; i++)
	{
		param1[i] = superval[currentPos++];
	}
	
	putValue(P_FSG_80_0_0_25_1_len, len1);
	putValue(P_FSG_80_0_0_25_1_cnt, cnt1);
	
	if(len1 > getValueSize(P_FSG_80_0_0_25_1))
		putValue(P_FSG_80_0_0_25_1, param1, len1);
	else
		putValue(P_FSG_80_0_0_25_1, param1, getValueSize(P_FSG_80_0_0_25_1));

	///////// Start param2 - STRING /////////
	getValue(P_FSG_80_0_0_25_2, param2);
	if((superval[currentPos] & 0x80) > 0)
	{
		if(30>127) /* Max Fct-Katalog Laenge: 30*/
		{
			len2 = ( (superval[currentPos]&0x7F) <<8) + superval[currentPos+1];
			currentPos = currentPos + 2;
			cnt2 = 1;
		}
		else
		{
			len2 = 30;
			writelineEx(gBAP_Trace, 0, "Anzahl der Laengeninformation-Bytes in P_FSG_80_0_0_25 ueberschreitet die erlaubte 1 Byte vom Fct-Kalatog.");
		}
	}
	else
	{
		len2 = superval[currentPos]&0x7F;
		currentPos = currentPos + 1;
		cnt2 = 0;
	}
	
	if(len2 > 30)
	{
		writelineEx(gBAP_Trace, 0, "Laenge:%d bei der Byte Position:%d ueberschreitet die Maximale erlaubte Laenge von Fct-Kalatog", len2, currentPos);
		len2 = 30;
	
		if(len2 < 128) cnt2 = 0;
		else cnt2 = 1;
	}
	
	for(i = 0; i < len2; i++)
	{
		param2[i] = superval[currentPos++];
	}
	
	putValue(P_FSG_80_0_0_25_2_len, len2);
	putValue(P_FSG_80_0_0_25_2_cnt, cnt2);
	
	if(len2 > getValueSize(P_FSG_80_0_0_25_2))
		putValue(P_FSG_80_0_0_25_2, param2, len2);
	else
		putValue(P_FSG_80_0_0_25_2, param2, getValueSize(P_FSG_80_0_0_25_2));

	///////// Start param3 - STRING /////////
	getValue(P_FSG_80_0_0_25_3, param3);
	if((superval[currentPos] & 0x80) > 0)
	{
		if(149>127) /* Max Fct-Katalog Laenge: 149*/
		{
			len3 = ( (superval[currentPos]&0x7F) <<8) + superval[currentPos+1];
			currentPos = currentPos + 2;
			cnt3 = 1;
		}
		else
		{
			len3 = 149;
			writelineEx(gBAP_Trace, 0, "Anzahl der Laengeninformation-Bytes in P_FSG_80_0_0_25 ueberschreitet die erlaubte 1 Byte vom Fct-Kalatog.");
		}
	}
	else
	{
		len3 = superval[currentPos]&0x7F;
		currentPos = currentPos + 1;
		cnt3 = 0;
	}
	
	if(len3 > 149)
	{
		writelineEx(gBAP_Trace, 0, "Laenge:%d bei der Byte Position:%d ueberschreitet die Maximale erlaubte Laenge von Fct-Kalatog", len3, currentPos);
		len3 = 149;
	
		if(len3 < 128) cnt3 = 0;
		else cnt3 = 1;
	}
	
	for(i = 0; i < len3; i++)
	{
		param3[i] = superval[currentPos++];
	}
	
	putValue(P_FSG_80_0_0_25_3_len, len3);
	putValue(P_FSG_80_0_0_25_3_cnt, cnt3);
	
	if(len3 > getValueSize(P_FSG_80_0_0_25_3))
		putValue(P_FSG_80_0_0_25_3, param3, len3);
	else
		putValue(P_FSG_80_0_0_25_3, param3, getValueSize(P_FSG_80_0_0_25_3));

	///////// Start param4 - UINT8 /////////
	param4 = superval[currentPos++];
	putValue(P_FSG_80_0_0_25_4, round((param4 * 1.0) - (0) + (0), 1.0));
	///////// Start param5 - UINT8 /////////
	param5 = superval[currentPos++];
	putValue(P_FSG_80_0_0_25_5, round((param5 * 1.0) - (0) + (0), 1.0));
}

// Updates the bus value field and other dependencies.
P_FSG_80_0_0_25_BuildFct()
{
	byte param1[151]; // CurrentTrainVersion
	word len1;
	byte cnt1;
	byte param2[31]; // CurrentMUVersion
	word len2;
	byte cnt2;
	byte param3[151]; // UpdateTrainVersion
	word len3;
	byte cnt3;
	byte param4; // Extension1
	byte param5; // Extension2

	int i;
	byte superval[335];
	int currentPos;
	currentPos = 0;
// gen_BuildFunc_SetSuperVals 
	getValue(P_FSG_80_0_0_25_1, param1);
	len1 = getValue(P_FSG_80_0_0_25_1_len);
	cnt1= getValue(P_FSG_80_0_0_25_1_cnt);
	
	/* check box aktiviert*/
	if (cnt1 == 1)
	{
		/* 0 bis 149 (MaxString - 1B oder 2B) */
		if(len1 >= 0 && len1 <= 149)
		{
			//writelineEx(gBAP_Trace, 0, "[Debug-1] Len1: %d", len1);
			superval[currentPos] = (len1&0x7f00) | 0x80;
			superval[currentPos+1] = len1 & 0x00ff;
		}
		else
		{
			writelineEx(gBAP_Trace, 0, "Eingegebene Laenge: %d von P_FSG_80_0_0_25_1 ist ungueltig. Die max. erlaubte Laenge ist %d.", len1, 149);
			return;
		}
	}
	else if(cnt1 == 0) /*check box deaktiviert*/
	{
		if(len1 >= 0 && len1 <= 127)
		{
			//writelineEx(gBAP_Trace, 0, "[Debug-1] Len1: %d", len1);
			superval[currentPos]= len1 & 0x00ff;
			putValue(P_FSG_80_0_0_25_1_len, len1);
		}
		else if(len1 > 127 && len1 <= 149)
		{
			superval[currentPos] = (len1&0x7f00) | 0x80;
			superval[currentPos+1] = len1 & 0x00ff;
			putValue(P_FSG_80_0_0_25_1_len, len1);
			putValue(P_FSG_80_0_0_25_1_cnt, 1);
		}
		else
		{
			writelineEx(gBAP_Trace, 0, "Eingegebene Laenge: %d von P_FSG_80_0_0_25_1 ist ungueltig. Die max. erlaubte Laenge ist %d.", len1, 149);
			return;
		}
	}
	currentPos += cnt1+1;
	for(i = 0; i < len1; i++)
	{
		superval[currentPos++]= param1[i];
	}

// gen_BuildFunc_SetSuperVals 
	getValue(P_FSG_80_0_0_25_2, param2);
	len2 = getValue(P_FSG_80_0_0_25_2_len);
	cnt2= getValue(P_FSG_80_0_0_25_2_cnt);
	
	/* check box aktiviert*/
	if (cnt2 == 1)
	{
		/* 0 bis 30 (MaxString - 1B oder 2B) */
		if(len2 >= 0 && len2 <= 30)
		{
			//writelineEx(gBAP_Trace, 0, "[Debug-1] Len2: %d", len2);
			superval[currentPos] = (len2&0x7f00) | 0x80;
			superval[currentPos+1] = len2 & 0x00ff;
		}
		else
		{
			writelineEx(gBAP_Trace, 0, "Eingegebene Laenge: %d von P_FSG_80_0_0_25_2 ist ungueltig. Die max. erlaubte Laenge ist %d.", len2, 30);
			return;
		}
	}
	else if(cnt2 == 0) /*check box deaktiviert*/
	{
		if(len2 >= 0 && len2 <= 127)
		{
			//writelineEx(gBAP_Trace, 0, "[Debug-1] Len2: %d", len2);
			superval[currentPos]= len2 & 0x00ff;
			putValue(P_FSG_80_0_0_25_2_len, len2);
		}
		else if(len2 > 127 && len2 <= 30)
		{
			superval[currentPos] = (len2&0x7f00) | 0x80;
			superval[currentPos+1] = len2 & 0x00ff;
			putValue(P_FSG_80_0_0_25_2_len, len2);
			putValue(P_FSG_80_0_0_25_2_cnt, 1);
		}
		else
		{
			writelineEx(gBAP_Trace, 0, "Eingegebene Laenge: %d von P_FSG_80_0_0_25_2 ist ungueltig. Die max. erlaubte Laenge ist %d.", len2, 30);
			return;
		}
	}
	currentPos += cnt2+1;
	for(i = 0; i < len2; i++)
	{
		superval[currentPos++]= param2[i];
	}

// gen_BuildFunc_SetSuperVals 
	getValue(P_FSG_80_0_0_25_3, param3);
	len3 = getValue(P_FSG_80_0_0_25_3_len);
	cnt3= getValue(P_FSG_80_0_0_25_3_cnt);
	
	/* check box aktiviert*/
	if (cnt3 == 1)
	{
		/* 0 bis 149 (MaxString - 1B oder 2B) */
		if(len3 >= 0 && len3 <= 149)
		{
			//writelineEx(gBAP_Trace, 0, "[Debug-1] Len3: %d", len3);
			superval[currentPos] = (len3&0x7f00) | 0x80;
			superval[currentPos+1] = len3 & 0x00ff;
		}
		else
		{
			writelineEx(gBAP_Trace, 0, "Eingegebene Laenge: %d von P_FSG_80_0_0_25_3 ist ungueltig. Die max. erlaubte Laenge ist %d.", len3, 149);
			return;
		}
	}
	else if(cnt3 == 0) /*check box deaktiviert*/
	{
		if(len3 >= 0 && len3 <= 127)
		{
			//writelineEx(gBAP_Trace, 0, "[Debug-1] Len3: %d", len3);
			superval[currentPos]= len3 & 0x00ff;
			putValue(P_FSG_80_0_0_25_3_len, len3);
		}
		else if(len3 > 127 && len3 <= 149)
		{
			superval[currentPos] = (len3&0x7f00) | 0x80;
			superval[currentPos+1] = len3 & 0x00ff;
			putValue(P_FSG_80_0_0_25_3_len, len3);
			putValue(P_FSG_80_0_0_25_3_cnt, 1);
		}
		else
		{
			writelineEx(gBAP_Trace, 0, "Eingegebene Laenge: %d von P_FSG_80_0_0_25_3 ist ungueltig. Die max. erlaubte Laenge ist %d.", len3, 149);
			return;
		}
	}
	currentPos += cnt3+1;
	for(i = 0; i < len3; i++)
	{
		superval[currentPos++]= param3[i];
	}

// gen_BuildFunc_SetSuperVals 
	@P_FSG_80_0_0_25_4_range = round(@P_FSG_80_0_0_25_4 + (0), 1.0); // slider value + min = real value
	param4 = 0; // underlying parameter has constant value 0.
	superval[currentPos++]=param4;
// gen_BuildFunc_SetSuperVals 
	@P_FSG_80_0_0_25_5_range = round(@P_FSG_80_0_0_25_5 + (0), 1.0); // slider value + min = real value
	param5 = 0; // underlying parameter has constant value 0.
	superval[currentPos++]=param5;
	putValue(P_FSG_80_0_0_25, superval, currentPos);
}


// Ueberwachung der CheckBox fuer String
on envVar  P_FSG_80_0_0_25_1_cnt
{
	word len;
	byte cnt;
	len = getValue(P_FSG_80_0_0_25_1_len);
	cnt = getValue(P_FSG_80_0_0_25_1_cnt);

	/* wird nur gerufen, wenn check box deaktiviert mit Length>127*/ 
	if( cnt == 0) 
	{
		if(len > 127 )
		{
			putValue(P_FSG_80_0_0_25_1_len, 127);
		}
	}

	P_FSG_80_0_0_25_BuildFct();
}



// Ueberwachung der Eingabefeld fuer String Data
on envVar P_FSG_80_0_0_25_1_len
{
	word len;
	len = getValue(this);
	/* Validierung der Eingabe*/
	if(len > 149)
	{
		writelineEx(gBAP_Trace, 0, "Eingegebene Laenge: %d von P_FSG_80_0_0_25_1 ist ungueltig. Die max. erlaubte Laenge ist %d. ", len, 149);
		putValue(this, 149);
	}
	P_FSG_80_0_0_25_BuildFct();
}


on envVar P_FSG_80_0_0_25_1 // VersionInfo.CurrentTrainVersion
{
	putValue(P_FSG_80_0_0_25_1_len, getValueSize(this));
	P_FSG_80_0_0_25_BuildFct();
}


// Ueberwachung der CheckBox fuer String
on envVar  P_FSG_80_0_0_25_2_cnt
{
	word len;
	byte cnt;
	len = getValue(P_FSG_80_0_0_25_2_len);
	cnt = getValue(P_FSG_80_0_0_25_2_cnt);

	/* wird nur gerufen, wenn check box deaktiviert mit Length>127*/ 
	if( cnt == 0) 
	{
		if(len > 127 )
		{
			putValue(P_FSG_80_0_0_25_2_len, 127);
		}
	}

	P_FSG_80_0_0_25_BuildFct();
}



// Ueberwachung der Eingabefeld fuer String Data
on envVar P_FSG_80_0_0_25_2_len
{
	word len;
	len = getValue(this);
	/* Validierung der Eingabe*/
	if(len > 30)
	{
		writelineEx(gBAP_Trace, 0, "Eingegebene Laenge: %d von P_FSG_80_0_0_25_2 ist ungueltig. Die max. erlaubte Laenge ist %d. ", len, 30);
		putValue(this, 30);
	}
	P_FSG_80_0_0_25_BuildFct();
}


on envVar P_FSG_80_0_0_25_2 // VersionInfo.CurrentMUVersion
{
	putValue(P_FSG_80_0_0_25_2_len, getValueSize(this));
	P_FSG_80_0_0_25_BuildFct();
}


// Ueberwachung der CheckBox fuer String
on envVar  P_FSG_80_0_0_25_3_cnt
{
	word len;
	byte cnt;
	len = getValue(P_FSG_80_0_0_25_3_len);
	cnt = getValue(P_FSG_80_0_0_25_3_cnt);

	/* wird nur gerufen, wenn check box deaktiviert mit Length>127*/ 
	if( cnt == 0) 
	{
		if(len > 127 )
		{
			putValue(P_FSG_80_0_0_25_3_len, 127);
		}
	}

	P_FSG_80_0_0_25_BuildFct();
}



// Ueberwachung der Eingabefeld fuer String Data
on envVar P_FSG_80_0_0_25_3_len
{
	word len;
	len = getValue(this);
	/* Validierung der Eingabe*/
	if(len > 149)
	{
		writelineEx(gBAP_Trace, 0, "Eingegebene Laenge: %d von P_FSG_80_0_0_25_3 ist ungueltig. Die max. erlaubte Laenge ist %d. ", len, 149);
		putValue(this, 149);
	}
	P_FSG_80_0_0_25_BuildFct();
}


on envVar P_FSG_80_0_0_25_3 // VersionInfo.UpdateTrainVersion
{
	putValue(P_FSG_80_0_0_25_3_len, getValueSize(this));
	P_FSG_80_0_0_25_BuildFct();
}

// Ueberwachung der Darstellungsvariable der Range.
on envVar P_FSG_80_0_0_25_4_range // VersionInfo.Extension1 
{
	@P_FSG_80_0_0_25_4 = @P_FSG_80_0_0_25_4_range - (0); // slider = range - min
}

on envVar P_FSG_80_0_0_25_4 // VersionInfo.Extension1
{
	P_FSG_80_0_0_25_BuildFct();
}

// Ueberwachung der Darstellungsvariable der Range.
on envVar P_FSG_80_0_0_25_5_range // VersionInfo.Extension2 
{
	@P_FSG_80_0_0_25_5 = @P_FSG_80_0_0_25_5_range - (0); // slider = range - min
}

on envVar P_FSG_80_0_0_25_5 // VersionInfo.Extension2
{
	P_FSG_80_0_0_25_BuildFct();
}

// Ruecksetzen des Fehlerstatus durch manuelle Fehlereingabe
on envVar P_FSG_80_0_0_26_ErrCode
{
       if(gP_FSG_80_0_0_26_ErrCode) 
       {
           setControlBackColor(panel_name,"errfield_P_FSG_80_0_0_26", MakeRGB(255,255,255));
       }
       gP_FSG_80_0_0_26_ErrCode = 1;
}
on envVar P_FSG_80_0_0_26Status_BTN
{
	byte BAPTemp[366];
    if (P_FSG_80_0_0_26Status_BTN_already_pressed == 0)
    {
        putValue(P_FSG_80_0_0_26_ErrCode,0);
        SetControlBackColor(panel_name,"errField_P_FSG_80_0_0_26",MakeRGB(255,255,255));
        P_FSG_80_0_0_26Status_BTN_already_pressed = 1;
    }
    else
    {
		P_FSG_80_0_0_26_BuildFct();
        getValue(P_FSG_80_0_0_26, BAPTemp);
        Request_ByteSequence(LSGID, P_FSG_80_0_0_26_ID, Data_REQ, BAPTemp, getValueSize(P_FSG_80_0_0_26));
        if(getValue(P_FSG_80_0_0_26_IntTlgEn)) //getValue(IT))
        {
           intertelegram_err(P_FSG_80_0_0_26_ID);
        }
        if(getValue(P_FSG_80_0_0_26_SegmEn))   //getvalue(SG)
        {
           sequence_err(P_FSG_80_0_0_26_ID,elCount(BAPTemp));
        }
       P_FSG_80_0_0_26Status_BTN_already_pressed = 0;
    }
}
on envVar P_FSG_80_0_0_26_FctEn
{
    long data[3];
    data[0]=LSGID;
    data[1]=P_FSG_80_0_0_26_ID;
    data[2]=getValue(P_FSG_80_0_0_26_FctEn);
    ChangeConfig(0x0031,data);
}
// De-Aktivierung der Eingabefelder der FCTID P_FSG_80_0_0_26
on envVar P_FSG_80_0_0_26_FctLstItemEn
{
       if(getValue(this)) 
       {
           EnableControl(panel_name,"panel_FSG_80_0_0_26",1);
           EnableControl(panel_name,"errfield_P_FSG_80_0_0_26",1);
           EnableControl(panel_name,"panel_P_FSG_80_0_0_26",1);
           setControlForeColor(panel_name, "checkbox_P_FSG_80_0_0_26", MakeRGB(0,240,0));
       }
       else
       {
           EnableControl(panel_name,"panel_FSG_80_0_0_26",0);
           EnableControl(panel_name,"errfield_P_FSG_80_0_0_26",0);
           EnableControl(panel_name,"panel_P_FSG_80_0_0_26",0);
           setControlForeColor(panel_name, "checkbox_P_FSG_80_0_0_26", MakeRGB(250,0,0));
       }
}
// Man darf gleichzeitig nur Checkbox fuer SegmError oder IntertelegramError aktiviert werden
on envVar P_FSG_80_0_0_26_IntTlgEn
{
       if(getValue(this)) 
       {
           putValue(P_FSG_80_0_0_26_SegmEn,0);
           intertelegram_err(P_FSG_80_0_0_26_ID);
       }
       else
       {
           intertelegram_err_off(P_FSG_80_0_0_26_ID);
       }
}
// Man darf gleichzeitig nur Checkbox fuer SegmError oder IntertelegramError aktiviert werden
on envVar P_FSG_80_0_0_26_SegmEn
{
       if(getValue(this)) 
       {
           putValue(P_FSG_80_0_0_26_IntTlgEn,0);
           sequence_err(P_FSG_80_0_0_26_ID,getValueSize(P_FSG_80_0_0_26_SegmEn));
       }
       else
       {
              sequence_err_off(P_FSG_80_0_0_26_ID);
       }
}
on envVar P_FSG_80_0_0_26 // bus value of UpdateState (26).
{
	// opcodes: Error-Status
	byte param1; // AliveMessage
	byte param2; // DownloadState
	byte param3; // AvailableCommandTypes
	byte param4[362]; // ExceptionText
	word len4;
	byte cnt4;
	byte param5; // Extension2
	byte param6; // Extension3
	// DATATYPE_BYTESEQUENCE / DATATYPE_FIXEDBYTESEQUENCE
	int i;
	byte superval[366];
	int currentPos;
	currentPos = 0;
	for( i = 0; i < 366; i++ ) {
		superval[i] = 0;
	}
	getValue(P_FSG_80_0_0_26, superval);
	///////// Start param1 - NIBBLE /////////
	param1 = (superval[currentPos] & 0xf0)>>4;
	putValue(P_FSG_80_0_0_26_1, param1);
	///////// Start param2 - NIBBLE /////////
	param2 = superval[currentPos++] & 0x0f;
	putValue(P_FSG_80_0_0_26_2, param2);
	///////// Start param3 - UINT8 /////////
	param3 = superval[currentPos++];
	putValue(P_FSG_80_0_0_26_3, param3);
	///////// Start param4 - STRING /////////
	getValue(P_FSG_80_0_0_26_4, param4);
	if((superval[currentPos] & 0x80) > 0)
	{
		if(360>127) /* Max Fct-Katalog Laenge: 360*/
		{
			len4 = ( (superval[currentPos]&0x7F) <<8) + superval[currentPos+1];
			currentPos = currentPos + 2;
			cnt4 = 1;
		}
		else
		{
			len4 = 360;
			writelineEx(gBAP_Trace, 0, "Anzahl der Laengeninformation-Bytes in P_FSG_80_0_0_26 ueberschreitet die erlaubte 1 Byte vom Fct-Kalatog.");
		}
	}
	else
	{
		len4 = superval[currentPos]&0x7F;
		currentPos = currentPos + 1;
		cnt4 = 0;
	}
	
	if(len4 > 360)
	{
		writelineEx(gBAP_Trace, 0, "Laenge:%d bei der Byte Position:%d ueberschreitet die Maximale erlaubte Laenge von Fct-Kalatog", len4, currentPos);
		len4 = 360;
	
		if(len4 < 128) cnt4 = 0;
		else cnt4 = 1;
	}
	
	for(i = 0; i < len4; i++)
	{
		param4[i] = superval[currentPos++];
	}
	
	putValue(P_FSG_80_0_0_26_4_len, len4);
	putValue(P_FSG_80_0_0_26_4_cnt, cnt4);
	
	if(len4 > getValueSize(P_FSG_80_0_0_26_4))
		putValue(P_FSG_80_0_0_26_4, param4, len4);
	else
		putValue(P_FSG_80_0_0_26_4, param4, getValueSize(P_FSG_80_0_0_26_4));

	///////// Start param5 - UINT8 /////////
	param5 = superval[currentPos++];
	putValue(P_FSG_80_0_0_26_5, round((param5 * 1.0) - (0) + (0), 1.0));
	///////// Start param6 - UINT8 /////////
	param6 = superval[currentPos++];
	putValue(P_FSG_80_0_0_26_6, round((param6 * 1.0) - (0) + (0), 1.0));
}
// Updates the bus value field and other dependencies.
P_FSG_80_0_0_26_BuildFct()
{
	byte param1; // AliveMessage
	byte param2; // DownloadState
	byte param3; // AvailableCommandTypes
	byte param4[362]; // ExceptionText
	word len4;
	byte cnt4;
	byte param5; // Extension2
	byte param6; // Extension3

	int i;
	byte superval[366];
	int currentPos;
	currentPos = 0;
// gen_BuildFunc_SetSuperVals 
	param1 = getValue(P_FSG_80_0_0_26_1);
	param1=param1& 0x0f;
	@P_FSG_80_0_0_26_1_0 = (param1 & 1) > 0;
	param1 = param1 & 0x0f;
	superval[currentPos]= superval[currentPos]&0x0f;
	superval[currentPos]= superval[currentPos]|(param1<<4);
// gen_BuildFunc_SetSuperVals 
	param2 = getValue(P_FSG_80_0_0_26_2);
	param2 = param2 & 0x0f;
	superval[currentPos]= superval[currentPos]&0xf0;
	superval[currentPos]= superval[currentPos]|param2;
	currentPos++;
// gen_BuildFunc_SetSuperVals 
	param3 = getValue(P_FSG_80_0_0_26_3);
	@P_FSG_80_0_0_26_3_0 = (param3 & 1) > 0;
	@P_FSG_80_0_0_26_3_1 = (param3 & 2) > 0;
	@P_FSG_80_0_0_26_3_2 = (param3 & 4) > 0;
	@P_FSG_80_0_0_26_3_3 = (param3 & 8) > 0;
	superval[currentPos++]=param3;
// gen_BuildFunc_SetSuperVals 
	getValue(P_FSG_80_0_0_26_4, param4);
	len4 = getValue(P_FSG_80_0_0_26_4_len);
	cnt4= getValue(P_FSG_80_0_0_26_4_cnt);
	
	/* check box aktiviert*/
	if (cnt4 == 1)
	{
		/* 0 bis 360 (MaxString - 1B oder 2B) */
		if(len4 >= 0 && len4 <= 360)
		{
			//writelineEx(gBAP_Trace, 0, "[Debug-1] Len4: %d", len4);
			superval[currentPos] = (len4&0x7f00) | 0x80;
			superval[currentPos+1] = len4 & 0x00ff;
		}
		else
		{
			writelineEx(gBAP_Trace, 0, "Eingegebene Laenge: %d von P_FSG_80_0_0_26_4 ist ungueltig. Die max. erlaubte Laenge ist %d.", len4, 360);
			return;
		}
	}
	else if(cnt4 == 0) /*check box deaktiviert*/
	{
		if(len4 >= 0 && len4 <= 127)
		{
			//writelineEx(gBAP_Trace, 0, "[Debug-1] Len4: %d", len4);
			superval[currentPos]= len4 & 0x00ff;
			putValue(P_FSG_80_0_0_26_4_len, len4);
		}
		else if(len4 > 127 && len4 <= 360)
		{
			superval[currentPos] = (len4&0x7f00) | 0x80;
			superval[currentPos+1] = len4 & 0x00ff;
			putValue(P_FSG_80_0_0_26_4_len, len4);
			putValue(P_FSG_80_0_0_26_4_cnt, 1);
		}
		else
		{
			writelineEx(gBAP_Trace, 0, "Eingegebene Laenge: %d von P_FSG_80_0_0_26_4 ist ungueltig. Die max. erlaubte Laenge ist %d.", len4, 360);
			return;
		}
	}
	currentPos += cnt4+1;
	for(i = 0; i < len4; i++)
	{
		superval[currentPos++]= param4[i];
	}

// gen_BuildFunc_SetSuperVals 
	@P_FSG_80_0_0_26_5_range = round(@P_FSG_80_0_0_26_5 + (0), 1.0); // slider value + min = real value
	param5 = 0; // underlying parameter has constant value 0.
	superval[currentPos++]=param5;
// gen_BuildFunc_SetSuperVals 
	@P_FSG_80_0_0_26_6_range = round(@P_FSG_80_0_0_26_6 + (0), 1.0); // slider value + min = real value
	param6 = 0; // underlying parameter has constant value 0.
	superval[currentPos++]=param6;
	putValue(P_FSG_80_0_0_26, superval, currentPos);
}


on envVar P_FSG_80_0_0_26_1_0
{
	byte bitval;
	//thisval steht hier fuer den bitfield-wert, 
	//aus Generierungsgruenden hier keine einheitliche Bezeichnung moeglich.
	byte thisval; // AliveMessage
	bitval= getValue(this);
	thisval = getValue(P_FSG_80_0_0_26_1);
	thisval = thisval&~(1<<0)|(bitval<<0);
	putValue(P_FSG_80_0_0_26_1,thisval);
}

on envVar P_FSG_80_0_0_26_1 // UpdateState.AliveMessage
{
	P_FSG_80_0_0_26_BuildFct();
}

on envVar P_FSG_80_0_0_26_2 // UpdateState.DownloadState
{
	P_FSG_80_0_0_26_BuildFct();
}

on envVar P_FSG_80_0_0_26_3_0
{
	byte bitval;
	//thisval steht hier fuer den bitfield-wert, 
	//aus Generierungsgruenden hier keine einheitliche Bezeichnung moeglich.
	byte thisval; // AvailableCommandTypes
	bitval= getValue(this);
	thisval = getValue(P_FSG_80_0_0_26_3);
	thisval = thisval&~(1<<0)|(bitval<<0);
	putValue(P_FSG_80_0_0_26_3,thisval);
}

on envVar P_FSG_80_0_0_26_3_1
{
	byte bitval;
	//thisval steht hier fuer den bitfield-wert, 
	//aus Generierungsgruenden hier keine einheitliche Bezeichnung moeglich.
	byte thisval; // AvailableCommandTypes
	bitval= getValue(this);
	thisval = getValue(P_FSG_80_0_0_26_3);
	thisval = thisval&~(1<<1)|(bitval<<1);
	putValue(P_FSG_80_0_0_26_3,thisval);
}

on envVar P_FSG_80_0_0_26_3_2
{
	byte bitval;
	//thisval steht hier fuer den bitfield-wert, 
	//aus Generierungsgruenden hier keine einheitliche Bezeichnung moeglich.
	byte thisval; // AvailableCommandTypes
	bitval= getValue(this);
	thisval = getValue(P_FSG_80_0_0_26_3);
	thisval = thisval&~(1<<2)|(bitval<<2);
	putValue(P_FSG_80_0_0_26_3,thisval);
}

on envVar P_FSG_80_0_0_26_3_3
{
	byte bitval;
	//thisval steht hier fuer den bitfield-wert, 
	//aus Generierungsgruenden hier keine einheitliche Bezeichnung moeglich.
	byte thisval; // AvailableCommandTypes
	bitval= getValue(this);
	thisval = getValue(P_FSG_80_0_0_26_3);
	thisval = thisval&~(1<<3)|(bitval<<3);
	putValue(P_FSG_80_0_0_26_3,thisval);
}

on envVar P_FSG_80_0_0_26_3 // UpdateState.AvailableCommandTypes
{
	P_FSG_80_0_0_26_BuildFct();
}


// Ueberwachung der CheckBox fuer String
on envVar  P_FSG_80_0_0_26_4_cnt
{
	word len;
	byte cnt;
	len = getValue(P_FSG_80_0_0_26_4_len);
	cnt = getValue(P_FSG_80_0_0_26_4_cnt);

	/* wird nur gerufen, wenn check box deaktiviert mit Length>127*/ 
	if( cnt == 0) 
	{
		if(len > 127 )
		{
			putValue(P_FSG_80_0_0_26_4_len, 127);
		}
	}

	P_FSG_80_0_0_26_BuildFct();
}



// Ueberwachung der Eingabefeld fuer String Data
on envVar P_FSG_80_0_0_26_4_len
{
	word len;
	len = getValue(this);
	/* Validierung der Eingabe*/
	if(len > 360)
	{
		writelineEx(gBAP_Trace, 0, "Eingegebene Laenge: %d von P_FSG_80_0_0_26_4 ist ungueltig. Die max. erlaubte Laenge ist %d. ", len, 360);
		putValue(this, 360);
	}
	P_FSG_80_0_0_26_BuildFct();
}


on envVar P_FSG_80_0_0_26_4 // UpdateState.ExceptionText
{
	putValue(P_FSG_80_0_0_26_4_len, getValueSize(this));
	P_FSG_80_0_0_26_BuildFct();
}

// Ueberwachung der Darstellungsvariable der Range.
on envVar P_FSG_80_0_0_26_5_range // UpdateState.Extension2 
{
	@P_FSG_80_0_0_26_5 = @P_FSG_80_0_0_26_5_range - (0); // slider = range - min
}

on envVar P_FSG_80_0_0_26_5 // UpdateState.Extension2
{
	P_FSG_80_0_0_26_BuildFct();
}

// Ueberwachung der Darstellungsvariable der Range.
on envVar P_FSG_80_0_0_26_6_range // UpdateState.Extension3 
{
	@P_FSG_80_0_0_26_6 = @P_FSG_80_0_0_26_6_range - (0); // slider = range - min
}

on envVar P_FSG_80_0_0_26_6 // UpdateState.Extension3
{
	P_FSG_80_0_0_26_BuildFct();
}

// Ruecksetzen des Fehlerstatus durch manuelle Fehlereingabe
on envVar M_FSG_80_0_0_27_ErrCode
{
       if(gM_FSG_80_0_0_27_ErrCode) 
       {
           setControlBackColor(panel_name,"errfield_M_FSG_80_0_0_27", MakeRGB(255,255,255));
       }
       gM_FSG_80_0_0_27_ErrCode = 1;
}
on envVar M_FSG_80_0_0_27Result_BTN
{
    byte temp[2];
    if (M_FSG_80_0_0_27Result_BTN_already_pressed == 0)
    {
        putValue(M_FSG_80_0_0_27_ErrCode,0);
        SetControlBackColor(panel_name,"errField_M_FSG_80_0_0_27",MakeRGB(255,255,255));
        M_FSG_80_0_0_27Result_BTN_already_pressed = 1;
    }
    else
    {
        putValue(M_FSG_80_0_0_27_State, "Result");
        getValue(M_FSG_80_0_0_27_Result, temp);
        Request_ByteSequence(LSGID, M_FSG_80_0_0_27_ID, Result_REQ, temp, getValueSize(M_FSG_80_0_0_27_Result));
        M_FSG_80_0_0_27Result_BTN_already_pressed = 0;
    }
}
on envVar M_FSG_80_0_0_27_FctEn
{
    long data[3];
    data[0]=LSGID;
    data[1]=M_FSG_80_0_0_27_ID;
    data[2]=getValue(M_FSG_80_0_0_27_FctEn);
    ChangeConfig(0x0031,data);
}
// De-Aktivierung der Eingabefelder der FCTID M_FSG_80_0_0_27
on envVar M_FSG_80_0_0_27_FctLstItemEn
{
       if(getValue(this)) 
       {
           EnableControl(panel_name,"panel_FSG_80_0_0_27",1);
           EnableControl(panel_name,"errfield_M_FSG_80_0_0_27",1);
           EnableControl(panel_name,"panel_M_FSG_80_0_0_27",1);
           EnableControl(panel_name,"panel_M_FSG_80_0_0_27_Processing",1);
           EnableControl(panel_name,"panel_M_FSG_80_0_0_27_Start",1);
           setControlForeColor(panel_name, "checkbox_M_FSG_80_0_0_27", MakeRGB(0,240,0));
       }
       else
       {
           EnableControl(panel_name,"panel_FSG_80_0_0_27",0);
           EnableControl(panel_name,"errfield_M_FSG_80_0_0_27",0);
           EnableControl(panel_name,"panel_M_FSG_80_0_0_27",0);
           EnableControl(panel_name,"panel_M_FSG_80_0_0_27_Processing",0);
           EnableControl(panel_name,"panel_M_FSG_80_0_0_27_Start",0);
           setControlForeColor(panel_name, "checkbox_M_FSG_80_0_0_27", MakeRGB(250,0,0));
       }
}
on envVar M_FSG_80_0_0_27_Result // bus value of UpdateCommands (27).
{
	// opcodes: Error-Processing-Result
	byte param1; // ASG_ID
	byte param2; // CommandType
	byte param3; // UpdateCommands_Result
	// DATATYPE_BYTESEQUENCE / DATATYPE_FIXEDBYTESEQUENCE
	int i;
	byte superval[2];
	int currentPos;
	currentPos = 0;
	for( i = 0; i < 2; i++ ) {
		superval[i] = 0;
	}
	getValue(M_FSG_80_0_0_27_Result, superval);
	///////// Start param1 - NIBBLE /////////
	param1 = (superval[currentPos] & 0xf0)>>4;
	putValue(M_FSG_80_0_0_27_Result_1, param1);
	///////// Start param2 - NIBBLE /////////
	param2 = superval[currentPos++] & 0x0f;
	putValue(M_FSG_80_0_0_27_Result_2, param2);
	///////// Start param3 - UINT8 /////////
	param3 = superval[currentPos++];
	putValue(M_FSG_80_0_0_27_Result_3, param3);
}

on envVar M_FSG_80_0_0_27_Result_1 // UpdateCommands.ASG_ID
{
	byte superval[2];

	//Update Childvalue (Enum)
	byte thisval; // ASG_ID
	thisval = 0x0f & getValue(this);

    // Update superval
	getValue(M_FSG_80_0_0_27_Result, superval);
	superval[0]= superval[0]&0x0f;
	superval[0]= superval[0]|(thisval<<4);
	putValue(M_FSG_80_0_0_27_Result,superval);
}

on envVar M_FSG_80_0_0_27_Result_2 // UpdateCommands.CommandType
{
	byte superval[2];

	//Update Childvalue (Enum)
	byte thisval; // CommandType
	thisval = 0x0f & getValue(this);

    // Update superval
	getValue(M_FSG_80_0_0_27_Result, superval);
	superval[0]= superval[0]&0xf0;
	superval[0]= superval[0]|thisval;
	putValue(M_FSG_80_0_0_27_Result,superval);
}

on envVar M_FSG_80_0_0_27_Result_3 // UpdateCommands.UpdateCommands_Result
{
	byte superval[2];

	//Update Childvalue (Enum)
	byte thisval; // UpdateCommands_Result
	thisval = getValue(this);

    // Update superval
	getValue(M_FSG_80_0_0_27_Result, superval);
	superval[1]=thisval;
	putValue(M_FSG_80_0_0_27_Result,superval);
}

on envVar M_FSG_80_0_0_27_Processing // bus value of UpdateCommands (27).
{
	// opcodes: Error-Processing-Result
	byte param1; // ASG_ID
	byte param2; // CommandType
	byte param3; // Reserve
	// DATATYPE_BYTESEQUENCE / DATATYPE_FIXEDBYTESEQUENCE
	int i;
	byte superval[2];
	int currentPos;
	currentPos = 0;
	for( i = 0; i < 2; i++ ) {
		superval[i] = 0;
	}
	getValue(M_FSG_80_0_0_27_Processing, superval);
	///////// Start param1 - NIBBLE /////////
	param1 = (superval[currentPos] & 0xf0)>>4;
	putValue(M_FSG_80_0_0_27_Processing_1, param1);
	///////// Start param2 - NIBBLE /////////
	param2 = superval[currentPos++] & 0x0f;
	putValue(M_FSG_80_0_0_27_Processing_2, param2);
	///////// Start param3 - UINT8 /////////
	param3 = superval[currentPos++];
	putValue(M_FSG_80_0_0_27_Processing_3, round((param3 * 1.0) - (0) + (0), 1.0));
}

on envVar M_FSG_80_0_0_27_Processing_1 // UpdateCommands.ASG_ID
{
	byte superval[2];

	//Update Childvalue (Enum)
	byte thisval; // ASG_ID
	thisval = 0x0f & getValue(this);

    // Update superval
	getValue(M_FSG_80_0_0_27_Processing, superval);
	superval[0]= superval[0]&0x0f;
	superval[0]= superval[0]|(thisval<<4);
	putValue(M_FSG_80_0_0_27_Processing,superval);
}

on envVar M_FSG_80_0_0_27_Processing_2 // UpdateCommands.CommandType
{
	byte superval[2];

	//Update Childvalue (Enum)
	byte thisval; // CommandType
	thisval = 0x0f & getValue(this);

    // Update superval
	getValue(M_FSG_80_0_0_27_Processing, superval);
	superval[0]= superval[0]&0xf0;
	superval[0]= superval[0]|thisval;
	putValue(M_FSG_80_0_0_27_Processing,superval);
}

// Ueberwachung der Darstellungsvariable der Range.
on envVar M_FSG_80_0_0_27_Processing_3_range // UpdateCommands.Reserve 
{
	@M_FSG_80_0_0_27_Processing_3 = @M_FSG_80_0_0_27_Processing_3_range - (0); // slider = range - min
}

on envVar M_FSG_80_0_0_27_Processing_3 // UpdateCommands.Reserve
{
	byte superval[2];

	//Update Childvalue (Number)
	byte thisval; // Reserve
	float slider_value;

	slider_value = 0; // Konstanter Parameter.
	@M_FSG_80_0_0_27_Processing_3_range = slider_value + (0); // real value := slider value + range min.
	thisval = (byte)round((slider_value + (0) - (0)) / (1.0), 1); // bus value := (slider value + min - offset) / step.

    // Update superval
	getValue(M_FSG_80_0_0_27_Processing, superval);
	superval[1]=thisval;
	putValue(M_FSG_80_0_0_27_Processing,superval);
}

on envVar M_FSG_80_0_0_27_Start // bus value of UpdateCommands (27).
{
	// opcodes: AbortResult-StartResult
	byte param1; // ASG_ID
	byte param2; // CommandType
	byte param3; // Extension1
	// DATATYPE_BYTESEQUENCE / DATATYPE_FIXEDBYTESEQUENCE
	int i;
	byte superval[2];
	int currentPos;
	currentPos = 0;
	for( i = 0; i < 2; i++ ) {
		superval[i] = 0;
	}
	getValue(M_FSG_80_0_0_27_Start, superval);
	///////// Start param1 - NIBBLE /////////
	param1 = (superval[currentPos] & 0xf0)>>4;
	putValue(M_FSG_80_0_0_27_Start_1, param1);
	///////// Start param2 - NIBBLE /////////
	param2 = superval[currentPos++] & 0x0f;
	putValue(M_FSG_80_0_0_27_Start_2, param2);
	///////// Start param3 - UINT8 /////////
	param3 = superval[currentPos++];
	putValue(M_FSG_80_0_0_27_Start_3, round((param3 * 1.0) - (0) + (0), 1.0));
}

on envVar M_FSG_80_0_0_27_Start_1 // UpdateCommands.ASG_ID
{
	byte superval[2];

	//Update Childvalue (Enum)
	byte thisval; // ASG_ID
	thisval = 0x0f & getValue(this);

    // Update superval
	getValue(M_FSG_80_0_0_27_Start, superval);
	superval[0]= superval[0]&0x0f;
	superval[0]= superval[0]|(thisval<<4);
	putValue(M_FSG_80_0_0_27_Start,superval);
}

on envVar M_FSG_80_0_0_27_Start_2 // UpdateCommands.CommandType
{
	byte superval[2];

	//Update Childvalue (Enum)
	byte thisval; // CommandType
	thisval = 0x0f & getValue(this);

    // Update superval
	getValue(M_FSG_80_0_0_27_Start, superval);
	superval[0]= superval[0]&0xf0;
	superval[0]= superval[0]|thisval;
	putValue(M_FSG_80_0_0_27_Start,superval);
}

// Ueberwachung der Darstellungsvariable der Range.
on envVar M_FSG_80_0_0_27_Start_3_range // UpdateCommands.Extension1 
{
	@M_FSG_80_0_0_27_Start_3 = @M_FSG_80_0_0_27_Start_3_range - (0); // slider = range - min
}

on envVar M_FSG_80_0_0_27_Start_3 // UpdateCommands.Extension1
{
	byte superval[2];

	//Update Childvalue (Number)
	byte thisval; // Extension1
	float slider_value;

	slider_value = 0; // Konstanter Parameter.
	@M_FSG_80_0_0_27_Start_3_range = slider_value + (0); // real value := slider value + range min.
	thisval = (byte)round((slider_value + (0) - (0)) / (1.0), 1); // bus value := (slider value + min - offset) / step.

    // Update superval
	getValue(M_FSG_80_0_0_27_Start, superval);
	superval[1]=thisval;
	putValue(M_FSG_80_0_0_27_Start,superval);
}

// Ruecksetzen des Fehlerstatus durch manuelle Fehlereingabe
on envVar A_FSG_80_0_0_28_ErrCode
{
       if(gA_FSG_80_0_0_28_ErrCode) 
       {
           setControlBackColor(panel_name,"errfield_A_FSG_80_0_0_28", MakeRGB(255,255,255));
       }
       gA_FSG_80_0_0_28_ErrCode = 1;
}
on envVar A_FSG_80_0_0_28Changed_BTN
{
    byte data[4032]; 
    byte stringValue[4032];
    byte head[5];
    int i;
    int headLength;
    long tempValue;
    word currentPos;
    word startVal;
    word elementsVal;
  byte nibbleSetted;
    if (A_FSG_80_0_0_28Changed_BTN_already_pressed == 0)
    {
        putValue(A_FSG_80_0_0_28_ErrCode,0);
        SetControlBackColor(panel_name,"errField_A_FSG_80_0_0_28",MakeRGB(255,255,255));
        A_FSG_80_0_0_28Changed_BTN_already_pressed = 1;
    }
    else 
    {
        currentPos = 0;
        //Einzelparameter: Operation
        tempValue = getValue(A_FSG_80_0_0_28_1_Changed);
        //voriger Parameter war ein first nibble, bei 1 Byte Werten Position incr
        if(nibbleSetted == 1) currentPos++;
        nibbleSetted = 0;
        data[currentPos++] = tempValue;
        //Einzelparameter: Type
        tempValue = getValue(A_FSG_80_0_0_28_2_Changed);
        //voriger Parameter war ein first nibble, bei 1 Byte Werten Position incr
        if(nibbleSetted == 1) currentPos++;
        nibbleSetted = 0;
        data[currentPos++] = tempValue;
        //Einzelparameter: Slot
        tempValue = getValue(A_FSG_80_0_0_28_3_Changed);
        //voriger Parameter war ein first nibble, bei 1 Byte Werten Position incr
        if(nibbleSetted == 1) currentPos++;
        nibbleSetted = 0;
        data[currentPos++] = tempValue;
        //head Parameter
        headLength = getValueSize(A_FSG_80_0_0_28_Changed);
        getValue(A_FSG_80_0_0_28_Changed,head);
        for(i=0; i< headLength; i++)
        {
            data[currentPos++] = head[i];
        }

       Request_ByteSequence(LSGID, A_FSG_80_0_0_28_ID, Changed_REQ, data, currentPos);
       if(getValue(A_FSG_80_0_0_28_IntTlgEn)) //getValue(IT))
       {
           intertelegram_err(A_FSG_80_0_0_28_ID);
       }
       if(getValue(A_FSG_80_0_0_28_SegmEn))   //getvalue(SG)
       {
             sequence_err(A_FSG_80_0_0_28_ID,getValueSize(A_FSG_80_0_0_28_Changed));
       }
        A_FSG_80_0_0_28Changed_BTN_already_pressed = 0;
    }
}
on envVar A_FSG_80_0_0_28Status_BTN
{
    byte data[4032 + 5]; // array header (3 or 5 bytes), followed by payload.
    byte stringValue[4032];
    byte head[5];
    int i = 0;
    int j = 0;
    long StringLength = 0;
    int headLength;
    long tempValue;
    word currentPos;

    word startVal;
    word elementsVal;
    byte nibbleSetted;
    if (A_FSG_80_0_0_28Status_BTN_already_pressed == 0)
    {
        putValue(A_FSG_80_0_0_28_ErrCode,0);
        SetControlBackColor(panel_name,"errField_A_FSG_80_0_0_28",MakeRGB(255,255,255));
        A_FSG_80_0_0_28Status_BTN_already_pressed = 1;
    }
    else
    {
        currentPos = 0;
        //Einzelparameter: Operation
        tempValue = getValue(A_FSG_80_0_0_28_1);
        //voriger Parameter war ein first nibble, bei 1 Byte Werten Position incr
        if(nibbleSetted == 1) currentPos++;
        nibbleSetted = 0;
        data[currentPos++] = tempValue;
        //Einzelparameter: Type
        tempValue = getValue(A_FSG_80_0_0_28_2);
        //voriger Parameter war ein first nibble, bei 1 Byte Werten Position incr
        if(nibbleSetted == 1) currentPos++;
        nibbleSetted = 0;
        data[currentPos++] = tempValue;
        //Einzelparameter: Slot
        tempValue = getValue(A_FSG_80_0_0_28_3);
        //voriger Parameter war ein first nibble, bei 1 Byte Werten Position incr
        if(nibbleSetted == 1) currentPos++;
        nibbleSetted = 0;
        data[currentPos++] = tempValue;
        //Einzelparameter: State
        tempValue = getValue(A_FSG_80_0_0_28_4);
        //voriger Parameter war ein first nibble, bei 1 Byte Werten Position incr
        if(nibbleSetted == 1) currentPos++;
        nibbleSetted = 0;
        data[currentPos++] = tempValue;
        //Einzelparameter: ASG_ID
        tempValue = getValue(A_FSG_80_0_0_28_5);
    if(nibbleSetted == 1)
    {
        //voriger Parameter war ein Nibble, => second nibble, Pos incr und Flag zuruecksetzen
        data[currentPos] = (tempValue &0x0F) | (data[currentPos] &0xF0);
        currentPos++;
        nibbleSetted = 0;
    }
    else
    {
        //first nibble, kein increment, Flag setzen
        data[currentPos] = (tempValue<<4) &0xF0;
        nibbleSetted = 1;
    }
        //Einzelparameter: TAID
        tempValue = getValue(A_FSG_80_0_0_28_6);
    if(nibbleSetted == 1)
    {
        //voriger Parameter war ein Nibble, => second nibble, Pos incr und Flag zuruecksetzen
        data[currentPos] = (tempValue &0x0F) | (data[currentPos] &0xF0);
        currentPos++;
        nibbleSetted = 0;
    }
    else
    {
        //first nibble, kein increment, Flag setzen
        data[currentPos] = (tempValue<<4) &0xF0;
        nibbleSetted = 1;
    }
        //Einzelparameter: TotalNumListElements
        tempValue = getValue(A_FSG_80_0_0_28_7);
        //voriger Parameter war ein first nibble, bei 1 Byte Werten Position incr
        if(nibbleSetted == 1) currentPos++;
        nibbleSetted = 0;
        data[currentPos++] = (tempValue ) & 0xFF;
        data[currentPos++] = (tempValue >> 8) & 0xFF;
        //head Parameter
        headLength = getValueSize(A_FSG_80_0_0_28);
        getValue(A_FSG_80_0_0_28,head);
        for(i=0; i< headLength; i++)
        {
            data[currentPos++] = head[i];
        }
    //data Parameter
     startVal = getValue(A_FSG_80_0_0_28_Start);
     elementsVal = getValue(A_FSG_80_0_0_28_Elements);
     nibbleSetted = 0;
    if( (head[0]&0x20) == 0)
    {
     if( (head[0] & 0x10) > 0)
     {
        startVal++;
     }
     for( i = startVal ; i < startVal + elementsVal ; i++)
     {
       if( i < 0 || i >= A_FSG_80_0_0_28_ArrayDataList_Length )
       {
         write("Array index ausserhalb der Grenzen, Fct: 28");
         break;
       }
      if(nibbleSetted == 1) currentPos++;
      nibbleSetted = 0;
     if( (head[0]&0x40) == 0){ /* Transmit_Pos = 0, keine Positionsdaten */ }
     else
     {
        if( (head[0]&0x80) == 0)
        {
           //IndexSize = 0, Pos als 1 Byte Wert
           //Kein POS definiert
        }
        else
        {
           //IndexSize = 1, Pos als 2 Byte Wert
           //Kein POS definiert
        }
     }
      // Check if the current value of RecAdr enables the variable Parameter_ID:
      if( 0 || 1 == getValue( A_FSG_80_0_0_28_RecAdr ) || 2 == getValue( A_FSG_80_0_0_28_RecAdr ) || 3 == getValue( A_FSG_80_0_0_28_RecAdr ) )
      {
        //Sollte vor einem 4 Byte Wert 1 Nibble kommen, muss der index um 1 incrementiert werden!
        if( nibbleSetted==1) currentPos++;
        nibbleSetted = 0;
        data[currentPos++] = (A_FSG_80_0_0_28_ArrayDataList[i].Param1      ) & 0xFF;
        data[currentPos++] = (A_FSG_80_0_0_28_ArrayDataList[i].Param1 >>  8) & 0xFF;
        data[currentPos++] = (A_FSG_80_0_0_28_ArrayDataList[i].Param1 >> 16) & 0xFF;
        data[currentPos++] = (A_FSG_80_0_0_28_ArrayDataList[i].Param1 >> 24) & 0xFF;
       }
      // Check if the current value of RecAdr enables the variable DataDescription:
      if( 0 || 1 == getValue( A_FSG_80_0_0_28_RecAdr ) || 2 == getValue( A_FSG_80_0_0_28_RecAdr ) || 3 == getValue( A_FSG_80_0_0_28_RecAdr ) )
      {
        //Sollte vor einem 1 Byte Wert 1 Nibble kommen, muss der index um 1 incrementiert werden!
        if( nibbleSetted==1) currentPos++;
        nibbleSetted = 0;
        data[currentPos++] = (A_FSG_80_0_0_28_ArrayDataList[i].Param2 ) & 0xFF;
       }
      // Check if the current value of RecAdr enables the variable DataTag:
      if( 0 || 2 == getValue( A_FSG_80_0_0_28_RecAdr ) || 3 == getValue( A_FSG_80_0_0_28_RecAdr ) )
      {
        //Sollte vor einem 1 Byte Wert 1 Nibble kommen, muss der index um 1 incrementiert werden!
        if( nibbleSetted==1) currentPos++;
        nibbleSetted = 0;
        data[currentPos++] = (A_FSG_80_0_0_28_ArrayDataList[i].Param3 ) & 0xFF;
       }
      // Check if the current value of RecAdr enables the variable DataLength:
      if( 0 || 3 == getValue( A_FSG_80_0_0_28_RecAdr ) )
      {
        //Sollte vor einem 4 Byte Wert 1 Nibble kommen, muss der index um 1 incrementiert werden!
        if( nibbleSetted==1) currentPos++;
        nibbleSetted = 0;
        data[currentPos++] = (A_FSG_80_0_0_28_ArrayDataList[i].Param4      ) & 0xFF;
        data[currentPos++] = (A_FSG_80_0_0_28_ArrayDataList[i].Param4 >>  8) & 0xFF;
        data[currentPos++] = (A_FSG_80_0_0_28_ArrayDataList[i].Param4 >> 16) & 0xFF;
        data[currentPos++] = (A_FSG_80_0_0_28_ArrayDataList[i].Param4 >> 24) & 0xFF;
       }
      // Check if the current value of RecAdr enables the variable Data:
      if( 0 || 3 == getValue( A_FSG_80_0_0_28_RecAdr ) )
      {
        //Sollte vor einem String Wert 1 Nibble kommen, muss der index um 1 incrementiert werden!
        if( nibbleSetted==1) currentPos++;
        nibbleSetted = 0;
        StringLength =A_FSG_80_0_0_28_ArrayDataList[i].Param5_Length;
		/* Pruefung ob die Laenge-Checkbox aktiv ist */
		if (1 == A_FSG_80_0_0_28_Data_5_CntList[i] )
		{
			if(StringLength >= 0 && StringLength <= 32767 && StringLength <= 32767-2)
			{
				data[currentPos++] = ( (StringLength >> 8) & 0x7F ) | 0x80; //2Byte Flag (Bit 8) setzen + HighByte (erste 7 bit)
				data[currentPos++] = StringLength &0xFF;
			}
			else
			{
				writelineEx(gBAP_Trace, 0, "Eingegebene Laenge: %d von A_FSG_80_0_0_28_Data_5 mit Record Nr. %d ist ungueltig. Die max. erlaubte Laenge ist %d.", StringLength, i, 32767-2);
				return;
			}
		}
		else if(0 == A_FSG_80_0_0_28_Data_5_CntList[i] ) /*check box deaktiviert*/
		{
			if(StringLength >= 0 && StringLength <= 127 && StringLength <= 32767-1)
			{
				data[currentPos++] = StringLength & 0x7F; //Bit 8 = 0
			}
			else
			{
				writelineEx(gBAP_Trace, 0, "Eingegebene Laenge: %d von A_FSG_80_0_0_28_Data_5 mit Record Nr. %d ist ungueltig. Die max. erlaubte Laenge ist %d. ", StringLength, i, 32767-1);
				return;
			}
		}
        for(j=0; j < StringLength ; j++)
        {
            data[currentPos++] = A_FSG_80_0_0_28_ArrayDataList[i].Param5[j];
        }
       }
    //sollte der letzte Parameter ein first nibble gewesen sein, muss noch 1 increment durchgefuehrt werden
    if( nibbleSetted==1) currentPos++;
    nibbleSetted = 0;
     }
    }
    else
    {
     if( (head[0] & 0x10) > 0)
     {
        if(startVal != 0) startVal--;
        else
        {
           startVal = A_FSG_80_0_0_28_ArrayDataList_Length -1;
        }
     }
     for( i = startVal ; i > startVal - elementsVal ; i--)
     {
       if( i < 0 || i >= A_FSG_80_0_0_28_ArrayDataList_Length )
       {
         write("Array index ausserhalb der Grenzen, Fct: 28");
         break;
       }
      if(nibbleSetted == 1) currentPos++;
      nibbleSetted = 0;
     if( (head[0]&0x40) == 0){ /* Transmit_Pos = 0, keine Positionsdaten */ }
     else
     {
        if( (head[0]&0x80) == 0)
        {
           //IndexSize = 0, Pos als 1 Byte Wert
           //Kein POS definiert
        }
        else
        {
           //IndexSize = 1, Pos als 2 Byte Wert
           //Kein POS definiert
        }
     }
      // Check if the current value of RecAdr enables the variable Parameter_ID:
      if( 0 || 1 == getValue( A_FSG_80_0_0_28_RecAdr ) || 2 == getValue( A_FSG_80_0_0_28_RecAdr ) || 3 == getValue( A_FSG_80_0_0_28_RecAdr ) )
      {
        //Sollte vor einem 4 Byte Wert 1 Nibble kommen, muss der index um 1 incrementiert werden!
        if( nibbleSetted==1) currentPos++;
        nibbleSetted = 0;
        data[currentPos++] = (A_FSG_80_0_0_28_ArrayDataList[i].Param1      ) & 0xFF;
        data[currentPos++] = (A_FSG_80_0_0_28_ArrayDataList[i].Param1 >>  8) & 0xFF;
        data[currentPos++] = (A_FSG_80_0_0_28_ArrayDataList[i].Param1 >> 16) & 0xFF;
        data[currentPos++] = (A_FSG_80_0_0_28_ArrayDataList[i].Param1 >> 24) & 0xFF;
       }
      // Check if the current value of RecAdr enables the variable DataDescription:
      if( 0 || 1 == getValue( A_FSG_80_0_0_28_RecAdr ) || 2 == getValue( A_FSG_80_0_0_28_RecAdr ) || 3 == getValue( A_FSG_80_0_0_28_RecAdr ) )
      {
        //Sollte vor einem 1 Byte Wert 1 Nibble kommen, muss der index um 1 incrementiert werden!
        if( nibbleSetted==1) currentPos++;
        nibbleSetted = 0;
        data[currentPos++] = (A_FSG_80_0_0_28_ArrayDataList[i].Param2 ) & 0xFF;
       }
      // Check if the current value of RecAdr enables the variable DataTag:
      if( 0 || 2 == getValue( A_FSG_80_0_0_28_RecAdr ) || 3 == getValue( A_FSG_80_0_0_28_RecAdr ) )
      {
        //Sollte vor einem 1 Byte Wert 1 Nibble kommen, muss der index um 1 incrementiert werden!
        if( nibbleSetted==1) currentPos++;
        nibbleSetted = 0;
        data[currentPos++] = (A_FSG_80_0_0_28_ArrayDataList[i].Param3 ) & 0xFF;
       }
      // Check if the current value of RecAdr enables the variable DataLength:
      if( 0 || 3 == getValue( A_FSG_80_0_0_28_RecAdr ) )
      {
        //Sollte vor einem 4 Byte Wert 1 Nibble kommen, muss der index um 1 incrementiert werden!
        if( nibbleSetted==1) currentPos++;
        nibbleSetted = 0;
        data[currentPos++] = (A_FSG_80_0_0_28_ArrayDataList[i].Param4      ) & 0xFF;
        data[currentPos++] = (A_FSG_80_0_0_28_ArrayDataList[i].Param4 >>  8) & 0xFF;
        data[currentPos++] = (A_FSG_80_0_0_28_ArrayDataList[i].Param4 >> 16) & 0xFF;
        data[currentPos++] = (A_FSG_80_0_0_28_ArrayDataList[i].Param4 >> 24) & 0xFF;
       }
      // Check if the current value of RecAdr enables the variable Data:
      if( 0 || 3 == getValue( A_FSG_80_0_0_28_RecAdr ) )
      {
        //Sollte vor einem String Wert 1 Nibble kommen, muss der index um 1 incrementiert werden!
        if( nibbleSetted==1) currentPos++;
        nibbleSetted = 0;
        StringLength =A_FSG_80_0_0_28_ArrayDataList[i].Param5_Length;
		/* Pruefung ob die Laenge-Checkbox aktiv ist */
		if (1 == A_FSG_80_0_0_28_Data_5_CntList[i] )
		{
			if(StringLength >= 0 && StringLength <= 32767 && StringLength <= 32767-2)
			{
				data[currentPos++] = ( (StringLength >> 8) & 0x7F ) | 0x80; //2Byte Flag (Bit 8) setzen + HighByte (erste 7 bit)
				data[currentPos++] = StringLength &0xFF;
			}
			else
			{
				writelineEx(gBAP_Trace, 0, "Eingegebene Laenge: %d von A_FSG_80_0_0_28_Data_5 mit Record Nr. %d ist ungueltig. Die max. erlaubte Laenge ist %d.", StringLength, i, 32767-2);
				return;
			}
		}
		else if(0 == A_FSG_80_0_0_28_Data_5_CntList[i] ) /*check box deaktiviert*/
		{
			if(StringLength >= 0 && StringLength <= 127 && StringLength <= 32767-1)
			{
				data[currentPos++] = StringLength & 0x7F; //Bit 8 = 0
			}
			else
			{
				writelineEx(gBAP_Trace, 0, "Eingegebene Laenge: %d von A_FSG_80_0_0_28_Data_5 mit Record Nr. %d ist ungueltig. Die max. erlaubte Laenge ist %d. ", StringLength, i, 32767-1);
				return;
			}
		}
        for(j=0; j < StringLength ; j++)
        {
            data[currentPos++] = A_FSG_80_0_0_28_ArrayDataList[i].Param5[j];
        }
       }
    //sollte der letzte Parameter ein first nibble gewesen sein, muss noch 1 increment durchgefuehrt werden
    if( nibbleSetted==1) currentPos++;
    nibbleSetted = 0;
     }
    }

        //getValue(A_FSG_80_0_0_28, data);
        Request_ByteSequence(LSGID, A_FSG_80_0_0_28_ID, Data_REQ, data,currentPos);
        if(getValue(A_FSG_80_0_0_28_IntTlgEn)) //getValue(IT))
        {
            intertelegram_err(A_FSG_80_0_0_28_ID);
        }
        if(getValue(A_FSG_80_0_0_28_SegmEn))   //getvalue(SG)
        {
            sequence_err(A_FSG_80_0_0_28_ID,getValueSize(A_FSG_80_0_0_28));
        }
        A_FSG_80_0_0_28Status_BTN_already_pressed = 0;
    }
}
A_FSG_80_0_0_28_SendStatus()
{
    word currentPos;
    word headLength;
    int i;
    int j;
    word StringLength;
    long tempValue;
    word startVal;
    word elementsVal;
    byte data[4032];
    byte stringValue[4032];
    byte head[5];
    byte nibbleSetted;
    nibbleSetted = 0;
        currentPos = 0;
        //Einzelparameter: Operation
        tempValue = getValue(A_FSG_80_0_0_28_1);
        //voriger Parameter war ein first nibble, bei 1 Byte Werten Position incr
        if(nibbleSetted == 1) currentPos++;
        nibbleSetted = 0;
        data[currentPos++] = tempValue;
        //Einzelparameter: Type
        tempValue = getValue(A_FSG_80_0_0_28_2);
        //voriger Parameter war ein first nibble, bei 1 Byte Werten Position incr
        if(nibbleSetted == 1) currentPos++;
        nibbleSetted = 0;
        data[currentPos++] = tempValue;
        //Einzelparameter: Slot
        tempValue = getValue(A_FSG_80_0_0_28_3);
        //voriger Parameter war ein first nibble, bei 1 Byte Werten Position incr
        if(nibbleSetted == 1) currentPos++;
        nibbleSetted = 0;
        data[currentPos++] = tempValue;
        //Einzelparameter: State
        tempValue = getValue(A_FSG_80_0_0_28_4);
        //voriger Parameter war ein first nibble, bei 1 Byte Werten Position incr
        if(nibbleSetted == 1) currentPos++;
        nibbleSetted = 0;
        data[currentPos++] = tempValue;
        //Einzelparameter: ASG_ID
        tempValue = getValue(A_FSG_80_0_0_28_5);
    if(nibbleSetted == 1)
    {
        //voriger Parameter war ein Nibble, => second nibble, Pos incr und Flag zuruecksetzen
        data[currentPos] = (tempValue &0x0F) | (data[currentPos] &0xF0);
        currentPos++;
        nibbleSetted = 0;
    }
    else
    {
        //first nibble, kein increment, Flag setzen
        data[currentPos] = (tempValue<<4) &0xF0;
        nibbleSetted = 1;
    }
        //Einzelparameter: TAID
        tempValue = getValue(A_FSG_80_0_0_28_6);
    if(nibbleSetted == 1)
    {
        //voriger Parameter war ein Nibble, => second nibble, Pos incr und Flag zuruecksetzen
        data[currentPos] = (tempValue &0x0F) | (data[currentPos] &0xF0);
        currentPos++;
        nibbleSetted = 0;
    }
    else
    {
        //first nibble, kein increment, Flag setzen
        data[currentPos] = (tempValue<<4) &0xF0;
        nibbleSetted = 1;
    }
        //Einzelparameter: TotalNumListElements
        tempValue = getValue(A_FSG_80_0_0_28_7);
        //voriger Parameter war ein first nibble, bei 1 Byte Werten Position incr
        if(nibbleSetted == 1) currentPos++;
        nibbleSetted = 0;
        data[currentPos++] = (tempValue ) & 0xFF;
        data[currentPos++] = (tempValue >> 8) & 0xFF;
        //head Parameter
        headLength = getValueSize(A_FSG_80_0_0_28);
        getValue(A_FSG_80_0_0_28,head);
        for(i=0; i< headLength; i++)
        {
            data[currentPos++] = head[i];
        }
    //data Parameter
     startVal = getValue(A_FSG_80_0_0_28_Start);
     elementsVal = getValue(A_FSG_80_0_0_28_Elements);
     nibbleSetted = 0;
    if( (head[0]&0x20) == 0)
    {
     if( (head[0] & 0x10) > 0)
     {
        startVal++;
     }
     for( i = startVal ; i < startVal + elementsVal ; i++)
     {
       if( i < 0 || i >= A_FSG_80_0_0_28_ArrayDataList_Length )
       {
         write("Array index ausserhalb der Grenzen, Fct: 28");
         break;
       }
      if(nibbleSetted == 1) currentPos++;
      nibbleSetted = 0;
     if( (head[0]&0x40) == 0){ /* Transmit_Pos = 0, keine Positionsdaten */ }
     else
     {
        if( (head[0]&0x80) == 0)
        {
           //IndexSize = 0, Pos als 1 Byte Wert
           //Kein POS definiert
        }
        else
        {
           //IndexSize = 1, Pos als 2 Byte Wert
           //Kein POS definiert
        }
     }
      // Check if the current value of RecAdr enables the variable Parameter_ID:
      if( 0 || 1 == getValue( A_FSG_80_0_0_28_RecAdr ) || 2 == getValue( A_FSG_80_0_0_28_RecAdr ) || 3 == getValue( A_FSG_80_0_0_28_RecAdr ) )
      {
        //Sollte vor einem 4 Byte Wert 1 Nibble kommen, muss der index um 1 incrementiert werden!
        if( nibbleSetted==1) currentPos++;
        nibbleSetted = 0;
        data[currentPos++] = (A_FSG_80_0_0_28_ArrayDataList[i].Param1      ) & 0xFF;
        data[currentPos++] = (A_FSG_80_0_0_28_ArrayDataList[i].Param1 >>  8) & 0xFF;
        data[currentPos++] = (A_FSG_80_0_0_28_ArrayDataList[i].Param1 >> 16) & 0xFF;
        data[currentPos++] = (A_FSG_80_0_0_28_ArrayDataList[i].Param1 >> 24) & 0xFF;
       }
      // Check if the current value of RecAdr enables the variable DataDescription:
      if( 0 || 1 == getValue( A_FSG_80_0_0_28_RecAdr ) || 2 == getValue( A_FSG_80_0_0_28_RecAdr ) || 3 == getValue( A_FSG_80_0_0_28_RecAdr ) )
      {
        //Sollte vor einem 1 Byte Wert 1 Nibble kommen, muss der index um 1 incrementiert werden!
        if( nibbleSetted==1) currentPos++;
        nibbleSetted = 0;
        data[currentPos++] = (A_FSG_80_0_0_28_ArrayDataList[i].Param2 ) & 0xFF;
       }
      // Check if the current value of RecAdr enables the variable DataTag:
      if( 0 || 2 == getValue( A_FSG_80_0_0_28_RecAdr ) || 3 == getValue( A_FSG_80_0_0_28_RecAdr ) )
      {
        //Sollte vor einem 1 Byte Wert 1 Nibble kommen, muss der index um 1 incrementiert werden!
        if( nibbleSetted==1) currentPos++;
        nibbleSetted = 0;
        data[currentPos++] = (A_FSG_80_0_0_28_ArrayDataList[i].Param3 ) & 0xFF;
       }
      // Check if the current value of RecAdr enables the variable DataLength:
      if( 0 || 3 == getValue( A_FSG_80_0_0_28_RecAdr ) )
      {
        //Sollte vor einem 4 Byte Wert 1 Nibble kommen, muss der index um 1 incrementiert werden!
        if( nibbleSetted==1) currentPos++;
        nibbleSetted = 0;
        data[currentPos++] = (A_FSG_80_0_0_28_ArrayDataList[i].Param4      ) & 0xFF;
        data[currentPos++] = (A_FSG_80_0_0_28_ArrayDataList[i].Param4 >>  8) & 0xFF;
        data[currentPos++] = (A_FSG_80_0_0_28_ArrayDataList[i].Param4 >> 16) & 0xFF;
        data[currentPos++] = (A_FSG_80_0_0_28_ArrayDataList[i].Param4 >> 24) & 0xFF;
       }
      // Check if the current value of RecAdr enables the variable Data:
      if( 0 || 3 == getValue( A_FSG_80_0_0_28_RecAdr ) )
      {
        //Sollte vor einem String Wert 1 Nibble kommen, muss der index um 1 incrementiert werden!
        if( nibbleSetted==1) currentPos++;
        nibbleSetted = 0;
        StringLength =A_FSG_80_0_0_28_ArrayDataList[i].Param5_Length;
		/* Pruefung ob die Laenge-Checkbox aktiv ist */
		if (1 == A_FSG_80_0_0_28_Data_5_CntList[i] )
		{
			if(StringLength >= 0 && StringLength <= 32767 && StringLength <= 32767-2)
			{
				data[currentPos++] = ( (StringLength >> 8) & 0x7F ) | 0x80; //2Byte Flag (Bit 8) setzen + HighByte (erste 7 bit)
				data[currentPos++] = StringLength &0xFF;
			}
			else
			{
				writelineEx(gBAP_Trace, 0, "Eingegebene Laenge: %d von A_FSG_80_0_0_28_Data_5 mit Record Nr. %d ist ungueltig. Die max. erlaubte Laenge ist %d.", StringLength, i, 32767-2);
				return;
			}
		}
		else if(0 == A_FSG_80_0_0_28_Data_5_CntList[i] ) /*check box deaktiviert*/
		{
			if(StringLength >= 0 && StringLength <= 127 && StringLength <= 32767-1)
			{
				data[currentPos++] = StringLength & 0x7F; //Bit 8 = 0
			}
			else
			{
				writelineEx(gBAP_Trace, 0, "Eingegebene Laenge: %d von A_FSG_80_0_0_28_Data_5 mit Record Nr. %d ist ungueltig. Die max. erlaubte Laenge ist %d. ", StringLength, i, 32767-1);
				return;
			}
		}
        for(j=0; j < StringLength ; j++)
        {
            data[currentPos++] = A_FSG_80_0_0_28_ArrayDataList[i].Param5[j];
        }
       }
    //sollte der letzte Parameter ein first nibble gewesen sein, muss noch 1 increment durchgefuehrt werden
    if( nibbleSetted==1) currentPos++;
    nibbleSetted = 0;
     }
    }
    else
    {
     if( (head[0] & 0x10) > 0)
     {
        if(startVal != 0) startVal--;
        else
        {
           startVal = A_FSG_80_0_0_28_ArrayDataList_Length -1;
        }
     }
     for( i = startVal ; i > startVal - elementsVal ; i--)
     {
       if( i < 0 || i >= A_FSG_80_0_0_28_ArrayDataList_Length )
       {
         write("Array index ausserhalb der Grenzen, Fct: 28");
         break;
       }
      if(nibbleSetted == 1) currentPos++;
      nibbleSetted = 0;
     if( (head[0]&0x40) == 0){ /* Transmit_Pos = 0, keine Positionsdaten */ }
     else
     {
        if( (head[0]&0x80) == 0)
        {
           //IndexSize = 0, Pos als 1 Byte Wert
           //Kein POS definiert
        }
        else
        {
           //IndexSize = 1, Pos als 2 Byte Wert
           //Kein POS definiert
        }
     }
      // Check if the current value of RecAdr enables the variable Parameter_ID:
      if( 0 || 1 == getValue( A_FSG_80_0_0_28_RecAdr ) || 2 == getValue( A_FSG_80_0_0_28_RecAdr ) || 3 == getValue( A_FSG_80_0_0_28_RecAdr ) )
      {
        //Sollte vor einem 4 Byte Wert 1 Nibble kommen, muss der index um 1 incrementiert werden!
        if( nibbleSetted==1) currentPos++;
        nibbleSetted = 0;
        data[currentPos++] = (A_FSG_80_0_0_28_ArrayDataList[i].Param1      ) & 0xFF;
        data[currentPos++] = (A_FSG_80_0_0_28_ArrayDataList[i].Param1 >>  8) & 0xFF;
        data[currentPos++] = (A_FSG_80_0_0_28_ArrayDataList[i].Param1 >> 16) & 0xFF;
        data[currentPos++] = (A_FSG_80_0_0_28_ArrayDataList[i].Param1 >> 24) & 0xFF;
       }
      // Check if the current value of RecAdr enables the variable DataDescription:
      if( 0 || 1 == getValue( A_FSG_80_0_0_28_RecAdr ) || 2 == getValue( A_FSG_80_0_0_28_RecAdr ) || 3 == getValue( A_FSG_80_0_0_28_RecAdr ) )
      {
        //Sollte vor einem 1 Byte Wert 1 Nibble kommen, muss der index um 1 incrementiert werden!
        if( nibbleSetted==1) currentPos++;
        nibbleSetted = 0;
        data[currentPos++] = (A_FSG_80_0_0_28_ArrayDataList[i].Param2 ) & 0xFF;
       }
      // Check if the current value of RecAdr enables the variable DataTag:
      if( 0 || 2 == getValue( A_FSG_80_0_0_28_RecAdr ) || 3 == getValue( A_FSG_80_0_0_28_RecAdr ) )
      {
        //Sollte vor einem 1 Byte Wert 1 Nibble kommen, muss der index um 1 incrementiert werden!
        if( nibbleSetted==1) currentPos++;
        nibbleSetted = 0;
        data[currentPos++] = (A_FSG_80_0_0_28_ArrayDataList[i].Param3 ) & 0xFF;
       }
      // Check if the current value of RecAdr enables the variable DataLength:
      if( 0 || 3 == getValue( A_FSG_80_0_0_28_RecAdr ) )
      {
        //Sollte vor einem 4 Byte Wert 1 Nibble kommen, muss der index um 1 incrementiert werden!
        if( nibbleSetted==1) currentPos++;
        nibbleSetted = 0;
        data[currentPos++] = (A_FSG_80_0_0_28_ArrayDataList[i].Param4      ) & 0xFF;
        data[currentPos++] = (A_FSG_80_0_0_28_ArrayDataList[i].Param4 >>  8) & 0xFF;
        data[currentPos++] = (A_FSG_80_0_0_28_ArrayDataList[i].Param4 >> 16) & 0xFF;
        data[currentPos++] = (A_FSG_80_0_0_28_ArrayDataList[i].Param4 >> 24) & 0xFF;
       }
      // Check if the current value of RecAdr enables the variable Data:
      if( 0 || 3 == getValue( A_FSG_80_0_0_28_RecAdr ) )
      {
        //Sollte vor einem String Wert 1 Nibble kommen, muss der index um 1 incrementiert werden!
        if( nibbleSetted==1) currentPos++;
        nibbleSetted = 0;
        StringLength =A_FSG_80_0_0_28_ArrayDataList[i].Param5_Length;
		/* Pruefung ob die Laenge-Checkbox aktiv ist */
		if (1 == A_FSG_80_0_0_28_Data_5_CntList[i] )
		{
			if(StringLength >= 0 && StringLength <= 32767 && StringLength <= 32767-2)
			{
				data[currentPos++] = ( (StringLength >> 8) & 0x7F ) | 0x80; //2Byte Flag (Bit 8) setzen + HighByte (erste 7 bit)
				data[currentPos++] = StringLength &0xFF;
			}
			else
			{
				writelineEx(gBAP_Trace, 0, "Eingegebene Laenge: %d von A_FSG_80_0_0_28_Data_5 mit Record Nr. %d ist ungueltig. Die max. erlaubte Laenge ist %d.", StringLength, i, 32767-2);
				return;
			}
		}
		else if(0 == A_FSG_80_0_0_28_Data_5_CntList[i] ) /*check box deaktiviert*/
		{
			if(StringLength >= 0 && StringLength <= 127 && StringLength <= 32767-1)
			{
				data[currentPos++] = StringLength & 0x7F; //Bit 8 = 0
			}
			else
			{
				writelineEx(gBAP_Trace, 0, "Eingegebene Laenge: %d von A_FSG_80_0_0_28_Data_5 mit Record Nr. %d ist ungueltig. Die max. erlaubte Laenge ist %d. ", StringLength, i, 32767-1);
				return;
			}
		}
        for(j=0; j < StringLength ; j++)
        {
            data[currentPos++] = A_FSG_80_0_0_28_ArrayDataList[i].Param5[j];
        }
       }
    //sollte der letzte Parameter ein first nibble gewesen sein, muss noch 1 increment durchgefuehrt werden
    if( nibbleSetted==1) currentPos++;
    nibbleSetted = 0;
     }
    }
    Request_byteSequence(LSGID, A_FSG_80_0_0_28_ID, Data_REQ, data, currentPos);
}
on envVar A_FSG_80_0_0_28
{
    byte temp[4032];
    getValue(A_FSG_80_0_0_28, temp);
    putValue(A_FSG_80_0_0_28_RecAdr, 0x0F & temp[0]); //Record Address = Bit 0-3 von Byte 0
    if ( (0x10 & temp[0]) >0)
        putValue(A_FSG_80_0_0_28_Shift, 1); //Shift = Bit 4 von Byte 0
    else
        putValue(A_FSG_80_0_0_28_Shift, 0); //Shift = Bit 4 von Byte 0
    if ( (0x20 & temp[0]) >0)
        putValue(A_FSG_80_0_0_28_Direction, 1); //Direction = Bit 5 von Byte 0
    else
        putValue(A_FSG_80_0_0_28_Direction, 0); //Direction = Bit 5 von Byte 0
    if ( (0x40 & temp[0]) >0)
        putValue(A_FSG_80_0_0_28_TransPos, 1); //Transmission Pos = Bit 6 von Byte 0
    else
        putValue(A_FSG_80_0_0_28_TransPos, 0); //Transmission Pos = Bit 6 von Byte 0
    if ( (0x80 & temp[0]) >0)
        putValue(A_FSG_80_0_0_28_IndexSize, 1); //IndexSize = Bit 7 von Byte 0
    else
        putValue(A_FSG_80_0_0_28_IndexSize, 0); //IndexSize = Bit 7 von Byte 0
    if(getValue(A_FSG_80_0_0_28_IndexSize))
    {
        putValue(A_FSG_80_0_0_28_Start, ((temp[2]<<8)| temp[1]) ); // Array Start index, 2 Byte.
        putValue(A_FSG_80_0_0_28_Elements, ((temp[4]<<8)| temp[3]) ); // Array element count, 2 Byte.
    }
    else
    {
        putValue(A_FSG_80_0_0_28_Start, temp[1]); // Array Start index, 1 Byte.
        putValue(A_FSG_80_0_0_28_Elements, temp[2]); // Array element count, 1 Byte.
    }
}
A_FSG_80_0_0_28_GenerateStatus()
{
    byte head[5];
    int i = 0;
    int headLength;
    long tempValue;
    int currentPos;
    //Record Address in Byte 0 Bit 0-3 kopieren - MAX Wert = 0x0F
    if(getValue(A_FSG_80_0_0_28_RecAdr) > 0x0F)
        putValue(A_FSG_80_0_0_28_RecAdr , 0x0F);
    head[0] = (head[0] & 0xF0) | getValue(A_FSG_80_0_0_28_RecAdr);
    //Shift Bit in Byte 0 Bit 4 kopieren
    if( getValue(A_FSG_80_0_0_28_Shift) > 0) head[0] = head[0] | 0x10;
    else head[0] = head[0] & 0xEF;
    // Direction Bit in Byte 0 Bit 5 kopieren
    if( getValue(A_FSG_80_0_0_28_Direction) > 0) head[0] = head[0] | 0x20;
    else head[0] = head[0] & 0xDF;
    // TransmissionPos Bit in Byte 0 Bit 6 kopieren
    if( getValue(A_FSG_80_0_0_28_TransPos) > 0) head[0] = head[0] | 0x40;
    else head[0] = head[0] & 0xBF;
    if( getValue(A_FSG_80_0_0_28_IndexSize) > 0)
    {
        // 5 Byte Header
        head[0] = head[0] | 0x80;
        head[1] =  getValue(A_FSG_80_0_0_28_Start) & 0xFF;
        head[2] = (getValue(A_FSG_80_0_0_28_Start) >> 8 ) & 0xFF;
        head[3] =  getValue(A_FSG_80_0_0_28_Elements) & 0xFF;
        head[4] = (getValue(A_FSG_80_0_0_28_Elements)  >> 8 ) & 0xFF;
        //ToDo: DATA - derzeit einfach laenge = 5
        headLength = 5;
    }
    else 
    {
        // 3 Byte Header
        head[0] = head[0] & 0x7F;
        head[1] = getValue(A_FSG_80_0_0_28_Start) & 0xFF;
        head[2] = getValue(A_FSG_80_0_0_28_Elements) & 0xFF;
        //ToDo: DATA - derzeit einfach laenge = 3
        headLength = 3;
    }

    currentPos = 0;

    putValue(A_FSG_80_0_0_28, head, headLength); 
}
on envVar A_FSG_80_0_0_28_RecAdr
{
    A_FSG_80_0_0_28_GenerateStatus();
}

on envVar A_FSG_80_0_0_28_Shift
{
    A_FSG_80_0_0_28_GenerateStatus();
}

on envVar A_FSG_80_0_0_28_Direction
{
    A_FSG_80_0_0_28_GenerateStatus();
}

on envVar A_FSG_80_0_0_28_Start
{
    A_FSG_80_0_0_28_GenerateStatus();
}

on envVar A_FSG_80_0_0_28_Elements
{
    A_FSG_80_0_0_28_GenerateStatus();
}

on envVar A_FSG_80_0_0_28_IndexSize
{
    A_FSG_80_0_0_28_GenerateStatus();
}
on envVar A_FSG_80_0_0_28_TransPos
{
    A_FSG_80_0_0_28_GenerateStatus();
}
A_FSG_80_0_0_28_Changed_GenerateChanged()
{
    byte head[5];
    //Record Address in Byte 0 Bit 0-3 kopieren - MAX Wert = 0x0F
    if(getValue(A_FSG_80_0_0_28_Changed_RecAdr) > 0x0F)
        putValue(A_FSG_80_0_0_28_Changed_RecAdr , 0x0F);
    head[0] = (head[0] & 0xF0) | getValue(A_FSG_80_0_0_28_Changed_RecAdr);
    //Shift Bit in Byte 0 Bit 4 kopieren
    if( getValue(A_FSG_80_0_0_28_Changed_Shift) > 0) head[0] = head[0] | 0x10;
    else head[0] = head[0] & 0xEF;
    // Direction Bit in Byte 0 Bit 5 kopieren
    if( getValue(A_FSG_80_0_0_28_Changed_Direction) > 0) head[0] = head[0] | 0x20;
    else head[0] = head[0] & 0xDF;
    // TransmissionPos Bit in Byte 0 Bit 6 kopieren
    if( getValue(A_FSG_80_0_0_28_Changed_TransPos) > 0) head[0] = head[0] | 0x40;
    else head[0] = head[0] & 0xBF;
    if( getValue(A_FSG_80_0_0_28_Changed_IndexSize) > 0)
    {
        // 5 Byte Header
        head[0] = head[0] | 0x80;
        head[1] =  getValue(A_FSG_80_0_0_28_Changed_Start) & 0xFF;
        head[2] = (getValue(A_FSG_80_0_0_28_Changed_Start) >> 8 ) & 0xFF;
        head[3] =  getValue(A_FSG_80_0_0_28_Changed_Elements) & 0xFF;
        head[4] = (getValue(A_FSG_80_0_0_28_Changed_Elements)  >> 8 ) & 0xFF;
        //ToDo: DATA - derzeit einfach laenge = 5
        putValue(A_FSG_80_0_0_28_Changed, head, 5); 
    }
    else 
    {
        // 3 Byte Header
        head[0] = head[0] & 0x7F;
        head[1] = getValue(A_FSG_80_0_0_28_Changed_Start) & 0xFF;
        head[2] = getValue(A_FSG_80_0_0_28_Changed_Elements) & 0xFF;
        //ToDo: DATA - derzeit einfach laenge = 3
        putValue(A_FSG_80_0_0_28_Changed, head, 3); 
    }
}

on envVar A_FSG_80_0_0_28_Changed_RecAdr
{
    A_FSG_80_0_0_28_Changed_GenerateChanged();
}

on envVar A_FSG_80_0_0_28_Changed_Shift
{
    A_FSG_80_0_0_28_Changed_GenerateChanged();
}

on envVar A_FSG_80_0_0_28_Changed_Direction
{
    A_FSG_80_0_0_28_Changed_GenerateChanged();
}

on envVar A_FSG_80_0_0_28_Changed_Start
{
    A_FSG_80_0_0_28_Changed_GenerateChanged();
}

on envVar A_FSG_80_0_0_28_Changed_Elements
{
    A_FSG_80_0_0_28_Changed_GenerateChanged();
}

on envVar A_FSG_80_0_0_28_Changed_IndexSize
{
    A_FSG_80_0_0_28_Changed_GenerateChanged();
}
on envVar A_FSG_80_0_0_28_Changed_TransPos
{
    A_FSG_80_0_0_28_Changed_GenerateChanged();
}
on envVar A_FSG_80_0_0_28_SetGet
{
    byte temp[4032];
    getValue(A_FSG_80_0_0_28_SetGet, temp);
    putValue(A_FSG_80_0_0_28_SetGet_RecAdr, 0x0F & temp[0]); //Record Address = Bit 0-3 von Byte 0
    if ( (0x10 & temp[0]) >0)
        putValue(A_FSG_80_0_0_28_SetGet_Shift, 1); //Shift = Bit 4 von Byte 0
    else
        putValue(A_FSG_80_0_0_28_SetGet_Shift, 0); //Shift = Bit 4 von Byte 0
    if ( (0x20 & temp[0]) >0)
        putValue(A_FSG_80_0_0_28_SetGet_Direction, 1); //Direction = Bit 5 von Byte 0
    else
        putValue(A_FSG_80_0_0_28_SetGet_Direction, 0); //Direction = Bit 5 von Byte 0
    // Bit 6 von Byte 0 = reserved
    if ( (0x80 & temp[0]) >0)
        putValue(A_FSG_80_0_0_28_SetGet_IndexSize, 1); //IndexSize = Bit 7 von Byte 0
    else
        putValue(A_FSG_80_0_0_28_SetGet_IndexSize, 0); //IndexSize = Bit 7 von Byte 0
    if(getValue(A_FSG_80_0_0_28_SetGet_IndexSize))
    {
        putValue(A_FSG_80_0_0_28_SetGet_Start, ((temp[2]<<8)| temp[1]) ); //Start Wert, 2 Byte lang
        putValue(A_FSG_80_0_0_28_SetGet_Elements, ((temp[4]<<8)| temp[3]) ); //Elements Wert, 2 Byte lang
    }
    else
    {
        putValue(A_FSG_80_0_0_28_SetGet_Start, temp[1]); //Start Wert, 1 Byte lang
        putValue(A_FSG_80_0_0_28_SetGet_Elements, temp[2]); //Start Wert, 1 Byte lang
    }
}
A_FSG_80_0_0_28_LoadArray()
{
	/********* Statische Deklarationen ***********/
	dword CSVfileHandle;
	dword filePos;
	dword paramPos;
	dword Num_of_csv_byte;
	dword element;
	dword current_CSV_line;
	byte buffer_byte[0xFFFF];
	dword i;
	dword j;
	char CSV_filename[255];
	dword  count1 =0, count2 =0;
	char CSV_filepath[0xFFFF];

	/********* Param Puffer Deklarationen ***********/
	char temp1[25];
	char temp2[25];
	char temp3[25];
	char temp4[25];

	/********* Initialisierungen ***********/
	CSVfileHandle = 0;
	filePos = 0;
	paramPos = 0;
	Num_of_csv_byte = 0;
	element = 1;
	current_CSV_line = 0;
	for(i = 0; i < A_FSG_80_0_0_28_ArrayDataList_Length; i++)
	{ /* Initialisierung von den Ziel-Strukturen */
		A_FSG_80_0_0_28_ArrayDataList[i].Param1 = 0;
		A_FSG_80_0_0_28_ArrayDataList[i].Param2 = 0;
		A_FSG_80_0_0_28_ArrayDataList[i].Param3 = 0;
		A_FSG_80_0_0_28_ArrayDataList[i].Param4 = 0;
		for(j=0; j<32767; j++)
			A_FSG_80_0_0_28_ArrayDataList[i].Param5[j] = 0;
		A_FSG_80_0_0_28_ArrayDataList[i].Param5_Length = 0;
		A_FSG_80_0_0_28_Data_5_LenList[i] = 0;
	}
	for(i=0;i<0xFFFF;i++)
		CSV_filepath[i] =0;

	getValue(A_FSG_80_0_0_28_fileSelector, CSV_filepath);
	i =0;
	while (CSV_filepath[i] !=0) //scan "path"
	{
		if(CSV_filepath[i] ==0x5C) //count "/" to seperate later "path" & "filename" 
				count1++;
		//write("Path[%d] of *.csv: %x",i, CSV_filepath[i]); //debug
		i++;
	}  
	 
	i =0; j =0; //reset values
	while (CSV_filepath[i] !=0) //seperate "path" and "filename"
	{
		if(count2==count1) //get filename after last "\"
		{              
			CSV_filename[j] =CSV_filepath[i];
			j++;
			CSV_filepath[i] =0;              
		}
		if(CSV_filepath[i]==0x5C) //count "\" to get filename after last "\"            
			count2++;   
		i++;
	}
	setFilePath(CSV_filepath, 0); //set path for *.csv file
	CSVfileHandle = openFileRead(CSV_filename, 1); //open *.csv (binary-mode ->get the ASCII/UTF-8 code)

	if (CSVfileHandle!=0) //*.csv file access successful
	{
		writelineEx(gBAP_Trace, 0,"Dateizugriff auf '%s' erfolgreich", CSV_filename);    //output result
		//get data from *.csv and store the total number of byte in *.csv-file
		Num_of_csv_byte = fileGetBinaryBlock (buffer_byte, elcount(buffer_byte), CSVfileHandle);

		for (filePos = 0; filePos < Num_of_csv_byte; filePos++) //copy data into "LastDestList"
		{
			if (buffer_byte[filePos] != 0x3B) //read data if no ";" is detected
			{
				//nextline in *.csv (next "record element" in LastDestList) -> "LF" and "CR" detected -> copy (transform string -> long) data from help values in global values
				if(buffer_byte[filePos] == 0x0D && buffer_byte[filePos+1] == 0x0A)
				{
					if(current_CSV_line > 0 && current_CSV_line < 401) //ignore first line in *.csv file
					{
						A_FSG_80_0_0_28_ArrayDataList[current_CSV_line-1].Param1 = atol(temp1); //Parameter_ID
						A_FSG_80_0_0_28_ArrayDataList[current_CSV_line-1].Param2 = atol(temp2); //DataDescription
						A_FSG_80_0_0_28_ArrayDataList[current_CSV_line-1].Param3 = atol(temp3); //DataTag
						A_FSG_80_0_0_28_ArrayDataList[current_CSV_line-1].Param4 = atol(temp4); //DataLength
						for(i = 0; i < 25; i++)
						{ /* Temp-Puffer Initialisierung zur Vermeidung von Nebeneffekte */
							temp1[i]=0;
							temp2[i]=0;
							temp3[i]=0;
							temp4[i]=0;
						}
					}
					current_CSV_line++; //next line in *.csv file
					element = 1; //start at 'POS' (first record element of "array data")
					paramPos = 0; //reset value
				}
 				//copy data from "buffer_byte" (data from *.csv file) in help values and "name" until end of line is not detected
				else if(current_CSV_line > 0 && current_CSV_line < 401)
				{
					//writelineEx(gBAP_Trace, 0, "Element %x  Index %x", element, j);
					switch (element)
					{
						case 1: //Parameter_ID
								if( paramPos >= elCount(temp1) ){
									writelineEx(gBAP_Trace, 0, "Param%x in Zeile %d in der Input CSV Datei, enthaelt mehr Zeichen als erlaubt. Bearbeitung abgebrochen!", element, current_CSV_line);
									return; //False
								}else{
									temp1[paramPos] = buffer_byte[filePos];
									paramPos++;
								}
							break;
						case 2: //DataDescription
								if( paramPos >= elCount(temp2) ){
									writelineEx(gBAP_Trace, 0, "Param%x in Zeile %d in der Input CSV Datei, enthaelt mehr Zeichen als erlaubt. Bearbeitung abgebrochen!", element, current_CSV_line);
									return; //False
								}else{
									temp2[paramPos] = buffer_byte[filePos];
									paramPos++;
								}
							break;
						case 3: //DataTag
								if( paramPos >= elCount(temp3) ){
									writelineEx(gBAP_Trace, 0, "Param%x in Zeile %d in der Input CSV Datei, enthaelt mehr Zeichen als erlaubt. Bearbeitung abgebrochen!", element, current_CSV_line);
									return; //False
								}else{
									temp3[paramPos] = buffer_byte[filePos];
									paramPos++;
								}
							break;
						case 4: //DataLength
								if( paramPos >= elCount(temp4) ){
									writelineEx(gBAP_Trace, 0, "Param%x in Zeile %d in der Input CSV Datei, enthaelt mehr Zeichen als erlaubt. Bearbeitung abgebrochen!", element, current_CSV_line);
									return; //False
								}else{
									temp4[paramPos] = buffer_byte[filePos];
									paramPos++;
								}
							break;
						case 5: //Data
								if(paramPos < 32765)
								{
									A_FSG_80_0_0_28_ArrayDataList[current_CSV_line-1].Param5[paramPos] = buffer_byte[filePos];
									A_FSG_80_0_0_28_ArrayDataList[current_CSV_line-1].Param5_Length = paramPos +1;
								}
								paramPos++;
						break;
						default:
						break;
					}
				}
			}
			else  // ";" is detected ->next record element of "array data"
			{
				//writelineEx(gBAP_Trace, 0, "naechstes Element %d Bytes",element);
				element++;
				paramPos=0; //reset value
			}
		}

		if(fileClose (CSVfileHandle) !=0) //close *.csv file
			writelineEx(gBAP_Trace, 0,"Datei '%s' geschlossen", CSV_filename); //output result
		else
			writelineEx(gBAP_Trace, 0,"Fehler beim Schliessen der Datei '%s'", CSV_filename);//output result
	}
	else //*.csv file access not successful
	{
		writelineEx(gBAP_Trace, 0,"Fehler beim Dateizugriff auf '%s'",CSV_filename); //output result
	}
}

on envVar A_FSG_80_0_0_28_loadArray_Btn
{
	char filePath[255];
	if (A_FSG_80_0_0_28_generateData_Btn_already_pressed == 0)
	{
		A_FSG_80_0_0_28_generateData_Btn_already_pressed = 1;
	}
	else
	{
		A_FSG_80_0_0_28_generateData_Btn_already_pressed = 0;
		getValue(A_FSG_80_0_0_28_fileSelector, filePath);
		if(0 == strlen(filePath))
		{
			writelineEx(gBAP_Trace, 0, "Invalid file path!");
		}
		else
		{
			A_FSG_80_0_0_28_LoadArray();
			writelineEx(gBAP_Trace, 0, "Load array from CSV file: %s", filePath);
		}
	}
	putValue(A_FSG_80_0_0_28_Data_1, A_FSG_80_0_0_28_ArrayDataList[ getValue( A_FSG_80_0_0_28_DataIndex) ].Param1);
	putValue(A_FSG_80_0_0_28_Data_2, A_FSG_80_0_0_28_ArrayDataList[ getValue( A_FSG_80_0_0_28_DataIndex) ].Param2);
	putValue(A_FSG_80_0_0_28_Data_3, A_FSG_80_0_0_28_ArrayDataList[ getValue( A_FSG_80_0_0_28_DataIndex) ].Param3);
	putValue(A_FSG_80_0_0_28_Data_4, A_FSG_80_0_0_28_ArrayDataList[ getValue( A_FSG_80_0_0_28_DataIndex) ].Param4);
	putValue(A_FSG_80_0_0_28_Data_5, A_FSG_80_0_0_28_ArrayDataList[ getValue( A_FSG_80_0_0_28_DataIndex) ].Param5, A_FSG_80_0_0_28_ArrayDataList[getValue(A_FSG_80_0_0_28_DataIndex)].Param5_Length);
}


on envVar A_FSG_80_0_0_28_generateData_Btn
{
	word i;
	dword elementsArray[6] = {4, 1, 1, 4, 32767, 2};
	byte elementsTypeArray[6] = {0, 0, 0, 0, 0xE, 0xF};
	dword elementsMaxSizeArray[6] = {4294967295LL, 255, 0xFF, 400000, 0, 0};
	byte tempArray[13111600];
	if (A_FSG_80_0_0_28_generateData_Btn_already_pressed == 0)
	{
		A_FSG_80_0_0_28_generateData_Btn_already_pressed = 1;
	}
	else
	{
		initStruct(tempArray, elementsArray, elementsTypeArray, elementsMaxSizeArray, 28, 400 );
		for(i = 0; i < 400; i++)
		{
			memcpy(A_FSG_80_0_0_28_ArrayDataList[i], tempArray, (i * 32779) );
			if(A_FSG_80_0_0_28_ArrayDataList[i].Param5_Length > 127 )
				A_FSG_80_0_0_28_Data_5_CntList[i] = 1;
		}
		A_FSG_80_0_0_28_generateData_Btn_already_pressed = 0;
	}
	putValue(A_FSG_80_0_0_28_Data_1, A_FSG_80_0_0_28_ArrayDataList[ getValue( A_FSG_80_0_0_28_DataIndex) ].Param1);
	putValue(A_FSG_80_0_0_28_Data_2, A_FSG_80_0_0_28_ArrayDataList[ getValue( A_FSG_80_0_0_28_DataIndex) ].Param2);
	putValue(A_FSG_80_0_0_28_Data_3, A_FSG_80_0_0_28_ArrayDataList[ getValue( A_FSG_80_0_0_28_DataIndex) ].Param3);
	putValue(A_FSG_80_0_0_28_Data_4, A_FSG_80_0_0_28_ArrayDataList[ getValue( A_FSG_80_0_0_28_DataIndex) ].Param4);
	putValue(A_FSG_80_0_0_28_Data_5, A_FSG_80_0_0_28_ArrayDataList[ getValue( A_FSG_80_0_0_28_DataIndex) ].Param5, A_FSG_80_0_0_28_ArrayDataList[getValue(A_FSG_80_0_0_28_DataIndex)].Param5_Length);
}
// HME generateCaplOnEnv (3131)
on envVar A_FSG_80_0_0_28_DataIndex
{
    long index;
    long maxIndex = 400-1;
    index = getValue(this);
    if(index >= maxIndex) index = maxIndex;
    else if(index < 0) index = 0;
    putValue(this, index);
    putValue(A_FSG_80_0_0_28_Data_1, A_FSG_80_0_0_28_ArrayDataList[index].Param1);
    putValue(A_FSG_80_0_0_28_Data_2, A_FSG_80_0_0_28_ArrayDataList[index].Param2);
    putValue(A_FSG_80_0_0_28_Data_3, A_FSG_80_0_0_28_ArrayDataList[index].Param3);
    putValue(A_FSG_80_0_0_28_Data_4, A_FSG_80_0_0_28_ArrayDataList[index].Param4);
    putValue(A_FSG_80_0_0_28_Data_5_len, A_FSG_80_0_0_28_Data_5_LenList[index]);
    putValue(A_FSG_80_0_0_28_Data_5_cnt, A_FSG_80_0_0_28_Data_5_CntList[index]);
    putValue(A_FSG_80_0_0_28_Data_5, A_FSG_80_0_0_28_ArrayDataList[index].Param5, A_FSG_80_0_0_28_ArrayDataList[index].Param5_Length);

}
on envVar A_FSG_80_0_0_28_DataIndex_Incr
{
    long index;
    if(A_FSG_80_0_0_28_DataIndex_Incr_already_pressed == 0)
    {
        A_FSG_80_0_0_28_DataIndex_Incr_already_pressed = 1;
    }
    else
    {
        index = getValue(A_FSG_80_0_0_28_DataIndex);
        index++;
        putValue(A_FSG_80_0_0_28_DataIndex, index);
        A_FSG_80_0_0_28_DataIndex_Incr_already_pressed = 0;
    }
}
on envVar A_FSG_80_0_0_28_DataIndex_Decr
{
    long index;
    if(A_FSG_80_0_0_28_DataIndex_Decr_already_pressed == 0)
    {
        A_FSG_80_0_0_28_DataIndex_Decr_already_pressed = 1;
    }
    else
    {
        index = getValue(A_FSG_80_0_0_28_DataIndex);
        index--;
        putValue(A_FSG_80_0_0_28_DataIndex, index);
        A_FSG_80_0_0_28_DataIndex_Decr_already_pressed = 0;
    }
}
// HME generateCaplOnEnv (3160)
on envVar A_FSG_80_0_0_28_DataIndex_SetGet
{
    long index;
    long maxIndex = 400-1;
    index = getValue(this);
    if(index >= maxIndex) index = maxIndex;
    else if(index < 0) index = 0;
    putValue(this, index);
    putValue(A_FSG_80_0_0_28_Data_1_SetGet, A_FSG_80_0_0_28_ArrayDataList[index].Param1);
    putValue(A_FSG_80_0_0_28_Data_2_SetGet, A_FSG_80_0_0_28_ArrayDataList[index].Param2);
    putValue(A_FSG_80_0_0_28_Data_3_SetGet, A_FSG_80_0_0_28_ArrayDataList[index].Param3);
    putValue(A_FSG_80_0_0_28_Data_4_SetGet, A_FSG_80_0_0_28_ArrayDataList[index].Param4);
    putValue(A_FSG_80_0_0_28_Data_5_SetGet_len, A_FSG_80_0_0_28_Data_5_SetGet_LenList[index]);
    putValue(A_FSG_80_0_0_28_Data_5_SetGet_cnt, A_FSG_80_0_0_28_Data_5_SetGet_CntList[index]);
    putValue(A_FSG_80_0_0_28_Data_5_SetGet, A_FSG_80_0_0_28_ArrayDataList[index].Param5, A_FSG_80_0_0_28_ArrayDataList[index].Param5_Length);

}
on envVar A_FSG_80_0_0_28_DataIndex_SetGet_Incr
{
    long index;
    if(A_FSG_80_0_0_28_DataIndex_SetGet_Incr_already_pressed == 0)
    {
        A_FSG_80_0_0_28_DataIndex_SetGet_Incr_already_pressed = 1;
    }
    else
    {
        index = getValue(A_FSG_80_0_0_28_DataIndex_SetGet);
        index++;
        putValue(A_FSG_80_0_0_28_DataIndex_SetGet, index);
        A_FSG_80_0_0_28_DataIndex_SetGet_Incr_already_pressed = 0;
    }
}
on envVar A_FSG_80_0_0_28_DataIndex_SetGet_Decr
{
    long index;
    if(A_FSG_80_0_0_28_DataIndex_SetGet_Decr_already_pressed == 0)
    {
        A_FSG_80_0_0_28_DataIndex_SetGet_Decr_already_pressed = 1;
    }
    else
    {
        index = getValue(A_FSG_80_0_0_28_DataIndex_SetGet);
        index--;
        putValue(A_FSG_80_0_0_28_DataIndex_SetGet, index);
        A_FSG_80_0_0_28_DataIndex_SetGet_Decr_already_pressed = 0;
    }
}
on envVar A_FSG_80_0_0_28_FctEn
{
    long data[3];
    data[0]=LSGID;
    data[1]=A_FSG_80_0_0_28_ID;
    data[2]=getValue(A_FSG_80_0_0_28_FctEn);
    ChangeConfig(0x0031,data);
}
// De-Aktivierung der Eingabefelder der FCTID A_FSG_80_0_0_28
on envVar A_FSG_80_0_0_28_FctLstItemEn
{
       if(getValue(this)) 
       {
           EnableControl(panel_name,"panel_FSG_80_0_0_28",1);
           EnableControl(panel_name,"panel_A_FSG_80_0_0_28_Status",1);
           EnableControl(panel_name,"errfield_A_FSG_80_0_0_28",1);
           EnableControl(panel_name,"panel_A_FSG_80_0_0_28",1);
           EnableControl(panel_name,"panel_A_FSG_80_0_0_28_Changed",1);
           EnableControl(panel_name,"panel_A_FSG_80_0_0_28_SetGet",1);
           setControlForeColor(panel_name, "checkbox_A_FSG_80_0_0_28", MakeRGB(0,240,0));
       }
       else
       {
           EnableControl(panel_name,"panel_FSG_80_0_0_28",0);
           EnableControl(panel_name,"panel_A_FSG_80_0_0_28_Status",0);
           EnableControl(panel_name,"errfield_A_FSG_80_0_0_28",0);
           EnableControl(panel_name,"panel_A_FSG_80_0_0_28",0);
           EnableControl(panel_name,"panel_A_FSG_80_0_0_28_Changed",0);
           EnableControl(panel_name,"panel_A_FSG_80_0_0_28_SetGet",0);
           setControlForeColor(panel_name, "checkbox_A_FSG_80_0_0_28", MakeRGB(250,0,0));
       }
}
// Man darf gleichzeitig nur Checkbox fuer SegmError oder IntertelegramError aktiviert werden
on envVar A_FSG_80_0_0_28_IntTlgEn
{
       if(getValue(this)) 
       {
           putValue(A_FSG_80_0_0_28_SegmEn,0);
           intertelegram_err(A_FSG_80_0_0_28_ID);
       }
       else
       {
           intertelegram_err_off(A_FSG_80_0_0_28_ID);
       }
}
// Man darf gleichzeitig nur Checkbox fuer SegmError oder IntertelegramError aktiviert werden
on envVar A_FSG_80_0_0_28_SegmEn
{
       if(getValue(this)) 
       {
           putValue(A_FSG_80_0_0_28_IntTlgEn,0);
           sequence_err(A_FSG_80_0_0_28_ID,getValueSize(A_FSG_80_0_0_28_SegmEn));
       }
       else
       {
              sequence_err_off(A_FSG_80_0_0_28_ID);
       }
}

// [XL] Ueberwachung der CheckBox fuer AT
on envVar A_FSG_80_0_0_28_AT
{
	if(getValue(this))
	{
		EnableControl(panel_name,"panel_A_FSG_80_0_0_28_Status",0);
	}
	else
	{
   	EnableControl(panel_name,"panel_A_FSG_80_0_0_28_Status",1);
 	}
}

A_FSG_80_0_0_28_SetInd () { /* leere Function*/ }

A_FSG_80_0_0_28_SetGetInd()
{
    int currentPos;
    byte head[5];
    byte stringTempValue[4032];
    int i;
    int j;
    int startVal;
    int elementsVal;
    byte recordAddressVal;
    byte transmitPosVal;
    long tempValue;
    long index;
    byte nibbleSetted;
    currentPos = 0;
    nibbleSetted = 0;
    //Einzelparameter: Operation
    //voriger Parameter war ein first nibble, bei 1 Byte Werten Position incr
    if(nibbleSetted == 1) currentPos++;
    nibbleSetted = 0;
    tempValue = gBAP_Indication_data[currentPos++];
    putValue(A_FSG_80_0_0_28_1_SetGet, tempValue);
    //Einzelparameter: Type
    //voriger Parameter war ein first nibble, bei 1 Byte Werten Position incr
    if(nibbleSetted == 1) currentPos++;
    nibbleSetted = 0;
    tempValue = gBAP_Indication_data[currentPos++];
    putValue(A_FSG_80_0_0_28_2_SetGet, tempValue);
    //Einzelparameter: Slot
    //voriger Parameter war ein first nibble, bei 1 Byte Werten Position incr
    if(nibbleSetted == 1) currentPos++;
    nibbleSetted = 0;
    tempValue = gBAP_Indication_data[currentPos++];
    putValue(A_FSG_80_0_0_28_3_SetGet, tempValue);
    //Einzelparameter: ASG_ID
    if(nibbleSetted == 1)
    {
        //voriger Parameter war ein Nibble, => second nibble, Pos incr und Flag zuruecksetzen
        tempValue = (gBAP_Indication_data[currentPos++] &0xF);
        nibbleSetted = 0;
    }
    else
    {
        //first nibble, kein increment, Flag setzen
        tempValue = ((gBAP_Indication_data[currentPos]>>4) &0xF);
        nibbleSetted = 1;
    }
    putValue(A_FSG_80_0_0_28_4_SetGet, tempValue);
    //Einzelparameter: TAID
    if(nibbleSetted == 1)
    {
        //voriger Parameter war ein Nibble, => second nibble, Pos incr und Flag zuruecksetzen
        tempValue = (gBAP_Indication_data[currentPos++] &0xF);
        nibbleSetted = 0;
    }
    else
    {
        //first nibble, kein increment, Flag setzen
        tempValue = ((gBAP_Indication_data[currentPos]>>4) &0xF);
        nibbleSetted = 1;
    }
    putValue(A_FSG_80_0_0_28_5_SetGet, tempValue);
    //head Parameter
    if(gBAP_Indication_header[4] >= (3+currentPos))
    {
        if( (gBAP_Indication_data[currentPos] & 0x80) > 0)
            if(gBAP_Indication_header[4] >= (5+currentPos))
            {
                for(i = 0; i < 5; i++) head[i] = gBAP_Indication_data[currentPos++];
                putValue(A_FSG_80_0_0_28_SetGet, head, 5);
                if(getValue(A_FSG_80_0_0_28_AT))
                {
                    putValue(A_FSG_80_0_0_28,head,5);
                }
                startVal = (head[2]<<8) | head[1];
                elementsVal = (head[4]<<8) | head[3];
            }
            else write("received Data Error");
        else
        {
            for(i = 0; i < 3; i++) head[i] = gBAP_Indication_data[currentPos++];
            putValue(A_FSG_80_0_0_28_SetGet, head, 3);
            if(getValue(A_FSG_80_0_0_28_AT))
            {
                putValue(A_FSG_80_0_0_28,head,3);
            }
                startVal = head[1];
                elementsVal = head[2];
        }
        recordAddressVal = head[0] & 0x0F;
        transmitPosVal = head[0] & 0x40;
        if(getValue(A_FSG_80_0_0_28_AT))
        {
            putValue(A_FSG_80_0_0_28_RecAdr,recordAddressVal);
            putValue(A_FSG_80_0_0_28_Start, startVal);
            putValue(A_FSG_80_0_0_28_Elements, elementsVal);
            putValue(A_FSG_80_0_0_28_TransPos, transmitPosVal);
        }
    }
    //data Parameter
     nibbleSetted = 0;
    if( (head[0] & 0x20) == 0) { // array header: increasing indices (Direction = 0).
      if( (head[0] & 0x10) > 0) { // array header: first element is one after specified start element (Shift = 1, Direction = 0).
        startVal++;
      }
      for ( i = startVal ; i < startVal + elementsVal ; i++) {
        if ( i < 0 || i >= A_FSG_80_0_0_28_ArrayDataList_Length ) {
          write("Array index ausserhalb der Grenzen, Fct: 28");
          break;
        }
        if(nibbleSetted == 1) currentPos++;
        nibbleSetted = 0;
     if( (head[0]&0x40) == 0){ /* Transmit_Pos = 0, keine Positionsdaten */ }
     else
     {
        if( (head[0]&0x80) == 0)
        {
           //IndexSize = 0, Pos als 1 Byte Wert
           //Kein POS definiert
        }
        else
        {
           //IndexSize = 1, Pos als 2 Byte Wert
           //Kein POS definiert
        }
     }
      // 0 - es kann vorkommen, dass das if leer ist dies wuerde zum Fehler fuehren. => automatische generierung der 0
      if( 0 || 1 == recordAddressVal || 2 == recordAddressVal || 3 == recordAddressVal )
      {
        //Sollte vor einem 4 Byte Wert 1 Nibble kommen, muss der index um 1 incrementiert werden!
        if( nibbleSetted==1) currentPos++;
        nibbleSetted = 0;
        A_FSG_80_0_0_28_ArrayDataList[i].Param1 = (gBAP_Indication_data[currentPos++] & 0xFF) + ((gBAP_Indication_data[currentPos++] & 0xFF) <<8) + ((gBAP_Indication_data[currentPos++] & 0xFF) <<16) + ((gBAP_Indication_data[currentPos++] & 0xFF) <<24);
      }
      // 0 - es kann vorkommen, dass das if leer ist dies wuerde zum Fehler fuehren. => automatische generierung der 0
      if( 0 || 1 == recordAddressVal || 2 == recordAddressVal || 3 == recordAddressVal )
      {
        //Sollte vor einem 1 Byte Wert 1 Nibble kommen, muss der index um 1 incrementiert werden!
        if( nibbleSetted==1) currentPos++;
        nibbleSetted = 0;
        A_FSG_80_0_0_28_ArrayDataList[i].Param2 = (gBAP_Indication_data[currentPos++] & 0xFF);
      }
      // 0 - es kann vorkommen, dass das if leer ist dies wuerde zum Fehler fuehren. => automatische generierung der 0
      if( 0 || 2 == recordAddressVal || 3 == recordAddressVal )
      {
        //Sollte vor einem 1 Byte Wert 1 Nibble kommen, muss der index um 1 incrementiert werden!
        if( nibbleSetted==1) currentPos++;
        nibbleSetted = 0;
        A_FSG_80_0_0_28_ArrayDataList[i].Param3 = (gBAP_Indication_data[currentPos++] & 0xFF);
      }
      // 0 - es kann vorkommen, dass das if leer ist dies wuerde zum Fehler fuehren. => automatische generierung der 0
      if( 0 || 3 == recordAddressVal )
      {
        //Sollte vor einem 4 Byte Wert 1 Nibble kommen, muss der index um 1 incrementiert werden!
        if( nibbleSetted==1) currentPos++;
        nibbleSetted = 0;
        A_FSG_80_0_0_28_ArrayDataList[i].Param4 = (gBAP_Indication_data[currentPos++] & 0xFF) + ((gBAP_Indication_data[currentPos++] & 0xFF) <<8) + ((gBAP_Indication_data[currentPos++] & 0xFF) <<16) + ((gBAP_Indication_data[currentPos++] & 0xFF) <<24);
      }
      // 0 - es kann vorkommen, dass das if leer ist dies wuerde zum Fehler fuehren. => automatische generierung der 0
      if( 0 || 3 == recordAddressVal )
      {
        //Sollte vor einem String Wert 1 Nibble kommen, muss der index um 1 incrementiert werden!
        if( nibbleSetted==1) currentPos++;
        nibbleSetted = 0;
        if((gBAP_Indication_data[currentPos] & 0x80) >= 1)
        {
        	 A_FSG_80_0_0_28_Data_5_SetGet_CntList[i] = 1;
            A_FSG_80_0_0_28_ArrayDataList[i].Param5_Length = ( (gBAP_Indication_data[currentPos++] & 0x7F) << 8) + (gBAP_Indication_data[currentPos++] & 0xFF);
        }
        else
        {
        	 A_FSG_80_0_0_28_Data_5_SetGet_CntList[i] = 0;
            A_FSG_80_0_0_28_ArrayDataList[i].Param5_Length = gBAP_Indication_data[currentPos++] & 0x7F;
        }
        for(j = 0; j < A_FSG_80_0_0_28_ArrayDataList[i].Param5_Length; j++)
        {
            A_FSG_80_0_0_28_ArrayDataList[i].Param5[j] = gBAP_Indication_data[currentPos++];
        }
      }
      } // for
    } else { // array header: decreasing indices (Direction = 1).
      if( (head[0] & 0x10) > 0) { // array header: first element is one before specified start element (Shift = 1, Direction = 1).
        if(startVal != 0) {          startVal--;
        } else {
          startVal = A_FSG_80_0_0_28_ArrayDataList_Length -1;
        }
      }
      for ( i = startVal ; i > startVal - elementsVal ; i--) {
        if ( i < 0 || i >= A_FSG_80_0_0_28_ArrayDataList_Length ) {
          write("Array index ausserhalb der Grenzen, Fct: 28");
          break;
        }
        if(nibbleSetted == 1) currentPos++;
        nibbleSetted = 0;
     if( (head[0]&0x40) == 0){ /* Transmit_Pos = 0, keine Positionsdaten */ }
     else
     {
        if( (head[0]&0x80) == 0)
        {
           //IndexSize = 0, Pos als 1 Byte Wert
           //Kein POS definiert
        }
        else
        {
           //IndexSize = 1, Pos als 2 Byte Wert
           //Kein POS definiert
        }
     }
      // 0 - es kann vorkommen, dass das if leer ist dies wuerde zum Fehler fuehren. => automatische generierung der 0
      if( 0 || 1 == recordAddressVal || 2 == recordAddressVal || 3 == recordAddressVal )
      {
        //Sollte vor einem 4 Byte Wert 1 Nibble kommen, muss der index um 1 incrementiert werden!
        if( nibbleSetted==1) currentPos++;
        nibbleSetted = 0;
        A_FSG_80_0_0_28_ArrayDataList[i].Param1 = (gBAP_Indication_data[currentPos++] & 0xFF) + ((gBAP_Indication_data[currentPos++] & 0xFF) <<8) + ((gBAP_Indication_data[currentPos++] & 0xFF) <<16) + ((gBAP_Indication_data[currentPos++] & 0xFF) <<24);
      }
      // 0 - es kann vorkommen, dass das if leer ist dies wuerde zum Fehler fuehren. => automatische generierung der 0
      if( 0 || 1 == recordAddressVal || 2 == recordAddressVal || 3 == recordAddressVal )
      {
        //Sollte vor einem 1 Byte Wert 1 Nibble kommen, muss der index um 1 incrementiert werden!
        if( nibbleSetted==1) currentPos++;
        nibbleSetted = 0;
        A_FSG_80_0_0_28_ArrayDataList[i].Param2 = (gBAP_Indication_data[currentPos++] & 0xFF);
      }
      // 0 - es kann vorkommen, dass das if leer ist dies wuerde zum Fehler fuehren. => automatische generierung der 0
      if( 0 || 2 == recordAddressVal || 3 == recordAddressVal )
      {
        //Sollte vor einem 1 Byte Wert 1 Nibble kommen, muss der index um 1 incrementiert werden!
        if( nibbleSetted==1) currentPos++;
        nibbleSetted = 0;
        A_FSG_80_0_0_28_ArrayDataList[i].Param3 = (gBAP_Indication_data[currentPos++] & 0xFF);
      }
      // 0 - es kann vorkommen, dass das if leer ist dies wuerde zum Fehler fuehren. => automatische generierung der 0
      if( 0 || 3 == recordAddressVal )
      {
        //Sollte vor einem 4 Byte Wert 1 Nibble kommen, muss der index um 1 incrementiert werden!
        if( nibbleSetted==1) currentPos++;
        nibbleSetted = 0;
        A_FSG_80_0_0_28_ArrayDataList[i].Param4 = (gBAP_Indication_data[currentPos++] & 0xFF) + ((gBAP_Indication_data[currentPos++] & 0xFF) <<8) + ((gBAP_Indication_data[currentPos++] & 0xFF) <<16) + ((gBAP_Indication_data[currentPos++] & 0xFF) <<24);
      }
      // 0 - es kann vorkommen, dass das if leer ist dies wuerde zum Fehler fuehren. => automatische generierung der 0
      if( 0 || 3 == recordAddressVal )
      {
        //Sollte vor einem String Wert 1 Nibble kommen, muss der index um 1 incrementiert werden!
        if( nibbleSetted==1) currentPos++;
        nibbleSetted = 0;
        if((gBAP_Indication_data[currentPos] & 0x80) >= 1)
        {
        	 A_FSG_80_0_0_28_Data_5_SetGet_CntList[i] = 1;
            A_FSG_80_0_0_28_ArrayDataList[i].Param5_Length = ( (gBAP_Indication_data[currentPos++] & 0x7F) << 8) + (gBAP_Indication_data[currentPos++] & 0xFF);
        }
        else
        {
        	 A_FSG_80_0_0_28_Data_5_SetGet_CntList[i] = 0;
            A_FSG_80_0_0_28_ArrayDataList[i].Param5_Length = gBAP_Indication_data[currentPos++] & 0x7F;
        }
        for(j = 0; j < A_FSG_80_0_0_28_ArrayDataList[i].Param5_Length; j++)
        {
            A_FSG_80_0_0_28_ArrayDataList[i].Param5[j] = gBAP_Indication_data[currentPos++];
        }
      }
      } // for
    }
    nibbleSetted = 0;
index = getValue(A_FSG_80_0_0_28_DataIndex);
    putValue(A_FSG_80_0_0_28_Data_1, A_FSG_80_0_0_28_ArrayDataList[index].Param1);
    putValue(A_FSG_80_0_0_28_Data_2, A_FSG_80_0_0_28_ArrayDataList[index].Param2);
    putValue(A_FSG_80_0_0_28_Data_3, A_FSG_80_0_0_28_ArrayDataList[index].Param3);
    putValue(A_FSG_80_0_0_28_Data_4, A_FSG_80_0_0_28_ArrayDataList[index].Param4);
    putValue(A_FSG_80_0_0_28_Data_5_len, A_FSG_80_0_0_28_Data_5_LenList[index]);
    putValue(A_FSG_80_0_0_28_Data_5_cnt, A_FSG_80_0_0_28_Data_5_CntList[index]);
    putValue(A_FSG_80_0_0_28_Data_5, A_FSG_80_0_0_28_ArrayDataList[index].Param5, A_FSG_80_0_0_28_ArrayDataList[index].Param5_Length);
}

A_FSG_80_0_0_28_GetInd()
{
    int currentPos;
    byte head[5];
    byte stringTempValue[4032];
    int i;
    int j;
    int startVal;
    int elementsVal;
    byte recordAddressVal;
    byte transmitPosVal;
    long tempValue;
    long index;
    byte nibbleSetted;
    currentPos = 0;
    nibbleSetted = 0;
    //Einzelparameter: Operation
    //voriger Parameter war ein first nibble, bei 1 Byte Werten Position incr
    if(nibbleSetted == 1) currentPos++;
    nibbleSetted = 0;
    tempValue = gBAP_Indication_data[currentPos++];
    putValue(A_FSG_80_0_0_28_1_SetGet, tempValue);
    //Einzelparameter: Type
    //voriger Parameter war ein first nibble, bei 1 Byte Werten Position incr
    if(nibbleSetted == 1) currentPos++;
    nibbleSetted = 0;
    tempValue = gBAP_Indication_data[currentPos++];
    putValue(A_FSG_80_0_0_28_2_SetGet, tempValue);
    //Einzelparameter: Slot
    //voriger Parameter war ein first nibble, bei 1 Byte Werten Position incr
    if(nibbleSetted == 1) currentPos++;
    nibbleSetted = 0;
    tempValue = gBAP_Indication_data[currentPos++];
    putValue(A_FSG_80_0_0_28_3_SetGet, tempValue);
    //Einzelparameter: ASG_ID
    if(nibbleSetted == 1)
    {
        //voriger Parameter war ein Nibble, => second nibble, Pos incr und Flag zuruecksetzen
        tempValue = (gBAP_Indication_data[currentPos++] &0xF);
        nibbleSetted = 0;
    }
    else
    {
        //first nibble, kein increment, Flag setzen
        tempValue = ((gBAP_Indication_data[currentPos]>>4) &0xF);
        nibbleSetted = 1;
    }
    putValue(A_FSG_80_0_0_28_4_SetGet, tempValue);
    //Einzelparameter: TAID
    if(nibbleSetted == 1)
    {
        //voriger Parameter war ein Nibble, => second nibble, Pos incr und Flag zuruecksetzen
        tempValue = (gBAP_Indication_data[currentPos++] &0xF);
        nibbleSetted = 0;
    }
    else
    {
        //first nibble, kein increment, Flag setzen
        tempValue = ((gBAP_Indication_data[currentPos]>>4) &0xF);
        nibbleSetted = 1;
    }
    putValue(A_FSG_80_0_0_28_5_SetGet, tempValue);
    //head Parameter
    if(gBAP_Indication_header[4] >= (3+currentPos))
    {
        if( (gBAP_Indication_data[currentPos] & 0x80) > 0)
            if(gBAP_Indication_header[4] >= (5+currentPos))
            {
                for(i = 0; i < 5; i++) head[i] = gBAP_Indication_data[currentPos++];
                putValue(A_FSG_80_0_0_28_SetGet, head, 5);
                if(getValue(A_FSG_80_0_0_28_AT))
                {
                    putValue(A_FSG_80_0_0_28,head,5);
                }
                startVal = (head[2]<<8) | head[1];
                elementsVal = (head[4]<<8) | head[3];
            }
            else write("received Data Error");
        else
        {
            for(i = 0; i < 3; i++) head[i] = gBAP_Indication_data[currentPos++];
            putValue(A_FSG_80_0_0_28_SetGet, head, 3);
            if(getValue(A_FSG_80_0_0_28_AT))
            {
                putValue(A_FSG_80_0_0_28,head,3);
            }
                startVal = head[1];
                elementsVal = head[2];
        }
        recordAddressVal = head[0] & 0x0F;
        transmitPosVal = head[0] & 0x40;
        if(getValue(A_FSG_80_0_0_28_AT))
        {
            putValue(A_FSG_80_0_0_28_RecAdr,recordAddressVal);
            putValue(A_FSG_80_0_0_28_Start, startVal);
            putValue(A_FSG_80_0_0_28_Elements, elementsVal);
            putValue(A_FSG_80_0_0_28_TransPos, transmitPosVal);
        }
    }
}

on envVar A_FSG_80_0_0_28_1
{
	byte superval[4032];

	//Update Childvalue (Enum)
	byte thisval; // Operation
	thisval = getValue(this);
}
on envVar A_FSG_80_0_0_28_2
{
	byte superval[4032];

	//Update Childvalue (Enum)
	byte thisval; // Type
	thisval = getValue(this);
}
// Ueberwachung der Darstellungsvariable der Range.
on envVar A_FSG_80_0_0_28_3_range // PSO_ImExport.Slot 
{
	@A_FSG_80_0_0_28_3 = @A_FSG_80_0_0_28_3_range - (0); // slider = range - min
}

on envVar A_FSG_80_0_0_28_3
{
	byte superval[4032];

	//Update Childvalue (Number)
	byte thisval; // Slot
	float slider_value;

	slider_value = round(@A_FSG_80_0_0_28_3, 1.0);
	@A_FSG_80_0_0_28_3_range = slider_value + (0); // real value := slider value + range min.
	thisval = (byte)round((slider_value + (0) - (0)) / (1.0), 1); // bus value := (slider value + min - offset) / step.
}
on envVar A_FSG_80_0_0_28_4_0
{
	byte bitval;
	//thisval steht hier fuer den bitfield-wert, 
	//aus Generierungsgruenden hier keine einheitliche Bezeichnung moeglich.
	byte thisval; // State
	bitval= getValue(this);
	thisval = getValue(A_FSG_80_0_0_28_4);
	thisval = thisval&~(1<<0)|(bitval<<0);
	putValue(A_FSG_80_0_0_28_4,thisval);
}

on envVar A_FSG_80_0_0_28_4_1
{
	byte bitval;
	//thisval steht hier fuer den bitfield-wert, 
	//aus Generierungsgruenden hier keine einheitliche Bezeichnung moeglich.
	byte thisval; // State
	bitval= getValue(this);
	thisval = getValue(A_FSG_80_0_0_28_4);
	thisval = thisval&~(1<<1)|(bitval<<1);
	putValue(A_FSG_80_0_0_28_4,thisval);
}

on envVar A_FSG_80_0_0_28_4_2
{
	byte bitval;
	//thisval steht hier fuer den bitfield-wert, 
	//aus Generierungsgruenden hier keine einheitliche Bezeichnung moeglich.
	byte thisval; // State
	bitval= getValue(this);
	thisval = getValue(A_FSG_80_0_0_28_4);
	thisval = thisval&~(1<<2)|(bitval<<2);
	putValue(A_FSG_80_0_0_28_4,thisval);
}

on envVar A_FSG_80_0_0_28_4
{
	byte superval[4032];

	//Update Childvalue (BitField)
	byte mask=0x01;
	int i = 0;
	byte thisval; // State
	thisval = getValue(this);
	if(thisval&(mask<<0))
		putValue(A_FSG_80_0_0_28_4_0, 1);
	else
		putValue(A_FSG_80_0_0_28_4_0, 0);
	if(thisval&(mask<<1))
		putValue(A_FSG_80_0_0_28_4_1, 1);
	else
		putValue(A_FSG_80_0_0_28_4_1, 0);
	if(thisval&(mask<<2))
		putValue(A_FSG_80_0_0_28_4_2, 1);
	else
		putValue(A_FSG_80_0_0_28_4_2, 0);
}
on envVar A_FSG_80_0_0_28_5
{
	byte superval[4032];

	//Update Childvalue (Enum)
	byte thisval; // ASG_ID
	thisval = 0x0f & getValue(this);
}
// Ueberwachung der Darstellungsvariable der Range.
on envVar A_FSG_80_0_0_28_6_range // PSO_ImExport.TAID 
{
	@A_FSG_80_0_0_28_6 = @A_FSG_80_0_0_28_6_range - (0); // slider = range - min
}

on envVar A_FSG_80_0_0_28_6
{
	byte superval[4032];

	//Update Childvalue (Number)
	byte thisval; // TAID
	float slider_value;

	slider_value = round(@A_FSG_80_0_0_28_6, 1.0);
	@A_FSG_80_0_0_28_6_range = slider_value + (0); // real value := slider value + range min.
	thisval = (byte)round((slider_value + (0) - (0)) / (1.0), 1); // bus value := (slider value + min - offset) / step.
}
// Ueberwachung der Darstellungsvariable der Range.
on envVar A_FSG_80_0_0_28_7_range // PSO_ImExport.TotalNumListElements 
{
	@A_FSG_80_0_0_28_7 = @A_FSG_80_0_0_28_7_range - (0); // slider = range - min
}

on envVar A_FSG_80_0_0_28_7
{
	byte superval[4032];

	//Update Childvalue (Number)
	word thisval; // TotalNumListElements
	float slider_value;

	slider_value = round(@A_FSG_80_0_0_28_7, 1.0);
	@A_FSG_80_0_0_28_7_range = slider_value + (0); // real value := slider value + range min.
	thisval = (word)round((slider_value + (0) - (0)) / (1.0), 1); // bus value := (slider value + min - offset) / step.
}
// Ueberwachung der Darstellungsvariable der Range.
on envVar A_FSG_80_0_0_28_Data_1_range // PSO_ImExport.Parameter_ID 
{
	@A_FSG_80_0_0_28_Data_1 = @A_FSG_80_0_0_28_Data_1_range - (0); // slider = range - min
}

on envVar A_FSG_80_0_0_28_Data_1
{
	byte superval[4032];

	//Update Childvalue (Number)
	dword thisval; // Parameter_ID
	float slider_value;

	slider_value = round(@A_FSG_80_0_0_28_Data_1, 1.0);
	@A_FSG_80_0_0_28_Data_1_range = slider_value + (0); // real value := slider value + range min.
	thisval = (dword)round((slider_value + (0) - (0)) / (1.0), 1); // bus value := (slider value + min - offset) / step.
    A_FSG_80_0_0_28_ArrayDataList[getValue(A_FSG_80_0_0_28_DataIndex)].Param1 = thisval;
}
// Ueberwachung der Darstellungsvariable der Range.
on envVar A_FSG_80_0_0_28_Data_2_range // PSO_ImExport.DataDescription 
{
	@A_FSG_80_0_0_28_Data_2 = @A_FSG_80_0_0_28_Data_2_range - (0); // slider = range - min
}

on envVar A_FSG_80_0_0_28_Data_2
{
	byte superval[4032];

	//Update Childvalue (Number)
	byte thisval; // DataDescription
	float slider_value;

	slider_value = round(@A_FSG_80_0_0_28_Data_2, 1.0);
	@A_FSG_80_0_0_28_Data_2_range = slider_value + (0); // real value := slider value + range min.
	thisval = (byte)round((slider_value + (0) - (0)) / (1.0), 1); // bus value := (slider value + min - offset) / step.
    A_FSG_80_0_0_28_ArrayDataList[getValue(A_FSG_80_0_0_28_DataIndex)].Param2 = thisval;
}
on envVar A_FSG_80_0_0_28_Data_3_0
{
	byte bitval;
	//thisval steht hier fuer den bitfield-wert, 
	//aus Generierungsgruenden hier keine einheitliche Bezeichnung moeglich.
	byte thisval; // DataTag
	bitval= getValue(this);
	thisval = getValue(A_FSG_80_0_0_28_Data_3);
	thisval = thisval&~(1<<0)|(bitval<<0);
	putValue(A_FSG_80_0_0_28_Data_3,thisval);
}

on envVar A_FSG_80_0_0_28_Data_3_4
{
	byte bitval;
	//thisval steht hier fuer den bitfield-wert, 
	//aus Generierungsgruenden hier keine einheitliche Bezeichnung moeglich.
	byte thisval; // DataTag
	bitval= getValue(this);
	thisval = getValue(A_FSG_80_0_0_28_Data_3);
	thisval = thisval&~(1<<4)|(bitval<<4);
	putValue(A_FSG_80_0_0_28_Data_3,thisval);
}

on envVar A_FSG_80_0_0_28_Data_3_5
{
	byte bitval;
	//thisval steht hier fuer den bitfield-wert, 
	//aus Generierungsgruenden hier keine einheitliche Bezeichnung moeglich.
	byte thisval; // DataTag
	bitval= getValue(this);
	thisval = getValue(A_FSG_80_0_0_28_Data_3);
	thisval = thisval&~(1<<5)|(bitval<<5);
	putValue(A_FSG_80_0_0_28_Data_3,thisval);
}

on envVar A_FSG_80_0_0_28_Data_3_6
{
	byte bitval;
	//thisval steht hier fuer den bitfield-wert, 
	//aus Generierungsgruenden hier keine einheitliche Bezeichnung moeglich.
	byte thisval; // DataTag
	bitval= getValue(this);
	thisval = getValue(A_FSG_80_0_0_28_Data_3);
	thisval = thisval&~(1<<6)|(bitval<<6);
	putValue(A_FSG_80_0_0_28_Data_3,thisval);
}

on envVar A_FSG_80_0_0_28_Data_3_7
{
	byte bitval;
	//thisval steht hier fuer den bitfield-wert, 
	//aus Generierungsgruenden hier keine einheitliche Bezeichnung moeglich.
	byte thisval; // DataTag
	bitval= getValue(this);
	thisval = getValue(A_FSG_80_0_0_28_Data_3);
	thisval = thisval&~(1<<7)|(bitval<<7);
	putValue(A_FSG_80_0_0_28_Data_3,thisval);
}

on envVar A_FSG_80_0_0_28_Data_3
{
	byte superval[4032];

	//Update Childvalue (BitField)
	byte mask=0x01;
	int i = 0;
	byte thisval; // DataTag
	thisval = getValue(this);
	if(thisval&(mask<<0))
		putValue(A_FSG_80_0_0_28_Data_3_0, 1);
	else
		putValue(A_FSG_80_0_0_28_Data_3_0, 0);
	if(thisval&(mask<<4))
		putValue(A_FSG_80_0_0_28_Data_3_4, 1);
	else
		putValue(A_FSG_80_0_0_28_Data_3_4, 0);
	if(thisval&(mask<<5))
		putValue(A_FSG_80_0_0_28_Data_3_5, 1);
	else
		putValue(A_FSG_80_0_0_28_Data_3_5, 0);
	if(thisval&(mask<<6))
		putValue(A_FSG_80_0_0_28_Data_3_6, 1);
	else
		putValue(A_FSG_80_0_0_28_Data_3_6, 0);
	if(thisval&(mask<<7))
		putValue(A_FSG_80_0_0_28_Data_3_7, 1);
	else
		putValue(A_FSG_80_0_0_28_Data_3_7, 0);
    A_FSG_80_0_0_28_ArrayDataList[getValue(A_FSG_80_0_0_28_DataIndex)].Param3 = thisval;
}
// Ueberwachung der Darstellungsvariable der Range.
on envVar A_FSG_80_0_0_28_Data_4_range // PSO_ImExport.DataLength 
{
	@A_FSG_80_0_0_28_Data_4 = @A_FSG_80_0_0_28_Data_4_range - (0); // slider = range - min
}

on envVar A_FSG_80_0_0_28_Data_4
{
	byte superval[4032];

	//Update Childvalue (Number)
	dword thisval; // DataLength
	float slider_value;

	slider_value = round(@A_FSG_80_0_0_28_Data_4, 1.0);
	@A_FSG_80_0_0_28_Data_4_range = slider_value + (0); // real value := slider value + range min.
	thisval = (dword)round((slider_value + (0) - (0)) / (1.0), 1); // bus value := (slider value + min - offset) / step.
    A_FSG_80_0_0_28_ArrayDataList[getValue(A_FSG_80_0_0_28_DataIndex)].Param4 = thisval;
}

// Ueberwachung der CheckBox fuer String
on envVar  A_FSG_80_0_0_28_Data_5_cnt
{
	word len;
	byte cnt;
	len = getValue(A_FSG_80_0_0_28_Data_5_len);
	cnt = getValue(this);

    /* Cnt Wert im Array aktualisieren */
	 A_FSG_80_0_0_28_Data_5_CntList[ getValue(A_FSG_80_0_0_28_DataIndex) ] = cnt;

	/* wird nur gerufen, wenn check box deaktiviert mit Length>127*/ 
	if(cnt == 0) 
	{
		if(len > 127 )
		{
			putValue(A_FSG_80_0_0_28_Data_5_len, 127);
		}
	}

}


on envVar A_FSG_80_0_0_28_Data_5_len
{
	long thisval;
	byte cnt;
	thisval = getValue(this);
	cnt = getValue(A_FSG_80_0_0_28_Data_5_cnt);

	/* wenn die Laenge ausserhalb des erlaubten Bereich liegt, wird diese begrenzt */
	if(thisval > 32765 || thisval < 0 )
	{
		writelineEx(gBAP_Trace, 0, "Eingegebene Laenge: %d von A_FSG_80_0_0_28_Data_5 ist ungueltig. Die max. erlaubte Laenge ist %d. ", thisval, 32765);
		thisval = 32765;
	}
	if( thisval >127)
	{
		putValue(A_FSG_80_0_0_28_Data_5_cnt, 1); /* Switch checkbox on */
	}

	A_FSG_80_0_0_28_ArrayDataList[getValue(A_FSG_80_0_0_28_DataIndex)].Param5_Length = thisval;
	A_FSG_80_0_0_28_Data_5_LenList[ getValue(A_FSG_80_0_0_28_DataIndex) ] = thisval;
	putValue(A_FSG_80_0_0_28_Data_5_len, thisval);

}

on envVar A_FSG_80_0_0_28_Data_5
{
	byte superval[4032];

	//Update Childvalue (String)
	word i;
	byte thisval[32767];
	getValue(this, thisval);
    for(i = 0; i < getValueSize(this); i++)
        A_FSG_80_0_0_28_ArrayDataList[getValue(A_FSG_80_0_0_28_DataIndex)].Param5[i] = thisval[i];
    A_FSG_80_0_0_28_ArrayDataList[getValue(A_FSG_80_0_0_28_DataIndex)].Param5_Length = getValueSize(this);
    A_FSG_80_0_0_28_Data_5_LenList[getValue(A_FSG_80_0_0_28_DataIndex)]= getValueSize(this);
    putValue(A_FSG_80_0_0_28_Data_5_len, getValueSize(this));
}
on envVar A_FSG_80_0_0_28_1_Changed
{
	byte superval[4032];

	//Update Childvalue (Enum)
	byte thisval; // Operation
	thisval = getValue(this);
}
on envVar A_FSG_80_0_0_28_2_Changed
{
	byte superval[4032];

	//Update Childvalue (Enum)
	byte thisval; // Type
	thisval = getValue(this);
}
// Ueberwachung der Darstellungsvariable der Range.
on envVar A_FSG_80_0_0_28_3_Changed_range // PSO_ImExport.Slot 
{
	@A_FSG_80_0_0_28_3_Changed = @A_FSG_80_0_0_28_3_Changed_range - (0); // slider = range - min
}

on envVar A_FSG_80_0_0_28_3_Changed
{
	byte superval[4032];

	//Update Childvalue (Number)
	byte thisval; // Slot
	float slider_value;

	slider_value = round(@A_FSG_80_0_0_28_3_Changed, 1.0);
	@A_FSG_80_0_0_28_3_Changed_range = slider_value + (0); // real value := slider value + range min.
	thisval = (byte)round((slider_value + (0) - (0)) / (1.0), 1); // bus value := (slider value + min - offset) / step.
}
on envVar A_FSG_80_0_0_28_1_SetGet
{
	byte superval[4029];

	//Update Childvalue (Enum)
	byte thisval; // Operation
	thisval = getValue(this);
}
on envVar A_FSG_80_0_0_28_2_SetGet
{
	byte superval[4029];

	//Update Childvalue (Enum)
	byte thisval; // Type
	thisval = getValue(this);
}
// Ueberwachung der Darstellungsvariable der Range.
on envVar A_FSG_80_0_0_28_3_SetGet_range // PSO_ImExport.Slot 
{
	@A_FSG_80_0_0_28_3_SetGet = @A_FSG_80_0_0_28_3_SetGet_range - (0); // slider = range - min
}

on envVar A_FSG_80_0_0_28_3_SetGet
{
	byte superval[4029];

	//Update Childvalue (Number)
	byte thisval; // Slot
	float slider_value;

	slider_value = round(@A_FSG_80_0_0_28_3_SetGet, 1.0);
	@A_FSG_80_0_0_28_3_SetGet_range = slider_value + (0); // real value := slider value + range min.
	thisval = (byte)round((slider_value + (0) - (0)) / (1.0), 1); // bus value := (slider value + min - offset) / step.
}
on envVar A_FSG_80_0_0_28_4_SetGet
{
	byte superval[4029];

	//Update Childvalue (Enum)
	byte thisval; // ASG_ID
	thisval = 0x0f & getValue(this);
}
// Ueberwachung der Darstellungsvariable der Range.
on envVar A_FSG_80_0_0_28_5_SetGet_range // PSO_ImExport.TAID 
{
	@A_FSG_80_0_0_28_5_SetGet = @A_FSG_80_0_0_28_5_SetGet_range - (0); // slider = range - min
}

on envVar A_FSG_80_0_0_28_5_SetGet
{
	byte superval[4029];

	//Update Childvalue (Number)
	byte thisval; // TAID
	float slider_value;

	slider_value = round(@A_FSG_80_0_0_28_5_SetGet, 1.0);
	@A_FSG_80_0_0_28_5_SetGet_range = slider_value + (0); // real value := slider value + range min.
	thisval = (byte)round((slider_value + (0) - (0)) / (1.0), 1); // bus value := (slider value + min - offset) / step.
}
// Ueberwachung der Darstellungsvariable der Range.
on envVar A_FSG_80_0_0_28_Data_1_SetGet_range // PSO_ImExport.Parameter_ID 
{
	@A_FSG_80_0_0_28_Data_1_SetGet = @A_FSG_80_0_0_28_Data_1_SetGet_range - (0); // slider = range - min
}

on envVar A_FSG_80_0_0_28_Data_1_SetGet
{
	byte superval[4029];

	//Update Childvalue (Number)
	dword thisval; // Parameter_ID
	float slider_value;

	slider_value = round(@A_FSG_80_0_0_28_Data_1_SetGet, 1.0);
	@A_FSG_80_0_0_28_Data_1_SetGet_range = slider_value + (0); // real value := slider value + range min.
	thisval = (dword)round((slider_value + (0) - (0)) / (1.0), 1); // bus value := (slider value + min - offset) / step.
    A_FSG_80_0_0_28_ArrayDataList[getValue(A_FSG_80_0_0_28_DataIndex_SetGet)].Param1 = thisval;
}
// Ueberwachung der Darstellungsvariable der Range.
on envVar A_FSG_80_0_0_28_Data_2_SetGet_range // PSO_ImExport.DataDescription 
{
	@A_FSG_80_0_0_28_Data_2_SetGet = @A_FSG_80_0_0_28_Data_2_SetGet_range - (0); // slider = range - min
}

on envVar A_FSG_80_0_0_28_Data_2_SetGet
{
	byte superval[4029];

	//Update Childvalue (Number)
	byte thisval; // DataDescription
	float slider_value;

	slider_value = round(@A_FSG_80_0_0_28_Data_2_SetGet, 1.0);
	@A_FSG_80_0_0_28_Data_2_SetGet_range = slider_value + (0); // real value := slider value + range min.
	thisval = (byte)round((slider_value + (0) - (0)) / (1.0), 1); // bus value := (slider value + min - offset) / step.
    A_FSG_80_0_0_28_ArrayDataList[getValue(A_FSG_80_0_0_28_DataIndex_SetGet)].Param2 = thisval;
}
on envVar A_FSG_80_0_0_28_Data_3_SetGet_0
{
	byte bitval;
	//thisval steht hier fuer den bitfield-wert, 
	//aus Generierungsgruenden hier keine einheitliche Bezeichnung moeglich.
	byte thisval; // DataTag
	bitval= getValue(this);
	thisval = getValue(A_FSG_80_0_0_28_Data_3_SetGet);
	thisval = thisval&~(1<<0)|(bitval<<0);
	putValue(A_FSG_80_0_0_28_Data_3_SetGet,thisval);
}

on envVar A_FSG_80_0_0_28_Data_3_SetGet_4
{
	byte bitval;
	//thisval steht hier fuer den bitfield-wert, 
	//aus Generierungsgruenden hier keine einheitliche Bezeichnung moeglich.
	byte thisval; // DataTag
	bitval= getValue(this);
	thisval = getValue(A_FSG_80_0_0_28_Data_3_SetGet);
	thisval = thisval&~(1<<4)|(bitval<<4);
	putValue(A_FSG_80_0_0_28_Data_3_SetGet,thisval);
}

on envVar A_FSG_80_0_0_28_Data_3_SetGet_5
{
	byte bitval;
	//thisval steht hier fuer den bitfield-wert, 
	//aus Generierungsgruenden hier keine einheitliche Bezeichnung moeglich.
	byte thisval; // DataTag
	bitval= getValue(this);
	thisval = getValue(A_FSG_80_0_0_28_Data_3_SetGet);
	thisval = thisval&~(1<<5)|(bitval<<5);
	putValue(A_FSG_80_0_0_28_Data_3_SetGet,thisval);
}

on envVar A_FSG_80_0_0_28_Data_3_SetGet_6
{
	byte bitval;
	//thisval steht hier fuer den bitfield-wert, 
	//aus Generierungsgruenden hier keine einheitliche Bezeichnung moeglich.
	byte thisval; // DataTag
	bitval= getValue(this);
	thisval = getValue(A_FSG_80_0_0_28_Data_3_SetGet);
	thisval = thisval&~(1<<6)|(bitval<<6);
	putValue(A_FSG_80_0_0_28_Data_3_SetGet,thisval);
}

on envVar A_FSG_80_0_0_28_Data_3_SetGet_7
{
	byte bitval;
	//thisval steht hier fuer den bitfield-wert, 
	//aus Generierungsgruenden hier keine einheitliche Bezeichnung moeglich.
	byte thisval; // DataTag
	bitval= getValue(this);
	thisval = getValue(A_FSG_80_0_0_28_Data_3_SetGet);
	thisval = thisval&~(1<<7)|(bitval<<7);
	putValue(A_FSG_80_0_0_28_Data_3_SetGet,thisval);
}

on envVar A_FSG_80_0_0_28_Data_3_SetGet
{
	byte superval[4029];

	//Update Childvalue (BitField)
	byte mask=0x01;
	int i = 0;
	byte thisval; // DataTag
	thisval = getValue(this);
	if(thisval&(mask<<0))
		putValue(A_FSG_80_0_0_28_Data_3_SetGet_0, 1);
	else
		putValue(A_FSG_80_0_0_28_Data_3_SetGet_0, 0);
	if(thisval&(mask<<4))
		putValue(A_FSG_80_0_0_28_Data_3_SetGet_4, 1);
	else
		putValue(A_FSG_80_0_0_28_Data_3_SetGet_4, 0);
	if(thisval&(mask<<5))
		putValue(A_FSG_80_0_0_28_Data_3_SetGet_5, 1);
	else
		putValue(A_FSG_80_0_0_28_Data_3_SetGet_5, 0);
	if(thisval&(mask<<6))
		putValue(A_FSG_80_0_0_28_Data_3_SetGet_6, 1);
	else
		putValue(A_FSG_80_0_0_28_Data_3_SetGet_6, 0);
	if(thisval&(mask<<7))
		putValue(A_FSG_80_0_0_28_Data_3_SetGet_7, 1);
	else
		putValue(A_FSG_80_0_0_28_Data_3_SetGet_7, 0);
    A_FSG_80_0_0_28_ArrayDataList[getValue(A_FSG_80_0_0_28_DataIndex_SetGet)].Param3 = thisval;
}
// Ueberwachung der Darstellungsvariable der Range.
on envVar A_FSG_80_0_0_28_Data_4_SetGet_range // PSO_ImExport.DataLength 
{
	@A_FSG_80_0_0_28_Data_4_SetGet = @A_FSG_80_0_0_28_Data_4_SetGet_range - (0); // slider = range - min
}

on envVar A_FSG_80_0_0_28_Data_4_SetGet
{
	byte superval[4029];

	//Update Childvalue (Number)
	dword thisval; // DataLength
	float slider_value;

	slider_value = round(@A_FSG_80_0_0_28_Data_4_SetGet, 1.0);
	@A_FSG_80_0_0_28_Data_4_SetGet_range = slider_value + (0); // real value := slider value + range min.
	thisval = (dword)round((slider_value + (0) - (0)) / (1.0), 1); // bus value := (slider value + min - offset) / step.
    A_FSG_80_0_0_28_ArrayDataList[getValue(A_FSG_80_0_0_28_DataIndex_SetGet)].Param4 = thisval;
}

// Ueberwachung der CheckBox fuer String
on envVar  A_FSG_80_0_0_28_Data_5_SetGet_cnt
{
	word len;
	byte cnt;
	len = getValue(A_FSG_80_0_0_28_Data_5_SetGet_len);
	cnt = getValue(this);

    /* Cnt Wert im Array aktualisieren */
	 A_FSG_80_0_0_28_Data_5_SetGet_CntList[ getValue(A_FSG_80_0_0_28_DataIndex_SetGet) ] = cnt;

	/* wird nur gerufen, wenn check box deaktiviert mit Length>127*/ 
	if(cnt == 0) 
	{
		if(len > 127 )
		{
			putValue(A_FSG_80_0_0_28_Data_5_SetGet_len, 127);
		}
	}

}


on envVar A_FSG_80_0_0_28_Data_5_SetGet_len
{
	long thisval;
	byte cnt;
	thisval = getValue(this);
	cnt = getValue(A_FSG_80_0_0_28_Data_5_SetGet_cnt);

	/* wenn die Laenge ausserhalb des erlaubten Bereich liegt, wird diese begrenzt */
	if(thisval > 32765 || thisval < 0 )
	{
		writelineEx(gBAP_Trace, 0, "Eingegebene Laenge: %d von A_FSG_80_0_0_28_Data_5_SetGet ist ungueltig. Die max. erlaubte Laenge ist %d. ", thisval, 32765);
		thisval = 32765;
	}
	if( thisval >127)
	{
		putValue(A_FSG_80_0_0_28_Data_5_SetGet_cnt, 1); /* Switch checkbox on */
	}

	A_FSG_80_0_0_28_ArrayDataList[getValue(A_FSG_80_0_0_28_DataIndex_SetGet)].Param5_Length = thisval;
	A_FSG_80_0_0_28_Data_5_SetGet_LenList[ getValue(A_FSG_80_0_0_28_DataIndex_SetGet) ] = thisval;
	putValue(A_FSG_80_0_0_28_Data_5_SetGet_len, thisval);

}

on envVar A_FSG_80_0_0_28_Data_5_SetGet
{
	byte superval[4029];

	//Update Childvalue (String)
	word i;
	byte thisval[32767];
	getValue(this, thisval);
    for(i = 0; i < getValueSize(this); i++)
        A_FSG_80_0_0_28_ArrayDataList[getValue(A_FSG_80_0_0_28_DataIndex_SetGet)].Param5[i] = thisval[i];
    A_FSG_80_0_0_28_ArrayDataList[getValue(A_FSG_80_0_0_28_DataIndex_SetGet)].Param5_Length = getValueSize(this);
    A_FSG_80_0_0_28_Data_5_SetGet_LenList[getValue(A_FSG_80_0_0_28_DataIndex_SetGet)]= getValueSize(this);
    putValue(A_FSG_80_0_0_28_Data_5_SetGet_len, getValueSize(this));
}

/**
*
* Template-Funktion zum automatischen befuellen der Array-Daten, die in einer Arrayfunktion genutzt werden.
* Die Funktion wird durch den von BAPSimGen generierten Code aufgerufen.
*
* Parameter:
* - structArray: Muss mindestens nMax * Arraygroesse Bytes Platz haben, wird vom BAPSimGen automatisch generiert
* - structElementsSizeArray: Enthaelt die Groesseangabe jedes Array-Elements. Die Arraygroesse entspricht der Elementanzahl im Array.
*       Byte & Nibble = 1; Word = 2; usw. Bei Strings wird die maximale Stringlaenge angegeben.
* - structElementsTypeArray: Gibt den Datentyp eines Array-Elements zurueck. Die Arraygroesse entspricht der Elmentanzahl im Array.
*                               0x0 = Zahlenwert, also ein Slider, Enum, Bitfield,...
*                               0xE = String (darauf folgt immer eine 2, mit der Angabe der benutzen Bytes im String)
*                               0xF = Laenge der Nutzdaten des Strings, nur return Wert
* - fctID: Kann zur Fallunterscheidung der Funktions-IDs verwendet werden.
* - nMax: Array-Index
*
* Die Funktion kann im Switch-Case beliebig erweitert werden. Der Switch-Case wertet den Parameter fctID aus.
*           
*                    
**/
initStruct(byte structArray[], dword structElementsSizeArray[], byte structElementsTypeArray[], dword structElementsMaxSizeArray[], word fctID, word nMax )
{
    byte rand8;
    word rand16;
    word randSize;
    word index;           //indexNr die an die String Parameter angehaengt wird.
    dword destArraySize;   //groesse von structArray
    dword destStructSize;  //groesse eines "Structs" also destArraySize / Anzahl Elemente (nMax))
    dword rand32;    
    dword i;
    dword pos;    //aktuelle Position im structArray
    dword elpos;  //aktuelle Position in den structElementsXXXArray's
   
    destArraySize = elCount(structArray);
    destStructSize = destArraySize / nMax;    

    Switch(fctID){

        //Idee ist, die Arrays je nach Funcion-ID speziell initalisieren zu koennen.
        //hierbei koennten die Daten z.B. aus einer Datei eingelesen werden,
        //oder auch ueber spezielle init Funktionen mit festen Werten initialisiert werden.
        //Der Default-Fall befuellt das Array mit Random-Werten und Strings mit einem vordefinierten Wort (hier test,)

        default :
        {
            pos = 0; 
            for(i = 1; i <= nMax; i++)
            {
                //walk through the array
                
                elpos = 0;
                while(pos < (destStructSize * i) )
                {   
                    //check Element type
                    if( structElementsTypeArray[elpos] == 0x0)          
                    { //Params like int, word, etc.
                        //check element length
                        Switch(structElementsSizeArray[elpos])
                        {
                            case(1) : //byte / nibble
                                rand8 = random(structElementsMaxSizeArray[elpos]);
                                structArray[pos] = rand8;
                                pos++;
                                break;

                            case(2) : //word / int
                                rand16 = random(structElementsMaxSizeArray[elpos]);
                                int2byte(structArray, pos, rand16);
                                pos += 2;
                                break;

                            case (4) : //dword / long
                                rand32 = random(structElementsMaxSizeArray[elpos]);
                                long2byte(structArray, pos, rand32);
                                pos += 4;
                                break;                        
                         }
                    }
                    else if(structElementsTypeArray[elpos] == 0xE)          
                    { //String Params like byte[]
                        randSize = random(structElementsSizeArray[elpos]);
                        if(randSize < 2) randSize = 2; 
                        index = i-1;
                        setRandomString(structArray ,pos ,structElementsSizeArray[elpos], randSize, index);
                        pos += structElementsSizeArray[elpos];
                    }
                    else if(structElementsTypeArray[elpos] == 0xF)          
                    {
                        int2byte(structArray, pos, randSize);
                        pos += 2;
                        //write("Pos: %d Strlth: %d Type: %d ",pos-1,randSize,structElementsTypeArray[elpos]);
                    
                    }
                    elpos++;
                }
            }   
        break;
        }            
    }
}

long2Byte(byte in[], dword pos, dword value)
{
    if( (elCount(in)-pos) < 4)
        write("Array out ouf bounds - too small!");
    in[pos] = value;
    in[++pos] = (value >> 8);
    in[++pos] = (value >> 16);
    in[++pos] = (value >> 24);
}

int2byte (byte in[],dword pos,word value)
{
    if( (elCount(in)-pos) < 2 )
        write("Array out of bounds - too small!");
    in[pos] = value;
    in[++pos] = (value >> 8);        
}

setRandomString (byte in[], dword pos, word strSize, word randSize, word count)
{
    word endPos, endString, j;
    byte testString[4]={'t','e','s','t'};
    
    endPos = pos + strSize;
    endString = pos + randSize;
    j=0;
    
    int2ascii(in, pos, count);
    pos += 2;
    
    for(pos; pos < endPos ;pos ++)
    {
        if(j > 3 )
            j = 0;
        if(pos < endString)
            in[pos] = testString[j++];
        else
            in[pos] = 0x0;
    }
}

int2ascii (byte in[], dword pos, word value)
{
    //Konvertiert nur die erste und zweite Dezimalstelle, also Zahlen zw. 0 und 99.
    
    //auf 2 Stellen kuerzen
    value = value%100;
    //10er schreiben
    in[pos] = (value/10) + 48;    //  0x30 hex = 48 dez = ascii null
    //1er schreiben
    in[pos+1] = (value%10) + 48;  //  0x30 hex = 48 dez = ascii null
}

Init_Arrays()
{
	byte Initval[3] = {0,0,0};
    putValue(M_FSG_80_0_0_16_Result, Initval, 2); 
    putValue(M_FSG_80_0_0_20_Result, Initval, 2); 
    putValue(M_FSG_80_0_0_23_Result, Initval, 2); 
    putValue(M_FSG_80_0_0_27_Result, Initval, 2); 
    putValue(A_FSG_80_0_0_22, Initval, 3); 
    putValue(A_FSG_80_0_0_22_Changed, Initval, 3); 
    putValue(A_FSG_80_0_0_24, Initval, 3); 
    putValue(A_FSG_80_0_0_24_Changed, Initval, 3); 
    putValue(A_FSG_80_0_0_28, Initval, 3); 
    putValue(A_FSG_80_0_0_28_Changed, Initval, 3); 
}

on envvar env_FSG_Panel_Infosettings
{
    if(@this)
    {
        OpenPanel("InfoSettings Main Panel");
    }
}
