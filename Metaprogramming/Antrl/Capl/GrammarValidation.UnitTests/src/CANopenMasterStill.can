/*@!Encoding:1252*/
// J. Raab 24.06.14

includes {
  
}

variables {
  
  // messages
  message ST_LiIoBMS_SDOreq     m1;
  message ST_ModuleControl      mc1;
  message ST_SYNC               mSync;
  message ST_Traction_Heartbeat msgTractionHB;
  message ST_Charger_Heartbeat  msgChargerHB;
  message ST_LiIoBMS_PDO1rx msgPDO1rx;
  message ST_TimeStamp mTimeStamp;
  
  // constants
  const CANopenSlaveNodeId = 0x3C;
  
  const syncTime = 10;
  const NumberOfHbBootUps = 11;
  const SendNomVoltDelayValueInMs = 100;
  
  const SDOuploadInitiate = 0x40;
  const SDOdownloadInitiate  = 0x20;

  const SDOAbortTransfer = 0x80;
  const SDOscsMask = 0xE0;
  const SDOCMask = 0x01; 
  const SDOstate_free = 0;
  const SDOstate_UploadInitiateSent = 1;
  const SDOstate_UploadSegmentSent = 2;

  const SDOstate_DownloadInitiateExpeditedSent = 6;
  const SDOstate_DownloadInitiateNormalSent = 7;
  const SDOstate_DownloadDataSent = 8;
  
  byte buffer[32];
  byte segmentedDataBuffer[5000];
  byte indexBuffer[2];
  byte oldState;
  dword SDOerrorCode;
  word lastSentID;
  int SDOstate = 0;
  int i = 0;
  int lastsegDataBufindex = 0;
  
  byte SDOrespSCS;
  byte SDOrespDataSize;
  word SDOrespIndex;
  byte SDOrespSubIndex;
  byte SDONumberofFreeBytes;
  byte SDOexpeditedOrNormal;
  byte SDOdataSize;
  
  byte ChargerHbBootupCount;
  byte TractionHbBootupCount;

  byte SDOuploadSegmentCommand = 0;
  int SDOsecondSegmentOffset = 0;
  
  byte QuittierungFehlerbits = 0;

  // timers
  msTimer syncTimer;
  msTimer SendNomvoltDelayTimer;
  msTimer PDO1rxXCyclicTimer;
  msTimer PDO1rxDelay;
  msTimer TimeInfoTimer;
  //on/off
  byte onBit;
  byte driveBit;
  byte chargeBit;
  byte diagBit;
  byte toggleBytes[2] = {0x70, 0x60};
  byte toggleBit = 0;
  long aucSysTime[9];
}

//-----------------------functions----------------------------------------------

void emptyBuffer(void){
  for (i=0; i<32; i++){
    buffer[i] = 0x0;
  }
}

void emptySegDatBuf(void){
  for (i=0; i<32; i++){
    segmentedDataBuffer[i] = 0x0;
  }
}

void writeSDOrequest(word index, byte subIndex, byte SDOcommand, byte valueBuffer [], byte SDOMessageChargerOrTraction ) {
  byte length;
  putValue(Still_SDOabortReason,"-");
  m1.ID = ST_LiIoBMS_SDOreq.ID;
  
  switch(SDOcommand){
    
    case SDOuploadInitiate:
      //status auf SDOuploadInitiateSent setzen
      SDOstate = SDOstate_UploadInitiateSent;
      m1.byte(3) = 0;
      m1.byte(4) = 0;
      m1.byte(5) = 0;
      m1.byte(6) = 0;
      m1.byte(7) = 0;
      break;
      
    case SDOdownloadInitiate: //data tx
      if (getLength(index) == 0){
        // n, e und s = 1; 3 Bytes leer, expedited transfer, size indicated
        SDOcommand = SDOcommand | 0x0F;
        SDOstate = SDOstate_DownloadInitiateExpeditedSent;
        m1.byte(4) = valueBuffer[0];
        m1.byte(3) = 0x0;
        m1.byte(5) = valueBuffer[1];
        m1.byte(6) = valueBuffer[2];
        m1.byte(7) = valueBuffer[3];
        
      }
      else {
        // size indicated
        SDOcommand = SDOdownloadInitiate | 0x1;
        SDOstate = SDOstate_DownloadInitiateNormalSent;
        m1.byte(4) = (byte)getLength(index);
        m1.byte(3) = 0x0;
        m1.byte(5) = 0x0;
        m1.byte(6) = 0x0;
        m1.byte(7) = 0x0;
      }
      break;
      
     case 0x00:
     case 0x15:
      SDOuploadSegmentCommand = toggleBits420(SDOuploadSegmentCommand);

      index = valueBuffer[1 + SDOsecondSegmentOffset]<<8 | valueBuffer[0 + SDOsecondSegmentOffset];
      m1.byte(3) = valueBuffer[2 + SDOsecondSegmentOffset];
      m1.byte(4) = valueBuffer[3 + SDOsecondSegmentOffset];
      m1.byte(5) = valueBuffer[4 + SDOsecondSegmentOffset];
      m1.byte(6) = valueBuffer[5 + SDOsecondSegmentOffset];
      m1.byte(7) = valueBuffer[6 + SDOsecondSegmentOffset];
      
      if (SDOsecondSegmentOffset == 7){
        SDOsecondSegmentOffset = 0;
        SDOstate = SDOstate_free;
        emptyBuffer();
      }
      else {
        SDOsecondSegmentOffset += 7;
      }
      break;
      
    default:
      break;
  }
    
    lastSentID = index;
    m1.byte(0) = SDOcommand;
    m1.byte(1) = index & 0x00FF;
    m1.byte(2) = (index & 0xFF00) >> 8;
    m1.byte(3) = subIndex;
    
//  }
  
  output(m1);
}

//------------------------------------------------------------------------------

void writeModuleControl(int command) {
  mc1.byte(0) = command;
  mc1.byte(1) = CANopenSlaveNodeId;
  output(mc1);
}

//------------------------------------------------------------------------------

byte getLength(word index) {
  int ret;
  switch(index){
    case 0x200f:
      ret = 0xC;
      break;
    case 0x2014:
      ret = 0xC;
      break;
    case 0x2022:
      ret = 0xC;
      break;
    case 0x2023:
      ret = 0xC;
      break;
    default:
      ret = 0x0;
      break;
  }
  return ret;
}
//------------------------------------------------------------------------------

byte toggleBits420(byte toToggle){
 return (toToggle ^ 0x15);
}

//------------------------------------------------------------------------------

void writeNomVoltViaSDO(void){
  emptyBuffer();
  buffer[0]= getValue(Still_NomVoltInValue); // 48dec Nominal Voltage
  writeSDOrequest(0x2270,1, SDOdownloadInitiate,buffer, 0);
}

void writeBatteryON(void) {
    onBit = getValue(Still_onBit);
    driveBit = getValue(Still_driveBit);
    chargeBit = getValue(Still_chargeBit);
    //diagBit = getValue(Still_diagBit);
  
    msgPDO1rx.Byte(0)= (onBit) | (driveBit << 1) | (chargeBit << 2);
    msgPDO1rx.Byte(1) = QuittierungFehlerbits;
    msgPDO1rx.Byte(7)= getValue(Still_WdCounterPDO1rx);
    
    output(msgPDO1rx);
    if (getValue(Still_incrementWdcountOnSend) == 1) {
      putValue(Still_WdCounterPDO1rx,(getValue(Still_WdCounterPDO1rx)+1));
    }
    if (getValue(Still_WdCounterPDO1rx) == 256) {
      putValue(Still_WdCounterPDO1rx,0);
    }
}
//------------------------------------------------------------------------------

on start  {
  setControlColors("CANopenMaster","Cyclic Check Box",MakeRGB(255,0,0),MakeRGB(0,0,0));
  setTimerCyclic(TimeInfoTimer, 0, 1000);
}

//------------------------------------------------------------------------------

on Timer SendNomvoltDelayTimer {
  writeNomVoltViaSDO();
}

on Timer TimeInfoTimer
{
  dword msSinceMidnight;
  int DaysSince84;
  if (getValue(Still_normalOperationEnable) == 1) {
    getLocalTime(aucSysTime);
    
    msSinceMidnight = (aucSysTime[0] + (aucSysTime[1] * 60) + ((aucSysTime[3]-1) * 3600)) * 1000; //ms(+1 i dont know why)
    DaysSince84 = 5848  + ((aucSysTime[5]-100) * 365) + aucSysTime[7];  //5848 is days from 1984 - 2000(which is reference of our fkt)
    mTimeStamp.Byte(0) = msSinceMidnight;      //0xA8; test bsp
    mTimeStamp.Byte(1) = msSinceMidnight >> 8; //0x95;
    mTimeStamp.Byte(2) = msSinceMidnight >> 16; //0x98;
    mTimeStamp.Byte(3) = msSinceMidnight >> 24; //0x01;
    mTimeStamp.Byte(4) = (DaysSince84 & 0xFF);
    mTimeStamp.Byte(5) = (DaysSince84 & 0xFF00) >> 8;

    mTimeStamp.DLC = 6;
    output(mTimeStamp);
  }
}

on Timer PDO1rxDelay {
  putValue(Still_writeBatteryOn,0);
  putValue(Still_writeBatteryOn,1);
  putValue(Still_sendPDO1rxCyclic,0);
  putValue(Still_sendPDO1rxCyclic,1);
}

on Timer PDO1rxXCyclicTimer {
  writeBatteryON();
  if (getValue(Still_sendPDO1rxCyclic) == 1) {
    setTimer(PDO1rxXCyclicTimer, getValue(Still_PDO1rxCycle));
  }
}
//------------------------------------------------------------------------------

on envVar (Still_sendPDO1rxCyclic) {
  if (getValue(Still_sendPDO1rxCyclic) == 0) {
  setControlColors("CANopenMaster","Cyclic Check Box",MakeRGB(255,0,0),MakeRGB(0,0,0));
  }
}

on envVar (Still_ODListIndexRaw) {
  word tempVal;
  byte tempBuf[2];
  tempVal =getValue(Still_ODListIndexRaw);
  tempBuf [0] = tempVal >> 8;
  tempBuf [1] = tempVal;
  putValue(Still_ODindex,tempBuf);
}

on envVar (Still_normalOperationEnable) {
    if (getValue(Still_normalOperationEnable) == 1){
      writeModuleControl(0x1);
      setTimer(SendNomvoltDelayTimer, SendNomVoltDelayValueInMs);
      putValue(Still_AutoSendNomVoltEnable,1);
      setTimer(PDO1rxDelay,300);
    }
    else {
      putValue(Still_syncEnable,0);
      putValue(Still_AutoSendNomVoltEnable,0);
      putValue(Still_sendPDO1rxCyclic,0);
    }
}

//------------------------------------------------------------------------------

on envVar(Still_syncEnable) {
  setTimer(syncTimer, syncTime);
}

on Timer syncTimer {
  output (mSync);
  if (getValue(Still_syncEnable) == 1) {
  setTimer(syncTimer, syncTime);
  }
}
//------------------------------------------------------------------------------

on envVar(Still_readBatteryOn) {
  if (getValue(Still_readBatteryOn) == 1) {
    emptybuffer();
    buffer[0] = 0;
    writeSDOrequest(0x2017,0, SDOuploadInitiate, buffer, 0); 
  }
}

on envVar(Still_writeBatteryOn) {
  if (getValue(Still_writeBatteryOn) == 1) {
    writeBatteryON();
    if (getValue(Still_sendPDO1rxCyclic) == 1) {
      setTimer(PDO1rxXCyclicTimer, getValue(Still_PDO1rxCycle));
      setControlColors("CANopenMaster","Cyclic Check Box",MakeRGB(0,255,0),MakeRGB(0,0,0));
    }
  }
}
//------------------------------------------------------------------------------

on EnvVar (Still_readNomVolt) {
  if (getValue(Still_readNomVolt) == 1) {
    emptybuffer();
    writeSDOrequest(0x2270,1, SDOuploadInitiate, buffer,0);
  }
}

on EnvVar (Still_writeNomVolt) {
  if (getValue(Still_writeNomVolt) == 1) {
    emptybuffer();
    buffer[0] = getValue(Still_NomVoltInValue);
    writeSDOrequest(0x2270,1, SDOdownloadInitiate,buffer,0);
  }
}

//------------------------------------------------------------------------------

on envVar(Still_ReadOD) {
  word localIndex;
  if (getValue(Still_ReadOD) == 1) {
    emptyBuffer();
    getValue(Still_ODindex, indexBuffer);
    localIndex = (indexBuffer[0]<<8 | indexBuffer[1]);
    writeSDOrequest(localIndex, getValue(Still_ODsubIndex), SDOuploadInitiate, buffer, 0);
  }
}
  
on envVar(Still_WriteOD) {
  if (getValue(Still_WriteOD) == 1) {
    word localIndex;
    byte SDOcommand;
    emptyBuffer();
    getValue(Still_ODInOutVal, buffer);
    getValue(Still_ODindex, indexBuffer);
    localIndex = (indexBuffer[0]<<8 | indexBuffer[1]);
    writeSDOrequest(localIndex,getValue(Still_ODsubIndex), SDOdownloadInitiate, buffer,0);
  }
}

on envVar(Still_ReadErrorData) {
  if (getValue(Still_ReadErrorData) == 1) {
    emptyBuffer();
    getValue(Still_ODindex, indexBuffer);
    writeSDOrequest(0x2320, 0x5, SDOuploadInitiate, buffer, 0);
  }
}

//------------------------------------------------------------------------------

on envVar(Still_startNode) {
  if(getValue(this) == 1) {
    writeModuleControl(0x1);
  }
}
on envVar(Still_stopNode) {
  if(getValue(this) == 1) {
    writeModuleControl(0x2);
  }
}
on envVar(Still_resetComm) {
  if(getValue(this) == 1) {
    writeModuleControl(0x82);
  }
}
on envVar(Still_resetNode) {
  if(getValue(this) == 1) {
    writeModuleControl(0x81);
  }
}
on envVar(Still_enterPreop) {
  if(getValue(this) == 1) {
    writeModuleControl(0x80);
  }
}

on envVar(Still_resetECU) {
    if (getValue(Still_resetECU) == 1) {
    emptybuffer();
    buffer[0] = 1;
    writeSDOrequest(0x2201,1, SDOdownloadInitiate,buffer, 0);
  }
}

on envVar(Still_ResetMalfunction) {
    if (getValue(Still_ResetMalfunction) == 1) {
    m1.BYTE(0) = 0x2F;
    m1.BYTE(1) = 0x12;
    m1.BYTE(2) = 0x22;
    m1.BYTE(3) = 0x0;
    m1.BYTE(4) = 0x1;
    m1.BYTE(5) = 0x0;
    m1.BYTE(6) = 0x0;
    m1.BYTE(7) = 0x0;
    output(m1);
  }
}

on envVar(Still_Quit_Fehlerbits) {
  
  QuittierungFehlerbits = getValue(Still_Quit_Fehlerbits);
}

//------------------------------------------------------------------------------

on message ST_LiIoBMS_SDOresp, ST_LiIoBMS_SDOresp2  {
  byte SDOcommandTemp;
  SDOrespSCS = this.byte(0) & SDOscsMask;
  SDONumberofFreeBytes = (this.byte(0) & 0x0C)>>2;
  SDOrespDataSize = this.byte(0) & 0x0F;
  SDOrespIndex = (this.byte(2) << 8) | this.byte(1);
  SDOexpeditedOrNormal = (this.byte(0) & 0x2)>>1;
  SDOdataSize = this.byte(0) & 0x1;
  
    switch(SDOrespSCS){
    case 0x40:
      // Response to SDOuploadInitiate (read)
      if (SDOstate == SDOstate_UploadInitiateSent){
        // expedited transfer
        if (SDOexpeditedOrNormal == 1) {
            if ((SDOrespIndex == 0x2200) && (SDOrespSubIndex == 0x1))  {
                putValue(Still_BatteryOnState, this.byte(4));
              }
              else if((SDOrespIndex == 0x2200) && (SDOrespSubIndex == 0x2)){
                putValue(Still_BatteryOffState, this.byte(4));
              }
              else if(SDOrespIndex == 0x2270){
                putValue(Still_NomVoltOutValue, this.byte(4));
              }
              else {
                emptyBuffer();
                buffer[3] = this.byte(4);
                buffer[2] = this.byte(5);
                buffer[1] = this.byte(6);
                buffer[0] = this.byte(7);
                putValue(Still_ODInOutVal,buffer);
              }
              SDOstate = SDOstate_free;
        }
        // normal transfer
        else if (SDOexpeditedOrNormal == 0) {
          // Response to SDOuploadInitiate if data > 4 Byte
          emptyBuffer();
          writeSDOrequest(0,0, 0x60, buffer,0);
          SDOstate = SDOstate_UploadSegmentSent;
        }
      }
      break;
     
    case 0x0:
        if (SDOstate == SDOstate_UploadSegmentSent){
          for(i=1; i < (8 - ((this.byte(0) & 0x0E)>>1)); i++){
            segmentedDataBuffer[i-1+lastsegDataBufindex] = this.byte(i);
          }
          lastsegDataBufindex = i-1;
          if ((this.byte(0) & SDOCMask) == 0x00){
            // mehr daten kommen
            writeSDOrequest(0,0, toggleBytes[toggleBit], buffer,0);
            toggleBit = toggleBit ^ 1;
          }
          else {
            // fertig
            toggleBit = 0;
            putValue(Still_ODInOutVal, segmentedDataBuffer);
            emptySegDatBuf();
            SDOstate = SDOstate_free;
            lastsegDataBufindex = 0;
          }
        }
    break;
    case 0x60:
        if (SDOstate == SDOstate_DownloadInitiateNormalSent){
          emptyBuffer();
          getValue(Still_ODInOutVal,buffer);
          writeSDOrequest(0,0,SDOuploadSegmentCommand,buffer,0);
          SDOstate = SDOstate_DownloadDataSent;
        }
        else if (SDOstate == SDOstate_DownloadInitiateExpeditedSent){
          SDOstate = SDOstate_free;
        }
        break;
    case 0x20:
        if (SDOstate == SDOstate_DownloadDataSent){
          emptyBuffer();
          getValue(Still_ODInOutVal,buffer);
          writeSDOrequest(0,0, SDOuploadSegmentCommand, buffer,0);
        }

        break;

    case SDOAbortTransfer:
          // SDO Abort
          SDOerrorCode = (this.byte(7)<< 24) | (this.byte(6)<< 16) | (this.byte(5)<< 8) | (this.byte(4));
          write ("%x",SDOerrorCode);
          switch (SDOerrorCode) {
            case 0x05030000:
              putValue(Still_SDOabortReason, "Toggle bit not alternated");
              break;
            case 0x05040000:
              putValue(Still_SDOabortReason, "SDO protocol timed out");
              break;
            case 0x05040001:
              putValue(Still_SDOabortReason, "Client/server command specifier not valid or unknown");
              break;
            case 0x05040002:
              putValue(Still_SDOabortReason, "Invalid block size (block mode only)");
              break;
            case 0x05040003:
              putValue(Still_SDOabortReason, "Invalid sequence number (block mode only)");
              break;
            case 0x05040004:
              putValue(Still_SDOabortReason, "CRC error (block mode only)");
              break;
            case 0x05040005:
              putValue(Still_SDOabortReason, "Out of Menory");
              break;
            case 0x06010000:
              putValue(Still_SDOabortReason, "Unsupported access to an object");
              break;
            case 0x06010001:
              putValue(Still_SDOabortReason, "Attempt to read a write only object");
              break;
            case 0x06010002:
              putValue(Still_SDOabortReason, "Attempt to write a read only object");
              break;
            case 0x06020000:
              putValue(Still_SDOabortReason, "Object does not exist in the object dictionary");
              break;
            case 0x06040041:
              putValue(Still_SDOabortReason, "Object can not be mapped to the PDO");
              break;
            case 0x06040042:
              putValue(Still_SDOabortReason, "The number and length of the objects to be mapped wolud exceed PDO length");
              break;
            case 0x06040043:
              putValue(Still_SDOabortReason, "General parameter incompatibility reason");
              break;
            case 0x06040047:
              putValue(Still_SDOabortReason, "General internal incompatibility in the device");
              break;
            case 0x06060000:
              putValue(Still_SDOabortReason, "Access failed due to an hardware error");
              break;
            case 0x06070010:
              putValue(Still_SDOabortReason, "Data type does not match, length of cervice parameter does not match");
              break;
            case 0x06070012:
              putValue(Still_SDOabortReason, "Data type does not match, length of service parameter too high");
              break;
            case 0x06070013:
              putValue(Still_SDOabortReason, "Data type does not match, length of service parameter too low");
              break;
            case 0x06090011:
              putValue(Still_SDOabortReason, "Sub-index does not exist");
              break;
            case 0x06090030:
              putValue(Still_SDOabortReason, "Valule range of parameter exceeded (only for wirte access)");
              break;
            case 0x06090031:
              putValue(Still_SDOabortReason, "Value of parameter wirtten too high");
              break;
            case 0x06090032:
              putValue(Still_SDOabortReason, "Value of parameter written too low");
              break;
            case 0x06090036:
              putValue(Still_SDOabortReason, "Maximum value is less than minimum value");
              break;
            case 0x08000000:
              putValue(Still_SDOabortReason, "general error");
              break;
            case 0x08000020:
              putValue(Still_SDOabortReason, "Data can not be transferred or stored to the application");
              break;
            case 0x08000021:
              putValue(Still_SDOabortReason, "Data can  not be transfered or stored to the application because of local control");
              break;
            case 0x08000022:
              putValue(Still_SDOabortReason, "Data can not be transferred or stored to the application because of the present device state");
              break;
            case 0x08000023:
              putValue(Still_SDOabortReason, "Object dictionary dynamic generation fails or no object dictionary is present");
              break;
            default:
              break;
          }
         break;
       default:
         break;
     }
}

//------------------------------------------------------------------------------

on message ST_LiIoBMS_Heartbeat {

  /* answer first heartbeat with modulcontrol go Operational*/
 if ((this.byte(0) == 0) && (getValue(Still_normalOperationEnable) == 1)){
   writeModuleControl(0x1);
 }
}

